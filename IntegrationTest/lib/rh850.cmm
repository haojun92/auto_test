
SYStem.RESet
SYStem.CPU R7F702300EBBG
SYStem.JtagClock 10.MHz
SYStem.CORECLOCK 400000000.
SYStem.OsCCLOCK 16000000.
SYStem.BAUDRATE 1000Kbps
SYStem.MemAccess CPU
SYStem.CpuBreak Enable
SYStem.CpuSpot Enable
SYStem.CONFIG CoreNumber 4.
SYStem.CONFIG CORE 1. 1.
CORE.ASSIGN 1. 2. 3. 4.
SYStem.Option.DUALPORT OFF
SYStem.Option IMASKASM OFF
SYStem.Option IMASKHLL OFF
SYStem.Option RESET ON
SYStem.Option STOP ON
SYStem.Option WAIT ON
SYStem.Option REQ ON
SYStem.Option PerStop OFF
SYStem.Option FLMD0 ON
SYStem.Option RDYLINE OFF
SYStem.Option SLOWRESET OFF
SYStem.CONFIG SLAVE OFF
SYStem.CONFIG TAPState SELectDRscan
;SYStem.Option OCDID 0xFFFFFFFF 0xFFFFFFFF 0xFFFFFFFF 0xFFFFFFFF 0xFFFFFFFF 0xFFFFFFFF 0xFFFFFFFF 0xFFFFFFFF
;SYStem.Option CFID 0xFFFFFFFF 0xFFFFFFFF 0xFFFFFFFF 0xFFFFFFFF 0xFFFFFFFF 0xFFFFFFFF 0xFFFFFFFF 0xFFFFFFFF
;SYStem.Option DFID 0xFFFFFFFF 0xFFFFFFFF 0xFFFFFFFF 0xFFFFFFFF 0xFFFFFFFF 0xFFFFFFFF 0xFFFFFFFF 0xFFFFFFFF

SYStem.CONFIG DEBUGPORTTYPE CSI
SYStem.Mode prepare

MAP.RESet
&opbt12=Data.Long(d:0xff3213d0)

MAP.DenyAccess  ; disable all memory accesses (default)
                ; enable memory access for declared flash areas only

FLASH.RESet

IF ((&opbt12&0x3)==0) ; ----------- DoubleMapMode -----------
(
  FLASH.Create 1.  C:0x00000000--0x0001FFFF 0x00004000 RH850 Long /INFO "User Area 0/1"
  FLASH.Create 1.  C:0x00020000--0x003FFFFF 0x00010000 RH850 Long /INFO "User Area 0/1"
  FLASH.Create 1.  C:0x00400000--0x0041FFFF 0x00004000 RH850 Long /INFO "User Area 2/3"
  FLASH.Create 1.  C:0x00420000--0x007FFFFF 0x00010000 RH850 Long /INFO "User Area 2/3"
  MAP.NoDenyAccess C:0x00000000--0x007FFFFF

  FLASH.Create 3.  C:0x08000000--0x0800FFFF 0x00010000 RH850 Long /INFO "User Boot Area 0/1"
  MAP.NoDenyAccess C:0x08000000--0x0800FFFF
)
ELSE                  ; ----------- SingleMapMode -----------
(
  FLASH.Create 1.  C:0x00000000--0x0001FFFF 0x00004000 RH850 Long /INFO "User Area 0"
  FLASH.Create 1.  C:0x00020000--0x003FFFFF 0x00010000 RH850 Long /INFO "User Area 0"
  FLASH.Create 1.  C:0x00400000--0x0041FFFF 0x00004000 RH850 Long /INFO "User Area 1"
  FLASH.Create 1.  C:0x00420000--0x007FFFFF 0x00010000 RH850 Long /INFO "User Area 1"
  FLASH.Create 1.  C:0x00800000--0x0081FFFF 0x00004000 RH850 Long /INFO "User Area 2"
  FLASH.Create 1.  C:0x00820000--0x00BFFFFF 0x00010000 RH850 Long /INFO "User Area 2"
  FLASH.Create 1.  C:0x00C00000--0x00C1FFFF 0x00004000 RH850 Long /INFO "User Area 3"
  FLASH.Create 1.  C:0x00C20000--0x00FFFFFF 0x00010000 RH850 Long /INFO "User Area 3"
  MAP.NoDenyAccess C:0x00000000--0x00FFFFFF

  FLASH.Create 3.  C:0x08000000--0x0800FFFF 0x00010000 RH850 Long /INFO "User Boot Area 0"
  MAP.NoDenyAccess C:0x08000000--0x0800FFFF

  FLASH.Create 3.  C:0x08400000--0x0840FFFF 0x00010000 RH850 Long /INFO "User Boot Area 1"
  MAP.NoDenyAccess C:0x08400000--0x0840FFFF
)

FLASH.Create 2.  C:0xFF200000--0xFF28FFFF 0x00001000 RH850 Long /INFO "Data Area"
MAP.NoDenyAccess C:0xFF200000--0xFF28FFFF

FLASH.Create 2.  C:0xFF320000--0xFF3207FF 0x00000800 RH850 Long /INFO "Data Extra Area"
MAP.NoDenyAccess C:0xFF320000--0xFF3207FF

;  FLASH.Create 7.  C:0xFF321200--0xFF3217FF 0x00000600 RH850CFG Long /INFO "Configuration Area"
MAP.NoDenyAccess C:0xFF321200--0xFF3217FF

;  FLASH.Create 7.  C:0xFF322200--0xFF3227FF 0x00000600 RH850CFG Long /INFO "Security Setting Area"
MAP.NoDenyAccess C:0xFF322200--0xFF3227FF

;  FLASH.Create 7.  C:0xFF323200--0xFF3237FF 0x00000600 RH850CFG Long /INFO "Block Protection Area 0"
MAP.NoDenyAccess C:0xFF323200--0xFF3237FF

;  FLASH.Create 7.  C:0xFF340A00--0xFF340FFF 0x00000600 RH850CFG Long /INFO "Block Protection Area 1"
MAP.NoDenyAccess C:0xFF340A00--0xFF340FFF
MAP.NoDenyAccess C:0xFE820000--0xFE83FFFF

DOWNLOAD_FLASH:
FLASH.ReProgram ALL
Data.LOAD.auto "D:\CICT\IntegrationTest\input\pilot3.1_e01_project_mcu_FULL_A.hex" 
FLASH.ReProgram.off

SYSTEM_SET:
SYStem.RESet
SYStem.CPU R7F702300EBBG
SYStem.JtagClock 10.MHz
SYStem.CORECLOCK 400000000.
SYStem.OsCCLOCK 16000000.
SYStem.BAUDRATE 1000Kbps
SYStem.MemAccess CPU
SYStem.CpuBreak Enable
SYStem.CpuSpot Enable
SYStem.CONFIG CoreNumber 4.
SYStem.CONFIG CORE 1. 1.
CORE.ASSIGN 1. 2. 3. 4.
SYStem.Option.DUALPORT ON
SYStem.Option IMASKASM ON
SYStem.Option IMASKHLL ON
SYStem.Option RESET OFF
SYStem.Option STOP ON
SYStem.Option WAIT ON
SYStem.Option REQ ON
SYStem.Option PerStop ON
SYStem.Option FLMD0 OFF
SYStem.Option RDYLINE ON
SYStem.Option SLOWRESET OFF
SYStem.CONFIG SLAVE OFF
SYStem.CONFIG TAPState SELectDRscan


JTAG_INTERFACE:
SYStem.CONFIG DEBUGPORTTYPE JTAG
SYStem.Mode Up

MAP.NoDenyAccess
FLASH.RESet
FLASH.Create 1. C:0x00000000--0x0001FFFF 0x00004000 TARGET Long 0x00 /INFO "(FACI-0) User Area 0"
FLASH.Create 1. C:0x00020000--0x003FFFFF 0x00010000 TARGET Long 0x00 /INFO "(FACI-0) User Area 0"
FLASH.Create 1. C:0x00400000--0x0041FFFF 0x00004000 TARGET Long 0x00 /INFO "(FACI-0) User Area 1"
FLASH.Create 1. C:0x00420000--0x007FFFFF 0x00010000 TARGET Long 0x00 /INFO "(FACI-0) User Area 1"
FLASH.Create 1. C:0x00800000--0x0081FFFF 0x00004000 TARGET Long 0x10 /INFO "(FACI-1) User Area 2"
FLASH.Create 1. C:0x00820000--0x00BFFFFF 0x00010000 TARGET Long 0x10 /INFO "(FACI-1) User Area 2"
FLASH.Create 1. C:0x00C00000--0x00C1FFFF 0x00004000 TARGET Long 0x10 /INFO "(FACI-1) User Area 3"
FLASH.Create 1. C:0x00C20000--0x00FFFFFF 0x00010000 TARGET Long 0x10 /INFO "(FACI-1) User Area 3"

FLASH.Create 3. C:0x08000000--0x0800FFFF 0x00010000 NOP    Long      /INFO "User Boot Area 0"
FLASH.Create 3. C:0x08400000--0x0840FFFF 0x00010000 NOP    Long      /INFO "User Boot Area 1"

FLASH.Create 2. C:0xFF200000--0xFF23FFFF 0x00001000 TARGET Long 0x01 /INFO "(FACI-0) Data Area 0"
FLASH.Create 2. C:0xFF240000--0xFF27FFFF 0x00001000 TARGET Long 0x11 /INFO "(FACI-1) Data Area 1"
FLASH.Create 2. C:0xFF280000--0xFF28FFFF 0x00001000 TARGET Long 0x21 /INFO "(FACI-2) Data Area 2"
FLASH.Create 2. C:0xFF320000--0xFF3207FF 0x00000800 TARGET Long 0x01 /INFO "(FACI-0) Extended Data Area"

PMACRO.EXPLICIT
LOCAL &flashbinary &RamBase &RamEnd &FlashCodeBase
&flashbinary=CPUFLASHTYPE()  ; get name of flashbinary for the selected CPU

IF ("&flashbinary"=="UNDEF")
(
  PRINT %ERROR "TRACE32 has no flash binary defined for the selected CPU --> script terminated"
  AREA.view
  END
)

// get Local-Ram area
&RamBase=0xfdc00000
&RamEnd=0xfdc0ffff

Data.Set &RamBase--&RamEnd %Long 0x0   ; init RAM to prevent ECC errors

&FlashCodeBase=&RamBase+0x2000

FLASH.TARGET &FlashCodeBase &RamBase 0x1000 ~~/demo/rh850/flash/long/&flashbinary /DualPort /STACKSIZE 0x400 /CORE 0

FLASH.ReProgram ALL
Data.LOAD.Elf "D:\CICT\IntegrationTest\input\pilot3.1_e01_project_mcu.elf"
FLASH.ReProgram.off

ENDDO