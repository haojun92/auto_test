VERSION "HIPBNYYYYYYYYYYYYYYYYYYYYYYYYYYYNNNYNNNNNN/4/%%%/4/'%**4NNN///"

NS_ :

BS_:

BU_: EcuNode DiagNode

BO_ 1852 AVM_Phys_Diag_Rx_Req_to_DVD: 8 DiagNode
 SG_ AVM_Diag_Request : 7|64@0+ (1,0) [0|0] "" Vector__XXX

BO_ 2015 Diag_Func_Rx: 8 EcuNode
 SG_ Diag_Function_Request : 7|64@0+ (1,0) [0|0] "" Vector__XXX

BO_ 1844 AVM_Phys_Diag_Tx_Resp_From_DVD: 8 EcuNode
 SG_ AVM_Diag_Response : 7|64@0+ (1,0) [0|0] "" Vector__XXX

BO_TX_BU_ 2015 : DiagNode,EcuNode;

CM_ "CAN communication matrix for body electronics
*******************************************************

implemented: turn lights, warning lights, windows


";
CM_ BU_ DiagNode "Test Transport-Layer with DLL";
BA_DEF_ BO_  "VFrameFormat" ENUM  "StandardCAN","ExtendedCAN","reserved","reserved","reserved","reserved","reserved","reserved","reserved","reserved","reserved","reserved","reserved","reserved","StandardCAN_FD","ExtendedCAN_FD";
BA_DEF_  "BusType" STRING ;
BA_DEF_ BU_  "TpAddressExtension" INT 0 255;
BA_DEF_ BU_  "TpUse2003Ext" INT 0 1;
BA_DEF_ BU_  "NodeLayerModules" STRING ;
BA_DEF_ BU_  "TpTxIdentifier" HEX 0 536870911;
BA_DEF_  "TpBaseAddress" HEX 0 536870911;
BA_DEF_ BU_  "TpRxIdentifier" HEX 0 536870911;
BA_DEF_ BU_  "Diagnose-Stationsadresse" HEX 0 255;
BA_DEF_ BU_  "TpRxMask" HEX 0 65535;
BA_DEF_ BU_  "TpCanBus" INT 1 2;
BA_DEF_ BU_  "TpUseFC" INT 0 1;
BA_DEF_ BU_  "TpNodeBaseAddress" HEX 0 33554431;
BA_DEF_ BU_  "TpAddressingMode" INT 0 4;
BA_DEF_ BU_  "TpTargetAddress" INT 0 255;
BA_DEF_ BU_  "TpSTMin" INT 0 255;
BA_DEF_ BU_  "TpBlockSize" INT 0 255;
BA_DEF_DEF_  "VFrameFormat" "ExtendedCAN_FD";
BA_DEF_DEF_  "BusType" "";
BA_DEF_DEF_  "TpAddressExtension" 0;
BA_DEF_DEF_  "TpUse2003Ext" 0;
BA_DEF_DEF_  "NodeLayerModules" "osek_tp.dll";
BA_DEF_DEF_  "TpTxIdentifier" 1;
BA_DEF_DEF_  "TpBaseAddress" 1536;
BA_DEF_DEF_  "TpRxIdentifier" 1;
BA_DEF_DEF_  "Diagnose-Stationsadresse" 0;
BA_DEF_DEF_  "TpRxMask" 255;
BA_DEF_DEF_  "TpCanBus" 1;
BA_DEF_DEF_  "TpUseFC" 1;
BA_DEF_DEF_  "TpNodeBaseAddress" 1536;
BA_DEF_DEF_  "TpAddressingMode" 0;
BA_DEF_DEF_  "TpTargetAddress" 0;
BA_DEF_DEF_  "TpSTMin" 0;
BA_DEF_DEF_  "TpBlockSize" 0;
BA_ "BusType" "CAN FD";
BA_ "TpAddressExtension" BU_ EcuNode 13;
BA_ "TpUse2003Ext" BU_ EcuNode 1;
BA_ "TpTxIdentifier" BU_ EcuNode 1539;
BA_ "TpRxIdentifier" BU_ EcuNode 1537;
BA_ "Diagnose-Stationsadresse" BU_ EcuNode 3;
BA_ "TpSTMin" BU_ EcuNode 20;
BA_ "TpBlockSize" BU_ EcuNode 2;
BA_ "TpTargetAddress" BU_ EcuNode 1;
BA_ "TpAddressingMode" BU_ DiagNode 1;
BA_ "TpAddressExtension" BU_ DiagNode 7;
BA_ "TpUse2003Ext" BU_ DiagNode 1;
BA_ "TpBlockSize" BU_ DiagNode 2;
BA_ "TpSTMin" BU_ DiagNode 20;
BA_ "TpTxIdentifier" BU_ DiagNode 1537;
BA_ "TpRxIdentifier" BU_ DiagNode 1539;
BA_ "Diagnose-Stationsadresse" BU_ DiagNode 241;
BA_ "TpTargetAddress" BU_ DiagNode 3;
BA_ "VFrameFormat" BO_ 1852 14;
BA_ "VFrameFormat" BO_ 2015 14;
BA_ "VFrameFormat" BO_ 1844 14;
