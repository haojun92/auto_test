/*@!Encoding:936*/
includes
{
  #include "GenericConn1.cin"
  #include "GenericConn2.cin"
}

variables
{
  char gECU[10] = "%NODE_NAME%";
  byte connId;
  enum AddressModes { kNormal = 0,
                      kExtendedBased = 1,
                      kNormalFixed = 2,
                      kMixed = 3,
                      kMixed11Bit = 4,
                      kExtendedFree = 5
                    };

  const int kBufferSize = 4096;
  const int kDuration_RxLEDOn_ms = 2000;
  const int kDuration_TxLEDOn_ms = 2000;
  const int kDuration_ErrLEDOn_ms = 4000;
  const int kDuration_RxLEDFlashOff_ms = 30000;
  const int kDuration_TxLEDFlashOff_ms = 30000;
  const int kDuration_LEDFlash_ms = 400;
  const int kIdConn1 = 1;
  const int kIdConn2 = 2;
}

on start
{
  long dbHandle;
  dbHandle = CanTpGetDBConnection();
  if (dbHandle > 0) {
    CanTpCloseConnection(dbHandle);
  }

  setwriteDbgLevel(@Global::sysDbgLevel);
  CanTpSetVerbosity(@Global::sysTPVerboseLevel);
  InitConn1();
  InitConn2();
}

on sysVar sysvar::%NODE_NAME%::sysClearData
{
  if (@this)
  {
     ClearReceivedData();
  }
}

on sysVar sysvar::%NODE_NAME%::sysFillData
{
  long txCount,i;
  char sendString[kBufferSize];

  // No action if button is released

  if (@this==0)
      return;

  txCount = @sysvar::%NODE_NAME%::sysNoOfBytesToFill;

  // don't write over array limits
  // use maximum capacity of protocol

  if (txCount>=kBufferSize) {
    txCount=kBufferSize-1;
    @sysvar::%NODE_NAME%::sysNoOfBytesToFill = txCount;
    writeDbgLevel(1,"%s: Length of data string to be sent is limited to %d bytes",
                  gECU, kBufferSize-1);
  }

  for( i=0; i<txCount; i++ )
  {
    sendString[i] = 48+i%75;
  }
  sendString[txCount] = 0;

  sysSetVariableString(sysvar::%NODE_NAME%::sysDataToTransmit, sendString);
}

on sysvar sysvar::%NODE_NAME%::sysDataToTransmit
{
  char sendString[kBufferSize];
  long tmp;

  if (sysGetVariableArrayLength(this) >= kBufferSize) {
    writeDbgLevel(1,"%s: Data string to be sent is too large (%d), truncated to %d bytes",
                  gECU, sysGetVariableArrayLength(this), kBufferSize-1);
    sysGetVariableString(this, sendString, kBufferSize-1);
    sysSetVariableString(this, sendString);
    // sysVar handler will be called again
  } else {
    sysGetVariableString(this, sendString, kBufferSize);
    tmp = strlen(sendString);
    @sysvar::%NODE_NAME%::sysNoOfBytesToSend = tmp;
  }
}

on sysVar Global::sysDbgLevel
{
  setwriteDbgLevel(@this);
}

on sysVar Global::sysTPVerboseLevel
{
  CanTpSetVerbosity(@this);
}

on sysVar sysvar::Global::GeneralSettings::sysResetToDefaultSettings
{
  if (@this > 0) {
    ResetGeneralSettingsToDefaults();
  }
}

on sysVar_update sysvar::Global::GeneralSettings::sysApplySettingsToAllConns
{
  if (@this > 0) {
    ResetToGeneralSettingsConn1();
    ResetToGeneralSettingsConn2();
  }
}

CanTp_SendCon(long connHandle, dword count)
{
 // byte connId;

  if (connHandle == gHandleConn1) {
    connId = kIdConn1;
    SendConConn1();
  } else  if (connHandle == gHandleConn2){
    connId = kIdConn2;
    SendConConn2();
  }

  writeDbgLevel(1,"%s, connection %d: Send confirmation for %d data bytes",
                gECU, connId, count);
}

CanTp_ReceptionInd(long connHandle, byte data[])
{
  // Output of Source Address
  long rxCount;
//  byte connId;

  rxCount = elcount(data);
  @sysvar::%NODE_NAME%::sysNoOfBytesReceived = rxCount;

  if (connHandle == gHandleConn1) {
    connId = kIdConn1;
    ReceptionIndConn1();
  } else  if (connHandle == gHandleConn2){
    connId = kIdConn2;
    ReceptionIndConn2();
  }
  
  /* Print message to write window */
  writeDbgLevel(1,"%s, connection %d: Reception indication for %d bytes",
                gECU, connId, rxCount);

  // put data to panel
  SetDataReceived(data, rxCount);
}

CanTp_ErrorInd(long connHandle, long error)
{
//  byte connId;

  if (connHandle == gHandleConn1) {
    connId = kIdConn1;
    ErrorIndConn1();
  } else  if (connHandle == gHandleConn2){
    connId = kIdConn2;
    ErrorIndConn2();
  }

  switch (error)
  {
    case 1:     writeDbgLevel(1,"%s, connection %d: Error (%d): Timeout while waiting for CF", gECU, connId, error);     break;
    case 2:     writeDbgLevel(1,"%s, connection %d: Error (%d): Timeout while waiting for FC", gECU, connId, error);     break;
    case 3:     writeDbgLevel(1,"%s, connection %d: Error (%d): Undefined error", gECU, connId, error);            break;
    case 4:     writeDbgLevel(1,"%s, connection %d: Error (%d): TP DLL is busy; only one transmission at the same time", gECU, connId, error);                      break;
    case 5:     writeDbgLevel(1,"%s, connection %d: Error (%d): Unexpected PDU received", gECU, connId, error);                   break;
    case 6:     writeDbgLevel(1,"%s, connection %d: Error (%d): Timeout while trying to send a CAN message", gECU, connId, error); break;
    case 7:     writeDbgLevel(1,"%s, connection %d: Error (%d): Too many wait frames sent", gECU, connId, error);                      break;
    case 8:     writeDbgLevel(1,"%s, connection %d: Error (%d): Receiver buffer overflow", gECU, connId, error); break;
    case 9:     writeDbgLevel(1,"%s, connection %d: Error (%d): Wrong parameter", gECU, connId, error);                      break;
    case 10:    writeDbgLevel(1,"%s, connection %d: Error (%d): Invalid status in FC frame", gECU, connId, error);                      break;
    default:    writeDbgLevel(1,"%s, connection %d: Error (%d): Unknown error", gECU, connId, error);                    break;
  }
}

CanTp_FirstFrameInd(long connHandle, dword length)
{


  if (connHandle == gHandleConn1) {
    connId = kIdConn1;
    setTimerCyclic(tFlashRxLEDConn1, kDuration_LEDFlash_ms);
    setTimer(tSwitchOffRxLEDConn1, kDuration_RxLEDFlashOff_ms);
  } else  if (connHandle == gHandleConn2){
    connId = kIdConn2;
    setTimerCyclic(tFlashRxLEDConn2, kDuration_LEDFlash_ms);
    setTimer(tSwitchOffRxLEDConn2, kDuration_RxLEDFlashOff_ms);
  }

  ClearReceivedData();

  writeDbgLevel(1,"%s, connection %d: FF indication",
         gECU, connId);
}

void SetDataReceived(byte data[], int count)
{
  byte sendString[kBufferSize];
  int i;
  long RxCnt; 
  for (i=0; i<count; i++) {
    sendString[i] = data[i];
  }
  RxCnt = (long)count;
  sendString[count] = 0;
  if (connId == kIdConn1)
  {
    sysSetVariableData(sysvar::%NODE_NAME%::sysDataReceivedCon1, sendString, RxCnt);
  }
  else if(connId == kIdConn2)
  {
    sysSetVariableData(sysvar::%NODE_NAME%::sysDataReceivedCon2, sendString, RxCnt);
  }
}

int GetDataToTransmit(byte data[])
{
  char sendString[kBufferSize];
  int count = 0;

  count=0;
  if (sysGetVariableString(sysvar::%NODE_NAME%::sysDataToTransmit, sendString, kBufferSize) == 0) {
    for (; sendString[count] != 0; count++) {
      data[count] = sendString[count];
    }
  }

  return count;
}

void ResetGeneralSettingsToDefaults()
{
  //addressing
  @sysvar::Global::GeneralSettings::sysAddrMode =         @sysvar::Global::DefaultSettings::sysAddrMode;
  @sysvar::Global::GeneralSettings::sysBaseAddress =      @sysvar::Global::DefaultSettings::sysBaseAddress;
  @sysvar::Global::GeneralSettings::sysAddrExtension =    @sysvar::Global::DefaultSettings::sysAddrExtension;
  @sysvar::Global::GeneralSettings::sysUseExtId =         @sysvar::Global::DefaultSettings::sysUseExtId;

  // flow control
  @sysvar::Global::GeneralSettings::sysBlockSize =        @sysvar::Global::DefaultSettings::sysBlockSize;
  @sysvar::Global::GeneralSettings::sysSTmin =            @sysvar::Global::DefaultSettings::sysSTmin;
  @sysvar::Global::GeneralSettings::sysFlowControlDelay = @sysvar::Global::DefaultSettings::sysFlowControlDelay;
  @sysvar::Global::GeneralSettings::sysUseFC =            @sysvar::Global::DefaultSettings::sysUseFC;

  // miscellaneous
  @sysvar::Global::GeneralSettings::sysStartSN =          @sysvar::Global::DefaultSettings::sysStartSN;
  @sysvar::Global::GeneralSettings::sysPaddingValue =     @sysvar::Global::DefaultSettings::sysPaddingValue;
  @sysvar::Global::GeneralSettings::sysMaxReceiveLength = @sysvar::Global::DefaultSettings::sysMaxReceiveLength;
}

void ClearReceivedData()
{
    sysSetVariableString(sysvar::%NODE_NAME%::sysDataReceived, "");
    sysSetVariableString(sysvar::%NODE_NAME%::sysDataToTransmit, "");
    @sysvar::%NODE_NAME%::sysNoOfBytesReceived = 0;
    @sysvar::%NODE_NAME%::sysNoOfBytesToSend = 0;
}


void SendDataAtFunctionalConnector(byte sendData[], long sendsize)
{
  CanTpSendData(gHandleConn2, sendData, sendsize);
}

void SendDataAtFhysicalConnector(byte sendData[], long sendsize)
{
    CanTpSendData(gHandleConn1, sendData, sendsize);
}
