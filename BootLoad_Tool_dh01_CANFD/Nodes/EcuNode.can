/*@!Encoding:936*/
includes
{
  #include "GenericNode.cin"
}

variables
{
  
  char gtestECU[12] = "Test node2";
  long handle;
  
  byte SecurityKey[2];
  byte SecuritySeed[2];

  enum gCondition{RxSize = 4098, TxSize = 4096};

  byte gRxDataBuffer[RxSize];
  byte gTxDataBuffer[TxSize];

  char gCaplRxStrBuffer[4098];
   
  byte gAddressingMode;

  // dummy must be used for SysSetVariableData(SendData_B,..)
  byte gClearData[10];
  long rxCount;
  
   enum DiagStatusType
    { 
      DiagNone = 0,
      StartExtendedSession = 1,
      DisableDTCstorage,
      DisableNMAndCommunicationMessage,
      StartReProgramSection,
      RequestSecuritySeed,
      SendSecurityKey,
      StartEraseMemoryProcedure,
      RequestEraseMemoryProcedureResult,
      StopEraseMemoryProcedure,
      RequestDownload,
      TransferDataBlock,
      StopTransferData,
      StartCheckProgramDependency,
      RequestCheckProgramDependencyResult,
      StopCheckProgramDependency,
      StartCheckApplicationProgramValidation,
      RequestCheckApplicationProgramValidationResult,
      StopCheckApplicationProgramValidation,
      RequestResetMcu,
      ChangeToExtendedSession,
      EnableNMAndCommunicationMessage,
      EnableDTCstorage,
      ClearAllDTC,
      ChangeToDefaultSession
    };
    enum DiagStatusType Diag_Status = StartExtendedSession;
    enum DiagStatusType Diag_State;
    
    const int Download_Restart = 1;
    
    char VersionNumber[17] ="Hw:c3.5 Sw:D1.15";
    char BootloadVersion[17] ="15-09-17Sw:D1.15";
    
    timer timer1s;
    
}

on timer timer1s
{
  gTxDataBuffer[0] = 0x50;
  gTxDataBuffer[1] = 0x02;
  SendDataAtFhysicalConnector(gTxDataBuffer, 2);
  Diag_Status++;
}

on sysvar_update sysvar::EcuNode::sysDataReceivedCon1
{
  write(" the ecu node reeived conn1");  
  sysGetVariableData(this,gRxDataBuffer,rxCount);
    DiagCmdResp();
}

on sysvar_update sysvar::EcuNode::sysDataReceivedCon2
{
  write(" the ecu node reeived conn2");  
  sysGetVariableData(this,gRxDataBuffer,rxCount);
  write("Decimal: %u", Diag_Status);
  DiagCmdResp();
}

void StrCopy(byte Des[], long Offset , char Src[])
{
    int i= 0;
    while(Src[i]!=0)
    {
      Des[i+Offset] = Src[i];
      i++;
    }
}
void DiagCmdResp(void)
{
  dword txCount;
  switch(Diag_Status)
  {
    case StartExtendedSession:
    if((gRxDataBuffer[0] == 0x10)&&(gRxDataBuffer[1] == 0x03))
    {
        gTxDataBuffer[0] = 0x50;
       gTxDataBuffer[1] = 0x03;
       gTxDataBuffer[2] = 0x00;
       gTxDataBuffer[3] = 0x80;
       gTxDataBuffer[4] = 0x00;
       gTxDataBuffer[5] = 0x32;
        txCount = 6;
        SendDataAtFunctionalConnector(gTxDataBuffer, txCount);
        Diag_Status++;
    }
    break;
    case DisableDTCstorage:
    if((gRxDataBuffer[0] == 0x85)&&(gRxDataBuffer[1] == 0x02))
    {
      gTxDataBuffer[0] = 0xC5;
       gTxDataBuffer[1] = 0x02;
        txCount = 2;
        SendDataAtFunctionalConnector(gTxDataBuffer, txCount);
        Diag_Status++;
    }
    break;
    case DisableNMAndCommunicationMessage:
    if((gRxDataBuffer[0] == 0x28)&&(gRxDataBuffer[1] == 0x03)&&(gRxDataBuffer[1] == 0x03))
    {
        gTxDataBuffer[0] = 0x68;
        gTxDataBuffer[1] = 0x03;
        txCount = 2;
        SendDataAtFunctionalConnector(gTxDataBuffer, txCount);
      Diag_Status = StartReProgramSection; 
    }
    break; 
    case StartReProgramSection:
      if((gRxDataBuffer[0] == 0x10)&&(gRxDataBuffer[1] == 0x02))
      {   
        gTxDataBuffer[0] = 0x78;
        txCount = 1;
        SendDataAtFhysicalConnector(gTxDataBuffer, txCount);
        Diag_Status++;
        setTimer(timer1s,1);
      }
      break;
      case RequestSecuritySeed:
      if((gRxDataBuffer[0] == 0x27)&&(gRxDataBuffer[1] == 0x03))
      {   
        gTxDataBuffer[0] = 0x67;
        gTxDataBuffer[1] = 0x03;
        gTxDataBuffer[2] = 0x12;
        gTxDataBuffer[3] = 0x02;
        txCount = 4;
        SecuritySeed[0] = gTxDataBuffer[2];
        SecuritySeed[1] = gTxDataBuffer[3];
        SendDataAtFhysicalConnector(gTxDataBuffer, txCount);
        Diag_Status++;
      }
      break;
      case SendSecurityKey:
      if((gRxDataBuffer[0] == 0x27)&&(gRxDataBuffer[1] == 0x04))
      { 
        calcKey(SecuritySeed);
        gTxDataBuffer[0] = 0x67;
        gTxDataBuffer[1] = 0x04;
        gTxDataBuffer[2] = SecurityKey[0];
        gTxDataBuffer[3] = SecurityKey[1];
        txCount = 4;
        SendDataAtFhysicalConnector(gTxDataBuffer, txCount);
        Diag_Status++;
      }
      break;    
      case RequestResetMcu:
      if((gRxDataBuffer[0] == 0x11)&&(gRxDataBuffer[1] == 0x01))
      {
        Diag_Status++;
        gTxDataBuffer[0] = 0x51;
        gTxDataBuffer[1] = 0x01;
        txCount = 2;
        SendDataAtFhysicalConnector(gTxDataBuffer, txCount);
        if(@sysvar::DownLoad::sysDownloadMode == 0)
        {
          Diag_Status++;
        }
      }
      break;
      case ChangeToExtendedSession:
      if((gRxDataBuffer[0] == 0x10)&&(gRxDataBuffer[1] == 0x03))
      {
          gTxDataBuffer[0] = 0x50;
         gTxDataBuffer[1] = 0x03;
         gTxDataBuffer[2] = 0x00;
         gTxDataBuffer[3] = 0x80;
         gTxDataBuffer[4] = 0x00;
         gTxDataBuffer[5] = 0x32;
          txCount = 6;
          SendDataAtFunctionalConnector(gTxDataBuffer, txCount);
          Diag_Status++;
        write("the ecu response at change to externded session");
      }
      break;
      case EnableDTCstorage:
      if((gRxDataBuffer[0] == 0x85)&&(gRxDataBuffer[1] == 0x01))
      {
          gTxDataBuffer[0] = 0xc5;
          gTxDataBuffer[1] = 0x01;
          txCount = 2;
          SendDataAtFunctionalConnector(gTxDataBuffer, txCount);
          Diag_Status++;
      }
      break;
      case ChangeToDefaultSession:
      if((gRxDataBuffer[0] == 0x10)&&(gRxDataBuffer[1] == 0x01))
      {
          gTxDataBuffer[0] = 0x50;
         gTxDataBuffer[1] = 0x01;
         gTxDataBuffer[2] = 0x00;
         gTxDataBuffer[3] = 0x80;
         gTxDataBuffer[4] = 0x00;
         gTxDataBuffer[5] = 0x32;
          txCount = 6;
          SendDataAtFunctionalConnector(gTxDataBuffer, txCount);
          Diag_Status++;
      }
      break;
      
      default:
      if((gRxDataBuffer[0] == 0x31)&&(gRxDataBuffer[1] == 0x01)&&(gRxDataBuffer[2] == 0x02)&&(gRxDataBuffer[3] == 0x02))
      {
         gTxDataBuffer[0] = 0x71;
        gTxDataBuffer[1] = 0x01;
        gTxDataBuffer[2] = 0x02;
        gTxDataBuffer[3] = 0x02;
        gTxDataBuffer[4] = 0x04;
        txCount = 5;
        SendDataAtFhysicalConnector(gTxDataBuffer, txCount);
      }
      else if((gRxDataBuffer[0] == 0x31)&&(gRxDataBuffer[1] == 0x01)&&(gRxDataBuffer[2] == 0xFF)&&(gRxDataBuffer[3] == 0x00))
      {
        gTxDataBuffer[0] = 0x71;
        gTxDataBuffer[1] = 0x01;
        gTxDataBuffer[2] = 0xFF;
        gTxDataBuffer[3] = 0x00;
        gTxDataBuffer[4] = 0x04;
        txCount = 5;
        SendDataAtFhysicalConnector(gTxDataBuffer, txCount);
      }
      else if((gRxDataBuffer[0] == 0x34)&&(gRxDataBuffer[1] == 0x00)&&(gRxDataBuffer[2] == 0x44))
      {
        gTxDataBuffer[0] = 0x74;
        gTxDataBuffer[1] = 0x40;
        gTxDataBuffer[2] = 0x00;
        gTxDataBuffer[3] = 0x00;
        gTxDataBuffer[4] = 0x04;
        gTxDataBuffer[5] = 0x02;
        txCount = 6;
        SendDataAtFhysicalConnector(gTxDataBuffer, txCount);
      }
      else if((gRxDataBuffer[0] == 0x36))
      {
        gTxDataBuffer[0] = 0x76;
        gTxDataBuffer[1] = gRxDataBuffer[1];
        txCount = 2;
        OSEKTL_DataReq(gTxDataBuffer, txCount);
      }
      else if((gRxDataBuffer[0] == 0x37))
      {
        gTxDataBuffer[0] = 0x77;
        txCount = 1;
        SendDataAtFhysicalConnector(gTxDataBuffer, txCount);
      }
      else if((gRxDataBuffer[0] == 0x31)&&(gRxDataBuffer[2] == 0xFF)&&(gRxDataBuffer[3] == 0x01))
      {   
        gTxDataBuffer[0] = 0x71;
        gTxDataBuffer[1] = 0x01;
        gTxDataBuffer[2] = 0xFF;
        gTxDataBuffer[3] = 0x01;
        gTxDataBuffer[4] = 0x04;
        txCount = 5;
        SendDataAtFhysicalConnector(gTxDataBuffer, txCount);
        Diag_Status = RequestResetMcu;
      }
      else if((gRxDataBuffer[0] == 0x22)&&(gRxDataBuffer[1] == 0xF1)&&(gRxDataBuffer[2] == 0x93))
      {
        gTxDataBuffer[0] = 0x62;
        gTxDataBuffer[1] = 0xF1;
        gTxDataBuffer[2] = 0x93;
        gTxDataBuffer[3] = 0x01;
        gTxDataBuffer[4] = 0x04;
        txCount = 5;
        SendDataAtFhysicalConnector(gTxDataBuffer, txCount);
        Diag_Status = RequestResetMcu;
      }
      break;
  }
}

/* Function Name: Word calcKey(Word seed)
* Description: Calculate key to a given seed.
* Param: seed - Seed to which the key has to be calculated
* Return: Word - Calculated key*/
void calcKey(byte seed[])
{
  byte bSeed[2];
  word remainder;
  byte n;
  byte i;
  bSeed[0] = seed[0]; /* MSB */
  bSeed[1] = seed[1]; /* LSB */
  remainder = 0xFFFE;
  for (n = 0; n < 2; n++)
  {
    /* Bring the next byte into the remainder. */
    remainder ^= ((bSeed[n]) << 8);
    /* Perform modulo-2 division, a bit at a time. */
    for (i = 0; i < 8; i++)
    {
      /* Try to divide the current data bit. */
      if (remainder & 0x8000)
      {
        if(remainder & 0x0080)
        {
          remainder = (remainder << 1) ^ 0x8408;
        }
      else
      {
        remainder = (remainder << 1) ^ 0x8025;
      }
     }
    else
    {
      remainder = (remainder << 1);
    }
    }
  }
  /* The final remainder is the key */
  SecurityKey[0] = (Byte)(remainder >> 8); /* MSB */
  SecurityKey[1] = (Byte)remainder; /* LSB */
}


on start
{

}
