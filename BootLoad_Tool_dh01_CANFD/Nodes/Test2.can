includes
{
  
}

variables
{
  char gECU[12] = "Test node2";
  long handle;


  enum gCondition{RxSize = 4098, TxSize = 4096};

  byte gRxDataBuffer[RxSize];
  byte gTxDataBuffer[TxSize];

  char gCaplRxStrBuffer[4098];
   
  byte gAddressingMode;

  // dummy must be used for SysSetVariableData(SendData_B,..)
  byte gClearData[10];
  
  msTimer tSignalRcvdData; // Signal Received Data
  
   enum DiagStatusType
    { 
      DiagNone = 0,
      ReadECUHardwareNumber = 1,
      ReadBootSoftwareIdentification =2,
      StartExtendedSession = 3,
      DisableDTCstorage =4,
      DisableNMAndCommunicationMessage =5,
      StartReProgramSection = 10,
      RequestSecuritySeed = 11,
      SendSecurityKey = 12,
      WriteDownloadIdentifierNum =13,
      WriteDownloadDate = 14,
      StartEraseMemoryProcedure =15,
      RequestDownload = 16,
      TransferDataBlock = 17,
      StopTransferData = 18,
      SetCalculateChecksum = 19,
      CheckProgramDependency =20,
      RequestResetMcu = 21, 
      DownloadFinished = 22,
      ChangeToExtendedSession = 31,
      EnableDiagnosticCommunication = 32,
      EnableDTCstorage =33,
      ChangeToDefaultSession=34
    };
    enum DiagStatusType Diag_Status;
    enum DiagStatusType Diag_State;
    message CAN_DIAG Diag_Req;
    message BCM_DiagRes Diag_Resp;
}
on start
{
   Diag_Status = StartReProgramSection;
   Diag_State = ReadECUHardwareNumber;
}

on sysvar_update sysvar::TestPanel2::Sended
{
   long txCount;
  
  // Prevent from sending when button is released

  if (@this == 0)
      return;
  
  SysGetVariableData(sysvar::TestPanel2::RxTxString, gTxDataBuffer, txCount);
  // OSEK TP supports only up to 4095 bytes per transmission

  if (txCount >= 4096)
      txCount = 4095;

  writeDbgLevel(1,"CAPL: %s: OSEKTL_DataReq mit %d Bytes", gECU, txCount);
       
   OSEKTL_DataReq(gTxDataBuffer, txCount); 
 // CanTpSendData( handle, gTxDataBuffer, txCount);
}

on sysvar_update sysvar::TestPanel2::Clear
{
   if (@this == 0)
      return;
    SysSetVariableData(sysvar::TestPanel2::RxTxString, gRxDataBuffer, 0);
  
}

on timer tSignalRcvdData 
{
  // Switch off led for RcvdData 
 // @sysvar::NodeB::RcvdData_B =0;   
}


void OSEKTL_DataInd( long rxCount )
{
  // Output of Source Address
  long src;
 // src = OSEKTL_GetSrcAdr();

  /* Print message to write window */
  write("Receive %d bytes!",rxCount);

  /* Get received data */
  OSEKTL_GetRxData( gRxDataBuffer, elcount(gRxDataBuffer) );
  //write("the received data is [%02x]",gRxDataBuffer[0]);
  //SysSetVariableData(sysvar::TestPanel1::RxString, gRxDataBuffer, rxCount);
  //SysSetVariableData(sysvar::TestPanel2::RxTxString, gRxDataBuffer, rxCount);

  //@sysvar::NodeB::RcvdData_B = 1;
  DiagCmdResp();

}



void OSEKTL_ErrorInd(int error)
{
  switch (error)
  {
    case 1:     writeDbgLevel(1,"CAPL: %s: Error (%d): Timeout while waiting for CF", gECU, error);     break;
    case 2:     writeDbgLevel(1,"CAPL: %s: Error (%d): Timeout while waiting for FC", gECU, error);     break;
    case 3:     writeDbgLevel(1,"CAPL: %s: Error (%d): Wrong Sequence Number", gECU, error);            break;
    case 4:     writeDbgLevel(1,"CAPL: %s: Error (%d): TP_DLL busy", gECU, error);                      break;
    case 5:     writeDbgLevel(1,"CAPL: %s: Error (%d): Unexpected PDU", gECU, error);                   break;
    case 6:     writeDbgLevel(1,"CAPL: %s: Error (%d): Timeout while waiting for Tx-Ack", gECU, error); break;
    case 7:     writeDbgLevel(1,"CAPL: %s: Error (%d): WFT Overrun", gECU, error);                      break;
    case 8:     writeDbgLevel(1,"CAPL: %s: Error (%d): Buffer overflow", gECU, error);                  break;
    case 9:     writeDbgLevel(1,"CAPL: %s: Error (%d): Wrong parameter", gECU, error);                  break;    
    default:    writeDbgLevel(1,"CAPL: %s: Error (%d): unknown error", gECU, error);                    break;
  }
}

OSEKTL_FirstFrameIndication( long sourceadr, long destadr, long rxCount )
{
  /* Print message to write window */
//  writeDbgLevel(1,"CAPL: %s: FF indication called, SA= 0x%02lx, TA= 0x%02lx, RxCount = %ld (AE=%d)", 
//         gECU, sourceadr, destadr, rxCount, OSEKTL_GetRecentAE());
}

void DiagCmdResp(void)
{
  dword txCount;
  switch(Diag_Status)
  {
      case StartReProgramSection:
      if((gRxDataBuffer[0] == 0x10)&&(gRxDataBuffer[1] == 0x02))
      {   
        gTxDataBuffer[0] = 0x50;
        gTxDataBuffer[1] = 0x02;
        gTxDataBuffer[2] = 12;
        gTxDataBuffer[3] = 0x02;
        gTxDataBuffer[4] = 0x00;
        gTxDataBuffer[5] = 0x32;
        txCount = 6;
        OSEKTL_DataReq(gTxDataBuffer, txCount);
        Diag_Status++;
      }
      break;
      case RequestSecuritySeed:
      if((gRxDataBuffer[0] == 0x27)&&(gRxDataBuffer[1] == 0x11))
      {   
        gTxDataBuffer[0] = 0x67;
        gTxDataBuffer[1] = 0x11;
        gTxDataBuffer[2] = 0x12;
        gTxDataBuffer[3] = 0x02;
        gTxDataBuffer[4] = 0x00;
        gTxDataBuffer[5] = 0x32;
        txCount = 6;
        
        OSEKTL_DataReq(gTxDataBuffer, txCount);
        Diag_Status++;
      }
      break;
      case SendSecurityKey:
      if((gRxDataBuffer[0] == 0x27)&&(gRxDataBuffer[1] == 0x12))
      {   
        gTxDataBuffer[0] = 0x67;
        gTxDataBuffer[1] = 0x12;
        txCount = 2;
        OSEKTL_DataReq(gTxDataBuffer, txCount);
        Diag_Status++;
      }
      break;
      case WriteDownloadIdentifierNum:
      if((gRxDataBuffer[0] == 0x2E)&&(gRxDataBuffer[1] == 0xF1)&&(gRxDataBuffer[2] == 0x98))
      {   
        gTxDataBuffer[0] = 0x6E;
        gTxDataBuffer[1] = 0xF1;
        gTxDataBuffer[2] = 0x98; 
        txCount = 3;
        OSEKTL_DataReq(gTxDataBuffer, txCount);
        Diag_Status++;
      }
      break;
      
      case WriteDownloadDate:
      if((gRxDataBuffer[0] == 0x2E)&&(gRxDataBuffer[1] == 0xF1)&&(gRxDataBuffer[2] == 0x99))
      {   
        gTxDataBuffer[0] = 0x6E;
        gTxDataBuffer[1] = 0xF1;
        gTxDataBuffer[2] = 0x99;
        txCount = 3;
        OSEKTL_DataReq(gTxDataBuffer, txCount);
        Diag_Status++;
      }
      break;

     
      case RequestResetMcu:
      if((gRxDataBuffer[0] == 0x11)&&(gRxDataBuffer[1] == 0x01))
      {
        gTxDataBuffer[0] = 0x51;
        gTxDataBuffer[1] = 0x01;
        txCount = 2;
        OSEKTL_DataReq(gTxDataBuffer, txCount);
      }
      break;
      default:
      if((gRxDataBuffer[0] == 0x31)&&(gRxDataBuffer[1] == 0x01)&&(gRxDataBuffer[2] == 0x02)&&(gRxDataBuffer[3] == 0x02))
      {
         gTxDataBuffer[0] = 0x71;
        gTxDataBuffer[1] = 0x01;
        gTxDataBuffer[2] = 0x02;
        gTxDataBuffer[3] = 0x02;
        gTxDataBuffer[4] = 0x04;
        txCount = 5;
        OSEKTL_DataReq(gTxDataBuffer, txCount);
      }
      else if((gRxDataBuffer[0] == 0x31)&&(gRxDataBuffer[1] == 0x01)&&(gRxDataBuffer[2] == 0xFF)&&(gRxDataBuffer[3] == 0x00))
      {
        gTxDataBuffer[0] = 0x71;
        gTxDataBuffer[1] = 0x01;
        gTxDataBuffer[2] = 0xFF;
        gTxDataBuffer[3] = 0x00;
        gTxDataBuffer[4] = 0x04;
        txCount = 5;
        OSEKTL_DataReq(gTxDataBuffer, txCount);
      }
      else if((gRxDataBuffer[0] == 0x34)&&(gRxDataBuffer[1] == 0x00)&&(gRxDataBuffer[2] == 0x44))
      {
        gTxDataBuffer[0] = 0x74;
        gTxDataBuffer[1] = 0x40;
        gTxDataBuffer[2] = 0x00;
        gTxDataBuffer[3] = 0x00;
        gTxDataBuffer[4] = 0x04;
        gTxDataBuffer[5] = 0x02;
        txCount = 6;
        OSEKTL_DataReq(gTxDataBuffer, txCount);
      }
      else if((gRxDataBuffer[0] == 0x36))
      {
        gTxDataBuffer[0] = 0x76;
        gTxDataBuffer[1] = gRxDataBuffer[1];
        txCount = 2;
        OSEKTL_DataReq(gTxDataBuffer, txCount);
      }
      else if((gRxDataBuffer[0] == 0x37))
      {
        gTxDataBuffer[0] = 0x77;
        txCount = 1;
        OSEKTL_DataReq(gTxDataBuffer, txCount);
      }
      else if((gRxDataBuffer[0] == 0x31)&&(gRxDataBuffer[2] == 0xFF)&&(gRxDataBuffer[3] == 0x01))
      {   
        gTxDataBuffer[0] = 0x71;
        gTxDataBuffer[1] = 0x01;
        gTxDataBuffer[2] = 0xFF;
        gTxDataBuffer[3] = 0x01;
        gTxDataBuffer[4] = 0x04;
        txCount = 5;
        OSEKTL_DataReq(gTxDataBuffer, txCount);
        Diag_Status = RequestResetMcu;
      }
      {
      }
      break;
  }
}


on message CAN_DIAG
{
    Diag_Req = this;
   switch(Diag_State)
    {
      case ReadECUHardwareNumber:
      
      break;
      case ReadBootSoftwareIdentification:
      
      break;
      case StartExtendedSession:
      
      break;
      case DisableDTCstorage:
      
      break;
      case DisableNMAndCommunicationMessage:
      
      break;
        default :
        break;
    }    
}

void Diag_SendDataReq(byte Data[], int Num)
{
  if( Num <8)
  {
    Diag_Resp.Diag_FType = 0;
    Diag_Resp.Diag_DLength = Num;
    if(Num>=1)
    {
      Diag_Resp.Diag_D1 = Data[0];
    }else
    {
      Diag_Resp.Diag_D1 = 0;
    }
    if(Num>=2)
    {
      Diag_Resp.Diag_D2= Data[1];
    }else
    {
      Diag_Resp.Diag_D2 = 0;
    }
    if(Num>=3)
    {
      Diag_Resp.Diag_D3 = Data[2];
    }else
    {
      Diag_Resp.Diag_D3 = 0;
    }
    if(Num>=4)
    {
      Diag_Resp.Diag_D4= Data[3];
    }else
    {
      Diag_Resp.Diag_D4 = 0;
    }
    if(Num>=5)
    {
      Diag_Resp.Diag_D5 = Data[4];
    }else
    {
      Diag_Resp.Diag_D5 = 0;
    }
    if(Num>=6)
    {
      Diag_Resp.Diag_D6 = Data[5];
    }else
    {
      Diag_Resp.Diag_D6 = 0;
    }
    if(Num>=7)
    {
      Diag_Resp.Diag_D7 = Data[6];
    }else
    {
      Diag_Resp.Diag_D7 = 0;
    }
    output(Diag_Resp);
  }else
  {
    write("The data is too long for transfer out!!!");
  }
}

void DiagReadECUHardwareNumberResp(void)
{
  if((Diag_Req.Diag_D1 == 0x22)&&(Diag_Req.Diag_D2 == 0x91)&&(Diag_Req.Diag_D3 == 0x80))
  {
  }
}


