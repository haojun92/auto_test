/*@!Encoding:936*/

variables
{
    byte DataStr[65535][1024];// 程序文件数据缓存数组 
    dword DataBlockAddr[65535];//
    dword DataBlockLength[65535];//
    int DataBlockStartIndex[65535];//
    int DataBlockTotalNum;//
  
    byte DocumentName[200];
    dword DocumentNameLength;
    
    int MaxDataLengh = 1024;
    int EveryAddressStep = 0x0C0;
   
    int DataCurrPos = 0;
    int DataCurrIndex = 0;
    dword DataCurrAddr = 0;
    dword DataTotalLen = 0;
    int DataBlockIndex = 0;
    dword DataPageAddr;  
  
    byte DrvStr[512][1024];
    dword DrvBlockAddr[512];
    dword DrvBlockLength[512];
    int DrvBlockStartIndex[512];
    int DrvBlockTotalNum;

    dword CurrentTotalLen;
    int DrvCurrPos = 0;
    int DrvCurrIndex = 0;
    dword DrvCurrAddr = 0;
    dword DrvTotalLen = 0;
    int DrvBlockIndex = 0;
    dword DrvPageAddr = 0;  

    const char FLASHDRIVER = 0;  
    const char FLASHCODE = 1; 
    const char READ = 0;
    const char WRITE = 1;

    byte IsDrvFileValid;
    byte IsCodeFileValid;

    long read_seg;
    long total_seg;

    long glbHandle = 0;

    char sourceFile[300] = "D:\\Doc\\OTA\\BootLoad_Tool_T15\\D_ENTRY_PLATFROM_test.hex";
    char FalshDrv_sourceFile[300] = "D:\\Doc\\OTA\\BootLoad_Tool_T15\\Holomatic_SBL.s19";
  
    char S19FilePath[300];
    char S19FileName[300];

    byte HexDataArray[1000];

    byte crc=0x00; /* initial value */
    byte tmp=0x00;
}


on stopMeasurement
{
  SysSetVariableString(sysvar::ReadFile::sysCodeFilePath,"");
}

on start
{
  sysSetVariableString(sysvar::ReadFile::sysCodeFilePath,"");
  sysSetVariableString(sysvar::ReadFile::sysDrvFilePath, "");
  sysSetVariableInt(sysvar::ReadFile::sysCodeFileLength , 0);
  sysSetVariableInt(sysvar::ReadFile::sysDrvFileLength,0);
  SysSetVariableString(sysvar::ReadFile::sysCodeFilePath,sourceFile);
  SysSetVariableString(sysvar::ReadFile::sysDrvFilePath,FalshDrv_sourceFile);
  write("set sysCodeFilePath");
}
void ReadFile_Init()
{
    ClearDrvBufferVar();
    ClearDataBufferVar();
    
}

void ClearDataBufferVar(void)
{
   DataCurrPos = 0;
   DataCurrIndex = 0;
   DataCurrAddr = 0;
   DataTotalLen = 0;
   DataBlockIndex = 0;
   DataPageAddr = 0; 
   read_seg = 0;
}

void ClearDrvBufferVar(void)
{
  DrvCurrPos = 0;
  DrvCurrIndex = 0;
  DrvCurrAddr = 0;
  DrvTotalLen = 0;
  DrvBlockIndex = 0;
  DrvPageAddr = 0; 
  read_seg = 0;
}

CloseFile()
{
	fileclose(glbHandle);
	glbHandle=0;//reset the global handle
	//write("eepGlbHandle is %d",eepGlbHandle);
}

  
void ReadFile(char Type)
{ 
    tmp =0;
    if(Type == FLASHCODE)
    {
      sysGetVariableString(sysvar::ReadFile::sysCodeFilePath,sourceFile,elcount(sourceFile));
      ClearDataBufferVar();
      
      if(OpenFile(sourceFile,READ))
  	  {
  		   ReadFileData(Type);   //load source data	
  	  }
      CloseFile();    //close source file
    }
    else
    {
      sysGetVariableString(sysvar::ReadFile::sysDrvFilePath,FalshDrv_sourceFile,elcount(FalshDrv_sourceFile));
      ClearDrvBufferVar();
    
      if(OpenFile(FalshDrv_sourceFile,READ))
  	  {
  		  ReadFileData(Type);   //load source data	
  	  }
      CloseFile();    //close source file
    }
    
	 write("read finish!");//clear the environment variable
}

byte OpenFile (char path[],char Mode)
{
	NormalizeFilePath(path);
  glbHandle =0;//reset the global handle before open the file for read/write   
  //putvaluetocontrol("down_load","info","opening...");  	
  if(Mode == READ)
	{
    //open the file for read
		setFilePath(S19FilePath,0);     //set the file path to read those data
		glbHandle =openfileread(S19FileName,0);   //open the file
	}
	else if(Mode == WRITE)
	{
    //open the file for write
		setFilePath(S19FilePath,1);     //set the file path to write those data
		glbHandle =openFileWrite (S19FileName,0);     //open the file
	}
  else
  {
    return 0;
  }
	if(glbHandle !=0)
	{
		write("The specified file is opened successfully.");
    return 1;
	}
	else
	{
		write("Error:The specified file is opened failure !!!");
		return 0;
	}
}

void ConvertAsciiStringToHexArray(char Data[],int length)
{
  int i,j;
  j = 0;
  for(i =0;i<length -1;)
  {  
    HexDataArray[j] = AsciiToHex(Data[i],Data[i+1]);
    i+=2;
    j++;
  }
  HexDataArray[j] = 0;
  //write("the length is %d",length);
}

byte S19checkOneLineChecksum(byte Data[],int length )
{
  int j; 
  byte tem_checksum;
  byte Datachecksum;
  tem_checksum = 0;
  //write("the length is %d",length);
  for(j =0;j<length -1;j++)
  {  
    tem_checksum += Data[j];
    //write("0x%X",Data[j]);
  }
  Datachecksum = Data[j];
  tem_checksum = 0xFF - tem_checksum; 
  write("the cal checksum is %x;the data checksum is %x",tem_checksum,Datachecksum);
  if(Datachecksum == tem_checksum)
  {
    return 1;
  }
  else
  {
    return 0;
  }
}

byte HexCheckOneLineCheckSum(byte Data[], int length)
{
  int j; 
  byte tem_checksum;
  byte Datachecksum;
  tem_checksum = 0;
  for(j =0;j<length -1;j++)
  {  
    tem_checksum += Data[j]; 
  }
  Datachecksum = Data[j];
  tem_checksum = 0xFF-tem_checksum+1;
  // write("the cal checksum is %x, the data checksum is %x",tem_checksum,Datachecksum);
  if(Datachecksum == tem_checksum)
  {
    return 1;
  }
  else
  {
    return 0;
  }
}


void NormalizeFilePath (char srcFile[])
{
	int charlength;
  int loopCnt,i;
  int sublength;


	charlength=strlen(srcFile); //get the length of the path(including the path and the file name)
   
	for(loopCnt=charlength-1;loopCnt>0;loopCnt--)
	{
		if(srcFile[loopCnt]=='\\')
		{
      sublength = loopCnt;
			break;
		}
	}
	for(loopCnt=0;loopCnt<sublength;loopCnt++)
	{
		S19FilePath[loopCnt]=srcFile[loopCnt]; //get the path of the source file			
	}
  S19FilePath[loopCnt] = 0;
  //write("The Destination File Path is: %s",S19FilePath);     //to output the source file path into the Write window
	i=0;
  for(loopCnt=sublength+1;loopCnt<charlength;loopCnt++)
  {
		S19FileName[i++]=srcFile[loopCnt];//get the source file name
	}
  S19FileName[i] = 0;
  //write("The Destination File name is: %s",S19FileName);    //to output the source file name into the Write window 
}

void CopyStringToBuffer(char Str[], char Buf[], int Offset, int Len)
{
  int i;
  for(i = 0;i< Len;i++)
  {
    Buf[i] = Str[i+Offset];
  }
  Buf[i]=0;
}

void ReadS19FileData(char Data[], char Type)
{
  int i, loopCnt;
  int datalength;
  char tempBuffer[1000];
  dword TempAddress;
  byte temhexstr[1000];
  loopCnt = AsciiToHex(Data[2],Data[3]);
  loopCnt = (int)(loopCnt<<1)+ 2;
  //write("theloopCnt is %d",loopCnt);
  CopyStringToBuffer(Data,tempBuffer,2,loopCnt);
  ConvertAsciiStringToHexArray(tempBuffer,loopCnt);
  loopCnt = loopCnt>>1;
  //write("%s;%d",tempBuffer,loopCnt);
  if(S19checkOneLineChecksum(HexDataArray,loopCnt)== 1)
  {
    if(Data[1]=='3')// S3 seg
    {
      read_seg++;   
      TempAddress = (dword)HexDataArray[1];
      TempAddress = (dword)(TempAddress<<8)+(dword)HexDataArray[2];
      TempAddress = (dword)(TempAddress<<8)+(dword)HexDataArray[3];
      TempAddress = (dword)(TempAddress<<8)+(dword)HexDataArray[4]; 
      for(i=0;i<loopCnt -6;i++)
      {
         temhexstr[i] = HexDataArray[i+5];
      }
      AddDataToBuffer(TempAddress,temhexstr, loopCnt - 6,Type);
      //write("theloopCnt is %d",loopCnt-5);
    }
    else if(Data[1]=='0')// S0 seg
    {
      read_seg++;   
      TempAddress = (dword)HexDataArray[1];
      TempAddress = (dword)(TempAddress<<8)+(dword)HexDataArray[2];
      DocumentName[0] = loopCnt;//real length add 4byte data total length
      for(i=0;i<loopCnt -4;i++)
      {
         DocumentName[i+1] = HexDataArray[i+3];
      }
      DocumentNameLength = loopCnt+1;
      //write("0000DocumentNameLength is %x",DocumentNameLength);
      //DocumentName[DocumentNameLength-1]=CalcCRC(DocumentName,DocumentNameLength);
      //write("0000Data[%x] is %x",DocumentNameLength-1,DocumentName[DocumentNameLength-1]);
    }
    else if(Data[1]=='7')
    {   
      total_seg = read_seg;
      DocumentName[DocumentNameLength -4] = (DataTotalLen&0xFF000000)>>24;
      DocumentName[DocumentNameLength -3] = (DataTotalLen&0x00FF0000)>>16;
      DocumentName[DocumentNameLength -2] = (DataTotalLen&0x0000FF00)>>8;;
      DocumentName[DocumentNameLength -1] = (DataTotalLen&0x000000FF);
      CalcCRC(DocumentName,DocumentNameLength);
      for(i=0;i<(DataTotalLen/MaxDataLengh);i++)
      {
        CalcCRC(DataStr[i],MaxDataLengh);
      }
      datalength = DataTotalLen%MaxDataLengh;
      CalcCRC(DataStr[i],datalength);
      write("1111111111111110%x",DocumentNameLength);
      //write("there are total %d segment of data are read !!!",read_seg);
      //putValue (ProgramSectionChecksum,file_checksum);
      if(Type == FLASHCODE)
      {
        //putValue(PromgramIndicationStr, "Procedure File Read Finish!!!");
        //putValue(ProcedureTotalSize,DataTotalLen);
        sysSetVariableInt(sysvar::ReadFile::sysCodeFileLength,DataTotalLen);
      }else
      {
        //putValue(PromgramIndicationStr, "Driver File Read Finish!!!");
        sysSetVariableInt(sysvar::ReadFile::sysDrvFileLength,DrvTotalLen);
      }
      //file_checksum = (dword)(StrChecksum[3]<<24)+(dword)(StrChecksum[2]<<16)+(dword)(StrChecksum[1]<<8)+(dword)(StrChecksum[0]);
      //write("the file checksum is: 0x%x !",file_checksum);
      
    }
    else
    {
            //do nothing 
    }
  }
  else
  {
  }
}



void ReadHexFileData(char Data[],char Type)
{
  int i, loopCnt;
  char tempBuffer[600];
  dword TempAddress;
  byte temhexstr[300];
  loopCnt = AsciiToHex(Data[1],Data[2]);
  loopCnt = (int)(loopCnt<<1)+ 10;
  CopyStringToBuffer(Data,tempBuffer,1,loopCnt);
  ConvertAsciiStringToHexArray(tempBuffer,loopCnt);
  loopCnt = loopCnt>>1;
  //write("the string is %s, the cnt is %d",tempBuffer,loopCnt);
  if(HexCheckOneLineCheckSum(HexDataArray,loopCnt)== 1)
  {
    if(HexDataArray[3] == 0x00)// data seg
    {
      TempAddress = (dword)HexDataArray[1];
      TempAddress = (dword)(TempAddress<<8) + (dword)HexDataArray[2]; 
      if(Type == FLASHCODE)
      {
        TempAddress = TempAddress + DataPageAddr;
      }
      else
      {
        TempAddress = TempAddress + DrvPageAddr;
      }
      for(i = 0; i < loopCnt - 5; i++)
      {
        temhexstr[i] = HexDataArray[i+4];
      }
      //write("the address is %X",TempAddress);
      AddDataToBuffer(TempAddress,temhexstr, loopCnt - 5,Type); 
      read_seg++;
    }
    else if(HexDataArray[3]== 0x01)// end file seg
    {
      total_seg = read_seg;
      //write("there are total %d segment of data are read !!!",read_seg);
      //putValue (ProgramSectionChecksum,file_checksum);
      if(Type == FLASHCODE)
      {
        //putValue(PromgramIndicationStr, "Procedure File Read Finish!!!");
         sysSetVariableInt(sysvar::ReadFile::sysCodeFileLength,DataTotalLen);
      }else
      {
        //putValue(PromgramIndicationStr, "Driver File Read Finish!!!");
        sysSetVariableInt(sysvar::ReadFile::sysDrvFileLength,DrvTotalLen);
      }
      //file_checksum = (dword)(StrChecksum[3]<<24)+(dword)(StrChecksum[2]<<16)+(dword)(StrChecksum[1]<<8)+(dword)(StrChecksum[0]);
      //write("the file checksum is: 0x%x !",file_checksum);
      
    }
    else if(HexDataArray[3]== 0x02)// Extended Linear Address as 20 bit
    {
      if(Type == FLASHCODE)
      {
        DataPageAddr = (dword)HexDataArray[4];
        DataPageAddr = (dword)(DataPageAddr<<8) + (dword)HexDataArray[5];
        DataPageAddr = (dword)(DataPageAddr<<4);
      }else
      {
        DrvPageAddr = (dword)HexDataArray[4];
        DrvPageAddr = (dword)(DrvPageAddr<<8) + (dword)HexDataArray[5];
        DrvPageAddr = (dword)(DrvPageAddr<<4);
      }
    }
    else if(HexDataArray[3]== 0x04)// Extended Linear Address as 32 bit
    {
      if(Type == FLASHCODE)
      {
        DataPageAddr = (dword)HexDataArray[4];
        DataPageAddr = (dword)(DataPageAddr<<8) + (dword)HexDataArray[5];
        DataPageAddr = (dword)(DataPageAddr<<16); 
      }else
      {
        DrvPageAddr = (dword)HexDataArray[4];
        DrvPageAddr = (dword)(DrvPageAddr<<8) + (dword)HexDataArray[5];
        DrvPageAddr = (dword)(DrvPageAddr<<16);
      } 
    } 
  }
}

void ReadFileData(char Type)
{
  int i;
  dword count = 0;
  char temstr[500];
	while(fileGetStringSZ(temstr,500,glbHandle)!=0)
	{   
    if(temstr[0] == 'S')// this is s19 file 
    {
      ReadS19FileData(temstr,Type);
      //write("%c",temstr[0]);
    }
    else if(temstr[0] == ':')// this is inter hex file
    {
      ReadHexFileData(temstr,Type);
      //write("the hex start %c",temstr[0]);
      count++;
      write("count = %d,temstr = %s",count,temstr);
    }
    else
    {
      write("File read failure! ");
      break;
    }
  }
  crc = ~((byte)tmp);
  write("tmp is %x ",tmp);
  write("crc is %x ",crc);
  if(Type == FLASHDRIVER)
  {
    for(i = 0 ; i<= DrvBlockIndex;i++)
    {
      //write("the DrvBlock %d Address is %X; the DrvBlock Length is %X,the Start Index is %d",i,DrvBlockAddr[i],DrvBlockLength[i],DrvBlockStartIndex[i]);
    }

    //putValue(PromgramIndicationStr, "Driver File Read Finish!!!");
    sysSetVariableInt(sysvar::ReadFile::sysDrvFileLength,DrvTotalLen);
    DrvBlockTotalNum = DrvBlockIndex + 1; 
    IsDrvFileValid = 1;
  }
  else
  {
    for(i = 0 ; i<= DataBlockIndex;i++)
    {
      //write("the DataBlock %d Address is %X; the DataBlock Length is %X,the Start Index is %d",i,DataBlockAddr[i],DataBlockLength[i],DataBlockStartIndex[i]);
    }
    //putValue(ProcedureTotalSize,DataTotalLen);
    sysSetVariableInt(sysvar::ReadFile::sysCodeFileLength,DataTotalLen);

    DataBlockTotalNum = DataBlockIndex + 1; 
    IsCodeFileValid = 1;
  }
}
void AddDataToBuffer(dword Addr, byte Data[], int Len, char Type )
{
    if(Type == FLASHCODE)
    {
      AddDataToDataBuffer(Addr, Data,Len);
    }
    else
    {
      AddDataToDriverBuffer(Addr, Data,Len);
    }
}


void AddDataToDriverBuffer(dword Addr, byte Data[], int Len)
{
  int i;  
  
  if((DrvTotalLen == 0)||(DrvCurrAddr + DrvCurrPos == Addr))
  {
    if(DrvTotalLen == 0)
    {
      DrvBlockIndex = 0;
      DrvCurrAddr = Addr;
      DrvCurrPos = 0;
      DrvBlockAddr[DrvBlockIndex] = Addr;
      DrvBlockLength[DrvBlockIndex] = 0;
      DrvBlockStartIndex[0] = DrvBlockIndex;
    }
    //write("the DrvBlockIndex is %d, the DrvCurrAddr is %X",DrvBlockIndex,DrvCurrAddr);
    for(i=0;i< Len;i++)
    {
      DrvStr[DrvCurrIndex][DrvCurrPos] = Data[i];
      if(++DrvCurrPos>=1024)
      {
        DrvCurrIndex++;
        DrvCurrAddr +=0x400;
        DrvCurrPos = 0;
        //write("the DrvCurrIndex is %d, the DrvCurrPos is %d",DrvCurrIndex,DrvCurrPos);
      }
    }
    DrvBlockLength[DrvBlockIndex] += Len;
    //write("the DrvCurrIndex is %d, the DrvCurrPos is %X",DrvCurrIndex,DrvCurrPos);
  }
  else
  {
    DrvCurrIndex++;
    DrvCurrPos = 0;
    DrvBlockIndex++;
    DrvCurrAddr = Addr;
    DrvBlockAddr[DrvBlockIndex] = Addr;
    DrvBlockLength[DrvBlockIndex] = 0;
    DrvBlockStartIndex[DrvBlockIndex] = DrvCurrIndex;
    
    //write("2the DrvBlockIndex is %d, the DrvCurrAddr is %X",DrvBlockIndex,DrvCurrAddr);
    for(i=0;i< Len;i++)
    {
      DrvStr[DrvCurrIndex][DrvCurrPos] = Data[i];
      
      if(++DrvCurrPos>=1024)
      {
        DrvCurrIndex++;
        DrvCurrAddr +=0x400;
        DrvCurrPos = 0;
      }
    }  
    DrvBlockLength[DrvBlockIndex] += Len;
  } 
  DrvTotalLen += Len;
  //write("the DrvTotalLen is %X",DrvTotalLen);
}

void AddDataToDataBuffer(dword Addr, byte Data[],int Len)
{
  int i;
  //CalcCRC(Data,Len);
  if((DataTotalLen == 0)||(DataCurrAddr + DataCurrPos == Addr))
  {
    if(DataTotalLen == 0)
    {
      DataBlockIndex = 0;
      DataCurrPos = 0;
      DataCurrAddr = Addr;
      DataBlockAddr[DataBlockIndex] = Addr;
      DataBlockLength[DataBlockIndex] = 0;
      DataBlockStartIndex[0] = DataBlockIndex;
    }
    //write("the DataBlockIndex is %d, the DataCurrAddr is %X",DataBlockIndex,DataCurrAddr);
    for(i=0;i< Len;i++)
    {
      DataStr[DataCurrIndex][DataCurrPos] = Data[i];
      if(++DataCurrPos>=MaxDataLengh)
      {
        DataCurrIndex++;
        DataCurrAddr +=EveryAddressStep;
        DataCurrPos = 0;
      }
    }
    DataBlockLength[DataBlockIndex] += Len;
    //write("the DataCurrIndex is %d",DataCurrIndex);
    //write("the DataTotalLen is %d",DataTotalLen);
  }
  else
  { 
    //DataCurrIndex++;
    //DataCurrPos= 0;
    DataBlockIndex++;
    DataCurrAddr = Addr;
    DataBlockAddr[DataBlockIndex] = Addr;
    DataBlockLength[DataBlockIndex] = 0;
    DataBlockStartIndex[DataBlockIndex] = DataCurrIndex;
    //write("2the DataBlockIndex is %d, the DataCurrAddr is %X",DataBlockIndex,DataCurrAddr);
    for(i=0;i< Len;i++)
    {
      DataStr[DataCurrIndex][DataCurrPos] = Data[i];
      if(++DataCurrPos>=MaxDataLengh)
      {
        DataCurrIndex++;
        DataCurrAddr +=EveryAddressStep;
        DataCurrPos = 0;
        write("the DataCurrIndex is %d",DataCurrIndex);
        write("the DataCurrAddr is %d",DataCurrAddr);
      }
    }
    DataBlockLength[DataBlockIndex] += Len;
  }
  DataTotalLen += Len;
  
  write("the DataTotalLen is %d",DataTotalLen);
}

byte AsciiToHex (char ch1, char ch2)
{
    byte i,j;
    byte hexval;
    i = Ascii2Hex(ch1);
    j = Ascii2Hex(ch2);
    hexval = i*16+j;
    return hexval;
}

byte Ascii2Hex(char cha)
{
    byte temp;
    if(cha >=0x30 &&cha <=0x39)
    {
        temp = cha-0x30;
    }
    else if(cha>='A'&&cha <='F')
    {
        temp = cha-'A'+10;
    }
    else if(cha >='a'&& cha<='f')
    {
        temp = cha-'a'+10;
    }
    else
    {
        temp = 255;
        write("error occured !");
    }
    return temp;
}

void CalcCRC(byte data[], int length)
{
int i;
for(i=0;i<length;i++)
{
  tmp= tmp + data[i];
} /* result of above calculation shall be: tmp=0x1F0 */ /* Since crc is char type, the high byte of tmp is ignored and crc shall be 1‘s
complement of low byte */
}

