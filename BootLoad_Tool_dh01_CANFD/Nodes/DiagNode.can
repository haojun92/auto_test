/*@!Encoding:936*/
includes
{
  #include "ReadFile.cin"
  #include "DiagCmd.can"
}

variables
{
  
}


on start
{
  //ReadFile(FLASHCODE);
  sysSetVariableString(sysvar::DownLoad::sysPromptMessage," ");
}

on sysvar_update  sysvar::ReadFile::sysCodeFilePath
{
    ReadFile(FLASHCODE);
    sysSetVariableString(sysvar::DownLoad::sysPromptMessage," ");
}

on sysvar_update  sysvar::ReadFile::sysDrvFilePath
{
  //  write("DrvFile sysvar_update");
  ReadFile(FLASHDRIVER);  
  sysSetVariableString(sysvar::DownLoad::sysPromptMessage," ");
}

on sysvar_update  sysvar::DownLoad::sysStartDownload
{
    write("sysStartDownload");
    if(@this==1)
    {
      CurrentTotalLen = 0;
      DiagStartReprogram();
      @DownLoad::sysDownloadMode = 0;
    }
}

on sysvar_update  sysvar::DownLoad::sysRestartDownload
{
    if(@this == 1)
    {
      CurrentTotalLen = 0;
       DiagResetMcuPre();
       @DownLoad::sysDownloadMode = 1;
    }
  //gRxDataBuffer
}

on sysvar_update  sysvar::DownLoad::sysStopDownload
{
    if(@this == 1)
    {
       CurrentTotalLen = 0;
       DiagStopResetMcu();
       @DownLoad::sysDownloadMode = 1;
    }
  //gRxDataBuffer
}