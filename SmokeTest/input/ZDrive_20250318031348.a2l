/* @@@@ File written by CANAPE_VERSION 17 0 51 @@@@ */
ASAP2_VERSION 1 71
/begin PROJECT ProjectName ""
/begin MODULE ModuleName ""
/begin MOD_COMMON "" BYTE_ORDER MSB_LAST ALIGNMENT_BYTE 1 ALIGNMENT_WORD 1 ALIGNMENT_LONG 1 ALIGNMENT_INT64 1 ALIGNMENT_FLOAT16_IEEE 1 ALIGNMENT_FLOAT32_IEEE 1 ALIGNMENT_FLOAT64_IEEE 1 /end MOD_COMMON
/begin IF_DATA XCP
 /begin PROTOCOL_LAYER 0x0104 0x07D0 0x2710 0x00 0x00 0x00 0x00 0x00 0x08 0x08 BYTE_ORDER_MSB_LAST ADDRESS_GRANULARITY_BYTE OPTIONAL_CMD GET_DAQ_RESOLUTION_INFO OPTIONAL_CMD GET_DAQ_PROCESSOR_INFO OPTIONAL_CMD DOWNLOAD OPTIONAL_CMD SHORT_UPLOAD OPTIONAL_CMD UPLOAD OPTIONAL_CMD SET_MTA OPTIONAL_CMD GET_COMM_MODE_INFO COMMUNICATION_MODE_SUPPORTED BLOCK MASTER 0x2B 0x00 /end PROTOCOL_LAYER
 /begin XCP_ON_CAN 0x0100 CAN_ID_MASTER 0x40000723 CAN_ID_SLAVE 0x40000712 BAUDRATE 0x07A120 SAMPLE_POINT 0x4B SAMPLE_RATE SINGLE BTL_CYCLES 0x08 SJW 0x02 SYNC_EDGE SINGLE MAX_DLC_REQUIRED /end XCP_ON_CAN
/end IF_DATA
/begin MOD_PAR ""
 /begin MEMORY_SEGMENT CALRAM_Flash "" DATA FLASH INTERN 0x3B0000 0x8000 -1 -1 -1 -1 -1
  /begin IF_DATA XCP
   /begin SEGMENT 0x00 0x01 0x00 0x00 0x00
    /begin PAGE 0x00 ECU_ACCESS_ALLOWED_DONT_CARE XCP_READ_ACCESS_ALLOWED_DONT_CARE XCP_WRITE_ACCESS_NOT_ALLOWED /end PAGE
    /begin ADDRESS_MAPPING 0x3B0000 0xFE820000 0x8000 /end ADDRESS_MAPPING
   /end SEGMENT
  /end IF_DATA
 /end MEMORY_SEGMENT
 /begin MEMORY_SEGMENT CALRAM "" DATA RAM INTERN 0xFE820000 0x8000 -1 -1 -1 -1 -1
  /begin IF_DATA XCP
   /begin SEGMENT 0x01 0x01 0x00 0x00 0x00
    /begin PAGE 0x00 ECU_ACCESS_ALLOWED_DONT_CARE XCP_READ_ACCESS_ALLOWED_DONT_CARE XCP_WRITE_ACCESS_ALLOWED_DONT_CARE INIT_SEGMENT 0x00 /end PAGE
   /end SEGMENT
  /end IF_DATA
 /end MEMORY_SEGMENT
/end MOD_PAR
/begin CHARACTERISTIC CLTS_BrkDlyInAsyEvlrCritEve_Ca "Delay values in lookup table for brake delay calculation." CURVE 0xfe5041f0 /* @ECU_Address@CLTS_BrkDlyInAsyEvlrCritEve_Ca@ */ Record_FLOAT32_IEEE 0 autosar_swc_aeb_CM_single_s 0.000000 1.500000
 /begin AXIS_DESCR COM_AXIS NO_INPUT_QUANTITY autosar_swc_aeb_CM_single_m_per_s 10 -20.000000 20.000000 AXIS_PTS_REF CLTS_AForBrkDlyInAsyEvlrCritEve_Ca /end AXIS_DESCR
/end CHARACTERISTIC
/begin CHARACTERISTIC CLTS_BrkDlyLowrValInAsyEvlrCritEve_Ca "Lower value used in brake delay estimator." VALUE 0xfe503d24 /* @ECU_Address@CLTS_BrkDlyLowrValInAsyEvlrCritEve_Ca@ */ Record_FLOAT32_IEEE 0 autosar_swc_aeb_CM_single_s 0.000000 10.000000 /end CHARACTERISTIC
/begin CHARACTERISTIC CLTS_BrkDlyUpprValInAsyEvlrCritEve_Ca "Upper value used in brake delay estimator." VALUE 0xfe503d28 /* @ECU_Address@CLTS_BrkDlyUpprValInAsyEvlrCritEve_Ca@ */ Record_FLOAT32_IEEE 0 autosar_swc_aeb_CM_single_s 0.000000 10.000000 /end CHARACTERISTIC
/begin CHARACTERISTIC CLTS_DrvrBrkgDlyDftInAsyEvlrCritEve_Ca "Default delay of braking initiated by driver." VALUE 0xfe503d34 /* @ECU_Address@CLTS_DrvrBrkgDlyDftInAsyEvlrCritEve_Ca@ */ Record_FLOAT32_IEEE 0 autosar_swc_aeb_CM_single_s 0.000000 1.000000 /end CHARACTERISTIC
/begin CHARACTERISTIC CLTS_DynCal_InpAdpr_AsySftyDecelEnadByVehDyn_Ca "" VALUE 0xfe503d4c /* @ECU_Address@CLTS_DynCal_InpAdpr_AsySftyDecelEnadByVehDyn_Ca@ */ Record_FLOAT32_IEEE 0 autosar_swc_aeb_CM_single -3.4E+38 3.4E+38 /end CHARACTERISTIC
/begin CHARACTERISTIC CLTS_MaxValForDynCalPrmForAxleDstReToVehFrntInAsyEvlrCritEve_Ca "The maximum value allowed for the distance from rear axle to vehicle front" VALUE 0xfe503d58 /* @ECU_Address@CLTS_MaxValForDynCalPrmForAxleDstReToVehFrntInAsyEvlrCritEve_Ca@ */ Record_FLOAT32_IEEE 0 autosar_swc_aeb_CM_single_m 2.000000 10.000000 /end CHARACTERISTIC
/begin CHARACTERISTIC CLTS_MinValForDynCalPrmForVehLenInAsyEvlrCritEve_Ca "The minimum value allowed for the vehicle length" VALUE 0xfe503d5c /* @ECU_Address@CLTS_MinValForDynCalPrmForVehLenInAsyEvlrCritEve_Ca@ */ Record_FLOAT32_IEEE 0 autosar_swc_aeb_CM_single_m 0.000000 5.000000 /end CHARACTERISTIC
/begin CHARACTERISTIC CLTS_SpdThdInAsyEvlrCritEve_Ca "Threshold for detectable host speed." VALUE 0xfe503dcc /* @ECU_Address@CLTS_SpdThdInAsyEvlrCritEve_Ca@ */ Record_FLOAT32_IEEE 0 autosar_swc_aeb_CM_single_m_per_s 0.000000 5.000000 /end CHARACTERISTIC
/begin CHARACTERISTIC CLTS_UseDynValInBrkDlyEstimnInAsyEvlrCritEve_Ca "Specifies whether the brake delay estimation from the brakes should be used. Otherwise an estimation is made from the acceleration of the host vehicle." VALUE 0xfe504192 /* @ECU_Address@CLTS_UseDynValInBrkDlyEstimnInAsyEvlrCritEve_Ca@ */ Record_BOOLEAN 0 autosar_swc_aeb_CM_logical 0 1 /end CHARACTERISTIC
/begin CHARACTERISTIC P_AEB_AWBTime "" VALUE 0xfe820008 /* @ECU_Address@P_AEB_AWBTime@ */ Record_FLOAT32_IEEE 0 autosar_swc_aeb_CM_single -3.4E+38 3.4E+38 /end CHARACTERISTIC
/begin CHARACTERISTIC P_AEB_DefaultAEBTarDec "" VALUE 0xfe8200e5 /* @ECU_Address@P_AEB_DefaultAEBTarDec@ */ Record_BOOLEAN 0 autosar_swc_aeb_CM_boolean 0 1 /end CHARACTERISTIC
/begin CHARACTERISTIC P_AEB_FuncSafetySwitch "" VALUE 0xfe8200e7 /* @ECU_Address@P_AEB_FuncSafetySwitch@ */ Record_BOOLEAN 0 autosar_swc_aeb_CM_boolean 0 1 /end CHARACTERISTIC
/begin CHARACTERISTIC P_AEB_StandStillSwitch "" VALUE 0xfe8200ed /* @ECU_Address@P_AEB_StandStillSwitch@ */ Record_BOOLEAN 0 autosar_swc_aeb_CM_boolean 0 1 /end CHARACTERISTIC
/begin CHARACTERISTIC P_AEB_StateConfirmTime "" VALUE 0xfe8200d0 /* @ECU_Address@P_AEB_StateConfirmTime@ */ Record_FLOAT32_IEEE 0 autosar_swc_aeb_CM_single -3.4E+38 3.4E+38 /end CHARACTERISTIC
/begin CHARACTERISTIC P_AEB_StepTime "" VALUE 0xfe8200d4 /* @ECU_Address@P_AEB_StepTime@ */ Record_FLOAT32_IEEE 0 autosar_swc_aeb_CM_single -3.4E+38 3.4E+38 /end CHARACTERISTIC
/begin CHARACTERISTIC P_AEB_Switch "" VALUE 0xfe8200ee /* @ECU_Address@P_AEB_Switch@ */ Record_BOOLEAN 0 autosar_swc_aeb_CM_boolean 0 1 /end CHARACTERISTIC
/begin CHARACTERISTIC VP_Prm_CmnCalPrmForMinThdForALatAvl "" VALUE 0xfe504160 /* @ECU_Address@VP_Prm_CmnCalPrmForMinThdForALatAvl@ */ Record_FLOAT32_IEEE 0 autosar_swc_aeb_CM_single 1.000000 1000000.000000 /end CHARACTERISTIC
/begin CHARACTERISTIC VP_Prm_DynCalPrmForAxleDstReToVehFrnt "" VALUE 0xfe504164 /* @ECU_Address@VP_Prm_DynCalPrmForAxleDstReToVehFrnt@ */ Record_FLOAT32_IEEE 0 autosar_swc_aeb_CM_single 1.000000 1000000.000000 /end CHARACTERISTIC
/begin CHARACTERISTIC VP_Prm_DynCalPrmForBicycleMdlAxleDistFrnt "" VALUE 0xfe504168 /* @ECU_Address@VP_Prm_DynCalPrmForBicycleMdlAxleDistFrnt@ */ Record_FLOAT32_IEEE 0 autosar_swc_aeb_CM_single 1.000000 1000000.000000 /end CHARACTERISTIC
/begin CHARACTERISTIC VP_Prm_DynCalPrmForBicycleMdlCornrgStfnFrnt "" VALUE 0xfe50416c /* @ECU_Address@VP_Prm_DynCalPrmForBicycleMdlCornrgStfnFrnt@ */ Record_FLOAT32_IEEE 0 autosar_swc_aeb_CM_single 1.000000 1000000.000000 /end CHARACTERISTIC
/begin CHARACTERISTIC VP_Prm_DynCalPrmForBicycleMdlCornrgStfnRe "" VALUE 0xfe504170 /* @ECU_Address@VP_Prm_DynCalPrmForBicycleMdlCornrgStfnRe@ */ Record_FLOAT32_IEEE 0 autosar_swc_aeb_CM_single 1.000000 1000000.000000 /end CHARACTERISTIC
/begin CHARACTERISTIC VP_Prm_DynCalPrmForVehLen "" VALUE 0xfe504174 /* @ECU_Address@VP_Prm_DynCalPrmForVehLen@ */ Record_FLOAT32_IEEE 0 autosar_swc_aeb_CM_single 1.000000 1000000.000000 /end CHARACTERISTIC
/begin CHARACTERISTIC VP_Prm_DynCalPrmForVehM "" VALUE 0xfe504178 /* @ECU_Address@VP_Prm_DynCalPrmForVehM@ */ Record_FLOAT32_IEEE 0 autosar_swc_aeb_CM_single 1.000000 1000000.000000 /end CHARACTERISTIC
/begin CHARACTERISTIC VP_Prm_DynCalPrmForVehSteerWhlAgRat "" VALUE 0xfe50417c /* @ECU_Address@VP_Prm_DynCalPrmForVehSteerWhlAgRat@ */ Record_FLOAT32_IEEE 0 autosar_swc_aeb_CM_single 1.000000 1000000.000000 /end CHARACTERISTIC
/begin CHARACTERISTIC VP_Prm_DynCalPrmForVehWhlBas "" VALUE 0xfe504180 /* @ECU_Address@VP_Prm_DynCalPrmForVehWhlBas@ */ Record_FLOAT32_IEEE 0 autosar_swc_aeb_CM_single 1.000000 1000000.000000 /end CHARACTERISTIC
/begin CHARACTERISTIC VP_Prm_DynCalPrmForVehWidth "" VALUE 0xfe504184 /* @ECU_Address@VP_Prm_DynCalPrmForVehWidth@ */ Record_FLOAT32_IEEE 0 autosar_swc_aeb_CM_single 1.000000 1000000.000000 /end CHARACTERISTIC
/begin MEASUREMENT AEB_AEBSts "" UBYTE autosar_swc_aeb_CM_uint8 0 0 0 255 ECU_ADDRESS 0xfe4a4d4c /* @ECU_Address@AEB_AEBSts@ */ /end MEASUREMENT
/begin MEASUREMENT AEB_BrakingThreat "" UBYTE autosar_swc_aeb_CM_boolean 0 0 0 1 ECU_ADDRESS 0xfe4a4d4e /* @ECU_Address@AEB_BrakingThreat@ */ /end MEASUREMENT
/begin MEASUREMENT AEB_BrkArbResult "" UBYTE autosar_swc_aeb_CM_uint8 0 0 0 255 ECU_ADDRESS 0xfe4a4d4f /* @ECU_Address@AEB_BrkArbResult@ */ /end MEASUREMENT
/begin MEASUREMENT AEB_DecelRequestBrkArb "" FLOAT32_IEEE autosar_swc_aeb_CM_single 0 0 -3.4E+38 3.4E+38 ECU_ADDRESS 0xfe4a4b00 /* @ECU_Address@AEB_DecelRequestBrkArb@ */ /end MEASUREMENT
/begin MEASUREMENT AEB_ExecTimestamp.nanoseconds "" ULONG autosar_swc_aeb_CM_uint32 0 0 0 4294967295 ECU_ADDRESS 0xfe4a458c /* @ECU_Address@AEB_ExecTimestamp.nanoseconds@ */ /end MEASUREMENT
/begin MEASUREMENT AEB_ExecTimestamp.seconds "" A_UINT64 autosar_swc_aeb_CM_uint64 0 0 0 18446744073709551615 ECU_ADDRESS 0xfe4a4590 /* @ECU_Address@AEB_ExecTimestamp.seconds@ */ /end MEASUREMENT
/begin MEASUREMENT AEB_ExecTimestamp.timeBaseStatus "" UBYTE autosar_swc_aeb_CM_uint8 0 0 0 255 ECU_ADDRESS 0xfe4a4588 /* @ECU_Address@AEB_ExecTimestamp.timeBaseStatus@ */ /end MEASUREMENT
/begin MEASUREMENT AEB_FCWSts "" UBYTE autosar_swc_aeb_CM_uint8 0 0 0 255 ECU_ADDRESS 0xfe4a4d51 /* @ECU_Address@AEB_FCWSts@ */ /end MEASUREMENT
/begin MEASUREMENT AEB_HostCrvtSceniaro "" UBYTE autosar_swc_aeb_CM_uint8 0 0 0 255 ECU_ADDRESS 0xfe4a4d52 /* @ECU_Address@AEB_HostCrvtSceniaro@ */ /end MEASUREMENT
/begin MEASUREMENT AEB_ObjSelectVersion "" ULONG autosar_swc_aeb_CM_uint32 0 0 0 4294967295 ECU_ADDRESS 0xfe4a4b04 /* @ECU_Address@AEB_ObjSelectVersion@ */ /end MEASUREMENT
/begin MEASUREMENT AEB_SafetyFunctionVersion "" ULONG autosar_swc_aeb_CM_uint32 0 0 0 4294967295 ECU_ADDRESS 0xfe4a4b08 /* @ECU_Address@AEB_SafetyFunctionVersion@ */ /end MEASUREMENT
/begin MEASUREMENT AEB_SceniaroCheckisOK "" UBYTE autosar_swc_aeb_CM_boolean 0 0 0 1 ECU_ADDRESS 0xfe4a4d55 /* @ECU_Address@AEB_SceniaroCheckisOK@ */ /end MEASUREMENT
/begin MEASUREMENT AEB_SceniaroFlag "" FLOAT32_IEEE autosar_swc_aeb_CM_single 0 0 -3.4E+38 3.4E+38 ECU_ADDRESS 0xfe4a4b10 /* @ECU_Address@AEB_SceniaroFlag@ */ /end MEASUREMENT
/begin MEASUREMENT AEB_TTC "" FLOAT32_IEEE autosar_swc_aeb_CM_single 0 0 -3.4E+38 3.4E+38 ECU_ADDRESS 0xfe4a4b14 /* @ECU_Address@AEB_TTC@ */ /end MEASUREMENT
/begin MEASUREMENT AEB_UpdateCnt "" UBYTE autosar_swc_aeb_CM_uint8 0 0 0 255 ECU_ADDRESS 0xfe4a4d57 /* @ECU_Address@AEB_UpdateCnt@ */ /end MEASUREMENT
/begin MEASUREMENT AEB_Version "" ULONG autosar_swc_aeb_CM_uint32 0 0 0 4294967295 ECU_ADDRESS 0xfe4a4b18 /* @ECU_Address@AEB_Version@ */ /end MEASUREMENT
/begin MEASUREMENT SwcOut_AEB_BRKINFO.AEBDecCtrlReqest "" UBYTE autosar_swc_aeb_CM_uint8 0 0 0 255 ECU_ADDRESS 0xfe4a4b1c /* @ECU_Address@SwcOut_AEB_BRKINFO.AEBDecCtrlReqest@ */ /end MEASUREMENT
/begin MEASUREMENT SwcOut_AEB_BRKINFO.AEBMode "" UBYTE autosar_swc_aeb_CM_uint8 0 0 0 255 ECU_ADDRESS 0xfe4a4b25 /* @ECU_Address@SwcOut_AEB_BRKINFO.AEBMode@ */ /end MEASUREMENT
/begin MEASUREMENT SwcOut_AEB_BRKINFO.AEBReq "" UBYTE autosar_swc_aeb_CM_uint8 0 0 0 255 ECU_ADDRESS 0xfe4a4b1d /* @ECU_Address@SwcOut_AEB_BRKINFO.AEBReq@ */ /end MEASUREMENT
/begin MEASUREMENT SwcOut_AEB_BRKINFO.AEBTarDec "" FLOAT32_IEEE autosar_swc_aeb_CM_single 0 0 -3.4E+38 3.4E+38 ECU_ADDRESS 0xfe4a4b2c /* @ECU_Address@SwcOut_AEB_BRKINFO.AEBTarDec@ */ /end MEASUREMENT
/begin MEASUREMENT SwcOut_AEB_BRKINFO.AWBLevel "" UBYTE autosar_swc_aeb_CM_uint8 0 0 0 255 ECU_ADDRESS 0xfe4a4b20 /* @ECU_Address@SwcOut_AEB_BRKINFO.AWBLevel@ */ /end MEASUREMENT
/begin MEASUREMENT SwcOut_AEB_BRKINFO.AWBRequest "" UBYTE autosar_swc_aeb_CM_uint8 0 0 0 255 ECU_ADDRESS 0xfe4a4b1f /* @ECU_Address@SwcOut_AEB_BRKINFO.AWBRequest@ */ /end MEASUREMENT
/begin MEASUREMENT SwcOut_AEB_BRKINFO.DWReq "" UBYTE autosar_swc_aeb_CM_uint8 0 0 0 255 ECU_ADDRESS 0xfe4a4b1e /* @ECU_Address@SwcOut_AEB_BRKINFO.DWReq@ */ /end MEASUREMENT
/begin MEASUREMENT SwcOut_AEB_BRKINFO.FCTBMode "" UBYTE autosar_swc_aeb_CM_uint8 0 0 0 255 ECU_ADDRESS 0xfe4a4b26 /* @ECU_Address@SwcOut_AEB_BRKINFO.FCTBMode@ */ /end MEASUREMENT
/begin MEASUREMENT SwcOut_AEB_BRKINFO.FCWMode "" UBYTE autosar_swc_aeb_CM_uint8 0 0 0 255 ECU_ADDRESS 0xfe4a4b24 /* @ECU_Address@SwcOut_AEB_BRKINFO.FCWMode@ */ /end MEASUREMENT
/begin MEASUREMENT SwcOut_AEB_BRKINFO.HBAlevel "" UBYTE autosar_swc_aeb_CM_uint8 0 0 0 255 ECU_ADDRESS 0xfe4a4b22 /* @ECU_Address@SwcOut_AEB_BRKINFO.HBAlevel@ */ /end MEASUREMENT
/begin MEASUREMENT SwcOut_AEB_BRKINFO.HBArequest "" UBYTE autosar_swc_aeb_CM_uint8 0 0 0 255 ECU_ADDRESS 0xfe4a4b23 /* @ECU_Address@SwcOut_AEB_BRKINFO.HBArequest@ */ /end MEASUREMENT
/begin MEASUREMENT SwcOut_AEB_BRKINFO.HazdLmpReq "" UBYTE autosar_swc_aeb_CM_uint8 0 0 0 255 ECU_ADDRESS 0xfe4a4b27 /* @ECU_Address@SwcOut_AEB_BRKINFO.HazdLmpReq@ */ /end MEASUREMENT
/begin MEASUREMENT SwcOut_AEB_BRKINFO.PrefillRequest "" UBYTE autosar_swc_aeb_CM_uint8 0 0 0 255 ECU_ADDRESS 0xfe4a4b21 /* @ECU_Address@SwcOut_AEB_BRKINFO.PrefillRequest@ */ /end MEASUREMENT
/begin MEASUREMENT SwcOut_AEB_BRKINFO.TextInfo "" UBYTE autosar_swc_aeb_CM_uint8 0 0 0 255 ECU_ADDRESS 0xfe4a4b28 /* @ECU_Address@SwcOut_AEB_BRKINFO.TextInfo@ */ /end MEASUREMENT
/begin MEASUREMENT SwcOut_AEB_BRKINFO.TextinfoWarn "" UBYTE autosar_swc_aeb_CM_uint8 0 0 0 255 ECU_ADDRESS 0xfe4a4b29 /* @ECU_Address@SwcOut_AEB_BRKINFO.TextinfoWarn@ */ /end MEASUREMENT
/begin MEASUREMENT SwcOut_AEB_DebugInfo.ego_info.a_lat "" FLOAT32_IEEE autosar_swc_aeb_CM_single 0 0 -3.4E+38 3.4E+38 ECU_ADDRESS 0xfe4a49c4 /* @ECU_Address@SwcOut_AEB_DebugInfo.ego_info.a_lat@ */ /end MEASUREMENT
/begin MEASUREMENT SwcOut_AEB_DebugInfo.ego_info.a_lgt "" FLOAT32_IEEE autosar_swc_aeb_CM_single 0 0 -3.4E+38 3.4E+38 ECU_ADDRESS 0xfe4a49c0 /* @ECU_Address@SwcOut_AEB_DebugInfo.ego_info.a_lgt@ */ /end MEASUREMENT
/begin MEASUREMENT SwcOut_AEB_DebugInfo.ego_info.acc_request_acceleration "" FLOAT32_IEEE autosar_swc_aeb_CM_single 0 0 -3.4E+38 3.4E+38 ECU_ADDRESS 0xfe4a49e4 /* @ECU_Address@SwcOut_AEB_DebugInfo.ego_info.acc_request_acceleration@ */ /end MEASUREMENT
/begin MEASUREMENT SwcOut_AEB_DebugInfo.ego_info.acceleration_pedal_position "" FLOAT32_IEEE autosar_swc_aeb_CM_single 0 0 -3.4E+38 3.4E+38 ECU_ADDRESS 0xfe4a49dc /* @ECU_Address@SwcOut_AEB_DebugInfo.ego_info.acceleration_pedal_position@ */ /end MEASUREMENT
/begin MEASUREMENT SwcOut_AEB_DebugInfo.ego_info.brake_pedal_applied "" UBYTE autosar_swc_aeb_CM_boolean 0 0 0 1 ECU_ADDRESS 0xfe4a49e3 /* @ECU_Address@SwcOut_AEB_DebugInfo.ego_info.brake_pedal_applied@ */ /end MEASUREMENT
/begin MEASUREMENT SwcOut_AEB_DebugInfo.ego_info.curvature "" FLOAT32_IEEE autosar_swc_aeb_CM_single 0 0 -3.4E+38 3.4E+38 ECU_ADDRESS 0xfe4a49cc /* @ECU_Address@SwcOut_AEB_DebugInfo.ego_info.curvature@ */ /end MEASUREMENT
/begin MEASUREMENT SwcOut_AEB_DebugInfo.ego_info.curve_radius "" FLOAT32_IEEE autosar_swc_aeb_CM_single 0 0 -3.4E+38 3.4E+38 ECU_ADDRESS 0xfe4a49d0 /* @ECU_Address@SwcOut_AEB_DebugInfo.ego_info.curve_radius@ */ /end MEASUREMENT
/begin MEASUREMENT SwcOut_AEB_DebugInfo.ego_info.gear "" SBYTE autosar_swc_aeb_CM_int8 0 0 -128 127 ECU_ADDRESS 0xfe4a49e1 /* @ECU_Address@SwcOut_AEB_DebugInfo.ego_info.gear@ */ /end MEASUREMENT
/begin MEASUREMENT SwcOut_AEB_DebugInfo.ego_info.master_cylinder_pressure "" SBYTE autosar_swc_aeb_CM_int8 0 0 -128 127 ECU_ADDRESS 0xfe4a49e0 /* @ECU_Address@SwcOut_AEB_DebugInfo.ego_info.master_cylinder_pressure@ */ /end MEASUREMENT
/begin MEASUREMENT SwcOut_AEB_DebugInfo.ego_info.steer_angle "" FLOAT32_IEEE autosar_swc_aeb_CM_single 0 0 -3.4E+38 3.4E+38 ECU_ADDRESS 0xfe4a49d4 /* @ECU_Address@SwcOut_AEB_DebugInfo.ego_info.steer_angle@ */ /end MEASUREMENT
/begin MEASUREMENT SwcOut_AEB_DebugInfo.ego_info.steer_angle_spd "" FLOAT32_IEEE autosar_swc_aeb_CM_single 0 0 -3.4E+38 3.4E+38 ECU_ADDRESS 0xfe4a49d8 /* @ECU_Address@SwcOut_AEB_DebugInfo.ego_info.steer_angle_spd@ */ /end MEASUREMENT
/begin MEASUREMENT SwcOut_AEB_DebugInfo.ego_info.v_lat "" FLOAT32_IEEE autosar_swc_aeb_CM_single 0 0 -3.4E+38 3.4E+38 ECU_ADDRESS 0xfe4a49bc /* @ECU_Address@SwcOut_AEB_DebugInfo.ego_info.v_lat@ */ /end MEASUREMENT
/begin MEASUREMENT SwcOut_AEB_DebugInfo.ego_info.v_lgt "" FLOAT32_IEEE autosar_swc_aeb_CM_single 0 0 -3.4E+38 3.4E+38 ECU_ADDRESS 0xfe4a49b8 /* @ECU_Address@SwcOut_AEB_DebugInfo.ego_info.v_lgt@ */ /end MEASUREMENT
/begin MEASUREMENT SwcOut_AEB_DebugInfo.ego_info.vehicle_standstill_status "" SBYTE autosar_swc_aeb_CM_int8 0 0 -128 127 ECU_ADDRESS 0xfe4a49e2 /* @ECU_Address@SwcOut_AEB_DebugInfo.ego_info.vehicle_standstill_status@ */ /end MEASUREMENT
/begin MEASUREMENT SwcOut_AEB_DebugInfo.ego_info.yaw_rate "" FLOAT32_IEEE autosar_swc_aeb_CM_single 0 0 -3.4E+38 3.4E+38 ECU_ADDRESS 0xfe4a49c8 /* @ECU_Address@SwcOut_AEB_DebugInfo.ego_info.yaw_rate@ */ /end MEASUREMENT
/begin MEASUREMENT SwcOut_AEB_DebugInfo.inhibit_info.aeb_deactive_flag "" ULONG autosar_swc_aeb_CM_uint32 0 0 0 4294967295 ECU_ADDRESS 0xfe4a4ad0 /* @ECU_Address@SwcOut_AEB_DebugInfo.inhibit_info.aeb_deactive_flag@ */ /end MEASUREMENT
/begin MEASUREMENT SwcOut_AEB_DebugInfo.inhibit_info.aeb_inhibit_flag_1 "" ULONG autosar_swc_aeb_CM_uint32 0 0 0 4294967295 ECU_ADDRESS 0xfe4a4ac4 /* @ECU_Address@SwcOut_AEB_DebugInfo.inhibit_info.aeb_inhibit_flag_1@ */ /end MEASUREMENT
/begin MEASUREMENT SwcOut_AEB_DebugInfo.inhibit_info.aeb_inhibit_flag_2 "" ULONG autosar_swc_aeb_CM_uint32 0 0 0 4294967295 ECU_ADDRESS 0xfe4a4ac8 /* @ECU_Address@SwcOut_AEB_DebugInfo.inhibit_info.aeb_inhibit_flag_2@ */ /end MEASUREMENT
/begin MEASUREMENT SwcOut_AEB_DebugInfo.inhibit_info.aeb_inhibit_override_flag "" ULONG autosar_swc_aeb_CM_uint32 0 0 0 4294967295 ECU_ADDRESS 0xfe4a4ad8 /* @ECU_Address@SwcOut_AEB_DebugInfo.inhibit_info.aeb_inhibit_override_flag@ */ /end MEASUREMENT
/begin MEASUREMENT SwcOut_AEB_DebugInfo.inhibit_info.confidence_info_flag "" ULONG autosar_swc_aeb_CM_uint32 0 0 0 4294967295 ECU_ADDRESS 0xfe4a4ac0 /* @ECU_Address@SwcOut_AEB_DebugInfo.inhibit_info.confidence_info_flag@ */ /end MEASUREMENT
/begin MEASUREMENT SwcOut_AEB_DebugInfo.inhibit_info.fcw_deactive_flag "" ULONG autosar_swc_aeb_CM_uint32 0 0 0 4294967295 ECU_ADDRESS 0xfe4a4ad4 /* @ECU_Address@SwcOut_AEB_DebugInfo.inhibit_info.fcw_deactive_flag@ */ /end MEASUREMENT
/begin MEASUREMENT SwcOut_AEB_DebugInfo.inhibit_info.fcw_inhibit_flag "" ULONG autosar_swc_aeb_CM_uint32 0 0 0 4294967295 ECU_ADDRESS 0xfe4a4acc /* @ECU_Address@SwcOut_AEB_DebugInfo.inhibit_info.fcw_inhibit_flag@ */ /end MEASUREMENT
/begin MEASUREMENT SwcOut_AEB_DebugInfo.inhibit_info.fcw_inhibit_override_flag "" ULONG autosar_swc_aeb_CM_uint32 0 0 0 4294967295 ECU_ADDRESS 0xfe4a4adc /* @ECU_Address@SwcOut_AEB_DebugInfo.inhibit_info.fcw_inhibit_override_flag@ */ /end MEASUREMENT
/begin MEASUREMENT SwcOut_AEB_DebugInfo.obj_data_info[0].bounding_box.cos_rotation "" FLOAT32_IEEE autosar_swc_aeb_CM_single 0 0 -3.4E+38 3.4E+38 ECU_ADDRESS 0xfe4a45d4 /* @ECU_Address@SwcOut_AEB_DebugInfo.obj_data_info[0].bounding_box.cos_rotation@ */ /end MEASUREMENT
/begin MEASUREMENT SwcOut_AEB_DebugInfo.obj_data_info[0].bounding_box.length_side_lat "" FLOAT32_IEEE autosar_swc_aeb_CM_single 0 0 -3.4E+38 3.4E+38 ECU_ADDRESS 0xfe4a45c8 /* @ECU_Address@SwcOut_AEB_DebugInfo.obj_data_info[0].bounding_box.length_side_lat@ */ /end MEASUREMENT
/begin MEASUREMENT SwcOut_AEB_DebugInfo.obj_data_info[0].bounding_box.length_side_lgt "" FLOAT32_IEEE autosar_swc_aeb_CM_single 0 0 -3.4E+38 3.4E+38 ECU_ADDRESS 0xfe4a45cc /* @ECU_Address@SwcOut_AEB_DebugInfo.obj_data_info[0].bounding_box.length_side_lgt@ */ /end MEASUREMENT
/begin MEASUREMENT SwcOut_AEB_DebugInfo.obj_data_info[0].bounding_box.sin_rotation "" FLOAT32_IEEE autosar_swc_aeb_CM_single 0 0 -3.4E+38 3.4E+38 ECU_ADDRESS 0xfe4a45d0 /* @ECU_Address@SwcOut_AEB_DebugInfo.obj_data_info[0].bounding_box.sin_rotation@ */ /end MEASUREMENT
/begin MEASUREMENT SwcOut_AEB_DebugInfo.obj_data_info[0].long_pred_time.inpath "" UBYTE autosar_swc_aeb_CM_boolean 0 0 0 1 ECU_ADDRESS 0xfe4a45ec /* @ECU_Address@SwcOut_AEB_DebugInfo.obj_data_info[0].long_pred_time.inpath@ */ /end MEASUREMENT
/begin MEASUREMENT SwcOut_AEB_DebugInfo.obj_data_info[0].long_pred_time.inpath_current_position "" UBYTE autosar_swc_aeb_CM_boolean 0 0 0 1 ECU_ADDRESS 0xfe4a45ee /* @ECU_Address@SwcOut_AEB_DebugInfo.obj_data_info[0].long_pred_time.inpath_current_position@ */ /end MEASUREMENT
/begin MEASUREMENT SwcOut_AEB_DebugInfo.obj_data_info[0].long_pred_time.inpath_predict_position "" UBYTE autosar_swc_aeb_CM_boolean 0 0 0 1 ECU_ADDRESS 0xfe4a45ed /* @ECU_Address@SwcOut_AEB_DebugInfo.obj_data_info[0].long_pred_time.inpath_predict_position@ */ /end MEASUREMENT
/begin MEASUREMENT SwcOut_AEB_DebugInfo.obj_data_info[0].long_pred_time.prediction_valid "" UBYTE autosar_swc_aeb_CM_boolean 0 0 0 1 ECU_ADDRESS 0xfe4a45f1 /* @ECU_Address@SwcOut_AEB_DebugInfo.obj_data_info[0].long_pred_time.prediction_valid@ */ /end MEASUREMENT
/begin MEASUREMENT SwcOut_AEB_DebugInfo.obj_data_info[0].long_pred_time.ttr "" FLOAT32_IEEE autosar_swc_aeb_CM_single 0 0 -3.4E+38 3.4E+38 ECU_ADDRESS 0xfe4a45e8 /* @ECU_Address@SwcOut_AEB_DebugInfo.obj_data_info[0].long_pred_time.ttr@ */ /end MEASUREMENT
/begin MEASUREMENT SwcOut_AEB_DebugInfo.obj_data_info[0].long_pred_time.use_inpath_calculation "" UBYTE autosar_swc_aeb_CM_boolean 0 0 0 1 ECU_ADDRESS 0xfe4a45ef /* @ECU_Address@SwcOut_AEB_DebugInfo.obj_data_info[0].long_pred_time.use_inpath_calculation@ */ /end MEASUREMENT
/begin MEASUREMENT SwcOut_AEB_DebugInfo.obj_data_info[0].long_pred_time.use_out_offpath_calculation "" UBYTE autosar_swc_aeb_CM_boolean 0 0 0 1 ECU_ADDRESS 0xfe4a45f0 /* @ECU_Address@SwcOut_AEB_DebugInfo.obj_data_info[0].long_pred_time.use_out_offpath_calculation@ */ /end MEASUREMENT
/begin MEASUREMENT SwcOut_AEB_DebugInfo.obj_data_info[0].motion_type.abs_heading "" FLOAT32_IEEE autosar_swc_aeb_CM_single 0 0 -3.4E+38 3.4E+38 ECU_ADDRESS 0xfe4a45c4 /* @ECU_Address@SwcOut_AEB_DebugInfo.obj_data_info[0].motion_type.abs_heading@ */ /end MEASUREMENT
/begin MEASUREMENT SwcOut_AEB_DebugInfo.obj_data_info[0].motion_type.curved_motion "" UBYTE autosar_swc_aeb_CM_boolean 0 0 0 1 ECU_ADDRESS 0xfe4a45c2 /* @ECU_Address@SwcOut_AEB_DebugInfo.obj_data_info[0].motion_type.curved_motion@ */ /end MEASUREMENT
/begin MEASUREMENT SwcOut_AEB_DebugInfo.obj_data_info[0].motion_type.moving_oncoming "" UBYTE autosar_swc_aeb_CM_boolean 0 0 0 1 ECU_ADDRESS 0xfe4a45bd /* @ECU_Address@SwcOut_AEB_DebugInfo.obj_data_info[0].motion_type.moving_oncoming@ */ /end MEASUREMENT
/begin MEASUREMENT SwcOut_AEB_DebugInfo.obj_data_info[0].motion_type.object_is_motor_vehicle "" UBYTE autosar_swc_aeb_CM_boolean 0 0 0 1 ECU_ADDRESS 0xfe4a45c1 /* @ECU_Address@SwcOut_AEB_DebugInfo.obj_data_info[0].motion_type.object_is_motor_vehicle@ */ /end MEASUREMENT
/begin MEASUREMENT SwcOut_AEB_DebugInfo.obj_data_info[0].motion_type.object_is_vehicle "" UBYTE autosar_swc_aeb_CM_boolean 0 0 0 1 ECU_ADDRESS 0xfe4a45c0 /* @ECU_Address@SwcOut_AEB_DebugInfo.obj_data_info[0].motion_type.object_is_vehicle@ */ /end MEASUREMENT
/begin MEASUREMENT SwcOut_AEB_DebugInfo.obj_data_info[0].motion_type.parallell_vehicle_long_predict "" UBYTE autosar_swc_aeb_CM_boolean 0 0 0 1 ECU_ADDRESS 0xfe4a45be /* @ECU_Address@SwcOut_AEB_DebugInfo.obj_data_info[0].motion_type.parallell_vehicle_long_predict@ */ /end MEASUREMENT
/begin MEASUREMENT SwcOut_AEB_DebugInfo.obj_data_info[0].motion_type.parallell_vehicle_short_predict "" UBYTE autosar_swc_aeb_CM_boolean 0 0 0 1 ECU_ADDRESS 0xfe4a45bf /* @ECU_Address@SwcOut_AEB_DebugInfo.obj_data_info[0].motion_type.parallell_vehicle_short_predict@ */ /end MEASUREMENT
/begin MEASUREMENT SwcOut_AEB_DebugInfo.obj_data_info[0].motion_type.side_is_closest "" UBYTE autosar_swc_aeb_CM_boolean 0 0 0 1 ECU_ADDRESS 0xfe4a45c3 /* @ECU_Address@SwcOut_AEB_DebugInfo.obj_data_info[0].motion_type.side_is_closest@ */ /end MEASUREMENT
/begin MEASUREMENT SwcOut_AEB_DebugInfo.obj_data_info[0].motion_type.stationary "" UBYTE autosar_swc_aeb_CM_boolean 0 0 0 1 ECU_ADDRESS 0xfe4a45bc /* @ECU_Address@SwcOut_AEB_DebugInfo.obj_data_info[0].motion_type.stationary@ */ /end MEASUREMENT
/begin MEASUREMENT SwcOut_AEB_DebugInfo.obj_data_info[0].offsets.offs_lat_inpath_close_edge "" FLOAT32_IEEE autosar_swc_aeb_CM_single 0 0 -3.4E+38 3.4E+38 ECU_ADDRESS 0xfe4a460c /* @ECU_Address@SwcOut_AEB_DebugInfo.obj_data_info[0].offsets.offs_lat_inpath_close_edge@ */ /end MEASUREMENT
/begin MEASUREMENT SwcOut_AEB_DebugInfo.obj_data_info[0].offsets.offs_lat_inpath_far_edge "" FLOAT32_IEEE autosar_swc_aeb_CM_single 0 0 -3.4E+38 3.4E+38 ECU_ADDRESS 0xfe4a4610 /* @ECU_Address@SwcOut_AEB_DebugInfo.obj_data_info[0].offsets.offs_lat_inpath_far_edge@ */ /end MEASUREMENT
/begin MEASUREMENT SwcOut_AEB_DebugInfo.obj_data_info[0].offsets.offs_lat_inpath_primary_target "" FLOAT32_IEEE autosar_swc_aeb_CM_single 0 0 -3.4E+38 3.4E+38 ECU_ADDRESS 0xfe4a4608 /* @ECU_Address@SwcOut_AEB_DebugInfo.obj_data_info[0].offsets.offs_lat_inpath_primary_target@ */ /end MEASUREMENT
/begin MEASUREMENT SwcOut_AEB_DebugInfo.obj_data_info[0].offsets.offs_lat_intersection "" FLOAT32_IEEE autosar_swc_aeb_CM_single 0 0 -3.4E+38 3.4E+38 ECU_ADDRESS 0xfe4a4614 /* @ECU_Address@SwcOut_AEB_DebugInfo.obj_data_info[0].offsets.offs_lat_intersection@ */ /end MEASUREMENT
/begin MEASUREMENT SwcOut_AEB_DebugInfo.obj_data_info[0].offsets.offs_lat_long_predict "" FLOAT32_IEEE autosar_swc_aeb_CM_single 0 0 -3.4E+38 3.4E+38 ECU_ADDRESS 0xfe4a45f8 /* @ECU_Address@SwcOut_AEB_DebugInfo.obj_data_info[0].offsets.offs_lat_long_predict@ */ /end MEASUREMENT
/begin MEASUREMENT SwcOut_AEB_DebugInfo.obj_data_info[0].offsets.offs_lat_manoeuvre "" FLOAT32_IEEE autosar_swc_aeb_CM_single 0 0 -3.4E+38 3.4E+38 ECU_ADDRESS 0xfe4a4604 /* @ECU_Address@SwcOut_AEB_DebugInfo.obj_data_info[0].offsets.offs_lat_manoeuvre@ */ /end MEASUREMENT
/begin MEASUREMENT SwcOut_AEB_DebugInfo.obj_data_info[0].offsets.offs_lat_multiple_target "" FLOAT32_IEEE autosar_swc_aeb_CM_single 0 0 -3.4E+38 3.4E+38 ECU_ADDRESS 0xfe4a4618 /* @ECU_Address@SwcOut_AEB_DebugInfo.obj_data_info[0].offsets.offs_lat_multiple_target@ */ /end MEASUREMENT
/begin MEASUREMENT SwcOut_AEB_DebugInfo.obj_data_info[0].offsets.offs_lat_short_predict "" FLOAT32_IEEE autosar_swc_aeb_CM_single 0 0 -3.4E+38 3.4E+38 ECU_ADDRESS 0xfe4a4600 /* @ECU_Address@SwcOut_AEB_DebugInfo.obj_data_info[0].offsets.offs_lat_short_predict@ */ /end MEASUREMENT
/begin MEASUREMENT SwcOut_AEB_DebugInfo.obj_data_info[0].offsets.offs_lgt_long_predict "" FLOAT32_IEEE autosar_swc_aeb_CM_single 0 0 -3.4E+38 3.4E+38 ECU_ADDRESS 0xfe4a45f4 /* @ECU_Address@SwcOut_AEB_DebugInfo.obj_data_info[0].offsets.offs_lgt_long_predict@ */ /end MEASUREMENT
/begin MEASUREMENT SwcOut_AEB_DebugInfo.obj_data_info[0].offsets.offs_lgt_short_predict "" FLOAT32_IEEE autosar_swc_aeb_CM_single 0 0 -3.4E+38 3.4E+38 ECU_ADDRESS 0xfe4a45fc /* @ECU_Address@SwcOut_AEB_DebugInfo.obj_data_info[0].offsets.offs_lgt_short_predict@ */ /end MEASUREMENT
/begin MEASUREMENT SwcOut_AEB_DebugInfo.obj_data_info[0].porperty.a "" FLOAT32_IEEE autosar_swc_aeb_CM_single 0 0 -3.4E+38 3.4E+38 ECU_ADDRESS 0xfe4a45b4 /* @ECU_Address@SwcOut_AEB_DebugInfo.obj_data_info[0].porperty.a@ */ /end MEASUREMENT
/begin MEASUREMENT SwcOut_AEB_DebugInfo.obj_data_info[0].porperty.a_lat "" FLOAT32_IEEE autosar_swc_aeb_CM_single 0 0 -3.4E+38 3.4E+38 ECU_ADDRESS 0xfe4a45b0 /* @ECU_Address@SwcOut_AEB_DebugInfo.obj_data_info[0].porperty.a_lat@ */ /end MEASUREMENT
/begin MEASUREMENT SwcOut_AEB_DebugInfo.obj_data_info[0].porperty.a_lgt "" FLOAT32_IEEE autosar_swc_aeb_CM_single 0 0 -3.4E+38 3.4E+38 ECU_ADDRESS 0xfe4a45ac /* @ECU_Address@SwcOut_AEB_DebugInfo.obj_data_info[0].porperty.a_lgt@ */ /end MEASUREMENT
/begin MEASUREMENT SwcOut_AEB_DebugInfo.obj_data_info[0].porperty.curvature "" FLOAT32_IEEE autosar_swc_aeb_CM_single 0 0 -3.4E+38 3.4E+38 ECU_ADDRESS 0xfe4a45b8 /* @ECU_Address@SwcOut_AEB_DebugInfo.obj_data_info[0].porperty.curvature@ */ /end MEASUREMENT
/begin MEASUREMENT SwcOut_AEB_DebugInfo.obj_data_info[0].porperty.p_lat "" FLOAT32_IEEE autosar_swc_aeb_CM_single 0 0 -3.4E+38 3.4E+38 ECU_ADDRESS 0xfe4a459c /* @ECU_Address@SwcOut_AEB_DebugInfo.obj_data_info[0].porperty.p_lat@ */ /end MEASUREMENT
/begin MEASUREMENT SwcOut_AEB_DebugInfo.obj_data_info[0].porperty.p_lgt "" FLOAT32_IEEE autosar_swc_aeb_CM_single 0 0 -3.4E+38 3.4E+38 ECU_ADDRESS 0xfe4a4598 /* @ECU_Address@SwcOut_AEB_DebugInfo.obj_data_info[0].porperty.p_lgt@ */ /end MEASUREMENT
/begin MEASUREMENT SwcOut_AEB_DebugInfo.obj_data_info[0].porperty.spd "" FLOAT32_IEEE autosar_swc_aeb_CM_single 0 0 -3.4E+38 3.4E+38 ECU_ADDRESS 0xfe4a45a0 /* @ECU_Address@SwcOut_AEB_DebugInfo.obj_data_info[0].porperty.spd@ */ /end MEASUREMENT
/begin MEASUREMENT SwcOut_AEB_DebugInfo.obj_data_info[0].porperty.v_lat "" FLOAT32_IEEE autosar_swc_aeb_CM_single 0 0 -3.4E+38 3.4E+38 ECU_ADDRESS 0xfe4a45a8 /* @ECU_Address@SwcOut_AEB_DebugInfo.obj_data_info[0].porperty.v_lat@ */ /end MEASUREMENT
/begin MEASUREMENT SwcOut_AEB_DebugInfo.obj_data_info[0].porperty.v_lgt "" FLOAT32_IEEE autosar_swc_aeb_CM_single 0 0 -3.4E+38 3.4E+38 ECU_ADDRESS 0xfe4a45a4 /* @ECU_Address@SwcOut_AEB_DebugInfo.obj_data_info[0].porperty.v_lgt@ */ /end MEASUREMENT
/begin MEASUREMENT SwcOut_AEB_DebugInfo.obj_data_info[0].short_pred_time.inpath "" UBYTE autosar_swc_aeb_CM_boolean 0 0 0 1 ECU_ADDRESS 0xfe4a45e1 /* @ECU_Address@SwcOut_AEB_DebugInfo.obj_data_info[0].short_pred_time.inpath@ */ /end MEASUREMENT
/begin MEASUREMENT SwcOut_AEB_DebugInfo.obj_data_info[0].short_pred_time.inpath_current_position "" UBYTE autosar_swc_aeb_CM_boolean 0 0 0 1 ECU_ADDRESS 0xfe4a45e3 /* @ECU_Address@SwcOut_AEB_DebugInfo.obj_data_info[0].short_pred_time.inpath_current_position@ */ /end MEASUREMENT
/begin MEASUREMENT SwcOut_AEB_DebugInfo.obj_data_info[0].short_pred_time.inpath_predict_position "" UBYTE autosar_swc_aeb_CM_boolean 0 0 0 1 ECU_ADDRESS 0xfe4a45e2 /* @ECU_Address@SwcOut_AEB_DebugInfo.obj_data_info[0].short_pred_time.inpath_predict_position@ */ /end MEASUREMENT
/begin MEASUREMENT SwcOut_AEB_DebugInfo.obj_data_info[0].short_pred_time.prediction_valid "" UBYTE autosar_swc_aeb_CM_boolean 0 0 0 1 ECU_ADDRESS 0xfe4a45e6 /* @ECU_Address@SwcOut_AEB_DebugInfo.obj_data_info[0].short_pred_time.prediction_valid@ */ /end MEASUREMENT
/begin MEASUREMENT SwcOut_AEB_DebugInfo.obj_data_info[0].short_pred_time.ttm "" FLOAT32_IEEE autosar_swc_aeb_CM_single 0 0 -3.4E+38 3.4E+38 ECU_ADDRESS 0xfe4a45dc /* @ECU_Address@SwcOut_AEB_DebugInfo.obj_data_info[0].short_pred_time.ttm@ */ /end MEASUREMENT
/begin MEASUREMENT SwcOut_AEB_DebugInfo.obj_data_info[0].short_pred_time.ttm_selected "" UBYTE autosar_swc_aeb_CM_boolean 0 0 0 1 ECU_ADDRESS 0xfe4a45e0 /* @ECU_Address@SwcOut_AEB_DebugInfo.obj_data_info[0].short_pred_time.ttm_selected@ */ /end MEASUREMENT
/begin MEASUREMENT SwcOut_AEB_DebugInfo.obj_data_info[0].short_pred_time.ttr "" FLOAT32_IEEE autosar_swc_aeb_CM_single 0 0 -3.4E+38 3.4E+38 ECU_ADDRESS 0xfe4a45d8 /* @ECU_Address@SwcOut_AEB_DebugInfo.obj_data_info[0].short_pred_time.ttr@ */ /end MEASUREMENT
/begin MEASUREMENT SwcOut_AEB_DebugInfo.obj_data_info[0].short_pred_time.use_inpath_calculation "" UBYTE autosar_swc_aeb_CM_boolean 0 0 0 1 ECU_ADDRESS 0xfe4a45e4 /* @ECU_Address@SwcOut_AEB_DebugInfo.obj_data_info[0].short_pred_time.use_inpath_calculation@ */ /end MEASUREMENT
/begin MEASUREMENT SwcOut_AEB_DebugInfo.obj_data_info[0].short_pred_time.use_out_offpath_calculation "" UBYTE autosar_swc_aeb_CM_boolean 0 0 0 1 ECU_ADDRESS 0xfe4a45e5 /* @ECU_Address@SwcOut_AEB_DebugInfo.obj_data_info[0].short_pred_time.use_out_offpath_calculation@ */ /end MEASUREMENT
/begin MEASUREMENT SwcOut_AEB_DebugInfo.primary_target_intv_info.motion_request_intv.a_lat_quality "" UBYTE autosar_swc_aeb_CM_boolean 0 0 0 1 ECU_ADDRESS 0xfe4a49ec /* @ECU_Address@SwcOut_AEB_DebugInfo.primary_target_intv_info.motion_request_intv.a_lat_quality@ */ /end MEASUREMENT
/begin MEASUREMENT SwcOut_AEB_DebugInfo.primary_target_intv_info.motion_request_intv.a_lat_request "" FLOAT32_IEEE autosar_swc_aeb_CM_single 0 0 -3.4E+38 3.4E+38 ECU_ADDRESS 0xfe4a49e8 /* @ECU_Address@SwcOut_AEB_DebugInfo.primary_target_intv_info.motion_request_intv.a_lat_request@ */ /end MEASUREMENT
/begin MEASUREMENT SwcOut_AEB_DebugInfo.primary_target_intv_info.motion_request_intv.a_neg_lgt_request "" FLOAT32_IEEE autosar_swc_aeb_CM_single 0 0 -3.4E+38 3.4E+38 ECU_ADDRESS 0xfe4a49f0 /* @ECU_Address@SwcOut_AEB_DebugInfo.primary_target_intv_info.motion_request_intv.a_neg_lgt_request@ */ /end MEASUREMENT
/begin MEASUREMENT SwcOut_AEB_DebugInfo.primary_target_intv_info.motion_request_intv.crvt_rate_request_left "" FLOAT32_IEEE autosar_swc_aeb_CM_single 0 0 -3.4E+38 3.4E+38 ECU_ADDRESS 0xfe4a49fc /* @ECU_Address@SwcOut_AEB_DebugInfo.primary_target_intv_info.motion_request_intv.crvt_rate_request_left@ */ /end MEASUREMENT
/begin MEASUREMENT SwcOut_AEB_DebugInfo.primary_target_intv_info.motion_request_intv.crvt_rate_request_right "" FLOAT32_IEEE autosar_swc_aeb_CM_single 0 0 -3.4E+38 3.4E+38 ECU_ADDRESS 0xfe4a4a04 /* @ECU_Address@SwcOut_AEB_DebugInfo.primary_target_intv_info.motion_request_intv.crvt_rate_request_right@ */ /end MEASUREMENT
/begin MEASUREMENT SwcOut_AEB_DebugInfo.primary_target_intv_info.motion_request_intv.crvt_request_left "" FLOAT32_IEEE autosar_swc_aeb_CM_single 0 0 -3.4E+38 3.4E+38 ECU_ADDRESS 0xfe4a49f8 /* @ECU_Address@SwcOut_AEB_DebugInfo.primary_target_intv_info.motion_request_intv.crvt_request_left@ */ /end MEASUREMENT
/begin MEASUREMENT SwcOut_AEB_DebugInfo.primary_target_intv_info.motion_request_intv.crvt_request_right "" FLOAT32_IEEE autosar_swc_aeb_CM_single 0 0 -3.4E+38 3.4E+38 ECU_ADDRESS 0xfe4a4a00 /* @ECU_Address@SwcOut_AEB_DebugInfo.primary_target_intv_info.motion_request_intv.crvt_request_right@ */ /end MEASUREMENT
/begin MEASUREMENT SwcOut_AEB_DebugInfo.primary_target_intv_info.motion_request_intv.jerk_neg_lgt_request "" FLOAT32_IEEE autosar_swc_aeb_CM_single 0 0 -3.4E+38 3.4E+38 ECU_ADDRESS 0xfe4a49f4 /* @ECU_Address@SwcOut_AEB_DebugInfo.primary_target_intv_info.motion_request_intv.jerk_neg_lgt_request@ */ /end MEASUREMENT
/begin MEASUREMENT SwcOut_AEB_DebugInfo.primary_target_intv_info.primary_target_intv.a_lat "" FLOAT32_IEEE autosar_swc_aeb_CM_single 0 0 -3.4E+38 3.4E+38 ECU_ADDRESS 0xfe4a4a24 /* @ECU_Address@SwcOut_AEB_DebugInfo.primary_target_intv_info.primary_target_intv.a_lat@ */ /end MEASUREMENT
/begin MEASUREMENT SwcOut_AEB_DebugInfo.primary_target_intv_info.primary_target_intv.a_lgt "" FLOAT32_IEEE autosar_swc_aeb_CM_single 0 0 -3.4E+38 3.4E+38 ECU_ADDRESS 0xfe4a4a20 /* @ECU_Address@SwcOut_AEB_DebugInfo.primary_target_intv_info.primary_target_intv.a_lgt@ */ /end MEASUREMENT
/begin MEASUREMENT SwcOut_AEB_DebugInfo.primary_target_intv_info.primary_target_intv.ang_dir "" FLOAT32_IEEE autosar_swc_aeb_CM_single 0 0 -3.4E+38 3.4E+38 ECU_ADDRESS 0xfe4a4a30 /* @ECU_Address@SwcOut_AEB_DebugInfo.primary_target_intv_info.primary_target_intv.ang_dir@ */ /end MEASUREMENT
/begin MEASUREMENT SwcOut_AEB_DebugInfo.primary_target_intv_info.primary_target_intv.new_ta_found "" UBYTE autosar_swc_aeb_CM_boolean 0 0 0 1 ECU_ADDRESS 0xfe4a4a0d /* @ECU_Address@SwcOut_AEB_DebugInfo.primary_target_intv_info.primary_target_intv.new_ta_found@ */ /end MEASUREMENT
/begin MEASUREMENT SwcOut_AEB_DebugInfo.primary_target_intv_info.primary_target_intv.obj_id "" SLONG autosar_swc_aeb_CM_int32 0 0 -2147483648 2147483647 ECU_ADDRESS 0xfe4a4a08 /* @ECU_Address@SwcOut_AEB_DebugInfo.primary_target_intv_info.primary_target_intv.obj_id@ */ /end MEASUREMENT
/begin MEASUREMENT SwcOut_AEB_DebugInfo.primary_target_intv_info.primary_target_intv.obj_type "" SBYTE autosar_swc_aeb_CM_int8 0 0 -128 127 ECU_ADDRESS 0xfe4a4a0c /* @ECU_Address@SwcOut_AEB_DebugInfo.primary_target_intv_info.primary_target_intv.obj_type@ */ /end MEASUREMENT
/begin MEASUREMENT SwcOut_AEB_DebugInfo.primary_target_intv_info.primary_target_intv.obs_conf "" SBYTE autosar_swc_aeb_CM_int8 0 0 -128 127 ECU_ADDRESS 0xfe4a4a2d /* @ECU_Address@SwcOut_AEB_DebugInfo.primary_target_intv_info.primary_target_intv.obs_conf@ */ /end MEASUREMENT
/begin MEASUREMENT SwcOut_AEB_DebugInfo.primary_target_intv_info.primary_target_intv.posn_lat "" FLOAT32_IEEE autosar_swc_aeb_CM_single 0 0 -3.4E+38 3.4E+38 ECU_ADDRESS 0xfe4a4a14 /* @ECU_Address@SwcOut_AEB_DebugInfo.primary_target_intv_info.primary_target_intv.posn_lat@ */ /end MEASUREMENT
/begin MEASUREMENT SwcOut_AEB_DebugInfo.primary_target_intv_info.primary_target_intv.posn_lgt "" FLOAT32_IEEE autosar_swc_aeb_CM_single 0 0 -3.4E+38 3.4E+38 ECU_ADDRESS 0xfe4a4a10 /* @ECU_Address@SwcOut_AEB_DebugInfo.primary_target_intv_info.primary_target_intv.posn_lgt@ */ /end MEASUREMENT
/begin MEASUREMENT SwcOut_AEB_DebugInfo.primary_target_intv_info.primary_target_intv.trigger_flag "" SBYTE autosar_swc_aeb_CM_int8 0 0 -128 127 ECU_ADDRESS 0xfe4a4a2c /* @ECU_Address@SwcOut_AEB_DebugInfo.primary_target_intv_info.primary_target_intv.trigger_flag@ */ /end MEASUREMENT
/begin MEASUREMENT SwcOut_AEB_DebugInfo.primary_target_intv_info.primary_target_intv.ttc_val "" FLOAT32_IEEE autosar_swc_aeb_CM_single 0 0 -3.4E+38 3.4E+38 ECU_ADDRESS 0xfe4a4a28 /* @ECU_Address@SwcOut_AEB_DebugInfo.primary_target_intv_info.primary_target_intv.ttc_val@ */ /end MEASUREMENT
/begin MEASUREMENT SwcOut_AEB_DebugInfo.primary_target_intv_info.primary_target_intv.v_lat "" FLOAT32_IEEE autosar_swc_aeb_CM_single 0 0 -3.4E+38 3.4E+38 ECU_ADDRESS 0xfe4a4a1c /* @ECU_Address@SwcOut_AEB_DebugInfo.primary_target_intv_info.primary_target_intv.v_lat@ */ /end MEASUREMENT
/begin MEASUREMENT SwcOut_AEB_DebugInfo.primary_target_intv_info.primary_target_intv.v_lgt "" FLOAT32_IEEE autosar_swc_aeb_CM_single 0 0 -3.4E+38 3.4E+38 ECU_ADDRESS 0xfe4a4a18 /* @ECU_Address@SwcOut_AEB_DebugInfo.primary_target_intv_info.primary_target_intv.v_lgt@ */ /end MEASUREMENT
/begin MEASUREMENT SwcOut_AEB_DebugInfo.primary_target_warn_info.motion_request_warn.a_lat_request "" FLOAT32_IEEE autosar_swc_aeb_CM_single 0 0 -3.4E+38 3.4E+38 ECU_ADDRESS 0xfe4a4a34 /* @ECU_Address@SwcOut_AEB_DebugInfo.primary_target_warn_info.motion_request_warn.a_lat_request@ */ /end MEASUREMENT
/begin MEASUREMENT SwcOut_AEB_DebugInfo.primary_target_warn_info.motion_request_warn.a_neg_lgt_request_forwarn "" FLOAT32_IEEE autosar_swc_aeb_CM_single 0 0 -3.4E+38 3.4E+38 ECU_ADDRESS 0xfe4a4a38 /* @ECU_Address@SwcOut_AEB_DebugInfo.primary_target_warn_info.motion_request_warn.a_neg_lgt_request_forwarn@ */ /end MEASUREMENT
/begin MEASUREMENT SwcOut_AEB_DebugInfo.primary_target_warn_info.primary_target_warn.a_lat "" FLOAT32_IEEE autosar_swc_aeb_CM_single 0 0 -3.4E+38 3.4E+38 ECU_ADDRESS 0xfe4a4a58 /* @ECU_Address@SwcOut_AEB_DebugInfo.primary_target_warn_info.primary_target_warn.a_lat@ */ /end MEASUREMENT
/begin MEASUREMENT SwcOut_AEB_DebugInfo.primary_target_warn_info.primary_target_warn.a_lgt "" FLOAT32_IEEE autosar_swc_aeb_CM_single 0 0 -3.4E+38 3.4E+38 ECU_ADDRESS 0xfe4a4a54 /* @ECU_Address@SwcOut_AEB_DebugInfo.primary_target_warn_info.primary_target_warn.a_lgt@ */ /end MEASUREMENT
/begin MEASUREMENT SwcOut_AEB_DebugInfo.primary_target_warn_info.primary_target_warn.ang_dir "" FLOAT32_IEEE autosar_swc_aeb_CM_single 0 0 -3.4E+38 3.4E+38 ECU_ADDRESS 0xfe4a4a64 /* @ECU_Address@SwcOut_AEB_DebugInfo.primary_target_warn_info.primary_target_warn.ang_dir@ */ /end MEASUREMENT
/begin MEASUREMENT SwcOut_AEB_DebugInfo.primary_target_warn_info.primary_target_warn.new_ta_found "" UBYTE autosar_swc_aeb_CM_boolean 0 0 0 1 ECU_ADDRESS 0xfe4a4a41 /* @ECU_Address@SwcOut_AEB_DebugInfo.primary_target_warn_info.primary_target_warn.new_ta_found@ */ /end MEASUREMENT
/begin MEASUREMENT SwcOut_AEB_DebugInfo.primary_target_warn_info.primary_target_warn.obj_id "" SLONG autosar_swc_aeb_CM_int32 0 0 -2147483648 2147483647 ECU_ADDRESS 0xfe4a4a3c /* @ECU_Address@SwcOut_AEB_DebugInfo.primary_target_warn_info.primary_target_warn.obj_id@ */ /end MEASUREMENT
/begin MEASUREMENT SwcOut_AEB_DebugInfo.primary_target_warn_info.primary_target_warn.obj_type "" SBYTE autosar_swc_aeb_CM_int8 0 0 -128 127 ECU_ADDRESS 0xfe4a4a40 /* @ECU_Address@SwcOut_AEB_DebugInfo.primary_target_warn_info.primary_target_warn.obj_type@ */ /end MEASUREMENT
/begin MEASUREMENT SwcOut_AEB_DebugInfo.primary_target_warn_info.primary_target_warn.obs_conf "" SBYTE autosar_swc_aeb_CM_int8 0 0 -128 127 ECU_ADDRESS 0xfe4a4a61 /* @ECU_Address@SwcOut_AEB_DebugInfo.primary_target_warn_info.primary_target_warn.obs_conf@ */ /end MEASUREMENT
/begin MEASUREMENT SwcOut_AEB_DebugInfo.primary_target_warn_info.primary_target_warn.posn_lat "" FLOAT32_IEEE autosar_swc_aeb_CM_single 0 0 -3.4E+38 3.4E+38 ECU_ADDRESS 0xfe4a4a48 /* @ECU_Address@SwcOut_AEB_DebugInfo.primary_target_warn_info.primary_target_warn.posn_lat@ */ /end MEASUREMENT
/begin MEASUREMENT SwcOut_AEB_DebugInfo.primary_target_warn_info.primary_target_warn.posn_lgt "" FLOAT32_IEEE autosar_swc_aeb_CM_single 0 0 -3.4E+38 3.4E+38 ECU_ADDRESS 0xfe4a4a44 /* @ECU_Address@SwcOut_AEB_DebugInfo.primary_target_warn_info.primary_target_warn.posn_lgt@ */ /end MEASUREMENT
/begin MEASUREMENT SwcOut_AEB_DebugInfo.primary_target_warn_info.primary_target_warn.trigger_flag "" SBYTE autosar_swc_aeb_CM_int8 0 0 -128 127 ECU_ADDRESS 0xfe4a4a60 /* @ECU_Address@SwcOut_AEB_DebugInfo.primary_target_warn_info.primary_target_warn.trigger_flag@ */ /end MEASUREMENT
/begin MEASUREMENT SwcOut_AEB_DebugInfo.primary_target_warn_info.primary_target_warn.ttc_val "" FLOAT32_IEEE autosar_swc_aeb_CM_single 0 0 -3.4E+38 3.4E+38 ECU_ADDRESS 0xfe4a4a5c /* @ECU_Address@SwcOut_AEB_DebugInfo.primary_target_warn_info.primary_target_warn.ttc_val@ */ /end MEASUREMENT
/begin MEASUREMENT SwcOut_AEB_DebugInfo.primary_target_warn_info.primary_target_warn.v_lat "" FLOAT32_IEEE autosar_swc_aeb_CM_single 0 0 -3.4E+38 3.4E+38 ECU_ADDRESS 0xfe4a4a50 /* @ECU_Address@SwcOut_AEB_DebugInfo.primary_target_warn_info.primary_target_warn.v_lat@ */ /end MEASUREMENT
/begin MEASUREMENT SwcOut_AEB_DebugInfo.primary_target_warn_info.primary_target_warn.v_lgt "" FLOAT32_IEEE autosar_swc_aeb_CM_single 0 0 -3.4E+38 3.4E+38 ECU_ADDRESS 0xfe4a4a4c /* @ECU_Address@SwcOut_AEB_DebugInfo.primary_target_warn_info.primary_target_warn.v_lgt@ */ /end MEASUREMENT
/begin MEASUREMENT SwcOut_AEB_DebugInfo.risk_condition_info.Sceniaro_Check_Result "" ULONG autosar_swc_aeb_CM_uint32 0 0 0 4294967295 ECU_ADDRESS 0xfe4a4ab8 /* @ECU_Address@SwcOut_AEB_DebugInfo.risk_condition_info.Sceniaro_Check_Result@ */ /end MEASUREMENT
/begin MEASUREMENT SwcOut_AEB_DebugInfo.risk_condition_info.Sceniaro_Flag "" ULONG autosar_swc_aeb_CM_uint32 0 0 0 4294967295 ECU_ADDRESS 0xfe4a4ab4 /* @ECU_Address@SwcOut_AEB_DebugInfo.risk_condition_info.Sceniaro_Flag@ */ /end MEASUREMENT
/begin MEASUREMENT SwcOut_AEB_DebugInfo.risk_condition_info.Sceniaro_Host_State "" ULONG autosar_swc_aeb_CM_uint32 0 0 0 4294967295 ECU_ADDRESS 0xfe4a4abc /* @ECU_Address@SwcOut_AEB_DebugInfo.risk_condition_info.Sceniaro_Host_State@ */ /end MEASUREMENT
/begin MEASUREMENT SwcOut_AEB_DebugInfo.risk_condition_info.confidence_info_flag "" ULONG autosar_swc_aeb_CM_uint32 0 0 0 4294967295 ECU_ADDRESS 0xfe4a4ab0 /* @ECU_Address@SwcOut_AEB_DebugInfo.risk_condition_info.confidence_info_flag@ */ /end MEASUREMENT
/begin MEASUREMENT SwcOut_AEB_DebugInfo.risk_condition_info.fullbrake.a_lat_quality "" UBYTE autosar_swc_aeb_CM_uint8 0 0 0 255 ECU_ADDRESS 0xfe4a4a7f /* @ECU_Address@SwcOut_AEB_DebugInfo.risk_condition_info.fullbrake.a_lat_quality@ */ /end MEASUREMENT
/begin MEASUREMENT SwcOut_AEB_DebugInfo.risk_condition_info.fullbrake.a_lat_threthold "" FLOAT32_IEEE autosar_swc_aeb_CM_single 0 0 -3.4E+38 3.4E+38 ECU_ADDRESS 0xfe4a4a70 /* @ECU_Address@SwcOut_AEB_DebugInfo.risk_condition_info.fullbrake.a_lat_threthold@ */ /end MEASUREMENT
/begin MEASUREMENT SwcOut_AEB_DebugInfo.risk_condition_info.fullbrake.a_lgt_threat "" UBYTE autosar_swc_aeb_CM_boolean 0 0 0 1 ECU_ADDRESS 0xfe4a4a7e /* @ECU_Address@SwcOut_AEB_DebugInfo.risk_condition_info.fullbrake.a_lgt_threat@ */ /end MEASUREMENT
/begin MEASUREMENT SwcOut_AEB_DebugInfo.risk_condition_info.fullbrake.a_neg_lgt_threthold "" FLOAT32_IEEE autosar_swc_aeb_CM_single 0 0 -3.4E+38 3.4E+38 ECU_ADDRESS 0xfe4a4a74 /* @ECU_Address@SwcOut_AEB_DebugInfo.risk_condition_info.fullbrake.a_neg_lgt_threthold@ */ /end MEASUREMENT
/begin MEASUREMENT SwcOut_AEB_DebugInfo.risk_condition_info.fullbrake.braking_threat "" UBYTE autosar_swc_aeb_CM_boolean 0 0 0 1 ECU_ADDRESS 0xfe4a4a7d /* @ECU_Address@SwcOut_AEB_DebugInfo.risk_condition_info.fullbrake.braking_threat@ */ /end MEASUREMENT
/begin MEASUREMENT SwcOut_AEB_DebugInfo.risk_condition_info.fullbrake.curvature_absolute_maximum "" FLOAT32_IEEE autosar_swc_aeb_CM_single 0 0 -3.4E+38 3.4E+38 ECU_ADDRESS 0xfe4a4a68 /* @ECU_Address@SwcOut_AEB_DebugInfo.risk_condition_info.fullbrake.curvature_absolute_maximum@ */ /end MEASUREMENT
/begin MEASUREMENT SwcOut_AEB_DebugInfo.risk_condition_info.fullbrake.curvature_rateabsolute_maximum "" FLOAT32_IEEE autosar_swc_aeb_CM_single 0 0 -3.4E+38 3.4E+38 ECU_ADDRESS 0xfe4a4a6c /* @ECU_Address@SwcOut_AEB_DebugInfo.risk_condition_info.fullbrake.curvature_rateabsolute_maximum@ */ /end MEASUREMENT
/begin MEASUREMENT SwcOut_AEB_DebugInfo.risk_condition_info.fullbrake.fullbrake_confirm "" UBYTE autosar_swc_aeb_CM_uint8 0 0 0 255 ECU_ADDRESS 0xfe4a4a81 /* @ECU_Address@SwcOut_AEB_DebugInfo.risk_condition_info.fullbrake.fullbrake_confirm@ */ /end MEASUREMENT
/begin MEASUREMENT SwcOut_AEB_DebugInfo.risk_condition_info.fullbrake.fullbrake_counter "" UBYTE autosar_swc_aeb_CM_uint8 0 0 0 255 ECU_ADDRESS 0xfe4a4a80 /* @ECU_Address@SwcOut_AEB_DebugInfo.risk_condition_info.fullbrake.fullbrake_counter@ */ /end MEASUREMENT
/begin MEASUREMENT SwcOut_AEB_DebugInfo.risk_condition_info.fullbrake.intv_obj_confirm "" UBYTE autosar_swc_aeb_CM_uint8 0 0 0 255 ECU_ADDRESS 0xfe4a4a88 /* @ECU_Address@SwcOut_AEB_DebugInfo.risk_condition_info.fullbrake.intv_obj_confirm@ */ /end MEASUREMENT
/begin MEASUREMENT SwcOut_AEB_DebugInfo.risk_condition_info.fullbrake.intv_obj_counter "" FLOAT32_IEEE autosar_swc_aeb_CM_single 0 0 -3.4E+38 3.4E+38 ECU_ADDRESS 0xfe4a4a84 /* @ECU_Address@SwcOut_AEB_DebugInfo.risk_condition_info.fullbrake.intv_obj_counter@ */ /end MEASUREMENT
/begin MEASUREMENT SwcOut_AEB_DebugInfo.risk_condition_info.fullbrake.jerk_longitudinal_negative_minimum "" FLOAT32_IEEE autosar_swc_aeb_CM_single 0 0 -3.4E+38 3.4E+38 ECU_ADDRESS 0xfe4a4a78 /* @ECU_Address@SwcOut_AEB_DebugInfo.risk_condition_info.fullbrake.jerk_longitudinal_negative_minimum@ */ /end MEASUREMENT
/begin MEASUREMENT SwcOut_AEB_DebugInfo.risk_condition_info.fullbrake.steering_threat "" UBYTE autosar_swc_aeb_CM_boolean 0 0 0 1 ECU_ADDRESS 0xfe4a4a7c /* @ECU_Address@SwcOut_AEB_DebugInfo.risk_condition_info.fullbrake.steering_threat@ */ /end MEASUREMENT
/begin MEASUREMENT SwcOut_AEB_DebugInfo.risk_condition_info.prebrake.a_lat_quality "" UBYTE autosar_swc_aeb_CM_uint8 0 0 0 255 ECU_ADDRESS 0xfe4a4a9f /* @ECU_Address@SwcOut_AEB_DebugInfo.risk_condition_info.prebrake.a_lat_quality@ */ /end MEASUREMENT
/begin MEASUREMENT SwcOut_AEB_DebugInfo.risk_condition_info.prebrake.a_lat_threthold "" FLOAT32_IEEE autosar_swc_aeb_CM_single 0 0 -3.4E+38 3.4E+38 ECU_ADDRESS 0xfe4a4a94 /* @ECU_Address@SwcOut_AEB_DebugInfo.risk_condition_info.prebrake.a_lat_threthold@ */ /end MEASUREMENT
/begin MEASUREMENT SwcOut_AEB_DebugInfo.risk_condition_info.prebrake.a_lgt_threat "" UBYTE autosar_swc_aeb_CM_boolean 0 0 0 1 ECU_ADDRESS 0xfe4a4a9e /* @ECU_Address@SwcOut_AEB_DebugInfo.risk_condition_info.prebrake.a_lgt_threat@ */ /end MEASUREMENT
/begin MEASUREMENT SwcOut_AEB_DebugInfo.risk_condition_info.prebrake.a_neg_lgt_threthold "" FLOAT32_IEEE autosar_swc_aeb_CM_single 0 0 -3.4E+38 3.4E+38 ECU_ADDRESS 0xfe4a4a98 /* @ECU_Address@SwcOut_AEB_DebugInfo.risk_condition_info.prebrake.a_neg_lgt_threthold@ */ /end MEASUREMENT
/begin MEASUREMENT SwcOut_AEB_DebugInfo.risk_condition_info.prebrake.braking_threat "" UBYTE autosar_swc_aeb_CM_boolean 0 0 0 1 ECU_ADDRESS 0xfe4a4a9d /* @ECU_Address@SwcOut_AEB_DebugInfo.risk_condition_info.prebrake.braking_threat@ */ /end MEASUREMENT
/begin MEASUREMENT SwcOut_AEB_DebugInfo.risk_condition_info.prebrake.curvature_absolute_comfort "" FLOAT32_IEEE autosar_swc_aeb_CM_single 0 0 -3.4E+38 3.4E+38 ECU_ADDRESS 0xfe4a4a8c /* @ECU_Address@SwcOut_AEB_DebugInfo.risk_condition_info.prebrake.curvature_absolute_comfort@ */ /end MEASUREMENT
/begin MEASUREMENT SwcOut_AEB_DebugInfo.risk_condition_info.prebrake.curvature_rate_absolute_comfort "" FLOAT32_IEEE autosar_swc_aeb_CM_single 0 0 -3.4E+38 3.4E+38 ECU_ADDRESS 0xfe4a4a90 /* @ECU_Address@SwcOut_AEB_DebugInfo.risk_condition_info.prebrake.curvature_rate_absolute_comfort@ */ /end MEASUREMENT
/begin MEASUREMENT SwcOut_AEB_DebugInfo.risk_condition_info.prebrake.intv_obj_confirm "" UBYTE autosar_swc_aeb_CM_uint8 0 0 0 255 ECU_ADDRESS 0xfe4a4aa3 /* @ECU_Address@SwcOut_AEB_DebugInfo.risk_condition_info.prebrake.intv_obj_confirm@ */ /end MEASUREMENT
/begin MEASUREMENT SwcOut_AEB_DebugInfo.risk_condition_info.prebrake.intv_obj_counter "" UBYTE autosar_swc_aeb_CM_uint8 0 0 0 255 ECU_ADDRESS 0xfe4a4aa2 /* @ECU_Address@SwcOut_AEB_DebugInfo.risk_condition_info.prebrake.intv_obj_counter@ */ /end MEASUREMENT
/begin MEASUREMENT SwcOut_AEB_DebugInfo.risk_condition_info.prebrake.prebrake_confirm "" UBYTE autosar_swc_aeb_CM_uint8 0 0 0 255 ECU_ADDRESS 0xfe4a4aa1 /* @ECU_Address@SwcOut_AEB_DebugInfo.risk_condition_info.prebrake.prebrake_confirm@ */ /end MEASUREMENT
/begin MEASUREMENT SwcOut_AEB_DebugInfo.risk_condition_info.prebrake.prebrake_counter "" UBYTE autosar_swc_aeb_CM_uint8 0 0 0 255 ECU_ADDRESS 0xfe4a4aa0 /* @ECU_Address@SwcOut_AEB_DebugInfo.risk_condition_info.prebrake.prebrake_counter@ */ /end MEASUREMENT
/begin MEASUREMENT SwcOut_AEB_DebugInfo.risk_condition_info.prebrake.steering_threat "" UBYTE autosar_swc_aeb_CM_boolean 0 0 0 1 ECU_ADDRESS 0xfe4a4a9c /* @ECU_Address@SwcOut_AEB_DebugInfo.risk_condition_info.prebrake.steering_threat@ */ /end MEASUREMENT
/begin MEASUREMENT SwcOut_AEB_DebugInfo.risk_condition_info.prewarn.brake_num "" FLOAT32_IEEE autosar_swc_aeb_CM_single 0 0 -3.4E+38 3.4E+38 ECU_ADDRESS 0xfe4a4aa4 /* @ECU_Address@SwcOut_AEB_DebugInfo.risk_condition_info.prewarn.brake_num@ */ /end MEASUREMENT
/begin MEASUREMENT SwcOut_AEB_DebugInfo.risk_condition_info.prewarn.fcw_confirm "" UBYTE autosar_swc_aeb_CM_uint8 0 0 0 255 ECU_ADDRESS 0xfe4a4aab /* @ECU_Address@SwcOut_AEB_DebugInfo.risk_condition_info.prewarn.fcw_confirm@ */ /end MEASUREMENT
/begin MEASUREMENT SwcOut_AEB_DebugInfo.risk_condition_info.prewarn.fcw_counter "" UBYTE autosar_swc_aeb_CM_uint8 0 0 0 255 ECU_ADDRESS 0xfe4a4aaa /* @ECU_Address@SwcOut_AEB_DebugInfo.risk_condition_info.prewarn.fcw_counter@ */ /end MEASUREMENT
/begin MEASUREMENT SwcOut_AEB_DebugInfo.risk_condition_info.prewarn.fcw_obj_confirm "" UBYTE autosar_swc_aeb_CM_uint8 0 0 0 255 ECU_ADDRESS 0xfe4a4aad /* @ECU_Address@SwcOut_AEB_DebugInfo.risk_condition_info.prewarn.fcw_obj_confirm@ */ /end MEASUREMENT
/begin MEASUREMENT SwcOut_AEB_DebugInfo.risk_condition_info.prewarn.fcw_obj_counter "" UBYTE autosar_swc_aeb_CM_uint8 0 0 0 255 ECU_ADDRESS 0xfe4a4aac /* @ECU_Address@SwcOut_AEB_DebugInfo.risk_condition_info.prewarn.fcw_obj_counter@ */ /end MEASUREMENT
/begin MEASUREMENT SwcOut_AEB_DebugInfo.risk_condition_info.prewarn.obj_valid "" UBYTE autosar_swc_aeb_CM_boolean 0 0 0 1 ECU_ADDRESS 0xfe4a4aa8 /* @ECU_Address@SwcOut_AEB_DebugInfo.risk_condition_info.prewarn.obj_valid@ */ /end MEASUREMENT
/begin MEASUREMENT SwcOut_AEB_DebugInfo.risk_condition_info.prewarn.steer_valid "" UBYTE autosar_swc_aeb_CM_boolean 0 0 0 1 ECU_ADDRESS 0xfe4a4aa9 /* @ECU_Address@SwcOut_AEB_DebugInfo.risk_condition_info.prewarn.steer_valid@ */ /end MEASUREMENT
/begin MEASUREMENT SwcOut_AEB_EDRType "" UBYTE autosar_swc_aeb_CM_uint8 0 0 0 255 ECU_ADDRESS 0xfe4a4d58 /* @ECU_Address@SwcOut_AEB_EDRType@ */ /end MEASUREMENT
/begin MEASUREMENT SwcOut_AEB_FuSAIN.ActSftySts "" UBYTE autosar_swc_aeb_CM_uint8 0 0 0 255 ECU_ADDRESS 0xfe4a4b32 /* @ECU_Address@SwcOut_AEB_FuSAIN.ActSftySts@ */ /end MEASUREMENT
/begin MEASUREMENT SwcOut_AEB_FuSAIN.AebReq "" UBYTE autosar_swc_aeb_CM_uint8 0 0 0 255 ECU_ADDRESS 0xfe4a4b33 /* @ECU_Address@SwcOut_AEB_FuSAIN.AebReq@ */ /end MEASUREMENT
/begin MEASUREMENT SwcOut_AEB_FuSAIN.AebTarCamID "" ULONG autosar_swc_aeb_CM_uint32 0 0 0 4294967295 ECU_ADDRESS 0xfe4a4b48 /* @ECU_Address@SwcOut_AEB_FuSAIN.AebTarCamID@ */ /end MEASUREMENT
/begin MEASUREMENT SwcOut_AEB_FuSAIN.AebTarDec "" FLOAT32_IEEE autosar_swc_aeb_CM_single 0 0 -3.4E+38 3.4E+38 ECU_ADDRESS 0xfe4a4b38 /* @ECU_Address@SwcOut_AEB_FuSAIN.AebTarDec@ */ /end MEASUREMENT
/begin MEASUREMENT SwcOut_AEB_FuSAIN.AebTarID "" ULONG autosar_swc_aeb_CM_uint32 0 0 0 4294967295 ECU_ADDRESS 0xfe4a4b44 /* @ECU_Address@SwcOut_AEB_FuSAIN.AebTarID@ */ /end MEASUREMENT
/begin MEASUREMENT SwcOut_AEB_FuSAIN.AebTarSource "" UBYTE autosar_swc_aeb_CM_uint8 0 0 0 255 ECU_ADDRESS 0xfe4a4b31 /* @ECU_Address@SwcOut_AEB_FuSAIN.AebTarSource@ */ /end MEASUREMENT
/begin MEASUREMENT SwcOut_AEB_FuSAIN.EgoCvrt "" FLOAT32_IEEE autosar_swc_aeb_CM_single 0 0 -3.4E+38 3.4E+38 ECU_ADDRESS 0xfe4a4b3c /* @ECU_Address@SwcOut_AEB_FuSAIN.EgoCvrt@ */ /end MEASUREMENT
/begin MEASUREMENT SwcOut_AEB_FuSAIN.EgoPreTraj[0].Heading "" FLOAT32_IEEE autosar_swc_aeb_CM_single 0 0 -3.4E+38 3.4E+38 ECU_ADDRESS 0xfe4a4b54 /* @ECU_Address@SwcOut_AEB_FuSAIN.EgoPreTraj[0].Heading@ */ /end MEASUREMENT
/begin MEASUREMENT SwcOut_AEB_FuSAIN.EgoPreTraj[0].PosX "" FLOAT32_IEEE autosar_swc_aeb_CM_single 0 0 -3.4E+38 3.4E+38 ECU_ADDRESS 0xfe4a4b4c /* @ECU_Address@SwcOut_AEB_FuSAIN.EgoPreTraj[0].PosX@ */ /end MEASUREMENT
/begin MEASUREMENT SwcOut_AEB_FuSAIN.EgoPreTraj[0].PosY "" FLOAT32_IEEE autosar_swc_aeb_CM_single 0 0 -3.4E+38 3.4E+38 ECU_ADDRESS 0xfe4a4b50 /* @ECU_Address@SwcOut_AEB_FuSAIN.EgoPreTraj[0].PosY@ */ /end MEASUREMENT
/begin MEASUREMENT SwcOut_AEB_FuSAIN.QM_AebRqrdAx "" FLOAT32_IEEE autosar_swc_aeb_CM_single 0 0 -3.4E+38 3.4E+38 ECU_ADDRESS 0xfe4a4b40 /* @ECU_Address@SwcOut_AEB_FuSAIN.QM_AebRqrdAx@ */ /end MEASUREMENT
/begin MEASUREMENT SwcOut_AEB_FuSAIN.QM_AebTarTTC "" FLOAT32_IEEE autosar_swc_aeb_CM_single 0 0 -3.4E+38 3.4E+38 ECU_ADDRESS 0xfe4a4b34 /* @ECU_Address@SwcOut_AEB_FuSAIN.QM_AebTarTTC@ */ /end MEASUREMENT
/begin MEASUREMENT SwcOut_AEB_FuSAIN.isMainTarExist "" UBYTE autosar_swc_aeb_CM_boolean 0 0 0 1 ECU_ADDRESS 0xfe4a4b30 /* @ECU_Address@SwcOut_AEB_FuSAIN.isMainTarExist@ */ /end MEASUREMENT
/begin MEASUREMENT SwcOut_AEB_Herbeat_Info.inner_error "" ULONG autosar_swc_aeb_CM_uint32 0 0 0 4294967295 ECU_ADDRESS 0xfe4a4cb8 /* @ECU_Address@SwcOut_AEB_Herbeat_Info.inner_error@ */ /end MEASUREMENT
/begin MEASUREMENT SwcOut_AEB_Herbeat_Info.module_status "" UBYTE autosar_swc_aeb_CM_SM_MODULE_STATUS 0 0 0 3 ECU_ADDRESS 0xfe4a4cbc /* @ECU_Address@SwcOut_AEB_Herbeat_Info.module_status@ */ /end MEASUREMENT
/begin MEASUREMENT SwcOut_AEB_Herbeat_Info.sequence_num "" UBYTE autosar_swc_aeb_CM_uint8 0 0 0 255 ECU_ADDRESS 0xfe4a4cb5 /* @ECU_Address@SwcOut_AEB_Herbeat_Info.sequence_num@ */ /end MEASUREMENT
/begin MEASUREMENT SwcOut_AEB_Herbeat_Info.swc_id "" UBYTE autosar_swc_aeb_CM_uint8 0 0 0 255 ECU_ADDRESS 0xfe4a4cb4 /* @ECU_Address@SwcOut_AEB_Herbeat_Info.swc_id@ */ /end MEASUREMENT
/begin MEASUREMENT SwcOut_AEB_RECORDER_DATA.aeb_inhibit_flag_1 "" ULONG autosar_swc_aeb_CM_uint32 0 0 0 4294967295 ECU_ADDRESS 0xfe4a4af8 /* @ECU_Address@SwcOut_AEB_RECORDER_DATA.aeb_inhibit_flag_1@ */ /end MEASUREMENT
/begin MEASUREMENT SwcOut_AEB_RECORDER_DATA.aeb_inhibit_flag_2 "" ULONG autosar_swc_aeb_CM_uint32 0 0 0 4294967295 ECU_ADDRESS 0xfe4a4afc /* @ECU_Address@SwcOut_AEB_RECORDER_DATA.aeb_inhibit_flag_2@ */ /end MEASUREMENT
/begin MEASUREMENT SwcOut_AEB_RECORDER_DATA.axv "" SWORD autosar_swc_aeb_CM_int16 0 0 -32768 32767 ECU_ADDRESS 0xfe4a4af0 /* @ECU_Address@SwcOut_AEB_RECORDER_DATA.axv@ */ /end MEASUREMENT
/begin MEASUREMENT SwcOut_AEB_RECORDER_DATA.axv_ref "" SWORD autosar_swc_aeb_CM_int16 0 0 -32768 32767 ECU_ADDRESS 0xfe4a4ae4 /* @ECU_Address@SwcOut_AEB_RECORDER_DATA.axv_ref@ */ /end MEASUREMENT
/begin MEASUREMENT SwcOut_AEB_RECORDER_DATA.ayv "" SWORD autosar_swc_aeb_CM_int16 0 0 -32768 32767 ECU_ADDRESS 0xfe4a4af2 /* @ECU_Address@SwcOut_AEB_RECORDER_DATA.ayv@ */ /end MEASUREMENT
/begin MEASUREMENT SwcOut_AEB_RECORDER_DATA.ayv_ref "" SWORD autosar_swc_aeb_CM_int16 0 0 -32768 32767 ECU_ADDRESS 0xfe4a4ae6 /* @ECU_Address@SwcOut_AEB_RECORDER_DATA.ayv_ref@ */ /end MEASUREMENT
/begin MEASUREMENT SwcOut_AEB_RECORDER_DATA.curve_rate "" SWORD autosar_swc_aeb_CM_int16 0 0 -32768 32767 ECU_ADDRESS 0xfe4a4af6 /* @ECU_Address@SwcOut_AEB_RECORDER_DATA.curve_rate@ */ /end MEASUREMENT
/begin MEASUREMENT SwcOut_AEB_RECORDER_DATA.d_width "" SWORD autosar_swc_aeb_CM_int16 0 0 -32768 32767 ECU_ADDRESS 0xfe4a4af4 /* @ECU_Address@SwcOut_AEB_RECORDER_DATA.d_width@ */ /end MEASUREMENT
/begin MEASUREMENT SwcOut_AEB_RECORDER_DATA.dxv "" SWORD autosar_swc_aeb_CM_int16 0 0 -32768 32767 ECU_ADDRESS 0xfe4a4ae8 /* @ECU_Address@SwcOut_AEB_RECORDER_DATA.dxv@ */ /end MEASUREMENT
/begin MEASUREMENT SwcOut_AEB_RECORDER_DATA.dyv "" SWORD autosar_swc_aeb_CM_int16 0 0 -32768 32767 ECU_ADDRESS 0xfe4a4aea /* @ECU_Address@SwcOut_AEB_RECORDER_DATA.dyv@ */ /end MEASUREMENT
/begin MEASUREMENT SwcOut_AEB_RECORDER_DATA.object_class "" UBYTE autosar_swc_aeb_CM_uint8 0 0 0 255 ECU_ADDRESS 0xfe4a4ae0 /* @ECU_Address@SwcOut_AEB_RECORDER_DATA.object_class@ */ /end MEASUREMENT
/begin MEASUREMENT SwcOut_AEB_RECORDER_DATA.object_status "" UBYTE autosar_swc_aeb_CM_uint8 0 0 0 255 ECU_ADDRESS 0xfe4a4ae1 /* @ECU_Address@SwcOut_AEB_RECORDER_DATA.object_status@ */ /end MEASUREMENT
/begin MEASUREMENT SwcOut_AEB_RECORDER_DATA.vxv "" SWORD autosar_swc_aeb_CM_int16 0 0 -32768 32767 ECU_ADDRESS 0xfe4a4aec /* @ECU_Address@SwcOut_AEB_RECORDER_DATA.vxv@ */ /end MEASUREMENT
/begin MEASUREMENT SwcOut_AEB_RECORDER_DATA.vxv_ref "" SWORD autosar_swc_aeb_CM_int16 0 0 -32768 32767 ECU_ADDRESS 0xfe4a4ae2 /* @ECU_Address@SwcOut_AEB_RECORDER_DATA.vxv_ref@ */ /end MEASUREMENT
/begin MEASUREMENT SwcOut_AEB_RECORDER_DATA.vyv "" SWORD autosar_swc_aeb_CM_int16 0 0 -32768 32767 ECU_ADDRESS 0xfe4a4aee /* @ECU_Address@SwcOut_AEB_RECORDER_DATA.vyv@ */ /end MEASUREMENT
/begin MEASUREMENT SwcOut_AEB_TAROBJ.ALatRqrd "" FLOAT32_IEEE autosar_swc_aeb_CM_single 0 0 -3.4E+38 3.4E+38 ECU_ADDRESS 0xfe4a4d0c /* @ECU_Address@SwcOut_AEB_TAROBJ.ALatRqrd@ */ /end MEASUREMENT
/begin MEASUREMENT SwcOut_AEB_TAROBJ.ANegLgtRqrd "" FLOAT32_IEEE autosar_swc_aeb_CM_single 0 0 -3.4E+38 3.4E+38 ECU_ADDRESS 0xfe4a4cfc /* @ECU_Address@SwcOut_AEB_TAROBJ.ANegLgtRqrd@ */ /end MEASUREMENT
/begin MEASUREMENT SwcOut_AEB_TAROBJ.ANegLgtRqrdForPrimTarWarn "" FLOAT32_IEEE autosar_swc_aeb_CM_single 0 0 -3.4E+38 3.4E+38 ECU_ADDRESS 0xfe4a4d00 /* @ECU_Address@SwcOut_AEB_TAROBJ.ANegLgtRqrdForPrimTarWarn@ */ /end MEASUREMENT
/begin MEASUREMENT SwcOut_AEB_TAROBJ.BrakeThreat "" FLOAT32_IEEE autosar_swc_aeb_CM_single 0 0 -3.4E+38 3.4E+38 ECU_ADDRESS 0xfe4a4d30 /* @ECU_Address@SwcOut_AEB_TAROBJ.BrakeThreat@ */ /end MEASUREMENT
/begin MEASUREMENT SwcOut_AEB_TAROBJ.CrvtRqrdLe "" FLOAT32_IEEE autosar_swc_aeb_CM_single 0 0 -3.4E+38 3.4E+38 ECU_ADDRESS 0xfe4a4d04 /* @ECU_Address@SwcOut_AEB_TAROBJ.CrvtRqrdLe@ */ /end MEASUREMENT
/begin MEASUREMENT SwcOut_AEB_TAROBJ.CrvtRqrdRi "" FLOAT32_IEEE autosar_swc_aeb_CM_single 0 0 -3.4E+38 3.4E+38 ECU_ADDRESS 0xfe4a4d08 /* @ECU_Address@SwcOut_AEB_TAROBJ.CrvtRqrdRi@ */ /end MEASUREMENT
/begin MEASUREMENT SwcOut_AEB_TAROBJ.Ego_axvRefMs2 "" FLOAT32_IEEE autosar_swc_aeb_CM_single 0 0 -3.4E+38 3.4E+38 ECU_ADDRESS 0xfe4a4d14 /* @ECU_Address@SwcOut_AEB_TAROBJ.Ego_axvRefMs2@ */ /end MEASUREMENT
/begin MEASUREMENT SwcOut_AEB_TAROBJ.Ego_ayvRefMs2 "" FLOAT32_IEEE autosar_swc_aeb_CM_single 0 0 -3.4E+38 3.4E+38 ECU_ADDRESS 0xfe4a4d1c /* @ECU_Address@SwcOut_AEB_TAROBJ.Ego_ayvRefMs2@ */ /end MEASUREMENT
/begin MEASUREMENT SwcOut_AEB_TAROBJ.Ego_kapTraj "" FLOAT32_IEEE autosar_swc_aeb_CM_single 0 0 -3.4E+38 3.4E+38 ECU_ADDRESS 0xfe4a4d18 /* @ECU_Address@SwcOut_AEB_TAROBJ.Ego_kapTraj@ */ /end MEASUREMENT
/begin MEASUREMENT SwcOut_AEB_TAROBJ.Ego_psiDtOpt "" FLOAT32_IEEE autosar_swc_aeb_CM_single 0 0 -3.4E+38 3.4E+38 ECU_ADDRESS 0xfe4a4d20 /* @ECU_Address@SwcOut_AEB_TAROBJ.Ego_psiDtOpt@ */ /end MEASUREMENT
/begin MEASUREMENT SwcOut_AEB_TAROBJ.Ego_vxvRefMs "" FLOAT32_IEEE autosar_swc_aeb_CM_single 0 0 -3.4E+38 3.4E+38 ECU_ADDRESS 0xfe4a4d10 /* @ECU_Address@SwcOut_AEB_TAROBJ.Ego_vxvRefMs@ */ /end MEASUREMENT
/begin MEASUREMENT SwcOut_AEB_TAROBJ.FCW_ANegLgtRqrdForWarn "" FLOAT32_IEEE autosar_swc_aeb_CM_single 0 0 -3.4E+38 3.4E+38 ECU_ADDRESS 0xfe4a4d28 /* @ECU_Address@SwcOut_AEB_TAROBJ.FCW_ANegLgtRqrdForWarn@ */ /end MEASUREMENT
/begin MEASUREMENT SwcOut_AEB_TAROBJ.FCW_startConditionMet "" FLOAT32_IEEE autosar_swc_aeb_CM_single 0 0 -3.4E+38 3.4E+38 ECU_ADDRESS 0xfe4a4d2c /* @ECU_Address@SwcOut_AEB_TAROBJ.FCW_startConditionMet@ */ /end MEASUREMENT
/begin MEASUREMENT SwcOut_AEB_TAROBJ.FusionType "" UBYTE autosar_swc_aeb_CM_uint8 0 0 0 255 ECU_ADDRESS 0xfe4a4cc2 /* @ECU_Address@SwcOut_AEB_TAROBJ.FusionType@ */ /end MEASUREMENT
/begin MEASUREMENT SwcOut_AEB_TAROBJ.Host_State "" FLOAT32_IEEE autosar_swc_aeb_CM_single 0 0 -3.4E+38 3.4E+38 ECU_ADDRESS 0xfe4a4d3c /* @ECU_Address@SwcOut_AEB_TAROBJ.Host_State@ */ /end MEASUREMENT
/begin MEASUREMENT SwcOut_AEB_TAROBJ.InPathPredict "" UBYTE autosar_swc_aeb_CM_boolean 0 0 0 1 ECU_ADDRESS 0xfe4a4cc1 /* @ECU_Address@SwcOut_AEB_TAROBJ.InPathPredict@ */ /end MEASUREMENT
/begin MEASUREMENT SwcOut_AEB_TAROBJ.ObjectHeadingAngle "" FLOAT32_IEEE autosar_swc_aeb_CM_single 0 0 -3.4E+38 3.4E+38 ECU_ADDRESS 0xfe4a4cd0 /* @ECU_Address@SwcOut_AEB_TAROBJ.ObjectHeadingAngle@ */ /end MEASUREMENT
/begin MEASUREMENT SwcOut_AEB_TAROBJ.ObjectID "" ULONG autosar_swc_aeb_CM_uint32 0 0 0 4294967295 ECU_ADDRESS 0xfe4a4d44 /* @ECU_Address@SwcOut_AEB_TAROBJ.ObjectID@ */ /end MEASUREMENT
/begin MEASUREMENT SwcOut_AEB_TAROBJ.ObjectIndex "" UBYTE autosar_swc_aeb_CM_uint8 0 0 0 255 ECU_ADDRESS 0xfe4a4cc3 /* @ECU_Address@SwcOut_AEB_TAROBJ.ObjectIndex@ */ /end MEASUREMENT
/begin MEASUREMENT SwcOut_AEB_TAROBJ.ObjectLength "" FLOAT32_IEEE autosar_swc_aeb_CM_single 0 0 -3.4E+38 3.4E+38 ECU_ADDRESS 0xfe4a4cc8 /* @ECU_Address@SwcOut_AEB_TAROBJ.ObjectLength@ */ /end MEASUREMENT
/begin MEASUREMENT SwcOut_AEB_TAROBJ.ObjectMovingOrientation "" UBYTE autosar_swc_aeb_CM_uint8 0 0 0 255 ECU_ADDRESS 0xfe4a4cc6 /* @ECU_Address@SwcOut_AEB_TAROBJ.ObjectMovingOrientation@ */ /end MEASUREMENT
/begin MEASUREMENT SwcOut_AEB_TAROBJ.ObjectMovingState "" UBYTE autosar_swc_aeb_CM_uint8 0 0 0 255 ECU_ADDRESS 0xfe4a4cc5 /* @ECU_Address@SwcOut_AEB_TAROBJ.ObjectMovingState@ */ /end MEASUREMENT
/begin MEASUREMENT SwcOut_AEB_TAROBJ.ObjectType "" UBYTE autosar_swc_aeb_CM_uint8 0 0 0 255 ECU_ADDRESS 0xfe4a4cc4 /* @ECU_Address@SwcOut_AEB_TAROBJ.ObjectType@ */ /end MEASUREMENT
/begin MEASUREMENT SwcOut_AEB_TAROBJ.ObjectWidth "" FLOAT32_IEEE autosar_swc_aeb_CM_single 0 0 -3.4E+38 3.4E+38 ECU_ADDRESS 0xfe4a4ccc /* @ECU_Address@SwcOut_AEB_TAROBJ.ObjectWidth@ */ /end MEASUREMENT
/begin MEASUREMENT SwcOut_AEB_TAROBJ.Object_Abs_AX "" FLOAT32_IEEE autosar_swc_aeb_CM_single 0 0 -3.4E+38 3.4E+38 ECU_ADDRESS 0xfe4a4cf0 /* @ECU_Address@SwcOut_AEB_TAROBJ.Object_Abs_AX@ */ /end MEASUREMENT
/begin MEASUREMENT SwcOut_AEB_TAROBJ.Object_Abs_AY "" FLOAT32_IEEE autosar_swc_aeb_CM_single 0 0 -3.4E+38 3.4E+38 ECU_ADDRESS 0xfe4a4cf4 /* @ECU_Address@SwcOut_AEB_TAROBJ.Object_Abs_AY@ */ /end MEASUREMENT
/begin MEASUREMENT SwcOut_AEB_TAROBJ.Object_Abs_SPEED "" FLOAT32_IEEE autosar_swc_aeb_CM_single 0 0 -3.4E+38 3.4E+38 ECU_ADDRESS 0xfe4a4ce4 /* @ECU_Address@SwcOut_AEB_TAROBJ.Object_Abs_SPEED@ */ /end MEASUREMENT
/begin MEASUREMENT SwcOut_AEB_TAROBJ.Object_Abs_VX "" FLOAT32_IEEE autosar_swc_aeb_CM_single 0 0 -3.4E+38 3.4E+38 ECU_ADDRESS 0xfe4a4ce8 /* @ECU_Address@SwcOut_AEB_TAROBJ.Object_Abs_VX@ */ /end MEASUREMENT
/begin MEASUREMENT SwcOut_AEB_TAROBJ.Object_Abs_VY "" FLOAT32_IEEE autosar_swc_aeb_CM_single 0 0 -3.4E+38 3.4E+38 ECU_ADDRESS 0xfe4a4cec /* @ECU_Address@SwcOut_AEB_TAROBJ.Object_Abs_VY@ */ /end MEASUREMENT
/begin MEASUREMENT SwcOut_AEB_TAROBJ.Object_DX "" FLOAT32_IEEE autosar_swc_aeb_CM_single 0 0 -3.4E+38 3.4E+38 ECU_ADDRESS 0xfe4a4cd4 /* @ECU_Address@SwcOut_AEB_TAROBJ.Object_DX@ */ /end MEASUREMENT
/begin MEASUREMENT SwcOut_AEB_TAROBJ.Object_DY "" FLOAT32_IEEE autosar_swc_aeb_CM_single 0 0 -3.4E+38 3.4E+38 ECU_ADDRESS 0xfe4a4cd8 /* @ECU_Address@SwcOut_AEB_TAROBJ.Object_DY@ */ /end MEASUREMENT
/begin MEASUREMENT SwcOut_AEB_TAROBJ.Object_RangeX "" FLOAT32_IEEE autosar_swc_aeb_CM_single 0 0 -3.4E+38 3.4E+38 ECU_ADDRESS 0xfe4a4cdc /* @ECU_Address@SwcOut_AEB_TAROBJ.Object_RangeX@ */ /end MEASUREMENT
/begin MEASUREMENT SwcOut_AEB_TAROBJ.Object_RangeY "" FLOAT32_IEEE autosar_swc_aeb_CM_single 0 0 -3.4E+38 3.4E+38 ECU_ADDRESS 0xfe4a4ce0 /* @ECU_Address@SwcOut_AEB_TAROBJ.Object_RangeY@ */ /end MEASUREMENT
/begin MEASUREMENT SwcOut_AEB_TAROBJ.PrimTarInPahNow "" UBYTE autosar_swc_aeb_CM_boolean 0 0 0 1 ECU_ADDRESS 0xfe4a4cc0 /* @ECU_Address@SwcOut_AEB_TAROBJ.PrimTarInPahNow@ */ /end MEASUREMENT
/begin MEASUREMENT SwcOut_AEB_TAROBJ.Sceniaro_Flag "" FLOAT32_IEEE autosar_swc_aeb_CM_single 0 0 -3.4E+38 3.4E+38 ECU_ADDRESS 0xfe4a4d40 /* @ECU_Address@SwcOut_AEB_TAROBJ.Sceniaro_Flag@ */ /end MEASUREMENT
/begin MEASUREMENT SwcOut_AEB_TAROBJ.Sceniaro_OK "" FLOAT32_IEEE autosar_swc_aeb_CM_single 0 0 -3.4E+38 3.4E+38 ECU_ADDRESS 0xfe4a4d38 /* @ECU_Address@SwcOut_AEB_TAROBJ.Sceniaro_OK@ */ /end MEASUREMENT
/begin MEASUREMENT SwcOut_AEB_TAROBJ.SteerThreat "" FLOAT32_IEEE autosar_swc_aeb_CM_single 0 0 -3.4E+38 3.4E+38 ECU_ADDRESS 0xfe4a4d34 /* @ECU_Address@SwcOut_AEB_TAROBJ.SteerThreat@ */ /end MEASUREMENT
/begin MEASUREMENT SwcOut_AEB_TAROBJ.TTC "" FLOAT32_IEEE autosar_swc_aeb_CM_single 0 0 -3.4E+38 3.4E+38 ECU_ADDRESS 0xfe4a4d24 /* @ECU_Address@SwcOut_AEB_TAROBJ.TTC@ */ /end MEASUREMENT
/begin MEASUREMENT SwcOut_AEB_TAROBJ.TiToCllsn "" FLOAT32_IEEE autosar_swc_aeb_CM_single 0 0 -3.4E+38 3.4E+38 ECU_ADDRESS 0xfe4a4cf8 /* @ECU_Address@SwcOut_AEB_TAROBJ.TiToCllsn@ */ /end MEASUREMENT
/begin MEASUREMENT SwcOut_AEB_TAROBJ.camID "" ULONG autosar_swc_aeb_CM_uint32 0 0 0 4294967295 ECU_ADDRESS 0xfe4a4d48 /* @ECU_Address@SwcOut_AEB_TAROBJ.camID@ */ /end MEASUREMENT
/begin MEASUREMENT autosar_swc_aeb_rtARID_DEF.ARID_DEF_MATLABFunction31.Active_Sts "" UBYTE autosar_swc_aeb_CM_uint8 0 0 0 255 ECU_ADDRESS 0xfe4a4db8 /* @ECU_Address@autosar_swc_aeb_rtARID_DEF.ARID_DEF_MATLABFunction31.Active_Sts@ */ /end MEASUREMENT
/begin MEASUREMENT autosar_swc_aeb_rtARID_DEF.ARID_DEF_MATLABFunction31.Active_Time "" FLOAT32_IEEE autosar_swc_aeb_CM_single 0 0 -3.4E+38 3.4E+38 ECU_ADDRESS 0xfe4a4db4 /* @ECU_Address@autosar_swc_aeb_rtARID_DEF.ARID_DEF_MATLABFunction31.Active_Time@ */ /end MEASUREMENT
/begin MEASUREMENT autosar_swc_aeb_rtARID_DEF.AWBLevel "" UBYTE autosar_swc_aeb_CM_uint8 0 0 0 255 MATRIX_DIM 1 1 ECU_ADDRESS 0xfe4aba5d /* @ECU_Address@autosar_swc_aeb_rtARID_DEF.AWBLevel@ */ /end MEASUREMENT
/begin MEASUREMENT autosar_swc_aeb_rtARID_DEF.AWBRequest "" UBYTE autosar_swc_aeb_CM_uint8 0 0 0 255 MATRIX_DIM 1 1 ECU_ADDRESS 0xfe4aba5c /* @ECU_Address@autosar_swc_aeb_rtARID_DEF.AWBRequest@ */ /end MEASUREMENT
/begin MEASUREMENT autosar_swc_aeb_rtARID_DEF.Active "" UBYTE autosar_swc_aeb_CM_logical 0 0 0 1 ECU_ADDRESS 0xfe4abac1 /* @ECU_Address@autosar_swc_aeb_rtARID_DEF.Active@ */ /end MEASUREMENT
/begin MEASUREMENT autosar_swc_aeb_rtARID_DEF.Active_Sts "" UBYTE autosar_swc_aeb_CM_uint8 0 0 0 255 ECU_ADDRESS 0xfe4aba91 /* @ECU_Address@autosar_swc_aeb_rtARID_DEF.Active_Sts@ */ /end MEASUREMENT
/begin MEASUREMENT autosar_swc_aeb_rtARID_DEF.Active_Sts_d "" UBYTE autosar_swc_aeb_CM_uint8 0 0 0 255 ECU_ADDRESS 0xfe4abaa7 /* @ECU_Address@autosar_swc_aeb_rtARID_DEF.Active_Sts_d@ */ /end MEASUREMENT
/begin MEASUREMENT autosar_swc_aeb_rtARID_DEF.Active_Time "" FLOAT32_IEEE autosar_swc_aeb_CM_single 0 0 -3.4E+38 3.4E+38 ECU_ADDRESS 0xfe4ab974 /* @ECU_Address@autosar_swc_aeb_rtARID_DEF.Active_Time@ */ /end MEASUREMENT
/begin MEASUREMENT autosar_swc_aeb_rtARID_DEF.Active_Time_g "" FLOAT32_IEEE autosar_swc_aeb_CM_single 0 0 -3.4E+38 3.4E+38 ECU_ADDRESS 0xfe4ab984 /* @ECU_Address@autosar_swc_aeb_rtARID_DEF.Active_Time_g@ */ /end MEASUREMENT
/begin MEASUREMENT autosar_swc_aeb_rtARID_DEF.Assignment4 "" FLOAT32_IEEE autosar_swc_aeb_CM_single 0 0 -3.4E+38 3.4E+38 LAYOUT COLUMN_DIR MATRIX_DIM 20 ECU_ADDRESS 0xfe4aa5a0 /* @ECU_Address@autosar_swc_aeb_rtARID_DEF.Assignment4@ */ /end MEASUREMENT
/begin MEASUREMENT autosar_swc_aeb_rtARID_DEF.Confirm_St "" UBYTE autosar_swc_aeb_CM_uint8 0 0 0 255 ECU_ADDRESS 0xfe4aba9a /* @ECU_Address@autosar_swc_aeb_rtARID_DEF.Confirm_St@ */ /end MEASUREMENT
/begin MEASUREMENT autosar_swc_aeb_rtARID_DEF.CoolOK "" UBYTE autosar_swc_aeb_CM_logical 0 0 0 1 ECU_ADDRESS 0xfe4abac8 /* @ECU_Address@autosar_swc_aeb_rtARID_DEF.CoolOK@ */ /end MEASUREMENT
/begin MEASUREMENT autosar_swc_aeb_rtARID_DEF.CoolOK_j "" UBYTE autosar_swc_aeb_CM_logical 0 0 0 1 ECU_ADDRESS 0xfe4abac9 /* @ECU_Address@autosar_swc_aeb_rtARID_DEF.CoolOK_j@ */ /end MEASUREMENT
/begin MEASUREMENT autosar_swc_aeb_rtARID_DEF.CoolOK_k "" UBYTE autosar_swc_aeb_CM_logical 0 0 0 1 MATRIX_DIM 1 1 ECU_ADDRESS 0xfe4abaca /* @ECU_Address@autosar_swc_aeb_rtARID_DEF.CoolOK_k@ */ /end MEASUREMENT
/begin MEASUREMENT autosar_swc_aeb_rtARID_DEF.DWRequest "" UBYTE autosar_swc_aeb_CM_uint8 0 0 0 255 MATRIX_DIM 1 1 ECU_ADDRESS 0xfe4aba59 /* @ECU_Address@autosar_swc_aeb_rtARID_DEF.DWRequest@ */ /end MEASUREMENT
/begin MEASUREMENT autosar_swc_aeb_rtARID_DEF.DuringTime "" FLOAT32_IEEE autosar_swc_aeb_CM_single 0 0 -3.4E+38 3.4E+38 ECU_ADDRESS 0xfe4ab970 /* @ECU_Address@autosar_swc_aeb_rtARID_DEF.DuringTime@ */ /end MEASUREMENT
/begin MEASUREMENT autosar_swc_aeb_rtARID_DEF.Duringtime "" FLOAT32_IEEE autosar_swc_aeb_CM_single 0 0 -3.4E+38 3.4E+38 ECU_ADDRESS 0xfe4ab97c /* @ECU_Address@autosar_swc_aeb_rtARID_DEF.Duringtime@ */ /end MEASUREMENT
/begin MEASUREMENT autosar_swc_aeb_rtARID_DEF.Duringtime_f "" FLOAT32_IEEE autosar_swc_aeb_CM_single 0 0 -3.4E+38 3.4E+38 ECU_ADDRESS 0xfe4ab980 /* @ECU_Address@autosar_swc_aeb_rtARID_DEF.Duringtime_f@ */ /end MEASUREMENT
/begin MEASUREMENT autosar_swc_aeb_rtARID_DEF.ObjInitCrvtPosnLat "" FLOAT32_IEEE autosar_swc_aeb_CM_single 0 0 -3.4E+38 3.4E+38 LAYOUT COLUMN_DIR MATRIX_DIM 20 ECU_ADDRESS 0xfe4aa400 /* @ECU_Address@autosar_swc_aeb_rtARID_DEF.ObjInitCrvtPosnLat@ */ /end MEASUREMENT
/begin MEASUREMENT autosar_swc_aeb_rtARID_DEF.Output_DSTATE "" UBYTE autosar_swc_aeb_CM_uint8 0 0 0 255 ECU_ADDRESS 0xfe4aba5e /* @ECU_Address@autosar_swc_aeb_rtARID_DEF.Output_DSTATE@ */ /end MEASUREMENT
/begin MEASUREMENT autosar_swc_aeb_rtARID_DEF.Output_DSTATE_n "" UBYTE autosar_swc_aeb_CM_uint8 0 0 0 255 ECU_ADDRESS 0xfe4aba67 /* @ECU_Address@autosar_swc_aeb_rtARID_DEF.Output_DSTATE_n@ */ /end MEASUREMENT
/begin MEASUREMENT autosar_swc_aeb_rtARID_DEF.Quotient "" FLOAT32_IEEE autosar_swc_aeb_CM_single 0 0 -3.4E+38 3.4E+38 ECU_ADDRESS 0xfe4ab648 /* @ECU_Address@autosar_swc_aeb_rtARID_DEF.Quotient@ */ /end MEASUREMENT
/begin MEASUREMENT autosar_swc_aeb_rtARID_DEF.Spd "" UWORD autosar_swc_aeb_CM_uint16 0 0 0 65535 ECU_ADDRESS 0xfe4aba14 /* @ECU_Address@autosar_swc_aeb_rtARID_DEF.Spd@ */ /end MEASUREMENT
/begin MEASUREMENT autosar_swc_aeb_rtARID_DEF.TextinfoWarn "" UBYTE autosar_swc_aeb_CM_uint8 0 0 0 255 MATRIX_DIM 1 1 ECU_ADDRESS 0xfe4aba5b /* @ECU_Address@autosar_swc_aeb_rtARID_DEF.TextinfoWarn@ */ /end MEASUREMENT
/begin MEASUREMENT autosar_swc_aeb_rtARID_DEF.Textinfo_Out "" UBYTE autosar_swc_aeb_CM_uint8 0 0 0 255 MATRIX_DIM 1 1 ECU_ADDRESS 0xfe4aba5a /* @ECU_Address@autosar_swc_aeb_rtARID_DEF.Textinfo_Out@ */ /end MEASUREMENT
/begin MEASUREMENT autosar_swc_aeb_rtARID_DEF.Time_j "" FLOAT32_IEEE autosar_swc_aeb_CM_single 0 0 -3.4E+38 3.4E+38 ECU_ADDRESS 0xfe4ab978 /* @ECU_Address@autosar_swc_aeb_rtARID_DEF.Time_j@ */ /end MEASUREMENT
/begin MEASUREMENT autosar_swc_aeb_rtARID_DEF.Time_o "" FLOAT32_IEEE autosar_swc_aeb_CM_single 0 0 -3.4E+38 3.4E+38 ECU_ADDRESS 0xfe4ab988 /* @ECU_Address@autosar_swc_aeb_rtARID_DEF.Time_o@ */ /end MEASUREMENT
/begin MEASUREMENT autosar_swc_aeb_rtARID_DEF.Time_p "" FLOAT32_IEEE autosar_swc_aeb_CM_single 0 0 -3.4E+38 3.4E+38 ECU_ADDRESS 0xfe4ab98c /* @ECU_Address@autosar_swc_aeb_rtARID_DEF.Time_p@ */ /end MEASUREMENT
/begin MEASUREMENT autosar_swc_aeb_rtARID_DEF.UnitDelay1_DSTATE "" FLOAT32_IEEE autosar_swc_aeb_CM_single 0 0 -3.4E+38 3.4E+38 ECU_ADDRESS 0xfe4ab7e8 /* @ECU_Address@autosar_swc_aeb_rtARID_DEF.UnitDelay1_DSTATE@ */ /end MEASUREMENT
/begin MEASUREMENT autosar_swc_aeb_rtARID_DEF.UnitDelay1_DSTATE_aa "" UBYTE autosar_swc_aeb_CM_uint8 0 0 0 255 ECU_ADDRESS 0xfe4aba60 /* @ECU_Address@autosar_swc_aeb_rtARID_DEF.UnitDelay1_DSTATE_aa@ */ /end MEASUREMENT
/begin MEASUREMENT autosar_swc_aeb_rtARID_DEF.UnitDelay1_DSTATE_c "" FLOAT32_IEEE autosar_swc_aeb_CM_single 0 0 -3.4E+38 3.4E+38 ECU_ADDRESS 0xfe4ab810 /* @ECU_Address@autosar_swc_aeb_rtARID_DEF.UnitDelay1_DSTATE_c@ */ /end MEASUREMENT
/begin MEASUREMENT autosar_swc_aeb_rtARID_DEF.UnitDelay1_DSTATE_k "" FLOAT32_IEEE autosar_swc_aeb_CM_single 0 0 -3.4E+38 3.4E+38 ECU_ADDRESS 0xfe4ab864 /* @ECU_Address@autosar_swc_aeb_rtARID_DEF.UnitDelay1_DSTATE_k@ */ /end MEASUREMENT
/begin MEASUREMENT autosar_swc_aeb_rtARID_DEF.UnitDelay2_DSTATE_f "" UBYTE autosar_swc_aeb_CM_uint8 0 0 0 255 ECU_ADDRESS 0xfe4aba61 /* @ECU_Address@autosar_swc_aeb_rtARID_DEF.UnitDelay2_DSTATE_f@ */ /end MEASUREMENT
/begin MEASUREMENT autosar_swc_aeb_rtARID_DEF.UnitDelay2_DSTATE_i "" FLOAT32_IEEE autosar_swc_aeb_CM_single 0 0 -3.4E+38 3.4E+38 ECU_ADDRESS 0xfe4ab868 /* @ECU_Address@autosar_swc_aeb_rtARID_DEF.UnitDelay2_DSTATE_i@ */ /end MEASUREMENT
/begin MEASUREMENT autosar_swc_aeb_rtARID_DEF.UnitDelay2_DSTATE_o "" FLOAT32_IEEE autosar_swc_aeb_CM_single 0 0 -3.4E+38 3.4E+38 ECU_ADDRESS 0xfe4ab858 /* @ECU_Address@autosar_swc_aeb_rtARID_DEF.UnitDelay2_DSTATE_o@ */ /end MEASUREMENT
/begin MEASUREMENT autosar_swc_aeb_rtARID_DEF.UnitDelay3_DSTATE_b "" UBYTE autosar_swc_aeb_CM_uint8 0 0 0 255 ECU_ADDRESS 0xfe4aba65 /* @ECU_Address@autosar_swc_aeb_rtARID_DEF.UnitDelay3_DSTATE_b@ */ /end MEASUREMENT
/begin MEASUREMENT autosar_swc_aeb_rtARID_DEF.UnitDelay4_DSTATE_k "" UBYTE autosar_swc_aeb_CM_uint8 0 0 0 255 ECU_ADDRESS 0xfe4aba62 /* @ECU_Address@autosar_swc_aeb_rtARID_DEF.UnitDelay4_DSTATE_k@ */ /end MEASUREMENT
/begin MEASUREMENT autosar_swc_aeb_rtARID_DEF.UnitDelay5_DSTATE_b "" UBYTE autosar_swc_aeb_CM_uint8 0 0 0 255 ECU_ADDRESS 0xfe4aba63 /* @ECU_Address@autosar_swc_aeb_rtARID_DEF.UnitDelay5_DSTATE_b@ */ /end MEASUREMENT
/begin MEASUREMENT autosar_swc_aeb_rtARID_DEF.UnitDelay6_DSTATE_e "" UBYTE autosar_swc_aeb_CM_uint8 0 0 0 255 ECU_ADDRESS 0xfe4aba64 /* @ECU_Address@autosar_swc_aeb_rtARID_DEF.UnitDelay6_DSTATE_e@ */ /end MEASUREMENT
/begin MEASUREMENT autosar_swc_aeb_rtARID_DEF.UnitDelay_DSTATE_e1 "" FLOAT32_IEEE autosar_swc_aeb_CM_single 0 0 -3.4E+38 3.4E+38 ECU_ADDRESS 0xfe4ab860 /* @ECU_Address@autosar_swc_aeb_rtARID_DEF.UnitDelay_DSTATE_e1@ */ /end MEASUREMENT
/begin MEASUREMENT autosar_swc_aeb_rtARID_DEF.UnitDelay_DSTATE_g "" UBYTE autosar_swc_aeb_CM_uint8 0 0 0 255 ECU_ADDRESS 0xfe4aba5f /* @ECU_Address@autosar_swc_aeb_rtARID_DEF.UnitDelay_DSTATE_g@ */ /end MEASUREMENT
/begin MEASUREMENT autosar_swc_aeb_rtARID_DEF.UnitDelay_DSTATE_jj "" FLOAT32_IEEE autosar_swc_aeb_CM_single 0 0 -3.4E+38 3.4E+38 ECU_ADDRESS 0xfe4ab85c /* @ECU_Address@autosar_swc_aeb_rtARID_DEF.UnitDelay_DSTATE_jj@ */ /end MEASUREMENT
/begin MEASUREMENT autosar_swc_aeb_rtARID_DEF.UnitDelay_DSTATE_ox "" SLONG autosar_swc_aeb_CM_AsySftyDecelReqDendBySpdRedn0 0 0 0 1 ECU_ADDRESS 0xfe4ab9f8 /* @ECU_Address@autosar_swc_aeb_rtARID_DEF.UnitDelay_DSTATE_ox@ */ /end MEASUREMENT
/begin MEASUREMENT autosar_swc_aeb_rtARID_DEF.is_AWB_Active_ActiveTIme "" UBYTE autosar_swc_aeb_CM_uint8 0 0 0 255 ECU_ADDRESS 0xfe4abaa2 /* @ECU_Address@autosar_swc_aeb_rtARID_DEF.is_AWB_Active_ActiveTIme@ */ /end MEASUREMENT
/begin MEASUREMENT autosar_swc_aeb_rtARID_DEF.is_Confirm "" UBYTE autosar_swc_aeb_CM_uint8 0 0 0 255 ECU_ADDRESS 0xfe4aba9d /* @ECU_Address@autosar_swc_aeb_rtARID_DEF.is_Confirm@ */ /end MEASUREMENT
/begin MEASUREMENT autosar_swc_aeb_rtARID_DEF.is_SubModule "" UBYTE autosar_swc_aeb_CM_uint8 0 0 0 255 ECU_ADDRESS 0xfe4aba94 /* @ECU_Address@autosar_swc_aeb_rtARID_DEF.is_SubModule@ */ /end MEASUREMENT
/begin MEASUREMENT autosar_swc_aeb_rtARID_DEF.is_SubModule2 "" UBYTE autosar_swc_aeb_CM_uint8 0 0 0 255 ECU_ADDRESS 0xfe4aba95 /* @ECU_Address@autosar_swc_aeb_rtARID_DEF.is_SubModule2@ */ /end MEASUREMENT
/begin MEASUREMENT autosar_swc_aeb_rtARID_DEF.is_SubModule2_o "" UBYTE autosar_swc_aeb_CM_uint8 0 0 0 255 ECU_ADDRESS 0xfe4abaa6 /* @ECU_Address@autosar_swc_aeb_rtARID_DEF.is_SubModule2_o@ */ /end MEASUREMENT
/begin MEASUREMENT autosar_swc_aeb_rtARID_DEF.is_SubModule_p "" UBYTE autosar_swc_aeb_CM_uint8 0 0 0 255 ECU_ADDRESS 0xfe4abaa5 /* @ECU_Address@autosar_swc_aeb_rtARID_DEF.is_SubModule_p@ */ /end MEASUREMENT
/begin MEASUREMENT autosar_swc_aeb_rtARID_DEF.is_active_c12_autosar_swc_aeb "" UBYTE autosar_swc_aeb_CM_uint8 0 0 0 255 ECU_ADDRESS 0xfe4aba9b /* @ECU_Address@autosar_swc_aeb_rtARID_DEF.is_active_c12_autosar_swc_aeb@ */ /end MEASUREMENT
/begin MEASUREMENT autosar_swc_aeb_rtARID_DEF.is_active_c15_autosar_swc_aeb "" UBYTE autosar_swc_aeb_CM_uint8 0 0 0 255 ECU_ADDRESS 0xfe4aba96 /* @ECU_Address@autosar_swc_aeb_rtARID_DEF.is_active_c15_autosar_swc_aeb@ */ /end MEASUREMENT
/begin MEASUREMENT autosar_swc_aeb_rtARID_DEF.is_active_c19_autosar_swc_aeb "" UBYTE autosar_swc_aeb_CM_uint8 0 0 0 255 ECU_ADDRESS 0xfe4abaaa /* @ECU_Address@autosar_swc_aeb_rtARID_DEF.is_active_c19_autosar_swc_aeb@ */ /end MEASUREMENT
/begin MEASUREMENT autosar_swc_aeb_rtARID_DEF.is_active_c34_autosar_swc_aeb "" UBYTE autosar_swc_aeb_CM_uint8 0 0 0 255 ECU_ADDRESS 0xfe4abaa8 /* @ECU_Address@autosar_swc_aeb_rtARID_DEF.is_active_c34_autosar_swc_aeb@ */ /end MEASUREMENT
/begin MEASUREMENT autosar_swc_aeb_rtARID_DEF.is_active_c48_autosar_swc_aeb "" UBYTE autosar_swc_aeb_CM_uint8 0 0 0 255 ECU_ADDRESS 0xfe4abaa3 /* @ECU_Address@autosar_swc_aeb_rtARID_DEF.is_active_c48_autosar_swc_aeb@ */ /end MEASUREMENT
/begin MEASUREMENT autosar_swc_aeb_rtARID_DEF.is_active_c52_autosar_swc_aeb "" UBYTE autosar_swc_aeb_CM_uint8 0 0 0 255 ECU_ADDRESS 0xfe4abaa0 /* @ECU_Address@autosar_swc_aeb_rtARID_DEF.is_active_c52_autosar_swc_aeb@ */ /end MEASUREMENT
/begin MEASUREMENT autosar_swc_aeb_rtARID_DEF.is_active_c5_autosar_swc_aeb "" UBYTE autosar_swc_aeb_CM_uint8 0 0 0 255 ECU_ADDRESS 0xfe4aba9e /* @ECU_Address@autosar_swc_aeb_rtARID_DEF.is_active_c5_autosar_swc_aeb@ */ /end MEASUREMENT
/begin MEASUREMENT autosar_swc_aeb_rtARID_DEF.is_active_c70_autosar_swc_aeb "" UBYTE autosar_swc_aeb_CM_uint8 0 0 0 255 ECU_ADDRESS 0xfe4aba98 /* @ECU_Address@autosar_swc_aeb_rtARID_DEF.is_active_c70_autosar_swc_aeb@ */ /end MEASUREMENT
/begin MEASUREMENT autosar_swc_aeb_rtARID_DEF.is_active_c80_autosar_swc_aeb "" UBYTE autosar_swc_aeb_CM_uint8 0 0 0 255 ECU_ADDRESS 0xfe4aba8f /* @ECU_Address@autosar_swc_aeb_rtARID_DEF.is_active_c80_autosar_swc_aeb@ */ /end MEASUREMENT
/begin MEASUREMENT autosar_swc_aeb_rtARID_DEF.is_active_c88_autosar_swc_aeb "" UBYTE autosar_swc_aeb_CM_uint8 0 0 0 255 ECU_ADDRESS 0xfe4aba92 /* @ECU_Address@autosar_swc_aeb_rtARID_DEF.is_active_c88_autosar_swc_aeb@ */ /end MEASUREMENT
/begin MEASUREMENT autosar_swc_aeb_rtARID_DEF.is_c12_autosar_swc_aeb "" UBYTE autosar_swc_aeb_CM_uint8 0 0 0 255 ECU_ADDRESS 0xfe4aba9c /* @ECU_Address@autosar_swc_aeb_rtARID_DEF.is_c12_autosar_swc_aeb@ */ /end MEASUREMENT
/begin MEASUREMENT autosar_swc_aeb_rtARID_DEF.is_c15_autosar_swc_aeb "" UBYTE autosar_swc_aeb_CM_uint8 0 0 0 255 ECU_ADDRESS 0xfe4aba97 /* @ECU_Address@autosar_swc_aeb_rtARID_DEF.is_c15_autosar_swc_aeb@ */ /end MEASUREMENT
/begin MEASUREMENT autosar_swc_aeb_rtARID_DEF.is_c19_autosar_swc_aeb "" UBYTE autosar_swc_aeb_CM_uint8 0 0 0 255 ECU_ADDRESS 0xfe4abaab /* @ECU_Address@autosar_swc_aeb_rtARID_DEF.is_c19_autosar_swc_aeb@ */ /end MEASUREMENT
/begin MEASUREMENT autosar_swc_aeb_rtARID_DEF.is_c34_autosar_swc_aeb "" UBYTE autosar_swc_aeb_CM_uint8 0 0 0 255 ECU_ADDRESS 0xfe4abaa9 /* @ECU_Address@autosar_swc_aeb_rtARID_DEF.is_c34_autosar_swc_aeb@ */ /end MEASUREMENT
/begin MEASUREMENT autosar_swc_aeb_rtARID_DEF.is_c48_autosar_swc_aeb "" UBYTE autosar_swc_aeb_CM_uint8 0 0 0 255 ECU_ADDRESS 0xfe4abaa4 /* @ECU_Address@autosar_swc_aeb_rtARID_DEF.is_c48_autosar_swc_aeb@ */ /end MEASUREMENT
/begin MEASUREMENT autosar_swc_aeb_rtARID_DEF.is_c52_autosar_swc_aeb "" UBYTE autosar_swc_aeb_CM_uint8 0 0 0 255 ECU_ADDRESS 0xfe4abaa1 /* @ECU_Address@autosar_swc_aeb_rtARID_DEF.is_c52_autosar_swc_aeb@ */ /end MEASUREMENT
/begin MEASUREMENT autosar_swc_aeb_rtARID_DEF.is_c5_autosar_swc_aeb "" UBYTE autosar_swc_aeb_CM_uint8 0 0 0 255 ECU_ADDRESS 0xfe4aba9f /* @ECU_Address@autosar_swc_aeb_rtARID_DEF.is_c5_autosar_swc_aeb@ */ /end MEASUREMENT
/begin MEASUREMENT autosar_swc_aeb_rtARID_DEF.is_c70_autosar_swc_aeb "" UBYTE autosar_swc_aeb_CM_uint8 0 0 0 255 ECU_ADDRESS 0xfe4aba99 /* @ECU_Address@autosar_swc_aeb_rtARID_DEF.is_c70_autosar_swc_aeb@ */ /end MEASUREMENT
/begin MEASUREMENT autosar_swc_aeb_rtARID_DEF.is_c80_autosar_swc_aeb "" UBYTE autosar_swc_aeb_CM_uint8 0 0 0 255 ECU_ADDRESS 0xfe4aba90 /* @ECU_Address@autosar_swc_aeb_rtARID_DEF.is_c80_autosar_swc_aeb@ */ /end MEASUREMENT
/begin MEASUREMENT autosar_swc_aeb_rtARID_DEF.is_c88_autosar_swc_aeb "" UBYTE autosar_swc_aeb_CM_uint8 0 0 0 255 ECU_ADDRESS 0xfe4aba93 /* @ECU_Address@autosar_swc_aeb_rtARID_DEF.is_c88_autosar_swc_aeb@ */ /end MEASUREMENT
/begin MEASUREMENT autosar_swc_aeb_rtARID_DEF.sendtime "" FLOAT64_IEEE autosar_swc_aeb_CM_double 0 0 -1.7E+308 1.7E+308 ECU_ADDRESS 0xfe4aa3f0 /* @ECU_Address@autosar_swc_aeb_rtARID_DEF.sendtime@ */ /end MEASUREMENT
/begin MEASUREMENT autosar_swc_aeb_rtARID_DEF.sendtime_a "" FLOAT64_IEEE autosar_swc_aeb_CM_double 0 0 -1.7E+308 1.7E+308 ECU_ADDRESS 0xfe4aa3f8 /* @ECU_Address@autosar_swc_aeb_rtARID_DEF.sendtime_a@ */ /end MEASUREMENT
/begin AXIS_PTS CLTS_AForBrkDlyInAsyEvlrCritEve_Ca "" 0xfe5041c8 /* @ECU_Address@CLTS_AForBrkDlyInAsyEvlrCritEve_Ca@ */ NO_INPUT_QUANTITY Axis_FLOAT32_IEEE 0 autosar_swc_aeb_CM_single_m_per_s 10 -20.000000 20.000000 /end AXIS_PTS
/begin FUNCTION autosar_swc_aeb_BeyondLastSegment ""
 /begin IN_MEASUREMENT autosar_swc_aeb_rtARID_DEF.DstLatConCoeff_p autosar_swc_aeb_rtARID_DEF.DstLatFirstCoeff_h autosar_swc_aeb_rtARID_DEF.DstLatSecCoeff_f autosar_swc_aeb_rtARID_DEF.DstLatThrdCoeff_c /end IN_MEASUREMENT
/end FUNCTION
/begin FUNCTION autosar_swc_aeb_CircularPrediction ""
 /begin IN_MEASUREMENT autosar_swc_aeb_rtARID_DEF.PredPosnLgt_a autosar_swc_aeb_rtARID_DEF.PredVLgtObj_c autosar_swc_aeb_rtARID_DEF.PredALgtObj_g autosar_swc_aeb_rtARID_DEF.PredPosnLat_f autosar_swc_aeb_rtARID_DEF.PredVLatObj_c autosar_swc_aeb_rtARID_DEF.PredALatObj_d /end IN_MEASUREMENT
/end FUNCTION
/begin FUNCTION autosar_swc_aeb_CircularPrediction_i ""
 /begin IN_MEASUREMENT autosar_swc_aeb_rtARID_DEF.PosnLgtObj_o autosar_swc_aeb_rtARID_DEF.PosnLatObj_p autosar_swc_aeb_rtARID_DEF.VLgtObj_f autosar_swc_aeb_rtARID_DEF.VLatObj_j autosar_swc_aeb_rtARID_DEF.HeadingObj_m autosar_swc_aeb_rtARID_DEF.PosnLgtObj_o0 autosar_swc_aeb_rtARID_DEF.PosnLatObj_p3 autosar_swc_aeb_rtARID_DEF.VLgtObj_foijp autosar_swc_aeb_rtARID_DEF.VLatObj_ja0hf autosar_swc_aeb_rtARID_DEF.HeadingObj_mh autosar_swc_aeb_rtARID_DEF.PosnLgtObj_o0e3h autosar_swc_aeb_rtARID_DEF.PosnLatObj_p3hko autosar_swc_aeb_rtARID_DEF.VLgtObj_fo autosar_swc_aeb_rtARID_DEF.VLatObj_ja autosar_swc_aeb_rtARID_DEF.HeadingObj_mhzxn autosar_swc_aeb_rtARID_DEF.PosnLgtObj_o0e autosar_swc_aeb_rtARID_DEF.PosnLatObj_p3h autosar_swc_aeb_rtARID_DEF.VLgtObj_foi autosar_swc_aeb_rtARID_DEF.VLatObj_ja0 autosar_swc_aeb_rtARID_DEF.HeadingObj_mhz autosar_swc_aeb_rtARID_DEF.PosnLgtObj_o0e3 autosar_swc_aeb_rtARID_DEF.PosnLatObj_p3hk autosar_swc_aeb_rtARID_DEF.VLgtObj_foij autosar_swc_aeb_rtARID_DEF.VLatObj_ja0h autosar_swc_aeb_rtARID_DEF.HeadingObj_mhzx autosar_swc_aeb_rtARID_DEF.ALgtObj_c autosar_swc_aeb_rtARID_DEF.ALatObj_o autosar_swc_aeb_rtARID_DEF.ALgtObj_cmoa autosar_swc_aeb_rtARID_DEF.ALatObj_onhu autosar_swc_aeb_rtARID_DEF.ALgtObj_cm autosar_swc_aeb_rtARID_DEF.ALatObj_on autosar_swc_aeb_rtARID_DEF.CrvtObj_l autosar_swc_aeb_rtARID_DEF.ALgtObj_cmo autosar_swc_aeb_rtARID_DEF.ALatObj_onh autosar_swc_aeb_rtARID_DEF.CrvtObj_lk /end IN_MEASUREMENT
/end FUNCTION
/begin FUNCTION autosar_swc_aeb_LinearPrediction ""
 /begin IN_MEASUREMENT autosar_swc_aeb_rtARID_DEF.PredPosnLgt_a autosar_swc_aeb_rtARID_DEF.PredVLgtObj_c autosar_swc_aeb_rtARID_DEF.PredALgtObj_g autosar_swc_aeb_rtARID_DEF.PredPosnLat_f autosar_swc_aeb_rtARID_DEF.PredVLatObj_c autosar_swc_aeb_rtARID_DEF.PredALatObj_d /end IN_MEASUREMENT
/end FUNCTION
/begin FUNCTION autosar_swc_aeb_NoPrediction ""
 /begin IN_MEASUREMENT autosar_swc_aeb_rtARID_DEF.PredPosnLgt_a autosar_swc_aeb_rtARID_DEF.PredVLgtObj_c autosar_swc_aeb_rtARID_DEF.PredALgtObj_g autosar_swc_aeb_rtARID_DEF.PredPosnLat_f autosar_swc_aeb_rtARID_DEF.PredVLatObj_c autosar_swc_aeb_rtARID_DEF.PredALatObj_d /end IN_MEASUREMENT
/end FUNCTION
/begin FUNCTION autosar_swc_aeb_ObjectWillBrake ""
 /begin IN_MEASUREMENT autosar_swc_aeb_rtARID_DEF.ALgtObj_c autosar_swc_aeb_rtARID_DEF.ALatObj_o /end IN_MEASUREMENT
/end FUNCTION
/begin FUNCTION autosar_swc_aeb_ObjectWillSteerLeft ""
 /begin IN_MEASUREMENT autosar_swc_aeb_rtARID_DEF.ALgtObj_cm autosar_swc_aeb_rtARID_DEF.ALatObj_on autosar_swc_aeb_rtARID_DEF.CrvtObj_l /end IN_MEASUREMENT
/end FUNCTION
/begin FUNCTION autosar_swc_aeb_ObjectWillSteerRight ""
 /begin IN_MEASUREMENT autosar_swc_aeb_rtARID_DEF.CrvtObj_lk autosar_swc_aeb_rtARID_DEF.ALatObj_onh autosar_swc_aeb_rtARID_DEF.ALgtObj_cmo /end IN_MEASUREMENT
/end FUNCTION
/begin FUNCTION autosar_swc_aeb_PosnLgtForIntv "" /begin IN_MEASUREMENT autosar_swc_aeb_rtARID_DEF.PosnLgt_b /end IN_MEASUREMENT /end FUNCTION
/begin FUNCTION autosar_swc_aeb_RequiredLongitudinalAccelerationCalculator "" /begin IN_MEASUREMENT autosar_swc_aeb_rtARID_DEF.ALgtRqrd_e /end IN_MEASUREMENT /end FUNCTION
/begin FUNCTION autosar_swc_aeb_SimpleLateralAccelerationEstimatorForIntv ""
 /begin IN_MEASUREMENT autosar_swc_aeb_rtARID_DEF.Out autosar_swc_aeb_rtARID_DEF.ALatRqrd_as autosar_swc_aeb_rtARID_DEF.ProjectedPosnLatRel_i autosar_swc_aeb_rtARID_DEF.ProjectedLengthSideLat_c /end IN_MEASUREMENT
/end FUNCTION
/begin FUNCTION autosar_swc_aeb_WithinFirstSegment ""
 /begin IN_MEASUREMENT autosar_swc_aeb_rtARID_DEF.DstLatConCoeff_p autosar_swc_aeb_rtARID_DEF.DstLatFirstCoeff_h autosar_swc_aeb_rtARID_DEF.DstLatSecCoeff_f autosar_swc_aeb_rtARID_DEF.DstLatThrdCoeff_c /end IN_MEASUREMENT
/end FUNCTION
/begin FUNCTION autosar_swc_aeb_WithinThirdSegment ""
 /begin IN_MEASUREMENT autosar_swc_aeb_rtARID_DEF.DstLatConCoeff_p autosar_swc_aeb_rtARID_DEF.DstLatFirstCoeff_h autosar_swc_aeb_rtARID_DEF.DstLatSecCoeff_f autosar_swc_aeb_rtARID_DEF.DstLatThrdCoeff_c /end IN_MEASUREMENT
/end FUNCTION
/begin COMPU_METHOD autosar_swc_aeb_CM_AsySftyDecelReqDendBySpdRedn0 "Enumerated data type: AsySftyDecelReqDendBySpdRedn0" TAB_VERB "%0.6" "" COMPU_TAB_REF VTAB_FOR_autosar_swc_aeb_CM_AsySftyDecelReqDendBySpdRedn0 /end COMPU_METHOD
/begin COMPU_VTAB VTAB_FOR_autosar_swc_aeb_CM_AsySftyDecelReqDendBySpdRedn0 "Enumerated data type: AsySftyDecelReqDendBySpdRedn0" TAB_VERB 2 1 "AsySftyDecelReqDendBySpdRedn0_TRUE" 0 "AsySftyDecelReqDendBySpdRedn0_FALSE" /end COMPU_VTAB
/begin COMPU_METHOD autosar_swc_aeb_CM_SM_MODULE_STATUS "Enumerated data type: SM_MODULE_STATUS" TAB_VERB "%0.6" "" COMPU_TAB_REF VTAB_FOR_autosar_swc_aeb_CM_SM_MODULE_STATUS /end COMPU_METHOD
/begin COMPU_VTAB VTAB_FOR_autosar_swc_aeb_CM_SM_MODULE_STATUS "Enumerated data type: SM_MODULE_STATUS" TAB_VERB 4 0 "STATUS_NORMAL" 1 "STATUS_NOT_CONNECTED" 2 "STATUS_HEARTBEAT_MISSED" 3 "STATUS_ABNORMAL" /end COMPU_VTAB
/begin COMPU_METHOD autosar_swc_aeb_CM_boolean "Q = V" IDENTICAL "%1.0" "" /end COMPU_METHOD
/begin COMPU_METHOD autosar_swc_aeb_CM_double "Q = V" IDENTICAL "%15.10" "" /end COMPU_METHOD
/begin COMPU_METHOD autosar_swc_aeb_CM_int16 "Q = V" IDENTICAL "%5.0" "" /end COMPU_METHOD
/begin COMPU_METHOD autosar_swc_aeb_CM_int32 "Q = V" IDENTICAL "%10.0" "" /end COMPU_METHOD
/begin COMPU_METHOD autosar_swc_aeb_CM_int8 "Q = V" IDENTICAL "%3.0" "" /end COMPU_METHOD
/begin COMPU_METHOD autosar_swc_aeb_CM_logical "Q = V" IDENTICAL "%1.0" "" /end COMPU_METHOD
/begin COMPU_METHOD autosar_swc_aeb_CM_single "Q = V" IDENTICAL "%8.6" "" /end COMPU_METHOD
/begin COMPU_METHOD autosar_swc_aeb_CM_single_m "Q = V" IDENTICAL "%8.6" "m" /end COMPU_METHOD
/begin COMPU_METHOD autosar_swc_aeb_CM_single_m_per_s "Q = V" IDENTICAL "%8.6" "m/s" /end COMPU_METHOD
/begin COMPU_METHOD autosar_swc_aeb_CM_single_s "Q = V" IDENTICAL "%8.6" "s" /end COMPU_METHOD
/begin COMPU_METHOD autosar_swc_aeb_CM_uint16 "Q = V" IDENTICAL "%5.0" "" /end COMPU_METHOD
/begin COMPU_METHOD autosar_swc_aeb_CM_uint32 "Q = V" IDENTICAL "%10.0" "" /end COMPU_METHOD
/begin COMPU_METHOD autosar_swc_aeb_CM_uint64 "Q = V" IDENTICAL "%20.0" "" /end COMPU_METHOD
/begin COMPU_METHOD autosar_swc_aeb_CM_uint8 "Q = V" IDENTICAL "%3.0" "" /end COMPU_METHOD
/begin RECORD_LAYOUT Record_BOOLEAN FNC_VALUES 1 UBYTE COLUMN_DIR DIRECT /end RECORD_LAYOUT
/begin RECORD_LAYOUT Record_FLOAT32_IEEE FNC_VALUES 1 FLOAT32_IEEE COLUMN_DIR DIRECT /end RECORD_LAYOUT
/begin RECORD_LAYOUT Axis_FLOAT32_IEEE AXIS_PTS_X 1 FLOAT32_IEEE INDEX_INCR DIRECT /end RECORD_LAYOUT
/begin GROUP AEB_ExecTimestamp ""
 /begin REF_MEASUREMENT AEB_ExecTimestamp.timeBaseStatus AEB_ExecTimestamp.nanoseconds AEB_ExecTimestamp.seconds /end REF_MEASUREMENT
/end GROUP
/begin GROUP SwcOut_AEB_BRKINFO ""
 /begin REF_MEASUREMENT SwcOut_AEB_BRKINFO.AEBDecCtrlReqest SwcOut_AEB_BRKINFO.AEBReq SwcOut_AEB_BRKINFO.DWReq SwcOut_AEB_BRKINFO.AWBRequest SwcOut_AEB_BRKINFO.AWBLevel SwcOut_AEB_BRKINFO.PrefillRequest SwcOut_AEB_BRKINFO.HBAlevel SwcOut_AEB_BRKINFO.HBArequest SwcOut_AEB_BRKINFO.FCWMode SwcOut_AEB_BRKINFO.AEBMode SwcOut_AEB_BRKINFO.FCTBMode SwcOut_AEB_BRKINFO.HazdLmpReq SwcOut_AEB_BRKINFO.TextInfo SwcOut_AEB_BRKINFO.TextinfoWarn SwcOut_AEB_BRKINFO.AEBTarDec /end REF_MEASUREMENT
/end GROUP
/begin GROUP SwcOut_AEB_DebugInfo ""
 /begin SUB_GROUP SwcOut_AEB_DebugInfo.ego_info SwcOut_AEB_DebugInfo.primary_target_intv_info SwcOut_AEB_DebugInfo.primary_target_warn_info SwcOut_AEB_DebugInfo.risk_condition_info SwcOut_AEB_DebugInfo.inhibit_info /end SUB_GROUP
 /begin REF_MEASUREMENT /end REF_MEASUREMENT
/end GROUP
/begin GROUP SwcOut_AEB_DebugInfo.ego_info ""
 /begin REF_MEASUREMENT SwcOut_AEB_DebugInfo.ego_info.v_lgt SwcOut_AEB_DebugInfo.ego_info.v_lat SwcOut_AEB_DebugInfo.ego_info.a_lgt SwcOut_AEB_DebugInfo.ego_info.a_lat SwcOut_AEB_DebugInfo.ego_info.yaw_rate SwcOut_AEB_DebugInfo.ego_info.curvature SwcOut_AEB_DebugInfo.ego_info.curve_radius SwcOut_AEB_DebugInfo.ego_info.steer_angle SwcOut_AEB_DebugInfo.ego_info.steer_angle_spd SwcOut_AEB_DebugInfo.ego_info.acceleration_pedal_position SwcOut_AEB_DebugInfo.ego_info.master_cylinder_pressure SwcOut_AEB_DebugInfo.ego_info.gear SwcOut_AEB_DebugInfo.ego_info.vehicle_standstill_status SwcOut_AEB_DebugInfo.ego_info.brake_pedal_applied SwcOut_AEB_DebugInfo.ego_info.acc_request_acceleration /end REF_MEASUREMENT
/end GROUP
/begin GROUP SwcOut_AEB_DebugInfo.inhibit_info ""
 /begin REF_MEASUREMENT SwcOut_AEB_DebugInfo.inhibit_info.confidence_info_flag SwcOut_AEB_DebugInfo.inhibit_info.aeb_inhibit_flag_1 SwcOut_AEB_DebugInfo.inhibit_info.aeb_inhibit_flag_2 SwcOut_AEB_DebugInfo.inhibit_info.fcw_inhibit_flag SwcOut_AEB_DebugInfo.inhibit_info.aeb_deactive_flag SwcOut_AEB_DebugInfo.inhibit_info.fcw_deactive_flag SwcOut_AEB_DebugInfo.inhibit_info.aeb_inhibit_override_flag SwcOut_AEB_DebugInfo.inhibit_info.fcw_inhibit_override_flag /end REF_MEASUREMENT
/end GROUP
/begin GROUP SwcOut_AEB_DebugInfo.obj_data_info[0] ""
 /begin SUB_GROUP SwcOut_AEB_DebugInfo.obj_data_info[0].porperty SwcOut_AEB_DebugInfo.obj_data_info[0].motion_type SwcOut_AEB_DebugInfo.obj_data_info[0].bounding_box SwcOut_AEB_DebugInfo.obj_data_info[0].short_pred_time SwcOut_AEB_DebugInfo.obj_data_info[0].long_pred_time SwcOut_AEB_DebugInfo.obj_data_info[0].offsets /end SUB_GROUP
/end GROUP
/begin GROUP SwcOut_AEB_DebugInfo.obj_data_info[0].bounding_box ""
 /begin REF_MEASUREMENT SwcOut_AEB_DebugInfo.obj_data_info[0].bounding_box.length_side_lat SwcOut_AEB_DebugInfo.obj_data_info[0].bounding_box.length_side_lgt SwcOut_AEB_DebugInfo.obj_data_info[0].bounding_box.sin_rotation SwcOut_AEB_DebugInfo.obj_data_info[0].bounding_box.cos_rotation /end REF_MEASUREMENT
/end GROUP
/begin GROUP SwcOut_AEB_DebugInfo.obj_data_info[0].long_pred_time ""
 /begin REF_MEASUREMENT SwcOut_AEB_DebugInfo.obj_data_info[0].long_pred_time.ttr SwcOut_AEB_DebugInfo.obj_data_info[0].long_pred_time.inpath SwcOut_AEB_DebugInfo.obj_data_info[0].long_pred_time.inpath_predict_position SwcOut_AEB_DebugInfo.obj_data_info[0].long_pred_time.inpath_current_position SwcOut_AEB_DebugInfo.obj_data_info[0].long_pred_time.use_inpath_calculation SwcOut_AEB_DebugInfo.obj_data_info[0].long_pred_time.use_out_offpath_calculation SwcOut_AEB_DebugInfo.obj_data_info[0].long_pred_time.prediction_valid /end REF_MEASUREMENT
/end GROUP
/begin GROUP SwcOut_AEB_DebugInfo.obj_data_info[0].motion_type ""
 /begin REF_MEASUREMENT SwcOut_AEB_DebugInfo.obj_data_info[0].motion_type.stationary SwcOut_AEB_DebugInfo.obj_data_info[0].motion_type.moving_oncoming SwcOut_AEB_DebugInfo.obj_data_info[0].motion_type.parallell_vehicle_long_predict SwcOut_AEB_DebugInfo.obj_data_info[0].motion_type.parallell_vehicle_short_predict SwcOut_AEB_DebugInfo.obj_data_info[0].motion_type.object_is_vehicle SwcOut_AEB_DebugInfo.obj_data_info[0].motion_type.object_is_motor_vehicle SwcOut_AEB_DebugInfo.obj_data_info[0].motion_type.curved_motion SwcOut_AEB_DebugInfo.obj_data_info[0].motion_type.side_is_closest SwcOut_AEB_DebugInfo.obj_data_info[0].motion_type.abs_heading /end REF_MEASUREMENT
/end GROUP
/begin GROUP SwcOut_AEB_DebugInfo.obj_data_info[0].offsets ""
 /begin REF_MEASUREMENT SwcOut_AEB_DebugInfo.obj_data_info[0].offsets.offs_lgt_long_predict SwcOut_AEB_DebugInfo.obj_data_info[0].offsets.offs_lat_long_predict SwcOut_AEB_DebugInfo.obj_data_info[0].offsets.offs_lgt_short_predict SwcOut_AEB_DebugInfo.obj_data_info[0].offsets.offs_lat_short_predict SwcOut_AEB_DebugInfo.obj_data_info[0].offsets.offs_lat_manoeuvre SwcOut_AEB_DebugInfo.obj_data_info[0].offsets.offs_lat_inpath_primary_target SwcOut_AEB_DebugInfo.obj_data_info[0].offsets.offs_lat_inpath_close_edge SwcOut_AEB_DebugInfo.obj_data_info[0].offsets.offs_lat_inpath_far_edge SwcOut_AEB_DebugInfo.obj_data_info[0].offsets.offs_lat_intersection SwcOut_AEB_DebugInfo.obj_data_info[0].offsets.offs_lat_multiple_target /end REF_MEASUREMENT
/end GROUP
/begin GROUP SwcOut_AEB_DebugInfo.obj_data_info[0].porperty ""
 /begin REF_MEASUREMENT SwcOut_AEB_DebugInfo.obj_data_info[0].porperty.p_lgt SwcOut_AEB_DebugInfo.obj_data_info[0].porperty.p_lat SwcOut_AEB_DebugInfo.obj_data_info[0].porperty.spd SwcOut_AEB_DebugInfo.obj_data_info[0].porperty.v_lgt SwcOut_AEB_DebugInfo.obj_data_info[0].porperty.v_lat SwcOut_AEB_DebugInfo.obj_data_info[0].porperty.a_lgt SwcOut_AEB_DebugInfo.obj_data_info[0].porperty.a_lat SwcOut_AEB_DebugInfo.obj_data_info[0].porperty.a SwcOut_AEB_DebugInfo.obj_data_info[0].porperty.curvature /end REF_MEASUREMENT
/end GROUP
/begin GROUP SwcOut_AEB_DebugInfo.obj_data_info[0].short_pred_time ""
 /begin REF_MEASUREMENT SwcOut_AEB_DebugInfo.obj_data_info[0].short_pred_time.ttr SwcOut_AEB_DebugInfo.obj_data_info[0].short_pred_time.ttm SwcOut_AEB_DebugInfo.obj_data_info[0].short_pred_time.ttm_selected SwcOut_AEB_DebugInfo.obj_data_info[0].short_pred_time.inpath SwcOut_AEB_DebugInfo.obj_data_info[0].short_pred_time.inpath_predict_position SwcOut_AEB_DebugInfo.obj_data_info[0].short_pred_time.inpath_current_position SwcOut_AEB_DebugInfo.obj_data_info[0].short_pred_time.use_inpath_calculation SwcOut_AEB_DebugInfo.obj_data_info[0].short_pred_time.use_out_offpath_calculation SwcOut_AEB_DebugInfo.obj_data_info[0].short_pred_time.prediction_valid /end REF_MEASUREMENT
/end GROUP
/begin GROUP SwcOut_AEB_DebugInfo.primary_target_intv_info ""
 /begin SUB_GROUP SwcOut_AEB_DebugInfo.primary_target_intv_info.motion_request_intv SwcOut_AEB_DebugInfo.primary_target_intv_info.primary_target_intv /end SUB_GROUP
/end GROUP
/begin GROUP SwcOut_AEB_DebugInfo.primary_target_intv_info.motion_request_intv ""
 /begin REF_MEASUREMENT SwcOut_AEB_DebugInfo.primary_target_intv_info.motion_request_intv.a_lat_request SwcOut_AEB_DebugInfo.primary_target_intv_info.motion_request_intv.a_lat_quality SwcOut_AEB_DebugInfo.primary_target_intv_info.motion_request_intv.a_neg_lgt_request SwcOut_AEB_DebugInfo.primary_target_intv_info.motion_request_intv.jerk_neg_lgt_request SwcOut_AEB_DebugInfo.primary_target_intv_info.motion_request_intv.crvt_request_left SwcOut_AEB_DebugInfo.primary_target_intv_info.motion_request_intv.crvt_rate_request_left SwcOut_AEB_DebugInfo.primary_target_intv_info.motion_request_intv.crvt_request_right SwcOut_AEB_DebugInfo.primary_target_intv_info.motion_request_intv.crvt_rate_request_right /end REF_MEASUREMENT
/end GROUP
/begin GROUP SwcOut_AEB_DebugInfo.primary_target_intv_info.primary_target_intv ""
 /begin REF_MEASUREMENT SwcOut_AEB_DebugInfo.primary_target_intv_info.primary_target_intv.obj_id SwcOut_AEB_DebugInfo.primary_target_intv_info.primary_target_intv.obj_type SwcOut_AEB_DebugInfo.primary_target_intv_info.primary_target_intv.new_ta_found SwcOut_AEB_DebugInfo.primary_target_intv_info.primary_target_intv.posn_lgt SwcOut_AEB_DebugInfo.primary_target_intv_info.primary_target_intv.posn_lat SwcOut_AEB_DebugInfo.primary_target_intv_info.primary_target_intv.v_lgt SwcOut_AEB_DebugInfo.primary_target_intv_info.primary_target_intv.v_lat SwcOut_AEB_DebugInfo.primary_target_intv_info.primary_target_intv.a_lgt SwcOut_AEB_DebugInfo.primary_target_intv_info.primary_target_intv.a_lat SwcOut_AEB_DebugInfo.primary_target_intv_info.primary_target_intv.ttc_val SwcOut_AEB_DebugInfo.primary_target_intv_info.primary_target_intv.trigger_flag SwcOut_AEB_DebugInfo.primary_target_intv_info.primary_target_intv.obs_conf SwcOut_AEB_DebugInfo.primary_target_intv_info.primary_target_intv.ang_dir /end REF_MEASUREMENT
/end GROUP
/begin GROUP SwcOut_AEB_DebugInfo.primary_target_warn_info ""
 /begin SUB_GROUP SwcOut_AEB_DebugInfo.primary_target_warn_info.motion_request_warn SwcOut_AEB_DebugInfo.primary_target_warn_info.primary_target_warn /end SUB_GROUP
/end GROUP
/begin GROUP SwcOut_AEB_DebugInfo.primary_target_warn_info.motion_request_warn ""
 /begin REF_MEASUREMENT SwcOut_AEB_DebugInfo.primary_target_warn_info.motion_request_warn.a_lat_request SwcOut_AEB_DebugInfo.primary_target_warn_info.motion_request_warn.a_neg_lgt_request_forwarn /end REF_MEASUREMENT
/end GROUP
/begin GROUP SwcOut_AEB_DebugInfo.primary_target_warn_info.primary_target_warn ""
 /begin REF_MEASUREMENT SwcOut_AEB_DebugInfo.primary_target_warn_info.primary_target_warn.obj_id SwcOut_AEB_DebugInfo.primary_target_warn_info.primary_target_warn.obj_type SwcOut_AEB_DebugInfo.primary_target_warn_info.primary_target_warn.new_ta_found SwcOut_AEB_DebugInfo.primary_target_warn_info.primary_target_warn.posn_lgt SwcOut_AEB_DebugInfo.primary_target_warn_info.primary_target_warn.posn_lat SwcOut_AEB_DebugInfo.primary_target_warn_info.primary_target_warn.v_lgt SwcOut_AEB_DebugInfo.primary_target_warn_info.primary_target_warn.v_lat SwcOut_AEB_DebugInfo.primary_target_warn_info.primary_target_warn.a_lgt SwcOut_AEB_DebugInfo.primary_target_warn_info.primary_target_warn.a_lat SwcOut_AEB_DebugInfo.primary_target_warn_info.primary_target_warn.ttc_val SwcOut_AEB_DebugInfo.primary_target_warn_info.primary_target_warn.trigger_flag SwcOut_AEB_DebugInfo.primary_target_warn_info.primary_target_warn.obs_conf SwcOut_AEB_DebugInfo.primary_target_warn_info.primary_target_warn.ang_dir /end REF_MEASUREMENT
/end GROUP
/begin GROUP SwcOut_AEB_DebugInfo.risk_condition_info ""
 /begin SUB_GROUP SwcOut_AEB_DebugInfo.risk_condition_info.fullbrake SwcOut_AEB_DebugInfo.risk_condition_info.prebrake SwcOut_AEB_DebugInfo.risk_condition_info.prewarn /end SUB_GROUP
 /begin REF_MEASUREMENT SwcOut_AEB_DebugInfo.risk_condition_info.confidence_info_flag SwcOut_AEB_DebugInfo.risk_condition_info.Sceniaro_Flag SwcOut_AEB_DebugInfo.risk_condition_info.Sceniaro_Check_Result SwcOut_AEB_DebugInfo.risk_condition_info.Sceniaro_Host_State /end REF_MEASUREMENT
/end GROUP
/begin GROUP SwcOut_AEB_DebugInfo.risk_condition_info.fullbrake ""
 /begin REF_MEASUREMENT SwcOut_AEB_DebugInfo.risk_condition_info.fullbrake.curvature_absolute_maximum SwcOut_AEB_DebugInfo.risk_condition_info.fullbrake.curvature_rateabsolute_maximum SwcOut_AEB_DebugInfo.risk_condition_info.fullbrake.a_lat_threthold SwcOut_AEB_DebugInfo.risk_condition_info.fullbrake.a_neg_lgt_threthold SwcOut_AEB_DebugInfo.risk_condition_info.fullbrake.jerk_longitudinal_negative_minimum SwcOut_AEB_DebugInfo.risk_condition_info.fullbrake.steering_threat SwcOut_AEB_DebugInfo.risk_condition_info.fullbrake.braking_threat SwcOut_AEB_DebugInfo.risk_condition_info.fullbrake.a_lgt_threat SwcOut_AEB_DebugInfo.risk_condition_info.fullbrake.a_lat_quality SwcOut_AEB_DebugInfo.risk_condition_info.fullbrake.fullbrake_counter SwcOut_AEB_DebugInfo.risk_condition_info.fullbrake.fullbrake_confirm SwcOut_AEB_DebugInfo.risk_condition_info.fullbrake.intv_obj_counter SwcOut_AEB_DebugInfo.risk_condition_info.fullbrake.intv_obj_confirm /end REF_MEASUREMENT
/end GROUP
/begin GROUP SwcOut_AEB_DebugInfo.risk_condition_info.prebrake ""
 /begin REF_MEASUREMENT SwcOut_AEB_DebugInfo.risk_condition_info.prebrake.curvature_absolute_comfort SwcOut_AEB_DebugInfo.risk_condition_info.prebrake.curvature_rate_absolute_comfort SwcOut_AEB_DebugInfo.risk_condition_info.prebrake.a_lat_threthold SwcOut_AEB_DebugInfo.risk_condition_info.prebrake.a_neg_lgt_threthold SwcOut_AEB_DebugInfo.risk_condition_info.prebrake.steering_threat SwcOut_AEB_DebugInfo.risk_condition_info.prebrake.braking_threat SwcOut_AEB_DebugInfo.risk_condition_info.prebrake.a_lgt_threat SwcOut_AEB_DebugInfo.risk_condition_info.prebrake.a_lat_quality SwcOut_AEB_DebugInfo.risk_condition_info.prebrake.prebrake_counter SwcOut_AEB_DebugInfo.risk_condition_info.prebrake.prebrake_confirm SwcOut_AEB_DebugInfo.risk_condition_info.prebrake.intv_obj_counter SwcOut_AEB_DebugInfo.risk_condition_info.prebrake.intv_obj_confirm /end REF_MEASUREMENT
/end GROUP
/begin GROUP SwcOut_AEB_DebugInfo.risk_condition_info.prewarn ""
 /begin REF_MEASUREMENT SwcOut_AEB_DebugInfo.risk_condition_info.prewarn.brake_num SwcOut_AEB_DebugInfo.risk_condition_info.prewarn.obj_valid SwcOut_AEB_DebugInfo.risk_condition_info.prewarn.steer_valid SwcOut_AEB_DebugInfo.risk_condition_info.prewarn.fcw_counter SwcOut_AEB_DebugInfo.risk_condition_info.prewarn.fcw_confirm SwcOut_AEB_DebugInfo.risk_condition_info.prewarn.fcw_obj_counter SwcOut_AEB_DebugInfo.risk_condition_info.prewarn.fcw_obj_confirm /end REF_MEASUREMENT
/end GROUP
/begin GROUP SwcOut_AEB_FuSAIN ""
 /begin REF_MEASUREMENT SwcOut_AEB_FuSAIN.isMainTarExist SwcOut_AEB_FuSAIN.AebTarSource SwcOut_AEB_FuSAIN.ActSftySts SwcOut_AEB_FuSAIN.AebReq SwcOut_AEB_FuSAIN.QM_AebTarTTC SwcOut_AEB_FuSAIN.AebTarDec SwcOut_AEB_FuSAIN.EgoCvrt SwcOut_AEB_FuSAIN.QM_AebRqrdAx SwcOut_AEB_FuSAIN.AebTarID SwcOut_AEB_FuSAIN.AebTarCamID /end REF_MEASUREMENT
/end GROUP
/begin GROUP SwcOut_AEB_FuSAIN.EgoPreTraj[0] ""
 /begin REF_MEASUREMENT SwcOut_AEB_FuSAIN.EgoPreTraj[0].PosX SwcOut_AEB_FuSAIN.EgoPreTraj[0].PosY SwcOut_AEB_FuSAIN.EgoPreTraj[0].Heading /end REF_MEASUREMENT
/end GROUP
/begin GROUP SwcOut_AEB_Herbeat_Info ""
 /begin REF_MEASUREMENT SwcOut_AEB_Herbeat_Info.swc_id SwcOut_AEB_Herbeat_Info.sequence_num SwcOut_AEB_Herbeat_Info.inner_error SwcOut_AEB_Herbeat_Info.module_status /end REF_MEASUREMENT
/end GROUP
/begin GROUP SwcOut_AEB_RECORDER_DATA ""
 /begin REF_MEASUREMENT SwcOut_AEB_RECORDER_DATA.object_class SwcOut_AEB_RECORDER_DATA.object_status SwcOut_AEB_RECORDER_DATA.vxv_ref SwcOut_AEB_RECORDER_DATA.axv_ref SwcOut_AEB_RECORDER_DATA.ayv_ref SwcOut_AEB_RECORDER_DATA.dxv SwcOut_AEB_RECORDER_DATA.dyv SwcOut_AEB_RECORDER_DATA.vxv SwcOut_AEB_RECORDER_DATA.vyv SwcOut_AEB_RECORDER_DATA.axv SwcOut_AEB_RECORDER_DATA.ayv SwcOut_AEB_RECORDER_DATA.d_width SwcOut_AEB_RECORDER_DATA.curve_rate SwcOut_AEB_RECORDER_DATA.aeb_inhibit_flag_1 SwcOut_AEB_RECORDER_DATA.aeb_inhibit_flag_2 /end REF_MEASUREMENT
/end GROUP
/begin GROUP SwcOut_AEB_TAROBJ ""
 /begin REF_MEASUREMENT SwcOut_AEB_TAROBJ.PrimTarInPahNow SwcOut_AEB_TAROBJ.InPathPredict SwcOut_AEB_TAROBJ.FusionType SwcOut_AEB_TAROBJ.ObjectIndex SwcOut_AEB_TAROBJ.ObjectType SwcOut_AEB_TAROBJ.ObjectMovingState SwcOut_AEB_TAROBJ.ObjectMovingOrientation SwcOut_AEB_TAROBJ.ObjectLength SwcOut_AEB_TAROBJ.ObjectWidth SwcOut_AEB_TAROBJ.ObjectHeadingAngle SwcOut_AEB_TAROBJ.Object_DX SwcOut_AEB_TAROBJ.Object_DY SwcOut_AEB_TAROBJ.Object_RangeX SwcOut_AEB_TAROBJ.Object_RangeY SwcOut_AEB_TAROBJ.Object_Abs_SPEED SwcOut_AEB_TAROBJ.Object_Abs_VX SwcOut_AEB_TAROBJ.Object_Abs_VY SwcOut_AEB_TAROBJ.Object_Abs_AX SwcOut_AEB_TAROBJ.Object_Abs_AY SwcOut_AEB_TAROBJ.TiToCllsn SwcOut_AEB_TAROBJ.ANegLgtRqrd SwcOut_AEB_TAROBJ.ANegLgtRqrdForPrimTarWarn SwcOut_AEB_TAROBJ.CrvtRqrdLe SwcOut_AEB_TAROBJ.CrvtRqrdRi SwcOut_AEB_TAROBJ.ALatRqrd SwcOut_AEB_TAROBJ.Ego_vxvRefMs SwcOut_AEB_TAROBJ.Ego_axvRefMs2 SwcOut_AEB_TAROBJ.Ego_kapTraj SwcOut_AEB_TAROBJ.Ego_ayvRefMs2 SwcOut_AEB_TAROBJ.Ego_psiDtOpt SwcOut_AEB_TAROBJ.TTC SwcOut_AEB_TAROBJ.FCW_ANegLgtRqrdForWarn SwcOut_AEB_TAROBJ.FCW_startConditionMet SwcOut_AEB_TAROBJ.BrakeThreat SwcOut_AEB_TAROBJ.SteerThreat SwcOut_AEB_TAROBJ.Sceniaro_OK SwcOut_AEB_TAROBJ.Host_State SwcOut_AEB_TAROBJ.Sceniaro_Flag SwcOut_AEB_TAROBJ.ObjectID SwcOut_AEB_TAROBJ.camID /end REF_MEASUREMENT
/end GROUP
/begin GROUP autosar_swc_aeb "autosar_swc_aeb" ROOT
 /begin SUB_GROUP AEB_ExecTimestamp SwcOut_AEB_BRKINFO SwcOut_AEB_DebugInfo SwcOut_AEB_FuSAIN SwcOut_AEB_Herbeat_Info SwcOut_AEB_RECORDER_DATA SwcOut_AEB_TAROBJ autosar_swc_aeb_autosar_swc_aeb_Step_sys /end SUB_GROUP
/end GROUP
/begin GROUP autosar_swc_aeb_autosar_swc_aeb_Step_sys "autosar_swc_aeb/autosar_swc_aeb_Step_sys"
 /begin SUB_GROUP autosar_swc_aeb_autosar_swc_aeb_Step_sys_AEB autosar_swc_aeb_autosar_swc_aeb_Step_sys_Compare_To_Constant4 autosar_swc_aeb_autosar_swc_aeb_Step_sys_Compare_To_Constant6 autosar_swc_aeb_autosar_swc_aeb_Step_sys_Compare_To_Constant8 autosar_swc_aeb_autosar_swc_aeb_Step_sys_Counter_Limited autosar_swc_aeb_autosar_swc_aeb_Step_sys_Counter_Limited1 autosar_swc_aeb_autosar_swc_aeb_Step_sys_FCW autosar_swc_aeb_autosar_swc_aeb_Step_sys_For_Each_Subsystem autosar_swc_aeb_autosar_swc_aeb_Step_sys_Subsystem_Reference /end SUB_GROUP
 /begin REF_CHARACTERISTIC P_AEB_AWBTime P_AEB_DefaultAEBTarDec P_AEB_FuncSafetySwitch P_AEB_StandStillSwitch P_AEB_StepTime P_AEB_Switch /end REF_CHARACTERISTIC
 /begin REF_MEASUREMENT AEB_AEBSts AEB_BrakingThreat AEB_DecelRequestBrkArb AEB_FCWSts AEB_HostCrvtSceniaro AEB_SceniaroCheckisOK AEB_SceniaroFlag AEB_Version SwcOut_AEB_EDRType autosar_swc_aeb_rtARID_DEF.ARID_DEF_MATLABFunction31.Active_Sts autosar_swc_aeb_rtARID_DEF.ARID_DEF_MATLABFunction31.Active_Time autosar_swc_aeb_rtARID_DEF.AWBLevel autosar_swc_aeb_rtARID_DEF.AWBRequest autosar_swc_aeb_rtARID_DEF.Active autosar_swc_aeb_rtARID_DEF.Active_Sts autosar_swc_aeb_rtARID_DEF.Active_Time autosar_swc_aeb_rtARID_DEF.Assignment4 autosar_swc_aeb_rtARID_DEF.Confirm_St autosar_swc_aeb_rtARID_DEF.DWRequest autosar_swc_aeb_rtARID_DEF.DuringTime autosar_swc_aeb_rtARID_DEF.Duringtime autosar_swc_aeb_rtARID_DEF.Duringtime_f autosar_swc_aeb_rtARID_DEF.ObjInitCrvtPosnLat autosar_swc_aeb_rtARID_DEF.Quotient autosar_swc_aeb_rtARID_DEF.Spd autosar_swc_aeb_rtARID_DEF.TextinfoWarn autosar_swc_aeb_rtARID_DEF.Textinfo_Out autosar_swc_aeb_rtARID_DEF.UnitDelay1_DSTATE_aa autosar_swc_aeb_rtARID_DEF.UnitDelay2_DSTATE_f autosar_swc_aeb_rtARID_DEF.UnitDelay3_DSTATE_b autosar_swc_aeb_rtARID_DEF.UnitDelay4_DSTATE_k autosar_swc_aeb_rtARID_DEF.UnitDelay5_DSTATE_b autosar_swc_aeb_rtARID_DEF.UnitDelay6_DSTATE_e autosar_swc_aeb_rtARID_DEF.UnitDelay_DSTATE_g autosar_swc_aeb_rtARID_DEF.is_AWB_Active_ActiveTIme autosar_swc_aeb_rtARID_DEF.is_Confirm autosar_swc_aeb_rtARID_DEF.is_SubModule autosar_swc_aeb_rtARID_DEF.is_SubModule2 autosar_swc_aeb_rtARID_DEF.is_SubModule2_o autosar_swc_aeb_rtARID_DEF.is_SubModule_p autosar_swc_aeb_rtARID_DEF.is_active_c12_autosar_swc_aeb autosar_swc_aeb_rtARID_DEF.is_active_c48_autosar_swc_aeb autosar_swc_aeb_rtARID_DEF.is_active_c52_autosar_swc_aeb autosar_swc_aeb_rtARID_DEF.is_active_c5_autosar_swc_aeb autosar_swc_aeb_rtARID_DEF.is_active_c70_autosar_swc_aeb autosar_swc_aeb_rtARID_DEF.is_active_c80_autosar_swc_aeb autosar_swc_aeb_rtARID_DEF.is_active_c88_autosar_swc_aeb autosar_swc_aeb_rtARID_DEF.is_c12_autosar_swc_aeb autosar_swc_aeb_rtARID_DEF.is_c48_autosar_swc_aeb autosar_swc_aeb_rtARID_DEF.is_c52_autosar_swc_aeb autosar_swc_aeb_rtARID_DEF.is_c5_autosar_swc_aeb autosar_swc_aeb_rtARID_DEF.is_c70_autosar_swc_aeb autosar_swc_aeb_rtARID_DEF.is_c80_autosar_swc_aeb autosar_swc_aeb_rtARID_DEF.is_c88_autosar_swc_aeb autosar_swc_aeb_rtARID_DEF.sendtime autosar_swc_aeb_rtARID_DEF.sendtime_a /end REF_MEASUREMENT
/end GROUP
/begin GROUP autosar_swc_aeb_autosar_swc_aeb_Step_sys_AEB "autosar_swc_aeb/autosar_swc_aeb_Step_sys/AEB" /begin REF_CHARACTERISTIC P_AEB_StateConfirmTime P_AEB_StepTime /end REF_CHARACTERISTIC
 /begin REF_MEASUREMENT autosar_swc_aeb_rtARID_DEF.Active_Sts_d autosar_swc_aeb_rtARID_DEF.Active_Time_g autosar_swc_aeb_rtARID_DEF.CoolOK_j autosar_swc_aeb_rtARID_DEF.CoolOK_k autosar_swc_aeb_rtARID_DEF.Time_o autosar_swc_aeb_rtARID_DEF.Time_p autosar_swc_aeb_rtARID_DEF.UnitDelay1_DSTATE autosar_swc_aeb_rtARID_DEF.UnitDelay2_DSTATE_o autosar_swc_aeb_rtARID_DEF.UnitDelay_DSTATE_jj autosar_swc_aeb_rtARID_DEF.is_active_c19_autosar_swc_aeb autosar_swc_aeb_rtARID_DEF.is_active_c34_autosar_swc_aeb autosar_swc_aeb_rtARID_DEF.is_c19_autosar_swc_aeb autosar_swc_aeb_rtARID_DEF.is_c34_autosar_swc_aeb /end REF_MEASUREMENT
/end GROUP
/begin GROUP autosar_swc_aeb_autosar_swc_aeb_Step_sys_Compare_To_Constant4 "autosar_swc_aeb/autosar_swc_aeb_Step_sys/Compare\nTo Constant4" /begin REF_MEASUREMENT AEB_BrkArbResult /end REF_MEASUREMENT /end GROUP
/begin GROUP autosar_swc_aeb_autosar_swc_aeb_Step_sys_Compare_To_Constant6 "autosar_swc_aeb/autosar_swc_aeb_Step_sys/Compare\nTo Constant6" /begin REF_MEASUREMENT AEB_BrkArbResult /end REF_MEASUREMENT /end GROUP
/begin GROUP autosar_swc_aeb_autosar_swc_aeb_Step_sys_Compare_To_Constant8 "autosar_swc_aeb/autosar_swc_aeb_Step_sys/Compare\nTo Constant8" /begin REF_MEASUREMENT AEB_BrkArbResult /end REF_MEASUREMENT /end GROUP
/begin GROUP autosar_swc_aeb_autosar_swc_aeb_Step_sys_Counter_Limited "autosar_swc_aeb/autosar_swc_aeb_Step_sys/Counter\nLimited"
 /begin SUB_GROUP autosar_swc_aeb_autosar_swc_aeb_Step_sys_Counter_Limited_Increment_Real_World /end SUB_GROUP
 /begin REF_MEASUREMENT AEB_UpdateCnt autosar_swc_aeb_rtARID_DEF.Output_DSTATE_n /end REF_MEASUREMENT
/end GROUP
/begin GROUP autosar_swc_aeb_autosar_swc_aeb_Step_sys_Counter_Limited1 "autosar_swc_aeb/autosar_swc_aeb_Step_sys/Counter\nLimited1" /begin REF_MEASUREMENT autosar_swc_aeb_rtARID_DEF.Output_DSTATE /end REF_MEASUREMENT /end GROUP
/begin GROUP autosar_swc_aeb_autosar_swc_aeb_Step_sys_Counter_Limited_Increment_Real_World "autosar_swc_aeb/autosar_swc_aeb_Step_sys/Counter\nLimited/Increment\nReal World" /begin REF_MEASUREMENT AEB_UpdateCnt /end REF_MEASUREMENT /end GROUP
/begin GROUP autosar_swc_aeb_autosar_swc_aeb_Step_sys_FCW "autosar_swc_aeb/autosar_swc_aeb_Step_sys/FCW" /begin REF_CHARACTERISTIC P_AEB_StateConfirmTime P_AEB_StepTime /end REF_CHARACTERISTIC
 /begin REF_MEASUREMENT autosar_swc_aeb_rtARID_DEF.CoolOK autosar_swc_aeb_rtARID_DEF.Time_j autosar_swc_aeb_rtARID_DEF.UnitDelay1_DSTATE_k autosar_swc_aeb_rtARID_DEF.UnitDelay2_DSTATE_i autosar_swc_aeb_rtARID_DEF.UnitDelay_DSTATE_e1 autosar_swc_aeb_rtARID_DEF.is_active_c15_autosar_swc_aeb autosar_swc_aeb_rtARID_DEF.is_c15_autosar_swc_aeb /end REF_MEASUREMENT
/end GROUP
/begin GROUP autosar_swc_aeb_autosar_swc_aeb_Step_sys_For_Each_Subsystem "autosar_swc_aeb/autosar_swc_aeb_Step_sys/For Each\nSubsystem"
 /begin SUB_GROUP autosar_swc_aeb_autosar_swc_aeb_Step_sys_For_Each_Subsystem_CalculateHeading /end SUB_GROUP
/end GROUP
/begin GROUP autosar_swc_aeb_autosar_swc_aeb_Step_sys_For_Each_Subsystem_CalculateHeading "autosar_swc_aeb/autosar_swc_aeb_Step_sys/For Each\nSubsystem/CalculateHeading"
 /begin SUB_GROUP autosar_swc_aeb_autosar_swc_aeb_Step_sys_For_Each_Subsystem_CalculateHeading_CheckSpeed autosar_swc_aeb_autosar_swc_aeb_Step_sys_For_Each_Subsystem_CalculateHeading_ExtractVelocitiesAtStartOfSegments /end SUB_GROUP
/end GROUP
/begin GROUP autosar_swc_aeb_autosar_swc_aeb_Step_sys_For_Each_Subsystem_CalculateHeading_CheckSpeed "autosar_swc_aeb/autosar_swc_aeb_Step_sys/For Each\nSubsystem/CalculateHeading/CheckSpeed" /begin REF_CHARACTERISTIC CLTS_SpdThdInAsyEvlrCritEve_Ca /end REF_CHARACTERISTIC /end GROUP
/begin GROUP autosar_swc_aeb_autosar_swc_aeb_Step_sys_For_Each_Subsystem_CalculateHeading_ExtractVelocitiesAtStartOfSegments "autosar_swc_aeb/autosar_swc_aeb_Step_sys/For Each\nSubsystem/CalculateHeading/ExtractVelocitiesAtStartOfSegments"
 /begin SUB_GROUP autosar_swc_aeb_autosar_swc_aeb_Step_sys_For_Each_Subsystem_CalculateHeading_ExtractVelocitiesAtStartOfSegments_CheckSpeed /end SUB_GROUP
/end GROUP
/begin GROUP autosar_swc_aeb_autosar_swc_aeb_Step_sys_For_Each_Subsystem_CalculateHeading_ExtractVelocitiesAtStartOfSegments_CheckSpeed "autosar_swc_aeb/autosar_swc_aeb_Step_sys/For Each\nSubsystem/CalculateHeading/ExtractVelocitiesAtStartOfSegments/CheckSpeed" /begin REF_CHARACTERISTIC CLTS_SpdThdInAsyEvlrCritEve_Ca /end REF_CHARACTERISTIC /end GROUP
/begin GROUP autosar_swc_aeb_autosar_swc_aeb_Step_sys_Subsystem_Reference "autosar_swc_aeb/autosar_swc_aeb_Step_sys/Subsystem Reference"
 /begin SUB_GROUP autosar_swc_aeb_autosar_swc_aeb_Step_sys_Subsystem_Reference_AEB_Function autosar_swc_aeb_autosar_swc_aeb_Step_sys_Subsystem_Reference_AEB_SafetyFunctionUpdateCnt autosar_swc_aeb_autosar_swc_aeb_Step_sys_Subsystem_Reference_AM autosar_swc_aeb_autosar_swc_aeb_Step_sys_Subsystem_Reference_InputProcessor /end SUB_GROUP
 /begin REF_CHARACTERISTIC VP_Prm_CmnCalPrmForMinThdForALatAvl VP_Prm_DynCalPrmForAxleDstReToVehFrnt VP_Prm_DynCalPrmForBicycleMdlAxleDistFrnt VP_Prm_DynCalPrmForBicycleMdlCornrgStfnFrnt VP_Prm_DynCalPrmForBicycleMdlCornrgStfnRe VP_Prm_DynCalPrmForVehLen VP_Prm_DynCalPrmForVehM VP_Prm_DynCalPrmForVehSteerWhlAgRat VP_Prm_DynCalPrmForVehWhlBas VP_Prm_DynCalPrmForVehWidth /end REF_CHARACTERISTIC
 /begin REF_MEASUREMENT AEB_DecelRequestBrkArb AEB_SafetyFunctionVersion autosar_swc_aeb_rtARID_DEF.UnitDelay_DSTATE_ox /end REF_MEASUREMENT
/end GROUP
/begin GROUP autosar_swc_aeb_autosar_swc_aeb_Step_sys_Subsystem_Reference_AEB_Function "autosar_swc_aeb/autosar_swc_aeb_Step_sys/Subsystem Reference/AEB Function"
 /begin SUB_GROUP autosar_swc_aeb_autosar_swc_aeb_Step_sys_Subsystem_Reference_AEB_Function_Run_AsyEvlrCritEve_Step_Func autosar_swc_aeb_autosar_swc_aeb_Step_sys_Subsystem_Reference_AEB_Function_Run_CllsnFwdWarnCtrl_Step_Func autosar_swc_aeb_autosar_swc_aeb_Step_sys_Subsystem_Reference_AEB_Function_Run_CllsnRednByBrkgCtrl_Step_Func autosar_swc_aeb_autosar_swc_aeb_Step_sys_Subsystem_Reference_AEB_Function_Run_DrvrStEstimr_Step_Func autosar_swc_aeb_autosar_swc_aeb_Step_sys_Subsystem_Reference_AEB_Function_Sceniaro_Analysis /end SUB_GROUP
 /begin REF_MEASUREMENT AEB_TTC autosar_swc_aeb_rtARID_DEF.UnitDelay1_DSTATE_c /end REF_MEASUREMENT
/end GROUP
/begin GROUP autosar_swc_aeb_autosar_swc_aeb_Step_sys_Subsystem_Reference_AEB_Function_Run_AsyEvlrCritEve_Step_Func "autosar_swc_aeb/autosar_swc_aeb_Step_sys/Subsystem Reference/AEB Function/Run_AsyEvlrCritEve_Step_Func"
 /begin SUB_GROUP autosar_swc_aeb_autosar_swc_aeb_Step_sys_Subsystem_Reference_AEB_Function_Run_AsyEvlrCritEve_Step_Func_Run_AsyEvlrCritEve_Step_Func /end SUB_GROUP
 /begin REF_CHARACTERISTIC CLTS_DynCal_InpAdpr_AsySftyDecelEnadByVehDyn_Ca /end REF_CHARACTERISTIC
 /begin REF_MEASUREMENT AEB_ObjSelectVersion /end REF_MEASUREMENT
/end GROUP
/begin GROUP autosar_swc_aeb_autosar_swc_aeb_Step_sys_Subsystem_Reference_AEB_Function_Run_AsyEvlrCritEve_Step_Func_Run_AsyEvlrCritEve_Step_Func "autosar_swc_aeb/autosar_swc_aeb_Step_sys/Subsystem Reference/AEB Function/Run_AsyEvlrCritEve_Step_Func/Run_AsyEvlrCritEve_Step_Func"
 /begin SUB_GROUP autosar_swc_aeb_autosar_swc_aeb_Step_sys_Subsystem_Reference_AEB_Function_Run_AsyEvlrCritEve_Step_Func_Run_AsyEvlrCritEve_Step_Func_TAWrapper /end SUB_GROUP
/end GROUP
/begin GROUP autosar_swc_aeb_autosar_swc_aeb_Step_sys_Subsystem_Reference_AEB_Function_Run_AsyEvlrCritEve_Step_Func_Run_AsyEvlrCritEve_Step_Func_TAWrapper "autosar_swc_aeb/autosar_swc_aeb_Step_sys/Subsystem Reference/AEB Function/Run_AsyEvlrCritEve_Step_Func/Run_AsyEvlrCritEve_Step_Func/TAWrapper"
 /begin SUB_GROUP autosar_swc_aeb_autosar_swc_aeb_Step_sys_Subsystem_Reference_AEB_Function_Run_AsyEvlrCritEve_Step_Func_Run_AsyEvlrCritEve_Step_Func_TAWrapper_CreateDynCalPrmBus autosar_swc_aeb_autosar_swc_aeb_Step_sys_Subsystem_Reference_AEB_Function_Run_AsyEvlrCritEve_Step_Func_Run_AsyEvlrCritEve_Step_Func_TAWrapper_LongitudinalThreatAssessor autosar_swc_aeb_autosar_swc_aeb_Step_sys_Subsystem_Reference_AEB_Function_Run_AsyEvlrCritEve_Step_Func_Run_AsyEvlrCritEve_Step_Func_TAWrapper_PreProcessor /end SUB_GROUP
/end GROUP
/begin GROUP autosar_swc_aeb_autosar_swc_aeb_Step_sys_Subsystem_Reference_AEB_Function_Run_AsyEvlrCritEve_Step_Func_Run_AsyEvlrCritEve_Step_Func_TAWrapper_CreateDynCalPrmBus "autosar_swc_aeb/autosar_swc_aeb_Step_sys/Subsystem Reference/AEB Function/Run_AsyEvlrCritEve_Step_Func/Run_AsyEvlrCritEve_Step_Func/TAWrapper/CreateDynCalPrmBus"
 /begin REF_CHARACTERISTIC CLTS_MaxValForDynCalPrmForAxleDstReToVehFrntInAsyEvlrCritEve_Ca CLTS_MinValForDynCalPrmForVehLenInAsyEvlrCritEve_Ca /end REF_CHARACTERISTIC
/end GROUP
/begin GROUP autosar_swc_aeb_autosar_swc_aeb_Step_sys_Subsystem_Reference_AEB_Function_Run_AsyEvlrCritEve_Step_Func_Run_AsyEvlrCritEve_Step_Func_TAWrapper_LongitudinalThreatAssessor "autosar_swc_aeb/autosar_swc_aeb_Step_sys/Subsystem Reference/AEB Function/Run_AsyEvlrCritEve_Step_Func/Run_AsyEvlrCritEve_Step_Func/TAWrapper/LongitudinalThreatAssessor"
 /begin SUB_GROUP autosar_swc_aeb_autosar_swc_aeb_Step_sys_Subsystem_Reference_AEB_Function_Run_AsyEvlrCritEve_Step_Func_Run_AsyEvlrCritEve_Step_Func_TAWrapper_LongitudinalThreatAssessor_BrakeDelayEstimator autosar_swc_aeb_autosar_swc_aeb_Step_sys_Subsystem_Reference_AEB_Function_Run_AsyEvlrCritEve_Step_Func_Run_AsyEvlrCritEve_Step_Func_TAWrapper_LongitudinalThreatAssessor_LongitudinalThreatOutputSelector autosar_swc_aeb_autosar_swc_aeb_Step_sys_Subsystem_Reference_AEB_Function_Run_AsyEvlrCritEve_Step_Func_Run_AsyEvlrCritEve_Step_Func_TAWrapper_LongitudinalThreatAssessor_SingleTargetThreatAssessor autosar_swc_aeb_autosar_swc_aeb_Step_sys_Subsystem_Reference_AEB_Function_Run_AsyEvlrCritEve_Step_Func_Run_AsyEvlrCritEve_Step_Func_TAWrapper_LongitudinalThreatAssessor_ThreatAssessorForIntv autosar_swc_aeb_autosar_swc_aeb_Step_sys_Subsystem_Reference_AEB_Function_Run_AsyEvlrCritEve_Step_Func_Run_AsyEvlrCritEve_Step_Func_TAWrapper_LongitudinalThreatAssessor_ThreatAssessorForWarn /end SUB_GROUP
 /begin REF_CHARACTERISTIC CLTS_DrvrBrkgDlyDftInAsyEvlrCritEve_Ca /end REF_CHARACTERISTIC
/end GROUP
/begin GROUP autosar_swc_aeb_autosar_swc_aeb_Step_sys_Subsystem_Reference_AEB_Function_Run_AsyEvlrCritEve_Step_Func_Run_AsyEvlrCritEve_Step_Func_TAWrapper_LongitudinalThreatAssessor_BrakeDelayEstimator "autosar_swc_aeb/autosar_swc_aeb_Step_sys/Subsystem Reference/AEB Function/Run_AsyEvlrCritEve_Step_Func/Run_AsyEvlrCritEve_Step_Func/TAWrapper/LongitudinalThreatAssessor/BrakeDelayEstimator"
 /begin REF_CHARACTERISTIC CLTS_AForBrkDlyInAsyEvlrCritEve_Ca CLTS_BrkDlyInAsyEvlrCritEve_Ca CLTS_BrkDlyLowrValInAsyEvlrCritEve_Ca CLTS_BrkDlyUpprValInAsyEvlrCritEve_Ca CLTS_UseDynValInBrkDlyEstimnInAsyEvlrCritEve_Ca /end REF_CHARACTERISTIC
/end GROUP
/begin GROUP autosar_swc_aeb_autosar_swc_aeb_Step_sys_Subsystem_Reference_AEB_Function_Run_AsyEvlrCritEve_Step_Func_Run_AsyEvlrCritEve_Step_Func_TAWrapper_LongitudinalThreatAssessor_LongitudinalThreatOutputSelector "autosar_swc_aeb/autosar_swc_aeb_Step_sys/Subsystem Reference/AEB Function/Run_AsyEvlrCritEve_Step_Func/Run_AsyEvlrCritEve_Step_Func/TAWrapper/LongitudinalThreatAssessor/LongitudinalThreatOutputSelector"
 /begin SUB_GROUP autosar_swc_aeb_autosar_swc_aeb_Step_sys_Subsystem_Reference_AEB_Function_Run_AsyEvlrCritEve_Step_Func_Run_AsyEvlrCritEve_Step_Func_TAWrapper_LongitudinalThreatAssessor_LongitudinalThreatOutputSelector_ForIntv autosar_swc_aeb_autosar_swc_aeb_Step_sys_Subsystem_Reference_AEB_Function_Run_AsyEvlrCritEve_Step_Func_Run_AsyEvlrCritEve_Step_Func_TAWrapper_LongitudinalThreatAssessor_LongitudinalThreatOutputSelector_ForWarn /end SUB_GROUP
/end GROUP
/begin GROUP autosar_swc_aeb_autosar_swc_aeb_Step_sys_Subsystem_Reference_AEB_Function_Run_AsyEvlrCritEve_Step_Func_Run_AsyEvlrCritEve_Step_Func_TAWrapper_LongitudinalThreatAssessor_LongitudinalThreatOutputSelector_ForIntv "autosar_swc_aeb/autosar_swc_aeb_Step_sys/Subsystem Reference/AEB Function/Run_AsyEvlrCritEve_Step_Func/Run_AsyEvlrCritEve_Step_Func/TAWrapper/LongitudinalThreatAssessor/LongitudinalThreatOutputSelector/ForIntv"
 /begin SUB_GROUP autosar_swc_aeb_autosar_swc_aeb_Step_sys_Subsystem_Reference_AEB_Function_Run_AsyEvlrCritEve_Step_Func_Run_AsyEvlrCritEve_Step_Func_TAWrapper_LongitudinalThreatAssessor_LongitudinalThreatOutputSelector_ForIntv_DefaultValues autosar_swc_aeb_autosar_swc_aeb_Step_sys_Subsystem_Reference_AEB_Function_Run_AsyEvlrCritEve_Step_Func_Run_AsyEvlrCritEve_Step_Func_TAWrapper_LongitudinalThreatAssessor_LongitudinalThreatOutputSelector_ForIntv_PrimTarExtractor /end SUB_GROUP
/end GROUP
/begin GROUP autosar_swc_aeb_autosar_swc_aeb_Step_sys_Subsystem_Reference_AEB_Function_Run_AsyEvlrCritEve_Step_Func_Run_AsyEvlrCritEve_Step_Func_TAWrapper_LongitudinalThreatAssessor_SingleTargetThreatAssessor_PrimaryTargetForIntv_RequiredLongitudinalAccelerationComputerForIntv_PredictHostPositionAtTime_CalculateHeading_CheckSpeed "autosar_swc_aeb/autosar_swc_aeb_Step_sys/Subsystem Reference/AEB Function/Run_AsyEvlrCritEve_Step_Func/Run_AsyEvlrCritEve_Step_Func/TAWrapper/LongitudinalThreatAssessor/SingleTargetThreatAssessor/PrimaryTargetForIntv/RequiredLongitudinalAccelerationComputerForIntv/PredictHostPositionAtTime/CalculateHeading/CheckSpeed" /begin REF_CHARACTERISTIC CLTS_SpdThdInAsyEvlrCritEve_Ca /end REF_CHARACTERISTIC /end GROUP
/begin GROUP autosar_swc_aeb_autosar_swc_aeb_Step_sys_Subsystem_Reference_AEB_Function_Run_AsyEvlrCritEve_Step_Func_Run_AsyEvlrCritEve_Step_Func_TAWrapper_LongitudinalThreatAssessor_SingleTargetThreatAssessor_PrimaryTargetForIntv_RequiredLongitudinalAccelerationComputerForIntv_PredictHostPositionAtTime_CalculateHeading_ExtractVelocitiesAtStartOfSegments_CheckSpeed "autosar_swc_aeb/autosar_swc_aeb_Step_sys/Subsystem Reference/AEB Function/Run_AsyEvlrCritEve_Step_Func/Run_AsyEvlrCritEve_Step_Func/TAWrapper/LongitudinalThreatAssessor/SingleTargetThreatAssessor/PrimaryTargetForIntv/RequiredLongitudinalAccelerationComputerForIntv/PredictHostPositionAtTime/CalculateHeading/ExtractVelocitiesAtStartOfSegments/CheckSpeed" /begin REF_CHARACTERISTIC CLTS_SpdThdInAsyEvlrCritEve_Ca /end REF_CHARACTERISTIC /end GROUP
/begin GROUP autosar_swc_aeb_autosar_swc_aeb_Step_sys_Subsystem_Reference_AEB_Function_Run_AsyEvlrCritEve_Step_Func_Run_AsyEvlrCritEve_Step_Func_TAWrapper_LongitudinalThreatAssessor_SingleTargetThreatAssessor_PrimaryTargetForWarn_RequiredLongitudinalAccelerationComputerForWarn_PredictHostPositionAtTime_CalculateHeading_CheckSpeed "autosar_swc_aeb/autosar_swc_aeb_Step_sys/Subsystem Reference/AEB Function/Run_AsyEvlrCritEve_Step_Func/Run_AsyEvlrCritEve_Step_Func/TAWrapper/LongitudinalThreatAssessor/SingleTargetThreatAssessor/PrimaryTargetForWarn/RequiredLongitudinalAccelerationComputerForWarn/PredictHostPositionAtTime/CalculateHeading/CheckSpeed" /begin REF_CHARACTERISTIC CLTS_SpdThdInAsyEvlrCritEve_Ca /end REF_CHARACTERISTIC /end GROUP
/begin GROUP autosar_swc_aeb_autosar_swc_aeb_Step_sys_Subsystem_Reference_AEB_Function_Run_AsyEvlrCritEve_Step_Func_Run_AsyEvlrCritEve_Step_Func_TAWrapper_LongitudinalThreatAssessor_SingleTargetThreatAssessor_PrimaryTargetForWarn_RequiredLongitudinalAccelerationComputerForWarn_PredictHostPositionAtTime_CalculateHeading_ExtractVelocitiesAtStartOfSegments_CheckSpeed "autosar_swc_aeb/autosar_swc_aeb_Step_sys/Subsystem Reference/AEB Function/Run_AsyEvlrCritEve_Step_Func/Run_AsyEvlrCritEve_Step_Func/TAWrapper/LongitudinalThreatAssessor/SingleTargetThreatAssessor/PrimaryTargetForWarn/RequiredLongitudinalAccelerationComputerForWarn/PredictHostPositionAtTime/CalculateHeading/ExtractVelocitiesAtStartOfSegments/CheckSpeed" /begin REF_CHARACTERISTIC CLTS_SpdThdInAsyEvlrCritEve_Ca /end REF_CHARACTERISTIC /end GROUP
/begin GROUP autosar_swc_aeb_autosar_swc_aeb_Step_sys_Subsystem_Reference_AEB_Function_Run_AsyEvlrCritEve_Step_Func_Run_AsyEvlrCritEve_Step_Func_TAWrapper_LongitudinalThreatAssessor_ThreatAssessorForIntv_ThreatAssessor "autosar_swc_aeb/autosar_swc_aeb_Step_sys/Subsystem Reference/AEB Function/Run_AsyEvlrCritEve_Step_Func/Run_AsyEvlrCritEve_Step_Func/TAWrapper/LongitudinalThreatAssessor/ThreatAssessorForIntv/ThreatAssessor" /begin REF_MEASUREMENT autosar_swc_aeb_rtARID_DEF.Quotient /end REF_MEASUREMENT /end GROUP
/begin GROUP autosar_swc_aeb_autosar_swc_aeb_Step_sys_Subsystem_Reference_AEB_Function_Run_AsyEvlrCritEve_Step_Func_Run_AsyEvlrCritEve_Step_Func_TAWrapper_LongitudinalThreatAssessor_ThreatAssessorForIntv_ThreatAssessor_LTAPAssessor_CreateHostAndObjectData_CollectObjectData_ObjectWidthAndLength "autosar_swc_aeb/autosar_swc_aeb_Step_sys/Subsystem Reference/AEB Function/Run_AsyEvlrCritEve_Step_Func/Run_AsyEvlrCritEve_Step_Func/TAWrapper/LongitudinalThreatAssessor/ThreatAssessorForIntv/ThreatAssessor/LTAPAssessor/CreateHostAndObjectData/CollectObjectData/ObjectWidthAndLength" /begin REF_MEASUREMENT autosar_swc_aeb_rtARID_DEF.Quotient /end REF_MEASUREMENT /end GROUP
/begin GROUP autosar_swc_aeb_autosar_swc_aeb_Step_sys_Subsystem_Reference_AEB_Function_Run_AsyEvlrCritEve_Step_Func_Run_AsyEvlrCritEve_Step_Func_TAWrapper_LongitudinalThreatAssessor_ThreatAssessorForIntv_ThreatAssessor_LTAPAssessor_CreateHostAndObjectData_DetermineVehStDly "autosar_swc_aeb/autosar_swc_aeb_Step_sys/Subsystem Reference/AEB Function/Run_AsyEvlrCritEve_Step_Func/Run_AsyEvlrCritEve_Step_Func/TAWrapper/LongitudinalThreatAssessor/ThreatAssessorForIntv/ThreatAssessor/LTAPAssessor/CreateHostAndObjectData/DetermineVehStDly" /begin REF_CHARACTERISTIC CLTS_AForBrkDlyInAsyEvlrCritEve_Ca /end REF_CHARACTERISTIC /end GROUP
/begin GROUP autosar_swc_aeb_autosar_swc_aeb_Step_sys_Subsystem_Reference_AEB_Function_Run_AsyEvlrCritEve_Step_Func_Run_AsyEvlrCritEve_Step_Func_TAWrapper_LongitudinalThreatAssessor_ThreatAssessorForIntv_ThreatAssessor_LTAPAssessor_ThreatAssessment "autosar_swc_aeb/autosar_swc_aeb_Step_sys/Subsystem Reference/AEB Function/Run_AsyEvlrCritEve_Step_Func/Run_AsyEvlrCritEve_Step_Func/TAWrapper/LongitudinalThreatAssessor/ThreatAssessorForIntv/ThreatAssessor/LTAPAssessor/ThreatAssessment" /begin REF_MEASUREMENT autosar_swc_aeb_rtARID_DEF.Quotient /end REF_MEASUREMENT /end GROUP
/begin GROUP autosar_swc_aeb_autosar_swc_aeb_Step_sys_Subsystem_Reference_AEB_Function_Run_AsyEvlrCritEve_Step_Func_Run_AsyEvlrCritEve_Step_Func_TAWrapper_LongitudinalThreatAssessor_ThreatAssessorForIntv_ThreatAssessor_LTAPAssessor_ThreatAssessment_CreateObjectEdgesSteering_FindEdgePositionAtTimeAroundTTR_FindClosestEdgesAtTTI_PredictHostPosition_CalculateHeading_CheckSpeed "autosar_swc_aeb/autosar_swc_aeb_Step_sys/Subsystem Reference/AEB Function/Run_AsyEvlrCritEve_Step_Func/Run_AsyEvlrCritEve_Step_Func/TAWrapper/LongitudinalThreatAssessor/ThreatAssessorForIntv/ThreatAssessor/LTAPAssessor/ThreatAssessment/CreateObjectEdgesSteering/FindEdgePositionAtTimeAroundTTR/FindClosestEdgesAtTTI/PredictHostPosition/CalculateHeading/CheckSpeed" /begin REF_CHARACTERISTIC CLTS_SpdThdInAsyEvlrCritEve_Ca /end REF_CHARACTERISTIC /end GROUP
/begin GROUP autosar_swc_aeb_autosar_swc_aeb_Step_sys_Subsystem_Reference_AEB_Function_Run_AsyEvlrCritEve_Step_Func_Run_AsyEvlrCritEve_Step_Func_TAWrapper_LongitudinalThreatAssessor_ThreatAssessorForIntv_ThreatAssessor_LTAPAssessor_ThreatAssessment_CreateObjectEdgesSteering_FindEdgePositionAtTimeAroundTTR_FindClosestEdgesAtTTI_PredictHostPosition_CalculateHeading_ExtractVelocitiesAtStartOfSegments_CheckSpeed "autosar_swc_aeb/autosar_swc_aeb_Step_sys/Subsystem Reference/AEB Function/Run_AsyEvlrCritEve_Step_Func/Run_AsyEvlrCritEve_Step_Func/TAWrapper/LongitudinalThreatAssessor/ThreatAssessorForIntv/ThreatAssessor/LTAPAssessor/ThreatAssessment/CreateObjectEdgesSteering/FindEdgePositionAtTimeAroundTTR/FindClosestEdgesAtTTI/PredictHostPosition/CalculateHeading/ExtractVelocitiesAtStartOfSegments/CheckSpeed" /begin REF_CHARACTERISTIC CLTS_SpdThdInAsyEvlrCritEve_Ca /end REF_CHARACTERISTIC /end GROUP
/begin GROUP autosar_swc_aeb_autosar_swc_aeb_Step_sys_Subsystem_Reference_AEB_Function_Run_AsyEvlrCritEve_Step_Func_Run_AsyEvlrCritEve_Step_Func_TAWrapper_LongitudinalThreatAssessor_ThreatAssessorForWarn_ThreatAssessor_RequiredLongitudinalAccelerationForIntv_PredictHostPositionAtTime_CalculateHeading_CheckSpeed "autosar_swc_aeb/autosar_swc_aeb_Step_sys/Subsystem Reference/AEB Function/Run_AsyEvlrCritEve_Step_Func/Run_AsyEvlrCritEve_Step_Func/TAWrapper/LongitudinalThreatAssessor/ThreatAssessorForWarn/ThreatAssessor/RequiredLongitudinalAccelerationForIntv/PredictHostPositionAtTime/CalculateHeading/CheckSpeed" /begin REF_CHARACTERISTIC CLTS_SpdThdInAsyEvlrCritEve_Ca /end REF_CHARACTERISTIC /end GROUP
/begin GROUP autosar_swc_aeb_autosar_swc_aeb_Step_sys_Subsystem_Reference_AEB_Function_Run_AsyEvlrCritEve_Step_Func_Run_AsyEvlrCritEve_Step_Func_TAWrapper_LongitudinalThreatAssessor_ThreatAssessorForWarn_ThreatAssessor_RequiredLongitudinalAccelerationForIntv_PredictHostPositionAtTime_CalculateHeading_ExtractVelocitiesAtStartOfSegments_CheckSpeed "autosar_swc_aeb/autosar_swc_aeb_Step_sys/Subsystem Reference/AEB Function/Run_AsyEvlrCritEve_Step_Func/Run_AsyEvlrCritEve_Step_Func/TAWrapper/LongitudinalThreatAssessor/ThreatAssessorForWarn/ThreatAssessor/RequiredLongitudinalAccelerationForIntv/PredictHostPositionAtTime/CalculateHeading/ExtractVelocitiesAtStartOfSegments/CheckSpeed" /begin REF_CHARACTERISTIC CLTS_SpdThdInAsyEvlrCritEve_Ca /end REF_CHARACTERISTIC /end GROUP
/begin GROUP autosar_swc_aeb_autosar_swc_aeb_Step_sys_Subsystem_Reference_AEB_Function_Run_AsyEvlrCritEve_Step_Func_Run_AsyEvlrCritEve_Step_Func_TAWrapper_PreProcessor_FindIndicesOfValidFrontObjects_ObjUtilityAndInPath_ComputeUtilityAndInPath_DetermineInPath_PredictHostLateralPositionAtTTR_CalculateHeading_CheckSpeed "autosar_swc_aeb/autosar_swc_aeb_Step_sys/Subsystem Reference/AEB Function/Run_AsyEvlrCritEve_Step_Func/Run_AsyEvlrCritEve_Step_Func/TAWrapper/PreProcessor/FindIndicesOfValidFrontObjects/ObjUtilityAndInPath/ComputeUtilityAndInPath/DetermineInPath/PredictHostLateralPositionAtTTR/CalculateHeading/CheckSpeed" /begin REF_CHARACTERISTIC CLTS_SpdThdInAsyEvlrCritEve_Ca /end REF_CHARACTERISTIC /end GROUP
/begin GROUP autosar_swc_aeb_autosar_swc_aeb_Step_sys_Subsystem_Reference_AEB_Function_Run_AsyEvlrCritEve_Step_Func_Run_AsyEvlrCritEve_Step_Func_TAWrapper_PreProcessor_FindIndicesOfValidFrontObjects_ObjUtilityAndInPath_ComputeUtilityAndInPath_DetermineInPath_PredictHostLateralPositionAtTTR_CalculateHeading_ExtractVelocitiesAtStartOfSegments_CheckSpeed "autosar_swc_aeb/autosar_swc_aeb_Step_sys/Subsystem Reference/AEB Function/Run_AsyEvlrCritEve_Step_Func/Run_AsyEvlrCritEve_Step_Func/TAWrapper/PreProcessor/FindIndicesOfValidFrontObjects/ObjUtilityAndInPath/ComputeUtilityAndInPath/DetermineInPath/PredictHostLateralPositionAtTTR/CalculateHeading/ExtractVelocitiesAtStartOfSegments/CheckSpeed" /begin REF_CHARACTERISTIC CLTS_SpdThdInAsyEvlrCritEve_Ca /end REF_CHARACTERISTIC /end GROUP
/begin GROUP autosar_swc_aeb_autosar_swc_aeb_Step_sys_Subsystem_Reference_AEB_Function_Run_AsyEvlrCritEve_Step_Func_Run_AsyEvlrCritEve_Step_Func_TAWrapper_PreProcessor_ObjectPreProcessor_ObjectPreProcessorLoop "autosar_swc_aeb/autosar_swc_aeb_Step_sys/Subsystem Reference/AEB Function/Run_AsyEvlrCritEve_Step_Func/Run_AsyEvlrCritEve_Step_Func/TAWrapper/PreProcessor/ObjectPreProcessor/ObjectPreProcessorLoop" /begin REF_MEASUREMENT autosar_swc_aeb_rtARID_DEF.Assignment4 /end REF_MEASUREMENT /end GROUP
/begin GROUP autosar_swc_aeb_autosar_swc_aeb_Step_sys_Subsystem_Reference_AEB_Function_Run_AsyEvlrCritEve_Step_Func_Run_AsyEvlrCritEve_Step_Func_TAWrapper_PreProcessor_ObjectPreProcessor_ObjectPreProcessorLoop_ValidObject_SafetyMarginFrontObjects_InPathCalculationWithCurrentObjPositions_FindClosestCornerDistance_TransformCloseLeftToCurvedCoordSys "autosar_swc_aeb/autosar_swc_aeb_Step_sys/Subsystem Reference/AEB Function/Run_AsyEvlrCritEve_Step_Func/Run_AsyEvlrCritEve_Step_Func/TAWrapper/PreProcessor/ObjectPreProcessor/ObjectPreProcessorLoop/ValidObject/SafetyMarginFrontObjects/InPathCalculationWithCurrentObjPositions/FindClosestCornerDistance/TransformCloseLeftToCurvedCoordSys" /begin REF_MEASUREMENT autosar_swc_aeb_rtARID_DEF.Quotient /end REF_MEASUREMENT /end GROUP
/begin GROUP autosar_swc_aeb_autosar_swc_aeb_Step_sys_Subsystem_Reference_AEB_Function_Run_AsyEvlrCritEve_Step_Func_Run_AsyEvlrCritEve_Step_Func_TAWrapper_PreProcessor_ObjectPreProcessor_ObjectPreProcessorLoop_ValidObject_SafetyMarginFrontObjects_InPathCalculationWithCurrentObjPositions_FindClosestCornerDistance_TransformCloseRightToCurvedCoordSys "autosar_swc_aeb/autosar_swc_aeb_Step_sys/Subsystem Reference/AEB Function/Run_AsyEvlrCritEve_Step_Func/Run_AsyEvlrCritEve_Step_Func/TAWrapper/PreProcessor/ObjectPreProcessor/ObjectPreProcessorLoop/ValidObject/SafetyMarginFrontObjects/InPathCalculationWithCurrentObjPositions/FindClosestCornerDistance/TransformCloseRightToCurvedCoordSys" /begin REF_MEASUREMENT autosar_swc_aeb_rtARID_DEF.Quotient /end REF_MEASUREMENT /end GROUP
/begin GROUP autosar_swc_aeb_autosar_swc_aeb_Step_sys_Subsystem_Reference_AEB_Function_Run_AsyEvlrCritEve_Step_Func_Run_AsyEvlrCritEve_Step_Func_TAWrapper_PreProcessor_ObjectPreProcessor_ObjectPreProcessorLoop_ValidObject_SafetyMarginFrontObjects_InPathCalculationWithCurrentObjPositions_FindClosestCornerDistance_TransformRemoteLeftToCurvedCoordSys "autosar_swc_aeb/autosar_swc_aeb_Step_sys/Subsystem Reference/AEB Function/Run_AsyEvlrCritEve_Step_Func/Run_AsyEvlrCritEve_Step_Func/TAWrapper/PreProcessor/ObjectPreProcessor/ObjectPreProcessorLoop/ValidObject/SafetyMarginFrontObjects/InPathCalculationWithCurrentObjPositions/FindClosestCornerDistance/TransformRemoteLeftToCurvedCoordSys" /begin REF_MEASUREMENT autosar_swc_aeb_rtARID_DEF.Quotient /end REF_MEASUREMENT /end GROUP
/begin GROUP autosar_swc_aeb_autosar_swc_aeb_Step_sys_Subsystem_Reference_AEB_Function_Run_AsyEvlrCritEve_Step_Func_Run_AsyEvlrCritEve_Step_Func_TAWrapper_PreProcessor_ObjectPreProcessor_ObjectPreProcessorLoop_ValidObject_SafetyMarginFrontObjects_InPathCalculationWithCurrentObjPositions_FindClosestCornerDistance_TransformRemoteRightToCurvedCoordSys "autosar_swc_aeb/autosar_swc_aeb_Step_sys/Subsystem Reference/AEB Function/Run_AsyEvlrCritEve_Step_Func/Run_AsyEvlrCritEve_Step_Func/TAWrapper/PreProcessor/ObjectPreProcessor/ObjectPreProcessorLoop/ValidObject/SafetyMarginFrontObjects/InPathCalculationWithCurrentObjPositions/FindClosestCornerDistance/TransformRemoteRightToCurvedCoordSys" /begin REF_MEASUREMENT autosar_swc_aeb_rtARID_DEF.Quotient /end REF_MEASUREMENT /end GROUP
/begin GROUP autosar_swc_aeb_autosar_swc_aeb_Step_sys_Subsystem_Reference_AEB_Function_Run_AsyEvlrCritEve_Step_Func_Run_AsyEvlrCritEve_Step_Func_TAWrapper_PreProcessor_ObjectPreProcessor_ObjectPreProcessorLoop_ValidObject_SafetyMarginFrontObjects_InPathCalculationWithPredictedObjPositions_CreateInPathDataTTM_CalculateAccelerationAndPredictPosition_PredictHostLateralPositionAtTTR_CalculateHeading_CheckSpeed "autosar_swc_aeb/autosar_swc_aeb_Step_sys/Subsystem Reference/AEB Function/Run_AsyEvlrCritEve_Step_Func/Run_AsyEvlrCritEve_Step_Func/TAWrapper/PreProcessor/ObjectPreProcessor/ObjectPreProcessorLoop/ValidObject/SafetyMarginFrontObjects/InPathCalculationWithPredictedObjPositions/CreateInPathDataTTM/CalculateAccelerationAndPredictPosition/PredictHostLateralPositionAtTTR/CalculateHeading/CheckSpeed" /begin REF_CHARACTERISTIC CLTS_SpdThdInAsyEvlrCritEve_Ca /end REF_CHARACTERISTIC /end GROUP
/begin GROUP autosar_swc_aeb_autosar_swc_aeb_Step_sys_Subsystem_Reference_AEB_Function_Run_AsyEvlrCritEve_Step_Func_Run_AsyEvlrCritEve_Step_Func_TAWrapper_PreProcessor_ObjectPreProcessor_ObjectPreProcessorLoop_ValidObject_SafetyMarginFrontObjects_InPathCalculationWithPredictedObjPositions_CreateInPathDataTTM_CalculateAccelerationAndPredictPosition_PredictHostLateralPositionAtTTR_CalculateHeading_ExtractVelocitiesAtStartOfSegments_CheckSpeed "autosar_swc_aeb/autosar_swc_aeb_Step_sys/Subsystem Reference/AEB Function/Run_AsyEvlrCritEve_Step_Func/Run_AsyEvlrCritEve_Step_Func/TAWrapper/PreProcessor/ObjectPreProcessor/ObjectPreProcessorLoop/ValidObject/SafetyMarginFrontObjects/InPathCalculationWithPredictedObjPositions/CreateInPathDataTTM/CalculateAccelerationAndPredictPosition/PredictHostLateralPositionAtTTR/CalculateHeading/ExtractVelocitiesAtStartOfSegments/CheckSpeed" /begin REF_CHARACTERISTIC CLTS_SpdThdInAsyEvlrCritEve_Ca /end REF_CHARACTERISTIC /end GROUP
/begin GROUP autosar_swc_aeb_autosar_swc_aeb_Step_sys_Subsystem_Reference_AEB_Function_Run_AsyEvlrCritEve_Step_Func_Run_AsyEvlrCritEve_Step_Func_TAWrapper_PreProcessor_ObjectPreProcessor_ObjectPreProcessorLoop_ValidObject_SafetyMarginFrontObjects_InPathCalculationWithPredictedObjPositions_CreateInPathDataTTR_CalculateAccelerationAndPredictPosition_PredictHostLateralPositionAtTTR_CalculateHeading_CheckSpeed "autosar_swc_aeb/autosar_swc_aeb_Step_sys/Subsystem Reference/AEB Function/Run_AsyEvlrCritEve_Step_Func/Run_AsyEvlrCritEve_Step_Func/TAWrapper/PreProcessor/ObjectPreProcessor/ObjectPreProcessorLoop/ValidObject/SafetyMarginFrontObjects/InPathCalculationWithPredictedObjPositions/CreateInPathDataTTR/CalculateAccelerationAndPredictPosition/PredictHostLateralPositionAtTTR/CalculateHeading/CheckSpeed" /begin REF_CHARACTERISTIC CLTS_SpdThdInAsyEvlrCritEve_Ca /end REF_CHARACTERISTIC /end GROUP
/begin GROUP autosar_swc_aeb_autosar_swc_aeb_Step_sys_Subsystem_Reference_AEB_Function_Run_AsyEvlrCritEve_Step_Func_Run_AsyEvlrCritEve_Step_Func_TAWrapper_PreProcessor_ObjectPreProcessor_ObjectPreProcessorLoop_ValidObject_SafetyMarginFrontObjects_InPathCalculationWithPredictedObjPositions_CreateInPathDataTTR_CalculateAccelerationAndPredictPosition_PredictHostLateralPositionAtTTR_CalculateHeading_ExtractVelocitiesAtStartOfSegments_CheckSpeed "autosar_swc_aeb/autosar_swc_aeb_Step_sys/Subsystem Reference/AEB Function/Run_AsyEvlrCritEve_Step_Func/Run_AsyEvlrCritEve_Step_Func/TAWrapper/PreProcessor/ObjectPreProcessor/ObjectPreProcessorLoop/ValidObject/SafetyMarginFrontObjects/InPathCalculationWithPredictedObjPositions/CreateInPathDataTTR/CalculateAccelerationAndPredictPosition/PredictHostLateralPositionAtTTR/CalculateHeading/ExtractVelocitiesAtStartOfSegments/CheckSpeed" /begin REF_CHARACTERISTIC CLTS_SpdThdInAsyEvlrCritEve_Ca /end REF_CHARACTERISTIC /end GROUP
/begin GROUP autosar_swc_aeb_autosar_swc_aeb_Step_sys_Subsystem_Reference_AEB_Function_Run_AsyEvlrCritEve_Step_Func_Run_AsyEvlrCritEve_Step_Func_TAWrapper_PreProcessor_ObjectPreProcessor_ObjectPreProcessorLoop_ValidObject_SafetyMarginFrontObjects_PosnLatRelByCoordSysTransform "autosar_swc_aeb/autosar_swc_aeb_Step_sys/Subsystem Reference/AEB Function/Run_AsyEvlrCritEve_Step_Func/Run_AsyEvlrCritEve_Step_Func/TAWrapper/PreProcessor/ObjectPreProcessor/ObjectPreProcessorLoop/ValidObject/SafetyMarginFrontObjects/PosnLatRelByCoordSysTransform" /begin REF_MEASUREMENT autosar_swc_aeb_rtARID_DEF.Quotient /end REF_MEASUREMENT /end GROUP
/begin GROUP autosar_swc_aeb_autosar_swc_aeb_Step_sys_Subsystem_Reference_AEB_Function_Run_AsyEvlrCritEve_Step_Func_Run_AsyEvlrCritEve_Step_Func_TAWrapper_PreProcessor_ObjectPreProcessor_ObjectPreProcessorLoop_ValidObject_SafetyMarginFrontObjects_PosnLatRelByCoordSysTransform_TransformToCurvedCoordSys "autosar_swc_aeb/autosar_swc_aeb_Step_sys/Subsystem Reference/AEB Function/Run_AsyEvlrCritEve_Step_Func/Run_AsyEvlrCritEve_Step_Func/TAWrapper/PreProcessor/ObjectPreProcessor/ObjectPreProcessorLoop/ValidObject/SafetyMarginFrontObjects/PosnLatRelByCoordSysTransform/TransformToCurvedCoordSys" /begin REF_MEASUREMENT autosar_swc_aeb_rtARID_DEF.Quotient /end REF_MEASUREMENT /end GROUP
/begin GROUP autosar_swc_aeb_autosar_swc_aeb_Step_sys_Subsystem_Reference_AEB_Function_Run_AsyEvlrCritEve_Step_Func_Run_AsyEvlrCritEve_Step_Func_TAWrapper_PreProcessor_ObjectPreProcessor_ObjectPreProcessorLoop_ValidObject_Subsystem_For_Each_Subsystem_CalculateHeading_CheckSpeed "autosar_swc_aeb/autosar_swc_aeb_Step_sys/Subsystem Reference/AEB Function/Run_AsyEvlrCritEve_Step_Func/Run_AsyEvlrCritEve_Step_Func/TAWrapper/PreProcessor/ObjectPreProcessor/ObjectPreProcessorLoop/ValidObject/Subsystem/For Each\nSubsystem/CalculateHeading/CheckSpeed" /begin REF_CHARACTERISTIC CLTS_SpdThdInAsyEvlrCritEve_Ca /end REF_CHARACTERISTIC /end GROUP
/begin GROUP autosar_swc_aeb_autosar_swc_aeb_Step_sys_Subsystem_Reference_AEB_Function_Run_AsyEvlrCritEve_Step_Func_Run_AsyEvlrCritEve_Step_Func_TAWrapper_PreProcessor_ObjectPreProcessor_ObjectPreProcessorLoop_ValidObject_Subsystem_For_Each_Subsystem_CalculateHeading_ExtractVelocitiesAtStartOfSegments_CheckSpeed "autosar_swc_aeb/autosar_swc_aeb_Step_sys/Subsystem Reference/AEB Function/Run_AsyEvlrCritEve_Step_Func/Run_AsyEvlrCritEve_Step_Func/TAWrapper/PreProcessor/ObjectPreProcessor/ObjectPreProcessorLoop/ValidObject/Subsystem/For Each\nSubsystem/CalculateHeading/ExtractVelocitiesAtStartOfSegments/CheckSpeed" /begin REF_CHARACTERISTIC CLTS_SpdThdInAsyEvlrCritEve_Ca /end REF_CHARACTERISTIC /end GROUP
/begin GROUP autosar_swc_aeb_autosar_swc_aeb_Step_sys_Subsystem_Reference_AEB_Function_Run_AsyEvlrCritEve_Step_Func_Run_AsyEvlrCritEve_Step_Func_TAWrapper_PreProcessor_VehiclePreProcessor_SafeDivide1 "autosar_swc_aeb/autosar_swc_aeb_Step_sys/Subsystem Reference/AEB Function/Run_AsyEvlrCritEve_Step_Func/Run_AsyEvlrCritEve_Step_Func/TAWrapper/PreProcessor/VehiclePreProcessor/SafeDivide1" /begin REF_MEASUREMENT autosar_swc_aeb_rtARID_DEF.Quotient /end REF_MEASUREMENT /end GROUP
/begin GROUP autosar_swc_aeb_autosar_swc_aeb_Step_sys_Subsystem_Reference_AEB_Function_Run_CllsnFwdWarnCtrl_Step_Func_Run_CllsnFwdWarn_Step_FCW_InhibitConditions "autosar_swc_aeb/autosar_swc_aeb_Step_sys/Subsystem Reference/AEB Function/Run_CllsnFwdWarnCtrl_Step_Func/Run_CllsnFwdWarn_Step/FCW/InhibitConditions" /begin REF_MEASUREMENT AEB_SceniaroCheckisOK /end REF_MEASUREMENT /end GROUP
/begin GROUP autosar_swc_aeb_autosar_swc_aeb_Step_sys_Subsystem_Reference_AEB_Function_Run_CllsnFwdWarnCtrl_Step_Func_Run_CllsnFwdWarn_Step_FCW_WarningAndBrakeGainManager "autosar_swc_aeb/autosar_swc_aeb_Step_sys/Subsystem Reference/AEB Function/Run_CllsnFwdWarnCtrl_Step_Func/Run_CllsnFwdWarn_Step/FCW/WarningAndBrakeGainManager" /begin REF_MEASUREMENT autosar_swc_aeb_rtARID_DEF.Quotient /end REF_MEASUREMENT /end GROUP
/begin GROUP autosar_swc_aeb_autosar_swc_aeb_Step_sys_Subsystem_Reference_AEB_Function_Run_CllsnRednByBrkgCtrl_Step_Func_Run_CllsnRednByBrkg_Step_CollisionMitigationSystem_EvaluationCMbBInput_CritLgtEvaluation_Deactivate_HighTTCTime "autosar_swc_aeb/autosar_swc_aeb_Step_sys/Subsystem Reference/AEB Function/Run_CllsnRednByBrkgCtrl_Step_Func/Run_CllsnRednByBrkg_Step/CollisionMitigationSystem/EvaluationCMbBInput/CritLgtEvaluation/Deactivate/HighTTCTime" /begin REF_MEASUREMENT autosar_swc_aeb_rtARID_DEF.Quotient /end REF_MEASUREMENT /end GROUP
/begin GROUP autosar_swc_aeb_autosar_swc_aeb_Step_sys_Subsystem_Reference_AEB_Function_Run_CllsnRednByBrkgCtrl_Step_Func_Run_CllsnRednByBrkg_Step_CollisionMitigationSystem_EvaluationCMbBInput_CritLgtEvaluation_EvaluateFullBrakingConditions "autosar_swc_aeb/autosar_swc_aeb_Step_sys/Subsystem Reference/AEB Function/Run_CllsnRednByBrkgCtrl_Step_Func/Run_CllsnRednByBrkg_Step/CollisionMitigationSystem/EvaluationCMbBInput/CritLgtEvaluation/EvaluateFullBrakingConditions" /begin REF_MEASUREMENT AEB_SceniaroCheckisOK autosar_swc_aeb_rtARID_DEF.Quotient /end REF_MEASUREMENT /end GROUP
/begin GROUP autosar_swc_aeb_autosar_swc_aeb_Step_sys_Subsystem_Reference_AEB_Function_Run_CllsnRednByBrkgCtrl_Step_Func_Run_CllsnRednByBrkg_Step_CollisionMitigationSystem_EvaluationCMbBInput_CritLgtEvaluation_EvaluateFullBrakingConditions_BrakingThreat "autosar_swc_aeb/autosar_swc_aeb_Step_sys/Subsystem Reference/AEB Function/Run_CllsnRednByBrkgCtrl_Step_Func/Run_CllsnRednByBrkg_Step/CollisionMitigationSystem/EvaluationCMbBInput/CritLgtEvaluation/EvaluateFullBrakingConditions/BrakingThreat" /begin REF_MEASUREMENT autosar_swc_aeb_rtARID_DEF.Quotient /end REF_MEASUREMENT /end GROUP
/begin GROUP autosar_swc_aeb_autosar_swc_aeb_Step_sys_Subsystem_Reference_AEB_Function_Run_CllsnRednByBrkgCtrl_Step_Func_Run_CllsnRednByBrkg_Step_CollisionMitigationSystem_EvaluationCMbBInput_CritLgtEvaluation_EvaluatePreBrakingConditions "autosar_swc_aeb/autosar_swc_aeb_Step_sys/Subsystem Reference/AEB Function/Run_CllsnRednByBrkgCtrl_Step_Func/Run_CllsnRednByBrkg_Step/CollisionMitigationSystem/EvaluationCMbBInput/CritLgtEvaluation/EvaluatePreBrakingConditions"
 /begin REF_MEASUREMENT AEB_BrakingThreat AEB_SceniaroCheckisOK autosar_swc_aeb_rtARID_DEF.Quotient /end REF_MEASUREMENT
/end GROUP
/begin GROUP autosar_swc_aeb_autosar_swc_aeb_Step_sys_Subsystem_Reference_AEB_Function_Run_CllsnRednByBrkgCtrl_Step_Func_Run_CllsnRednByBrkg_Step_CollisionMitigationSystem_EvaluationCMbBInput_CritLgtEvaluation_EvaluatePreBrakingConditions_BrakingThreat "autosar_swc_aeb/autosar_swc_aeb_Step_sys/Subsystem Reference/AEB Function/Run_CllsnRednByBrkgCtrl_Step_Func/Run_CllsnRednByBrkg_Step/CollisionMitigationSystem/EvaluationCMbBInput/CritLgtEvaluation/EvaluatePreBrakingConditions/BrakingThreat" /begin REF_MEASUREMENT AEB_BrakingThreat autosar_swc_aeb_rtARID_DEF.Quotient /end REF_MEASUREMENT /end GROUP
/begin GROUP autosar_swc_aeb_autosar_swc_aeb_Step_sys_Subsystem_Reference_AEB_Function_Run_CllsnRednByBrkgCtrl_Step_Func_Run_CllsnRednByBrkg_Step_CollisionMitigationSystem_EvaluationCMbBInput_CritLgtEvaluation_Inhibit_Activation_OncomingInhibit_LTAPInhibit_IntegrateAngle "autosar_swc_aeb/autosar_swc_aeb_Step_sys/Subsystem Reference/AEB Function/Run_CllsnRednByBrkgCtrl_Step_Func/Run_CllsnRednByBrkg_Step/CollisionMitigationSystem/EvaluationCMbBInput/CritLgtEvaluation/Inhibit Activation/OncomingInhibit/LTAPInhibit/IntegrateAngle" /begin REF_CHARACTERISTIC P_AEB_StepTime /end REF_CHARACTERISTIC /end GROUP
/begin GROUP autosar_swc_aeb_autosar_swc_aeb_Step_sys_Subsystem_Reference_AEB_Function_Run_CllsnRednByBrkgCtrl_Step_Func_Run_CllsnRednByBrkg_Step_CollisionMitigationSystem_EvaluationCMbBInput_CritLgtEvaluation_Inhibit_Activation_OncomingInhibit_PreProcessor_CalculateCurrentCurvature "autosar_swc_aeb/autosar_swc_aeb_Step_sys/Subsystem Reference/AEB Function/Run_CllsnRednByBrkgCtrl_Step_Func/Run_CllsnRednByBrkg_Step/CollisionMitigationSystem/EvaluationCMbBInput/CritLgtEvaluation/Inhibit Activation/OncomingInhibit/PreProcessor/CalculateCurrentCurvature" /begin REF_MEASUREMENT autosar_swc_aeb_rtARID_DEF.Quotient /end REF_MEASUREMENT /end GROUP
/begin GROUP autosar_swc_aeb_autosar_swc_aeb_Step_sys_Subsystem_Reference_AEB_Function_Sceniaro_Analysis "autosar_swc_aeb/autosar_swc_aeb_Step_sys/Subsystem Reference/AEB Function/Sceniaro Analysis"
 /begin REF_MEASUREMENT AEB_HostCrvtSceniaro AEB_SceniaroCheckisOK AEB_SceniaroFlag autosar_swc_aeb_rtARID_DEF.Active autosar_swc_aeb_rtARID_DEF.ObjInitCrvtPosnLat autosar_swc_aeb_rtARID_DEF.Quotient /end REF_MEASUREMENT
/end GROUP
/begin GROUP autosar_swc_aeb_autosar_swc_aeb_Step_sys_Subsystem_Reference_AM_BrkArb "autosar_swc_aeb/autosar_swc_aeb_Step_sys/Subsystem Reference/AM/BrkArb" /begin REF_MEASUREMENT AEB_BrkArbResult /end REF_MEASUREMENT /end GROUP
/begin GROUP autosar_swc_aeb_autosar_swc_aeb_Step_sys_Subsystem_Reference_AM_BrkArb_AutnmsBrakingArb_SpeedLimitation "autosar_swc_aeb/autosar_swc_aeb_Step_sys/Subsystem Reference/AM/BrkArb/AutnmsBrakingArb/SpeedLimitation" /begin REF_CHARACTERISTIC P_AEB_StepTime /end REF_CHARACTERISTIC /end GROUP
/begin GROUP autosar_swc_aeb_autosar_swc_aeb_Step_sys_Subsystem_Reference_AM_BrkArb_SpeedLimitation "autosar_swc_aeb/autosar_swc_aeb_Step_sys/Subsystem Reference/AM/BrkArb/SpeedLimitation" /begin REF_CHARACTERISTIC P_AEB_StepTime /end REF_CHARACTERISTIC /end GROUP
/begin GROUP autosar_swc_aeb_autosar_swc_aeb_Step_sys_Subsystem_Reference_InputProcessor_ObjSignalProcess_For_Each_Subsystem "autosar_swc_aeb/autosar_swc_aeb_Step_sys/Subsystem Reference/InputProcessor/ObjSignalProcess/For Each\nSubsystem" /begin REF_CHARACTERISTIC P_AEB_StepTime /end REF_CHARACTERISTIC /begin REF_MEASUREMENT autosar_swc_aeb_rtARID_DEF.Quotient /end REF_MEASUREMENT /end GROUP
/begin RECORD_LAYOUT Record_BOOLEAN FNC_VALUES 1 UBYTE COLUMN_DIR DIRECT /end RECORD_LAYOUT
/begin RECORD_LAYOUT Record_FLOAT32_IEEE FNC_VALUES 1 FLOAT32_IEEE COLUMN_DIR DIRECT /end RECORD_LAYOUT
/begin RECORD_LAYOUT Axis_FLOAT32_IEEE AXIS_PTS_X 1 FLOAT32_IEEE INDEX_INCR DIRECT /end RECORD_LAYOUT
/begin RECORD_LAYOUT Record_BOOLEAN FNC_VALUES 1 UBYTE COLUMN_DIR DIRECT /end RECORD_LAYOUT
/begin RECORD_LAYOUT Record_FLOAT32_IEEE FNC_VALUES 1 FLOAT32_IEEE COLUMN_DIR DIRECT /end RECORD_LAYOUT
/begin FUNCTION autosar_swc_icas_IfActionSubsystem ""
 /begin IN_MEASUREMENT autosar_swc_icas_rtARID_DEF.UnitDelay1_DSTATE_bp autosar_swc_icas_rtARID_DEF.UnitDelay1_DSTATE_bp /end IN_MEASUREMENT
/end FUNCTION
/begin FUNCTION autosar_swc_icas_IfActionSubsystem1 "" /begin IN_MEASUREMENT autosar_swc_icas_rtARID_DEF.UnitDelay1_DSTATE_bp /end IN_MEASUREMENT /end FUNCTION
/begin RECORD_LAYOUT Record_BOOLEAN FNC_VALUES 1 UBYTE COLUMN_DIR DIRECT /end RECORD_LAYOUT
/begin RECORD_LAYOUT Record_FLOAT32_IEEE FNC_VALUES 1 FLOAT32_IEEE COLUMN_DIR DIRECT /end RECORD_LAYOUT
/begin RECORD_LAYOUT Axis_FLOAT32_IEEE AXIS_PTS_X 1 FLOAT32_IEEE INDEX_INCR DIRECT /end RECORD_LAYOUT
/begin FUNCTION autosar_swc_las_IfActionSubsystem ""
 /begin IN_MEASUREMENT autosar_swc_las_rtARID_DEF.UnitDelay1_DSTATE_g autosar_swc_las_rtARID_DEF.UnitDelay1_DSTATE_g /end IN_MEASUREMENT
/end FUNCTION
/begin FUNCTION autosar_swc_las_IfActionSubsystem1 "" /begin IN_MEASUREMENT autosar_swc_las_rtARID_DEF.UnitDelay1_DSTATE_g /end IN_MEASUREMENT /end FUNCTION
/begin FUNCTION autosar_swc_las_Subsystem ""
 /begin IN_MEASUREMENT autosar_swc_las_rtARID_DEF.mPrePointX_c autosar_swc_las_rtARID_DEF.mPrePointY_l /end IN_MEASUREMENT
/end FUNCTION
/begin FUNCTION autosar_swc_las_Subsystem1 ""
 /begin IN_MEASUREMENT autosar_swc_las_rtARID_DEF.mPrePointX_c autosar_swc_las_rtARID_DEF.mPrePointY_l /end IN_MEASUREMENT
/end FUNCTION
/begin RECORD_LAYOUT Record_BOOLEAN FNC_VALUES 1 UBYTE COLUMN_DIR DIRECT /end RECORD_LAYOUT
/begin RECORD_LAYOUT Record_FLOAT32_IEEE FNC_VALUES 1 FLOAT32_IEEE COLUMN_DIR DIRECT /end RECORD_LAYOUT
/begin RECORD_LAYOUT Axis_FLOAT32_IEEE AXIS_PTS_X 1 FLOAT32_IEEE INDEX_INCR DIRECT /end RECORD_LAYOUT
/begin RECORD_LAYOUT Record_BOOLEAN FNC_VALUES 1 UBYTE COLUMN_DIR DIRECT /end RECORD_LAYOUT
/begin RECORD_LAYOUT Record_FLOAT32_IEEE FNC_VALUES 1 FLOAT32_IEEE COLUMN_DIR DIRECT /end RECORD_LAYOUT
/begin RECORD_LAYOUT Axis_FLOAT32_IEEE AXIS_PTS_X 1 FLOAT32_IEEE INDEX_INCR DIRECT /end RECORD_LAYOUT
/begin FUNCTION autosar_swc_tos_IfActionSubsystem ""
 /begin IN_MEASUREMENT autosar_swc_tos_rtARID_DEF.UnitDelay1_DSTATE_o autosar_swc_tos_rtARID_DEF.UnitDelay1_DSTATE_o /end IN_MEASUREMENT
/end FUNCTION
/begin FUNCTION autosar_swc_tos_IfActionSubsystem1 "" /begin IN_MEASUREMENT autosar_swc_tos_rtARID_DEF.UnitDelay1_DSTATE_o /end IN_MEASUREMENT /end FUNCTION
/begin RECORD_LAYOUT Record_BOOLEAN FNC_VALUES 1 UBYTE COLUMN_DIR DIRECT /end RECORD_LAYOUT
/begin RECORD_LAYOUT Record_FLOAT32_IEEE FNC_VALUES 1 FLOAT32_IEEE COLUMN_DIR DIRECT /end RECORD_LAYOUT
/begin RECORD_LAYOUT Record_BOOLEAN FNC_VALUES 1 UBYTE COLUMN_DIR DIRECT /end RECORD_LAYOUT
/begin RECORD_LAYOUT Record_FLOAT32_IEEE FNC_VALUES 1 FLOAT32_IEEE COLUMN_DIR DIRECT /end RECORD_LAYOUT
/begin RECORD_LAYOUT Axis_FLOAT32_IEEE AXIS_PTS_X 1 FLOAT32_IEEE INDEX_INCR DIRECT /end RECORD_LAYOUT
/begin RECORD_LAYOUT Record_BOOLEAN FNC_VALUES 1 UBYTE COLUMN_DIR DIRECT /end RECORD_LAYOUT
/begin RECORD_LAYOUT Record_FLOAT32_IEEE FNC_VALUES 1 FLOAT32_IEEE COLUMN_DIR DIRECT /end RECORD_LAYOUT
/begin RECORD_LAYOUT Axis_FLOAT32_IEEE AXIS_PTS_X 1 FLOAT32_IEEE INDEX_INCR DIRECT /end RECORD_LAYOUT
/begin FUNCTION autosar_swc_vmp_CCNegAcceleBandCalc ""
 /begin IN_MEASUREMENT autosar_swc_vmp_rtARID_DEF.accelCCDes_ny autosar_swc_vmp_rtARID_DEF.upperBandCC_f autosar_swc_vmp_rtARID_DEF.lowerBandCC_a /end IN_MEASUREMENT
/end FUNCTION
/begin FUNCTION autosar_swc_vmp_CCPosAcceleBandCalc ""
 /begin IN_MEASUREMENT autosar_swc_vmp_rtARID_DEF.accelCCDes_n autosar_swc_vmp_rtARID_DEF.upperBandCC_m autosar_swc_vmp_rtARID_DEF.lowerBandCC_g /end IN_MEASUREMENT
/end FUNCTION
/begin FUNCTION autosar_swc_vmp_IfActionSubsystem ""
 /begin IN_MEASUREMENT autosar_swc_vmp_rtARID_DEF.UnitDelay1_DSTATE_n autosar_swc_vmp_rtARID_DEF.UnitDelay1_DSTATE_n /end IN_MEASUREMENT
/end FUNCTION
/begin FUNCTION autosar_swc_vmp_IfActionSubsystem1 "" /begin IN_MEASUREMENT autosar_swc_vmp_rtARID_DEF.UnitDelay1_DSTATE_n /end IN_MEASUREMENT /end FUNCTION
/begin FUNCTION autosar_swc_vmp_accelOffRampCalc ""
 /begin IN_MEASUREMENT autosar_swc_vmp_rtARID_DEF.distRamp2Cur_g autosar_swc_vmp_rtARID_DEF.StartVel_a autosar_swc_vmp_rtARID_DEF.EndVel_i autosar_swc_vmp_rtARID_DEF.accelOffRamp_oi /end IN_MEASUREMENT
/end FUNCTION
/begin FUNCTION autosar_swc_vmp_accelOffRampPosCalc ""
 /begin IN_MEASUREMENT autosar_swc_vmp_rtARID_DEF.velDelta_p autosar_swc_vmp_rtARID_DEF.accelOffRamp_ce /end IN_MEASUREMENT
/end FUNCTION
/begin FUNCTION autosar_swc_vmp_velDeltaCalc ""
 /begin IN_MEASUREMENT autosar_swc_vmp_rtARID_DEF.velOffRampLimit_a autosar_swc_vmp_rtARID_DEF.vehicleSpd_d autosar_swc_vmp_rtARID_DEF.velDelta_k /end IN_MEASUREMENT
/end FUNCTION
/begin RECORD_LAYOUT Record_BOOLEAN FNC_VALUES 1 UBYTE COLUMN_DIR DIRECT /end RECORD_LAYOUT
/begin RECORD_LAYOUT Record_FLOAT32_IEEE FNC_VALUES 1 FLOAT32_IEEE COLUMN_DIR DIRECT /end RECORD_LAYOUT
/begin RECORD_LAYOUT Axis_FLOAT32_IEEE AXIS_PTS_X 1 FLOAT32_IEEE INDEX_INCR DIRECT /end RECORD_LAYOUT
/begin RECORD_LAYOUT Record_BOOLEAN FNC_VALUES 1 UBYTE COLUMN_DIR DIRECT /end RECORD_LAYOUT
/begin RECORD_LAYOUT Record_FLOAT32_IEEE FNC_VALUES 1 FLOAT32_IEEE COLUMN_DIR DIRECT /end RECORD_LAYOUT
/begin RECORD_LAYOUT Axis_FLOAT32_IEEE AXIS_PTS_X 1 FLOAT32_IEEE INDEX_INCR DIRECT /end RECORD_LAYOUT
/end MODULE
/end PROJECT
