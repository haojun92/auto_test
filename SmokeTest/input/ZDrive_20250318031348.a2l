ASAP2_VERSION 1 71
/begin PROJECT ProjectName ""
/begin MODULE ModuleName ""
/begin MOD_COMMON "" BYTE_ORDER MSB_LAST ALIGNMENT_BYTE 1 ALIGNMENT_WORD 1 ALIGNMENT_LONG 1 ALIGNMENT_INT64 1 ALIGNMENT_FLOAT16_IEEE 1 ALIGNMENT_FLOAT32_IEEE 1 ALIGNMENT_FLOAT64_IEEE 1 /end MOD_COMMON
/begin RECORD_LAYOUT Scalar_SWORD FNC_VALUES 1 SWORD COLUMN_DIR DIRECT /end RECORD_LAYOUT
/begin MEASUREMENT SwcIn_J3_LANE.Left_Out_Lane.LaneConfidence "" UBYTE autosar_swc_val_CM_uint8 0 0 0 255 ECU_ADDRESS 0xfe4cad18 /* @ECU_Address@SwcIn_J3_LANE.Left_Out_Lane.LaneConfidence@ */ /end MEASUREMENT
/begin MEASUREMENT SwcIn_J3_LANE.Left_Out_Lane.LaneCrossing "" UBYTE autosar_swc_val_CM_uint8 0 0 0 255 ECU_ADDRESS 0xfe4cad1d /* @ECU_Address@SwcIn_J3_LANE.Left_Out_Lane.LaneCrossing@ */ /end MEASUREMENT
/begin MEASUREMENT SwcIn_J3_LANE.Left_Out_Lane.LaneExtraFarPointPosX "" FLOAT32_IEEE autosar_swc_val_CM_single 0 0 -3.4E+38 3.4E+38 ECU_ADDRESS 0xfe4cad48 /* @ECU_Address@SwcIn_J3_LANE.Left_Out_Lane.LaneExtraFarPointPosX@ */ /end MEASUREMENT
/begin MEASUREMENT SwcIn_J3_LANE.Left_Out_Lane.LaneExtraFarPointPosY "" FLOAT32_IEEE autosar_swc_val_CM_single 0 0 -3.4E+38 3.4E+38 ECU_ADDRESS 0xfe4cad4c /* @ECU_Address@SwcIn_J3_LANE.Left_Out_Lane.LaneExtraFarPointPosY@ */ /end MEASUREMENT
/begin MEASUREMENT SwcIn_J3_LANE.Left_Out_Lane.LaneExtraFarPointType "" UBYTE autosar_swc_val_CM_uint8 0 0 0 255 ECU_ADDRESS 0xfe4cad20 /* @ECU_Address@SwcIn_J3_LANE.Left_Out_Lane.LaneExtraFarPointType@ */ /end MEASUREMENT
/begin MEASUREMENT SwcIn_J3_LANE.Left_Out_Lane.LaneExtraNearPointPosX "" FLOAT32_IEEE autosar_swc_val_CM_single 0 0 -3.4E+38 3.4E+38 ECU_ADDRESS 0xfe4cad50 /* @ECU_Address@SwcIn_J3_LANE.Left_Out_Lane.LaneExtraNearPointPosX@ */ /end MEASUREMENT
/begin MEASUREMENT SwcIn_J3_LANE.Left_Out_Lane.LaneExtraNearPointPosY "" FLOAT32_IEEE autosar_swc_val_CM_single 0 0 -3.4E+38 3.4E+38 ECU_ADDRESS 0xfe4cad54 /* @ECU_Address@SwcIn_J3_LANE.Left_Out_Lane.LaneExtraNearPointPosY@ */ /end MEASUREMENT
/begin MEASUREMENT SwcIn_J3_LANE.Left_Out_Lane.LaneExtraNearPointType "" UBYTE autosar_swc_val_CM_uint8 0 0 0 255 ECU_ADDRESS 0xfe4cad1f /* @ECU_Address@SwcIn_J3_LANE.Left_Out_Lane.LaneExtraNearPointType@ */ /end MEASUREMENT
/begin MEASUREMENT SwcIn_J3_LANE.Left_Out_Lane.LaneMarkColor "" UBYTE autosar_swc_val_CM_uint8 0 0 0 255 ECU_ADDRESS 0xfe4cad1b /* @ECU_Address@SwcIn_J3_LANE.Left_Out_Lane.LaneMarkColor@ */ /end MEASUREMENT
/begin MEASUREMENT SwcIn_J3_LANE.Left_Out_Lane.LaneMeasuringStatus "" UBYTE autosar_swc_val_CM_uint8 0 0 0 255 ECU_ADDRESS 0xfe4cad19 /* @ECU_Address@SwcIn_J3_LANE.Left_Out_Lane.LaneMeasuringStatus@ */ /end MEASUREMENT
/begin MEASUREMENT SwcIn_J3_LANE.Left_Out_Lane.LaneModelC0 "" FLOAT32_IEEE autosar_swc_val_CM_single 0 0 -3.4E+38 3.4E+38 ECU_ADDRESS 0xfe4cad34 /* @ECU_Address@SwcIn_J3_LANE.Left_Out_Lane.LaneModelC0@ */ /end MEASUREMENT
/begin MEASUREMENT SwcIn_J3_LANE.Left_Out_Lane.LaneModelC1 "" FLOAT32_IEEE autosar_swc_val_CM_single 0 0 -3.4E+38 3.4E+38 ECU_ADDRESS 0xfe4cad38 /* @ECU_Address@SwcIn_J3_LANE.Left_Out_Lane.LaneModelC1@ */ /end MEASUREMENT
/begin MEASUREMENT SwcIn_J3_LANE.Left_Out_Lane.LaneModelC2 "" FLOAT32_IEEE autosar_swc_val_CM_single 0 0 -3.4E+38 3.4E+38 ECU_ADDRESS 0xfe4cad3c /* @ECU_Address@SwcIn_J3_LANE.Left_Out_Lane.LaneModelC2@ */ /end MEASUREMENT
/begin MEASUREMENT SwcIn_J3_LANE.Left_Out_Lane.LaneModelC3 "" FLOAT32_IEEE autosar_swc_val_CM_single 0 0 -3.4E+38 3.4E+38 ECU_ADDRESS 0xfe4cad40 /* @ECU_Address@SwcIn_J3_LANE.Left_Out_Lane.LaneModelC3@ */ /end MEASUREMENT
/begin MEASUREMENT SwcIn_J3_LANE.Left_Out_Lane.LaneParsingConfidence "" UBYTE autosar_swc_val_CM_uint8 0 0 0 255 ECU_ADDRESS 0xfe4cad21 /* @ECU_Address@SwcIn_J3_LANE.Left_Out_Lane.LaneParsingConfidence@ */ /end MEASUREMENT
/begin MEASUREMENT SwcIn_J3_LANE.Left_Out_Lane.LaneQuality "" UBYTE autosar_swc_val_CM_uint8 0 0 0 255 ECU_ADDRESS 0xfe4cad1c /* @ECU_Address@SwcIn_J3_LANE.Left_Out_Lane.LaneQuality@ */ /end MEASUREMENT
/begin MEASUREMENT SwcIn_J3_LANE.Left_Out_Lane.LaneTLC "" FLOAT32_IEEE autosar_swc_val_CM_single 0 0 -3.4E+38 3.4E+38 ECU_ADDRESS 0xfe4cad44 /* @ECU_Address@SwcIn_J3_LANE.Left_Out_Lane.LaneTLC@ */ /end MEASUREMENT
/begin MEASUREMENT SwcIn_J3_LANE.Left_Out_Lane.LaneTrackID "" UWORD autosar_swc_val_CM_uint16 0 0 0 65535 ECU_ADDRESS 0xfe4cad24 /* @ECU_Address@SwcIn_J3_LANE.Left_Out_Lane.LaneTrackID@ */ /end MEASUREMENT
/begin MEASUREMENT SwcIn_J3_LANE.Left_Out_Lane.LaneTypeClass "" UBYTE autosar_swc_val_CM_uint8 0 0 0 255 ECU_ADDRESS 0xfe4cad1a /* @ECU_Address@SwcIn_J3_LANE.Left_Out_Lane.LaneTypeClass@ */ /end MEASUREMENT
/begin MEASUREMENT SwcIn_J3_LANE.Left_Out_Lane.LaneViewRangeEnd "" FLOAT32_IEEE autosar_swc_val_CM_single 0 0 -3.4E+38 3.4E+38 ECU_ADDRESS 0xfe4cad30 /* @ECU_Address@SwcIn_J3_LANE.Left_Out_Lane.LaneViewRangeEnd@ */ /end MEASUREMENT
/begin MEASUREMENT SwcIn_J3_LANE.Left_Out_Lane.LaneViewRangeStart "" FLOAT32_IEEE autosar_swc_val_CM_single 0 0 -3.4E+38 3.4E+38 ECU_ADDRESS 0xfe4cad2c /* @ECU_Address@SwcIn_J3_LANE.Left_Out_Lane.LaneViewRangeStart@ */ /end MEASUREMENT
/begin MEASUREMENT SwcIn_J3_LANE.Left_Out_Lane.LaneWidthMarking "" FLOAT32_IEEE autosar_swc_val_CM_single 0 0 -3.4E+38 3.4E+38 ECU_ADDRESS 0xfe4cad28 /* @ECU_Address@SwcIn_J3_LANE.Left_Out_Lane.LaneWidthMarking@ */ /end MEASUREMENT
/begin MEASUREMENT SwcIn_J3_LANE.Left_Out_Lane.ObstacleFlag "" UBYTE autosar_swc_val_CM_uint8 0 0 0 255 ECU_ADDRESS 0xfe4cad1e /* @ECU_Address@SwcIn_J3_LANE.Left_Out_Lane.ObstacleFlag@ */ /end MEASUREMENT
/begin MEASUREMENT SwcIn_J3_LANE.Left_Out_Lane.Stopline_Relevancy "" UBYTE autosar_swc_val_CM_uint8 0 0 0 255 ECU_ADDRESS 0xfe4cad22 /* @ECU_Address@SwcIn_J3_LANE.Left_Out_Lane.Stopline_Relevancy@ */ /end MEASUREMENT
/begin MEASUREMENT SwcIn_J3_LANE.Left_Road_Edge.LaneConfidence "" UBYTE autosar_swc_val_CM_uint8 0 0 0 255 ECU_ADDRESS 0xfe4cad98 /* @ECU_Address@SwcIn_J3_LANE.Left_Road_Edge.LaneConfidence@ */ /end MEASUREMENT
/begin MEASUREMENT SwcIn_J3_LANE.Left_Road_Edge.LaneExtraFarPointPosX "" FLOAT32_IEEE autosar_swc_val_CM_single 0 0 -3.4E+38 3.4E+38 ECU_ADDRESS 0xfe4cadc4 /* @ECU_Address@SwcIn_J3_LANE.Left_Road_Edge.LaneExtraFarPointPosX@ */ /end MEASUREMENT
/begin MEASUREMENT SwcIn_J3_LANE.Left_Road_Edge.LaneExtraFarPointPosY "" FLOAT32_IEEE autosar_swc_val_CM_single 0 0 -3.4E+38 3.4E+38 ECU_ADDRESS 0xfe4cadc8 /* @ECU_Address@SwcIn_J3_LANE.Left_Road_Edge.LaneExtraFarPointPosY@ */ /end MEASUREMENT
/begin MEASUREMENT SwcIn_J3_LANE.Left_Road_Edge.LaneExtraFarPointType "" UBYTE autosar_swc_val_CM_uint8 0 0 0 255 ECU_ADDRESS 0xfe4cad9f /* @ECU_Address@SwcIn_J3_LANE.Left_Road_Edge.LaneExtraFarPointType@ */ /end MEASUREMENT
/begin MEASUREMENT SwcIn_J3_LANE.Left_Road_Edge.LaneExtraNearPointPosX "" FLOAT32_IEEE autosar_swc_val_CM_single 0 0 -3.4E+38 3.4E+38 ECU_ADDRESS 0xfe4cadcc /* @ECU_Address@SwcIn_J3_LANE.Left_Road_Edge.LaneExtraNearPointPosX@ */ /end MEASUREMENT
/begin MEASUREMENT SwcIn_J3_LANE.Left_Road_Edge.LaneExtraNearPointPosY "" FLOAT32_IEEE autosar_swc_val_CM_single 0 0 -3.4E+38 3.4E+38 ECU_ADDRESS 0xfe4cadd0 /* @ECU_Address@SwcIn_J3_LANE.Left_Road_Edge.LaneExtraNearPointPosY@ */ /end MEASUREMENT
/begin MEASUREMENT SwcIn_J3_LANE.Left_Road_Edge.LaneExtraNearPointType "" UBYTE autosar_swc_val_CM_uint8 0 0 0 255 ECU_ADDRESS 0xfe4cad9e /* @ECU_Address@SwcIn_J3_LANE.Left_Road_Edge.LaneExtraNearPointType@ */ /end MEASUREMENT
/begin MEASUREMENT SwcIn_J3_LANE.Left_Road_Edge.LaneMarkColor "" UBYTE autosar_swc_val_CM_uint8 0 0 0 255 ECU_ADDRESS 0xfe4cad9b /* @ECU_Address@SwcIn_J3_LANE.Left_Road_Edge.LaneMarkColor@ */ /end MEASUREMENT
/begin MEASUREMENT SwcIn_J3_LANE.Left_Road_Edge.LaneMeasuringStatus "" UBYTE autosar_swc_val_CM_uint8 0 0 0 255 ECU_ADDRESS 0xfe4cad99 /* @ECU_Address@SwcIn_J3_LANE.Left_Road_Edge.LaneMeasuringStatus@ */ /end MEASUREMENT
/begin MEASUREMENT SwcIn_J3_LANE.Left_Road_Edge.LaneModelC0 "" FLOAT32_IEEE autosar_swc_val_CM_single 0 0 -3.4E+38 3.4E+38 ECU_ADDRESS 0xfe4cadb0 /* @ECU_Address@SwcIn_J3_LANE.Left_Road_Edge.LaneModelC0@ */ /end MEASUREMENT
/begin MEASUREMENT SwcIn_J3_LANE.Left_Road_Edge.LaneModelC1 "" FLOAT32_IEEE autosar_swc_val_CM_single 0 0 -3.4E+38 3.4E+38 ECU_ADDRESS 0xfe4cadb4 /* @ECU_Address@SwcIn_J3_LANE.Left_Road_Edge.LaneModelC1@ */ /end MEASUREMENT
/begin MEASUREMENT SwcIn_J3_LANE.Left_Road_Edge.LaneModelC2 "" FLOAT32_IEEE autosar_swc_val_CM_single 0 0 -3.4E+38 3.4E+38 ECU_ADDRESS 0xfe4cadb8 /* @ECU_Address@SwcIn_J3_LANE.Left_Road_Edge.LaneModelC2@ */ /end MEASUREMENT
/begin MEASUREMENT SwcIn_J3_LANE.Left_Road_Edge.LaneModelC3 "" FLOAT32_IEEE autosar_swc_val_CM_single 0 0 -3.4E+38 3.4E+38 ECU_ADDRESS 0xfe4cadbc /* @ECU_Address@SwcIn_J3_LANE.Left_Road_Edge.LaneModelC3@ */ /end MEASUREMENT
/begin MEASUREMENT SwcIn_J3_LANE.Left_Road_Edge.LaneParsingConfidence "" UBYTE autosar_swc_val_CM_uint8 0 0 0 255 ECU_ADDRESS 0xfe4cada0 /* @ECU_Address@SwcIn_J3_LANE.Left_Road_Edge.LaneParsingConfidence@ */ /end MEASUREMENT
/begin MEASUREMENT SwcIn_J3_LANE.Left_Road_Edge.LaneQuality "" UBYTE autosar_swc_val_CM_uint8 0 0 0 255 ECU_ADDRESS 0xfe4cad9c /* @ECU_Address@SwcIn_J3_LANE.Left_Road_Edge.LaneQuality@ */ /end MEASUREMENT
/begin MEASUREMENT SwcIn_J3_LANE.Left_Road_Edge.LaneTLC "" FLOAT32_IEEE autosar_swc_val_CM_single 0 0 -3.4E+38 3.4E+38 ECU_ADDRESS 0xfe4cadc0 /* @ECU_Address@SwcIn_J3_LANE.Left_Road_Edge.LaneTLC@ */ /end MEASUREMENT
/begin MEASUREMENT SwcIn_J3_LANE.Left_Road_Edge.LaneTrackID "" UWORD autosar_swc_val_CM_uint16 0 0 0 65535 ECU_ADDRESS 0xfe4cada2 /* @ECU_Address@SwcIn_J3_LANE.Left_Road_Edge.LaneTrackID@ */ /end MEASUREMENT
/begin MEASUREMENT SwcIn_J3_LANE.Left_Road_Edge.LaneTypeClass "" UBYTE autosar_swc_val_CM_uint8 0 0 0 255 ECU_ADDRESS 0xfe4cad9a /* @ECU_Address@SwcIn_J3_LANE.Left_Road_Edge.LaneTypeClass@ */ /end MEASUREMENT
/begin MEASUREMENT SwcIn_J3_LANE.Left_Road_Edge.LaneViewRangeEnd "" FLOAT32_IEEE autosar_swc_val_CM_single 0 0 -3.4E+38 3.4E+38 ECU_ADDRESS 0xfe4cadac /* @ECU_Address@SwcIn_J3_LANE.Left_Road_Edge.LaneViewRangeEnd@ */ /end MEASUREMENT
/begin MEASUREMENT SwcIn_J3_LANE.Left_Road_Edge.LaneViewRangeStart "" FLOAT32_IEEE autosar_swc_val_CM_single 0 0 -3.4E+38 3.4E+38 ECU_ADDRESS 0xfe4cada8 /* @ECU_Address@SwcIn_J3_LANE.Left_Road_Edge.LaneViewRangeStart@ */ /end MEASUREMENT
/begin MEASUREMENT SwcIn_J3_LANE.Left_Road_Edge.LaneWidthMarking "" FLOAT32_IEEE autosar_swc_val_CM_single 0 0 -3.4E+38 3.4E+38 ECU_ADDRESS 0xfe4cada4 /* @ECU_Address@SwcIn_J3_LANE.Left_Road_Edge.LaneWidthMarking@ */ /end MEASUREMENT
/begin MEASUREMENT SwcIn_J3_LANE.Left_Road_Edge.ObstacleFlag "" UBYTE autosar_swc_val_CM_uint8 0 0 0 255 ECU_ADDRESS 0xfe4cad9d /* @ECU_Address@SwcIn_J3_LANE.Left_Road_Edge.ObstacleFlag@ */ /end MEASUREMENT
/begin MEASUREMENT SwcIn_J3_LANE.Left_Road_Edge.Stopline_Relevancy "" UBYTE autosar_swc_val_CM_uint8 0 0 0 255 ECU_ADDRESS 0xfe4cada1 /* @ECU_Address@SwcIn_J3_LANE.Left_Road_Edge.Stopline_Relevancy@ */ /end MEASUREMENT
/begin MEASUREMENT SwcIn_J3_LANE.LinePoints.linepoints[0].id "" ULONG autosar_swc_val_CM_uint32 0 0 0 4294967295 ECU_ADDRESS 0xfe4ca658 /* @ECU_Address@SwcIn_J3_LANE.LinePoints.linepoints[0].id@ */ /end MEASUREMENT
/begin MEASUREMENT SwcIn_J3_LANE.LinePoints.linepoints[0].point[0].point_x "" FLOAT64_IEEE autosar_swc_val_CM_double 0 0 -1.7E+308 1.7E+308 ECU_ADDRESS 0xfe4ca660 /* @ECU_Address@SwcIn_J3_LANE.LinePoints.linepoints[0].point[0].point_x@ */ /end MEASUREMENT
/begin MEASUREMENT SwcIn_J3_LANE.LinePoints.linepoints[0].point[0].point_y "" FLOAT64_IEEE autosar_swc_val_CM_double 0 0 -1.7E+308 1.7E+308 ECU_ADDRESS 0xfe4ca668 /* @ECU_Address@SwcIn_J3_LANE.LinePoints.linepoints[0].point[0].point_y@ */ /end MEASUREMENT
/begin MEASUREMENT SwcIn_J3_LANE.LinePoints.timestamp "" A_UINT64 autosar_swc_val_CM_uint64 0 0 0.0 1.844674407370955e+19 ECU_ADDRESS 0xfe4ca650 /* @ECU_Address@SwcIn_J3_LANE.LinePoints.timestamp@ */ /end MEASUREMENT
/begin MEASUREMENT SwcIn_J3_LANE.Right_Cone_Road_Edge.ConeRoadEdgeConfidence "" UBYTE autosar_swc_val_CM_uint8 0 0 0 255 ECU_ADDRESS 0xfe4ca500 /* @ECU_Address@SwcIn_J3_LANE.Right_Cone_Road_Edge.ConeRoadEdgeConfidence@ */ /end MEASUREMENT
/begin MEASUREMENT SwcIn_J3_LANE.Right_Cone_Road_Edge.ConeRoadEdgeMeasuringStatus "" UBYTE autosar_swc_val_CM_uint8 0 0 0 255 ECU_ADDRESS 0xfe4ca501 /* @ECU_Address@SwcIn_J3_LANE.Right_Cone_Road_Edge.ConeRoadEdgeMeasuringStatus@ */ /end MEASUREMENT
/begin MEASUREMENT SwcIn_J3_LANE.Right_Cone_Road_Edge.ConeRoadEdgeModelC0 "" FLOAT32_IEEE autosar_swc_val_CM_single 0 0 -3.4E+38 3.4E+38 ECU_ADDRESS 0xfe4ca510 /* @ECU_Address@SwcIn_J3_LANE.Right_Cone_Road_Edge.ConeRoadEdgeModelC0@ */ /end MEASUREMENT
/begin MEASUREMENT SwcIn_J3_LANE.Right_Cone_Road_Edge.ConeRoadEdgeModelC1 "" FLOAT32_IEEE autosar_swc_val_CM_single 0 0 -3.4E+38 3.4E+38 ECU_ADDRESS 0xfe4ca514 /* @ECU_Address@SwcIn_J3_LANE.Right_Cone_Road_Edge.ConeRoadEdgeModelC1@ */ /end MEASUREMENT
/begin MEASUREMENT SwcIn_J3_LANE.Right_Cone_Road_Edge.ConeRoadEdgeModelC2 "" FLOAT32_IEEE autosar_swc_val_CM_single 0 0 -3.4E+38 3.4E+38 ECU_ADDRESS 0xfe4ca518 /* @ECU_Address@SwcIn_J3_LANE.Right_Cone_Road_Edge.ConeRoadEdgeModelC2@ */ /end MEASUREMENT
/begin MEASUREMENT SwcIn_J3_LANE.Right_Cone_Road_Edge.ConeRoadEdgeModelC3 "" FLOAT32_IEEE autosar_swc_val_CM_single 0 0 -3.4E+38 3.4E+38 ECU_ADDRESS 0xfe4ca51c /* @ECU_Address@SwcIn_J3_LANE.Right_Cone_Road_Edge.ConeRoadEdgeModelC3@ */ /end MEASUREMENT
/begin MEASUREMENT SwcIn_J3_LANE.Right_Cone_Road_Edge.ConeRoadEdgeParsingConfidence "" UBYTE autosar_swc_val_CM_uint8 0 0 0 255 ECU_ADDRESS 0xfe4ca504 /* @ECU_Address@SwcIn_J3_LANE.Right_Cone_Road_Edge.ConeRoadEdgeParsingConfidence@ */ /end MEASUREMENT
/begin MEASUREMENT SwcIn_J3_LANE.Right_Cone_Road_Edge.ConeRoadEdgeQuality "" UBYTE autosar_swc_val_CM_uint8 0 0 0 255 ECU_ADDRESS 0xfe4ca503 /* @ECU_Address@SwcIn_J3_LANE.Right_Cone_Road_Edge.ConeRoadEdgeQuality@ */ /end MEASUREMENT
/begin MEASUREMENT SwcIn_J3_LANE.Right_Cone_Road_Edge.ConeRoadEdgeTLC "" FLOAT32_IEEE autosar_swc_val_CM_single 0 0 -3.4E+38 3.4E+38 ECU_ADDRESS 0xfe4ca520 /* @ECU_Address@SwcIn_J3_LANE.Right_Cone_Road_Edge.ConeRoadEdgeTLC@ */ /end MEASUREMENT
/begin MEASUREMENT SwcIn_J3_LANE.Right_Cone_Road_Edge.ConeRoadEdgeTrackID "" UWORD autosar_swc_val_CM_uint16 0 0 0 65535 ECU_ADDRESS 0xfe4ca506 /* @ECU_Address@SwcIn_J3_LANE.Right_Cone_Road_Edge.ConeRoadEdgeTrackID@ */ /end MEASUREMENT
/begin MEASUREMENT SwcIn_J3_LANE.Right_Cone_Road_Edge.ConeRoadEdgeTypeClass "" UBYTE autosar_swc_val_CM_uint8 0 0 0 255 ECU_ADDRESS 0xfe4ca502 /* @ECU_Address@SwcIn_J3_LANE.Right_Cone_Road_Edge.ConeRoadEdgeTypeClass@ */ /end MEASUREMENT
/begin MEASUREMENT SwcIn_J3_LANE.Right_Cone_Road_Edge.ConeRoadEdgeViewRangeEnd "" FLOAT32_IEEE autosar_swc_val_CM_single 0 0 -3.4E+38 3.4E+38 ECU_ADDRESS 0xfe4ca50c /* @ECU_Address@SwcIn_J3_LANE.Right_Cone_Road_Edge.ConeRoadEdgeViewRangeEnd@ */ /end MEASUREMENT
/begin MEASUREMENT SwcIn_J3_LANE.Right_Cone_Road_Edge.ConeRoadEdgeViewRangeStart "" FLOAT32_IEEE autosar_swc_val_CM_single 0 0 -3.4E+38 3.4E+38 ECU_ADDRESS 0xfe4ca508 /* @ECU_Address@SwcIn_J3_LANE.Right_Cone_Road_Edge.ConeRoadEdgeViewRangeStart@ */ /end MEASUREMENT
/begin MEASUREMENT SwcIn_J3_LANE.Right_LKA_Lane.LaneConfidence "" UBYTE autosar_swc_val_CM_uint8 0 0 0 255 ECU_ADDRESS 0xfe4ca610 /* @ECU_Address@SwcIn_J3_LANE.Right_LKA_Lane.LaneConfidence@ */ /end MEASUREMENT
/begin MEASUREMENT SwcIn_J3_LANE.Right_LKA_Lane.LaneCrossing "" UBYTE autosar_swc_val_CM_uint8 0 0 0 255 ECU_ADDRESS 0xfe4ca615 /* @ECU_Address@SwcIn_J3_LANE.Right_LKA_Lane.LaneCrossing@ */ /end MEASUREMENT
/begin MEASUREMENT SwcIn_J3_LANE.Right_LKA_Lane.LaneExtraFarPointPosX "" FLOAT32_IEEE autosar_swc_val_CM_single 0 0 -3.4E+38 3.4E+38 ECU_ADDRESS 0xfe4ca640 /* @ECU_Address@SwcIn_J3_LANE.Right_LKA_Lane.LaneExtraFarPointPosX@ */ /end MEASUREMENT
/begin MEASUREMENT SwcIn_J3_LANE.Right_LKA_Lane.LaneExtraFarPointPosY "" FLOAT32_IEEE autosar_swc_val_CM_single 0 0 -3.4E+38 3.4E+38 ECU_ADDRESS 0xfe4ca644 /* @ECU_Address@SwcIn_J3_LANE.Right_LKA_Lane.LaneExtraFarPointPosY@ */ /end MEASUREMENT
/begin MEASUREMENT SwcIn_J3_LANE.Right_LKA_Lane.LaneExtraFarPointType "" UBYTE autosar_swc_val_CM_uint8 0 0 0 255 ECU_ADDRESS 0xfe4ca618 /* @ECU_Address@SwcIn_J3_LANE.Right_LKA_Lane.LaneExtraFarPointType@ */ /end MEASUREMENT
/begin MEASUREMENT SwcIn_J3_LANE.Right_LKA_Lane.LaneExtraNearPointPosX "" FLOAT32_IEEE autosar_swc_val_CM_single 0 0 -3.4E+38 3.4E+38 ECU_ADDRESS 0xfe4ca648 /* @ECU_Address@SwcIn_J3_LANE.Right_LKA_Lane.LaneExtraNearPointPosX@ */ /end MEASUREMENT
/begin MEASUREMENT SwcIn_J3_LANE.Right_LKA_Lane.LaneExtraNearPointPosY "" FLOAT32_IEEE autosar_swc_val_CM_single 0 0 -3.4E+38 3.4E+38 ECU_ADDRESS 0xfe4ca64c /* @ECU_Address@SwcIn_J3_LANE.Right_LKA_Lane.LaneExtraNearPointPosY@ */ /end MEASUREMENT
/begin MEASUREMENT SwcIn_J3_LANE.Right_LKA_Lane.LaneExtraNearPointType "" UBYTE autosar_swc_val_CM_uint8 0 0 0 255 ECU_ADDRESS 0xfe4ca617 /* @ECU_Address@SwcIn_J3_LANE.Right_LKA_Lane.LaneExtraNearPointType@ */ /end MEASUREMENT
/begin MEASUREMENT SwcIn_J3_LANE.Right_LKA_Lane.LaneMarkColor "" UBYTE autosar_swc_val_CM_uint8 0 0 0 255 ECU_ADDRESS 0xfe4ca613 /* @ECU_Address@SwcIn_J3_LANE.Right_LKA_Lane.LaneMarkColor@ */ /end MEASUREMENT
/begin MEASUREMENT SwcIn_J3_LANE.Right_LKA_Lane.LaneMeasuringStatus "" UBYTE autosar_swc_val_CM_uint8 0 0 0 255 ECU_ADDRESS 0xfe4ca611 /* @ECU_Address@SwcIn_J3_LANE.Right_LKA_Lane.LaneMeasuringStatus@ */ /end MEASUREMENT
/begin MEASUREMENT SwcIn_J3_LANE.Right_LKA_Lane.LaneModelC0 "" FLOAT32_IEEE autosar_swc_val_CM_single 0 0 -3.4E+38 3.4E+38 ECU_ADDRESS 0xfe4ca62c /* @ECU_Address@SwcIn_J3_LANE.Right_LKA_Lane.LaneModelC0@ */ /end MEASUREMENT
/begin MEASUREMENT SwcIn_J3_LANE.Right_LKA_Lane.LaneModelC1 "" FLOAT32_IEEE autosar_swc_val_CM_single 0 0 -3.4E+38 3.4E+38 ECU_ADDRESS 0xfe4ca630 /* @ECU_Address@SwcIn_J3_LANE.Right_LKA_Lane.LaneModelC1@ */ /end MEASUREMENT
/begin MEASUREMENT SwcIn_J3_LANE.Right_LKA_Lane.LaneModelC2 "" FLOAT32_IEEE autosar_swc_val_CM_single 0 0 -3.4E+38 3.4E+38 ECU_ADDRESS 0xfe4ca634 /* @ECU_Address@SwcIn_J3_LANE.Right_LKA_Lane.LaneModelC2@ */ /end MEASUREMENT
/begin MEASUREMENT SwcIn_J3_LANE.Right_LKA_Lane.LaneModelC3 "" FLOAT32_IEEE autosar_swc_val_CM_single 0 0 -3.4E+38 3.4E+38 ECU_ADDRESS 0xfe4ca638 /* @ECU_Address@SwcIn_J3_LANE.Right_LKA_Lane.LaneModelC3@ */ /end MEASUREMENT
/begin MEASUREMENT SwcIn_J3_LANE.Right_LKA_Lane.LaneParsingConfidence "" UBYTE autosar_swc_val_CM_uint8 0 0 0 255 ECU_ADDRESS 0xfe4ca619 /* @ECU_Address@SwcIn_J3_LANE.Right_LKA_Lane.LaneParsingConfidence@ */ /end MEASUREMENT
/begin MEASUREMENT SwcIn_J3_LANE.Right_LKA_Lane.LaneQuality "" UBYTE autosar_swc_val_CM_uint8 0 0 0 255 ECU_ADDRESS 0xfe4ca614 /* @ECU_Address@SwcIn_J3_LANE.Right_LKA_Lane.LaneQuality@ */ /end MEASUREMENT
/begin MEASUREMENT SwcIn_J3_LANE.Right_LKA_Lane.LaneTLC "" FLOAT32_IEEE autosar_swc_val_CM_single 0 0 -3.4E+38 3.4E+38 ECU_ADDRESS 0xfe4ca63c /* @ECU_Address@SwcIn_J3_LANE.Right_LKA_Lane.LaneTLC@ */ /end MEASUREMENT
/begin MEASUREMENT SwcIn_J3_LANE.Right_LKA_Lane.LaneTrackID "" UWORD autosar_swc_val_CM_uint16 0 0 0 65535 ECU_ADDRESS 0xfe4ca61c /* @ECU_Address@SwcIn_J3_LANE.Right_LKA_Lane.LaneTrackID@ */ /end MEASUREMENT
/begin MEASUREMENT SwcIn_J3_LANE.Right_LKA_Lane.LaneTypeClass "" UBYTE autosar_swc_val_CM_uint8 0 0 0 255 ECU_ADDRESS 0xfe4ca612 /* @ECU_Address@SwcIn_J3_LANE.Right_LKA_Lane.LaneTypeClass@ */ /end MEASUREMENT
/begin MEASUREMENT SwcIn_J3_LANE.Right_LKA_Lane.LaneViewRangeEnd "" FLOAT32_IEEE autosar_swc_val_CM_single 0 0 -3.4E+38 3.4E+38 ECU_ADDRESS 0xfe4ca628 /* @ECU_Address@SwcIn_J3_LANE.Right_LKA_Lane.LaneViewRangeEnd@ */ /end MEASUREMENT
/begin MEASUREMENT SwcIn_J3_LANE.Right_LKA_Lane.LaneViewRangeStart "" FLOAT32_IEEE autosar_swc_val_CM_single 0 0 -3.4E+38 3.4E+38 ECU_ADDRESS 0xfe4ca624 /* @ECU_Address@SwcIn_J3_LANE.Right_LKA_Lane.LaneViewRangeStart@ */ /end MEASUREMENT
/begin MEASUREMENT SwcIn_J3_LANE.Right_LKA_Lane.LaneWidthMarking "" FLOAT32_IEEE autosar_swc_val_CM_single 0 0 -3.4E+38 3.4E+38 ECU_ADDRESS 0xfe4ca620 /* @ECU_Address@SwcIn_J3_LANE.Right_LKA_Lane.LaneWidthMarking@ */ /end MEASUREMENT
/begin MEASUREMENT SwcIn_J3_LANE.Right_LKA_Lane.ObstacleFlag "" UBYTE autosar_swc_val_CM_uint8 0 0 0 255 ECU_ADDRESS 0xfe4ca616 /* @ECU_Address@SwcIn_J3_LANE.Right_LKA_Lane.ObstacleFlag@ */ /end MEASUREMENT
/begin MEASUREMENT SwcIn_J3_LANE.Right_LKA_Lane.Stopline_Relevancy "" UBYTE autosar_swc_val_CM_uint8 0 0 0 255 ECU_ADDRESS 0xfe4ca61a /* @ECU_Address@SwcIn_J3_LANE.Right_LKA_Lane.Stopline_Relevancy@ */ /end MEASUREMENT
/begin MEASUREMENT SwcIn_J3_LANE.Right_Next_Lane.LaneConfidence "" UBYTE autosar_swc_val_CM_uint8 0 0 0 255 ECU_ADDRESS 0xfe4cace0 /* @ECU_Address@SwcIn_J3_LANE.Right_Next_Lane.LaneConfidence@ */ /end MEASUREMENT
/begin MEASUREMENT SwcIn_J3_LANE.Right_Next_Lane.LaneExtraFarPointPosX "" FLOAT32_IEEE autosar_swc_val_CM_single 0 0 -3.4E+38 3.4E+38 ECU_ADDRESS 0xfe4cad08 /* @ECU_Address@SwcIn_J3_LANE.Right_Next_Lane.LaneExtraFarPointPosX@ */ /end MEASUREMENT
/begin MEASUREMENT SwcIn_J3_LANE.Right_Next_Lane.LaneExtraFarPointPosY "" FLOAT32_IEEE autosar_swc_val_CM_single 0 0 -3.4E+38 3.4E+38 ECU_ADDRESS 0xfe4cad0c /* @ECU_Address@SwcIn_J3_LANE.Right_Next_Lane.LaneExtraFarPointPosY@ */ /end MEASUREMENT
/begin MEASUREMENT SwcIn_J3_LANE.Right_Next_Lane.LaneExtraFarPointType "" UBYTE autosar_swc_val_CM_uint8 0 0 0 255 ECU_ADDRESS 0xfe4cace7 /* @ECU_Address@SwcIn_J3_LANE.Right_Next_Lane.LaneExtraFarPointType@ */ /end MEASUREMENT
/begin MEASUREMENT SwcIn_J3_LANE.Right_Next_Lane.LaneExtraNearPointPosX "" FLOAT32_IEEE autosar_swc_val_CM_single 0 0 -3.4E+38 3.4E+38 ECU_ADDRESS 0xfe4cad10 /* @ECU_Address@SwcIn_J3_LANE.Right_Next_Lane.LaneExtraNearPointPosX@ */ /end MEASUREMENT
/begin MEASUREMENT SwcIn_J3_LANE.Right_Next_Lane.LaneExtraNearPointPosY "" FLOAT32_IEEE autosar_swc_val_CM_single 0 0 -3.4E+38 3.4E+38 ECU_ADDRESS 0xfe4cad14 /* @ECU_Address@SwcIn_J3_LANE.Right_Next_Lane.LaneExtraNearPointPosY@ */ /end MEASUREMENT
/begin MEASUREMENT SwcIn_J3_LANE.Right_Next_Lane.LaneExtraNearPointType "" UBYTE autosar_swc_val_CM_uint8 0 0 0 255 ECU_ADDRESS 0xfe4cace6 /* @ECU_Address@SwcIn_J3_LANE.Right_Next_Lane.LaneExtraNearPointType@ */ /end MEASUREMENT
/begin MEASUREMENT SwcIn_J3_LANE.Right_Next_Lane.LaneMarkColor "" UBYTE autosar_swc_val_CM_uint8 0 0 0 255 ECU_ADDRESS 0xfe4cace3 /* @ECU_Address@SwcIn_J3_LANE.Right_Next_Lane.LaneMarkColor@ */ /end MEASUREMENT
/begin MEASUREMENT SwcIn_J3_LANE.Right_Next_Lane.LaneMeasuringStatus "" UBYTE autosar_swc_val_CM_uint8 0 0 0 255 ECU_ADDRESS 0xfe4cace1 /* @ECU_Address@SwcIn_J3_LANE.Right_Next_Lane.LaneMeasuringStatus@ */ /end MEASUREMENT
/begin MEASUREMENT SwcIn_J3_LANE.Right_Next_Lane.LaneModelC0 "" FLOAT32_IEEE autosar_swc_val_CM_single 0 0 -3.4E+38 3.4E+38 ECU_ADDRESS 0xfe4cacf8 /* @ECU_Address@SwcIn_J3_LANE.Right_Next_Lane.LaneModelC0@ */ /end MEASUREMENT
/begin MEASUREMENT SwcIn_J3_LANE.Right_Next_Lane.LaneModelC1 "" FLOAT32_IEEE autosar_swc_val_CM_single 0 0 -3.4E+38 3.4E+38 ECU_ADDRESS 0xfe4cacfc /* @ECU_Address@SwcIn_J3_LANE.Right_Next_Lane.LaneModelC1@ */ /end MEASUREMENT
/begin MEASUREMENT SwcIn_J3_LANE.Right_Next_Lane.LaneModelC2 "" FLOAT32_IEEE autosar_swc_val_CM_single 0 0 -3.4E+38 3.4E+38 ECU_ADDRESS 0xfe4cad00 /* @ECU_Address@SwcIn_J3_LANE.Right_Next_Lane.LaneModelC2@ */ /end MEASUREMENT
/begin MEASUREMENT SwcIn_J3_LANE.Right_Next_Lane.LaneModelC3 "" FLOAT32_IEEE autosar_swc_val_CM_single 0 0 -3.4E+38 3.4E+38 ECU_ADDRESS 0xfe4cad04 /* @ECU_Address@SwcIn_J3_LANE.Right_Next_Lane.LaneModelC3@ */ /end MEASUREMENT
/begin MEASUREMENT SwcIn_J3_LANE.Right_Next_Lane.LaneParsingConfidence "" UBYTE autosar_swc_val_CM_uint8 0 0 0 255 ECU_ADDRESS 0xfe4cace8 /* @ECU_Address@SwcIn_J3_LANE.Right_Next_Lane.LaneParsingConfidence@ */ /end MEASUREMENT
/begin MEASUREMENT SwcIn_J3_LANE.Right_Next_Lane.LaneQuality "" UBYTE autosar_swc_val_CM_uint8 0 0 0 255 ECU_ADDRESS 0xfe4cace4 /* @ECU_Address@SwcIn_J3_LANE.Right_Next_Lane.LaneQuality@ */ /end MEASUREMENT
/begin MEASUREMENT SwcIn_J3_LANE.Right_Next_Lane.LaneTrackID "" UWORD autosar_swc_val_CM_uint16 0 0 0 65535 ECU_ADDRESS 0xfe4cacea /* @ECU_Address@SwcIn_J3_LANE.Right_Next_Lane.LaneTrackID@ */ /end MEASUREMENT
/begin MEASUREMENT SwcIn_J3_LANE.Right_Next_Lane.LaneTypeClass "" UBYTE autosar_swc_val_CM_uint8 0 0 0 255 ECU_ADDRESS 0xfe4cace2 /* @ECU_Address@SwcIn_J3_LANE.Right_Next_Lane.LaneTypeClass@ */ /end MEASUREMENT
/begin MEASUREMENT SwcIn_J3_LANE.Right_Next_Lane.LaneViewRangeEnd "" FLOAT32_IEEE autosar_swc_val_CM_single 0 0 -3.4E+38 3.4E+38 ECU_ADDRESS 0xfe4cacf4 /* @ECU_Address@SwcIn_J3_LANE.Right_Next_Lane.LaneViewRangeEnd@ */ /end MEASUREMENT
/begin MEASUREMENT SwcIn_J3_LANE.Right_Next_Lane.LaneViewRangeStart "" FLOAT32_IEEE autosar_swc_val_CM_single 0 0 -3.4E+38 3.4E+38 ECU_ADDRESS 0xfe4cacf0 /* @ECU_Address@SwcIn_J3_LANE.Right_Next_Lane.LaneViewRangeStart@ */ /end MEASUREMENT
/begin MEASUREMENT SwcIn_J3_LANE.Right_Next_Lane.LaneWidthMarking "" FLOAT32_IEEE autosar_swc_val_CM_single 0 0 -3.4E+38 3.4E+38 ECU_ADDRESS 0xfe4cacec /* @ECU_Address@SwcIn_J3_LANE.Right_Next_Lane.LaneWidthMarking@ */ /end MEASUREMENT
/begin MEASUREMENT SwcIn_J3_LANE.Right_Next_Lane.ObstacleFlag "" UBYTE autosar_swc_val_CM_uint8 0 0 0 255 ECU_ADDRESS 0xfe4cace5 /* @ECU_Address@SwcIn_J3_LANE.Right_Next_Lane.ObstacleFlag@ */ /end MEASUREMENT
/begin MEASUREMENT SwcIn_J3_LANE.Right_Out_Lane.LaneConfidence "" UBYTE autosar_swc_val_CM_uint8 0 0 0 255 ECU_ADDRESS 0xfe4cad58 /* @ECU_Address@SwcIn_J3_LANE.Right_Out_Lane.LaneConfidence@ */ /end MEASUREMENT
/begin MEASUREMENT SwcIn_J3_LANE.Right_Out_Lane.LaneCrossing "" UBYTE autosar_swc_val_CM_uint8 0 0 0 255 ECU_ADDRESS 0xfe4cad5d /* @ECU_Address@SwcIn_J3_LANE.Right_Out_Lane.LaneCrossing@ */ /end MEASUREMENT
/begin MEASUREMENT SwcIn_J3_LANE.Right_Out_Lane.LaneExtraFarPointPosX "" FLOAT32_IEEE autosar_swc_val_CM_single 0 0 -3.4E+38 3.4E+38 ECU_ADDRESS 0xfe4cad88 /* @ECU_Address@SwcIn_J3_LANE.Right_Out_Lane.LaneExtraFarPointPosX@ */ /end MEASUREMENT
/begin MEASUREMENT SwcIn_J3_LANE.Right_Out_Lane.LaneExtraFarPointPosY "" FLOAT32_IEEE autosar_swc_val_CM_single 0 0 -3.4E+38 3.4E+38 ECU_ADDRESS 0xfe4cad8c /* @ECU_Address@SwcIn_J3_LANE.Right_Out_Lane.LaneExtraFarPointPosY@ */ /end MEASUREMENT
/begin MEASUREMENT SwcIn_J3_LANE.Right_Out_Lane.LaneExtraFarPointType "" UBYTE autosar_swc_val_CM_uint8 0 0 0 255 ECU_ADDRESS 0xfe4cad60 /* @ECU_Address@SwcIn_J3_LANE.Right_Out_Lane.LaneExtraFarPointType@ */ /end MEASUREMENT
/begin MEASUREMENT SwcIn_J3_LANE.Right_Out_Lane.LaneExtraNearPointPosX "" FLOAT32_IEEE autosar_swc_val_CM_single 0 0 -3.4E+38 3.4E+38 ECU_ADDRESS 0xfe4cad90 /* @ECU_Address@SwcIn_J3_LANE.Right_Out_Lane.LaneExtraNearPointPosX@ */ /end MEASUREMENT
/begin MEASUREMENT SwcIn_J3_LANE.Right_Out_Lane.LaneExtraNearPointPosY "" FLOAT32_IEEE autosar_swc_val_CM_single 0 0 -3.4E+38 3.4E+38 ECU_ADDRESS 0xfe4cad94 /* @ECU_Address@SwcIn_J3_LANE.Right_Out_Lane.LaneExtraNearPointPosY@ */ /end MEASUREMENT
/begin MEASUREMENT SwcIn_J3_LANE.Right_Out_Lane.LaneExtraNearPointType "" UBYTE autosar_swc_val_CM_uint8 0 0 0 255 ECU_ADDRESS 0xfe4cad5f /* @ECU_Address@SwcIn_J3_LANE.Right_Out_Lane.LaneExtraNearPointType@ */ /end MEASUREMENT
/begin MEASUREMENT SwcIn_J3_LANE.Right_Out_Lane.LaneMarkColor "" UBYTE autosar_swc_val_CM_uint8 0 0 0 255 ECU_ADDRESS 0xfe4cad5b /* @ECU_Address@SwcIn_J3_LANE.Right_Out_Lane.LaneMarkColor@ */ /end MEASUREMENT
/begin MEASUREMENT SwcIn_J3_LANE.Right_Out_Lane.LaneMeasuringStatus "" UBYTE autosar_swc_val_CM_uint8 0 0 0 255 ECU_ADDRESS 0xfe4cad59 /* @ECU_Address@SwcIn_J3_LANE.Right_Out_Lane.LaneMeasuringStatus@ */ /end MEASUREMENT
/begin MEASUREMENT SwcIn_J3_LANE.Right_Out_Lane.LaneModelC0 "" FLOAT32_IEEE autosar_swc_val_CM_single 0 0 -3.4E+38 3.4E+38 ECU_ADDRESS 0xfe4cad74 /* @ECU_Address@SwcIn_J3_LANE.Right_Out_Lane.LaneModelC0@ */ /end MEASUREMENT
/begin MEASUREMENT SwcIn_J3_LANE.Right_Out_Lane.LaneModelC1 "" FLOAT32_IEEE autosar_swc_val_CM_single 0 0 -3.4E+38 3.4E+38 ECU_ADDRESS 0xfe4cad78 /* @ECU_Address@SwcIn_J3_LANE.Right_Out_Lane.LaneModelC1@ */ /end MEASUREMENT
/begin MEASUREMENT SwcIn_J3_LANE.Right_Out_Lane.LaneModelC2 "" FLOAT32_IEEE autosar_swc_val_CM_single 0 0 -3.4E+38 3.4E+38 ECU_ADDRESS 0xfe4cad7c /* @ECU_Address@SwcIn_J3_LANE.Right_Out_Lane.LaneModelC2@ */ /end MEASUREMENT
/begin MEASUREMENT SwcIn_J3_LANE.Right_Out_Lane.LaneModelC3 "" FLOAT32_IEEE autosar_swc_val_CM_single 0 0 -3.4E+38 3.4E+38 ECU_ADDRESS 0xfe4cad80 /* @ECU_Address@SwcIn_J3_LANE.Right_Out_Lane.LaneModelC3@ */ /end MEASUREMENT
/begin MEASUREMENT SwcIn_J3_LANE.Right_Out_Lane.LaneParsingConfidence "" UBYTE autosar_swc_val_CM_uint8 0 0 0 255 ECU_ADDRESS 0xfe4cad61 /* @ECU_Address@SwcIn_J3_LANE.Right_Out_Lane.LaneParsingConfidence@ */ /end MEASUREMENT
/begin MEASUREMENT SwcIn_J3_LANE.Right_Out_Lane.LaneQuality "" UBYTE autosar_swc_val_CM_uint8 0 0 0 255 ECU_ADDRESS 0xfe4cad5c /* @ECU_Address@SwcIn_J3_LANE.Right_Out_Lane.LaneQuality@ */ /end MEASUREMENT
/begin MEASUREMENT SwcIn_J3_LANE.Right_Out_Lane.LaneTLC "" FLOAT32_IEEE autosar_swc_val_CM_single 0 0 -3.4E+38 3.4E+38 ECU_ADDRESS 0xfe4cad84 /* @ECU_Address@SwcIn_J3_LANE.Right_Out_Lane.LaneTLC@ */ /end MEASUREMENT
/begin MEASUREMENT SwcIn_J3_LANE.Right_Out_Lane.LaneTrackID "" UWORD autosar_swc_val_CM_uint16 0 0 0 65535 ECU_ADDRESS 0xfe4cad64 /* @ECU_Address@SwcIn_J3_LANE.Right_Out_Lane.LaneTrackID@ */ /end MEASUREMENT
/begin MEASUREMENT SwcIn_J3_LANE.Right_Out_Lane.LaneTypeClass "" UBYTE autosar_swc_val_CM_uint8 0 0 0 255 ECU_ADDRESS 0xfe4cad5a /* @ECU_Address@SwcIn_J3_LANE.Right_Out_Lane.LaneTypeClass@ */ /end MEASUREMENT
/begin MEASUREMENT SwcIn_J3_LANE.Right_Out_Lane.LaneViewRangeEnd "" FLOAT32_IEEE autosar_swc_val_CM_single 0 0 -3.4E+38 3.4E+38 ECU_ADDRESS 0xfe4cad70 /* @ECU_Address@SwcIn_J3_LANE.Right_Out_Lane.LaneViewRangeEnd@ */ /end MEASUREMENT
/begin MEASUREMENT SwcIn_J3_LANE.Right_Out_Lane.LaneViewRangeStart "" FLOAT32_IEEE autosar_swc_val_CM_single 0 0 -3.4E+38 3.4E+38 ECU_ADDRESS 0xfe4cad6c /* @ECU_Address@SwcIn_J3_LANE.Right_Out_Lane.LaneViewRangeStart@ */ /end MEASUREMENT
/begin MEASUREMENT SwcIn_J3_LANE.Right_Out_Lane.LaneWidthMarking "" FLOAT32_IEEE autosar_swc_val_CM_single 0 0 -3.4E+38 3.4E+38 ECU_ADDRESS 0xfe4cad68 /* @ECU_Address@SwcIn_J3_LANE.Right_Out_Lane.LaneWidthMarking@ */ /end MEASUREMENT
/begin MEASUREMENT SwcIn_J3_LANE.Right_Out_Lane.ObstacleFlag "" UBYTE autosar_swc_val_CM_uint8 0 0 0 255 ECU_ADDRESS 0xfe4cad5e /* @ECU_Address@SwcIn_J3_LANE.Right_Out_Lane.ObstacleFlag@ */ /end MEASUREMENT
/begin MEASUREMENT SwcIn_J3_LANE.Right_Out_Lane.Stopline_Relevancy "" UBYTE autosar_swc_val_CM_uint8 0 0 0 255 ECU_ADDRESS 0xfe4cad62 /* @ECU_Address@SwcIn_J3_LANE.Right_Out_Lane.Stopline_Relevancy@ */ /end MEASUREMENT
/begin MEASUREMENT SwcIn_J3_LANE.Right_Road_Edge.LaneConfidence "" UBYTE autosar_swc_val_CM_uint8 0 0 0 255 ECU_ADDRESS 0xfe4cadd4 /* @ECU_Address@SwcIn_J3_LANE.Right_Road_Edge.LaneConfidence@ */ /end MEASUREMENT
/begin MEASUREMENT SwcIn_J3_LANE.Right_Road_Edge.LaneExtraFarPointPosX "" FLOAT32_IEEE autosar_swc_val_CM_single 0 0 -3.4E+38 3.4E+38 ECU_ADDRESS 0xfe4cae00 /* @ECU_Address@SwcIn_J3_LANE.Right_Road_Edge.LaneExtraFarPointPosX@ */ /end MEASUREMENT
/begin MEASUREMENT SwcIn_J3_LANE.Right_Road_Edge.LaneExtraFarPointPosY "" FLOAT32_IEEE autosar_swc_val_CM_single 0 0 -3.4E+38 3.4E+38 ECU_ADDRESS 0xfe4cae04 /* @ECU_Address@SwcIn_J3_LANE.Right_Road_Edge.LaneExtraFarPointPosY@ */ /end MEASUREMENT
/begin MEASUREMENT SwcIn_J3_LANE.Right_Road_Edge.LaneExtraFarPointType "" UBYTE autosar_swc_val_CM_uint8 0 0 0 255 ECU_ADDRESS 0xfe4caddb /* @ECU_Address@SwcIn_J3_LANE.Right_Road_Edge.LaneExtraFarPointType@ */ /end MEASUREMENT
/begin MEASUREMENT SwcIn_J3_LANE.Right_Road_Edge.LaneExtraNearPointPosX "" FLOAT32_IEEE autosar_swc_val_CM_single 0 0 -3.4E+38 3.4E+38 ECU_ADDRESS 0xfe4cae08 /* @ECU_Address@SwcIn_J3_LANE.Right_Road_Edge.LaneExtraNearPointPosX@ */ /end MEASUREMENT
/begin MEASUREMENT SwcIn_J3_LANE.Right_Road_Edge.LaneExtraNearPointPosY "" FLOAT32_IEEE autosar_swc_val_CM_single 0 0 -3.4E+38 3.4E+38 ECU_ADDRESS 0xfe4cae0c /* @ECU_Address@SwcIn_J3_LANE.Right_Road_Edge.LaneExtraNearPointPosY@ */ /end MEASUREMENT
/begin MEASUREMENT SwcIn_J3_LANE.Right_Road_Edge.LaneExtraNearPointType "" UBYTE autosar_swc_val_CM_uint8 0 0 0 255 ECU_ADDRESS 0xfe4cadda /* @ECU_Address@SwcIn_J3_LANE.Right_Road_Edge.LaneExtraNearPointType@ */ /end MEASUREMENT
/begin MEASUREMENT SwcIn_J3_LANE.Right_Road_Edge.LaneMarkColor "" UBYTE autosar_swc_val_CM_uint8 0 0 0 255 ECU_ADDRESS 0xfe4cadd7 /* @ECU_Address@SwcIn_J3_LANE.Right_Road_Edge.LaneMarkColor@ */ /end MEASUREMENT
/begin MEASUREMENT SwcIn_J3_LANE.Right_Road_Edge.LaneMeasuringStatus "" UBYTE autosar_swc_val_CM_uint8 0 0 0 255 ECU_ADDRESS 0xfe4cadd5 /* @ECU_Address@SwcIn_J3_LANE.Right_Road_Edge.LaneMeasuringStatus@ */ /end MEASUREMENT
/begin MEASUREMENT SwcIn_J3_LANE.Right_Road_Edge.LaneModelC0 "" FLOAT32_IEEE autosar_swc_val_CM_single 0 0 -3.4E+38 3.4E+38 ECU_ADDRESS 0xfe4cadec /* @ECU_Address@SwcIn_J3_LANE.Right_Road_Edge.LaneModelC0@ */ /end MEASUREMENT
/begin MEASUREMENT SwcIn_J3_LANE.Right_Road_Edge.LaneModelC1 "" FLOAT32_IEEE autosar_swc_val_CM_single 0 0 -3.4E+38 3.4E+38 ECU_ADDRESS 0xfe4cadf0 /* @ECU_Address@SwcIn_J3_LANE.Right_Road_Edge.LaneModelC1@ */ /end MEASUREMENT
/begin MEASUREMENT SwcIn_J3_LANE.Right_Road_Edge.LaneModelC2 "" FLOAT32_IEEE autosar_swc_val_CM_single 0 0 -3.4E+38 3.4E+38 ECU_ADDRESS 0xfe4cadf4 /* @ECU_Address@SwcIn_J3_LANE.Right_Road_Edge.LaneModelC2@ */ /end MEASUREMENT
/begin MEASUREMENT SwcIn_J3_LANE.Right_Road_Edge.LaneModelC3 "" FLOAT32_IEEE autosar_swc_val_CM_single 0 0 -3.4E+38 3.4E+38 ECU_ADDRESS 0xfe4cadf8 /* @ECU_Address@SwcIn_J3_LANE.Right_Road_Edge.LaneModelC3@ */ /end MEASUREMENT
/begin MEASUREMENT SwcIn_J3_LANE.Right_Road_Edge.LaneParsingConfidence "" UBYTE autosar_swc_val_CM_uint8 0 0 0 255 ECU_ADDRESS 0xfe4caddc /* @ECU_Address@SwcIn_J3_LANE.Right_Road_Edge.LaneParsingConfidence@ */ /end MEASUREMENT
/begin MEASUREMENT SwcIn_J3_LANE.Right_Road_Edge.LaneQuality "" UBYTE autosar_swc_val_CM_uint8 0 0 0 255 ECU_ADDRESS 0xfe4cadd8 /* @ECU_Address@SwcIn_J3_LANE.Right_Road_Edge.LaneQuality@ */ /end MEASUREMENT
/begin MEASUREMENT SwcIn_J3_LANE.Right_Road_Edge.LaneTLC "" FLOAT32_IEEE autosar_swc_val_CM_single 0 0 -3.4E+38 3.4E+38 ECU_ADDRESS 0xfe4cadfc /* @ECU_Address@SwcIn_J3_LANE.Right_Road_Edge.LaneTLC@ */ /end MEASUREMENT
/begin MEASUREMENT SwcIn_J3_LANE.Right_Road_Edge.LaneTrackID "" UWORD autosar_swc_val_CM_uint16 0 0 0 65535 ECU_ADDRESS 0xfe4cadde /* @ECU_Address@SwcIn_J3_LANE.Right_Road_Edge.LaneTrackID@ */ /end MEASUREMENT
/begin MEASUREMENT SwcIn_J3_LANE.Right_Road_Edge.LaneTypeClass "" UBYTE autosar_swc_val_CM_uint8 0 0 0 255 ECU_ADDRESS 0xfe4cadd6 /* @ECU_Address@SwcIn_J3_LANE.Right_Road_Edge.LaneTypeClass@ */ /end MEASUREMENT
/begin MEASUREMENT SwcIn_J3_LANE.Right_Road_Edge.LaneViewRangeEnd "" FLOAT32_IEEE autosar_swc_val_CM_single 0 0 -3.4E+38 3.4E+38 ECU_ADDRESS 0xfe4cade8 /* @ECU_Address@SwcIn_J3_LANE.Right_Road_Edge.LaneViewRangeEnd@ */ /end MEASUREMENT
/begin MEASUREMENT SwcIn_J3_LANE.Right_Road_Edge.LaneViewRangeStart "" FLOAT32_IEEE autosar_swc_val_CM_single 0 0 -3.4E+38 3.4E+38 ECU_ADDRESS 0xfe4cade4 /* @ECU_Address@SwcIn_J3_LANE.Right_Road_Edge.LaneViewRangeStart@ */ /end MEASUREMENT
/begin MEASUREMENT SwcIn_J3_LANE.Right_Road_Edge.LaneWidthMarking "" FLOAT32_IEEE autosar_swc_val_CM_single 0 0 -3.4E+38 3.4E+38 ECU_ADDRESS 0xfe4cade0 /* @ECU_Address@SwcIn_J3_LANE.Right_Road_Edge.LaneWidthMarking@ */ /end MEASUREMENT
/begin MEASUREMENT SwcIn_J3_LANE.Right_Road_Edge.ObstacleFlag "" UBYTE autosar_swc_val_CM_uint8 0 0 0 255 ECU_ADDRESS 0xfe4cadd9 /* @ECU_Address@SwcIn_J3_LANE.Right_Road_Edge.ObstacleFlag@ */ /end MEASUREMENT
/begin MEASUREMENT SwcIn_J3_LANE.Right_Road_Edge.Stopline_Relevancy "" UBYTE autosar_swc_val_CM_uint8 0 0 0 255 ECU_ADDRESS 0xfe4caddd /* @ECU_Address@SwcIn_J3_LANE.Right_Road_Edge.Stopline_Relevancy@ */ /end MEASUREMENT
/begin MEASUREMENT SwcIn_J3_LANE.Road_Information.CrossWalkBox.corner_x_vec "" FLOAT32_IEEE autosar_swc_val_CM_single 0 0 -3.4E+38 3.4E+38 LAYOUT COLUMN_DIR MATRIX_DIM 4 ECU_ADDRESS 0xfe4cae20 /* @ECU_Address@SwcIn_J3_LANE.Road_Information.CrossWalkBox.corner_x_vec@ */ /end MEASUREMENT
/begin MEASUREMENT SwcIn_J3_LANE.Road_Information.CrossWalkBox.corner_y_vec "" FLOAT32_IEEE autosar_swc_val_CM_single 0 0 -3.4E+38 3.4E+38 LAYOUT COLUMN_DIR MATRIX_DIM 4 ECU_ADDRESS 0xfe4cae30 /* @ECU_Address@SwcIn_J3_LANE.Road_Information.CrossWalkBox.corner_y_vec@ */ /end MEASUREMENT
/begin MEASUREMENT SwcIn_J3_LANE.Road_Information.CrossWalkCoor.mod "" FLOAT32_IEEE autosar_swc_val_CM_single 0 0 -3.4E+38 3.4E+38 ECU_ADDRESS 0xfe4cae48 /* @ECU_Address@SwcIn_J3_LANE.Road_Information.CrossWalkCoor.mod@ */ /end MEASUREMENT
/begin MEASUREMENT SwcIn_J3_LANE.Road_Information.CrossWalkCoor.x "" FLOAT32_IEEE autosar_swc_val_CM_single 0 0 -3.4E+38 3.4E+38 ECU_ADDRESS 0xfe4cae40 /* @ECU_Address@SwcIn_J3_LANE.Road_Information.CrossWalkCoor.x@ */ /end MEASUREMENT
/begin MEASUREMENT SwcIn_J3_LANE.Road_Information.CrossWalkCoor.y "" FLOAT32_IEEE autosar_swc_val_CM_single 0 0 -3.4E+38 3.4E+38 ECU_ADDRESS 0xfe4cae44 /* @ECU_Address@SwcIn_J3_LANE.Road_Information.CrossWalkCoor.y@ */ /end MEASUREMENT
/begin MEASUREMENT SwcIn_J3_LANE.Road_Information.CrossWalkValid "" UBYTE autosar_swc_val_CM_uint8 0 0 0 255 ECU_ADDRESS 0xfe4cae18 /* @ECU_Address@SwcIn_J3_LANE.Road_Information.CrossWalkValid@ */ /end MEASUREMENT
/begin MEASUREMENT SwcIn_J3_LANE.Road_Information.CurrentTime "" UBYTE autosar_swc_val_CM_uint8 0 0 0 255 ECU_ADDRESS 0xfe4cae12 /* @ECU_Address@SwcIn_J3_LANE.Road_Information.CurrentTime@ */ /end MEASUREMENT
/begin MEASUREMENT SwcIn_J3_LANE.Road_Information.CurrentWeather "" UBYTE autosar_swc_val_CM_uint8 0 0 0 255 ECU_ADDRESS 0xfe4cae11 /* @ECU_Address@SwcIn_J3_LANE.Road_Information.CurrentWeather@ */ /end MEASUREMENT
/begin MEASUREMENT SwcIn_J3_LANE.Road_Information.DisStopline "" FLOAT32_IEEE autosar_swc_val_CM_single 0 0 -3.4E+38 3.4E+38 ECU_ADDRESS 0xfe4cae1c /* @ECU_Address@SwcIn_J3_LANE.Road_Information.DisStopline@ */ /end MEASUREMENT
/begin MEASUREMENT SwcIn_J3_LANE.Road_Information.DisStoplineValid "" UBYTE autosar_swc_val_CM_uint8 0 0 0 255 ECU_ADDRESS 0xfe4cae14 /* @ECU_Address@SwcIn_J3_LANE.Road_Information.DisStoplineValid@ */ /end MEASUREMENT
/begin MEASUREMENT SwcIn_J3_LANE.Road_Information.LightType "" UBYTE autosar_swc_val_CM_uint8 0 0 0 255 ECU_ADDRESS 0xfe4cae13 /* @ECU_Address@SwcIn_J3_LANE.Road_Information.LightType@ */ /end MEASUREMENT
/begin MEASUREMENT SwcIn_J3_LANE.Road_Information.ProtocolMajorVersion "" UBYTE autosar_swc_val_CM_uint8 0 0 0 255 ECU_ADDRESS 0xfe4cae15 /* @ECU_Address@SwcIn_J3_LANE.Road_Information.ProtocolMajorVersion@ */ /end MEASUREMENT
/begin MEASUREMENT SwcIn_J3_LANE.Road_Information.ProtocolMinorVersion "" UBYTE autosar_swc_val_CM_uint8 0 0 0 255 ECU_ADDRESS 0xfe4cae16 /* @ECU_Address@SwcIn_J3_LANE.Road_Information.ProtocolMinorVersion@ */ /end MEASUREMENT
/begin MEASUREMENT SwcIn_J3_LANE.Road_Information.RoadType "" UBYTE autosar_swc_val_CM_uint8 0 0 0 255 ECU_ADDRESS 0xfe4cae10 /* @ECU_Address@SwcIn_J3_LANE.Road_Information.RoadType@ */ /end MEASUREMENT
/begin MEASUREMENT SwcIn_J3_LANE.Road_Information.TerrainType "" UBYTE autosar_swc_val_CM_uint8 0 0 0 255 ECU_ADDRESS 0xfe4cae17 /* @ECU_Address@SwcIn_J3_LANE.Road_Information.TerrainType@ */ /end MEASUREMENT
/begin MEASUREMENT SwcIn_MFS_2.MFS_2_CRC "" UBYTE autosar_swc_val_CM_MFS_2_CRC_864_dt 0 0 0 255 ECU_ADDRESS 0xfe4cce6f /* @ECU_Address@SwcIn_MFS_2.MFS_2_CRC@ */ /end MEASUREMENT
/begin MEASUREMENT SwcIn_MFS_2.MFS_2_RollgCntr "" UBYTE autosar_swc_val_CM_MFS_2_RollgCntr_864_dt 0 0 0 255 ECU_ADDRESS 0xfe4cce70 /* @ECU_Address@SwcIn_MFS_2.MFS_2_RollgCntr@ */ /end MEASUREMENT
/begin MEASUREMENT SwcIn_MFS_2.MFS_Cruise_Control "" UBYTE autosar_swc_val_CM_MFS_Cruise_Control_864_dt 0 0 0 255 ECU_ADDRESS 0xfe4cce71 /* @ECU_Address@SwcIn_MFS_2.MFS_Cruise_Control@ */ /end MEASUREMENT
/begin MEASUREMENT SwcIn_MFS_2.MFS_LeRollrUpDwnAdjSteps "" UBYTE autosar_swc_val_CM_MFS_LeRollrUpDwnAdjSteps_864_dt 0 0 0 255 ECU_ADDRESS 0xfe4cce79 /* @ECU_Address@SwcIn_MFS_2.MFS_LeRollrUpDwnAdjSteps@ */ /end MEASUREMENT
/begin MEASUREMENT SwcIn_MFS_2.MFS_LeftRoller "" UBYTE autosar_swc_val_CM_MFS_LeftRoller_864_dt 0 0 0 255 ECU_ADDRESS 0xfe4cce77 /* @ECU_Address@SwcIn_MFS_2.MFS_LeftRoller@ */ /end MEASUREMENT
/begin MEASUREMENT SwcIn_MFS_2.MFS_LeftRollerMiddleKey "" UBYTE autosar_swc_val_CM_MFS_LeftRollerMiddleKey_864_dt 0 0 0 255 ECU_ADDRESS 0xfe4cce78 /* @ECU_Address@SwcIn_MFS_2.MFS_LeftRollerMiddleKey@ */ /end MEASUREMENT
/begin MEASUREMENT SwcIn_MFS_2.MFS_RESPlus "" UBYTE autosar_swc_val_CM_MFS_RESPlus_864_dt 0 0 0 255 ECU_ADDRESS 0xfe4cce72 /* @ECU_Address@SwcIn_MFS_2.MFS_RESPlus@ */ /end MEASUREMENT
/begin MEASUREMENT SwcIn_MFS_2.MFS_Rsp_Error "" UBYTE autosar_swc_val_CM_MFS_Rsp_Error_864_dt 0 0 0 255 ECU_ADDRESS 0xfe4cce76 /* @ECU_Address@SwcIn_MFS_2.MFS_Rsp_Error@ */ /end MEASUREMENT
/begin MEASUREMENT SwcIn_MFS_2.MFS_SETMinus "" UBYTE autosar_swc_val_CM_MFS_SETMinus_864_dt 0 0 0 255 ECU_ADDRESS 0xfe4cce73 /* @ECU_Address@SwcIn_MFS_2.MFS_SETMinus@ */ /end MEASUREMENT
/begin MEASUREMENT SwcIn_MFS_2.MFS_Time_Gap_Add "" UBYTE autosar_swc_val_CM_MFS_Time_Gap_Add_864_dt 0 0 0 255 ECU_ADDRESS 0xfe4cce75 /* @ECU_Address@SwcIn_MFS_2.MFS_Time_Gap_Add@ */ /end MEASUREMENT
/begin MEASUREMENT SwcIn_MFS_2.MFS_Time_Gap_Reduce "" UBYTE autosar_swc_val_CM_MFS_Time_Gap_Reduce_864_dt 0 0 0 255 ECU_ADDRESS 0xfe4cce74 /* @ECU_Address@SwcIn_MFS_2.MFS_Time_Gap_Reduce@ */ /end MEASUREMENT
/begin MEASUREMENT SwcIn_ONEBOX_1.ABS_ESP_1_ABSActive "" UBYTE autosar_swc_val_CM_ABS_ESP_1_ABSActive_152_dt 0 0 0 255 ECU_ADDRESS 0xfe4caea7 /* @ECU_Address@SwcIn_ONEBOX_1.ABS_ESP_1_ABSActive@ */ /end MEASUREMENT
/begin MEASUREMENT SwcIn_ONEBOX_1.ABS_ESP_1_ABSFailSts "" UBYTE autosar_swc_val_CM_ABS_ESP_1_ABSFailSts_152_dt 0 0 0 255 ECU_ADDRESS 0xfe4caea2 /* @ECU_Address@SwcIn_ONEBOX_1.ABS_ESP_1_ABSFailSts@ */ /end MEASUREMENT
/begin MEASUREMENT SwcIn_ONEBOX_1.ABS_ESP_1_EBDFailSts "" UBYTE autosar_swc_val_CM_ABS_ESP_1_EBDFailSts_152_dt 0 0 0 255 ECU_ADDRESS 0xfe4caea1 /* @ECU_Address@SwcIn_ONEBOX_1.ABS_ESP_1_EBDFailSts@ */ /end MEASUREMENT
/begin MEASUREMENT SwcIn_ONEBOX_1.ABS_ESP_1_ESPSwitchStatus "" UBYTE autosar_swc_val_CM_ABS_ESP_1_ESPSwitchStatus_152_dt 0 0 0 255 ECU_ADDRESS 0xfe4caeb2 /* @ECU_Address@SwcIn_ONEBOX_1.ABS_ESP_1_ESPSwitchStatus@ */ /end MEASUREMENT
/begin MEASUREMENT SwcIn_ONEBOX_1.ABS_ESP_1_HDCCtrlSts "" UBYTE autosar_swc_val_CM_ABS_ESP_1_HDCCtrlSts_152_dt 0 0 0 255 ECU_ADDRESS 0xfe4caeaf /* @ECU_Address@SwcIn_ONEBOX_1.ABS_ESP_1_HDCCtrlSts@ */ /end MEASUREMENT
/begin MEASUREMENT SwcIn_ONEBOX_1.ABS_ESP_1_HDCFailSts "" UBYTE autosar_swc_val_CM_ABS_ESP_1_HDCFailSts_152_dt 0 0 0 255 ECU_ADDRESS 0xfe4caeb0 /* @ECU_Address@SwcIn_ONEBOX_1.ABS_ESP_1_HDCFailSts@ */ /end MEASUREMENT
/begin MEASUREMENT SwcIn_ONEBOX_1.ABS_ESP_1_HHCFailSts "" UBYTE autosar_swc_val_CM_ABS_ESP_1_HHCFailSts_152_dt 0 0 0 255 ECU_ADDRESS 0xfe4caead /* @ECU_Address@SwcIn_ONEBOX_1.ABS_ESP_1_HHCFailSts@ */ /end MEASUREMENT
/begin MEASUREMENT SwcIn_ONEBOX_1.ABS_ESP_1_TCSActive "" UBYTE autosar_swc_val_CM_ABS_ESP_1_TCSActive_152_dt 0 0 0 255 ECU_ADDRESS 0xfe4caeab /* @ECU_Address@SwcIn_ONEBOX_1.ABS_ESP_1_TCSActive@ */ /end MEASUREMENT
/begin MEASUREMENT SwcIn_ONEBOX_1.ABS_ESP_1_TCSFailSts "" UBYTE autosar_swc_val_CM_ABS_ESP_1_TCSFailSts_152_dt 0 0 0 255 ECU_ADDRESS 0xfe4caeaa /* @ECU_Address@SwcIn_ONEBOX_1.ABS_ESP_1_TCSFailSts@ */ /end MEASUREMENT
/begin MEASUREMENT SwcIn_ONEBOX_1.ABS_ESP_1_VDCActive "" UBYTE autosar_swc_val_CM_ABS_ESP_1_VDCActive_152_dt 0 0 0 255 ECU_ADDRESS 0xfe4caea9 /* @ECU_Address@SwcIn_ONEBOX_1.ABS_ESP_1_VDCActive@ */ /end MEASUREMENT
/begin MEASUREMENT SwcIn_ONEBOX_1.ABS_ESP_1_VDCFailSts "" UBYTE autosar_swc_val_CM_ABS_ESP_1_VDCFailSts_152_dt 0 0 0 255 ECU_ADDRESS 0xfe4caea8 /* @ECU_Address@SwcIn_ONEBOX_1.ABS_ESP_1_VDCFailSts@ */ /end MEASUREMENT
/begin MEASUREMENT SwcIn_ONEBOX_1.ABS_ESP_1_VehicleSpeedVSOSig "" FLOAT32_IEEE autosar_swc_val_CM_ABS_ESP_1_VehicleSpeedVSOSig_152_dt 0 0 -3.4E+38 3.4E+38 ECU_ADDRESS 0xfe4cae9c /* @ECU_Address@SwcIn_ONEBOX_1.ABS_ESP_1_VehicleSpeedVSOSig@ */ /end MEASUREMENT
/begin MEASUREMENT SwcIn_ONEBOX_1.AEBdecActive "" UBYTE autosar_swc_val_CM_AEBdecActive_152_dt 0 0 0 255 ECU_ADDRESS 0xfe4caebb /* @ECU_Address@SwcIn_ONEBOX_1.AEBdecActive@ */ /end MEASUREMENT
/begin MEASUREMENT SwcIn_ONEBOX_1.AEBdecAvailable "" UBYTE autosar_swc_val_CM_AEBdecAvailable_152_dt 0 0 0 255 ECU_ADDRESS 0xfe4caebc /* @ECU_Address@SwcIn_ONEBOX_1.AEBdecAvailable@ */ /end MEASUREMENT
/begin MEASUREMENT SwcIn_ONEBOX_1.BLRequestController "" UBYTE autosar_swc_val_CM_BLRequestController_152_dt 0 0 0 255 ECU_ADDRESS 0xfe4caeb3 /* @ECU_Address@SwcIn_ONEBOX_1.BLRequestController@ */ /end MEASUREMENT
/begin MEASUREMENT SwcIn_ONEBOX_1.BrakeSystemType "" UBYTE autosar_swc_val_CM_BrakeSystemType_152_dt 0 0 0 255 ECU_ADDRESS 0xfe4caeac /* @ECU_Address@SwcIn_ONEBOX_1.BrakeSystemType@ */ /end MEASUREMENT
/begin MEASUREMENT SwcIn_ONEBOX_1.CDPActive "" UBYTE autosar_swc_val_CM_CDPActive_152_dt 0 0 0 255 ECU_ADDRESS 0xfe4caebd /* @ECU_Address@SwcIn_ONEBOX_1.CDPActive@ */ /end MEASUREMENT
/begin MEASUREMENT SwcIn_ONEBOX_1.CDPFailSts "" UBYTE autosar_swc_val_CM_CDPFailSts_152_dt 0 0 0 255 ECU_ADDRESS 0xfe4caebe /* @ECU_Address@SwcIn_ONEBOX_1.CDPFailSts@ */ /end MEASUREMENT
/begin MEASUREMENT SwcIn_ONEBOX_1.ESP1_VehicleSpeedVSOSigValidData "" UBYTE autosar_swc_val_CM_ESP1_VehicleSpeedVSOSigValidData_152_dt 0 0 0 255 ECU_ADDRESS 0xfe4caea0 /* @ECU_Address@SwcIn_ONEBOX_1.ESP1_VehicleSpeedVSOSigValidData@ */ /end MEASUREMENT
/begin MEASUREMENT SwcIn_ONEBOX_1.HHCActive "" UBYTE autosar_swc_val_CM_HHCActive_152_dt 0 0 0 255 ECU_ADDRESS 0xfe4caeae /* @ECU_Address@SwcIn_ONEBOX_1.HHCActive@ */ /end MEASUREMENT
/begin MEASUREMENT SwcIn_ONEBOX_1.HLRequest "" UBYTE autosar_swc_val_CM_HLRequest_152_dt 0 0 0 255 ECU_ADDRESS 0xfe4caeb1 /* @ECU_Address@SwcIn_ONEBOX_1.HLRequest@ */ /end MEASUREMENT
/begin MEASUREMENT SwcIn_ONEBOX_1.IPB_1_MbRegenTargetWheel "" SWORD autosar_swc_val_CM_IPB_1_MbRegenTargetWheel_152_dt 0 0 -32768 32767 ECU_ADDRESS 0xfe4caeb8 /* @ECU_Address@SwcIn_ONEBOX_1.IPB_1_MbRegenTargetWheel@ */ /end MEASUREMENT
/begin MEASUREMENT SwcIn_ONEBOX_1.IPB_1_MbRegenTargetWheelQ "" UBYTE autosar_swc_val_CM_IPB_1_MbRegenTargetWheelQ_152_dt 0 0 0 255 ECU_ADDRESS 0xfe4caeba /* @ECU_Address@SwcIn_ONEBOX_1.IPB_1_MbRegenTargetWheelQ@ */ /end MEASUREMENT
/begin MEASUREMENT SwcIn_ONEBOX_1.IPB_SimulatorPressure "" UWORD autosar_swc_val_CM_IPB_SimulatorPressure_152_dt 0 0 0 65535 ECU_ADDRESS 0xfe4caea4 /* @ECU_Address@SwcIn_ONEBOX_1.IPB_SimulatorPressure@ */ /end MEASUREMENT
/begin MEASUREMENT SwcIn_ONEBOX_1.IPB_SimulatorPressureStatus "" UBYTE autosar_swc_val_CM_IPB_SimulatorPressureStatus_152_dt 0 0 0 255 ECU_ADDRESS 0xfe4caea6 /* @ECU_Address@SwcIn_ONEBOX_1.IPB_SimulatorPressureStatus@ */ /end MEASUREMENT
/begin MEASUREMENT SwcIn_ONEBOX_1.ONEBOX_1_CRC1 "" UBYTE autosar_swc_val_CM_ONEBOX_1_CRC1_152_dt 0 0 0 255 ECU_ADDRESS 0xfe4cae98 /* @ECU_Address@SwcIn_ONEBOX_1.ONEBOX_1_CRC1@ */ /end MEASUREMENT
/begin MEASUREMENT SwcIn_ONEBOX_1.ONEBOX_1_CRC2 "" UBYTE autosar_swc_val_CM_ONEBOX_1_CRC2_152_dt 0 0 0 255 ECU_ADDRESS 0xfe4caeb5 /* @ECU_Address@SwcIn_ONEBOX_1.ONEBOX_1_CRC2@ */ /end MEASUREMENT
/begin MEASUREMENT SwcIn_ONEBOX_1.ONEBOX_1_Resd1 "" UBYTE autosar_swc_val_CM_ONEBOX_1_Resd1_152_dt 0 0 0 255 ECU_ADDRESS 0xfe4cae9a /* @ECU_Address@SwcIn_ONEBOX_1.ONEBOX_1_Resd1@ */ /end MEASUREMENT
/begin MEASUREMENT SwcIn_ONEBOX_1.ONEBOX_1_Resd2 "" UBYTE autosar_swc_val_CM_ONEBOX_1_Resd2_152_dt 0 0 0 255 ECU_ADDRESS 0xfe4caeb7 /* @ECU_Address@SwcIn_ONEBOX_1.ONEBOX_1_Resd2@ */ /end MEASUREMENT
/begin MEASUREMENT SwcIn_ONEBOX_1.ONEBOX_1_RollgCntr1 "" UBYTE autosar_swc_val_CM_ONEBOX_1_RollgCntr1_152_dt 0 0 0 255 ECU_ADDRESS 0xfe4cae99 /* @ECU_Address@SwcIn_ONEBOX_1.ONEBOX_1_RollgCntr1@ */ /end MEASUREMENT
/begin MEASUREMENT SwcIn_ONEBOX_1.ONEBOX_1_RollgCntr2 "" UBYTE autosar_swc_val_CM_ONEBOX_1_RollgCntr2_152_dt 0 0 0 255 ECU_ADDRESS 0xfe4caeb6 /* @ECU_Address@SwcIn_ONEBOX_1.ONEBOX_1_RollgCntr2@ */ /end MEASUREMENT
/begin MEASUREMENT SwcIn_ONEBOX_1.SwitchOffCruiseControl "" UBYTE autosar_swc_val_CM_SwitchOffCruiseControl_152_dt 0 0 0 255 ECU_ADDRESS 0xfe4caeb4 /* @ECU_Address@SwcIn_ONEBOX_1.SwitchOffCruiseControl@ */ /end MEASUREMENT
/begin MEASUREMENT SwcIn_ONEBOX_2_G.BrakesystemFailSts "" UBYTE autosar_swc_val_CM_BrakesystemFailSts_1193_dt 0 0 0 255 ECU_ADDRESS 0xfe4ccb2f /* @ECU_Address@SwcIn_ONEBOX_2_G.BrakesystemFailSts@ */ /end MEASUREMENT
/begin MEASUREMENT SwcIn_ONEBOX_2_G.ONEBOX_2_G_CRC "" UBYTE autosar_swc_val_CM_ONEBOX_2_G_CRC_1193_dt 0 0 0 255 ECU_ADDRESS 0xfe4ccb2c /* @ECU_Address@SwcIn_ONEBOX_2_G.ONEBOX_2_G_CRC@ */ /end MEASUREMENT
/begin MEASUREMENT SwcIn_ONEBOX_2_G.ONEBOX_2_G_Resd "" UBYTE autosar_swc_val_CM_ONEBOX_2_G_Resd_1193_dt 0 0 0 255 ECU_ADDRESS 0xfe4ccb2e /* @ECU_Address@SwcIn_ONEBOX_2_G.ONEBOX_2_G_Resd@ */ /end MEASUREMENT
/begin MEASUREMENT SwcIn_ONEBOX_2_G.ONEBOX_2_G_RollgCntr "" UBYTE autosar_swc_val_CM_ONEBOX_2_G_RollgCntr_1193_dt 0 0 0 255 ECU_ADDRESS 0xfe4ccb2d /* @ECU_Address@SwcIn_ONEBOX_2_G.ONEBOX_2_G_RollgCntr@ */ /end MEASUREMENT
/begin MEASUREMENT SwcIn_ONEBOX_3.AVHFailSts "" UBYTE autosar_swc_val_CM_AVHFailSts_555_dt 0 0 0 255 ECU_ADDRESS 0xfe4caec6 /* @ECU_Address@SwcIn_ONEBOX_3.AVHFailSts@ */ /end MEASUREMENT
/begin MEASUREMENT SwcIn_ONEBOX_3.AVHSts "" UBYTE autosar_swc_val_CM_AVHSts_555_dt 0 0 0 255 ECU_ADDRESS 0xfe4caec3 /* @ECU_Address@SwcIn_ONEBOX_3.AVHSts@ */ /end MEASUREMENT
/begin MEASUREMENT SwcIn_ONEBOX_3.CDDActive "" UBYTE autosar_swc_val_CM_CDDActive_555_dt 0 0 0 255 ECU_ADDRESS 0xfe4caeca /* @ECU_Address@SwcIn_ONEBOX_3.CDDActive@ */ /end MEASUREMENT
/begin MEASUREMENT SwcIn_ONEBOX_3.CDDAvailable "" UBYTE autosar_swc_val_CM_CDDAvailable_555_dt 0 0 0 255 ECU_ADDRESS 0xfe4caecb /* @ECU_Address@SwcIn_ONEBOX_3.CDDAvailable@ */ /end MEASUREMENT
/begin MEASUREMENT SwcIn_ONEBOX_3.DCFail "" UBYTE autosar_swc_val_CM_DCFail_555_dt 0 0 0 255 ECU_ADDRESS 0xfe4caec9 /* @ECU_Address@SwcIn_ONEBOX_3.DCFail@ */ /end MEASUREMENT
/begin MEASUREMENT SwcIn_ONEBOX_3.DTCActive "" UBYTE autosar_swc_val_CM_DTCActive_555_dt 0 0 0 255 ECU_ADDRESS 0xfe4caee6 /* @ECU_Address@SwcIn_ONEBOX_3.DTCActive@ */ /end MEASUREMENT
/begin MEASUREMENT SwcIn_ONEBOX_3.DTCAvailable "" UBYTE autosar_swc_val_CM_DTCAvailable_555_dt 0 0 0 255 ECU_ADDRESS 0xfe4caee5 /* @ECU_Address@SwcIn_ONEBOX_3.DTCAvailable@ */ /end MEASUREMENT
/begin MEASUREMENT SwcIn_ONEBOX_3.DTC_Intervention "" UBYTE autosar_swc_val_CM_DTC_Intervention_555_dt 0 0 0 255 ECU_ADDRESS 0xfe4caee4 /* @ECU_Address@SwcIn_ONEBOX_3.DTC_Intervention@ */ /end MEASUREMENT
/begin MEASUREMENT SwcIn_ONEBOX_3.ECDTempOff "" UBYTE autosar_swc_val_CM_ECDTempOff_555_dt 0 0 0 255 ECU_ADDRESS 0xfe4caec8 /* @ECU_Address@SwcIn_ONEBOX_3.ECDTempOff@ */ /end MEASUREMENT
/begin MEASUREMENT SwcIn_ONEBOX_3.IPB_InputRodStroke "" FLOAT32_IEEE autosar_swc_val_CM_IPB_InputRodStroke_555_dt 0 0 -3.4E+38 3.4E+38 ECU_ADDRESS 0xfe4caee0 /* @ECU_Address@SwcIn_ONEBOX_3.IPB_InputRodStroke@ */ /end MEASUREMENT
/begin MEASUREMENT SwcIn_ONEBOX_3.IPB_InputRodStrokeStatus "" UBYTE autosar_swc_val_CM_IPB_InputRodStrokeStatus_555_dt 0 0 0 255 ECU_ADDRESS 0xfe4caed8 /* @ECU_Address@SwcIn_ONEBOX_3.IPB_InputRodStrokeStatus@ */ /end MEASUREMENT
/begin MEASUREMENT SwcIn_ONEBOX_3.IPB_PlungerPressure "" UWORD autosar_swc_val_CM_IPB_PlungerPressure_555_dt 0 0 0 65535 ECU_ADDRESS 0xfe4caedc /* @ECU_Address@SwcIn_ONEBOX_3.IPB_PlungerPressure@ */ /end MEASUREMENT
/begin MEASUREMENT SwcIn_ONEBOX_3.IPB_PlungerPressureValidData "" UBYTE autosar_swc_val_CM_IPB_PlungerPressureValidData_555_dt 0 0 0 255 ECU_ADDRESS 0xfe4caed7 /* @ECU_Address@SwcIn_ONEBOX_3.IPB_PlungerPressureValidData@ */ /end MEASUREMENT
/begin MEASUREMENT SwcIn_ONEBOX_3.NoBrakeForce "" UBYTE autosar_swc_val_CM_NoBrakeForce_555_dt 0 0 0 255 ECU_ADDRESS 0xfe4caec5 /* @ECU_Address@SwcIn_ONEBOX_3.NoBrakeForce@ */ /end MEASUREMENT
/begin MEASUREMENT SwcIn_ONEBOX_3.ONEBOX_3_CRC1 "" UBYTE autosar_swc_val_CM_ONEBOX_3_CRC1_555_dt 0 0 0 255 ECU_ADDRESS 0xfe4caec0 /* @ECU_Address@SwcIn_ONEBOX_3.ONEBOX_3_CRC1@ */ /end MEASUREMENT
/begin MEASUREMENT SwcIn_ONEBOX_3.ONEBOX_3_CRC2 "" UBYTE autosar_swc_val_CM_ONEBOX_3_CRC2_555_dt 0 0 0 255 ECU_ADDRESS 0xfe4caecd /* @ECU_Address@SwcIn_ONEBOX_3.ONEBOX_3_CRC2@ */ /end MEASUREMENT
/begin MEASUREMENT SwcIn_ONEBOX_3.ONEBOX_3_CRC4 "" UBYTE autosar_swc_val_CM_ONEBOX_3_CRC4_555_dt 0 0 0 255 ECU_ADDRESS 0xfe4caed4 /* @ECU_Address@SwcIn_ONEBOX_3.ONEBOX_3_CRC4@ */ /end MEASUREMENT
/begin MEASUREMENT SwcIn_ONEBOX_3.ONEBOX_3_Resd1 "" UBYTE autosar_swc_val_CM_ONEBOX_3_Resd1_555_dt 0 0 0 255 ECU_ADDRESS 0xfe4caec2 /* @ECU_Address@SwcIn_ONEBOX_3.ONEBOX_3_Resd1@ */ /end MEASUREMENT
/begin MEASUREMENT SwcIn_ONEBOX_3.ONEBOX_3_Resd2 "" UBYTE autosar_swc_val_CM_ONEBOX_3_Resd2_555_dt 0 0 0 255 ECU_ADDRESS 0xfe4caecf /* @ECU_Address@SwcIn_ONEBOX_3.ONEBOX_3_Resd2@ */ /end MEASUREMENT
/begin MEASUREMENT SwcIn_ONEBOX_3.ONEBOX_3_Resd4 "" UBYTE autosar_swc_val_CM_ONEBOX_3_Resd4_555_dt 0 0 0 255 ECU_ADDRESS 0xfe4caed6 /* @ECU_Address@SwcIn_ONEBOX_3.ONEBOX_3_Resd4@ */ /end MEASUREMENT
/begin MEASUREMENT SwcIn_ONEBOX_3.ONEBOX_3_RollgCntr1 "" UBYTE autosar_swc_val_CM_ONEBOX_3_RollgCntr1_555_dt 0 0 0 255 ECU_ADDRESS 0xfe4caec1 /* @ECU_Address@SwcIn_ONEBOX_3.ONEBOX_3_RollgCntr1@ */ /end MEASUREMENT
/begin MEASUREMENT SwcIn_ONEBOX_3.ONEBOX_3_RollgCntr2 "" UBYTE autosar_swc_val_CM_ONEBOX_3_RollgCntr2_555_dt 0 0 0 255 ECU_ADDRESS 0xfe4caece /* @ECU_Address@SwcIn_ONEBOX_3.ONEBOX_3_RollgCntr2@ */ /end MEASUREMENT
/begin MEASUREMENT SwcIn_ONEBOX_3.ONEBOX_3_RollgCntr4 "" UBYTE autosar_swc_val_CM_ONEBOX_3_RollgCntr4_555_dt 0 0 0 255 ECU_ADDRESS 0xfe4caed5 /* @ECU_Address@SwcIn_ONEBOX_3.ONEBOX_3_RollgCntr4@ */ /end MEASUREMENT
/begin MEASUREMENT SwcIn_ONEBOX_3.Reserved_EDCActive "" UBYTE autosar_swc_val_CM_Reserved_EDCActive_555_dt 0 0 0 255 ECU_ADDRESS 0xfe4caec7 /* @ECU_Address@SwcIn_ONEBOX_3.Reserved_EDCActive@ */ /end MEASUREMENT
/begin MEASUREMENT SwcIn_ONEBOX_3.Reserved_ESPLampInformation "" UBYTE autosar_swc_val_CM_Reserved_ESPLampInformation_555_dt 0 0 0 255 ECU_ADDRESS 0xfe4caecc /* @ECU_Address@SwcIn_ONEBOX_3.Reserved_ESPLampInformation@ */ /end MEASUREMENT
/begin MEASUREMENT SwcIn_ONEBOX_3.SCMActive "" UBYTE autosar_swc_val_CM_SCMActive_555_dt 0 0 0 255 ECU_ADDRESS 0xfe4caed9 /* @ECU_Address@SwcIn_ONEBOX_3.SCMActive@ */ /end MEASUREMENT
/begin MEASUREMENT SwcIn_ONEBOX_3.SCMAvalable "" UBYTE autosar_swc_val_CM_SCMAvalable_555_dt 0 0 0 255 ECU_ADDRESS 0xfe4caeda /* @ECU_Address@SwcIn_ONEBOX_3.SCMAvalable@ */ /end MEASUREMENT
/begin MEASUREMENT SwcIn_ONEBOX_3.VehicleStandstill "" UBYTE autosar_swc_val_CM_VehicleStandstill_555_dt 0 0 0 255 ECU_ADDRESS 0xfe4caec4 /* @ECU_Address@SwcIn_ONEBOX_3.VehicleStandstill@ */ /end MEASUREMENT
/begin MEASUREMENT SwcIn_ONEBOX_3.WheelBrakeForce "" SLONG autosar_swc_val_CM_WheelBrakeForce_555_dt 0 0 -2147483648 2147483647 ECU_ADDRESS 0xfe4caed0 /* @ECU_Address@SwcIn_ONEBOX_3.WheelBrakeForce@ */ /end MEASUREMENT
/begin MEASUREMENT SwcIn_ONEBOX_4.LHFPulseCounter "" UWORD autosar_swc_val_CM_LHFPulseCounter_587_dt 0 0 0 65535 ECU_ADDRESS 0xfe4caf10 /* @ECU_Address@SwcIn_ONEBOX_4.LHFPulseCounter@ */ /end MEASUREMENT
/begin MEASUREMENT SwcIn_ONEBOX_4.LHFPulseCounterFailSts "" UBYTE autosar_swc_val_CM_LHFPulseCounterFailSts_587_dt 0 0 0 255 ECU_ADDRESS 0xfe4caf0e /* @ECU_Address@SwcIn_ONEBOX_4.LHFPulseCounterFailSts@ */ /end MEASUREMENT
/begin MEASUREMENT SwcIn_ONEBOX_4.LHFWheelDriveDirection "" UBYTE autosar_swc_val_CM_LHFWheelDriveDirection_587_dt 0 0 0 255 ECU_ADDRESS 0xfe4caf18 /* @ECU_Address@SwcIn_ONEBOX_4.LHFWheelDriveDirection@ */ /end MEASUREMENT
/begin MEASUREMENT SwcIn_ONEBOX_4.LHFWheelSpeedRPM "" FLOAT32_IEEE autosar_swc_val_CM_LHFWheelSpeedRPM_587_dt 0 0 -3.4E+38 3.4E+38 ECU_ADDRESS 0xfe4caeec /* @ECU_Address@SwcIn_ONEBOX_4.LHFWheelSpeedRPM@ */ /end MEASUREMENT
/begin MEASUREMENT SwcIn_ONEBOX_4.LHFWheelSpeedRaw "" FLOAT32_IEEE autosar_swc_val_CM_LHFWheelSpeedRaw_587_dt 0 0 -3.4E+38 3.4E+38 ECU_ADDRESS 0xfe4caf14 /* @ECU_Address@SwcIn_ONEBOX_4.LHFWheelSpeedRaw@ */ /end MEASUREMENT
/begin MEASUREMENT SwcIn_ONEBOX_4.LHFWheelSpeedRawValidData "" UBYTE autosar_swc_val_CM_LHFWheelSpeedRawValidData_587_dt 0 0 0 255 ECU_ADDRESS 0xfe4caf19 /* @ECU_Address@SwcIn_ONEBOX_4.LHFWheelSpeedRawValidData@ */ /end MEASUREMENT
/begin MEASUREMENT SwcIn_ONEBOX_4.LHRPulseCounter "" UWORD autosar_swc_val_CM_LHRPulseCounter_587_dt 0 0 0 65535 ECU_ADDRESS 0xfe4caf02 /* @ECU_Address@SwcIn_ONEBOX_4.LHRPulseCounter@ */ /end MEASUREMENT
/begin MEASUREMENT SwcIn_ONEBOX_4.LHRPulseCounterFailSts "" UBYTE autosar_swc_val_CM_LHRPulseCounterFailSts_587_dt 0 0 0 255 ECU_ADDRESS 0xfe4caf00 /* @ECU_Address@SwcIn_ONEBOX_4.LHRPulseCounterFailSts@ */ /end MEASUREMENT
/begin MEASUREMENT SwcIn_ONEBOX_4.LHRWheelDriveDirection "" UBYTE autosar_swc_val_CM_LHRWheelDriveDirection_587_dt 0 0 0 255 ECU_ADDRESS 0xfe4caf2c /* @ECU_Address@SwcIn_ONEBOX_4.LHRWheelDriveDirection@ */ /end MEASUREMENT
/begin MEASUREMENT SwcIn_ONEBOX_4.LHRWheelSpeedRPM "" FLOAT32_IEEE autosar_swc_val_CM_LHRWheelSpeedRPM_587_dt 0 0 -3.4E+38 3.4E+38 ECU_ADDRESS 0xfe4caef4 /* @ECU_Address@SwcIn_ONEBOX_4.LHRWheelSpeedRPM@ */ /end MEASUREMENT
/begin MEASUREMENT SwcIn_ONEBOX_4.LHRWheelSpeedRaw "" FLOAT32_IEEE autosar_swc_val_CM_LHRWheelSpeedRaw_587_dt 0 0 -3.4E+38 3.4E+38 ECU_ADDRESS 0xfe4caf28 /* @ECU_Address@SwcIn_ONEBOX_4.LHRWheelSpeedRaw@ */ /end MEASUREMENT
/begin MEASUREMENT SwcIn_ONEBOX_4.LHRWheelSpeedRawValidData "" UBYTE autosar_swc_val_CM_LHRWheelSpeedRawValidData_587_dt 0 0 0 255 ECU_ADDRESS 0xfe4caf2d /* @ECU_Address@SwcIn_ONEBOX_4.LHRWheelSpeedRawValidData@ */ /end MEASUREMENT
/begin MEASUREMENT SwcIn_ONEBOX_4.ONEBOX_4_CRC1 "" UBYTE autosar_swc_val_CM_ONEBOX_4_CRC1_587_dt 0 0 0 255 ECU_ADDRESS 0xfe4caee8 /* @ECU_Address@SwcIn_ONEBOX_4.ONEBOX_4_CRC1@ */ /end MEASUREMENT
/begin MEASUREMENT SwcIn_ONEBOX_4.ONEBOX_4_CRC2 "" UBYTE autosar_swc_val_CM_ONEBOX_4_CRC2_587_dt 0 0 0 255 ECU_ADDRESS 0xfe4caef8 /* @ECU_Address@SwcIn_ONEBOX_4.ONEBOX_4_CRC2@ */ /end MEASUREMENT
/begin MEASUREMENT SwcIn_ONEBOX_4.ONEBOX_4_CRC3 "" UBYTE autosar_swc_val_CM_ONEBOX_4_CRC3_587_dt 0 0 0 255 ECU_ADDRESS 0xfe4caf08 /* @ECU_Address@SwcIn_ONEBOX_4.ONEBOX_4_CRC3@ */ /end MEASUREMENT
/begin MEASUREMENT SwcIn_ONEBOX_4.ONEBOX_4_CRC4 "" UBYTE autosar_swc_val_CM_ONEBOX_4_CRC4_587_dt 0 0 0 255 ECU_ADDRESS 0xfe4caf1a /* @ECU_Address@SwcIn_ONEBOX_4.ONEBOX_4_CRC4@ */ /end MEASUREMENT
/begin MEASUREMENT SwcIn_ONEBOX_4.ONEBOX_4_Resd1 "" UBYTE autosar_swc_val_CM_ONEBOX_4_Resd1_587_dt 0 0 0 255 ECU_ADDRESS 0xfe4caeea /* @ECU_Address@SwcIn_ONEBOX_4.ONEBOX_4_Resd1@ */ /end MEASUREMENT
/begin MEASUREMENT SwcIn_ONEBOX_4.ONEBOX_4_Resd2 "" UBYTE autosar_swc_val_CM_ONEBOX_4_Resd2_587_dt 0 0 0 255 ECU_ADDRESS 0xfe4caefa /* @ECU_Address@SwcIn_ONEBOX_4.ONEBOX_4_Resd2@ */ /end MEASUREMENT
/begin MEASUREMENT SwcIn_ONEBOX_4.ONEBOX_4_Resd3 "" UBYTE autosar_swc_val_CM_ONEBOX_4_Resd3_587_dt 0 0 0 255 ECU_ADDRESS 0xfe4caf0a /* @ECU_Address@SwcIn_ONEBOX_4.ONEBOX_4_Resd3@ */ /end MEASUREMENT
/begin MEASUREMENT SwcIn_ONEBOX_4.ONEBOX_4_Resd4 "" UBYTE autosar_swc_val_CM_ONEBOX_4_Resd4_587_dt 0 0 0 255 ECU_ADDRESS 0xfe4caf1c /* @ECU_Address@SwcIn_ONEBOX_4.ONEBOX_4_Resd4@ */ /end MEASUREMENT
/begin MEASUREMENT SwcIn_ONEBOX_4.ONEBOX_4_RollgCntr1 "" UBYTE autosar_swc_val_CM_ONEBOX_4_RollgCntr1_587_dt 0 0 0 255 ECU_ADDRESS 0xfe4caee9 /* @ECU_Address@SwcIn_ONEBOX_4.ONEBOX_4_RollgCntr1@ */ /end MEASUREMENT
/begin MEASUREMENT SwcIn_ONEBOX_4.ONEBOX_4_RollgCntr2 "" UBYTE autosar_swc_val_CM_ONEBOX_4_RollgCntr2_587_dt 0 0 0 255 ECU_ADDRESS 0xfe4caef9 /* @ECU_Address@SwcIn_ONEBOX_4.ONEBOX_4_RollgCntr2@ */ /end MEASUREMENT
/begin MEASUREMENT SwcIn_ONEBOX_4.ONEBOX_4_RollgCntr3 "" UBYTE autosar_swc_val_CM_ONEBOX_4_RollgCntr3_587_dt 0 0 0 255 ECU_ADDRESS 0xfe4caf09 /* @ECU_Address@SwcIn_ONEBOX_4.ONEBOX_4_RollgCntr3@ */ /end MEASUREMENT
/begin MEASUREMENT SwcIn_ONEBOX_4.ONEBOX_4_RollgCntr4 "" UBYTE autosar_swc_val_CM_ONEBOX_4_RollgCntr4_587_dt 0 0 0 255 ECU_ADDRESS 0xfe4caf1b /* @ECU_Address@SwcIn_ONEBOX_4.ONEBOX_4_RollgCntr4@ */ /end MEASUREMENT
/begin MEASUREMENT SwcIn_ONEBOX_4.RHFPulseCounter "" UWORD autosar_swc_val_CM_RHFPulseCounter_587_dt 0 0 0 65535 ECU_ADDRESS 0xfe4caf0c /* @ECU_Address@SwcIn_ONEBOX_4.RHFPulseCounter@ */ /end MEASUREMENT
/begin MEASUREMENT SwcIn_ONEBOX_4.RHFPulseCounterFailSts "" UBYTE autosar_swc_val_CM_RHFPulseCounterFailSts_587_dt 0 0 0 255 ECU_ADDRESS 0xfe4caf0b /* @ECU_Address@SwcIn_ONEBOX_4.RHFPulseCounterFailSts@ */ /end MEASUREMENT
/begin MEASUREMENT SwcIn_ONEBOX_4.RHFWheelDriveDirection "" UBYTE autosar_swc_val_CM_RHFWheelDriveDirection_587_dt 0 0 0 255 ECU_ADDRESS 0xfe4caf24 /* @ECU_Address@SwcIn_ONEBOX_4.RHFWheelDriveDirection@ */ /end MEASUREMENT
/begin MEASUREMENT SwcIn_ONEBOX_4.RHFWheelSpeedRPM "" FLOAT32_IEEE autosar_swc_val_CM_RHFWheelSpeedRPM_587_dt 0 0 -3.4E+38 3.4E+38 ECU_ADDRESS 0xfe4caef0 /* @ECU_Address@SwcIn_ONEBOX_4.RHFWheelSpeedRPM@ */ /end MEASUREMENT
/begin MEASUREMENT SwcIn_ONEBOX_4.RHFWheelSpeedRaw "" FLOAT32_IEEE autosar_swc_val_CM_RHFWheelSpeedRaw_587_dt 0 0 -3.4E+38 3.4E+38 ECU_ADDRESS 0xfe4caf20 /* @ECU_Address@SwcIn_ONEBOX_4.RHFWheelSpeedRaw@ */ /end MEASUREMENT
/begin MEASUREMENT SwcIn_ONEBOX_4.RHFWheelSpeedRawValidData "" UBYTE autosar_swc_val_CM_RHFWheelSpeedRawValidData_587_dt 0 0 0 255 ECU_ADDRESS 0xfe4caf25 /* @ECU_Address@SwcIn_ONEBOX_4.RHFWheelSpeedRawValidData@ */ /end MEASUREMENT
/begin MEASUREMENT SwcIn_ONEBOX_4.RHRPulseCounter "" UWORD autosar_swc_val_CM_RHRPulseCounter_587_dt 0 0 0 65535 ECU_ADDRESS 0xfe4caf06 /* @ECU_Address@SwcIn_ONEBOX_4.RHRPulseCounter@ */ /end MEASUREMENT
/begin MEASUREMENT SwcIn_ONEBOX_4.RHRPulseCounterFailSts "" UBYTE autosar_swc_val_CM_RHRPulseCounterFailSts_587_dt 0 0 0 255 ECU_ADDRESS 0xfe4caf04 /* @ECU_Address@SwcIn_ONEBOX_4.RHRPulseCounterFailSts@ */ /end MEASUREMENT
/begin MEASUREMENT SwcIn_ONEBOX_4.RHRWheelDriveDirection "" UBYTE autosar_swc_val_CM_RHRWheelDriveDirection_587_dt 0 0 0 255 ECU_ADDRESS 0xfe4caf34 /* @ECU_Address@SwcIn_ONEBOX_4.RHRWheelDriveDirection@ */ /end MEASUREMENT
/begin MEASUREMENT SwcIn_ONEBOX_4.RHRWheelSpeedRPM "" FLOAT32_IEEE autosar_swc_val_CM_RHRWheelSpeedRPM_587_dt 0 0 -3.4E+38 3.4E+38 ECU_ADDRESS 0xfe4caefc /* @ECU_Address@SwcIn_ONEBOX_4.RHRWheelSpeedRPM@ */ /end MEASUREMENT
/begin MEASUREMENT SwcIn_ONEBOX_4.RHRWheelSpeedRaw "" FLOAT32_IEEE autosar_swc_val_CM_RHRWheelSpeedRaw_587_dt 0 0 -3.4E+38 3.4E+38 ECU_ADDRESS 0xfe4caf30 /* @ECU_Address@SwcIn_ONEBOX_4.RHRWheelSpeedRaw@ */ /end MEASUREMENT
/begin MEASUREMENT SwcIn_ONEBOX_4.RHRWheelSpeedRawValidData "" UBYTE autosar_swc_val_CM_RHRWheelSpeedRawValidData_587_dt 0 0 0 255 ECU_ADDRESS 0xfe4caf35 /* @ECU_Address@SwcIn_ONEBOX_4.RHRWheelSpeedRawValidData@ */ /end MEASUREMENT
/begin MEASUREMENT SwcIn_ONEBOX_5.ONEBOX_5_APCFailureSts "" UBYTE autosar_swc_val_CM_ONEBOX_5_APCFailureSts_335_dt 0 0 0 255 ECU_ADDRESS 0xfe4cccaa /* @ECU_Address@SwcIn_ONEBOX_5.ONEBOX_5_APCFailureSts@ */ /end MEASUREMENT
/begin MEASUREMENT SwcIn_ONEBOX_5.ONEBOX_5_APCStatus "" UBYTE autosar_swc_val_CM_ONEBOX_5_APCStatus_335_dt 0 0 0 255 ECU_ADDRESS 0xfe4cccab /* @ECU_Address@SwcIn_ONEBOX_5.ONEBOX_5_APCStatus@ */ /end MEASUREMENT
/begin MEASUREMENT SwcIn_ONEBOX_5.ONEBOX_5_AbaActSts "" UBYTE autosar_swc_val_CM_ONEBOX_5_AbaActSts_335_dt 0 0 0 255 ECU_ADDRESS 0xfe4cccb7 /* @ECU_Address@SwcIn_ONEBOX_5.ONEBOX_5_AbaActSts@ */ /end MEASUREMENT
/begin MEASUREMENT SwcIn_ONEBOX_5.ONEBOX_5_AbaAvlSts "" UBYTE autosar_swc_val_CM_ONEBOX_5_AbaAvlSts_335_dt 0 0 0 255 ECU_ADDRESS 0xfe4cccb8 /* @ECU_Address@SwcIn_ONEBOX_5.ONEBOX_5_AbaAvlSts@ */ /end MEASUREMENT
/begin MEASUREMENT SwcIn_ONEBOX_5.ONEBOX_5_AbaLvlSts "" UBYTE autosar_swc_val_CM_ONEBOX_5_AbaLvlSts_335_dt 0 0 0 255 ECU_ADDRESS 0xfe4cccb9 /* @ECU_Address@SwcIn_ONEBOX_5.ONEBOX_5_AbaLvlSts@ */ /end MEASUREMENT
/begin MEASUREMENT SwcIn_ONEBOX_5.ONEBOX_5_AbpActSts "" UBYTE autosar_swc_val_CM_ONEBOX_5_AbpActSts_335_dt 0 0 0 255 ECU_ADDRESS 0xfe4cccb3 /* @ECU_Address@SwcIn_ONEBOX_5.ONEBOX_5_AbpActSts@ */ /end MEASUREMENT
/begin MEASUREMENT SwcIn_ONEBOX_5.ONEBOX_5_AbpAvlSts "" UBYTE autosar_swc_val_CM_ONEBOX_5_AbpAvlSts_335_dt 0 0 0 255 ECU_ADDRESS 0xfe4cccb4 /* @ECU_Address@SwcIn_ONEBOX_5.ONEBOX_5_AbpAvlSts@ */ /end MEASUREMENT
/begin MEASUREMENT SwcIn_ONEBOX_5.ONEBOX_5_ApaAvl "" UBYTE autosar_swc_val_CM_ONEBOX_5_ApaAvl_335_dt 0 0 0 255 ECU_ADDRESS 0xfe4cccac /* @ECU_Address@SwcIn_ONEBOX_5.ONEBOX_5_ApaAvl@ */ /end MEASUREMENT
/begin MEASUREMENT SwcIn_ONEBOX_5.ONEBOX_5_AwbActSts "" UBYTE autosar_swc_val_CM_ONEBOX_5_AwbActSts_335_dt 0 0 0 255 ECU_ADDRESS 0xfe4cccb5 /* @ECU_Address@SwcIn_ONEBOX_5.ONEBOX_5_AwbActSts@ */ /end MEASUREMENT
/begin MEASUREMENT SwcIn_ONEBOX_5.ONEBOX_5_AwbAvlSts "" UBYTE autosar_swc_val_CM_ONEBOX_5_AwbAvlSts_335_dt 0 0 0 255 ECU_ADDRESS 0xfe4cccb6 /* @ECU_Address@SwcIn_ONEBOX_5.ONEBOX_5_AwbAvlSts@ */ /end MEASUREMENT
/begin MEASUREMENT SwcIn_ONEBOX_5.ONEBOX_5_CRC1 "" UBYTE autosar_swc_val_CM_ONEBOX_5_CRC1_335_dt 0 0 0 255 ECU_ADDRESS 0xfe4ccca4 /* @ECU_Address@SwcIn_ONEBOX_5.ONEBOX_5_CRC1@ */ /end MEASUREMENT
/begin MEASUREMENT SwcIn_ONEBOX_5.ONEBOX_5_CddAdcActiveVehHld "" UBYTE autosar_swc_val_CM_ONEBOX_5_CddAdcActiveVehHld_335_dt 0 0 0 255 ECU_ADDRESS 0xfe4ccca9 /* @ECU_Address@SwcIn_ONEBOX_5.ONEBOX_5_CddAdcActiveVehHld@ */ /end MEASUREMENT
/begin MEASUREMENT SwcIn_ONEBOX_5.ONEBOX_5_CddApActiveVehHld "" UBYTE autosar_swc_val_CM_ONEBOX_5_CddApActiveVehHld_335_dt 0 0 0 255 ECU_ADDRESS 0xfe4cccaf /* @ECU_Address@SwcIn_ONEBOX_5.ONEBOX_5_CddApActiveVehHld@ */ /end MEASUREMENT
/begin MEASUREMENT SwcIn_ONEBOX_5.ONEBOX_5_MebAvl "" UBYTE autosar_swc_val_CM_ONEBOX_5_MebAvl_335_dt 0 0 0 255 ECU_ADDRESS 0xfe4cccae /* @ECU_Address@SwcIn_ONEBOX_5.ONEBOX_5_MebAvl@ */ /end MEASUREMENT
/begin MEASUREMENT SwcIn_ONEBOX_5.ONEBOX_5_PilotParkBrkDecActSts "" UBYTE autosar_swc_val_CM_ONEBOX_5_PilotParkBrkDecActSts_335_dt 0 0 0 255 ECU_ADDRESS 0xfe4ccca8 /* @ECU_Address@SwcIn_ONEBOX_5.ONEBOX_5_PilotParkBrkDecActSts@ */ /end MEASUREMENT
/begin MEASUREMENT SwcIn_ONEBOX_5.ONEBOX_5_PilotParkBrkDecCtlAvl "" UBYTE autosar_swc_val_CM_ONEBOX_5_PilotParkBrkDecCtlAvl_335_dt 0 0 0 255 ECU_ADDRESS 0xfe4ccca7 /* @ECU_Address@SwcIn_ONEBOX_5.ONEBOX_5_PilotParkBrkDecCtlAvl@ */ /end MEASUREMENT
/begin MEASUREMENT SwcIn_ONEBOX_5.ONEBOX_5_Resd1 "" UBYTE autosar_swc_val_CM_ONEBOX_5_Resd1_335_dt 0 0 0 255 ECU_ADDRESS 0xfe4ccca6 /* @ECU_Address@SwcIn_ONEBOX_5.ONEBOX_5_Resd1@ */ /end MEASUREMENT
/begin MEASUREMENT SwcIn_ONEBOX_5.ONEBOX_5_RollgCntr1 "" UBYTE autosar_swc_val_CM_ONEBOX_5_RollgCntr1_335_dt 0 0 0 255 ECU_ADDRESS 0xfe4ccca5 /* @ECU_Address@SwcIn_ONEBOX_5.ONEBOX_5_RollgCntr1@ */ /end MEASUREMENT
/begin MEASUREMENT SwcIn_ONEBOX_5.ONEBOX_5_RpaAvl "" UBYTE autosar_swc_val_CM_ONEBOX_5_RpaAvl_335_dt 0 0 0 255 ECU_ADDRESS 0xfe4cccad /* @ECU_Address@SwcIn_ONEBOX_5.ONEBOX_5_RpaAvl@ */ /end MEASUREMENT
/begin MEASUREMENT SwcIn_ONEBOX_5.ONEBOX_5_SysBrkP "" UWORD autosar_swc_val_CM_ONEBOX_5_SysBrkP_335_dt 0 0 0 65535 ECU_ADDRESS 0xfe4cccb0 /* @ECU_Address@SwcIn_ONEBOX_5.ONEBOX_5_SysBrkP@ */ /end MEASUREMENT
/begin MEASUREMENT SwcIn_ONEBOX_5.ONEBOX_5_SysBrkPVld "" UBYTE autosar_swc_val_CM_ONEBOX_5_SysBrkPVld_335_dt 0 0 0 255 ECU_ADDRESS 0xfe4cccb2 /* @ECU_Address@SwcIn_ONEBOX_5.ONEBOX_5_SysBrkPVld@ */ /end MEASUREMENT
/begin MEASUREMENT SwcIn_PPMID_1.PPMID_1_HWSt "" UBYTE autosar_swc_val_CM_PPMID_1_HWSt_1208_dt 0 0 0 255 ECU_ADDRESS 0xfe4ccb30 /* @ECU_Address@SwcIn_PPMID_1.PPMID_1_HWSt@ */ /end MEASUREMENT
/begin MEASUREMENT SwcIn_PPMID_1.PPMID_1_PPMICounter "" UBYTE autosar_swc_val_CM_PPMID_1_PPMICounter_1208_dt 0 0 0 255 ECU_ADDRESS 0xfe4ccb32 /* @ECU_Address@SwcIn_PPMID_1.PPMID_1_PPMICounter@ */ /end MEASUREMENT
/begin MEASUREMENT SwcIn_PPMID_1.PPMID_1_PPMISt "" UBYTE autosar_swc_val_CM_PPMID_1_PPMISt_1208_dt 0 0 0 255 ECU_ADDRESS 0xfe4ccb33 /* @ECU_Address@SwcIn_PPMID_1.PPMID_1_PPMISt@ */ /end MEASUREMENT
/begin MEASUREMENT SwcIn_PPMID_1.PPMID_1_PPSt "" UBYTE autosar_swc_val_CM_PPMID_1_PPSt_1208_dt 0 0 0 255 ECU_ADDRESS 0xfe4ccb31 /* @ECU_Address@SwcIn_PPMID_1.PPMID_1_PPSt@ */ /end MEASUREMENT
/begin MEASUREMENT SwcIn_RLCR_1.RLCR_1_BSDWarn "" UBYTE autosar_swc_val_CM_RLCR_1_BSDWarn_1095_dt 0 0 0 255 ECU_ADDRESS 0xfe4cccbf /* @ECU_Address@SwcIn_RLCR_1.RLCR_1_BSDWarn@ */ /end MEASUREMENT
/begin MEASUREMENT SwcIn_RLCR_1.RLCR_1_BlkSts "" UBYTE autosar_swc_val_CM_RLCR_1_BlkSts_1095_dt 0 0 0 255 ECU_ADDRESS 0xfe4cccbe /* @ECU_Address@SwcIn_RLCR_1.RLCR_1_BlkSts@ */ /end MEASUREMENT
/begin MEASUREMENT SwcIn_RLCR_1.RLCR_1_CRC1 "" UBYTE autosar_swc_val_CM_RLCR_1_CRC1_1095_dt 0 0 0 255 ECU_ADDRESS 0xfe4cccba /* @ECU_Address@SwcIn_RLCR_1.RLCR_1_CRC1@ */ /end MEASUREMENT
/begin MEASUREMENT SwcIn_RLCR_1.RLCR_1_DOWWarn "" UBYTE autosar_swc_val_CM_RLCR_1_DOWWarn_1095_dt 0 0 0 255 ECU_ADDRESS 0xfe4cccc0 /* @ECU_Address@SwcIn_RLCR_1.RLCR_1_DOWWarn@ */ /end MEASUREMENT
/begin MEASUREMENT SwcIn_RLCR_1.RLCR_1_DowLock "" UBYTE autosar_swc_val_CM_RLCR_1_DowLock_1095_dt 0 0 0 255 ECU_ADDRESS 0xfe4cccc1 /* @ECU_Address@SwcIn_RLCR_1.RLCR_1_DowLock@ */ /end MEASUREMENT
/begin MEASUREMENT SwcIn_RLCR_1.RLCR_1_ELK_CollisionFlagValid "" UBYTE autosar_swc_val_CM_RLCR_1_ELK_CollisionFlagValid_1095_dt 0 0 0 255 ECU_ADDRESS 0xfe4cccc3 /* @ECU_Address@SwcIn_RLCR_1.RLCR_1_ELK_CollisionFlagValid@ */ /end MEASUREMENT
/begin MEASUREMENT SwcIn_RLCR_1.RLCR_1_ELK_Collision_flag "" UBYTE autosar_swc_val_CM_RLCR_1_ELK_Collision_flag_1095_dt 0 0 0 255 ECU_ADDRESS 0xfe4cccc2 /* @ECU_Address@SwcIn_RLCR_1.RLCR_1_ELK_Collision_flag@ */ /end MEASUREMENT
/begin MEASUREMENT SwcIn_RLCR_1.RLCR_1_Resd1 "" UBYTE autosar_swc_val_CM_RLCR_1_Resd1_1095_dt 0 0 0 255 ECU_ADDRESS 0xfe4cccbc /* @ECU_Address@SwcIn_RLCR_1.RLCR_1_Resd1@ */ /end MEASUREMENT
/begin MEASUREMENT SwcIn_RLCR_1.RLCR_1_RollgCntr1 "" UBYTE autosar_swc_val_CM_RLCR_1_RollgCntr1_1095_dt 0 0 0 255 ECU_ADDRESS 0xfe4cccbb /* @ECU_Address@SwcIn_RLCR_1.RLCR_1_RollgCntr1@ */ /end MEASUREMENT
/begin MEASUREMENT SwcIn_RLCR_1.RLCR_1_SysSt "" UBYTE autosar_swc_val_CM_RLCR_1_SysSt_1095_dt 0 0 0 255 ECU_ADDRESS 0xfe4cccbd /* @ECU_Address@SwcIn_RLCR_1.RLCR_1_SysSt@ */ /end MEASUREMENT
/begin MEASUREMENT SwcIn_RLCR_2.RLCR_2_BSDLCWONOFFSts "" UBYTE autosar_swc_val_CM_RLCR_2_BSDLCWONOFFSts_1104_dt 0 0 0 255 ECU_ADDRESS 0xfe4caf44 /* @ECU_Address@SwcIn_RLCR_2.RLCR_2_BSDLCWONOFFSts@ */ /end MEASUREMENT
/begin MEASUREMENT SwcIn_RLCR_2.RLCR_2_CRC1 "" UBYTE autosar_swc_val_CM_RLCR_2_CRC1_1104_dt 0 0 0 255 ECU_ADDRESS 0xfe4caf38 /* @ECU_Address@SwcIn_RLCR_2.RLCR_2_CRC1@ */ /end MEASUREMENT
/begin MEASUREMENT SwcIn_RLCR_2.RLCR_2_DOWONOFFSts "" UBYTE autosar_swc_val_CM_RLCR_2_DOWONOFFSts_1104_dt 0 0 0 255 ECU_ADDRESS 0xfe4caf45 /* @ECU_Address@SwcIn_RLCR_2.RLCR_2_DOWONOFFSts@ */ /end MEASUREMENT
/begin MEASUREMENT SwcIn_RLCR_2.RLCR_2_RCTARCTBONOFFSts "" UBYTE autosar_swc_val_CM_RLCR_2_RCTARCTBONOFFSts_1104_dt 0 0 0 255 ECU_ADDRESS 0xfe4caf47 /* @ECU_Address@SwcIn_RLCR_2.RLCR_2_RCTARCTBONOFFSts@ */ /end MEASUREMENT
/begin MEASUREMENT SwcIn_RLCR_2.RLCR_2_RCTAWarn "" UBYTE autosar_swc_val_CM_RLCR_2_RCTAWarn_1104_dt 0 0 0 255 ECU_ADDRESS 0xfe4caf3c /* @ECU_Address@SwcIn_RLCR_2.RLCR_2_RCTAWarn@ */ /end MEASUREMENT
/begin MEASUREMENT SwcIn_RLCR_2.RLCR_2_RCTBCtrlA "" FLOAT32_IEEE autosar_swc_val_CM_RLCR_2_RCTBCtrlA_1104_dt 0 0 -3.4E+38 3.4E+38 ECU_ADDRESS 0xfe4caf40 /* @ECU_Address@SwcIn_RLCR_2.RLCR_2_RCTBCtrlA@ */ /end MEASUREMENT
/begin MEASUREMENT SwcIn_RLCR_2.RLCR_2_RCTBReq "" UBYTE autosar_swc_val_CM_RLCR_2_RCTBReq_1104_dt 0 0 0 255 ECU_ADDRESS 0xfe4caf3e /* @ECU_Address@SwcIn_RLCR_2.RLCR_2_RCTBReq@ */ /end MEASUREMENT
/begin MEASUREMENT SwcIn_RLCR_2.RLCR_2_RCTBWarn "" UBYTE autosar_swc_val_CM_RLCR_2_RCTBWarn_1104_dt 0 0 0 255 ECU_ADDRESS 0xfe4caf3d /* @ECU_Address@SwcIn_RLCR_2.RLCR_2_RCTBWarn@ */ /end MEASUREMENT
/begin MEASUREMENT SwcIn_RLCR_2.RLCR_2_RCWONOFFSts "" UBYTE autosar_swc_val_CM_RLCR_2_RCWONOFFSts_1104_dt 0 0 0 255 ECU_ADDRESS 0xfe4caf46 /* @ECU_Address@SwcIn_RLCR_2.RLCR_2_RCWONOFFSts@ */ /end MEASUREMENT
/begin MEASUREMENT SwcIn_RLCR_2.RLCR_2_RCWWarn "" UBYTE autosar_swc_val_CM_RLCR_2_RCWWarn_1104_dt 0 0 0 255 ECU_ADDRESS 0xfe4caf3b /* @ECU_Address@SwcIn_RLCR_2.RLCR_2_RCWWarn@ */ /end MEASUREMENT
/begin MEASUREMENT SwcIn_RLCR_2.RLCR_2_Resd1 "" UBYTE autosar_swc_val_CM_RLCR_2_Resd1_1104_dt 0 0 0 255 ECU_ADDRESS 0xfe4caf3a /* @ECU_Address@SwcIn_RLCR_2.RLCR_2_Resd1@ */ /end MEASUREMENT
/begin MEASUREMENT SwcIn_RLCR_2.RLCR_2_RollgCntr1 "" UBYTE autosar_swc_val_CM_RLCR_2_RollgCntr1_1104_dt 0 0 0 255 ECU_ADDRESS 0xfe4caf39 /* @ECU_Address@SwcIn_RLCR_2.RLCR_2_RollgCntr1@ */ /end MEASUREMENT
/begin MEASUREMENT SwcIn_RLCR_3.RLCR_3_CRC "" UWORD autosar_swc_val_CM_RLCR_3_CRC_935_dt 0 0 0 65535 ECU_ADDRESS 0xfe4caf48 /* @ECU_Address@SwcIn_RLCR_3.RLCR_3_CRC@ */ /end MEASUREMENT
/begin MEASUREMENT SwcIn_RLCR_3.RLCR_3_Le1HdTo "" FLOAT32_IEEE autosar_swc_val_CM_RLCR_3_Le1HdTo_935_dt 0 0 -3.4E+38 3.4E+38 ECU_ADDRESS 0xfe4caf54 /* @ECU_Address@SwcIn_RLCR_3.RLCR_3_Le1HdTo@ */ /end MEASUREMENT
/begin MEASUREMENT SwcIn_RLCR_3.RLCR_3_Le1ObjBoxLen "" FLOAT32_IEEE autosar_swc_val_CM_RLCR_3_Le1ObjBoxLen_935_dt 0 0 -3.4E+38 3.4E+38 ECU_ADDRESS 0xfe4caf4c /* @ECU_Address@SwcIn_RLCR_3.RLCR_3_Le1ObjBoxLen@ */ /end MEASUREMENT
/begin MEASUREMENT SwcIn_RLCR_3.RLCR_3_Le1ObjBoxWidth "" FLOAT32_IEEE autosar_swc_val_CM_RLCR_3_Le1ObjBoxWidth_935_dt 0 0 -3.4E+38 3.4E+38 ECU_ADDRESS 0xfe4caf50 /* @ECU_Address@SwcIn_RLCR_3.RLCR_3_Le1ObjBoxWidth@ */ /end MEASUREMENT
/begin MEASUREMENT SwcIn_RLCR_3.RLCR_3_Le1ObjConf "" UBYTE autosar_swc_val_CM_RLCR_3_Le1ObjConf_935_dt 0 0 0 255 ECU_ADDRESS 0xfe4caf72 /* @ECU_Address@SwcIn_RLCR_3.RLCR_3_Le1ObjConf@ */ /end MEASUREMENT
/begin MEASUREMENT SwcIn_RLCR_3.RLCR_3_Le1ObjCoordX "" FLOAT32_IEEE autosar_swc_val_CM_RLCR_3_Le1ObjCoordX_935_dt 0 0 -3.4E+38 3.4E+38 ECU_ADDRESS 0xfe4caf60 /* @ECU_Address@SwcIn_RLCR_3.RLCR_3_Le1ObjCoordX@ */ /end MEASUREMENT
/begin MEASUREMENT SwcIn_RLCR_3.RLCR_3_Le1ObjCoordXDstStdDe "" FLOAT32_IEEE autosar_swc_val_CM_RLCR_3_Le1ObjCoordXDstStdDe_935_dt 0 0 -3.4E+38 3.4E+38 ECU_ADDRESS 0xfe4caf78 /* @ECU_Address@SwcIn_RLCR_3.RLCR_3_Le1ObjCoordXDstStdDe@ */ /end MEASUREMENT
/begin MEASUREMENT SwcIn_RLCR_3.RLCR_3_Le1ObjCoordY "" FLOAT32_IEEE autosar_swc_val_CM_RLCR_3_Le1ObjCoordY_935_dt 0 0 -3.4E+38 3.4E+38 ECU_ADDRESS 0xfe4caf5c /* @ECU_Address@SwcIn_RLCR_3.RLCR_3_Le1ObjCoordY@ */ /end MEASUREMENT
/begin MEASUREMENT SwcIn_RLCR_3.RLCR_3_Le1ObjCoordYDstStdDe "" FLOAT32_IEEE autosar_swc_val_CM_RLCR_3_Le1ObjCoordYDstStdDe_935_dt 0 0 -3.4E+38 3.4E+38 ECU_ADDRESS 0xfe4caf7c /* @ECU_Address@SwcIn_RLCR_3.RLCR_3_Le1ObjCoordYDstStdDe@ */ /end MEASUREMENT
/begin MEASUREMENT SwcIn_RLCR_3.RLCR_3_Le1ObjID "" UBYTE autosar_swc_val_CM_RLCR_3_Le1ObjID_935_dt 0 0 0 255 ECU_ADDRESS 0xfe4caf58 /* @ECU_Address@SwcIn_RLCR_3.RLCR_3_Le1ObjID@ */ /end MEASUREMENT
/begin MEASUREMENT SwcIn_RLCR_3.RLCR_3_Le1ObjMtnChartc "" UBYTE autosar_swc_val_CM_RLCR_3_Le1ObjMtnChartc_935_dt 0 0 0 255 ECU_ADDRESS 0xfe4caf70 /* @ECU_Address@SwcIn_RLCR_3.RLCR_3_Le1ObjMtnChartc@ */ /end MEASUREMENT
/begin MEASUREMENT SwcIn_RLCR_3.RLCR_3_Le1ObjNrOffocst "" UBYTE autosar_swc_val_CM_RLCR_3_Le1ObjNrOffocst_935_dt 0 0 0 255 ECU_ADDRESS 0xfe4caf73 /* @ECU_Address@SwcIn_RLCR_3.RLCR_3_Le1ObjNrOffocst@ */ /end MEASUREMENT
/begin MEASUREMENT SwcIn_RLCR_3.RLCR_3_Le1ObjTrackSt "" UBYTE autosar_swc_val_CM_RLCR_3_Le1ObjTrackSt_935_dt 0 0 0 255 ECU_ADDRESS 0xfe4caf74 /* @ECU_Address@SwcIn_RLCR_3.RLCR_3_Le1ObjTrackSt@ */ /end MEASUREMENT
/begin MEASUREMENT SwcIn_RLCR_3.RLCR_3_Le1ObjTyp "" UBYTE autosar_swc_val_CM_RLCR_3_Le1ObjTyp_935_dt 0 0 0 255 ECU_ADDRESS 0xfe4caf71 /* @ECU_Address@SwcIn_RLCR_3.RLCR_3_Le1ObjTyp@ */ /end MEASUREMENT
/begin MEASUREMENT SwcIn_RLCR_3.RLCR_3_Le1ObjXDirAV "" FLOAT32_IEEE autosar_swc_val_CM_RLCR_3_Le1ObjXDirAV_935_dt 0 0 -3.4E+38 3.4E+38 ECU_ADDRESS 0xfe4caf64 /* @ECU_Address@SwcIn_RLCR_3.RLCR_3_Le1ObjXDirAV@ */ /end MEASUREMENT
/begin MEASUREMENT SwcIn_RLCR_3.RLCR_3_Le1ObjXDirV "" FLOAT32_IEEE autosar_swc_val_CM_RLCR_3_Le1ObjXDirV_935_dt 0 0 -3.4E+38 3.4E+38 ECU_ADDRESS 0xfe4caf6c /* @ECU_Address@SwcIn_RLCR_3.RLCR_3_Le1ObjXDirV@ */ /end MEASUREMENT
/begin MEASUREMENT SwcIn_RLCR_3.RLCR_3_Le1ObjXDirVStdDe "" FLOAT32_IEEE autosar_swc_val_CM_RLCR_3_Le1ObjXDirVStdDe_935_dt 0 0 -3.4E+38 3.4E+38 ECU_ADDRESS 0xfe4caf80 /* @ECU_Address@SwcIn_RLCR_3.RLCR_3_Le1ObjXDirVStdDe@ */ /end MEASUREMENT
/begin MEASUREMENT SwcIn_RLCR_3.RLCR_3_Le1ObjYDirV "" FLOAT32_IEEE autosar_swc_val_CM_RLCR_3_Le1ObjYDirV_935_dt 0 0 -3.4E+38 3.4E+38 ECU_ADDRESS 0xfe4caf68 /* @ECU_Address@SwcIn_RLCR_3.RLCR_3_Le1ObjYDirV@ */ /end MEASUREMENT
/begin MEASUREMENT SwcIn_RLCR_3.RLCR_3_Le1ObjYDirVStdDe "" FLOAT32_IEEE autosar_swc_val_CM_RLCR_3_Le1ObjYDirVStdDe_935_dt 0 0 -3.4E+38 3.4E+38 ECU_ADDRESS 0xfe4caf84 /* @ECU_Address@SwcIn_RLCR_3.RLCR_3_Le1ObjYDirVStdDe@ */ /end MEASUREMENT
/begin MEASUREMENT SwcIn_RLCR_3.RLCR_3_RollgCntr "" UBYTE autosar_swc_val_CM_RLCR_3_RollgCntr_935_dt 0 0 0 255 ECU_ADDRESS 0xfe4caf4a /* @ECU_Address@SwcIn_RLCR_3.RLCR_3_RollgCntr@ */ /end MEASUREMENT
/begin MEASUREMENT SwcIn_RLCR_4.RLCR_4_CRC "" UWORD autosar_swc_val_CM_RLCR_4_CRC_937_dt 0 0 0 65535 ECU_ADDRESS 0xfe4caf88 /* @ECU_Address@SwcIn_RLCR_4.RLCR_4_CRC@ */ /end MEASUREMENT
/begin MEASUREMENT SwcIn_RLCR_4.RLCR_4_Le2HdTo "" FLOAT32_IEEE autosar_swc_val_CM_RLCR_4_Le2HdTo_937_dt 0 0 -3.4E+38 3.4E+38 ECU_ADDRESS 0xfe4caf94 /* @ECU_Address@SwcIn_RLCR_4.RLCR_4_Le2HdTo@ */ /end MEASUREMENT
/begin MEASUREMENT SwcIn_RLCR_4.RLCR_4_Le2ObjBoxLen "" FLOAT32_IEEE autosar_swc_val_CM_RLCR_4_Le2ObjBoxLen_937_dt 0 0 -3.4E+38 3.4E+38 ECU_ADDRESS 0xfe4caf8c /* @ECU_Address@SwcIn_RLCR_4.RLCR_4_Le2ObjBoxLen@ */ /end MEASUREMENT
/begin MEASUREMENT SwcIn_RLCR_4.RLCR_4_Le2ObjBoxWidth "" FLOAT32_IEEE autosar_swc_val_CM_RLCR_4_Le2ObjBoxWidth_937_dt 0 0 -3.4E+38 3.4E+38 ECU_ADDRESS 0xfe4caf90 /* @ECU_Address@SwcIn_RLCR_4.RLCR_4_Le2ObjBoxWidth@ */ /end MEASUREMENT
/begin MEASUREMENT SwcIn_RLCR_4.RLCR_4_Le2ObjConf "" UBYTE autosar_swc_val_CM_RLCR_4_Le2ObjConf_937_dt 0 0 0 255 ECU_ADDRESS 0xfe4cafb2 /* @ECU_Address@SwcIn_RLCR_4.RLCR_4_Le2ObjConf@ */ /end MEASUREMENT
/begin MEASUREMENT SwcIn_RLCR_4.RLCR_4_Le2ObjCoordX "" FLOAT32_IEEE autosar_swc_val_CM_RLCR_4_Le2ObjCoordX_937_dt 0 0 -3.4E+38 3.4E+38 ECU_ADDRESS 0xfe4cafa0 /* @ECU_Address@SwcIn_RLCR_4.RLCR_4_Le2ObjCoordX@ */ /end MEASUREMENT
/begin MEASUREMENT SwcIn_RLCR_4.RLCR_4_Le2ObjCoordXDstStdDe "" FLOAT32_IEEE autosar_swc_val_CM_RLCR_4_Le2ObjCoordXDstStdDe_937_dt 0 0 -3.4E+38 3.4E+38 ECU_ADDRESS 0xfe4cafb8 /* @ECU_Address@SwcIn_RLCR_4.RLCR_4_Le2ObjCoordXDstStdDe@ */ /end MEASUREMENT
/begin MEASUREMENT SwcIn_RLCR_4.RLCR_4_Le2ObjCoordY "" FLOAT32_IEEE autosar_swc_val_CM_RLCR_4_Le2ObjCoordY_937_dt 0 0 -3.4E+38 3.4E+38 ECU_ADDRESS 0xfe4caf9c /* @ECU_Address@SwcIn_RLCR_4.RLCR_4_Le2ObjCoordY@ */ /end MEASUREMENT
/begin MEASUREMENT SwcIn_RLCR_4.RLCR_4_Le2ObjCoordYDstStdDe "" FLOAT32_IEEE autosar_swc_val_CM_RLCR_4_Le2ObjCoordYDstStdDe_937_dt 0 0 -3.4E+38 3.4E+38 ECU_ADDRESS 0xfe4cafbc /* @ECU_Address@SwcIn_RLCR_4.RLCR_4_Le2ObjCoordYDstStdDe@ */ /end MEASUREMENT
/begin MEASUREMENT SwcIn_RLCR_4.RLCR_4_Le2ObjID "" UBYTE autosar_swc_val_CM_RLCR_4_Le2ObjID_937_dt 0 0 0 255 ECU_ADDRESS 0xfe4caf98 /* @ECU_Address@SwcIn_RLCR_4.RLCR_4_Le2ObjID@ */ /end MEASUREMENT
/begin MEASUREMENT SwcIn_RLCR_4.RLCR_4_Le2ObjMtnChartc "" UBYTE autosar_swc_val_CM_RLCR_4_Le2ObjMtnChartc_937_dt 0 0 0 255 ECU_ADDRESS 0xfe4cafb0 /* @ECU_Address@SwcIn_RLCR_4.RLCR_4_Le2ObjMtnChartc@ */ /end MEASUREMENT
/begin MEASUREMENT SwcIn_RLCR_4.RLCR_4_Le2ObjNrOffocst "" UBYTE autosar_swc_val_CM_RLCR_4_Le2ObjNrOffocst_937_dt 0 0 0 255 ECU_ADDRESS 0xfe4cafb3 /* @ECU_Address@SwcIn_RLCR_4.RLCR_4_Le2ObjNrOffocst@ */ /end MEASUREMENT
/begin MEASUREMENT SwcIn_RLCR_4.RLCR_4_Le2ObjTrackSt "" UBYTE autosar_swc_val_CM_RLCR_4_Le2ObjTrackSt_937_dt 0 0 0 255 ECU_ADDRESS 0xfe4cafb4 /* @ECU_Address@SwcIn_RLCR_4.RLCR_4_Le2ObjTrackSt@ */ /end MEASUREMENT
/begin MEASUREMENT SwcIn_RLCR_4.RLCR_4_Le2ObjTyp "" UBYTE autosar_swc_val_CM_RLCR_4_Le2ObjTyp_937_dt 0 0 0 255 ECU_ADDRESS 0xfe4cafb1 /* @ECU_Address@SwcIn_RLCR_4.RLCR_4_Le2ObjTyp@ */ /end MEASUREMENT
/begin MEASUREMENT SwcIn_RLCR_4.RLCR_4_Le2ObjXDirAV "" FLOAT32_IEEE autosar_swc_val_CM_RLCR_4_Le2ObjXDirAV_937_dt 0 0 -3.4E+38 3.4E+38 ECU_ADDRESS 0xfe4cafa4 /* @ECU_Address@SwcIn_RLCR_4.RLCR_4_Le2ObjXDirAV@ */ /end MEASUREMENT
/begin MEASUREMENT SwcIn_RLCR_4.RLCR_4_Le2ObjXDirV "" FLOAT32_IEEE autosar_swc_val_CM_RLCR_4_Le2ObjXDirV_937_dt 0 0 -3.4E+38 3.4E+38 ECU_ADDRESS 0xfe4cafac /* @ECU_Address@SwcIn_RLCR_4.RLCR_4_Le2ObjXDirV@ */ /end MEASUREMENT
/begin MEASUREMENT SwcIn_RLCR_4.RLCR_4_Le2ObjXDirVStdDe "" FLOAT32_IEEE autosar_swc_val_CM_RLCR_4_Le2ObjXDirVStdDe_937_dt 0 0 -3.4E+38 3.4E+38 ECU_ADDRESS 0xfe4cafc0 /* @ECU_Address@SwcIn_RLCR_4.RLCR_4_Le2ObjXDirVStdDe@ */ /end MEASUREMENT
/begin MEASUREMENT SwcIn_RLCR_4.RLCR_4_Le2ObjYDirV "" FLOAT32_IEEE autosar_swc_val_CM_RLCR_4_Le2ObjYDirV_937_dt 0 0 -3.4E+38 3.4E+38 ECU_ADDRESS 0xfe4cafa8 /* @ECU_Address@SwcIn_RLCR_4.RLCR_4_Le2ObjYDirV@ */ /end MEASUREMENT
/begin MEASUREMENT SwcIn_RLCR_4.RLCR_4_Le2ObjYDirVStdDe "" FLOAT32_IEEE autosar_swc_val_CM_RLCR_4_Le2ObjYDirVStdDe_937_dt 0 0 -3.4E+38 3.4E+38 ECU_ADDRESS 0xfe4cafc4 /* @ECU_Address@SwcIn_RLCR_4.RLCR_4_Le2ObjYDirVStdDe@ */ /end MEASUREMENT
/begin MEASUREMENT SwcIn_RLCR_4.RLCR_4_RollgCntr "" UBYTE autosar_swc_val_CM_RLCR_4_RollgCntr_937_dt 0 0 0 255 ECU_ADDRESS 0xfe4caf8a /* @ECU_Address@SwcIn_RLCR_4.RLCR_4_RollgCntr@ */ /end MEASUREMENT
/begin MEASUREMENT SwcIn_RLCR_5.RLCR_5_CRC "" UWORD autosar_swc_val_CM_RLCR_5_CRC_941_dt 0 0 0 65535 ECU_ADDRESS 0xfe4cafc8 /* @ECU_Address@SwcIn_RLCR_5.RLCR_5_CRC@ */ /end MEASUREMENT
/begin MEASUREMENT SwcIn_RLCR_5.RLCR_5_Le3HdTo "" FLOAT32_IEEE autosar_swc_val_CM_RLCR_5_Le3HdTo_941_dt 0 0 -3.4E+38 3.4E+38 ECU_ADDRESS 0xfe4cafd4 /* @ECU_Address@SwcIn_RLCR_5.RLCR_5_Le3HdTo@ */ /end MEASUREMENT
/begin MEASUREMENT SwcIn_RLCR_5.RLCR_5_Le3ObjBoxLen "" FLOAT32_IEEE autosar_swc_val_CM_RLCR_5_Le3ObjBoxLen_941_dt 0 0 -3.4E+38 3.4E+38 ECU_ADDRESS 0xfe4cafcc /* @ECU_Address@SwcIn_RLCR_5.RLCR_5_Le3ObjBoxLen@ */ /end MEASUREMENT
/begin MEASUREMENT SwcIn_RLCR_5.RLCR_5_Le3ObjBoxWidth "" FLOAT32_IEEE autosar_swc_val_CM_RLCR_5_Le3ObjBoxWidth_941_dt 0 0 -3.4E+38 3.4E+38 ECU_ADDRESS 0xfe4cafd0 /* @ECU_Address@SwcIn_RLCR_5.RLCR_5_Le3ObjBoxWidth@ */ /end MEASUREMENT
/begin MEASUREMENT SwcIn_RLCR_5.RLCR_5_Le3ObjConf "" UBYTE autosar_swc_val_CM_RLCR_5_Le3ObjConf_941_dt 0 0 0 255 ECU_ADDRESS 0xfe4caff2 /* @ECU_Address@SwcIn_RLCR_5.RLCR_5_Le3ObjConf@ */ /end MEASUREMENT
/begin MEASUREMENT SwcIn_RLCR_5.RLCR_5_Le3ObjCoordX "" FLOAT32_IEEE autosar_swc_val_CM_RLCR_5_Le3ObjCoordX_941_dt 0 0 -3.4E+38 3.4E+38 ECU_ADDRESS 0xfe4cafe0 /* @ECU_Address@SwcIn_RLCR_5.RLCR_5_Le3ObjCoordX@ */ /end MEASUREMENT
/begin MEASUREMENT SwcIn_RLCR_5.RLCR_5_Le3ObjCoordXDstStdDe "" FLOAT32_IEEE autosar_swc_val_CM_RLCR_5_Le3ObjCoordXDstStdDe_941_dt 0 0 -3.4E+38 3.4E+38 ECU_ADDRESS 0xfe4caff8 /* @ECU_Address@SwcIn_RLCR_5.RLCR_5_Le3ObjCoordXDstStdDe@ */ /end MEASUREMENT
/begin MEASUREMENT SwcIn_RLCR_5.RLCR_5_Le3ObjCoordY "" FLOAT32_IEEE autosar_swc_val_CM_RLCR_5_Le3ObjCoordY_941_dt 0 0 -3.4E+38 3.4E+38 ECU_ADDRESS 0xfe4cafdc /* @ECU_Address@SwcIn_RLCR_5.RLCR_5_Le3ObjCoordY@ */ /end MEASUREMENT
/begin MEASUREMENT SwcIn_RLCR_5.RLCR_5_Le3ObjCoordYDstStdDe "" FLOAT32_IEEE autosar_swc_val_CM_RLCR_5_Le3ObjCoordYDstStdDe_941_dt 0 0 -3.4E+38 3.4E+38 ECU_ADDRESS 0xfe4caffc /* @ECU_Address@SwcIn_RLCR_5.RLCR_5_Le3ObjCoordYDstStdDe@ */ /end MEASUREMENT
/begin MEASUREMENT SwcIn_RLCR_5.RLCR_5_Le3ObjID "" UBYTE autosar_swc_val_CM_RLCR_5_Le3ObjID_941_dt 0 0 0 255 ECU_ADDRESS 0xfe4cafd8 /* @ECU_Address@SwcIn_RLCR_5.RLCR_5_Le3ObjID@ */ /end MEASUREMENT
/begin MEASUREMENT SwcIn_RLCR_5.RLCR_5_Le3ObjMtnChartc "" UBYTE autosar_swc_val_CM_RLCR_5_Le3ObjMtnChartc_941_dt 0 0 0 255 ECU_ADDRESS 0xfe4caff0 /* @ECU_Address@SwcIn_RLCR_5.RLCR_5_Le3ObjMtnChartc@ */ /end MEASUREMENT
/begin MEASUREMENT SwcIn_RLCR_5.RLCR_5_Le3ObjNrOffocst "" UBYTE autosar_swc_val_CM_RLCR_5_Le3ObjNrOffocst_941_dt 0 0 0 255 ECU_ADDRESS 0xfe4caff3 /* @ECU_Address@SwcIn_RLCR_5.RLCR_5_Le3ObjNrOffocst@ */ /end MEASUREMENT
/begin MEASUREMENT SwcIn_RLCR_5.RLCR_5_Le3ObjTrackSt "" UBYTE autosar_swc_val_CM_RLCR_5_Le3ObjTrackSt_941_dt 0 0 0 255 ECU_ADDRESS 0xfe4caff4 /* @ECU_Address@SwcIn_RLCR_5.RLCR_5_Le3ObjTrackSt@ */ /end MEASUREMENT
/begin MEASUREMENT SwcIn_RLCR_5.RLCR_5_Le3ObjTyp "" UBYTE autosar_swc_val_CM_RLCR_5_Le3ObjTyp_941_dt 0 0 0 255 ECU_ADDRESS 0xfe4caff1 /* @ECU_Address@SwcIn_RLCR_5.RLCR_5_Le3ObjTyp@ */ /end MEASUREMENT
/begin MEASUREMENT SwcIn_RLCR_5.RLCR_5_Le3ObjXDirAV "" FLOAT32_IEEE autosar_swc_val_CM_RLCR_5_Le3ObjXDirAV_941_dt 0 0 -3.4E+38 3.4E+38 ECU_ADDRESS 0xfe4cafe4 /* @ECU_Address@SwcIn_RLCR_5.RLCR_5_Le3ObjXDirAV@ */ /end MEASUREMENT
/begin MEASUREMENT SwcIn_RLCR_5.RLCR_5_Le3ObjXDirV "" FLOAT32_IEEE autosar_swc_val_CM_RLCR_5_Le3ObjXDirV_941_dt 0 0 -3.4E+38 3.4E+38 ECU_ADDRESS 0xfe4cafec /* @ECU_Address@SwcIn_RLCR_5.RLCR_5_Le3ObjXDirV@ */ /end MEASUREMENT
/begin MEASUREMENT SwcIn_RLCR_5.RLCR_5_Le3ObjXDirVStdDe "" FLOAT32_IEEE autosar_swc_val_CM_RLCR_5_Le3ObjXDirVStdDe_941_dt 0 0 -3.4E+38 3.4E+38 ECU_ADDRESS 0xfe4cb000 /* @ECU_Address@SwcIn_RLCR_5.RLCR_5_Le3ObjXDirVStdDe@ */ /end MEASUREMENT
/begin MEASUREMENT SwcIn_RLCR_5.RLCR_5_Le3ObjYDirV "" FLOAT32_IEEE autosar_swc_val_CM_RLCR_5_Le3ObjYDirV_941_dt 0 0 -3.4E+38 3.4E+38 ECU_ADDRESS 0xfe4cafe8 /* @ECU_Address@SwcIn_RLCR_5.RLCR_5_Le3ObjYDirV@ */ /end MEASUREMENT
/begin MEASUREMENT SwcIn_RLCR_5.RLCR_5_Le3ObjYDirVStdDe "" FLOAT32_IEEE autosar_swc_val_CM_RLCR_5_Le3ObjYDirVStdDe_941_dt 0 0 -3.4E+38 3.4E+38 ECU_ADDRESS 0xfe4cb004 /* @ECU_Address@SwcIn_RLCR_5.RLCR_5_Le3ObjYDirVStdDe@ */ /end MEASUREMENT
/begin MEASUREMENT SwcIn_RLCR_5.RLCR_5_RollgCntr "" UBYTE autosar_swc_val_CM_RLCR_5_RollgCntr_941_dt 0 0 0 255 ECU_ADDRESS 0xfe4cafca /* @ECU_Address@SwcIn_RLCR_5.RLCR_5_RollgCntr@ */ /end MEASUREMENT
/begin MEASUREMENT SwcIn_RLCR_6.RLCR_6_CRC "" UWORD autosar_swc_val_CM_RLCR_6_CRC_946_dt 0 0 0 65535 ECU_ADDRESS 0xfe4cb008 /* @ECU_Address@SwcIn_RLCR_6.RLCR_6_CRC@ */ /end MEASUREMENT
/begin MEASUREMENT SwcIn_RLCR_6.RLCR_6_Le4HdTo "" FLOAT32_IEEE autosar_swc_val_CM_RLCR_6_Le4HdTo_946_dt 0 0 -3.4E+38 3.4E+38 ECU_ADDRESS 0xfe4cb014 /* @ECU_Address@SwcIn_RLCR_6.RLCR_6_Le4HdTo@ */ /end MEASUREMENT
/begin MEASUREMENT SwcIn_RLCR_6.RLCR_6_Le4ObjBoxLen "" FLOAT32_IEEE autosar_swc_val_CM_RLCR_6_Le4ObjBoxLen_946_dt 0 0 -3.4E+38 3.4E+38 ECU_ADDRESS 0xfe4cb00c /* @ECU_Address@SwcIn_RLCR_6.RLCR_6_Le4ObjBoxLen@ */ /end MEASUREMENT
/begin MEASUREMENT SwcIn_RLCR_6.RLCR_6_Le4ObjBoxWidth "" FLOAT32_IEEE autosar_swc_val_CM_RLCR_6_Le4ObjBoxWidth_946_dt 0 0 -3.4E+38 3.4E+38 ECU_ADDRESS 0xfe4cb010 /* @ECU_Address@SwcIn_RLCR_6.RLCR_6_Le4ObjBoxWidth@ */ /end MEASUREMENT
/begin MEASUREMENT SwcIn_RLCR_6.RLCR_6_Le4ObjConf "" UBYTE autosar_swc_val_CM_RLCR_6_Le4ObjConf_946_dt 0 0 0 255 ECU_ADDRESS 0xfe4cb032 /* @ECU_Address@SwcIn_RLCR_6.RLCR_6_Le4ObjConf@ */ /end MEASUREMENT
/begin MEASUREMENT SwcIn_RLCR_6.RLCR_6_Le4ObjCoordX "" FLOAT32_IEEE autosar_swc_val_CM_RLCR_6_Le4ObjCoordX_946_dt 0 0 -3.4E+38 3.4E+38 ECU_ADDRESS 0xfe4cb020 /* @ECU_Address@SwcIn_RLCR_6.RLCR_6_Le4ObjCoordX@ */ /end MEASUREMENT
/begin MEASUREMENT SwcIn_RLCR_6.RLCR_6_Le4ObjCoordXDstStdDe "" FLOAT32_IEEE autosar_swc_val_CM_RLCR_6_Le4ObjCoordXDstStdDe_946_dt 0 0 -3.4E+38 3.4E+38 ECU_ADDRESS 0xfe4cb038 /* @ECU_Address@SwcIn_RLCR_6.RLCR_6_Le4ObjCoordXDstStdDe@ */ /end MEASUREMENT
/begin MEASUREMENT SwcIn_RLCR_6.RLCR_6_Le4ObjCoordY "" FLOAT32_IEEE autosar_swc_val_CM_RLCR_6_Le4ObjCoordY_946_dt 0 0 -3.4E+38 3.4E+38 ECU_ADDRESS 0xfe4cb01c /* @ECU_Address@SwcIn_RLCR_6.RLCR_6_Le4ObjCoordY@ */ /end MEASUREMENT
/begin MEASUREMENT SwcIn_RLCR_6.RLCR_6_Le4ObjCoordYDstStdDe "" FLOAT32_IEEE autosar_swc_val_CM_RLCR_6_Le4ObjCoordYDstStdDe_946_dt 0 0 -3.4E+38 3.4E+38 ECU_ADDRESS 0xfe4cb03c /* @ECU_Address@SwcIn_RLCR_6.RLCR_6_Le4ObjCoordYDstStdDe@ */ /end MEASUREMENT
/begin MEASUREMENT SwcIn_RLCR_6.RLCR_6_Le4ObjID "" UBYTE autosar_swc_val_CM_RLCR_6_Le4ObjID_946_dt 0 0 0 255 ECU_ADDRESS 0xfe4cb018 /* @ECU_Address@SwcIn_RLCR_6.RLCR_6_Le4ObjID@ */ /end MEASUREMENT
/begin MEASUREMENT SwcIn_RLCR_6.RLCR_6_Le4ObjMtnChartc "" UBYTE autosar_swc_val_CM_RLCR_6_Le4ObjMtnChartc_946_dt 0 0 0 255 ECU_ADDRESS 0xfe4cb030 /* @ECU_Address@SwcIn_RLCR_6.RLCR_6_Le4ObjMtnChartc@ */ /end MEASUREMENT
/begin MEASUREMENT SwcIn_RLCR_6.RLCR_6_Le4ObjNrOffocst "" UBYTE autosar_swc_val_CM_RLCR_6_Le4ObjNrOffocst_946_dt 0 0 0 255 ECU_ADDRESS 0xfe4cb033 /* @ECU_Address@SwcIn_RLCR_6.RLCR_6_Le4ObjNrOffocst@ */ /end MEASUREMENT
/begin MEASUREMENT SwcIn_RLCR_6.RLCR_6_Le4ObjTrackSt "" UBYTE autosar_swc_val_CM_RLCR_6_Le4ObjTrackSt_946_dt 0 0 0 255 ECU_ADDRESS 0xfe4cb034 /* @ECU_Address@SwcIn_RLCR_6.RLCR_6_Le4ObjTrackSt@ */ /end MEASUREMENT
/begin MEASUREMENT SwcIn_RLCR_6.RLCR_6_Le4ObjTyp "" UBYTE autosar_swc_val_CM_RLCR_6_Le4ObjTyp_946_dt 0 0 0 255 ECU_ADDRESS 0xfe4cb031 /* @ECU_Address@SwcIn_RLCR_6.RLCR_6_Le4ObjTyp@ */ /end MEASUREMENT
/begin MEASUREMENT SwcIn_RLCR_6.RLCR_6_Le4ObjXDirAV "" FLOAT32_IEEE autosar_swc_val_CM_RLCR_6_Le4ObjXDirAV_946_dt 0 0 -3.4E+38 3.4E+38 ECU_ADDRESS 0xfe4cb024 /* @ECU_Address@SwcIn_RLCR_6.RLCR_6_Le4ObjXDirAV@ */ /end MEASUREMENT
/begin MEASUREMENT SwcIn_RLCR_6.RLCR_6_Le4ObjXDirV "" FLOAT32_IEEE autosar_swc_val_CM_RLCR_6_Le4ObjXDirV_946_dt 0 0 -3.4E+38 3.4E+38 ECU_ADDRESS 0xfe4cb02c /* @ECU_Address@SwcIn_RLCR_6.RLCR_6_Le4ObjXDirV@ */ /end MEASUREMENT
/begin MEASUREMENT SwcIn_RLCR_6.RLCR_6_Le4ObjXDirVStdDe "" FLOAT32_IEEE autosar_swc_val_CM_RLCR_6_Le4ObjXDirVStdDe_946_dt 0 0 -3.4E+38 3.4E+38 ECU_ADDRESS 0xfe4cb040 /* @ECU_Address@SwcIn_RLCR_6.RLCR_6_Le4ObjXDirVStdDe@ */ /end MEASUREMENT
/begin MEASUREMENT SwcIn_RLCR_6.RLCR_6_Le4ObjYDirV "" FLOAT32_IEEE autosar_swc_val_CM_RLCR_6_Le4ObjYDirV_946_dt 0 0 -3.4E+38 3.4E+38 ECU_ADDRESS 0xfe4cb028 /* @ECU_Address@SwcIn_RLCR_6.RLCR_6_Le4ObjYDirV@ */ /end MEASUREMENT
/begin MEASUREMENT SwcIn_RLCR_6.RLCR_6_Le4ObjYDirVStdDe "" FLOAT32_IEEE autosar_swc_val_CM_RLCR_6_Le4ObjYDirVStdDe_946_dt 0 0 -3.4E+38 3.4E+38 ECU_ADDRESS 0xfe4cb044 /* @ECU_Address@SwcIn_RLCR_6.RLCR_6_Le4ObjYDirVStdDe@ */ /end MEASUREMENT
/begin MEASUREMENT SwcIn_RLCR_6.RLCR_6_RollgCntr "" UBYTE autosar_swc_val_CM_RLCR_6_RollgCntr_946_dt 0 0 0 255 ECU_ADDRESS 0xfe4cb00a /* @ECU_Address@SwcIn_RLCR_6.RLCR_6_RollgCntr@ */ /end MEASUREMENT
/begin MEASUREMENT SwcIn_RLCR_7.RLCR_7_CRC "" UWORD autosar_swc_val_CM_RLCR_7_CRC_948_dt 0 0 0 65535 ECU_ADDRESS 0xfe4cb048 /* @ECU_Address@SwcIn_RLCR_7.RLCR_7_CRC@ */ /end MEASUREMENT
/begin MEASUREMENT SwcIn_RLCR_7.RLCR_7_Le5HdTo "" FLOAT32_IEEE autosar_swc_val_CM_RLCR_7_Le5HdTo_948_dt 0 0 -3.4E+38 3.4E+38 ECU_ADDRESS 0xfe4cb054 /* @ECU_Address@SwcIn_RLCR_7.RLCR_7_Le5HdTo@ */ /end MEASUREMENT
/begin MEASUREMENT SwcIn_RLCR_7.RLCR_7_Le5ObjBoxLen "" FLOAT32_IEEE autosar_swc_val_CM_RLCR_7_Le5ObjBoxLen_948_dt 0 0 -3.4E+38 3.4E+38 ECU_ADDRESS 0xfe4cb04c /* @ECU_Address@SwcIn_RLCR_7.RLCR_7_Le5ObjBoxLen@ */ /end MEASUREMENT
/begin MEASUREMENT SwcIn_RLCR_7.RLCR_7_Le5ObjBoxWidth "" FLOAT32_IEEE autosar_swc_val_CM_RLCR_7_Le5ObjBoxWidth_948_dt 0 0 -3.4E+38 3.4E+38 ECU_ADDRESS 0xfe4cb050 /* @ECU_Address@SwcIn_RLCR_7.RLCR_7_Le5ObjBoxWidth@ */ /end MEASUREMENT
/begin MEASUREMENT SwcIn_RLCR_7.RLCR_7_Le5ObjConf "" UBYTE autosar_swc_val_CM_RLCR_7_Le5ObjConf_948_dt 0 0 0 255 ECU_ADDRESS 0xfe4cb072 /* @ECU_Address@SwcIn_RLCR_7.RLCR_7_Le5ObjConf@ */ /end MEASUREMENT
/begin MEASUREMENT SwcIn_RLCR_7.RLCR_7_Le5ObjCoordX "" FLOAT32_IEEE autosar_swc_val_CM_RLCR_7_Le5ObjCoordX_948_dt 0 0 -3.4E+38 3.4E+38 ECU_ADDRESS 0xfe4cb060 /* @ECU_Address@SwcIn_RLCR_7.RLCR_7_Le5ObjCoordX@ */ /end MEASUREMENT
/begin MEASUREMENT SwcIn_RLCR_7.RLCR_7_Le5ObjCoordXDstStdDe "" FLOAT32_IEEE autosar_swc_val_CM_RLCR_7_Le5ObjCoordXDstStdDe_948_dt 0 0 -3.4E+38 3.4E+38 ECU_ADDRESS 0xfe4cb078 /* @ECU_Address@SwcIn_RLCR_7.RLCR_7_Le5ObjCoordXDstStdDe@ */ /end MEASUREMENT
/begin MEASUREMENT SwcIn_RLCR_7.RLCR_7_Le5ObjCoordY "" FLOAT32_IEEE autosar_swc_val_CM_RLCR_7_Le5ObjCoordY_948_dt 0 0 -3.4E+38 3.4E+38 ECU_ADDRESS 0xfe4cb05c /* @ECU_Address@SwcIn_RLCR_7.RLCR_7_Le5ObjCoordY@ */ /end MEASUREMENT
/begin MEASUREMENT SwcIn_RLCR_7.RLCR_7_Le5ObjCoordYDstStdDe "" FLOAT32_IEEE autosar_swc_val_CM_RLCR_7_Le5ObjCoordYDstStdDe_948_dt 0 0 -3.4E+38 3.4E+38 ECU_ADDRESS 0xfe4cb07c /* @ECU_Address@SwcIn_RLCR_7.RLCR_7_Le5ObjCoordYDstStdDe@ */ /end MEASUREMENT
/begin MEASUREMENT SwcIn_RLCR_7.RLCR_7_Le5ObjID "" UBYTE autosar_swc_val_CM_RLCR_7_Le5ObjID_948_dt 0 0 0 255 ECU_ADDRESS 0xfe4cb058 /* @ECU_Address@SwcIn_RLCR_7.RLCR_7_Le5ObjID@ */ /end MEASUREMENT
/begin MEASUREMENT SwcIn_RLCR_7.RLCR_7_Le5ObjMtnChartc "" UBYTE autosar_swc_val_CM_RLCR_7_Le5ObjMtnChartc_948_dt 0 0 0 255 ECU_ADDRESS 0xfe4cb070 /* @ECU_Address@SwcIn_RLCR_7.RLCR_7_Le5ObjMtnChartc@ */ /end MEASUREMENT
/begin MEASUREMENT SwcIn_RLCR_7.RLCR_7_Le5ObjNrOffocst "" UBYTE autosar_swc_val_CM_RLCR_7_Le5ObjNrOffocst_948_dt 0 0 0 255 ECU_ADDRESS 0xfe4cb073 /* @ECU_Address@SwcIn_RLCR_7.RLCR_7_Le5ObjNrOffocst@ */ /end MEASUREMENT
/begin MEASUREMENT SwcIn_RLCR_7.RLCR_7_Le5ObjTrackSt "" UBYTE autosar_swc_val_CM_RLCR_7_Le5ObjTrackSt_948_dt 0 0 0 255 ECU_ADDRESS 0xfe4cb074 /* @ECU_Address@SwcIn_RLCR_7.RLCR_7_Le5ObjTrackSt@ */ /end MEASUREMENT
/begin MEASUREMENT SwcIn_RLCR_7.RLCR_7_Le5ObjTyp "" UBYTE autosar_swc_val_CM_RLCR_7_Le5ObjTyp_948_dt 0 0 0 255 ECU_ADDRESS 0xfe4cb071 /* @ECU_Address@SwcIn_RLCR_7.RLCR_7_Le5ObjTyp@ */ /end MEASUREMENT
/begin MEASUREMENT SwcIn_RLCR_7.RLCR_7_Le5ObjXDirAV "" FLOAT32_IEEE autosar_swc_val_CM_RLCR_7_Le5ObjXDirAV_948_dt 0 0 -3.4E+38 3.4E+38 ECU_ADDRESS 0xfe4cb064 /* @ECU_Address@SwcIn_RLCR_7.RLCR_7_Le5ObjXDirAV@ */ /end MEASUREMENT
/begin MEASUREMENT SwcIn_RLCR_7.RLCR_7_Le5ObjXDirV "" FLOAT32_IEEE autosar_swc_val_CM_RLCR_7_Le5ObjXDirV_948_dt 0 0 -3.4E+38 3.4E+38 ECU_ADDRESS 0xfe4cb06c /* @ECU_Address@SwcIn_RLCR_7.RLCR_7_Le5ObjXDirV@ */ /end MEASUREMENT
/begin MEASUREMENT SwcIn_RLCR_7.RLCR_7_Le5ObjXDirVStdDe "" FLOAT32_IEEE autosar_swc_val_CM_RLCR_7_Le5ObjXDirVStdDe_948_dt 0 0 -3.4E+38 3.4E+38 ECU_ADDRESS 0xfe4cb080 /* @ECU_Address@SwcIn_RLCR_7.RLCR_7_Le5ObjXDirVStdDe@ */ /end MEASUREMENT
/begin MEASUREMENT SwcIn_RLCR_7.RLCR_7_Le5ObjYDirV "" FLOAT32_IEEE autosar_swc_val_CM_RLCR_7_Le5ObjYDirV_948_dt 0 0 -3.4E+38 3.4E+38 ECU_ADDRESS 0xfe4cb068 /* @ECU_Address@SwcIn_RLCR_7.RLCR_7_Le5ObjYDirV@ */ /end MEASUREMENT
/begin MEASUREMENT SwcIn_RLCR_7.RLCR_7_Le5ObjYDirVStdDe "" FLOAT32_IEEE autosar_swc_val_CM_RLCR_7_Le5ObjYDirVStdDe_948_dt 0 0 -3.4E+38 3.4E+38 ECU_ADDRESS 0xfe4cb084 /* @ECU_Address@SwcIn_RLCR_7.RLCR_7_Le5ObjYDirVStdDe@ */ /end MEASUREMENT
/begin MEASUREMENT SwcIn_RLCR_7.RLCR_7_RollgCntr "" UBYTE autosar_swc_val_CM_RLCR_7_RollgCntr_948_dt 0 0 0 255 ECU_ADDRESS 0xfe4cb04a /* @ECU_Address@SwcIn_RLCR_7.RLCR_7_RollgCntr@ */ /end MEASUREMENT
/begin MEASUREMENT SwcIn_RLCR_8.RLCR_8_CRC "" UWORD autosar_swc_val_CM_RLCR_8_CRC_953_dt 0 0 0 65535 ECU_ADDRESS 0xfe4cccc4 /* @ECU_Address@SwcIn_RLCR_8.RLCR_8_CRC@ */ /end MEASUREMENT
/begin MEASUREMENT SwcIn_RLCR_8.RLCR_8_RollgCntr "" UBYTE autosar_swc_val_CM_RLCR_8_RollgCntr_953_dt 0 0 0 255 ECU_ADDRESS 0xfe4cccc6 /* @ECU_Address@SwcIn_RLCR_8.RLCR_8_RollgCntr@ */ /end MEASUREMENT
/begin MEASUREMENT SwcIn_RLCR_8.RLCR_8_TiStampLaten "" UWORD autosar_swc_val_CM_RLCR_8_TiStampLaten_953_dt 0 0 0 65535 ECU_ADDRESS 0xfe4cccc8 /* @ECU_Address@SwcIn_RLCR_8.RLCR_8_TiStampLaten@ */ /end MEASUREMENT
/begin MEASUREMENT SwcIn_RRCR_1.RRCR_1_BSDWarn "" UBYTE autosar_swc_val_CM_RRCR_1_BSDWarn_1267_dt 0 0 0 255 ECU_ADDRESS 0xfe4ccccf /* @ECU_Address@SwcIn_RRCR_1.RRCR_1_BSDWarn@ */ /end MEASUREMENT
/begin MEASUREMENT SwcIn_RRCR_1.RRCR_1_BlkSts "" UBYTE autosar_swc_val_CM_RRCR_1_BlkSts_1267_dt 0 0 0 255 ECU_ADDRESS 0xfe4cccce /* @ECU_Address@SwcIn_RRCR_1.RRCR_1_BlkSts@ */ /end MEASUREMENT
/begin MEASUREMENT SwcIn_RRCR_1.RRCR_1_CRC1 "" UBYTE autosar_swc_val_CM_RRCR_1_CRC1_1267_dt 0 0 0 255 ECU_ADDRESS 0xfe4cccca /* @ECU_Address@SwcIn_RRCR_1.RRCR_1_CRC1@ */ /end MEASUREMENT
/begin MEASUREMENT SwcIn_RRCR_1.RRCR_1_DOWWarn "" UBYTE autosar_swc_val_CM_RRCR_1_DOWWarn_1267_dt 0 0 0 255 ECU_ADDRESS 0xfe4cccd0 /* @ECU_Address@SwcIn_RRCR_1.RRCR_1_DOWWarn@ */ /end MEASUREMENT
/begin MEASUREMENT SwcIn_RRCR_1.RRCR_1_DowLock "" UBYTE autosar_swc_val_CM_RRCR_1_DowLock_1267_dt 0 0 0 255 ECU_ADDRESS 0xfe4cccd1 /* @ECU_Address@SwcIn_RRCR_1.RRCR_1_DowLock@ */ /end MEASUREMENT
/begin MEASUREMENT SwcIn_RRCR_1.RRCR_1_ELK_CollisionFlagValid "" UBYTE autosar_swc_val_CM_RRCR_1_ELK_CollisionFlagValid_1267_dt 0 0 0 255 ECU_ADDRESS 0xfe4cccd3 /* @ECU_Address@SwcIn_RRCR_1.RRCR_1_ELK_CollisionFlagValid@ */ /end MEASUREMENT
/begin MEASUREMENT SwcIn_RRCR_1.RRCR_1_ELK_Collision_flag "" UBYTE autosar_swc_val_CM_RRCR_1_ELK_Collision_flag_1267_dt 0 0 0 255 ECU_ADDRESS 0xfe4cccd2 /* @ECU_Address@SwcIn_RRCR_1.RRCR_1_ELK_Collision_flag@ */ /end MEASUREMENT
/begin MEASUREMENT SwcIn_RRCR_1.RRCR_1_Resd1 "" UBYTE autosar_swc_val_CM_RRCR_1_Resd1_1267_dt 0 0 0 255 ECU_ADDRESS 0xfe4ccccc /* @ECU_Address@SwcIn_RRCR_1.RRCR_1_Resd1@ */ /end MEASUREMENT
/begin MEASUREMENT SwcIn_RRCR_1.RRCR_1_RollgCntr1 "" UBYTE autosar_swc_val_CM_RRCR_1_RollgCntr1_1267_dt 0 0 0 255 ECU_ADDRESS 0xfe4ccccb /* @ECU_Address@SwcIn_RRCR_1.RRCR_1_RollgCntr1@ */ /end MEASUREMENT
/begin MEASUREMENT SwcIn_RRCR_1.RRCR_1_SysSt "" UBYTE autosar_swc_val_CM_RRCR_1_SysSt_1267_dt 0 0 0 255 ECU_ADDRESS 0xfe4ccccd /* @ECU_Address@SwcIn_RRCR_1.RRCR_1_SysSt@ */ /end MEASUREMENT
/begin MEASUREMENT SwcIn_RRCR_3.RRCR_3_CRC "" UWORD autosar_swc_val_CM_RRCR_3_CRC_959_dt 0 0 0 65535 ECU_ADDRESS 0xfe4cb088 /* @ECU_Address@SwcIn_RRCR_3.RRCR_3_CRC@ */ /end MEASUREMENT
/begin MEASUREMENT SwcIn_RRCR_3.RRCR_3_Ri1HdTo "" FLOAT32_IEEE autosar_swc_val_CM_RRCR_3_Ri1HdTo_959_dt 0 0 -3.4E+38 3.4E+38 ECU_ADDRESS 0xfe4cb094 /* @ECU_Address@SwcIn_RRCR_3.RRCR_3_Ri1HdTo@ */ /end MEASUREMENT
/begin MEASUREMENT SwcIn_RRCR_3.RRCR_3_Ri1ObjBoxLen "" FLOAT32_IEEE autosar_swc_val_CM_RRCR_3_Ri1ObjBoxLen_959_dt 0 0 -3.4E+38 3.4E+38 ECU_ADDRESS 0xfe4cb08c /* @ECU_Address@SwcIn_RRCR_3.RRCR_3_Ri1ObjBoxLen@ */ /end MEASUREMENT
/begin MEASUREMENT SwcIn_RRCR_3.RRCR_3_Ri1ObjBoxWidth "" FLOAT32_IEEE autosar_swc_val_CM_RRCR_3_Ri1ObjBoxWidth_959_dt 0 0 -3.4E+38 3.4E+38 ECU_ADDRESS 0xfe4cb090 /* @ECU_Address@SwcIn_RRCR_3.RRCR_3_Ri1ObjBoxWidth@ */ /end MEASUREMENT
/begin MEASUREMENT SwcIn_RRCR_3.RRCR_3_Ri1ObjConf "" UBYTE autosar_swc_val_CM_RRCR_3_Ri1ObjConf_959_dt 0 0 0 255 ECU_ADDRESS 0xfe4cb0b2 /* @ECU_Address@SwcIn_RRCR_3.RRCR_3_Ri1ObjConf@ */ /end MEASUREMENT
/begin MEASUREMENT SwcIn_RRCR_3.RRCR_3_Ri1ObjCoordX "" FLOAT32_IEEE autosar_swc_val_CM_RRCR_3_Ri1ObjCoordX_959_dt 0 0 -3.4E+38 3.4E+38 ECU_ADDRESS 0xfe4cb0a0 /* @ECU_Address@SwcIn_RRCR_3.RRCR_3_Ri1ObjCoordX@ */ /end MEASUREMENT
/begin MEASUREMENT SwcIn_RRCR_3.RRCR_3_Ri1ObjCoordXDstStdDe "" FLOAT32_IEEE autosar_swc_val_CM_RRCR_3_Ri1ObjCoordXDstStdDe_959_dt 0 0 -3.4E+38 3.4E+38 ECU_ADDRESS 0xfe4cb0b8 /* @ECU_Address@SwcIn_RRCR_3.RRCR_3_Ri1ObjCoordXDstStdDe@ */ /end MEASUREMENT
/begin MEASUREMENT SwcIn_RRCR_3.RRCR_3_Ri1ObjCoordY "" FLOAT32_IEEE autosar_swc_val_CM_RRCR_3_Ri1ObjCoordY_959_dt 0 0 -3.4E+38 3.4E+38 ECU_ADDRESS 0xfe4cb09c /* @ECU_Address@SwcIn_RRCR_3.RRCR_3_Ri1ObjCoordY@ */ /end MEASUREMENT
/begin MEASUREMENT SwcIn_RRCR_3.RRCR_3_Ri1ObjCoordYDstStdDe "" FLOAT32_IEEE autosar_swc_val_CM_RRCR_3_Ri1ObjCoordYDstStdDe_959_dt 0 0 -3.4E+38 3.4E+38 ECU_ADDRESS 0xfe4cb0bc /* @ECU_Address@SwcIn_RRCR_3.RRCR_3_Ri1ObjCoordYDstStdDe@ */ /end MEASUREMENT
/begin MEASUREMENT SwcIn_RRCR_3.RRCR_3_Ri1ObjID "" UBYTE autosar_swc_val_CM_RRCR_3_Ri1ObjID_959_dt 0 0 0 255 ECU_ADDRESS 0xfe4cb098 /* @ECU_Address@SwcIn_RRCR_3.RRCR_3_Ri1ObjID@ */ /end MEASUREMENT
/begin MEASUREMENT SwcIn_RRCR_3.RRCR_3_Ri1ObjMtnChartc "" UBYTE autosar_swc_val_CM_RRCR_3_Ri1ObjMtnChartc_959_dt 0 0 0 255 ECU_ADDRESS 0xfe4cb0b0 /* @ECU_Address@SwcIn_RRCR_3.RRCR_3_Ri1ObjMtnChartc@ */ /end MEASUREMENT
/begin MEASUREMENT SwcIn_RRCR_3.RRCR_3_Ri1ObjNrOffocst "" UBYTE autosar_swc_val_CM_RRCR_3_Ri1ObjNrOffocst_959_dt 0 0 0 255 ECU_ADDRESS 0xfe4cb0b3 /* @ECU_Address@SwcIn_RRCR_3.RRCR_3_Ri1ObjNrOffocst@ */ /end MEASUREMENT
/begin MEASUREMENT SwcIn_RRCR_3.RRCR_3_Ri1ObjTrackSt "" UBYTE autosar_swc_val_CM_RRCR_3_Ri1ObjTrackSt_959_dt 0 0 0 255 ECU_ADDRESS 0xfe4cb0b4 /* @ECU_Address@SwcIn_RRCR_3.RRCR_3_Ri1ObjTrackSt@ */ /end MEASUREMENT
/begin MEASUREMENT SwcIn_RRCR_3.RRCR_3_Ri1ObjTyp "" UBYTE autosar_swc_val_CM_RRCR_3_Ri1ObjTyp_959_dt 0 0 0 255 ECU_ADDRESS 0xfe4cb0b1 /* @ECU_Address@SwcIn_RRCR_3.RRCR_3_Ri1ObjTyp@ */ /end MEASUREMENT
/begin MEASUREMENT SwcIn_RRCR_3.RRCR_3_Ri1ObjXDirAV "" FLOAT32_IEEE autosar_swc_val_CM_RRCR_3_Ri1ObjXDirAV_959_dt 0 0 -3.4E+38 3.4E+38 ECU_ADDRESS 0xfe4cb0a4 /* @ECU_Address@SwcIn_RRCR_3.RRCR_3_Ri1ObjXDirAV@ */ /end MEASUREMENT
/begin MEASUREMENT SwcIn_RRCR_3.RRCR_3_Ri1ObjXDirV "" FLOAT32_IEEE autosar_swc_val_CM_RRCR_3_Ri1ObjXDirV_959_dt 0 0 -3.4E+38 3.4E+38 ECU_ADDRESS 0xfe4cb0ac /* @ECU_Address@SwcIn_RRCR_3.RRCR_3_Ri1ObjXDirV@ */ /end MEASUREMENT
/begin MEASUREMENT SwcIn_RRCR_3.RRCR_3_Ri1ObjXDirVStdDe "" FLOAT32_IEEE autosar_swc_val_CM_RRCR_3_Ri1ObjXDirVStdDe_959_dt 0 0 -3.4E+38 3.4E+38 ECU_ADDRESS 0xfe4cb0c0 /* @ECU_Address@SwcIn_RRCR_3.RRCR_3_Ri1ObjXDirVStdDe@ */ /end MEASUREMENT
/begin MEASUREMENT SwcIn_RRCR_3.RRCR_3_Ri1ObjYDirV "" FLOAT32_IEEE autosar_swc_val_CM_RRCR_3_Ri1ObjYDirV_959_dt 0 0 -3.4E+38 3.4E+38 ECU_ADDRESS 0xfe4cb0a8 /* @ECU_Address@SwcIn_RRCR_3.RRCR_3_Ri1ObjYDirV@ */ /end MEASUREMENT
/begin MEASUREMENT SwcIn_RRCR_3.RRCR_3_Ri1ObjYDirVStdDe "" FLOAT32_IEEE autosar_swc_val_CM_RRCR_3_Ri1ObjYDirVStdDe_959_dt 0 0 -3.4E+38 3.4E+38 ECU_ADDRESS 0xfe4cb0c4 /* @ECU_Address@SwcIn_RRCR_3.RRCR_3_Ri1ObjYDirVStdDe@ */ /end MEASUREMENT
/begin MEASUREMENT SwcIn_RRCR_3.RRCR_3_RollgCntr "" UBYTE autosar_swc_val_CM_RRCR_3_RollgCntr_959_dt 0 0 0 255 ECU_ADDRESS 0xfe4cb08a /* @ECU_Address@SwcIn_RRCR_3.RRCR_3_RollgCntr@ */ /end MEASUREMENT
/begin MEASUREMENT SwcIn_RRCR_4.RRCR_4_CRC "" UWORD autosar_swc_val_CM_RRCR_4_CRC_969_dt 0 0 0 65535 ECU_ADDRESS 0xfe4cb0c8 /* @ECU_Address@SwcIn_RRCR_4.RRCR_4_CRC@ */ /end MEASUREMENT
/begin MEASUREMENT SwcIn_RRCR_4.RRCR_4_Ri2HdTo "" FLOAT32_IEEE autosar_swc_val_CM_RRCR_4_Ri2HdTo_969_dt 0 0 -3.4E+38 3.4E+38 ECU_ADDRESS 0xfe4cb0d4 /* @ECU_Address@SwcIn_RRCR_4.RRCR_4_Ri2HdTo@ */ /end MEASUREMENT
/begin MEASUREMENT SwcIn_RRCR_4.RRCR_4_Ri2ObjBoxLen "" FLOAT32_IEEE autosar_swc_val_CM_RRCR_4_Ri2ObjBoxLen_969_dt 0 0 -3.4E+38 3.4E+38 ECU_ADDRESS 0xfe4cb0cc /* @ECU_Address@SwcIn_RRCR_4.RRCR_4_Ri2ObjBoxLen@ */ /end MEASUREMENT
/begin MEASUREMENT SwcIn_RRCR_4.RRCR_4_Ri2ObjBoxWidth "" FLOAT32_IEEE autosar_swc_val_CM_RRCR_4_Ri2ObjBoxWidth_969_dt 0 0 -3.4E+38 3.4E+38 ECU_ADDRESS 0xfe4cb0d0 /* @ECU_Address@SwcIn_RRCR_4.RRCR_4_Ri2ObjBoxWidth@ */ /end MEASUREMENT
/begin MEASUREMENT SwcIn_RRCR_4.RRCR_4_Ri2ObjConf "" UBYTE autosar_swc_val_CM_RRCR_4_Ri2ObjConf_969_dt 0 0 0 255 ECU_ADDRESS 0xfe4cb0f2 /* @ECU_Address@SwcIn_RRCR_4.RRCR_4_Ri2ObjConf@ */ /end MEASUREMENT
/begin MEASUREMENT SwcIn_RRCR_4.RRCR_4_Ri2ObjCoordX "" FLOAT32_IEEE autosar_swc_val_CM_RRCR_4_Ri2ObjCoordX_969_dt 0 0 -3.4E+38 3.4E+38 ECU_ADDRESS 0xfe4cb0e0 /* @ECU_Address@SwcIn_RRCR_4.RRCR_4_Ri2ObjCoordX@ */ /end MEASUREMENT
/begin MEASUREMENT SwcIn_RRCR_4.RRCR_4_Ri2ObjCoordXDstStdDe "" FLOAT32_IEEE autosar_swc_val_CM_RRCR_4_Ri2ObjCoordXDstStdDe_969_dt 0 0 -3.4E+38 3.4E+38 ECU_ADDRESS 0xfe4cb0f8 /* @ECU_Address@SwcIn_RRCR_4.RRCR_4_Ri2ObjCoordXDstStdDe@ */ /end MEASUREMENT
/begin MEASUREMENT SwcIn_RRCR_4.RRCR_4_Ri2ObjCoordY "" FLOAT32_IEEE autosar_swc_val_CM_RRCR_4_Ri2ObjCoordY_969_dt 0 0 -3.4E+38 3.4E+38 ECU_ADDRESS 0xfe4cb0dc /* @ECU_Address@SwcIn_RRCR_4.RRCR_4_Ri2ObjCoordY@ */ /end MEASUREMENT
/begin MEASUREMENT SwcIn_RRCR_4.RRCR_4_Ri2ObjCoordYDstStdDe "" FLOAT32_IEEE autosar_swc_val_CM_RRCR_4_Ri2ObjCoordYDstStdDe_969_dt 0 0 -3.4E+38 3.4E+38 ECU_ADDRESS 0xfe4cb0fc /* @ECU_Address@SwcIn_RRCR_4.RRCR_4_Ri2ObjCoordYDstStdDe@ */ /end MEASUREMENT
/begin MEASUREMENT SwcIn_RRCR_4.RRCR_4_Ri2ObjID "" UBYTE autosar_swc_val_CM_RRCR_4_Ri2ObjID_969_dt 0 0 0 255 ECU_ADDRESS 0xfe4cb0d8 /* @ECU_Address@SwcIn_RRCR_4.RRCR_4_Ri2ObjID@ */ /end MEASUREMENT
/begin MEASUREMENT SwcIn_RRCR_4.RRCR_4_Ri2ObjMtnChartc "" UBYTE autosar_swc_val_CM_RRCR_4_Ri2ObjMtnChartc_969_dt 0 0 0 255 ECU_ADDRESS 0xfe4cb0f0 /* @ECU_Address@SwcIn_RRCR_4.RRCR_4_Ri2ObjMtnChartc@ */ /end MEASUREMENT
/begin MEASUREMENT SwcIn_RRCR_4.RRCR_4_Ri2ObjNrOffocst "" UBYTE autosar_swc_val_CM_RRCR_4_Ri2ObjNrOffocst_969_dt 0 0 0 255 ECU_ADDRESS 0xfe4cb0f3 /* @ECU_Address@SwcIn_RRCR_4.RRCR_4_Ri2ObjNrOffocst@ */ /end MEASUREMENT
/begin MEASUREMENT SwcIn_RRCR_4.RRCR_4_Ri2ObjTrackSt "" UBYTE autosar_swc_val_CM_RRCR_4_Ri2ObjTrackSt_969_dt 0 0 0 255 ECU_ADDRESS 0xfe4cb0f4 /* @ECU_Address@SwcIn_RRCR_4.RRCR_4_Ri2ObjTrackSt@ */ /end MEASUREMENT
/begin MEASUREMENT SwcIn_RRCR_4.RRCR_4_Ri2ObjTyp "" UBYTE autosar_swc_val_CM_RRCR_4_Ri2ObjTyp_969_dt 0 0 0 255 ECU_ADDRESS 0xfe4cb0f1 /* @ECU_Address@SwcIn_RRCR_4.RRCR_4_Ri2ObjTyp@ */ /end MEASUREMENT
/begin MEASUREMENT SwcIn_RRCR_4.RRCR_4_Ri2ObjXDirAV "" FLOAT32_IEEE autosar_swc_val_CM_RRCR_4_Ri2ObjXDirAV_969_dt 0 0 -3.4E+38 3.4E+38 ECU_ADDRESS 0xfe4cb0e4 /* @ECU_Address@SwcIn_RRCR_4.RRCR_4_Ri2ObjXDirAV@ */ /end MEASUREMENT
/begin MEASUREMENT SwcIn_RRCR_4.RRCR_4_Ri2ObjXDirV "" FLOAT32_IEEE autosar_swc_val_CM_RRCR_4_Ri2ObjXDirV_969_dt 0 0 -3.4E+38 3.4E+38 ECU_ADDRESS 0xfe4cb0ec /* @ECU_Address@SwcIn_RRCR_4.RRCR_4_Ri2ObjXDirV@ */ /end MEASUREMENT
/begin MEASUREMENT SwcIn_RRCR_4.RRCR_4_Ri2ObjXDirVStdDe "" FLOAT32_IEEE autosar_swc_val_CM_RRCR_4_Ri2ObjXDirVStdDe_969_dt 0 0 -3.4E+38 3.4E+38 ECU_ADDRESS 0xfe4cb100 /* @ECU_Address@SwcIn_RRCR_4.RRCR_4_Ri2ObjXDirVStdDe@ */ /end MEASUREMENT
/begin MEASUREMENT SwcIn_RRCR_4.RRCR_4_Ri2ObjYDirV "" FLOAT32_IEEE autosar_swc_val_CM_RRCR_4_Ri2ObjYDirV_969_dt 0 0 -3.4E+38 3.4E+38 ECU_ADDRESS 0xfe4cb0e8 /* @ECU_Address@SwcIn_RRCR_4.RRCR_4_Ri2ObjYDirV@ */ /end MEASUREMENT
/begin MEASUREMENT SwcIn_RRCR_4.RRCR_4_Ri2ObjYDirVStdDe "" FLOAT32_IEEE autosar_swc_val_CM_RRCR_4_Ri2ObjYDirVStdDe_969_dt 0 0 -3.4E+38 3.4E+38 ECU_ADDRESS 0xfe4cb104 /* @ECU_Address@SwcIn_RRCR_4.RRCR_4_Ri2ObjYDirVStdDe@ */ /end MEASUREMENT
/begin MEASUREMENT SwcIn_RRCR_4.RRCR_4_RollgCntr "" UBYTE autosar_swc_val_CM_RRCR_4_RollgCntr_969_dt 0 0 0 255 ECU_ADDRESS 0xfe4cb0ca /* @ECU_Address@SwcIn_RRCR_4.RRCR_4_RollgCntr@ */ /end MEASUREMENT
/begin MEASUREMENT SwcIn_RRCR_5.RRCR_5_CRC "" UWORD autosar_swc_val_CM_RRCR_5_CRC_976_dt 0 0 0 65535 ECU_ADDRESS 0xfe4cb108 /* @ECU_Address@SwcIn_RRCR_5.RRCR_5_CRC@ */ /end MEASUREMENT
/begin MEASUREMENT SwcIn_RRCR_5.RRCR_5_Ri3HdTo "" FLOAT32_IEEE autosar_swc_val_CM_RRCR_5_Ri3HdTo_976_dt 0 0 -3.4E+38 3.4E+38 ECU_ADDRESS 0xfe4cb114 /* @ECU_Address@SwcIn_RRCR_5.RRCR_5_Ri3HdTo@ */ /end MEASUREMENT
/begin MEASUREMENT SwcIn_RRCR_5.RRCR_5_Ri3ObjBoxLen "" FLOAT32_IEEE autosar_swc_val_CM_RRCR_5_Ri3ObjBoxLen_976_dt 0 0 -3.4E+38 3.4E+38 ECU_ADDRESS 0xfe4cb10c /* @ECU_Address@SwcIn_RRCR_5.RRCR_5_Ri3ObjBoxLen@ */ /end MEASUREMENT
/begin MEASUREMENT SwcIn_RRCR_5.RRCR_5_Ri3ObjBoxWidth "" FLOAT32_IEEE autosar_swc_val_CM_RRCR_5_Ri3ObjBoxWidth_976_dt 0 0 -3.4E+38 3.4E+38 ECU_ADDRESS 0xfe4cb110 /* @ECU_Address@SwcIn_RRCR_5.RRCR_5_Ri3ObjBoxWidth@ */ /end MEASUREMENT
/begin MEASUREMENT SwcIn_RRCR_5.RRCR_5_Ri3ObjConf "" UBYTE autosar_swc_val_CM_RRCR_5_Ri3ObjConf_976_dt 0 0 0 255 ECU_ADDRESS 0xfe4cb132 /* @ECU_Address@SwcIn_RRCR_5.RRCR_5_Ri3ObjConf@ */ /end MEASUREMENT
/begin MEASUREMENT SwcIn_RRCR_5.RRCR_5_Ri3ObjCoordX "" FLOAT32_IEEE autosar_swc_val_CM_RRCR_5_Ri3ObjCoordX_976_dt 0 0 -3.4E+38 3.4E+38 ECU_ADDRESS 0xfe4cb120 /* @ECU_Address@SwcIn_RRCR_5.RRCR_5_Ri3ObjCoordX@ */ /end MEASUREMENT
/begin MEASUREMENT SwcIn_RRCR_5.RRCR_5_Ri3ObjCoordXDstStdDe "" FLOAT32_IEEE autosar_swc_val_CM_RRCR_5_Ri3ObjCoordXDstStdDe_976_dt 0 0 -3.4E+38 3.4E+38 ECU_ADDRESS 0xfe4cb138 /* @ECU_Address@SwcIn_RRCR_5.RRCR_5_Ri3ObjCoordXDstStdDe@ */ /end MEASUREMENT
/begin MEASUREMENT SwcIn_RRCR_5.RRCR_5_Ri3ObjCoordY "" FLOAT32_IEEE autosar_swc_val_CM_RRCR_5_Ri3ObjCoordY_976_dt 0 0 -3.4E+38 3.4E+38 ECU_ADDRESS 0xfe4cb11c /* @ECU_Address@SwcIn_RRCR_5.RRCR_5_Ri3ObjCoordY@ */ /end MEASUREMENT
/begin MEASUREMENT SwcIn_RRCR_5.RRCR_5_Ri3ObjCoordYDstStdDe "" FLOAT32_IEEE autosar_swc_val_CM_RRCR_5_Ri3ObjCoordYDstStdDe_976_dt 0 0 -3.4E+38 3.4E+38 ECU_ADDRESS 0xfe4cb13c /* @ECU_Address@SwcIn_RRCR_5.RRCR_5_Ri3ObjCoordYDstStdDe@ */ /end MEASUREMENT
/begin MEASUREMENT SwcIn_RRCR_5.RRCR_5_Ri3ObjID "" UBYTE autosar_swc_val_CM_RRCR_5_Ri3ObjID_976_dt 0 0 0 255 ECU_ADDRESS 0xfe4cb118 /* @ECU_Address@SwcIn_RRCR_5.RRCR_5_Ri3ObjID@ */ /end MEASUREMENT
/begin MEASUREMENT SwcIn_RRCR_5.RRCR_5_Ri3ObjMtnChartc "" UBYTE autosar_swc_val_CM_RRCR_5_Ri3ObjMtnChartc_976_dt 0 0 0 255 ECU_ADDRESS 0xfe4cb130 /* @ECU_Address@SwcIn_RRCR_5.RRCR_5_Ri3ObjMtnChartc@ */ /end MEASUREMENT
/begin MEASUREMENT SwcIn_RRCR_5.RRCR_5_Ri3ObjNrOffocst "" UBYTE autosar_swc_val_CM_RRCR_5_Ri3ObjNrOffocst_976_dt 0 0 0 255 ECU_ADDRESS 0xfe4cb133 /* @ECU_Address@SwcIn_RRCR_5.RRCR_5_Ri3ObjNrOffocst@ */ /end MEASUREMENT
/begin MEASUREMENT SwcIn_RRCR_5.RRCR_5_Ri3ObjTrackSt "" UBYTE autosar_swc_val_CM_RRCR_5_Ri3ObjTrackSt_976_dt 0 0 0 255 ECU_ADDRESS 0xfe4cb134 /* @ECU_Address@SwcIn_RRCR_5.RRCR_5_Ri3ObjTrackSt@ */ /end MEASUREMENT
/begin MEASUREMENT SwcIn_RRCR_5.RRCR_5_Ri3ObjTyp "" UBYTE autosar_swc_val_CM_RRCR_5_Ri3ObjTyp_976_dt 0 0 0 255 ECU_ADDRESS 0xfe4cb131 /* @ECU_Address@SwcIn_RRCR_5.RRCR_5_Ri3ObjTyp@ */ /end MEASUREMENT
/begin MEASUREMENT SwcIn_RRCR_5.RRCR_5_Ri3ObjXDirAV "" FLOAT32_IEEE autosar_swc_val_CM_RRCR_5_Ri3ObjXDirAV_976_dt 0 0 -3.4E+38 3.4E+38 ECU_ADDRESS 0xfe4cb124 /* @ECU_Address@SwcIn_RRCR_5.RRCR_5_Ri3ObjXDirAV@ */ /end MEASUREMENT
/begin MEASUREMENT SwcIn_RRCR_5.RRCR_5_Ri3ObjXDirV "" FLOAT32_IEEE autosar_swc_val_CM_RRCR_5_Ri3ObjXDirV_976_dt 0 0 -3.4E+38 3.4E+38 ECU_ADDRESS 0xfe4cb12c /* @ECU_Address@SwcIn_RRCR_5.RRCR_5_Ri3ObjXDirV@ */ /end MEASUREMENT
/begin MEASUREMENT SwcIn_RRCR_5.RRCR_5_Ri3ObjXDirVStdDe "" FLOAT32_IEEE autosar_swc_val_CM_RRCR_5_Ri3ObjXDirVStdDe_976_dt 0 0 -3.4E+38 3.4E+38 ECU_ADDRESS 0xfe4cb140 /* @ECU_Address@SwcIn_RRCR_5.RRCR_5_Ri3ObjXDirVStdDe@ */ /end MEASUREMENT
/begin MEASUREMENT SwcIn_RRCR_5.RRCR_5_Ri3ObjYDirV "" FLOAT32_IEEE autosar_swc_val_CM_RRCR_5_Ri3ObjYDirV_976_dt 0 0 -3.4E+38 3.4E+38 ECU_ADDRESS 0xfe4cb128 /* @ECU_Address@SwcIn_RRCR_5.RRCR_5_Ri3ObjYDirV@ */ /end MEASUREMENT
/begin MEASUREMENT SwcIn_RRCR_5.RRCR_5_Ri3ObjYDirVStdDe "" FLOAT32_IEEE autosar_swc_val_CM_RRCR_5_Ri3ObjYDirVStdDe_976_dt 0 0 -3.4E+38 3.4E+38 ECU_ADDRESS 0xfe4cb144 /* @ECU_Address@SwcIn_RRCR_5.RRCR_5_Ri3ObjYDirVStdDe@ */ /end MEASUREMENT
/begin MEASUREMENT SwcIn_RRCR_5.RRCR_5_RollgCntr "" UBYTE autosar_swc_val_CM_RRCR_5_RollgCntr_976_dt 0 0 0 255 ECU_ADDRESS 0xfe4cb10a /* @ECU_Address@SwcIn_RRCR_5.RRCR_5_RollgCntr@ */ /end MEASUREMENT
/begin MEASUREMENT SwcIn_RRCR_6.RRCR_6_CRC "" UWORD autosar_swc_val_CM_RRCR_6_CRC_984_dt 0 0 0 65535 ECU_ADDRESS 0xfe4cb148 /* @ECU_Address@SwcIn_RRCR_6.RRCR_6_CRC@ */ /end MEASUREMENT
/begin MEASUREMENT SwcIn_RRCR_6.RRCR_6_Ri4HdTo "" FLOAT32_IEEE autosar_swc_val_CM_RRCR_6_Ri4HdTo_984_dt 0 0 -3.4E+38 3.4E+38 ECU_ADDRESS 0xfe4cb154 /* @ECU_Address@SwcIn_RRCR_6.RRCR_6_Ri4HdTo@ */ /end MEASUREMENT
/begin MEASUREMENT SwcIn_RRCR_6.RRCR_6_Ri4ObjBoxLen "" FLOAT32_IEEE autosar_swc_val_CM_RRCR_6_Ri4ObjBoxLen_984_dt 0 0 -3.4E+38 3.4E+38 ECU_ADDRESS 0xfe4cb14c /* @ECU_Address@SwcIn_RRCR_6.RRCR_6_Ri4ObjBoxLen@ */ /end MEASUREMENT
/begin MEASUREMENT SwcIn_RRCR_6.RRCR_6_Ri4ObjBoxWidth "" FLOAT32_IEEE autosar_swc_val_CM_RRCR_6_Ri4ObjBoxWidth_984_dt 0 0 -3.4E+38 3.4E+38 ECU_ADDRESS 0xfe4cb150 /* @ECU_Address@SwcIn_RRCR_6.RRCR_6_Ri4ObjBoxWidth@ */ /end MEASUREMENT
/begin MEASUREMENT SwcIn_RRCR_6.RRCR_6_Ri4ObjConf "" UBYTE autosar_swc_val_CM_RRCR_6_Ri4ObjConf_984_dt 0 0 0 255 ECU_ADDRESS 0xfe4cb172 /* @ECU_Address@SwcIn_RRCR_6.RRCR_6_Ri4ObjConf@ */ /end MEASUREMENT
/begin MEASUREMENT SwcIn_RRCR_6.RRCR_6_Ri4ObjCoordX "" FLOAT32_IEEE autosar_swc_val_CM_RRCR_6_Ri4ObjCoordX_984_dt 0 0 -3.4E+38 3.4E+38 ECU_ADDRESS 0xfe4cb160 /* @ECU_Address@SwcIn_RRCR_6.RRCR_6_Ri4ObjCoordX@ */ /end MEASUREMENT
/begin MEASUREMENT SwcIn_RRCR_6.RRCR_6_Ri4ObjCoordXDstStdDe "" FLOAT32_IEEE autosar_swc_val_CM_RRCR_6_Ri4ObjCoordXDstStdDe_984_dt 0 0 -3.4E+38 3.4E+38 ECU_ADDRESS 0xfe4cb178 /* @ECU_Address@SwcIn_RRCR_6.RRCR_6_Ri4ObjCoordXDstStdDe@ */ /end MEASUREMENT
/begin MEASUREMENT SwcIn_RRCR_6.RRCR_6_Ri4ObjCoordY "" FLOAT32_IEEE autosar_swc_val_CM_RRCR_6_Ri4ObjCoordY_984_dt 0 0 -3.4E+38 3.4E+38 ECU_ADDRESS 0xfe4cb15c /* @ECU_Address@SwcIn_RRCR_6.RRCR_6_Ri4ObjCoordY@ */ /end MEASUREMENT
/begin MEASUREMENT SwcIn_RRCR_6.RRCR_6_Ri4ObjCoordYDstStdDe "" FLOAT32_IEEE autosar_swc_val_CM_RRCR_6_Ri4ObjCoordYDstStdDe_984_dt 0 0 -3.4E+38 3.4E+38 ECU_ADDRESS 0xfe4cb17c /* @ECU_Address@SwcIn_RRCR_6.RRCR_6_Ri4ObjCoordYDstStdDe@ */ /end MEASUREMENT
/begin MEASUREMENT SwcIn_RRCR_6.RRCR_6_Ri4ObjID "" UBYTE autosar_swc_val_CM_RRCR_6_Ri4ObjID_984_dt 0 0 0 255 ECU_ADDRESS 0xfe4cb158 /* @ECU_Address@SwcIn_RRCR_6.RRCR_6_Ri4ObjID@ */ /end MEASUREMENT
/begin MEASUREMENT SwcIn_RRCR_6.RRCR_6_Ri4ObjMtnChartc "" UBYTE autosar_swc_val_CM_RRCR_6_Ri4ObjMtnChartc_984_dt 0 0 0 255 ECU_ADDRESS 0xfe4cb170 /* @ECU_Address@SwcIn_RRCR_6.RRCR_6_Ri4ObjMtnChartc@ */ /end MEASUREMENT
/begin MEASUREMENT SwcIn_RRCR_6.RRCR_6_Ri4ObjNrOffocst "" UBYTE autosar_swc_val_CM_RRCR_6_Ri4ObjNrOffocst_984_dt 0 0 0 255 ECU_ADDRESS 0xfe4cb173 /* @ECU_Address@SwcIn_RRCR_6.RRCR_6_Ri4ObjNrOffocst@ */ /end MEASUREMENT
/begin MEASUREMENT SwcIn_RRCR_6.RRCR_6_Ri4ObjTrackSt "" UBYTE autosar_swc_val_CM_RRCR_6_Ri4ObjTrackSt_984_dt 0 0 0 255 ECU_ADDRESS 0xfe4cb174 /* @ECU_Address@SwcIn_RRCR_6.RRCR_6_Ri4ObjTrackSt@ */ /end MEASUREMENT
/begin MEASUREMENT SwcIn_RRCR_6.RRCR_6_Ri4ObjTyp "" UBYTE autosar_swc_val_CM_RRCR_6_Ri4ObjTyp_984_dt 0 0 0 255 ECU_ADDRESS 0xfe4cb171 /* @ECU_Address@SwcIn_RRCR_6.RRCR_6_Ri4ObjTyp@ */ /end MEASUREMENT
/begin MEASUREMENT SwcIn_RRCR_6.RRCR_6_Ri4ObjXDirAV "" FLOAT32_IEEE autosar_swc_val_CM_RRCR_6_Ri4ObjXDirAV_984_dt 0 0 -3.4E+38 3.4E+38 ECU_ADDRESS 0xfe4cb164 /* @ECU_Address@SwcIn_RRCR_6.RRCR_6_Ri4ObjXDirAV@ */ /end MEASUREMENT
/begin MEASUREMENT SwcIn_RRCR_6.RRCR_6_Ri4ObjXDirV "" FLOAT32_IEEE autosar_swc_val_CM_RRCR_6_Ri4ObjXDirV_984_dt 0 0 -3.4E+38 3.4E+38 ECU_ADDRESS 0xfe4cb16c /* @ECU_Address@SwcIn_RRCR_6.RRCR_6_Ri4ObjXDirV@ */ /end MEASUREMENT
/begin MEASUREMENT SwcIn_RRCR_6.RRCR_6_Ri4ObjXDirVStdDe "" FLOAT32_IEEE autosar_swc_val_CM_RRCR_6_Ri4ObjXDirVStdDe_984_dt 0 0 -3.4E+38 3.4E+38 ECU_ADDRESS 0xfe4cb180 /* @ECU_Address@SwcIn_RRCR_6.RRCR_6_Ri4ObjXDirVStdDe@ */ /end MEASUREMENT
/begin MEASUREMENT SwcIn_RRCR_6.RRCR_6_Ri4ObjYDirV "" FLOAT32_IEEE autosar_swc_val_CM_RRCR_6_Ri4ObjYDirV_984_dt 0 0 -3.4E+38 3.4E+38 ECU_ADDRESS 0xfe4cb168 /* @ECU_Address@SwcIn_RRCR_6.RRCR_6_Ri4ObjYDirV@ */ /end MEASUREMENT
/begin MEASUREMENT SwcIn_RRCR_6.RRCR_6_Ri4ObjYDirVStdDe "" FLOAT32_IEEE autosar_swc_val_CM_RRCR_6_Ri4ObjYDirVStdDe_984_dt 0 0 -3.4E+38 3.4E+38 ECU_ADDRESS 0xfe4cb184 /* @ECU_Address@SwcIn_RRCR_6.RRCR_6_Ri4ObjYDirVStdDe@ */ /end MEASUREMENT
/begin MEASUREMENT SwcIn_RRCR_6.RRCR_6_RollgCntr "" UBYTE autosar_swc_val_CM_RRCR_6_RollgCntr_984_dt 0 0 0 255 ECU_ADDRESS 0xfe4cb14a /* @ECU_Address@SwcIn_RRCR_6.RRCR_6_RollgCntr@ */ /end MEASUREMENT
/begin MEASUREMENT SwcIn_RRCR_7.RRCR_7_CRC "" UWORD autosar_swc_val_CM_RRCR_7_CRC_986_dt 0 0 0 65535 ECU_ADDRESS 0xfe4cb188 /* @ECU_Address@SwcIn_RRCR_7.RRCR_7_CRC@ */ /end MEASUREMENT
/begin MEASUREMENT SwcIn_RRCR_7.RRCR_7_Ri5HdTo "" FLOAT32_IEEE autosar_swc_val_CM_RRCR_7_Ri5HdTo_986_dt 0 0 -3.4E+38 3.4E+38 ECU_ADDRESS 0xfe4cb194 /* @ECU_Address@SwcIn_RRCR_7.RRCR_7_Ri5HdTo@ */ /end MEASUREMENT
/begin MEASUREMENT SwcIn_RRCR_7.RRCR_7_Ri5ObjBoxLen "" FLOAT32_IEEE autosar_swc_val_CM_RRCR_7_Ri5ObjBoxLen_986_dt 0 0 -3.4E+38 3.4E+38 ECU_ADDRESS 0xfe4cb18c /* @ECU_Address@SwcIn_RRCR_7.RRCR_7_Ri5ObjBoxLen@ */ /end MEASUREMENT
/begin MEASUREMENT SwcIn_RRCR_7.RRCR_7_Ri5ObjBoxWidth "" FLOAT32_IEEE autosar_swc_val_CM_RRCR_7_Ri5ObjBoxWidth_986_dt 0 0 -3.4E+38 3.4E+38 ECU_ADDRESS 0xfe4cb190 /* @ECU_Address@SwcIn_RRCR_7.RRCR_7_Ri5ObjBoxWidth@ */ /end MEASUREMENT
/begin MEASUREMENT SwcIn_RRCR_7.RRCR_7_Ri5ObjConf "" UBYTE autosar_swc_val_CM_RRCR_7_Ri5ObjConf_986_dt 0 0 0 255 ECU_ADDRESS 0xfe4cb1b2 /* @ECU_Address@SwcIn_RRCR_7.RRCR_7_Ri5ObjConf@ */ /end MEASUREMENT
/begin MEASUREMENT SwcIn_RRCR_7.RRCR_7_Ri5ObjCoordX "" FLOAT32_IEEE autosar_swc_val_CM_RRCR_7_Ri5ObjCoordX_986_dt 0 0 -3.4E+38 3.4E+38 ECU_ADDRESS 0xfe4cb1a0 /* @ECU_Address@SwcIn_RRCR_7.RRCR_7_Ri5ObjCoordX@ */ /end MEASUREMENT
/begin MEASUREMENT SwcIn_RRCR_7.RRCR_7_Ri5ObjCoordXDstStdDe "" FLOAT32_IEEE autosar_swc_val_CM_RRCR_7_Ri5ObjCoordXDstStdDe_986_dt 0 0 -3.4E+38 3.4E+38 ECU_ADDRESS 0xfe4cb1b8 /* @ECU_Address@SwcIn_RRCR_7.RRCR_7_Ri5ObjCoordXDstStdDe@ */ /end MEASUREMENT
/begin MEASUREMENT SwcIn_RRCR_7.RRCR_7_Ri5ObjCoordY "" FLOAT32_IEEE autosar_swc_val_CM_RRCR_7_Ri5ObjCoordY_986_dt 0 0 -3.4E+38 3.4E+38 ECU_ADDRESS 0xfe4cb19c /* @ECU_Address@SwcIn_RRCR_7.RRCR_7_Ri5ObjCoordY@ */ /end MEASUREMENT
/begin MEASUREMENT SwcIn_RRCR_7.RRCR_7_Ri5ObjCoordYDstStdDe "" FLOAT32_IEEE autosar_swc_val_CM_RRCR_7_Ri5ObjCoordYDstStdDe_986_dt 0 0 -3.4E+38 3.4E+38 ECU_ADDRESS 0xfe4cb1bc /* @ECU_Address@SwcIn_RRCR_7.RRCR_7_Ri5ObjCoordYDstStdDe@ */ /end MEASUREMENT
/begin MEASUREMENT SwcIn_RRCR_7.RRCR_7_Ri5ObjID "" UBYTE autosar_swc_val_CM_RRCR_7_Ri5ObjID_986_dt 0 0 0 255 ECU_ADDRESS 0xfe4cb198 /* @ECU_Address@SwcIn_RRCR_7.RRCR_7_Ri5ObjID@ */ /end MEASUREMENT
/begin MEASUREMENT SwcIn_RRCR_7.RRCR_7_Ri5ObjMtnChartc "" UBYTE autosar_swc_val_CM_RRCR_7_Ri5ObjMtnChartc_986_dt 0 0 0 255 ECU_ADDRESS 0xfe4cb1b0 /* @ECU_Address@SwcIn_RRCR_7.RRCR_7_Ri5ObjMtnChartc@ */ /end MEASUREMENT
/begin MEASUREMENT SwcIn_RRCR_7.RRCR_7_Ri5ObjNrOffocst "" UBYTE autosar_swc_val_CM_RRCR_7_Ri5ObjNrOffocst_986_dt 0 0 0 255 ECU_ADDRESS 0xfe4cb1b3 /* @ECU_Address@SwcIn_RRCR_7.RRCR_7_Ri5ObjNrOffocst@ */ /end MEASUREMENT
/begin MEASUREMENT SwcIn_RRCR_7.RRCR_7_Ri5ObjTrackSt "" UBYTE autosar_swc_val_CM_RRCR_7_Ri5ObjTrackSt_986_dt 0 0 0 255 ECU_ADDRESS 0xfe4cb1b4 /* @ECU_Address@SwcIn_RRCR_7.RRCR_7_Ri5ObjTrackSt@ */ /end MEASUREMENT
/begin MEASUREMENT SwcIn_RRCR_7.RRCR_7_Ri5ObjTyp "" UBYTE autosar_swc_val_CM_RRCR_7_Ri5ObjTyp_986_dt 0 0 0 255 ECU_ADDRESS 0xfe4cb1b1 /* @ECU_Address@SwcIn_RRCR_7.RRCR_7_Ri5ObjTyp@ */ /end MEASUREMENT
/begin MEASUREMENT SwcIn_RRCR_7.RRCR_7_Ri5ObjXDirAV "" FLOAT32_IEEE autosar_swc_val_CM_RRCR_7_Ri5ObjXDirAV_986_dt 0 0 -3.4E+38 3.4E+38 ECU_ADDRESS 0xfe4cb1a4 /* @ECU_Address@SwcIn_RRCR_7.RRCR_7_Ri5ObjXDirAV@ */ /end MEASUREMENT
/begin MEASUREMENT SwcIn_RRCR_7.RRCR_7_Ri5ObjXDirV "" FLOAT32_IEEE autosar_swc_val_CM_RRCR_7_Ri5ObjXDirV_986_dt 0 0 -3.4E+38 3.4E+38 ECU_ADDRESS 0xfe4cb1ac /* @ECU_Address@SwcIn_RRCR_7.RRCR_7_Ri5ObjXDirV@ */ /end MEASUREMENT
/begin MEASUREMENT SwcIn_RRCR_7.RRCR_7_Ri5ObjXDirVStdDe "" FLOAT32_IEEE autosar_swc_val_CM_RRCR_7_Ri5ObjXDirVStdDe_986_dt 0 0 -3.4E+38 3.4E+38 ECU_ADDRESS 0xfe4cb1c0 /* @ECU_Address@SwcIn_RRCR_7.RRCR_7_Ri5ObjXDirVStdDe@ */ /end MEASUREMENT
/begin MEASUREMENT SwcIn_RRCR_7.RRCR_7_Ri5ObjYDirV "" FLOAT32_IEEE autosar_swc_val_CM_RRCR_7_Ri5ObjYDirV_986_dt 0 0 -3.4E+38 3.4E+38 ECU_ADDRESS 0xfe4cb1a8 /* @ECU_Address@SwcIn_RRCR_7.RRCR_7_Ri5ObjYDirV@ */ /end MEASUREMENT
/begin MEASUREMENT SwcIn_RRCR_7.RRCR_7_Ri5ObjYDirVStdDe "" FLOAT32_IEEE autosar_swc_val_CM_RRCR_7_Ri5ObjYDirVStdDe_986_dt 0 0 -3.4E+38 3.4E+38 ECU_ADDRESS 0xfe4cb1c4 /* @ECU_Address@SwcIn_RRCR_7.RRCR_7_Ri5ObjYDirVStdDe@ */ /end MEASUREMENT
/begin MEASUREMENT SwcIn_RRCR_7.RRCR_7_RollgCntr "" UBYTE autosar_swc_val_CM_RRCR_7_RollgCntr_986_dt 0 0 0 255 ECU_ADDRESS 0xfe4cb18a /* @ECU_Address@SwcIn_RRCR_7.RRCR_7_RollgCntr@ */ /end MEASUREMENT
/begin MEASUREMENT SwcIn_RRCR_8.RRCR_8_CRC "" UWORD autosar_swc_val_CM_RRCR_8_CRC_990_dt 0 0 0 65535 ECU_ADDRESS 0xfe4cccd4 /* @ECU_Address@SwcIn_RRCR_8.RRCR_8_CRC@ */ /end MEASUREMENT
/begin MEASUREMENT SwcIn_RRCR_8.RRCR_8_RollgCntr "" UBYTE autosar_swc_val_CM_RRCR_8_RollgCntr_990_dt 0 0 0 255 ECU_ADDRESS 0xfe4cccd6 /* @ECU_Address@SwcIn_RRCR_8.RRCR_8_RollgCntr@ */ /end MEASUREMENT
/begin MEASUREMENT SwcIn_RRCR_8.RRCR_8_TiStampLaten "" UWORD autosar_swc_val_CM_RRCR_8_TiStampLaten_990_dt 0 0 0 65535 ECU_ADDRESS 0xfe4cccd8 /* @ECU_Address@SwcIn_RRCR_8.RRCR_8_TiStampLaten@ */ /end MEASUREMENT
/begin MEASUREMENT SwcIn_RZCU_2.LHRDoorLockSts "" UBYTE autosar_swc_val_CM_LHRDoorLockSts_699_dt 0 0 0 255 ECU_ADDRESS 0xfe4cce7f /* @ECU_Address@SwcIn_RZCU_2.LHRDoorLockSts@ */ /end MEASUREMENT
/begin MEASUREMENT SwcIn_RZCU_2.LHRdoorSts "" UBYTE autosar_swc_val_CM_LHRdoorSts_699_dt 0 0 0 255 ECU_ADDRESS 0xfe4cce7d /* @ECU_Address@SwcIn_RZCU_2.LHRdoorSts@ */ /end MEASUREMENT
/begin MEASUREMENT SwcIn_RZCU_2.RZCU_2_CRC "" UBYTE autosar_swc_val_CM_RZCU_2_CRC_699_dt 0 0 0 255 ECU_ADDRESS 0xfe4cce7a /* @ECU_Address@SwcIn_RZCU_2.RZCU_2_CRC@ */ /end MEASUREMENT
/begin MEASUREMENT SwcIn_RZCU_2.RZCU_2_Resd "" UBYTE autosar_swc_val_CM_RZCU_2_Resd_699_dt 0 0 0 255 ECU_ADDRESS 0xfe4cce7c /* @ECU_Address@SwcIn_RZCU_2.RZCU_2_Resd@ */ /end MEASUREMENT
/begin MEASUREMENT SwcIn_RZCU_2.RZCU_2_RollgCntr "" UBYTE autosar_swc_val_CM_RZCU_2_RollgCntr_699_dt 0 0 0 255 ECU_ADDRESS 0xfe4cce7b /* @ECU_Address@SwcIn_RZCU_2.RZCU_2_RollgCntr@ */ /end MEASUREMENT
/begin MEASUREMENT SwcIn_RZCU_2.TrunkLockSts "" UBYTE autosar_swc_val_CM_TrunkLockSts_699_dt 0 0 0 255 ECU_ADDRESS 0xfe4cce80 /* @ECU_Address@SwcIn_RZCU_2.TrunkLockSts@ */ /end MEASUREMENT
/begin MEASUREMENT SwcIn_RZCU_2.TrunkSts "" UBYTE autosar_swc_val_CM_TrunkSts_699_dt 0 0 0 255 ECU_ADDRESS 0xfe4cce7e /* @ECU_Address@SwcIn_RZCU_2.TrunkSts@ */ /end MEASUREMENT
/begin MEASUREMENT SwcIn_RZCU_7.RZCU_7_CRC "" UBYTE autosar_swc_val_CM_RZCU_7_CRC_1258_dt 0 0 0 255 ECU_ADDRESS 0xfe4ccb34 /* @ECU_Address@SwcIn_RZCU_7.RZCU_7_CRC@ */ /end MEASUREMENT
/begin MEASUREMENT SwcIn_RZCU_7.RZCU_7_RollgCntr "" UBYTE autosar_swc_val_CM_RZCU_7_RollgCntr_1258_dt 0 0 0 255 ECU_ADDRESS 0xfe4ccb35 /* @ECU_Address@SwcIn_RZCU_7.RZCU_7_RollgCntr@ */ /end MEASUREMENT
/begin MEASUREMENT SwcIn_RZCU_7.RZCU_RearWiperParkStatus "" UBYTE autosar_swc_val_CM_RZCU_RearWiperParkStatus_1258_dt 0 0 0 255 ECU_ADDRESS 0xfe4ccb37 /* @ECU_Address@SwcIn_RZCU_7.RZCU_RearWiperParkStatus@ */ /end MEASUREMENT
/begin MEASUREMENT SwcIn_RZCU_7.RZCU_RearWiperWipingStatus "" UBYTE autosar_swc_val_CM_RZCU_RearWiperWipingStatus_1258_dt 0 0 0 255 ECU_ADDRESS 0xfe4ccb36 /* @ECU_Address@SwcIn_RZCU_7.RZCU_RearWiperWipingStatus@ */ /end MEASUREMENT
/begin MEASUREMENT SwcIn_SAS_1.SAM_1_CRC "" UBYTE autosar_swc_val_CM_SAM_1_CRC_306_dt 0 0 0 255 ECU_ADDRESS 0xfe4ccb38 /* @ECU_Address@SwcIn_SAS_1.SAM_1_CRC@ */ /end MEASUREMENT
/begin MEASUREMENT SwcIn_SAS_1.SAM_1_Resd "" UBYTE autosar_swc_val_CM_SAM_1_Resd_306_dt 0 0 0 255 ECU_ADDRESS 0xfe4ccb3a /* @ECU_Address@SwcIn_SAS_1.SAM_1_Resd@ */ /end MEASUREMENT
/begin MEASUREMENT SwcIn_SAS_1.SAM_1_RollgCntr "" UBYTE autosar_swc_val_CM_SAM_1_RollgCntr_306_dt 0 0 0 255 ECU_ADDRESS 0xfe4ccb39 /* @ECU_Address@SwcIn_SAS_1.SAM_1_RollgCntr@ */ /end MEASUREMENT
/begin MEASUREMENT SwcIn_SAS_1.SAM_1_SteeringAngle "" FLOAT32_IEEE autosar_swc_val_CM_SAM_1_SteeringAngle_306_dt 0 0 -3.4E+38 3.4E+38 ECU_ADDRESS 0xfe4ccb3c /* @ECU_Address@SwcIn_SAS_1.SAM_1_SteeringAngle@ */ /end MEASUREMENT
/begin MEASUREMENT SwcIn_SAS_1.SAM_1_SteeringAngleSpeed "" UWORD autosar_swc_val_CM_SAM_1_SteeringAngleSpeed_306_dt 0 0 0 65535 ECU_ADDRESS 0xfe4ccb40 /* @ECU_Address@SwcIn_SAS_1.SAM_1_SteeringAngleSpeed@ */ /end MEASUREMENT
/begin MEASUREMENT SwcIn_SAS_1.SAM_1_SteeringAngleSpeedVD "" UBYTE autosar_swc_val_CM_SAM_1_SteeringAngleSpeedVD_306_dt 0 0 0 255 ECU_ADDRESS 0xfe4ccb43 /* @ECU_Address@SwcIn_SAS_1.SAM_1_SteeringAngleSpeedVD@ */ /end MEASUREMENT
/begin MEASUREMENT SwcIn_SAS_1.SAM_1_SteeringAngleVD "" UBYTE autosar_swc_val_CM_SAM_1_SteeringAngleVD_306_dt 0 0 0 255 ECU_ADDRESS 0xfe4ccb42 /* @ECU_Address@SwcIn_SAS_1.SAM_1_SteeringAngleVD@ */ /end MEASUREMENT
/begin COMPU_METHOD autosar_swc_val_CM_ABS_ESP_1_ABSActive_152_dt "Q = V" IDENTICAL "%0.6" "" /end COMPU_METHOD
/begin COMPU_METHOD autosar_swc_val_CM_ABS_ESP_1_ABSFailSts_152_dt "Q = V" IDENTICAL "%0.6" "" /end COMPU_METHOD
/begin COMPU_METHOD autosar_swc_val_CM_ABS_ESP_1_EBDFailSts_152_dt "Q = V" IDENTICAL "%0.6" "" /end COMPU_METHOD
/begin COMPU_METHOD autosar_swc_val_CM_ABS_ESP_1_ESPSwitchStatus_152_dt "Q = V" IDENTICAL "%0.6" "" /end COMPU_METHOD
/begin COMPU_METHOD autosar_swc_val_CM_ABS_ESP_1_HDCCtrlSts_152_dt "Q = V" IDENTICAL "%0.6" "" /end COMPU_METHOD
/begin COMPU_METHOD autosar_swc_val_CM_ABS_ESP_1_HDCFailSts_152_dt "Q = V" IDENTICAL "%0.6" "" /end COMPU_METHOD
/begin COMPU_METHOD autosar_swc_val_CM_ABS_ESP_1_HHCFailSts_152_dt "Q = V" IDENTICAL "%0.6" "" /end COMPU_METHOD
/begin COMPU_METHOD autosar_swc_val_CM_ABS_ESP_1_TCSActive_152_dt "Q = V" IDENTICAL "%0.6" "" /end COMPU_METHOD
/begin COMPU_METHOD autosar_swc_val_CM_ABS_ESP_1_TCSFailSts_152_dt "Q = V" IDENTICAL "%0.6" "" /end COMPU_METHOD
/begin COMPU_METHOD autosar_swc_val_CM_ABS_ESP_1_VDCActive_152_dt "Q = V" IDENTICAL "%0.6" "" /end COMPU_METHOD
/begin COMPU_METHOD autosar_swc_val_CM_ABS_ESP_1_VDCFailSts_152_dt "Q = V" IDENTICAL "%0.6" "" /end COMPU_METHOD
/begin COMPU_METHOD autosar_swc_val_CM_ABS_ESP_1_VehicleSpeedVSOSig_152_dt "Q = V" IDENTICAL "%8.6" "" /end COMPU_METHOD
/begin COMPU_METHOD autosar_swc_val_CM_AEBdecActive_152_dt "Q = V" IDENTICAL "%0.6" "" /end COMPU_METHOD
/begin COMPU_METHOD autosar_swc_val_CM_AEBdecAvailable_152_dt "Q = V" IDENTICAL "%0.6" "" /end COMPU_METHOD
/begin COMPU_METHOD autosar_swc_val_CM_AVHFailSts_555_dt "Q = V" IDENTICAL "%0.6" "" /end COMPU_METHOD
/begin COMPU_METHOD autosar_swc_val_CM_AVHSts_555_dt "Q = V" IDENTICAL "%0.6" "" /end COMPU_METHOD
/begin COMPU_METHOD autosar_swc_val_CM_BLRequestController_152_dt "Q = V" IDENTICAL "%0.6" "" /end COMPU_METHOD
/begin COMPU_METHOD autosar_swc_val_CM_BrakeSystemType_152_dt "Q = V" IDENTICAL "%0.6" "" /end COMPU_METHOD
/begin COMPU_METHOD autosar_swc_val_CM_BrakesystemFailSts_1193_dt "Q = V" IDENTICAL "%0.6" "" /end COMPU_METHOD
/begin COMPU_METHOD autosar_swc_val_CM_CDDActive_555_dt "Q = V" IDENTICAL "%0.6" "" /end COMPU_METHOD
/begin COMPU_METHOD autosar_swc_val_CM_CDDAvailable_555_dt "Q = V" IDENTICAL "%0.6" "" /end COMPU_METHOD
/begin COMPU_METHOD autosar_swc_val_CM_CDPActive_152_dt "Q = V" IDENTICAL "%0.6" "" /end COMPU_METHOD
/begin COMPU_METHOD autosar_swc_val_CM_CDPFailSts_152_dt "Q = V" IDENTICAL "%0.6" "" /end COMPU_METHOD
/begin COMPU_METHOD autosar_swc_val_CM_DCFail_555_dt "Q = V" IDENTICAL "%0.6" "" /end COMPU_METHOD
/begin COMPU_METHOD autosar_swc_val_CM_DTCActive_555_dt "Q = V" IDENTICAL "%0.6" "" /end COMPU_METHOD
/begin COMPU_METHOD autosar_swc_val_CM_DTCAvailable_555_dt "Q = V" IDENTICAL "%0.6" "" /end COMPU_METHOD
/begin COMPU_METHOD autosar_swc_val_CM_DTC_Intervention_555_dt "Q = V" IDENTICAL "%0.6" "" /end COMPU_METHOD
/begin COMPU_METHOD autosar_swc_val_CM_ECDTempOff_555_dt "Q = V" IDENTICAL "%0.6" "" /end COMPU_METHOD
/begin COMPU_METHOD autosar_swc_val_CM_ESP1_VehicleSpeedVSOSigValidData_152_dt "Q = V" IDENTICAL "%0.6" "" /end COMPU_METHOD
/begin COMPU_METHOD autosar_swc_val_CM_HHCActive_152_dt "Q = V" IDENTICAL "%0.6" "" /end COMPU_METHOD
/begin COMPU_METHOD autosar_swc_val_CM_HLRequest_152_dt "Q = V" IDENTICAL "%0.6" "" /end COMPU_METHOD
/begin COMPU_METHOD autosar_swc_val_CM_IPB_1_MbRegenTargetWheelQ_152_dt "Q = V" IDENTICAL "%0.6" "" /end COMPU_METHOD
/begin COMPU_METHOD autosar_swc_val_CM_IPB_1_MbRegenTargetWheel_152_dt "Q = V" IDENTICAL "%0.6" "" /end COMPU_METHOD
/begin COMPU_METHOD autosar_swc_val_CM_IPB_InputRodStrokeStatus_555_dt "Q = V" IDENTICAL "%0.6" "" /end COMPU_METHOD
/begin COMPU_METHOD autosar_swc_val_CM_IPB_InputRodStroke_555_dt "Q = V" IDENTICAL "%8.6" "" /end COMPU_METHOD
/begin COMPU_METHOD autosar_swc_val_CM_IPB_PlungerPressureValidData_555_dt "Q = V" IDENTICAL "%0.6" "" /end COMPU_METHOD
/begin COMPU_METHOD autosar_swc_val_CM_IPB_PlungerPressure_555_dt "Q = V" IDENTICAL "%0.6" "" /end COMPU_METHOD
/begin COMPU_METHOD autosar_swc_val_CM_IPB_SimulatorPressureStatus_152_dt "Q = V" IDENTICAL "%0.6" "" /end COMPU_METHOD
/begin COMPU_METHOD autosar_swc_val_CM_IPB_SimulatorPressure_152_dt "Q = V" IDENTICAL "%0.6" "" /end COMPU_METHOD
/begin COMPU_METHOD autosar_swc_val_CM_LHFPulseCounterFailSts_587_dt "Q = V" IDENTICAL "%0.6" "" /end COMPU_METHOD
/begin COMPU_METHOD autosar_swc_val_CM_LHFPulseCounter_587_dt "Q = V" IDENTICAL "%0.6" "" /end COMPU_METHOD
/begin COMPU_METHOD autosar_swc_val_CM_LHFWheelDriveDirection_587_dt "Q = V" IDENTICAL "%0.6" "" /end COMPU_METHOD
/begin COMPU_METHOD autosar_swc_val_CM_LHFWheelSpeedRPM_587_dt "Q = V" IDENTICAL "%8.6" "" /end COMPU_METHOD
/begin COMPU_METHOD autosar_swc_val_CM_LHFWheelSpeedRawValidData_587_dt "Q = V" IDENTICAL "%0.6" "" /end COMPU_METHOD
/begin COMPU_METHOD autosar_swc_val_CM_LHFWheelSpeedRaw_587_dt "Q = V" IDENTICAL "%8.6" "" /end COMPU_METHOD
/begin COMPU_METHOD autosar_swc_val_CM_LHRDoorLockSts_699_dt "Q = V" IDENTICAL "%0.6" "" /end COMPU_METHOD
/begin COMPU_METHOD autosar_swc_val_CM_LHRPulseCounterFailSts_587_dt "Q = V" IDENTICAL "%0.6" "" /end COMPU_METHOD
/begin COMPU_METHOD autosar_swc_val_CM_LHRPulseCounter_587_dt "Q = V" IDENTICAL "%0.6" "" /end COMPU_METHOD
/begin COMPU_METHOD autosar_swc_val_CM_LHRWheelDriveDirection_587_dt "Q = V" IDENTICAL "%0.6" "" /end COMPU_METHOD
/begin COMPU_METHOD autosar_swc_val_CM_LHRWheelSpeedRPM_587_dt "Q = V" IDENTICAL "%8.6" "" /end COMPU_METHOD
/begin COMPU_METHOD autosar_swc_val_CM_LHRWheelSpeedRawValidData_587_dt "Q = V" IDENTICAL "%0.6" "" /end COMPU_METHOD
/begin COMPU_METHOD autosar_swc_val_CM_LHRWheelSpeedRaw_587_dt "Q = V" IDENTICAL "%8.6" "" /end COMPU_METHOD
/begin COMPU_METHOD autosar_swc_val_CM_LHRdoorSts_699_dt "Q = V" IDENTICAL "%0.6" "" /end COMPU_METHOD
/begin COMPU_METHOD autosar_swc_val_CM_MFS_2_CRC_864_dt "Q = V" IDENTICAL "%0.6" "" /end COMPU_METHOD
/begin COMPU_METHOD autosar_swc_val_CM_MFS_2_RollgCntr_864_dt "Q = V" IDENTICAL "%0.6" "" /end COMPU_METHOD
/begin COMPU_METHOD autosar_swc_val_CM_MFS_Cruise_Control_864_dt "Q = V" IDENTICAL "%0.6" "" /end COMPU_METHOD
/begin COMPU_METHOD autosar_swc_val_CM_MFS_LeRollrUpDwnAdjSteps_864_dt "Q = V" IDENTICAL "%0.6" "" /end COMPU_METHOD
/begin COMPU_METHOD autosar_swc_val_CM_MFS_LeftRollerMiddleKey_864_dt "Q = V" IDENTICAL "%0.6" "" /end COMPU_METHOD
/begin COMPU_METHOD autosar_swc_val_CM_MFS_LeftRoller_864_dt "Q = V" IDENTICAL "%0.6" "" /end COMPU_METHOD
/begin COMPU_METHOD autosar_swc_val_CM_MFS_RESPlus_864_dt "Q = V" IDENTICAL "%0.6" "" /end COMPU_METHOD
/begin COMPU_METHOD autosar_swc_val_CM_MFS_Rsp_Error_864_dt "Q = V" IDENTICAL "%0.6" "" /end COMPU_METHOD
/begin COMPU_METHOD autosar_swc_val_CM_MFS_SETMinus_864_dt "Q = V" IDENTICAL "%0.6" "" /end COMPU_METHOD
/begin COMPU_METHOD autosar_swc_val_CM_MFS_Time_Gap_Add_864_dt "Q = V" IDENTICAL "%0.6" "" /end COMPU_METHOD
/begin COMPU_METHOD autosar_swc_val_CM_MFS_Time_Gap_Reduce_864_dt "Q = V" IDENTICAL "%0.6" "" /end COMPU_METHOD
/begin COMPU_METHOD autosar_swc_val_CM_NoBrakeForce_555_dt "Q = V" IDENTICAL "%0.6" "" /end COMPU_METHOD
/begin COMPU_METHOD autosar_swc_val_CM_ONEBOX_1_CRC1_152_dt "Q = V" IDENTICAL "%0.6" "" /end COMPU_METHOD
/begin COMPU_METHOD autosar_swc_val_CM_ONEBOX_1_CRC2_152_dt "Q = V" IDENTICAL "%0.6" "" /end COMPU_METHOD
/begin COMPU_METHOD autosar_swc_val_CM_ONEBOX_1_Resd1_152_dt "Q = V" IDENTICAL "%0.6" "" /end COMPU_METHOD
/begin COMPU_METHOD autosar_swc_val_CM_ONEBOX_1_Resd2_152_dt "Q = V" IDENTICAL "%0.6" "" /end COMPU_METHOD
/begin COMPU_METHOD autosar_swc_val_CM_ONEBOX_1_RollgCntr1_152_dt "Q = V" IDENTICAL "%0.6" "" /end COMPU_METHOD
/begin COMPU_METHOD autosar_swc_val_CM_ONEBOX_1_RollgCntr2_152_dt "Q = V" IDENTICAL "%0.6" "" /end COMPU_METHOD
/begin COMPU_METHOD autosar_swc_val_CM_ONEBOX_2_G_CRC_1193_dt "Q = V" IDENTICAL "%0.6" "" /end COMPU_METHOD
/begin COMPU_METHOD autosar_swc_val_CM_ONEBOX_2_G_Resd_1193_dt "Q = V" IDENTICAL "%0.6" "" /end COMPU_METHOD
/begin COMPU_METHOD autosar_swc_val_CM_ONEBOX_2_G_RollgCntr_1193_dt "Q = V" IDENTICAL "%0.6" "" /end COMPU_METHOD
/begin COMPU_METHOD autosar_swc_val_CM_ONEBOX_3_CRC1_555_dt "Q = V" IDENTICAL "%0.6" "" /end COMPU_METHOD
/begin COMPU_METHOD autosar_swc_val_CM_ONEBOX_3_CRC2_555_dt "Q = V" IDENTICAL "%0.6" "" /end COMPU_METHOD
/begin COMPU_METHOD autosar_swc_val_CM_ONEBOX_3_CRC4_555_dt "Q = V" IDENTICAL "%0.6" "" /end COMPU_METHOD
/begin COMPU_METHOD autosar_swc_val_CM_ONEBOX_3_Resd1_555_dt "Q = V" IDENTICAL "%0.6" "" /end COMPU_METHOD
/begin COMPU_METHOD autosar_swc_val_CM_ONEBOX_3_Resd2_555_dt "Q = V" IDENTICAL "%0.6" "" /end COMPU_METHOD
/begin COMPU_METHOD autosar_swc_val_CM_ONEBOX_3_Resd4_555_dt "Q = V" IDENTICAL "%0.6" "" /end COMPU_METHOD
/begin COMPU_METHOD autosar_swc_val_CM_ONEBOX_3_RollgCntr1_555_dt "Q = V" IDENTICAL "%0.6" "" /end COMPU_METHOD
/begin COMPU_METHOD autosar_swc_val_CM_ONEBOX_3_RollgCntr2_555_dt "Q = V" IDENTICAL "%0.6" "" /end COMPU_METHOD
/begin COMPU_METHOD autosar_swc_val_CM_ONEBOX_3_RollgCntr4_555_dt "Q = V" IDENTICAL "%0.6" "" /end COMPU_METHOD
/begin COMPU_METHOD autosar_swc_val_CM_ONEBOX_4_CRC1_587_dt "Q = V" IDENTICAL "%0.6" "" /end COMPU_METHOD
/begin COMPU_METHOD autosar_swc_val_CM_ONEBOX_4_CRC2_587_dt "Q = V" IDENTICAL "%0.6" "" /end COMPU_METHOD
/begin COMPU_METHOD autosar_swc_val_CM_ONEBOX_4_CRC3_587_dt "Q = V" IDENTICAL "%0.6" "" /end COMPU_METHOD
/begin COMPU_METHOD autosar_swc_val_CM_ONEBOX_4_CRC4_587_dt "Q = V" IDENTICAL "%0.6" "" /end COMPU_METHOD
/begin COMPU_METHOD autosar_swc_val_CM_ONEBOX_4_Resd1_587_dt "Q = V" IDENTICAL "%0.6" "" /end COMPU_METHOD
/begin COMPU_METHOD autosar_swc_val_CM_ONEBOX_4_Resd2_587_dt "Q = V" IDENTICAL "%0.6" "" /end COMPU_METHOD
/begin COMPU_METHOD autosar_swc_val_CM_ONEBOX_4_Resd3_587_dt "Q = V" IDENTICAL "%0.6" "" /end COMPU_METHOD
/begin COMPU_METHOD autosar_swc_val_CM_ONEBOX_4_Resd4_587_dt "Q = V" IDENTICAL "%0.6" "" /end COMPU_METHOD
/begin COMPU_METHOD autosar_swc_val_CM_ONEBOX_4_RollgCntr1_587_dt "Q = V" IDENTICAL "%0.6" "" /end COMPU_METHOD
/begin COMPU_METHOD autosar_swc_val_CM_ONEBOX_4_RollgCntr2_587_dt "Q = V" IDENTICAL "%0.6" "" /end COMPU_METHOD
/begin COMPU_METHOD autosar_swc_val_CM_ONEBOX_4_RollgCntr3_587_dt "Q = V" IDENTICAL "%0.6" "" /end COMPU_METHOD
/begin COMPU_METHOD autosar_swc_val_CM_ONEBOX_4_RollgCntr4_587_dt "Q = V" IDENTICAL "%0.6" "" /end COMPU_METHOD
/begin COMPU_METHOD autosar_swc_val_CM_ONEBOX_5_APCFailureSts_335_dt "Q = V" IDENTICAL "%0.6" "" /end COMPU_METHOD
/begin COMPU_METHOD autosar_swc_val_CM_ONEBOX_5_APCStatus_335_dt "Q = V" IDENTICAL "%0.6" "" /end COMPU_METHOD
/begin COMPU_METHOD autosar_swc_val_CM_ONEBOX_5_AbaActSts_335_dt "Q = V" IDENTICAL "%0.6" "" /end COMPU_METHOD
/begin COMPU_METHOD autosar_swc_val_CM_ONEBOX_5_AbaAvlSts_335_dt "Q = V" IDENTICAL "%0.6" "" /end COMPU_METHOD
/begin COMPU_METHOD autosar_swc_val_CM_ONEBOX_5_AbaLvlSts_335_dt "Q = V" IDENTICAL "%0.6" "" /end COMPU_METHOD
/begin COMPU_METHOD autosar_swc_val_CM_ONEBOX_5_AbpActSts_335_dt "Q = V" IDENTICAL "%0.6" "" /end COMPU_METHOD
/begin COMPU_METHOD autosar_swc_val_CM_ONEBOX_5_AbpAvlSts_335_dt "Q = V" IDENTICAL "%0.6" "" /end COMPU_METHOD
/begin COMPU_METHOD autosar_swc_val_CM_ONEBOX_5_ApaAvl_335_dt "Q = V" IDENTICAL "%0.6" "" /end COMPU_METHOD
/begin COMPU_METHOD autosar_swc_val_CM_ONEBOX_5_AwbActSts_335_dt "Q = V" IDENTICAL "%0.6" "" /end COMPU_METHOD
/begin COMPU_METHOD autosar_swc_val_CM_ONEBOX_5_AwbAvlSts_335_dt "Q = V" IDENTICAL "%0.6" "" /end COMPU_METHOD
/begin COMPU_METHOD autosar_swc_val_CM_ONEBOX_5_CRC1_335_dt "Q = V" IDENTICAL "%0.6" "" /end COMPU_METHOD
/begin COMPU_METHOD autosar_swc_val_CM_ONEBOX_5_CddAdcActiveVehHld_335_dt "Q = V" IDENTICAL "%0.6" "" /end COMPU_METHOD
/begin COMPU_METHOD autosar_swc_val_CM_ONEBOX_5_CddApActiveVehHld_335_dt "Q = V" IDENTICAL "%0.6" "" /end COMPU_METHOD
/begin COMPU_METHOD autosar_swc_val_CM_ONEBOX_5_MebAvl_335_dt "Q = V" IDENTICAL "%0.6" "" /end COMPU_METHOD
/begin COMPU_METHOD autosar_swc_val_CM_ONEBOX_5_PilotParkBrkDecActSts_335_dt "Q = V" IDENTICAL "%0.6" "" /end COMPU_METHOD
/begin COMPU_METHOD autosar_swc_val_CM_ONEBOX_5_PilotParkBrkDecCtlAvl_335_dt "Q = V" IDENTICAL "%0.6" "" /end COMPU_METHOD
/begin COMPU_METHOD autosar_swc_val_CM_ONEBOX_5_Resd1_335_dt "Q = V" IDENTICAL "%0.6" "" /end COMPU_METHOD
/begin COMPU_METHOD autosar_swc_val_CM_ONEBOX_5_RollgCntr1_335_dt "Q = V" IDENTICAL "%0.6" "" /end COMPU_METHOD
/begin COMPU_METHOD autosar_swc_val_CM_ONEBOX_5_RpaAvl_335_dt "Q = V" IDENTICAL "%0.6" "" /end COMPU_METHOD
/begin COMPU_METHOD autosar_swc_val_CM_ONEBOX_5_SysBrkPVld_335_dt "Q = V" IDENTICAL "%0.6" "" /end COMPU_METHOD
/begin COMPU_METHOD autosar_swc_val_CM_ONEBOX_5_SysBrkP_335_dt "Q = V" IDENTICAL "%0.6" "" /end COMPU_METHOD
/begin COMPU_METHOD autosar_swc_val_CM_PPMID_1_HWSt_1208_dt "Q = V" IDENTICAL "%0.6" "" /end COMPU_METHOD
/begin COMPU_METHOD autosar_swc_val_CM_PPMID_1_PPMICounter_1208_dt "Q = V" IDENTICAL "%0.6" "" /end COMPU_METHOD
/begin COMPU_METHOD autosar_swc_val_CM_PPMID_1_PPMISt_1208_dt "Q = V" IDENTICAL "%0.6" "" /end COMPU_METHOD
/begin COMPU_METHOD autosar_swc_val_CM_PPMID_1_PPSt_1208_dt "Q = V" IDENTICAL "%0.6" "" /end COMPU_METHOD
/begin COMPU_METHOD autosar_swc_val_CM_RHFPulseCounterFailSts_587_dt "Q = V" IDENTICAL "%0.6" "" /end COMPU_METHOD
/begin COMPU_METHOD autosar_swc_val_CM_RHFPulseCounter_587_dt "Q = V" IDENTICAL "%0.6" "" /end COMPU_METHOD
/begin COMPU_METHOD autosar_swc_val_CM_RHFWheelDriveDirection_587_dt "Q = V" IDENTICAL "%0.6" "" /end COMPU_METHOD
/begin COMPU_METHOD autosar_swc_val_CM_RHFWheelSpeedRPM_587_dt "Q = V" IDENTICAL "%8.6" "" /end COMPU_METHOD
/begin COMPU_METHOD autosar_swc_val_CM_RHFWheelSpeedRawValidData_587_dt "Q = V" IDENTICAL "%0.6" "" /end COMPU_METHOD
/begin COMPU_METHOD autosar_swc_val_CM_RHFWheelSpeedRaw_587_dt "Q = V" IDENTICAL "%8.6" "" /end COMPU_METHOD
/begin COMPU_METHOD autosar_swc_val_CM_RHRPulseCounterFailSts_587_dt "Q = V" IDENTICAL "%0.6" "" /end COMPU_METHOD
/begin COMPU_METHOD autosar_swc_val_CM_RHRPulseCounter_587_dt "Q = V" IDENTICAL "%0.6" "" /end COMPU_METHOD
/begin COMPU_METHOD autosar_swc_val_CM_RHRWheelDriveDirection_587_dt "Q = V" IDENTICAL "%0.6" "" /end COMPU_METHOD
/begin COMPU_METHOD autosar_swc_val_CM_RHRWheelSpeedRPM_587_dt "Q = V" IDENTICAL "%8.6" "" /end COMPU_METHOD
/begin COMPU_METHOD autosar_swc_val_CM_RHRWheelSpeedRawValidData_587_dt "Q = V" IDENTICAL "%0.6" "" /end COMPU_METHOD
/begin COMPU_METHOD autosar_swc_val_CM_RHRWheelSpeedRaw_587_dt "Q = V" IDENTICAL "%8.6" "" /end COMPU_METHOD
/begin COMPU_METHOD autosar_swc_val_CM_RLCR_1_BSDWarn_1095_dt "Q = V" IDENTICAL "%0.6" "" /end COMPU_METHOD
/begin COMPU_METHOD autosar_swc_val_CM_RLCR_1_BlkSts_1095_dt "Q = V" IDENTICAL "%0.6" "" /end COMPU_METHOD
/begin COMPU_METHOD autosar_swc_val_CM_RLCR_1_CRC1_1095_dt "Q = V" IDENTICAL "%0.6" "" /end COMPU_METHOD
/begin COMPU_METHOD autosar_swc_val_CM_RLCR_1_DOWWarn_1095_dt "Q = V" IDENTICAL "%0.6" "" /end COMPU_METHOD
/begin COMPU_METHOD autosar_swc_val_CM_RLCR_1_DowLock_1095_dt "Q = V" IDENTICAL "%0.6" "" /end COMPU_METHOD
/begin COMPU_METHOD autosar_swc_val_CM_RLCR_1_ELK_CollisionFlagValid_1095_dt "Q = V" IDENTICAL "%0.6" "" /end COMPU_METHOD
/begin COMPU_METHOD autosar_swc_val_CM_RLCR_1_ELK_Collision_flag_1095_dt "Q = V" IDENTICAL "%0.6" "" /end COMPU_METHOD
/begin COMPU_METHOD autosar_swc_val_CM_RLCR_1_Resd1_1095_dt "Q = V" IDENTICAL "%0.6" "" /end COMPU_METHOD
/begin COMPU_METHOD autosar_swc_val_CM_RLCR_1_RollgCntr1_1095_dt "Q = V" IDENTICAL "%0.6" "" /end COMPU_METHOD
/begin COMPU_METHOD autosar_swc_val_CM_RLCR_1_SysSt_1095_dt "Q = V" IDENTICAL "%0.6" "" /end COMPU_METHOD
/begin COMPU_METHOD autosar_swc_val_CM_RLCR_2_BSDLCWONOFFSts_1104_dt "Q = V" IDENTICAL "%0.6" "" /end COMPU_METHOD
/begin COMPU_METHOD autosar_swc_val_CM_RLCR_2_CRC1_1104_dt "Q = V" IDENTICAL "%0.6" "" /end COMPU_METHOD
/begin COMPU_METHOD autosar_swc_val_CM_RLCR_2_DOWONOFFSts_1104_dt "Q = V" IDENTICAL "%0.6" "" /end COMPU_METHOD
/begin COMPU_METHOD autosar_swc_val_CM_RLCR_2_RCTARCTBONOFFSts_1104_dt "Q = V" IDENTICAL "%0.6" "" /end COMPU_METHOD
/begin COMPU_METHOD autosar_swc_val_CM_RLCR_2_RCTAWarn_1104_dt "Q = V" IDENTICAL "%0.6" "" /end COMPU_METHOD
/begin COMPU_METHOD autosar_swc_val_CM_RLCR_2_RCTBCtrlA_1104_dt "Q = V" IDENTICAL "%8.6" "" /end COMPU_METHOD
/begin COMPU_METHOD autosar_swc_val_CM_RLCR_2_RCTBReq_1104_dt "Q = V" IDENTICAL "%0.6" "" /end COMPU_METHOD
/begin COMPU_METHOD autosar_swc_val_CM_RLCR_2_RCTBWarn_1104_dt "Q = V" IDENTICAL "%0.6" "" /end COMPU_METHOD
/begin COMPU_METHOD autosar_swc_val_CM_RLCR_2_RCWONOFFSts_1104_dt "Q = V" IDENTICAL "%0.6" "" /end COMPU_METHOD
/begin COMPU_METHOD autosar_swc_val_CM_RLCR_2_RCWWarn_1104_dt "Q = V" IDENTICAL "%0.6" "" /end COMPU_METHOD
/begin COMPU_METHOD autosar_swc_val_CM_RLCR_2_Resd1_1104_dt "Q = V" IDENTICAL "%0.6" "" /end COMPU_METHOD
/begin COMPU_METHOD autosar_swc_val_CM_RLCR_2_RollgCntr1_1104_dt "Q = V" IDENTICAL "%0.6" "" /end COMPU_METHOD
/begin COMPU_METHOD autosar_swc_val_CM_RLCR_3_CRC_935_dt "Q = V" IDENTICAL "%0.6" "" /end COMPU_METHOD
/begin COMPU_METHOD autosar_swc_val_CM_RLCR_3_Le1HdTo_935_dt "Q = V" IDENTICAL "%8.6" "" /end COMPU_METHOD
/begin COMPU_METHOD autosar_swc_val_CM_RLCR_3_Le1ObjBoxLen_935_dt "Q = V" IDENTICAL "%8.6" "" /end COMPU_METHOD
/begin COMPU_METHOD autosar_swc_val_CM_RLCR_3_Le1ObjBoxWidth_935_dt "Q = V" IDENTICAL "%8.6" "" /end COMPU_METHOD
/begin COMPU_METHOD autosar_swc_val_CM_RLCR_3_Le1ObjConf_935_dt "Q = V" IDENTICAL "%0.6" "" /end COMPU_METHOD
/begin COMPU_METHOD autosar_swc_val_CM_RLCR_3_Le1ObjCoordXDstStdDe_935_dt "Q = V" IDENTICAL "%8.6" "" /end COMPU_METHOD
/begin COMPU_METHOD autosar_swc_val_CM_RLCR_3_Le1ObjCoordX_935_dt "Q = V" IDENTICAL "%8.6" "" /end COMPU_METHOD
/begin COMPU_METHOD autosar_swc_val_CM_RLCR_3_Le1ObjCoordYDstStdDe_935_dt "Q = V" IDENTICAL "%8.6" "" /end COMPU_METHOD
/begin COMPU_METHOD autosar_swc_val_CM_RLCR_3_Le1ObjCoordY_935_dt "Q = V" IDENTICAL "%8.6" "" /end COMPU_METHOD
/begin COMPU_METHOD autosar_swc_val_CM_RLCR_3_Le1ObjID_935_dt "Q = V" IDENTICAL "%0.6" "" /end COMPU_METHOD
/begin COMPU_METHOD autosar_swc_val_CM_RLCR_3_Le1ObjMtnChartc_935_dt "Q = V" IDENTICAL "%0.6" "" /end COMPU_METHOD
/begin COMPU_METHOD autosar_swc_val_CM_RLCR_3_Le1ObjNrOffocst_935_dt "Q = V" IDENTICAL "%0.6" "" /end COMPU_METHOD
/begin COMPU_METHOD autosar_swc_val_CM_RLCR_3_Le1ObjTrackSt_935_dt "Q = V" IDENTICAL "%0.6" "" /end COMPU_METHOD
/begin COMPU_METHOD autosar_swc_val_CM_RLCR_3_Le1ObjTyp_935_dt "Q = V" IDENTICAL "%0.6" "" /end COMPU_METHOD
/begin COMPU_METHOD autosar_swc_val_CM_RLCR_3_Le1ObjXDirAV_935_dt "Q = V" IDENTICAL "%8.6" "" /end COMPU_METHOD
/begin COMPU_METHOD autosar_swc_val_CM_RLCR_3_Le1ObjXDirVStdDe_935_dt "Q = V" IDENTICAL "%8.6" "" /end COMPU_METHOD
/begin COMPU_METHOD autosar_swc_val_CM_RLCR_3_Le1ObjXDirV_935_dt "Q = V" IDENTICAL "%8.6" "" /end COMPU_METHOD
/begin COMPU_METHOD autosar_swc_val_CM_RLCR_3_Le1ObjYDirVStdDe_935_dt "Q = V" IDENTICAL "%8.6" "" /end COMPU_METHOD
/begin COMPU_METHOD autosar_swc_val_CM_RLCR_3_Le1ObjYDirV_935_dt "Q = V" IDENTICAL "%8.6" "" /end COMPU_METHOD
/begin COMPU_METHOD autosar_swc_val_CM_RLCR_3_RollgCntr_935_dt "Q = V" IDENTICAL "%0.6" "" /end COMPU_METHOD
/begin COMPU_METHOD autosar_swc_val_CM_RLCR_4_CRC_937_dt "Q = V" IDENTICAL "%0.6" "" /end COMPU_METHOD
/begin COMPU_METHOD autosar_swc_val_CM_RLCR_4_Le2HdTo_937_dt "Q = V" IDENTICAL "%8.6" "" /end COMPU_METHOD
/begin COMPU_METHOD autosar_swc_val_CM_RLCR_4_Le2ObjBoxLen_937_dt "Q = V" IDENTICAL "%8.6" "" /end COMPU_METHOD
/begin COMPU_METHOD autosar_swc_val_CM_RLCR_4_Le2ObjBoxWidth_937_dt "Q = V" IDENTICAL "%8.6" "" /end COMPU_METHOD
/begin COMPU_METHOD autosar_swc_val_CM_RLCR_4_Le2ObjConf_937_dt "Q = V" IDENTICAL "%0.6" "" /end COMPU_METHOD
/begin COMPU_METHOD autosar_swc_val_CM_RLCR_4_Le2ObjCoordXDstStdDe_937_dt "Q = V" IDENTICAL "%8.6" "" /end COMPU_METHOD
/begin COMPU_METHOD autosar_swc_val_CM_RLCR_4_Le2ObjCoordX_937_dt "Q = V" IDENTICAL "%8.6" "" /end COMPU_METHOD
/begin COMPU_METHOD autosar_swc_val_CM_RLCR_4_Le2ObjCoordYDstStdDe_937_dt "Q = V" IDENTICAL "%8.6" "" /end COMPU_METHOD
/begin COMPU_METHOD autosar_swc_val_CM_RLCR_4_Le2ObjCoordY_937_dt "Q = V" IDENTICAL "%8.6" "" /end COMPU_METHOD
/begin COMPU_METHOD autosar_swc_val_CM_RLCR_4_Le2ObjID_937_dt "Q = V" IDENTICAL "%0.6" "" /end COMPU_METHOD
/begin COMPU_METHOD autosar_swc_val_CM_RLCR_4_Le2ObjMtnChartc_937_dt "Q = V" IDENTICAL "%0.6" "" /end COMPU_METHOD
/begin COMPU_METHOD autosar_swc_val_CM_RLCR_4_Le2ObjNrOffocst_937_dt "Q = V" IDENTICAL "%0.6" "" /end COMPU_METHOD
/begin COMPU_METHOD autosar_swc_val_CM_RLCR_4_Le2ObjTrackSt_937_dt "Q = V" IDENTICAL "%0.6" "" /end COMPU_METHOD
/begin COMPU_METHOD autosar_swc_val_CM_RLCR_4_Le2ObjTyp_937_dt "Q = V" IDENTICAL "%0.6" "" /end COMPU_METHOD
/begin COMPU_METHOD autosar_swc_val_CM_RLCR_4_Le2ObjXDirAV_937_dt "Q = V" IDENTICAL "%8.6" "" /end COMPU_METHOD
/begin COMPU_METHOD autosar_swc_val_CM_RLCR_4_Le2ObjXDirVStdDe_937_dt "Q = V" IDENTICAL "%8.6" "" /end COMPU_METHOD
/begin COMPU_METHOD autosar_swc_val_CM_RLCR_4_Le2ObjXDirV_937_dt "Q = V" IDENTICAL "%8.6" "" /end COMPU_METHOD
/begin COMPU_METHOD autosar_swc_val_CM_RLCR_4_Le2ObjYDirVStdDe_937_dt "Q = V" IDENTICAL "%8.6" "" /end COMPU_METHOD
/begin COMPU_METHOD autosar_swc_val_CM_RLCR_4_Le2ObjYDirV_937_dt "Q = V" IDENTICAL "%8.6" "" /end COMPU_METHOD
/begin COMPU_METHOD autosar_swc_val_CM_RLCR_4_RollgCntr_937_dt "Q = V" IDENTICAL "%0.6" "" /end COMPU_METHOD
/begin COMPU_METHOD autosar_swc_val_CM_RLCR_5_CRC_941_dt "Q = V" IDENTICAL "%0.6" "" /end COMPU_METHOD
/begin COMPU_METHOD autosar_swc_val_CM_RLCR_5_Le3HdTo_941_dt "Q = V" IDENTICAL "%8.6" "" /end COMPU_METHOD
/begin COMPU_METHOD autosar_swc_val_CM_RLCR_5_Le3ObjBoxLen_941_dt "Q = V" IDENTICAL "%8.6" "" /end COMPU_METHOD
/begin COMPU_METHOD autosar_swc_val_CM_RLCR_5_Le3ObjBoxWidth_941_dt "Q = V" IDENTICAL "%8.6" "" /end COMPU_METHOD
/begin COMPU_METHOD autosar_swc_val_CM_RLCR_5_Le3ObjConf_941_dt "Q = V" IDENTICAL "%0.6" "" /end COMPU_METHOD
/begin COMPU_METHOD autosar_swc_val_CM_RLCR_5_Le3ObjCoordXDstStdDe_941_dt "Q = V" IDENTICAL "%8.6" "" /end COMPU_METHOD
/begin COMPU_METHOD autosar_swc_val_CM_RLCR_5_Le3ObjCoordX_941_dt "Q = V" IDENTICAL "%8.6" "" /end COMPU_METHOD
/begin COMPU_METHOD autosar_swc_val_CM_RLCR_5_Le3ObjCoordYDstStdDe_941_dt "Q = V" IDENTICAL "%8.6" "" /end COMPU_METHOD
/begin COMPU_METHOD autosar_swc_val_CM_RLCR_5_Le3ObjCoordY_941_dt "Q = V" IDENTICAL "%8.6" "" /end COMPU_METHOD
/begin COMPU_METHOD autosar_swc_val_CM_RLCR_5_Le3ObjID_941_dt "Q = V" IDENTICAL "%0.6" "" /end COMPU_METHOD
/begin COMPU_METHOD autosar_swc_val_CM_RLCR_5_Le3ObjMtnChartc_941_dt "Q = V" IDENTICAL "%0.6" "" /end COMPU_METHOD
/begin COMPU_METHOD autosar_swc_val_CM_RLCR_5_Le3ObjNrOffocst_941_dt "Q = V" IDENTICAL "%0.6" "" /end COMPU_METHOD
/begin COMPU_METHOD autosar_swc_val_CM_RLCR_5_Le3ObjTrackSt_941_dt "Q = V" IDENTICAL "%0.6" "" /end COMPU_METHOD
/begin COMPU_METHOD autosar_swc_val_CM_RLCR_5_Le3ObjTyp_941_dt "Q = V" IDENTICAL "%0.6" "" /end COMPU_METHOD
/begin COMPU_METHOD autosar_swc_val_CM_RLCR_5_Le3ObjXDirAV_941_dt "Q = V" IDENTICAL "%8.6" "" /end COMPU_METHOD
/begin COMPU_METHOD autosar_swc_val_CM_RLCR_5_Le3ObjXDirVStdDe_941_dt "Q = V" IDENTICAL "%8.6" "" /end COMPU_METHOD
/begin COMPU_METHOD autosar_swc_val_CM_RLCR_5_Le3ObjXDirV_941_dt "Q = V" IDENTICAL "%8.6" "" /end COMPU_METHOD
/begin COMPU_METHOD autosar_swc_val_CM_RLCR_5_Le3ObjYDirVStdDe_941_dt "Q = V" IDENTICAL "%8.6" "" /end COMPU_METHOD
/begin COMPU_METHOD autosar_swc_val_CM_RLCR_5_Le3ObjYDirV_941_dt "Q = V" IDENTICAL "%8.6" "" /end COMPU_METHOD
/begin COMPU_METHOD autosar_swc_val_CM_RLCR_5_RollgCntr_941_dt "Q = V" IDENTICAL "%0.6" "" /end COMPU_METHOD
/begin COMPU_METHOD autosar_swc_val_CM_RLCR_6_CRC_946_dt "Q = V" IDENTICAL "%0.6" "" /end COMPU_METHOD
/begin COMPU_METHOD autosar_swc_val_CM_RLCR_6_Le4HdTo_946_dt "Q = V" IDENTICAL "%8.6" "" /end COMPU_METHOD
/begin COMPU_METHOD autosar_swc_val_CM_RLCR_6_Le4ObjBoxLen_946_dt "Q = V" IDENTICAL "%8.6" "" /end COMPU_METHOD
/begin COMPU_METHOD autosar_swc_val_CM_RLCR_6_Le4ObjBoxWidth_946_dt "Q = V" IDENTICAL "%8.6" "" /end COMPU_METHOD
/begin COMPU_METHOD autosar_swc_val_CM_RLCR_6_Le4ObjConf_946_dt "Q = V" IDENTICAL "%0.6" "" /end COMPU_METHOD
/begin COMPU_METHOD autosar_swc_val_CM_RLCR_6_Le4ObjCoordXDstStdDe_946_dt "Q = V" IDENTICAL "%8.6" "" /end COMPU_METHOD
/begin COMPU_METHOD autosar_swc_val_CM_RLCR_6_Le4ObjCoordX_946_dt "Q = V" IDENTICAL "%8.6" "" /end COMPU_METHOD
/begin COMPU_METHOD autosar_swc_val_CM_RLCR_6_Le4ObjCoordYDstStdDe_946_dt "Q = V" IDENTICAL "%8.6" "" /end COMPU_METHOD
/begin COMPU_METHOD autosar_swc_val_CM_RLCR_6_Le4ObjCoordY_946_dt "Q = V" IDENTICAL "%8.6" "" /end COMPU_METHOD
/begin COMPU_METHOD autosar_swc_val_CM_RLCR_6_Le4ObjID_946_dt "Q = V" IDENTICAL "%0.6" "" /end COMPU_METHOD
/begin COMPU_METHOD autosar_swc_val_CM_RLCR_6_Le4ObjMtnChartc_946_dt "Q = V" IDENTICAL "%0.6" "" /end COMPU_METHOD
/begin COMPU_METHOD autosar_swc_val_CM_RLCR_6_Le4ObjNrOffocst_946_dt "Q = V" IDENTICAL "%0.6" "" /end COMPU_METHOD
/begin COMPU_METHOD autosar_swc_val_CM_RLCR_6_Le4ObjTrackSt_946_dt "Q = V" IDENTICAL "%0.6" "" /end COMPU_METHOD
/begin COMPU_METHOD autosar_swc_val_CM_RLCR_6_Le4ObjTyp_946_dt "Q = V" IDENTICAL "%0.6" "" /end COMPU_METHOD
/begin COMPU_METHOD autosar_swc_val_CM_RLCR_6_Le4ObjXDirAV_946_dt "Q = V" IDENTICAL "%8.6" "" /end COMPU_METHOD
/begin COMPU_METHOD autosar_swc_val_CM_RLCR_6_Le4ObjXDirVStdDe_946_dt "Q = V" IDENTICAL "%8.6" "" /end COMPU_METHOD
/begin COMPU_METHOD autosar_swc_val_CM_RLCR_6_Le4ObjXDirV_946_dt "Q = V" IDENTICAL "%8.6" "" /end COMPU_METHOD
/begin COMPU_METHOD autosar_swc_val_CM_RLCR_6_Le4ObjYDirVStdDe_946_dt "Q = V" IDENTICAL "%8.6" "" /end COMPU_METHOD
/begin COMPU_METHOD autosar_swc_val_CM_RLCR_6_Le4ObjYDirV_946_dt "Q = V" IDENTICAL "%8.6" "" /end COMPU_METHOD
/begin COMPU_METHOD autosar_swc_val_CM_RLCR_6_RollgCntr_946_dt "Q = V" IDENTICAL "%0.6" "" /end COMPU_METHOD
/begin COMPU_METHOD autosar_swc_val_CM_RLCR_7_CRC_948_dt "Q = V" IDENTICAL "%0.6" "" /end COMPU_METHOD
/begin COMPU_METHOD autosar_swc_val_CM_RLCR_7_Le5HdTo_948_dt "Q = V" IDENTICAL "%8.6" "" /end COMPU_METHOD
/begin COMPU_METHOD autosar_swc_val_CM_RLCR_7_Le5ObjBoxLen_948_dt "Q = V" IDENTICAL "%8.6" "" /end COMPU_METHOD
/begin COMPU_METHOD autosar_swc_val_CM_RLCR_7_Le5ObjBoxWidth_948_dt "Q = V" IDENTICAL "%8.6" "" /end COMPU_METHOD
/begin COMPU_METHOD autosar_swc_val_CM_RLCR_7_Le5ObjConf_948_dt "Q = V" IDENTICAL "%0.6" "" /end COMPU_METHOD
/begin COMPU_METHOD autosar_swc_val_CM_RLCR_7_Le5ObjCoordXDstStdDe_948_dt "Q = V" IDENTICAL "%8.6" "" /end COMPU_METHOD
/begin COMPU_METHOD autosar_swc_val_CM_RLCR_7_Le5ObjCoordX_948_dt "Q = V" IDENTICAL "%8.6" "" /end COMPU_METHOD
/begin COMPU_METHOD autosar_swc_val_CM_RLCR_7_Le5ObjCoordYDstStdDe_948_dt "Q = V" IDENTICAL "%8.6" "" /end COMPU_METHOD
/begin COMPU_METHOD autosar_swc_val_CM_RLCR_7_Le5ObjCoordY_948_dt "Q = V" IDENTICAL "%8.6" "" /end COMPU_METHOD
/begin COMPU_METHOD autosar_swc_val_CM_RLCR_7_Le5ObjID_948_dt "Q = V" IDENTICAL "%0.6" "" /end COMPU_METHOD
/begin COMPU_METHOD autosar_swc_val_CM_RLCR_7_Le5ObjMtnChartc_948_dt "Q = V" IDENTICAL "%0.6" "" /end COMPU_METHOD
/begin COMPU_METHOD autosar_swc_val_CM_RLCR_7_Le5ObjNrOffocst_948_dt "Q = V" IDENTICAL "%0.6" "" /end COMPU_METHOD
/begin COMPU_METHOD autosar_swc_val_CM_RLCR_7_Le5ObjTrackSt_948_dt "Q = V" IDENTICAL "%0.6" "" /end COMPU_METHOD
/begin COMPU_METHOD autosar_swc_val_CM_RLCR_7_Le5ObjTyp_948_dt "Q = V" IDENTICAL "%0.6" "" /end COMPU_METHOD
/begin COMPU_METHOD autosar_swc_val_CM_RLCR_7_Le5ObjXDirAV_948_dt "Q = V" IDENTICAL "%8.6" "" /end COMPU_METHOD
/begin COMPU_METHOD autosar_swc_val_CM_RLCR_7_Le5ObjXDirVStdDe_948_dt "Q = V" IDENTICAL "%8.6" "" /end COMPU_METHOD
/begin COMPU_METHOD autosar_swc_val_CM_RLCR_7_Le5ObjXDirV_948_dt "Q = V" IDENTICAL "%8.6" "" /end COMPU_METHOD
/begin COMPU_METHOD autosar_swc_val_CM_RLCR_7_Le5ObjYDirVStdDe_948_dt "Q = V" IDENTICAL "%8.6" "" /end COMPU_METHOD
/begin COMPU_METHOD autosar_swc_val_CM_RLCR_7_Le5ObjYDirV_948_dt "Q = V" IDENTICAL "%8.6" "" /end COMPU_METHOD
/begin COMPU_METHOD autosar_swc_val_CM_RLCR_7_RollgCntr_948_dt "Q = V" IDENTICAL "%0.6" "" /end COMPU_METHOD
/begin COMPU_METHOD autosar_swc_val_CM_RLCR_8_CRC_953_dt "Q = V" IDENTICAL "%0.6" "" /end COMPU_METHOD
/begin COMPU_METHOD autosar_swc_val_CM_RLCR_8_RollgCntr_953_dt "Q = V" IDENTICAL "%0.6" "" /end COMPU_METHOD
/begin COMPU_METHOD autosar_swc_val_CM_RLCR_8_TiStampLaten_953_dt "Q = V" IDENTICAL "%0.6" "" /end COMPU_METHOD
/begin COMPU_METHOD autosar_swc_val_CM_RRCR_1_BSDWarn_1267_dt "Q = V" IDENTICAL "%0.6" "" /end COMPU_METHOD
/begin COMPU_METHOD autosar_swc_val_CM_RRCR_1_BlkSts_1267_dt "Q = V" IDENTICAL "%0.6" "" /end COMPU_METHOD
/begin COMPU_METHOD autosar_swc_val_CM_RRCR_1_CRC1_1267_dt "Q = V" IDENTICAL "%0.6" "" /end COMPU_METHOD
/begin COMPU_METHOD autosar_swc_val_CM_RRCR_1_DOWWarn_1267_dt "Q = V" IDENTICAL "%0.6" "" /end COMPU_METHOD
/begin COMPU_METHOD autosar_swc_val_CM_RRCR_1_DowLock_1267_dt "Q = V" IDENTICAL "%0.6" "" /end COMPU_METHOD
/begin COMPU_METHOD autosar_swc_val_CM_RRCR_1_ELK_CollisionFlagValid_1267_dt "Q = V" IDENTICAL "%0.6" "" /end COMPU_METHOD
/begin COMPU_METHOD autosar_swc_val_CM_RRCR_1_ELK_Collision_flag_1267_dt "Q = V" IDENTICAL "%0.6" "" /end COMPU_METHOD
/begin COMPU_METHOD autosar_swc_val_CM_RRCR_1_Resd1_1267_dt "Q = V" IDENTICAL "%0.6" "" /end COMPU_METHOD
/begin COMPU_METHOD autosar_swc_val_CM_RRCR_1_RollgCntr1_1267_dt "Q = V" IDENTICAL "%0.6" "" /end COMPU_METHOD
/begin COMPU_METHOD autosar_swc_val_CM_RRCR_1_SysSt_1267_dt "Q = V" IDENTICAL "%0.6" "" /end COMPU_METHOD
/begin COMPU_METHOD autosar_swc_val_CM_RRCR_3_CRC_959_dt "Q = V" IDENTICAL "%0.6" "" /end COMPU_METHOD
/begin COMPU_METHOD autosar_swc_val_CM_RRCR_3_Ri1HdTo_959_dt "Q = V" IDENTICAL "%8.6" "" /end COMPU_METHOD
/begin COMPU_METHOD autosar_swc_val_CM_RRCR_3_Ri1ObjBoxLen_959_dt "Q = V" IDENTICAL "%8.6" "" /end COMPU_METHOD
/begin COMPU_METHOD autosar_swc_val_CM_RRCR_3_Ri1ObjBoxWidth_959_dt "Q = V" IDENTICAL "%8.6" "" /end COMPU_METHOD
/begin COMPU_METHOD autosar_swc_val_CM_RRCR_3_Ri1ObjConf_959_dt "Q = V" IDENTICAL "%0.6" "" /end COMPU_METHOD
/begin COMPU_METHOD autosar_swc_val_CM_RRCR_3_Ri1ObjCoordXDstStdDe_959_dt "Q = V" IDENTICAL "%8.6" "" /end COMPU_METHOD
/begin COMPU_METHOD autosar_swc_val_CM_RRCR_3_Ri1ObjCoordX_959_dt "Q = V" IDENTICAL "%8.6" "" /end COMPU_METHOD
/begin COMPU_METHOD autosar_swc_val_CM_RRCR_3_Ri1ObjCoordYDstStdDe_959_dt "Q = V" IDENTICAL "%8.6" "" /end COMPU_METHOD
/begin COMPU_METHOD autosar_swc_val_CM_RRCR_3_Ri1ObjCoordY_959_dt "Q = V" IDENTICAL "%8.6" "" /end COMPU_METHOD
/begin COMPU_METHOD autosar_swc_val_CM_RRCR_3_Ri1ObjID_959_dt "Q = V" IDENTICAL "%0.6" "" /end COMPU_METHOD
/begin COMPU_METHOD autosar_swc_val_CM_RRCR_3_Ri1ObjMtnChartc_959_dt "Q = V" IDENTICAL "%0.6" "" /end COMPU_METHOD
/begin COMPU_METHOD autosar_swc_val_CM_RRCR_3_Ri1ObjNrOffocst_959_dt "Q = V" IDENTICAL "%0.6" "" /end COMPU_METHOD
/begin COMPU_METHOD autosar_swc_val_CM_RRCR_3_Ri1ObjTrackSt_959_dt "Q = V" IDENTICAL "%0.6" "" /end COMPU_METHOD
/begin COMPU_METHOD autosar_swc_val_CM_RRCR_3_Ri1ObjTyp_959_dt "Q = V" IDENTICAL "%0.6" "" /end COMPU_METHOD
/begin COMPU_METHOD autosar_swc_val_CM_RRCR_3_Ri1ObjXDirAV_959_dt "Q = V" IDENTICAL "%8.6" "" /end COMPU_METHOD
/begin COMPU_METHOD autosar_swc_val_CM_RRCR_3_Ri1ObjXDirVStdDe_959_dt "Q = V" IDENTICAL "%8.6" "" /end COMPU_METHOD
/begin COMPU_METHOD autosar_swc_val_CM_RRCR_3_Ri1ObjXDirV_959_dt "Q = V" IDENTICAL "%8.6" "" /end COMPU_METHOD
/begin COMPU_METHOD autosar_swc_val_CM_RRCR_3_Ri1ObjYDirVStdDe_959_dt "Q = V" IDENTICAL "%8.6" "" /end COMPU_METHOD
/begin COMPU_METHOD autosar_swc_val_CM_RRCR_3_Ri1ObjYDirV_959_dt "Q = V" IDENTICAL "%8.6" "" /end COMPU_METHOD
/begin COMPU_METHOD autosar_swc_val_CM_RRCR_3_RollgCntr_959_dt "Q = V" IDENTICAL "%0.6" "" /end COMPU_METHOD
/begin COMPU_METHOD autosar_swc_val_CM_RRCR_4_CRC_969_dt "Q = V" IDENTICAL "%0.6" "" /end COMPU_METHOD
/begin COMPU_METHOD autosar_swc_val_CM_RRCR_4_Ri2HdTo_969_dt "Q = V" IDENTICAL "%8.6" "" /end COMPU_METHOD
/begin COMPU_METHOD autosar_swc_val_CM_RRCR_4_Ri2ObjBoxLen_969_dt "Q = V" IDENTICAL "%8.6" "" /end COMPU_METHOD
/begin COMPU_METHOD autosar_swc_val_CM_RRCR_4_Ri2ObjBoxWidth_969_dt "Q = V" IDENTICAL "%8.6" "" /end COMPU_METHOD
/begin COMPU_METHOD autosar_swc_val_CM_RRCR_4_Ri2ObjConf_969_dt "Q = V" IDENTICAL "%0.6" "" /end COMPU_METHOD
/begin COMPU_METHOD autosar_swc_val_CM_RRCR_4_Ri2ObjCoordXDstStdDe_969_dt "Q = V" IDENTICAL "%8.6" "" /end COMPU_METHOD
/begin COMPU_METHOD autosar_swc_val_CM_RRCR_4_Ri2ObjCoordX_969_dt "Q = V" IDENTICAL "%8.6" "" /end COMPU_METHOD
/begin COMPU_METHOD autosar_swc_val_CM_RRCR_4_Ri2ObjCoordYDstStdDe_969_dt "Q = V" IDENTICAL "%8.6" "" /end COMPU_METHOD
/begin COMPU_METHOD autosar_swc_val_CM_RRCR_4_Ri2ObjCoordY_969_dt "Q = V" IDENTICAL "%8.6" "" /end COMPU_METHOD
/begin COMPU_METHOD autosar_swc_val_CM_RRCR_4_Ri2ObjID_969_dt "Q = V" IDENTICAL "%0.6" "" /end COMPU_METHOD
/begin COMPU_METHOD autosar_swc_val_CM_RRCR_4_Ri2ObjMtnChartc_969_dt "Q = V" IDENTICAL "%0.6" "" /end COMPU_METHOD
/begin COMPU_METHOD autosar_swc_val_CM_RRCR_4_Ri2ObjNrOffocst_969_dt "Q = V" IDENTICAL "%0.6" "" /end COMPU_METHOD
/begin COMPU_METHOD autosar_swc_val_CM_RRCR_4_Ri2ObjTrackSt_969_dt "Q = V" IDENTICAL "%0.6" "" /end COMPU_METHOD
/begin COMPU_METHOD autosar_swc_val_CM_RRCR_4_Ri2ObjTyp_969_dt "Q = V" IDENTICAL "%0.6" "" /end COMPU_METHOD
/begin COMPU_METHOD autosar_swc_val_CM_RRCR_4_Ri2ObjXDirAV_969_dt "Q = V" IDENTICAL "%8.6" "" /end COMPU_METHOD
/begin COMPU_METHOD autosar_swc_val_CM_RRCR_4_Ri2ObjXDirVStdDe_969_dt "Q = V" IDENTICAL "%8.6" "" /end COMPU_METHOD
/begin COMPU_METHOD autosar_swc_val_CM_RRCR_4_Ri2ObjXDirV_969_dt "Q = V" IDENTICAL "%8.6" "" /end COMPU_METHOD
/begin COMPU_METHOD autosar_swc_val_CM_RRCR_4_Ri2ObjYDirVStdDe_969_dt "Q = V" IDENTICAL "%8.6" "" /end COMPU_METHOD
/begin COMPU_METHOD autosar_swc_val_CM_RRCR_4_Ri2ObjYDirV_969_dt "Q = V" IDENTICAL "%8.6" "" /end COMPU_METHOD
/begin COMPU_METHOD autosar_swc_val_CM_RRCR_4_RollgCntr_969_dt "Q = V" IDENTICAL "%0.6" "" /end COMPU_METHOD
/begin COMPU_METHOD autosar_swc_val_CM_RRCR_5_CRC_976_dt "Q = V" IDENTICAL "%0.6" "" /end COMPU_METHOD
/begin COMPU_METHOD autosar_swc_val_CM_RRCR_5_Ri3HdTo_976_dt "Q = V" IDENTICAL "%8.6" "" /end COMPU_METHOD
/begin COMPU_METHOD autosar_swc_val_CM_RRCR_5_Ri3ObjBoxLen_976_dt "Q = V" IDENTICAL "%8.6" "" /end COMPU_METHOD
/begin COMPU_METHOD autosar_swc_val_CM_RRCR_5_Ri3ObjBoxWidth_976_dt "Q = V" IDENTICAL "%8.6" "" /end COMPU_METHOD
/begin COMPU_METHOD autosar_swc_val_CM_RRCR_5_Ri3ObjConf_976_dt "Q = V" IDENTICAL "%0.6" "" /end COMPU_METHOD
/begin COMPU_METHOD autosar_swc_val_CM_RRCR_5_Ri3ObjCoordXDstStdDe_976_dt "Q = V" IDENTICAL "%8.6" "" /end COMPU_METHOD
/begin COMPU_METHOD autosar_swc_val_CM_RRCR_5_Ri3ObjCoordX_976_dt "Q = V" IDENTICAL "%8.6" "" /end COMPU_METHOD
/begin COMPU_METHOD autosar_swc_val_CM_RRCR_5_Ri3ObjCoordYDstStdDe_976_dt "Q = V" IDENTICAL "%8.6" "" /end COMPU_METHOD
/begin COMPU_METHOD autosar_swc_val_CM_RRCR_5_Ri3ObjCoordY_976_dt "Q = V" IDENTICAL "%8.6" "" /end COMPU_METHOD
/begin COMPU_METHOD autosar_swc_val_CM_RRCR_5_Ri3ObjID_976_dt "Q = V" IDENTICAL "%0.6" "" /end COMPU_METHOD
/begin COMPU_METHOD autosar_swc_val_CM_RRCR_5_Ri3ObjMtnChartc_976_dt "Q = V" IDENTICAL "%0.6" "" /end COMPU_METHOD
/begin COMPU_METHOD autosar_swc_val_CM_RRCR_5_Ri3ObjNrOffocst_976_dt "Q = V" IDENTICAL "%0.6" "" /end COMPU_METHOD
/begin COMPU_METHOD autosar_swc_val_CM_RRCR_5_Ri3ObjTrackSt_976_dt "Q = V" IDENTICAL "%0.6" "" /end COMPU_METHOD
/begin COMPU_METHOD autosar_swc_val_CM_RRCR_5_Ri3ObjTyp_976_dt "Q = V" IDENTICAL "%0.6" "" /end COMPU_METHOD
/begin COMPU_METHOD autosar_swc_val_CM_RRCR_5_Ri3ObjXDirAV_976_dt "Q = V" IDENTICAL "%8.6" "" /end COMPU_METHOD
/begin COMPU_METHOD autosar_swc_val_CM_RRCR_5_Ri3ObjXDirVStdDe_976_dt "Q = V" IDENTICAL "%8.6" "" /end COMPU_METHOD
/begin COMPU_METHOD autosar_swc_val_CM_RRCR_5_Ri3ObjXDirV_976_dt "Q = V" IDENTICAL "%8.6" "" /end COMPU_METHOD
/begin COMPU_METHOD autosar_swc_val_CM_RRCR_5_Ri3ObjYDirVStdDe_976_dt "Q = V" IDENTICAL "%8.6" "" /end COMPU_METHOD
/begin COMPU_METHOD autosar_swc_val_CM_RRCR_5_Ri3ObjYDirV_976_dt "Q = V" IDENTICAL "%8.6" "" /end COMPU_METHOD
/begin COMPU_METHOD autosar_swc_val_CM_RRCR_5_RollgCntr_976_dt "Q = V" IDENTICAL "%0.6" "" /end COMPU_METHOD
/begin COMPU_METHOD autosar_swc_val_CM_RRCR_6_CRC_984_dt "Q = V" IDENTICAL "%0.6" "" /end COMPU_METHOD
/begin COMPU_METHOD autosar_swc_val_CM_RRCR_6_Ri4HdTo_984_dt "Q = V" IDENTICAL "%8.6" "" /end COMPU_METHOD
/begin COMPU_METHOD autosar_swc_val_CM_RRCR_6_Ri4ObjBoxLen_984_dt "Q = V" IDENTICAL "%8.6" "" /end COMPU_METHOD
/begin COMPU_METHOD autosar_swc_val_CM_RRCR_6_Ri4ObjBoxWidth_984_dt "Q = V" IDENTICAL "%8.6" "" /end COMPU_METHOD
/begin COMPU_METHOD autosar_swc_val_CM_RRCR_6_Ri4ObjConf_984_dt "Q = V" IDENTICAL "%0.6" "" /end COMPU_METHOD
/begin COMPU_METHOD autosar_swc_val_CM_RRCR_6_Ri4ObjCoordXDstStdDe_984_dt "Q = V" IDENTICAL "%8.6" "" /end COMPU_METHOD
/begin COMPU_METHOD autosar_swc_val_CM_RRCR_6_Ri4ObjCoordX_984_dt "Q = V" IDENTICAL "%8.6" "" /end COMPU_METHOD
/begin COMPU_METHOD autosar_swc_val_CM_RRCR_6_Ri4ObjCoordYDstStdDe_984_dt "Q = V" IDENTICAL "%8.6" "" /end COMPU_METHOD
/begin COMPU_METHOD autosar_swc_val_CM_RRCR_6_Ri4ObjCoordY_984_dt "Q = V" IDENTICAL "%8.6" "" /end COMPU_METHOD
/begin COMPU_METHOD autosar_swc_val_CM_RRCR_6_Ri4ObjID_984_dt "Q = V" IDENTICAL "%0.6" "" /end COMPU_METHOD
/begin COMPU_METHOD autosar_swc_val_CM_RRCR_6_Ri4ObjMtnChartc_984_dt "Q = V" IDENTICAL "%0.6" "" /end COMPU_METHOD
/begin COMPU_METHOD autosar_swc_val_CM_RRCR_6_Ri4ObjNrOffocst_984_dt "Q = V" IDENTICAL "%0.6" "" /end COMPU_METHOD
/begin COMPU_METHOD autosar_swc_val_CM_RRCR_6_Ri4ObjTrackSt_984_dt "Q = V" IDENTICAL "%0.6" "" /end COMPU_METHOD
/begin COMPU_METHOD autosar_swc_val_CM_RRCR_6_Ri4ObjTyp_984_dt "Q = V" IDENTICAL "%0.6" "" /end COMPU_METHOD
/begin COMPU_METHOD autosar_swc_val_CM_RRCR_6_Ri4ObjXDirAV_984_dt "Q = V" IDENTICAL "%8.6" "" /end COMPU_METHOD
/begin COMPU_METHOD autosar_swc_val_CM_RRCR_6_Ri4ObjXDirVStdDe_984_dt "Q = V" IDENTICAL "%8.6" "" /end COMPU_METHOD
/begin COMPU_METHOD autosar_swc_val_CM_RRCR_6_Ri4ObjXDirV_984_dt "Q = V" IDENTICAL "%8.6" "" /end COMPU_METHOD
/begin COMPU_METHOD autosar_swc_val_CM_RRCR_6_Ri4ObjYDirVStdDe_984_dt "Q = V" IDENTICAL "%8.6" "" /end COMPU_METHOD
/begin COMPU_METHOD autosar_swc_val_CM_RRCR_6_Ri4ObjYDirV_984_dt "Q = V" IDENTICAL "%8.6" "" /end COMPU_METHOD
/begin COMPU_METHOD autosar_swc_val_CM_RRCR_6_RollgCntr_984_dt "Q = V" IDENTICAL "%0.6" "" /end COMPU_METHOD
/begin COMPU_METHOD autosar_swc_val_CM_RRCR_7_CRC_986_dt "Q = V" IDENTICAL "%0.6" "" /end COMPU_METHOD
/begin COMPU_METHOD autosar_swc_val_CM_RRCR_7_Ri5HdTo_986_dt "Q = V" IDENTICAL "%8.6" "" /end COMPU_METHOD
/begin COMPU_METHOD autosar_swc_val_CM_RRCR_7_Ri5ObjBoxLen_986_dt "Q = V" IDENTICAL "%8.6" "" /end COMPU_METHOD
/begin COMPU_METHOD autosar_swc_val_CM_RRCR_7_Ri5ObjBoxWidth_986_dt "Q = V" IDENTICAL "%8.6" "" /end COMPU_METHOD
/begin COMPU_METHOD autosar_swc_val_CM_RRCR_7_Ri5ObjConf_986_dt "Q = V" IDENTICAL "%0.6" "" /end COMPU_METHOD
/begin COMPU_METHOD autosar_swc_val_CM_RRCR_7_Ri5ObjCoordXDstStdDe_986_dt "Q = V" IDENTICAL "%8.6" "" /end COMPU_METHOD
/begin COMPU_METHOD autosar_swc_val_CM_RRCR_7_Ri5ObjCoordX_986_dt "Q = V" IDENTICAL "%8.6" "" /end COMPU_METHOD
/begin COMPU_METHOD autosar_swc_val_CM_RRCR_7_Ri5ObjCoordYDstStdDe_986_dt "Q = V" IDENTICAL "%8.6" "" /end COMPU_METHOD
/begin COMPU_METHOD autosar_swc_val_CM_RRCR_7_Ri5ObjCoordY_986_dt "Q = V" IDENTICAL "%8.6" "" /end COMPU_METHOD
/begin COMPU_METHOD autosar_swc_val_CM_RRCR_7_Ri5ObjID_986_dt "Q = V" IDENTICAL "%0.6" "" /end COMPU_METHOD
/begin COMPU_METHOD autosar_swc_val_CM_RRCR_7_Ri5ObjMtnChartc_986_dt "Q = V" IDENTICAL "%0.6" "" /end COMPU_METHOD
/begin COMPU_METHOD autosar_swc_val_CM_RRCR_7_Ri5ObjNrOffocst_986_dt "Q = V" IDENTICAL "%0.6" "" /end COMPU_METHOD
/begin COMPU_METHOD autosar_swc_val_CM_RRCR_7_Ri5ObjTrackSt_986_dt "Q = V" IDENTICAL "%0.6" "" /end COMPU_METHOD
/begin COMPU_METHOD autosar_swc_val_CM_RRCR_7_Ri5ObjTyp_986_dt "Q = V" IDENTICAL "%0.6" "" /end COMPU_METHOD
/begin COMPU_METHOD autosar_swc_val_CM_RRCR_7_Ri5ObjXDirAV_986_dt "Q = V" IDENTICAL "%8.6" "" /end COMPU_METHOD
/begin COMPU_METHOD autosar_swc_val_CM_RRCR_7_Ri5ObjXDirVStdDe_986_dt "Q = V" IDENTICAL "%8.6" "" /end COMPU_METHOD
/begin COMPU_METHOD autosar_swc_val_CM_RRCR_7_Ri5ObjXDirV_986_dt "Q = V" IDENTICAL "%8.6" "" /end COMPU_METHOD
/begin COMPU_METHOD autosar_swc_val_CM_RRCR_7_Ri5ObjYDirVStdDe_986_dt "Q = V" IDENTICAL "%8.6" "" /end COMPU_METHOD
/begin COMPU_METHOD autosar_swc_val_CM_RRCR_7_Ri5ObjYDirV_986_dt "Q = V" IDENTICAL "%8.6" "" /end COMPU_METHOD
/begin COMPU_METHOD autosar_swc_val_CM_RRCR_7_RollgCntr_986_dt "Q = V" IDENTICAL "%0.6" "" /end COMPU_METHOD
/begin COMPU_METHOD autosar_swc_val_CM_RRCR_8_CRC_990_dt "Q = V" IDENTICAL "%0.6" "" /end COMPU_METHOD
/begin COMPU_METHOD autosar_swc_val_CM_RRCR_8_RollgCntr_990_dt "Q = V" IDENTICAL "%0.6" "" /end COMPU_METHOD
/begin COMPU_METHOD autosar_swc_val_CM_RRCR_8_TiStampLaten_990_dt "Q = V" IDENTICAL "%0.6" "" /end COMPU_METHOD
/begin COMPU_METHOD autosar_swc_val_CM_RZCU_2_CRC_699_dt "Q = V" IDENTICAL "%0.6" "" /end COMPU_METHOD
/begin COMPU_METHOD autosar_swc_val_CM_RZCU_2_Resd_699_dt "Q = V" IDENTICAL "%0.6" "" /end COMPU_METHOD
/begin COMPU_METHOD autosar_swc_val_CM_RZCU_2_RollgCntr_699_dt "Q = V" IDENTICAL "%0.6" "" /end COMPU_METHOD
/begin COMPU_METHOD autosar_swc_val_CM_RZCU_7_CRC_1258_dt "Q = V" IDENTICAL "%0.6" "" /end COMPU_METHOD
/begin COMPU_METHOD autosar_swc_val_CM_RZCU_7_RollgCntr_1258_dt "Q = V" IDENTICAL "%0.6" "" /end COMPU_METHOD
/begin COMPU_METHOD autosar_swc_val_CM_RZCU_RearWiperParkStatus_1258_dt "Q = V" IDENTICAL "%0.6" "" /end COMPU_METHOD
/begin COMPU_METHOD autosar_swc_val_CM_RZCU_RearWiperWipingStatus_1258_dt "Q = V" IDENTICAL "%0.6" "" /end COMPU_METHOD
/begin COMPU_METHOD autosar_swc_val_CM_Reserved_EDCActive_555_dt "Q = V" IDENTICAL "%0.6" "" /end COMPU_METHOD
/begin COMPU_METHOD autosar_swc_val_CM_Reserved_ESPLampInformation_555_dt "Q = V" IDENTICAL "%0.6" "" /end COMPU_METHOD
/begin COMPU_METHOD autosar_swc_val_CM_SAM_1_CRC_306_dt "Q = V" IDENTICAL "%0.6" "" /end COMPU_METHOD
/begin COMPU_METHOD autosar_swc_val_CM_SAM_1_Resd_306_dt "Q = V" IDENTICAL "%0.6" "" /end COMPU_METHOD
/begin COMPU_METHOD autosar_swc_val_CM_SAM_1_RollgCntr_306_dt "Q = V" IDENTICAL "%0.6" "" /end COMPU_METHOD
/begin COMPU_METHOD autosar_swc_val_CM_SAM_1_SteeringAngleSpeedVD_306_dt "Q = V" IDENTICAL "%0.6" "" /end COMPU_METHOD
/begin COMPU_METHOD autosar_swc_val_CM_SAM_1_SteeringAngleSpeed_306_dt "Q = V" IDENTICAL "%0.6" "" /end COMPU_METHOD
/begin COMPU_METHOD autosar_swc_val_CM_SAM_1_SteeringAngleVD_306_dt "Q = V" IDENTICAL "%0.6" "" /end COMPU_METHOD
/begin COMPU_METHOD autosar_swc_val_CM_SAM_1_SteeringAngle_306_dt "Q = V" IDENTICAL "%8.6" "" /end COMPU_METHOD
/begin COMPU_METHOD autosar_swc_val_CM_SCMActive_555_dt "Q = V" IDENTICAL "%0.6" "" /end COMPU_METHOD
/begin COMPU_METHOD autosar_swc_val_CM_SCMAvalable_555_dt "Q = V" IDENTICAL "%0.6" "" /end COMPU_METHOD
/begin COMPU_METHOD autosar_swc_val_CM_SwitchOffCruiseControl_152_dt "Q = V" IDENTICAL "%0.6" "" /end COMPU_METHOD
/begin COMPU_METHOD autosar_swc_val_CM_TrunkLockSts_699_dt "Q = V" IDENTICAL "%0.6" "" /end COMPU_METHOD
/begin COMPU_METHOD autosar_swc_val_CM_TrunkSts_699_dt "Q = V" IDENTICAL "%0.6" "" /end COMPU_METHOD
/begin COMPU_METHOD autosar_swc_val_CM_VehicleStandstill_555_dt "Q = V" IDENTICAL "%0.6" "" /end COMPU_METHOD
/begin COMPU_METHOD autosar_swc_val_CM_WheelBrakeForce_555_dt "Q = V" IDENTICAL "%0.6" "" /end COMPU_METHOD
/begin COMPU_METHOD autosar_swc_val_CM_double "Q = V" IDENTICAL "%15.10" "" /end COMPU_METHOD
/begin COMPU_METHOD autosar_swc_val_CM_single "Q = V" IDENTICAL "%8.6" "" /end COMPU_METHOD
/begin COMPU_METHOD autosar_swc_val_CM_uint16 "Q = V" IDENTICAL "%5.0" "" /end COMPU_METHOD
/begin COMPU_METHOD autosar_swc_val_CM_uint32 "Q = V" IDENTICAL "%10.0" "" /end COMPU_METHOD
/begin COMPU_METHOD autosar_swc_val_CM_uint64 "Q = V" IDENTICAL "%20.0" "" /end COMPU_METHOD
/begin COMPU_METHOD autosar_swc_val_CM_uint8 "Q = V" IDENTICAL "%3.0" "" /end COMPU_METHOD
/begin GROUP SwcIn_J3_LANE.Left_Out_Lane ""
 /begin REF_MEASUREMENT SwcIn_J3_LANE.Left_Out_Lane.LaneConfidence SwcIn_J3_LANE.Left_Out_Lane.LaneMeasuringStatus SwcIn_J3_LANE.Left_Out_Lane.LaneTypeClass SwcIn_J3_LANE.Left_Out_Lane.LaneMarkColor SwcIn_J3_LANE.Left_Out_Lane.LaneQuality SwcIn_J3_LANE.Left_Out_Lane.LaneCrossing SwcIn_J3_LANE.Left_Out_Lane.ObstacleFlag SwcIn_J3_LANE.Left_Out_Lane.LaneExtraNearPointType SwcIn_J3_LANE.Left_Out_Lane.LaneExtraFarPointType SwcIn_J3_LANE.Left_Out_Lane.LaneParsingConfidence SwcIn_J3_LANE.Left_Out_Lane.Stopline_Relevancy SwcIn_J3_LANE.Left_Out_Lane.LaneTrackID SwcIn_J3_LANE.Left_Out_Lane.LaneWidthMarking SwcIn_J3_LANE.Left_Out_Lane.LaneViewRangeStart SwcIn_J3_LANE.Left_Out_Lane.LaneViewRangeEnd SwcIn_J3_LANE.Left_Out_Lane.LaneModelC0 SwcIn_J3_LANE.Left_Out_Lane.LaneModelC1 SwcIn_J3_LANE.Left_Out_Lane.LaneModelC2 SwcIn_J3_LANE.Left_Out_Lane.LaneModelC3 SwcIn_J3_LANE.Left_Out_Lane.LaneTLC SwcIn_J3_LANE.Left_Out_Lane.LaneExtraFarPointPosX SwcIn_J3_LANE.Left_Out_Lane.LaneExtraFarPointPosY SwcIn_J3_LANE.Left_Out_Lane.LaneExtraNearPointPosX SwcIn_J3_LANE.Left_Out_Lane.LaneExtraNearPointPosY /end REF_MEASUREMENT
/end GROUP
/begin GROUP SwcIn_J3_LANE.Left_Road_Edge ""
 /begin REF_MEASUREMENT SwcIn_J3_LANE.Left_Road_Edge.LaneConfidence SwcIn_J3_LANE.Left_Road_Edge.LaneMeasuringStatus SwcIn_J3_LANE.Left_Road_Edge.LaneTypeClass SwcIn_J3_LANE.Left_Road_Edge.LaneMarkColor SwcIn_J3_LANE.Left_Road_Edge.LaneQuality SwcIn_J3_LANE.Left_Road_Edge.ObstacleFlag SwcIn_J3_LANE.Left_Road_Edge.LaneExtraNearPointType SwcIn_J3_LANE.Left_Road_Edge.LaneExtraFarPointType SwcIn_J3_LANE.Left_Road_Edge.LaneParsingConfidence SwcIn_J3_LANE.Left_Road_Edge.Stopline_Relevancy SwcIn_J3_LANE.Left_Road_Edge.LaneTrackID SwcIn_J3_LANE.Left_Road_Edge.LaneWidthMarking SwcIn_J3_LANE.Left_Road_Edge.LaneViewRangeStart SwcIn_J3_LANE.Left_Road_Edge.LaneViewRangeEnd SwcIn_J3_LANE.Left_Road_Edge.LaneModelC0 SwcIn_J3_LANE.Left_Road_Edge.LaneModelC1 SwcIn_J3_LANE.Left_Road_Edge.LaneModelC2 SwcIn_J3_LANE.Left_Road_Edge.LaneModelC3 SwcIn_J3_LANE.Left_Road_Edge.LaneTLC SwcIn_J3_LANE.Left_Road_Edge.LaneExtraFarPointPosX SwcIn_J3_LANE.Left_Road_Edge.LaneExtraFarPointPosY SwcIn_J3_LANE.Left_Road_Edge.LaneExtraNearPointPosX SwcIn_J3_LANE.Left_Road_Edge.LaneExtraNearPointPosY /end REF_MEASUREMENT
/end GROUP
/begin GROUP SwcIn_J3_LANE.LinePoints "" /begin REF_MEASUREMENT SwcIn_J3_LANE.LinePoints.timestamp /end REF_MEASUREMENT /end GROUP
/begin GROUP SwcIn_J3_LANE.LinePoints.linepoints[0] "" /begin REF_MEASUREMENT SwcIn_J3_LANE.LinePoints.linepoints[0].id /end REF_MEASUREMENT /end GROUP
/begin GROUP SwcIn_J3_LANE.LinePoints.linepoints[0].point[0] ""
 /begin REF_MEASUREMENT SwcIn_J3_LANE.LinePoints.linepoints[0].point[0].point_x SwcIn_J3_LANE.LinePoints.linepoints[0].point[0].point_y /end REF_MEASUREMENT
/end GROUP
/begin GROUP SwcIn_J3_LANE.Right_Cone_Road_Edge ""
 /begin REF_MEASUREMENT SwcIn_J3_LANE.Right_Cone_Road_Edge.ConeRoadEdgeConfidence SwcIn_J3_LANE.Right_Cone_Road_Edge.ConeRoadEdgeMeasuringStatus SwcIn_J3_LANE.Right_Cone_Road_Edge.ConeRoadEdgeTypeClass SwcIn_J3_LANE.Right_Cone_Road_Edge.ConeRoadEdgeQuality SwcIn_J3_LANE.Right_Cone_Road_Edge.ConeRoadEdgeParsingConfidence SwcIn_J3_LANE.Right_Cone_Road_Edge.ConeRoadEdgeTrackID SwcIn_J3_LANE.Right_Cone_Road_Edge.ConeRoadEdgeViewRangeStart SwcIn_J3_LANE.Right_Cone_Road_Edge.ConeRoadEdgeViewRangeEnd SwcIn_J3_LANE.Right_Cone_Road_Edge.ConeRoadEdgeModelC0 SwcIn_J3_LANE.Right_Cone_Road_Edge.ConeRoadEdgeModelC1 SwcIn_J3_LANE.Right_Cone_Road_Edge.ConeRoadEdgeModelC2 SwcIn_J3_LANE.Right_Cone_Road_Edge.ConeRoadEdgeModelC3 SwcIn_J3_LANE.Right_Cone_Road_Edge.ConeRoadEdgeTLC /end REF_MEASUREMENT
/end GROUP
/begin GROUP SwcIn_J3_LANE.Right_LKA_Lane ""
 /begin REF_MEASUREMENT SwcIn_J3_LANE.Right_LKA_Lane.LaneConfidence SwcIn_J3_LANE.Right_LKA_Lane.LaneMeasuringStatus SwcIn_J3_LANE.Right_LKA_Lane.LaneTypeClass SwcIn_J3_LANE.Right_LKA_Lane.LaneMarkColor SwcIn_J3_LANE.Right_LKA_Lane.LaneQuality SwcIn_J3_LANE.Right_LKA_Lane.LaneCrossing SwcIn_J3_LANE.Right_LKA_Lane.ObstacleFlag SwcIn_J3_LANE.Right_LKA_Lane.LaneExtraNearPointType SwcIn_J3_LANE.Right_LKA_Lane.LaneExtraFarPointType SwcIn_J3_LANE.Right_LKA_Lane.LaneParsingConfidence SwcIn_J3_LANE.Right_LKA_Lane.Stopline_Relevancy SwcIn_J3_LANE.Right_LKA_Lane.LaneTrackID SwcIn_J3_LANE.Right_LKA_Lane.LaneWidthMarking SwcIn_J3_LANE.Right_LKA_Lane.LaneViewRangeStart SwcIn_J3_LANE.Right_LKA_Lane.LaneViewRangeEnd SwcIn_J3_LANE.Right_LKA_Lane.LaneModelC0 SwcIn_J3_LANE.Right_LKA_Lane.LaneModelC1 SwcIn_J3_LANE.Right_LKA_Lane.LaneModelC2 SwcIn_J3_LANE.Right_LKA_Lane.LaneModelC3 SwcIn_J3_LANE.Right_LKA_Lane.LaneTLC SwcIn_J3_LANE.Right_LKA_Lane.LaneExtraFarPointPosX SwcIn_J3_LANE.Right_LKA_Lane.LaneExtraFarPointPosY SwcIn_J3_LANE.Right_LKA_Lane.LaneExtraNearPointPosX SwcIn_J3_LANE.Right_LKA_Lane.LaneExtraNearPointPosY /end REF_MEASUREMENT
/end GROUP
/begin GROUP SwcIn_J3_LANE.Right_Next_Lane ""
 /begin REF_MEASUREMENT SwcIn_J3_LANE.Right_Next_Lane.LaneConfidence SwcIn_J3_LANE.Right_Next_Lane.LaneMeasuringStatus SwcIn_J3_LANE.Right_Next_Lane.LaneTypeClass SwcIn_J3_LANE.Right_Next_Lane.LaneMarkColor SwcIn_J3_LANE.Right_Next_Lane.LaneQuality SwcIn_J3_LANE.Right_Next_Lane.ObstacleFlag SwcIn_J3_LANE.Right_Next_Lane.LaneExtraNearPointType SwcIn_J3_LANE.Right_Next_Lane.LaneExtraFarPointType SwcIn_J3_LANE.Right_Next_Lane.LaneParsingConfidence SwcIn_J3_LANE.Right_Next_Lane.LaneTrackID SwcIn_J3_LANE.Right_Next_Lane.LaneWidthMarking SwcIn_J3_LANE.Right_Next_Lane.LaneViewRangeStart SwcIn_J3_LANE.Right_Next_Lane.LaneViewRangeEnd SwcIn_J3_LANE.Right_Next_Lane.LaneModelC0 SwcIn_J3_LANE.Right_Next_Lane.LaneModelC1 SwcIn_J3_LANE.Right_Next_Lane.LaneModelC2 SwcIn_J3_LANE.Right_Next_Lane.LaneModelC3 SwcIn_J3_LANE.Right_Next_Lane.LaneExtraFarPointPosX SwcIn_J3_LANE.Right_Next_Lane.LaneExtraFarPointPosY SwcIn_J3_LANE.Right_Next_Lane.LaneExtraNearPointPosX SwcIn_J3_LANE.Right_Next_Lane.LaneExtraNearPointPosY /end REF_MEASUREMENT
/end GROUP
/begin GROUP SwcIn_J3_LANE.Right_Out_Lane ""
 /begin REF_MEASUREMENT SwcIn_J3_LANE.Right_Out_Lane.LaneConfidence SwcIn_J3_LANE.Right_Out_Lane.LaneMeasuringStatus SwcIn_J3_LANE.Right_Out_Lane.LaneTypeClass SwcIn_J3_LANE.Right_Out_Lane.LaneMarkColor SwcIn_J3_LANE.Right_Out_Lane.LaneQuality SwcIn_J3_LANE.Right_Out_Lane.LaneCrossing SwcIn_J3_LANE.Right_Out_Lane.ObstacleFlag SwcIn_J3_LANE.Right_Out_Lane.LaneExtraNearPointType SwcIn_J3_LANE.Right_Out_Lane.LaneExtraFarPointType SwcIn_J3_LANE.Right_Out_Lane.LaneParsingConfidence SwcIn_J3_LANE.Right_Out_Lane.Stopline_Relevancy SwcIn_J3_LANE.Right_Out_Lane.LaneTrackID SwcIn_J3_LANE.Right_Out_Lane.LaneWidthMarking SwcIn_J3_LANE.Right_Out_Lane.LaneViewRangeStart SwcIn_J3_LANE.Right_Out_Lane.LaneViewRangeEnd SwcIn_J3_LANE.Right_Out_Lane.LaneModelC0 SwcIn_J3_LANE.Right_Out_Lane.LaneModelC1 SwcIn_J3_LANE.Right_Out_Lane.LaneModelC2 SwcIn_J3_LANE.Right_Out_Lane.LaneModelC3 SwcIn_J3_LANE.Right_Out_Lane.LaneTLC SwcIn_J3_LANE.Right_Out_Lane.LaneExtraFarPointPosX SwcIn_J3_LANE.Right_Out_Lane.LaneExtraFarPointPosY SwcIn_J3_LANE.Right_Out_Lane.LaneExtraNearPointPosX SwcIn_J3_LANE.Right_Out_Lane.LaneExtraNearPointPosY /end REF_MEASUREMENT
/end GROUP
/begin GROUP SwcIn_J3_LANE.Right_Road_Edge ""
 /begin REF_MEASUREMENT SwcIn_J3_LANE.Right_Road_Edge.LaneConfidence SwcIn_J3_LANE.Right_Road_Edge.LaneMeasuringStatus SwcIn_J3_LANE.Right_Road_Edge.LaneTypeClass SwcIn_J3_LANE.Right_Road_Edge.LaneMarkColor SwcIn_J3_LANE.Right_Road_Edge.LaneQuality SwcIn_J3_LANE.Right_Road_Edge.ObstacleFlag SwcIn_J3_LANE.Right_Road_Edge.LaneExtraNearPointType SwcIn_J3_LANE.Right_Road_Edge.LaneExtraFarPointType SwcIn_J3_LANE.Right_Road_Edge.LaneParsingConfidence SwcIn_J3_LANE.Right_Road_Edge.Stopline_Relevancy SwcIn_J3_LANE.Right_Road_Edge.LaneTrackID SwcIn_J3_LANE.Right_Road_Edge.LaneWidthMarking SwcIn_J3_LANE.Right_Road_Edge.LaneViewRangeStart SwcIn_J3_LANE.Right_Road_Edge.LaneViewRangeEnd SwcIn_J3_LANE.Right_Road_Edge.LaneModelC0 SwcIn_J3_LANE.Right_Road_Edge.LaneModelC1 SwcIn_J3_LANE.Right_Road_Edge.LaneModelC2 SwcIn_J3_LANE.Right_Road_Edge.LaneModelC3 SwcIn_J3_LANE.Right_Road_Edge.LaneTLC SwcIn_J3_LANE.Right_Road_Edge.LaneExtraFarPointPosX SwcIn_J3_LANE.Right_Road_Edge.LaneExtraFarPointPosY SwcIn_J3_LANE.Right_Road_Edge.LaneExtraNearPointPosX SwcIn_J3_LANE.Right_Road_Edge.LaneExtraNearPointPosY /end REF_MEASUREMENT
/end GROUP
/begin GROUP SwcIn_J3_LANE.Road_Information ""
 /begin SUB_GROUP SwcIn_J3_LANE.Road_Information.CrossWalkBox SwcIn_J3_LANE.Road_Information.CrossWalkCoor /end SUB_GROUP
 /begin REF_MEASUREMENT SwcIn_J3_LANE.Road_Information.RoadType SwcIn_J3_LANE.Road_Information.CurrentWeather SwcIn_J3_LANE.Road_Information.CurrentTime SwcIn_J3_LANE.Road_Information.LightType SwcIn_J3_LANE.Road_Information.DisStoplineValid SwcIn_J3_LANE.Road_Information.ProtocolMajorVersion SwcIn_J3_LANE.Road_Information.ProtocolMinorVersion SwcIn_J3_LANE.Road_Information.TerrainType SwcIn_J3_LANE.Road_Information.CrossWalkValid SwcIn_J3_LANE.Road_Information.DisStopline /end REF_MEASUREMENT
/end GROUP
/begin GROUP SwcIn_J3_LANE.Road_Information.CrossWalkBox ""
 /begin REF_MEASUREMENT SwcIn_J3_LANE.Road_Information.CrossWalkBox.corner_x_vec SwcIn_J3_LANE.Road_Information.CrossWalkBox.corner_y_vec /end REF_MEASUREMENT
/end GROUP
/begin GROUP SwcIn_J3_LANE.Road_Information.CrossWalkCoor ""
 /begin REF_MEASUREMENT SwcIn_J3_LANE.Road_Information.CrossWalkCoor.x SwcIn_J3_LANE.Road_Information.CrossWalkCoor.y SwcIn_J3_LANE.Road_Information.CrossWalkCoor.mod /end REF_MEASUREMENT
/end GROUP
/begin GROUP SwcIn_MFS_2 ""
 /begin REF_MEASUREMENT SwcIn_MFS_2.MFS_2_CRC SwcIn_MFS_2.MFS_2_RollgCntr SwcIn_MFS_2.MFS_Cruise_Control SwcIn_MFS_2.MFS_RESPlus SwcIn_MFS_2.MFS_SETMinus SwcIn_MFS_2.MFS_Time_Gap_Reduce SwcIn_MFS_2.MFS_Time_Gap_Add SwcIn_MFS_2.MFS_Rsp_Error SwcIn_MFS_2.MFS_LeftRoller SwcIn_MFS_2.MFS_LeftRollerMiddleKey SwcIn_MFS_2.MFS_LeRollrUpDwnAdjSteps /end REF_MEASUREMENT
/end GROUP
/begin GROUP SwcIn_ONEBOX_1 ""
 /begin REF_MEASUREMENT SwcIn_ONEBOX_1.ONEBOX_1_CRC1 SwcIn_ONEBOX_1.ONEBOX_1_RollgCntr1 SwcIn_ONEBOX_1.ONEBOX_1_Resd1 SwcIn_ONEBOX_1.ABS_ESP_1_VehicleSpeedVSOSig SwcIn_ONEBOX_1.ESP1_VehicleSpeedVSOSigValidData SwcIn_ONEBOX_1.ABS_ESP_1_EBDFailSts SwcIn_ONEBOX_1.ABS_ESP_1_ABSFailSts SwcIn_ONEBOX_1.IPB_SimulatorPressure SwcIn_ONEBOX_1.IPB_SimulatorPressureStatus SwcIn_ONEBOX_1.ABS_ESP_1_ABSActive SwcIn_ONEBOX_1.ABS_ESP_1_VDCFailSts SwcIn_ONEBOX_1.ABS_ESP_1_VDCActive SwcIn_ONEBOX_1.ABS_ESP_1_TCSFailSts SwcIn_ONEBOX_1.ABS_ESP_1_TCSActive SwcIn_ONEBOX_1.BrakeSystemType SwcIn_ONEBOX_1.ABS_ESP_1_HHCFailSts SwcIn_ONEBOX_1.HHCActive SwcIn_ONEBOX_1.ABS_ESP_1_HDCCtrlSts SwcIn_ONEBOX_1.ABS_ESP_1_HDCFailSts SwcIn_ONEBOX_1.HLRequest SwcIn_ONEBOX_1.ABS_ESP_1_ESPSwitchStatus SwcIn_ONEBOX_1.BLRequestController SwcIn_ONEBOX_1.SwitchOffCruiseControl SwcIn_ONEBOX_1.ONEBOX_1_CRC2 SwcIn_ONEBOX_1.ONEBOX_1_RollgCntr2 SwcIn_ONEBOX_1.ONEBOX_1_Resd2 SwcIn_ONEBOX_1.IPB_1_MbRegenTargetWheel SwcIn_ONEBOX_1.IPB_1_MbRegenTargetWheelQ SwcIn_ONEBOX_1.AEBdecActive SwcIn_ONEBOX_1.AEBdecAvailable SwcIn_ONEBOX_1.CDPActive SwcIn_ONEBOX_1.CDPFailSts /end REF_MEASUREMENT
/end GROUP
/begin GROUP SwcIn_ONEBOX_2_G ""
 /begin REF_MEASUREMENT SwcIn_ONEBOX_2_G.ONEBOX_2_G_CRC SwcIn_ONEBOX_2_G.ONEBOX_2_G_RollgCntr SwcIn_ONEBOX_2_G.ONEBOX_2_G_Resd SwcIn_ONEBOX_2_G.BrakesystemFailSts /end REF_MEASUREMENT
/end GROUP
/begin GROUP SwcIn_ONEBOX_3 ""
 /begin REF_MEASUREMENT SwcIn_ONEBOX_3.ONEBOX_3_CRC1 SwcIn_ONEBOX_3.ONEBOX_3_RollgCntr1 SwcIn_ONEBOX_3.ONEBOX_3_Resd1 SwcIn_ONEBOX_3.AVHSts SwcIn_ONEBOX_3.VehicleStandstill SwcIn_ONEBOX_3.NoBrakeForce SwcIn_ONEBOX_3.AVHFailSts SwcIn_ONEBOX_3.Reserved_EDCActive SwcIn_ONEBOX_3.ECDTempOff SwcIn_ONEBOX_3.DCFail SwcIn_ONEBOX_3.CDDActive SwcIn_ONEBOX_3.CDDAvailable SwcIn_ONEBOX_3.Reserved_ESPLampInformation SwcIn_ONEBOX_3.ONEBOX_3_CRC2 SwcIn_ONEBOX_3.ONEBOX_3_RollgCntr2 SwcIn_ONEBOX_3.ONEBOX_3_Resd2 SwcIn_ONEBOX_3.WheelBrakeForce SwcIn_ONEBOX_3.ONEBOX_3_CRC4 SwcIn_ONEBOX_3.ONEBOX_3_RollgCntr4 SwcIn_ONEBOX_3.ONEBOX_3_Resd4 SwcIn_ONEBOX_3.IPB_PlungerPressureValidData SwcIn_ONEBOX_3.IPB_InputRodStrokeStatus SwcIn_ONEBOX_3.SCMActive SwcIn_ONEBOX_3.SCMAvalable SwcIn_ONEBOX_3.IPB_PlungerPressure SwcIn_ONEBOX_3.IPB_InputRodStroke SwcIn_ONEBOX_3.DTC_Intervention SwcIn_ONEBOX_3.DTCAvailable SwcIn_ONEBOX_3.DTCActive /end REF_MEASUREMENT
/end GROUP
/begin GROUP SwcIn_ONEBOX_4 ""
 /begin REF_MEASUREMENT SwcIn_ONEBOX_4.ONEBOX_4_CRC1 SwcIn_ONEBOX_4.ONEBOX_4_RollgCntr1 SwcIn_ONEBOX_4.ONEBOX_4_Resd1 SwcIn_ONEBOX_4.LHFWheelSpeedRPM SwcIn_ONEBOX_4.RHFWheelSpeedRPM SwcIn_ONEBOX_4.LHRWheelSpeedRPM SwcIn_ONEBOX_4.ONEBOX_4_CRC2 SwcIn_ONEBOX_4.ONEBOX_4_RollgCntr2 SwcIn_ONEBOX_4.ONEBOX_4_Resd2 SwcIn_ONEBOX_4.RHRWheelSpeedRPM SwcIn_ONEBOX_4.LHRPulseCounterFailSts SwcIn_ONEBOX_4.LHRPulseCounter SwcIn_ONEBOX_4.RHRPulseCounterFailSts SwcIn_ONEBOX_4.RHRPulseCounter SwcIn_ONEBOX_4.ONEBOX_4_CRC3 SwcIn_ONEBOX_4.ONEBOX_4_RollgCntr3 SwcIn_ONEBOX_4.ONEBOX_4_Resd3 SwcIn_ONEBOX_4.RHFPulseCounterFailSts SwcIn_ONEBOX_4.RHFPulseCounter SwcIn_ONEBOX_4.LHFPulseCounterFailSts SwcIn_ONEBOX_4.LHFPulseCounter SwcIn_ONEBOX_4.LHFWheelSpeedRaw SwcIn_ONEBOX_4.LHFWheelDriveDirection SwcIn_ONEBOX_4.LHFWheelSpeedRawValidData SwcIn_ONEBOX_4.ONEBOX_4_CRC4 SwcIn_ONEBOX_4.ONEBOX_4_RollgCntr4 SwcIn_ONEBOX_4.ONEBOX_4_Resd4 SwcIn_ONEBOX_4.RHFWheelSpeedRaw SwcIn_ONEBOX_4.RHFWheelDriveDirection SwcIn_ONEBOX_4.RHFWheelSpeedRawValidData SwcIn_ONEBOX_4.LHRWheelSpeedRaw SwcIn_ONEBOX_4.LHRWheelDriveDirection SwcIn_ONEBOX_4.LHRWheelSpeedRawValidData SwcIn_ONEBOX_4.RHRWheelSpeedRaw SwcIn_ONEBOX_4.RHRWheelDriveDirection SwcIn_ONEBOX_4.RHRWheelSpeedRawValidData /end REF_MEASUREMENT
/end GROUP
/begin GROUP SwcIn_ONEBOX_5 ""
 /begin REF_MEASUREMENT SwcIn_ONEBOX_5.ONEBOX_5_CRC1 SwcIn_ONEBOX_5.ONEBOX_5_RollgCntr1 SwcIn_ONEBOX_5.ONEBOX_5_Resd1 SwcIn_ONEBOX_5.ONEBOX_5_PilotParkBrkDecCtlAvl SwcIn_ONEBOX_5.ONEBOX_5_PilotParkBrkDecActSts SwcIn_ONEBOX_5.ONEBOX_5_CddAdcActiveVehHld SwcIn_ONEBOX_5.ONEBOX_5_APCFailureSts SwcIn_ONEBOX_5.ONEBOX_5_APCStatus SwcIn_ONEBOX_5.ONEBOX_5_ApaAvl SwcIn_ONEBOX_5.ONEBOX_5_RpaAvl SwcIn_ONEBOX_5.ONEBOX_5_MebAvl SwcIn_ONEBOX_5.ONEBOX_5_CddApActiveVehHld SwcIn_ONEBOX_5.ONEBOX_5_SysBrkP SwcIn_ONEBOX_5.ONEBOX_5_SysBrkPVld SwcIn_ONEBOX_5.ONEBOX_5_AbpActSts SwcIn_ONEBOX_5.ONEBOX_5_AbpAvlSts SwcIn_ONEBOX_5.ONEBOX_5_AwbActSts SwcIn_ONEBOX_5.ONEBOX_5_AwbAvlSts SwcIn_ONEBOX_5.ONEBOX_5_AbaActSts SwcIn_ONEBOX_5.ONEBOX_5_AbaAvlSts SwcIn_ONEBOX_5.ONEBOX_5_AbaLvlSts /end REF_MEASUREMENT
/end GROUP
/begin GROUP SwcIn_PPMID_1 ""
 /begin REF_MEASUREMENT SwcIn_PPMID_1.PPMID_1_HWSt SwcIn_PPMID_1.PPMID_1_PPSt SwcIn_PPMID_1.PPMID_1_PPMICounter SwcIn_PPMID_1.PPMID_1_PPMISt /end REF_MEASUREMENT
/end GROUP
/begin GROUP SwcIn_RLCR_1 ""
 /begin REF_MEASUREMENT SwcIn_RLCR_1.RLCR_1_CRC1 SwcIn_RLCR_1.RLCR_1_RollgCntr1 SwcIn_RLCR_1.RLCR_1_Resd1 SwcIn_RLCR_1.RLCR_1_SysSt SwcIn_RLCR_1.RLCR_1_BlkSts SwcIn_RLCR_1.RLCR_1_BSDWarn SwcIn_RLCR_1.RLCR_1_DOWWarn SwcIn_RLCR_1.RLCR_1_DowLock SwcIn_RLCR_1.RLCR_1_ELK_Collision_flag SwcIn_RLCR_1.RLCR_1_ELK_CollisionFlagValid /end REF_MEASUREMENT
/end GROUP
/begin GROUP SwcIn_RLCR_2 ""
 /begin REF_MEASUREMENT SwcIn_RLCR_2.RLCR_2_CRC1 SwcIn_RLCR_2.RLCR_2_RollgCntr1 SwcIn_RLCR_2.RLCR_2_Resd1 SwcIn_RLCR_2.RLCR_2_RCWWarn SwcIn_RLCR_2.RLCR_2_RCTAWarn SwcIn_RLCR_2.RLCR_2_RCTBWarn SwcIn_RLCR_2.RLCR_2_RCTBReq SwcIn_RLCR_2.RLCR_2_RCTBCtrlA SwcIn_RLCR_2.RLCR_2_BSDLCWONOFFSts SwcIn_RLCR_2.RLCR_2_DOWONOFFSts SwcIn_RLCR_2.RLCR_2_RCWONOFFSts SwcIn_RLCR_2.RLCR_2_RCTARCTBONOFFSts /end REF_MEASUREMENT
/end GROUP
/begin GROUP SwcIn_RLCR_3 ""
 /begin REF_MEASUREMENT SwcIn_RLCR_3.RLCR_3_CRC SwcIn_RLCR_3.RLCR_3_RollgCntr SwcIn_RLCR_3.RLCR_3_Le1ObjBoxLen SwcIn_RLCR_3.RLCR_3_Le1ObjBoxWidth SwcIn_RLCR_3.RLCR_3_Le1HdTo SwcIn_RLCR_3.RLCR_3_Le1ObjID SwcIn_RLCR_3.RLCR_3_Le1ObjCoordY SwcIn_RLCR_3.RLCR_3_Le1ObjCoordX SwcIn_RLCR_3.RLCR_3_Le1ObjXDirAV SwcIn_RLCR_3.RLCR_3_Le1ObjYDirV SwcIn_RLCR_3.RLCR_3_Le1ObjXDirV SwcIn_RLCR_3.RLCR_3_Le1ObjMtnChartc SwcIn_RLCR_3.RLCR_3_Le1ObjTyp SwcIn_RLCR_3.RLCR_3_Le1ObjConf SwcIn_RLCR_3.RLCR_3_Le1ObjNrOffocst SwcIn_RLCR_3.RLCR_3_Le1ObjTrackSt SwcIn_RLCR_3.RLCR_3_Le1ObjCoordXDstStdDe SwcIn_RLCR_3.RLCR_3_Le1ObjCoordYDstStdDe SwcIn_RLCR_3.RLCR_3_Le1ObjXDirVStdDe SwcIn_RLCR_3.RLCR_3_Le1ObjYDirVStdDe /end REF_MEASUREMENT
/end GROUP
/begin GROUP SwcIn_RLCR_4 ""
 /begin REF_MEASUREMENT SwcIn_RLCR_4.RLCR_4_CRC SwcIn_RLCR_4.RLCR_4_RollgCntr SwcIn_RLCR_4.RLCR_4_Le2ObjBoxLen SwcIn_RLCR_4.RLCR_4_Le2ObjBoxWidth SwcIn_RLCR_4.RLCR_4_Le2HdTo SwcIn_RLCR_4.RLCR_4_Le2ObjID SwcIn_RLCR_4.RLCR_4_Le2ObjCoordY SwcIn_RLCR_4.RLCR_4_Le2ObjCoordX SwcIn_RLCR_4.RLCR_4_Le2ObjXDirAV SwcIn_RLCR_4.RLCR_4_Le2ObjYDirV SwcIn_RLCR_4.RLCR_4_Le2ObjXDirV SwcIn_RLCR_4.RLCR_4_Le2ObjMtnChartc SwcIn_RLCR_4.RLCR_4_Le2ObjTyp SwcIn_RLCR_4.RLCR_4_Le2ObjConf SwcIn_RLCR_4.RLCR_4_Le2ObjNrOffocst SwcIn_RLCR_4.RLCR_4_Le2ObjTrackSt SwcIn_RLCR_4.RLCR_4_Le2ObjCoordXDstStdDe SwcIn_RLCR_4.RLCR_4_Le2ObjCoordYDstStdDe SwcIn_RLCR_4.RLCR_4_Le2ObjXDirVStdDe SwcIn_RLCR_4.RLCR_4_Le2ObjYDirVStdDe /end REF_MEASUREMENT
/end GROUP
/begin GROUP SwcIn_RLCR_5 ""
 /begin REF_MEASUREMENT SwcIn_RLCR_5.RLCR_5_CRC SwcIn_RLCR_5.RLCR_5_RollgCntr SwcIn_RLCR_5.RLCR_5_Le3ObjBoxLen SwcIn_RLCR_5.RLCR_5_Le3ObjBoxWidth SwcIn_RLCR_5.RLCR_5_Le3HdTo SwcIn_RLCR_5.RLCR_5_Le3ObjID SwcIn_RLCR_5.RLCR_5_Le3ObjCoordY SwcIn_RLCR_5.RLCR_5_Le3ObjCoordX SwcIn_RLCR_5.RLCR_5_Le3ObjXDirAV SwcIn_RLCR_5.RLCR_5_Le3ObjYDirV SwcIn_RLCR_5.RLCR_5_Le3ObjXDirV SwcIn_RLCR_5.RLCR_5_Le3ObjMtnChartc SwcIn_RLCR_5.RLCR_5_Le3ObjTyp SwcIn_RLCR_5.RLCR_5_Le3ObjConf SwcIn_RLCR_5.RLCR_5_Le3ObjNrOffocst SwcIn_RLCR_5.RLCR_5_Le3ObjTrackSt SwcIn_RLCR_5.RLCR_5_Le3ObjCoordXDstStdDe SwcIn_RLCR_5.RLCR_5_Le3ObjCoordYDstStdDe SwcIn_RLCR_5.RLCR_5_Le3ObjXDirVStdDe SwcIn_RLCR_5.RLCR_5_Le3ObjYDirVStdDe /end REF_MEASUREMENT
/end GROUP
/begin GROUP SwcIn_RLCR_6 ""
 /begin REF_MEASUREMENT SwcIn_RLCR_6.RLCR_6_CRC SwcIn_RLCR_6.RLCR_6_RollgCntr SwcIn_RLCR_6.RLCR_6_Le4ObjBoxLen SwcIn_RLCR_6.RLCR_6_Le4ObjBoxWidth SwcIn_RLCR_6.RLCR_6_Le4HdTo SwcIn_RLCR_6.RLCR_6_Le4ObjID SwcIn_RLCR_6.RLCR_6_Le4ObjCoordY SwcIn_RLCR_6.RLCR_6_Le4ObjCoordX SwcIn_RLCR_6.RLCR_6_Le4ObjXDirAV SwcIn_RLCR_6.RLCR_6_Le4ObjYDirV SwcIn_RLCR_6.RLCR_6_Le4ObjXDirV SwcIn_RLCR_6.RLCR_6_Le4ObjMtnChartc SwcIn_RLCR_6.RLCR_6_Le4ObjTyp SwcIn_RLCR_6.RLCR_6_Le4ObjConf SwcIn_RLCR_6.RLCR_6_Le4ObjNrOffocst SwcIn_RLCR_6.RLCR_6_Le4ObjTrackSt SwcIn_RLCR_6.RLCR_6_Le4ObjCoordXDstStdDe SwcIn_RLCR_6.RLCR_6_Le4ObjCoordYDstStdDe SwcIn_RLCR_6.RLCR_6_Le4ObjXDirVStdDe SwcIn_RLCR_6.RLCR_6_Le4ObjYDirVStdDe /end REF_MEASUREMENT
/end GROUP
/begin GROUP SwcIn_RLCR_7 ""
 /begin REF_MEASUREMENT SwcIn_RLCR_7.RLCR_7_CRC SwcIn_RLCR_7.RLCR_7_RollgCntr SwcIn_RLCR_7.RLCR_7_Le5ObjBoxLen SwcIn_RLCR_7.RLCR_7_Le5ObjBoxWidth SwcIn_RLCR_7.RLCR_7_Le5HdTo SwcIn_RLCR_7.RLCR_7_Le5ObjID SwcIn_RLCR_7.RLCR_7_Le5ObjCoordY SwcIn_RLCR_7.RLCR_7_Le5ObjCoordX SwcIn_RLCR_7.RLCR_7_Le5ObjXDirAV SwcIn_RLCR_7.RLCR_7_Le5ObjYDirV SwcIn_RLCR_7.RLCR_7_Le5ObjXDirV SwcIn_RLCR_7.RLCR_7_Le5ObjMtnChartc SwcIn_RLCR_7.RLCR_7_Le5ObjTyp SwcIn_RLCR_7.RLCR_7_Le5ObjConf SwcIn_RLCR_7.RLCR_7_Le5ObjNrOffocst SwcIn_RLCR_7.RLCR_7_Le5ObjTrackSt SwcIn_RLCR_7.RLCR_7_Le5ObjCoordXDstStdDe SwcIn_RLCR_7.RLCR_7_Le5ObjCoordYDstStdDe SwcIn_RLCR_7.RLCR_7_Le5ObjXDirVStdDe SwcIn_RLCR_7.RLCR_7_Le5ObjYDirVStdDe /end REF_MEASUREMENT
/end GROUP
/begin GROUP SwcIn_RLCR_8 ""
 /begin REF_MEASUREMENT SwcIn_RLCR_8.RLCR_8_CRC SwcIn_RLCR_8.RLCR_8_RollgCntr SwcIn_RLCR_8.RLCR_8_TiStampLaten /end REF_MEASUREMENT
/end GROUP
/begin GROUP SwcIn_RRCR_1 ""
 /begin REF_MEASUREMENT SwcIn_RRCR_1.RRCR_1_CRC1 SwcIn_RRCR_1.RRCR_1_RollgCntr1 SwcIn_RRCR_1.RRCR_1_Resd1 SwcIn_RRCR_1.RRCR_1_SysSt SwcIn_RRCR_1.RRCR_1_BlkSts SwcIn_RRCR_1.RRCR_1_BSDWarn SwcIn_RRCR_1.RRCR_1_DOWWarn SwcIn_RRCR_1.RRCR_1_DowLock SwcIn_RRCR_1.RRCR_1_ELK_Collision_flag SwcIn_RRCR_1.RRCR_1_ELK_CollisionFlagValid /end REF_MEASUREMENT
/end GROUP
/begin GROUP SwcIn_RRCR_3 ""
 /begin REF_MEASUREMENT SwcIn_RRCR_3.RRCR_3_CRC SwcIn_RRCR_3.RRCR_3_RollgCntr SwcIn_RRCR_3.RRCR_3_Ri1ObjBoxLen SwcIn_RRCR_3.RRCR_3_Ri1ObjBoxWidth SwcIn_RRCR_3.RRCR_3_Ri1HdTo SwcIn_RRCR_3.RRCR_3_Ri1ObjID SwcIn_RRCR_3.RRCR_3_Ri1ObjCoordY SwcIn_RRCR_3.RRCR_3_Ri1ObjCoordX SwcIn_RRCR_3.RRCR_3_Ri1ObjXDirAV SwcIn_RRCR_3.RRCR_3_Ri1ObjYDirV SwcIn_RRCR_3.RRCR_3_Ri1ObjXDirV SwcIn_RRCR_3.RRCR_3_Ri1ObjMtnChartc SwcIn_RRCR_3.RRCR_3_Ri1ObjTyp SwcIn_RRCR_3.RRCR_3_Ri1ObjConf SwcIn_RRCR_3.RRCR_3_Ri1ObjNrOffocst SwcIn_RRCR_3.RRCR_3_Ri1ObjTrackSt SwcIn_RRCR_3.RRCR_3_Ri1ObjCoordXDstStdDe SwcIn_RRCR_3.RRCR_3_Ri1ObjCoordYDstStdDe SwcIn_RRCR_3.RRCR_3_Ri1ObjXDirVStdDe SwcIn_RRCR_3.RRCR_3_Ri1ObjYDirVStdDe /end REF_MEASUREMENT
/end GROUP
/begin GROUP SwcIn_RRCR_4 ""
 /begin REF_MEASUREMENT SwcIn_RRCR_4.RRCR_4_CRC SwcIn_RRCR_4.RRCR_4_RollgCntr SwcIn_RRCR_4.RRCR_4_Ri2ObjBoxLen SwcIn_RRCR_4.RRCR_4_Ri2ObjBoxWidth SwcIn_RRCR_4.RRCR_4_Ri2HdTo SwcIn_RRCR_4.RRCR_4_Ri2ObjID SwcIn_RRCR_4.RRCR_4_Ri2ObjCoordY SwcIn_RRCR_4.RRCR_4_Ri2ObjCoordX SwcIn_RRCR_4.RRCR_4_Ri2ObjXDirAV SwcIn_RRCR_4.RRCR_4_Ri2ObjYDirV SwcIn_RRCR_4.RRCR_4_Ri2ObjXDirV SwcIn_RRCR_4.RRCR_4_Ri2ObjMtnChartc SwcIn_RRCR_4.RRCR_4_Ri2ObjTyp SwcIn_RRCR_4.RRCR_4_Ri2ObjConf SwcIn_RRCR_4.RRCR_4_Ri2ObjNrOffocst SwcIn_RRCR_4.RRCR_4_Ri2ObjTrackSt SwcIn_RRCR_4.RRCR_4_Ri2ObjCoordXDstStdDe SwcIn_RRCR_4.RRCR_4_Ri2ObjCoordYDstStdDe SwcIn_RRCR_4.RRCR_4_Ri2ObjXDirVStdDe SwcIn_RRCR_4.RRCR_4_Ri2ObjYDirVStdDe /end REF_MEASUREMENT
/end GROUP
/begin GROUP SwcIn_RRCR_5 ""
 /begin REF_MEASUREMENT SwcIn_RRCR_5.RRCR_5_CRC SwcIn_RRCR_5.RRCR_5_RollgCntr SwcIn_RRCR_5.RRCR_5_Ri3ObjBoxLen SwcIn_RRCR_5.RRCR_5_Ri3ObjBoxWidth SwcIn_RRCR_5.RRCR_5_Ri3HdTo SwcIn_RRCR_5.RRCR_5_Ri3ObjID SwcIn_RRCR_5.RRCR_5_Ri3ObjCoordY SwcIn_RRCR_5.RRCR_5_Ri3ObjCoordX SwcIn_RRCR_5.RRCR_5_Ri3ObjXDirAV SwcIn_RRCR_5.RRCR_5_Ri3ObjYDirV SwcIn_RRCR_5.RRCR_5_Ri3ObjXDirV SwcIn_RRCR_5.RRCR_5_Ri3ObjMtnChartc SwcIn_RRCR_5.RRCR_5_Ri3ObjTyp SwcIn_RRCR_5.RRCR_5_Ri3ObjConf SwcIn_RRCR_5.RRCR_5_Ri3ObjNrOffocst SwcIn_RRCR_5.RRCR_5_Ri3ObjTrackSt SwcIn_RRCR_5.RRCR_5_Ri3ObjCoordXDstStdDe SwcIn_RRCR_5.RRCR_5_Ri3ObjCoordYDstStdDe SwcIn_RRCR_5.RRCR_5_Ri3ObjXDirVStdDe SwcIn_RRCR_5.RRCR_5_Ri3ObjYDirVStdDe /end REF_MEASUREMENT
/end GROUP
/begin GROUP SwcIn_RRCR_6 ""
 /begin REF_MEASUREMENT SwcIn_RRCR_6.RRCR_6_CRC SwcIn_RRCR_6.RRCR_6_RollgCntr SwcIn_RRCR_6.RRCR_6_Ri4ObjBoxLen SwcIn_RRCR_6.RRCR_6_Ri4ObjBoxWidth SwcIn_RRCR_6.RRCR_6_Ri4HdTo SwcIn_RRCR_6.RRCR_6_Ri4ObjID SwcIn_RRCR_6.RRCR_6_Ri4ObjCoordY SwcIn_RRCR_6.RRCR_6_Ri4ObjCoordX SwcIn_RRCR_6.RRCR_6_Ri4ObjXDirAV SwcIn_RRCR_6.RRCR_6_Ri4ObjYDirV SwcIn_RRCR_6.RRCR_6_Ri4ObjXDirV SwcIn_RRCR_6.RRCR_6_Ri4ObjMtnChartc SwcIn_RRCR_6.RRCR_6_Ri4ObjTyp SwcIn_RRCR_6.RRCR_6_Ri4ObjConf SwcIn_RRCR_6.RRCR_6_Ri4ObjNrOffocst SwcIn_RRCR_6.RRCR_6_Ri4ObjTrackSt SwcIn_RRCR_6.RRCR_6_Ri4ObjCoordXDstStdDe SwcIn_RRCR_6.RRCR_6_Ri4ObjCoordYDstStdDe SwcIn_RRCR_6.RRCR_6_Ri4ObjXDirVStdDe SwcIn_RRCR_6.RRCR_6_Ri4ObjYDirVStdDe /end REF_MEASUREMENT
/end GROUP
/begin GROUP SwcIn_RRCR_7 ""
 /begin REF_MEASUREMENT SwcIn_RRCR_7.RRCR_7_CRC SwcIn_RRCR_7.RRCR_7_RollgCntr SwcIn_RRCR_7.RRCR_7_Ri5ObjBoxLen SwcIn_RRCR_7.RRCR_7_Ri5ObjBoxWidth SwcIn_RRCR_7.RRCR_7_Ri5HdTo SwcIn_RRCR_7.RRCR_7_Ri5ObjID SwcIn_RRCR_7.RRCR_7_Ri5ObjCoordY SwcIn_RRCR_7.RRCR_7_Ri5ObjCoordX SwcIn_RRCR_7.RRCR_7_Ri5ObjXDirAV SwcIn_RRCR_7.RRCR_7_Ri5ObjYDirV SwcIn_RRCR_7.RRCR_7_Ri5ObjXDirV SwcIn_RRCR_7.RRCR_7_Ri5ObjMtnChartc SwcIn_RRCR_7.RRCR_7_Ri5ObjTyp SwcIn_RRCR_7.RRCR_7_Ri5ObjConf SwcIn_RRCR_7.RRCR_7_Ri5ObjNrOffocst SwcIn_RRCR_7.RRCR_7_Ri5ObjTrackSt SwcIn_RRCR_7.RRCR_7_Ri5ObjCoordXDstStdDe SwcIn_RRCR_7.RRCR_7_Ri5ObjCoordYDstStdDe SwcIn_RRCR_7.RRCR_7_Ri5ObjXDirVStdDe SwcIn_RRCR_7.RRCR_7_Ri5ObjYDirVStdDe /end REF_MEASUREMENT
/end GROUP
/begin GROUP SwcIn_RRCR_8 ""
 /begin REF_MEASUREMENT SwcIn_RRCR_8.RRCR_8_CRC SwcIn_RRCR_8.RRCR_8_RollgCntr SwcIn_RRCR_8.RRCR_8_TiStampLaten /end REF_MEASUREMENT
/end GROUP
/begin GROUP SwcIn_RZCU_2 ""
 /begin REF_MEASUREMENT SwcIn_RZCU_2.RZCU_2_CRC SwcIn_RZCU_2.RZCU_2_RollgCntr SwcIn_RZCU_2.RZCU_2_Resd SwcIn_RZCU_2.LHRdoorSts SwcIn_RZCU_2.TrunkSts SwcIn_RZCU_2.LHRDoorLockSts SwcIn_RZCU_2.TrunkLockSts /end REF_MEASUREMENT
/end GROUP
/begin GROUP SwcIn_RZCU_7 ""
 /begin REF_MEASUREMENT SwcIn_RZCU_7.RZCU_7_CRC SwcIn_RZCU_7.RZCU_7_RollgCntr SwcIn_RZCU_7.RZCU_RearWiperWipingStatus SwcIn_RZCU_7.RZCU_RearWiperParkStatus /end REF_MEASUREMENT
/end GROUP
/begin GROUP SwcIn_SAS_1 ""
 /begin REF_MEASUREMENT SwcIn_SAS_1.SAM_1_CRC SwcIn_SAS_1.SAM_1_RollgCntr SwcIn_SAS_1.SAM_1_Resd SwcIn_SAS_1.SAM_1_SteeringAngle SwcIn_SAS_1.SAM_1_SteeringAngleSpeed SwcIn_SAS_1.SAM_1_SteeringAngleVD SwcIn_SAS_1.SAM_1_SteeringAngleSpeedVD /end REF_MEASUREMENT
/end GROUP
/begin GROUP SwcIn_SysIn_HMI_ADASSetting ""
 /begin SUB_GROUP SwcIn_SysIn_HMI_ADASSetting.ADASSettingInfo SwcIn_SysIn_HMI_ADASSetting.ADASSettingInfo_2 /end SUB_GROUP
/end GROUP
/end MODULE
/end PROJECT
