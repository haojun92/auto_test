ASAP2_VERSION 1 71
/begin PROJECT ProjectName ""
/begin MODULE ModuleName ""
/begin MOD_COMMON "" BYTE_ORDER MSB_LAST ALIGNMENT_BYTE 1 ALIGNMENT_WORD 1 ALIGNMENT_LONG 1 ALIGNMENT_INT64 1 ALIGNMENT_FLOAT16_IEEE 1 ALIGNMENT_FLOAT32_IEEE 1 ALIGNMENT_FLOAT64_IEEE 1 /end MOD_COMMON
/begin RECORD_LAYOUT Scalar_BOOLEAN FNC_VALUES 1 UBYTE COLUMN_DIR DIRECT /end RECORD_LAYOUT
/begin RECORD_LAYOUT Record_BOOLEAN FNC_VALUES 1 UBYTE COLUMN_DIR DIRECT /end RECORD_LAYOUT
/begin RECORD_LAYOUT Record_FLOAT32_IEEE FNC_VALUES 1 FLOAT32_IEEE COLUMN_DIR DIRECT /end RECORD_LAYOUT
/begin RECORD_LAYOUT Record_FLOAT64_IEEE FNC_VALUES 1 FLOAT64_IEEE COLUMN_DIR DIRECT /end RECORD_LAYOUT
/begin RECORD_LAYOUT Record_UBYTE FNC_VALUES 1 UBYTE COLUMN_DIR DIRECT /end RECORD_LAYOUT
/begin RECORD_LAYOUT Axis_FLOAT32_IEEE AXIS_PTS_X 1 FLOAT32_IEEE INDEX_INCR DIRECT /end RECORD_LAYOUT
/begin RECORD_LAYOUT Record_BOOLEAN FNC_VALUES 1 UBYTE COLUMN_DIR DIRECT /end RECORD_LAYOUT
/begin RECORD_LAYOUT Record_FLOAT32_IEEE FNC_VALUES 1 FLOAT32_IEEE COLUMN_DIR DIRECT /end RECORD_LAYOUT
/begin RECORD_LAYOUT Record_UBYTE FNC_VALUES 1 UBYTE COLUMN_DIR DIRECT /end RECORD_LAYOUT
/begin RECORD_LAYOUT Axis_FLOAT32_IEEE AXIS_PTS_X 1 FLOAT32_IEEE INDEX_INCR DIRECT /end RECORD_LAYOUT
/begin RECORD_LAYOUT Record_BOOLEAN FNC_VALUES 1 UBYTE COLUMN_DIR DIRECT /end RECORD_LAYOUT
/begin RECORD_LAYOUT Record_FLOAT32_IEEE FNC_VALUES 1 FLOAT32_IEEE COLUMN_DIR DIRECT /end RECORD_LAYOUT
/begin RECORD_LAYOUT Record_FLOAT64_IEEE FNC_VALUES 1 FLOAT64_IEEE COLUMN_DIR DIRECT /end RECORD_LAYOUT
/begin RECORD_LAYOUT Record_UBYTE FNC_VALUES 1 UBYTE COLUMN_DIR DIRECT /end RECORD_LAYOUT
/begin RECORD_LAYOUT Record_BOOLEAN FNC_VALUES 1 UBYTE COLUMN_DIR DIRECT /end RECORD_LAYOUT
/begin RECORD_LAYOUT Record_FLOAT32_IEEE FNC_VALUES 1 FLOAT32_IEEE COLUMN_DIR DIRECT /end RECORD_LAYOUT
/begin RECORD_LAYOUT Record_UBYTE FNC_VALUES 1 UBYTE COLUMN_DIR DIRECT /end RECORD_LAYOUT
/begin RECORD_LAYOUT Axis_FLOAT32_IEEE AXIS_PTS_X 1 FLOAT32_IEEE INDEX_INCR DIRECT /end RECORD_LAYOUT
/begin RECORD_LAYOUT Record_BOOLEAN FNC_VALUES 1 UBYTE COLUMN_DIR DIRECT /end RECORD_LAYOUT
/begin RECORD_LAYOUT Record_FLOAT32_IEEE FNC_VALUES 1 FLOAT32_IEEE COLUMN_DIR DIRECT /end RECORD_LAYOUT
/begin RECORD_LAYOUT Record_FLOAT64_IEEE FNC_VALUES 1 FLOAT64_IEEE COLUMN_DIR DIRECT /end RECORD_LAYOUT
/begin RECORD_LAYOUT Record_UBYTE FNC_VALUES 1 UBYTE COLUMN_DIR DIRECT /end RECORD_LAYOUT
/begin RECORD_LAYOUT Axis_FLOAT32_IEEE AXIS_PTS_X 1 FLOAT32_IEEE INDEX_INCR DIRECT /end RECORD_LAYOUT
/begin RECORD_LAYOUT Record_BOOLEAN FNC_VALUES 1 UBYTE COLUMN_DIR DIRECT /end RECORD_LAYOUT
/begin RECORD_LAYOUT Record_FLOAT32_IEEE FNC_VALUES 1 FLOAT32_IEEE COLUMN_DIR DIRECT /end RECORD_LAYOUT
/begin RECORD_LAYOUT Record_FLOAT64_IEEE FNC_VALUES 1 FLOAT64_IEEE COLUMN_DIR DIRECT /end RECORD_LAYOUT
/begin RECORD_LAYOUT Record_UBYTE FNC_VALUES 1 UBYTE COLUMN_DIR DIRECT /end RECORD_LAYOUT
/begin RECORD_LAYOUT Axis_FLOAT32_IEEE AXIS_PTS_X 1 FLOAT32_IEEE INDEX_INCR DIRECT /end RECORD_LAYOUT
/begin RECORD_LAYOUT Record_BOOLEAN FNC_VALUES 1 UBYTE COLUMN_DIR DIRECT /end RECORD_LAYOUT
/begin RECORD_LAYOUT Record_FLOAT32_IEEE FNC_VALUES 1 FLOAT32_IEEE COLUMN_DIR DIRECT /end RECORD_LAYOUT
/begin RECORD_LAYOUT Record_FLOAT64_IEEE FNC_VALUES 1 FLOAT64_IEEE COLUMN_DIR DIRECT /end RECORD_LAYOUT
/begin RECORD_LAYOUT Record_UBYTE FNC_VALUES 1 UBYTE COLUMN_DIR DIRECT /end RECORD_LAYOUT
/begin RECORD_LAYOUT Record_BOOLEAN FNC_VALUES 1 UBYTE COLUMN_DIR DIRECT /end RECORD_LAYOUT
/begin RECORD_LAYOUT Record_FLOAT32_IEEE FNC_VALUES 1 FLOAT32_IEEE COLUMN_DIR DIRECT /end RECORD_LAYOUT
/begin RECORD_LAYOUT Record_FLOAT64_IEEE FNC_VALUES 1 FLOAT64_IEEE COLUMN_DIR DIRECT /end RECORD_LAYOUT
/begin RECORD_LAYOUT Record_UBYTE FNC_VALUES 1 UBYTE COLUMN_DIR DIRECT /end RECORD_LAYOUT
/begin RECORD_LAYOUT Axis_FLOAT32_IEEE AXIS_PTS_X 1 FLOAT32_IEEE INDEX_INCR DIRECT /end RECORD_LAYOUT
/begin RECORD_LAYOUT Record_BOOLEAN FNC_VALUES 1 UBYTE COLUMN_DIR DIRECT /end RECORD_LAYOUT
/begin RECORD_LAYOUT Record_FLOAT32_IEEE FNC_VALUES 1 FLOAT32_IEEE COLUMN_DIR DIRECT /end RECORD_LAYOUT
/begin RECORD_LAYOUT Record_FLOAT64_IEEE FNC_VALUES 1 FLOAT64_IEEE COLUMN_DIR DIRECT /end RECORD_LAYOUT
/begin RECORD_LAYOUT Record_UBYTE FNC_VALUES 1 UBYTE COLUMN_DIR DIRECT /end RECORD_LAYOUT
/begin RECORD_LAYOUT Axis_FLOAT32_IEEE AXIS_PTS_X 1 FLOAT32_IEEE INDEX_INCR DIRECT /end RECORD_LAYOUT
/begin CHARACTERISTIC C_LongCtrl_0_Uint8 "" VALUE 0xfe5055a4 /* @ECU_Address@C_LongCtrl_0_Uint8@ */ Record_UBYTE 0 autosar_swc_vmp_CM_uint8 0 255 /end CHARACTERISTIC
/begin CHARACTERISTIC LONP_JerkForDecelToStopFac "" VALUE 0xfe5055a0 /* @ECU_Address@LONP_JerkForDecelToStopFac@ */ Record_FLOAT32_IEEE 0 autosar_swc_vmp_CM_single -3.4E+38 3.4E+38 /end CHARACTERISTIC
/begin CHARACTERISTIC P_LONP_ALaLowerChar "" CURVE 0xfe829524 /* @ECU_Address@P_LONP_ALaLowerChar@ */ Record_FLOAT32_IEEE 0 autosar_swc_vmp_CM_single_m_per_s_2 -3.4E+38 3.4E+38
 /begin AXIS_DESCR COM_AXIS autosar_swc_vmp_rtARID_DEF.TmpSignalConversionAtvxvRefMsOutport1 autosar_swc_vmp_CM_single_m_per_s 4 0.000000 70.000000 AXIS_PTS_REF P_LONP_ALvAcceleLowerChar /end AXIS_DESCR
/end CHARACTERISTIC
/begin CHARACTERISTIC P_LONP_ALaUpperCharEco "" CURVE 0xfe8299b4 /* @ECU_Address@P_LONP_ALaUpperCharEco@ */ Record_FLOAT32_IEEE 0 autosar_swc_vmp_CM_single_m_per_s_2 0.000000 3.000000
 /begin AXIS_DESCR COM_AXIS autosar_swc_vmp_rtARID_DEF.TmpSignalConversionAtvxvRefMsOutport1 autosar_swc_vmp_CM_single_m_per_s 15 0.000000 70.000000 AXIS_PTS_REF P_LONP_ALvAcceleUpperCharEco /end AXIS_DESCR
/end CHARACTERISTIC
/begin CHARACTERISTIC P_LONP_ALaUpperCharLaneChange "" CURVE 0xfe8299f0 /* @ECU_Address@P_LONP_ALaUpperCharLaneChange@ */ Record_FLOAT32_IEEE 0 autosar_swc_vmp_CM_single_m_per_s_2 0.000000 3.000000
 /begin AXIS_DESCR COM_AXIS autosar_swc_vmp_rtARID_DEF.TmpSignalConversionAtvxvRefMsOutport1 autosar_swc_vmp_CM_single_m_per_s 15 0.000000 100.000000 AXIS_PTS_REF P_LONP_ALvAcceleUpperCharLaneChange /end AXIS_DESCR
/end CHARACTERISTIC
/begin CHARACTERISTIC P_LONP_ALaUpperCharNormal "" CURVE 0xfe829a2c /* @ECU_Address@P_LONP_ALaUpperCharNormal@ */ Record_FLOAT32_IEEE 0 autosar_swc_vmp_CM_single_m_per_s_2 0.000000 3.000000
 /begin AXIS_DESCR COM_AXIS autosar_swc_vmp_rtARID_DEF.TmpSignalConversionAtvxvRefMsOutport1 autosar_swc_vmp_CM_single_m_per_s 7 0.000000 70.000000 AXIS_PTS_REF P_LONP_ALvAcceleUpperCharNormal /end AXIS_DESCR
/end CHARACTERISTIC
/begin CHARACTERISTIC P_LONP_ALaUpperCharRampMerge "m/s^2" CURVE 0xfe829a48 /* @ECU_Address@P_LONP_ALaUpperCharRampMerge@ */ Record_FLOAT32_IEEE 0 autosar_swc_vmp_CM_single -3.4E+38 3.4E+38
 /begin AXIS_DESCR COM_AXIS autosar_swc_vmp_rtARID_DEF.TmpSignalConversionAtvxvRefMsOutport1 autosar_swc_vmp_CM_single 15 -3.4E+38 3.4E+38 AXIS_PTS_REF P_LONP_ALvAcceleUpperCharRampMerge /end AXIS_DESCR
/end CHARACTERISTIC
/begin CHARACTERISTIC P_LONP_ALaUpperCharSport "" CURVE 0xfe829a84 /* @ECU_Address@P_LONP_ALaUpperCharSport@ */ Record_FLOAT32_IEEE 0 autosar_swc_vmp_CM_single_m_per_s_2 0.000000 3.000000
 /begin AXIS_DESCR COM_AXIS autosar_swc_vmp_rtARID_DEF.TmpSignalConversionAtvxvRefMsOutport1 autosar_swc_vmp_CM_single_m_per_s 15 0.000000 70.000000 AXIS_PTS_REF P_LONP_ALvAcceleUpperCharSport /end AXIS_DESCR
/end CHARACTERISTIC
/begin CHARACTERISTIC P_LONP_AcceUpperEcoLimitGainByNormalMode "" VALUE 0xfe829178 /* @ECU_Address@P_LONP_AcceUpperEcoLimitGainByNormalMode@ */ Record_FLOAT32_IEEE 0 autosar_swc_vmp_CM_single -3.4E+38 3.4E+38 /end CHARACTERISTIC
/begin CHARACTERISTIC P_LONP_AcceUpperSportLimitGainByNormalMode "" VALUE 0xfe82917c /* @ECU_Address@P_LONP_AcceUpperSportLimitGainByNormalMode@ */ Record_FLOAT32_IEEE 0 autosar_swc_vmp_CM_single -3.4E+38 3.4E+38 /end CHARACTERISTIC
/begin CHARACTERISTIC P_LONP_BicycleOrPedP1BrakeSW "" VALUE 0xfe829505 /* @ECU_Address@P_LONP_BicycleOrPedP1BrakeSW@ */ Record_BOOLEAN 0 autosar_swc_vmp_CM_boolean 0 1 /end CHARACTERISTIC
/begin CHARACTERISTIC P_LONP_CCLCIncSetSpdAdd "" VALUE 0xfe829180 /* @ECU_Address@P_LONP_CCLCIncSetSpdAdd@ */ Record_FLOAT32_IEEE 0 autosar_swc_vmp_CM_single_km_per_h 0.000000 30.000000 /end CHARACTERISTIC
/begin CHARACTERISTIC P_LONP_CCLCIncSetSpdAddDecStep "" VALUE 0xfe829184 /* @ECU_Address@P_LONP_CCLCIncSetSpdAddDecStep@ */ Record_FLOAT32_IEEE 0 autosar_swc_vmp_CM_single -3.4E+38 3.4E+38 /end CHARACTERISTIC
/begin CHARACTERISTIC P_LONP_CCLCIncSetSpdEnable "" VALUE 0xfe829506 /* @ECU_Address@P_LONP_CCLCIncSetSpdEnable@ */ Record_BOOLEAN 0 autosar_swc_vmp_CM_boolean 0.000000 1.000000 /end CHARACTERISTIC
/begin CHARACTERISTIC P_LONP_CCResumeDelayDeltaVel "" VALUE 0xfe829188 /* @ECU_Address@P_LONP_CCResumeDelayDeltaVel@ */ Record_FLOAT32_IEEE 0 autosar_swc_vmp_CM_single -3.4E+38 3.4E+38 /end CHARACTERISTIC
/begin CHARACTERISTIC P_LONP_CCaccelCCNeg2PosJerk "" VALUE 0xfe82919c /* @ECU_Address@P_LONP_CCaccelCCNeg2PosJerk@ */ Record_FLOAT32_IEEE 0 autosar_swc_vmp_CM_single_m_per_s_3 0.000000 5.000000 /end CHARACTERISTIC
/begin CHARACTERISTIC P_LONP_CCaccelCCPosJerk "" VALUE 0xfe8291a0 /* @ECU_Address@P_LONP_CCaccelCCPosJerk@ */ Record_FLOAT32_IEEE 0 autosar_swc_vmp_CM_single_m_per_s_3 0.000000 4.000000 /end CHARACTERISTIC
/begin CHARACTERISTIC P_LONP_CCaccelCCPosJerkRampMerge "" VALUE 0xfe8291a4 /* @ECU_Address@P_LONP_CCaccelCCPosJerkRampMerge@ */ Record_FLOAT32_IEEE 0 autosar_swc_vmp_CM_single -3.4E+38 3.4E+38 /end CHARACTERISTIC
/begin CHARACTERISTIC P_LONP_CCaccelLowerIsLaneChange "" VALUE 0xfe8291a8 /* @ECU_Address@P_LONP_CCaccelLowerIsLaneChange@ */ Record_FLOAT32_IEEE 0 autosar_swc_vmp_CM_single_m_per_s_2 0.000000 2.000000 /end CHARACTERISTIC
/begin CHARACTERISTIC P_LONP_CCaccelMaxLCActive "" VALUE 0xfe8291ac /* @ECU_Address@P_LONP_CCaccelMaxLCActive@ */ Record_FLOAT32_IEEE 0 autosar_swc_vmp_CM_single_m_per_s_2 -3.4E+38 3.4E+38 /end CHARACTERISTIC
/begin CHARACTERISTIC P_LONP_CCaccelMinECOAL "" VALUE 0xfe8291b0 /* @ECU_Address@P_LONP_CCaccelMinECOAL@ */ Record_FLOAT32_IEEE 0 autosar_swc_vmp_CM_single_m_per_s_2 0.000000 2.000000 /end CHARACTERISTIC
/begin CHARACTERISTIC P_LONP_CCaccelMinFastDecel "" VALUE 0xfe8291b4 /* @ECU_Address@P_LONP_CCaccelMinFastDecel@ */ Record_FLOAT32_IEEE 0 autosar_swc_vmp_CM_single_m_per_s_2 -5.000000 -1.000000 /end CHARACTERISTIC
/begin CHARACTERISTIC P_LONP_CCaccelMinNoFastDecel "" VALUE 0xfe8291b8 /* @ECU_Address@P_LONP_CCaccelMinNoFastDecel@ */ Record_FLOAT32_IEEE 0 autosar_swc_vmp_CM_single_m_per_s_2 -2.000000 0.000000 /end CHARACTERISTIC
/begin CHARACTERISTIC P_LONP_CCaccelMinNormAL "" VALUE 0xfe8291bc /* @ECU_Address@P_LONP_CCaccelMinNormAL@ */ Record_FLOAT32_IEEE 0 autosar_swc_vmp_CM_single_m_per_s_2 0.000000 2.000000 /end CHARACTERISTIC
/begin CHARACTERISTIC P_LONP_CCaccelMinRampMerge "" VALUE 0xfe8291c0 /* @ECU_Address@P_LONP_CCaccelMinRampMerge@ */ Record_FLOAT32_IEEE 0 autosar_swc_vmp_CM_single -3.4E+38 3.4E+38 /end CHARACTERISTIC
/begin CHARACTERISTIC P_LONP_CCaccelMinSportAL "" VALUE 0xfe8291c4 /* @ECU_Address@P_LONP_CCaccelMinSportAL@ */ Record_FLOAT32_IEEE 0 autosar_swc_vmp_CM_single_m_per_s_2 0.000000 2.000000 /end CHARACTERISTIC
/begin CHARACTERISTIC P_LONP_CCaccelUpperCC "" VALUE 0xfe8291c8 /* @ECU_Address@P_LONP_CCaccelUpperCC@ */ Record_FLOAT32_IEEE 0 autosar_swc_vmp_CM_single_m_per_s_2 1.000000 3.000000 /end CHARACTERISTIC
/begin CHARACTERISTIC P_LONP_CCaccelUpperCCSafeStop "" VALUE 0xfe8291cc /* @ECU_Address@P_LONP_CCaccelUpperCCSafeStop@ */ Record_FLOAT32_IEEE 0 autosar_swc_vmp_CM_single_m_per_s_2 -2.000000 0.000000 /end CHARACTERISTIC
/begin CHARACTERISTIC P_LONP_CCaccelUpperRampMerge "" VALUE 0xfe8291d0 /* @ECU_Address@P_LONP_CCaccelUpperRampMerge@ */ Record_FLOAT32_IEEE 0 autosar_swc_vmp_CM_single -3.4E+38 3.4E+38 /end CHARACTERISTIC
/begin CHARACTERISTIC P_LONP_CCbECO "" VALUE 0xfe8291d4 /* @ECU_Address@P_LONP_CCbECO@ */ Record_FLOAT32_IEEE 0 autosar_swc_vmp_CM_single -10.000000 10.000000 /end CHARACTERISTIC
/begin CHARACTERISTIC P_LONP_CCbNorm "" VALUE 0xfe8291d8 /* @ECU_Address@P_LONP_CCbNorm@ */ Record_FLOAT32_IEEE 0 autosar_swc_vmp_CM_single -10.000000 10.000000 /end CHARACTERISTIC
/begin CHARACTERISTIC P_LONP_CCbSport "" VALUE 0xfe8291dc /* @ECU_Address@P_LONP_CCbSport@ */ Record_FLOAT32_IEEE 0 autosar_swc_vmp_CM_single -10.000000 10.000000 /end CHARACTERISTIC
/begin CHARACTERISTIC P_LONP_CCdecelCCJerk "" VALUE 0xfe8291e0 /* @ECU_Address@P_LONP_CCdecelCCJerk@ */ Record_FLOAT32_IEEE 0 autosar_swc_vmp_CM_single_m_per_s_3 -4.000000 0.000000 /end CHARACTERISTIC
/begin CHARACTERISTIC P_LONP_CCdecelCCJerkNegVLCInternalAcc "" VALUE 0xfe8291e4 /* @ECU_Address@P_LONP_CCdecelCCJerkNegVLCInternalAcc@ */ Record_FLOAT32_IEEE 0 autosar_swc_vmp_CM_single_m_per_s_3 -4.000000 0.000000 /end CHARACTERISTIC
/begin CHARACTERISTIC P_LONP_CCdecelCCJerkRampMerge "" VALUE 0xfe8291e8 /* @ECU_Address@P_LONP_CCdecelCCJerkRampMerge@ */ Record_FLOAT32_IEEE 0 autosar_swc_vmp_CM_single -3.4E+38 3.4E+38 /end CHARACTERISTIC
/begin CHARACTERISTIC P_LONP_CCkECO "" VALUE 0xfe8291fc /* @ECU_Address@P_LONP_CCkECO@ */ Record_FLOAT32_IEEE 0 autosar_swc_vmp_CM_single -10.000000 10.000000 /end CHARACTERISTIC
/begin CHARACTERISTIC P_LONP_CCkNorm "" VALUE 0xfe829200 /* @ECU_Address@P_LONP_CCkNorm@ */ Record_FLOAT32_IEEE 0 autosar_swc_vmp_CM_single -10.000000 10.000000 /end CHARACTERISTIC
/begin CHARACTERISTIC P_LONP_CCkSport "" VALUE 0xfe829204 /* @ECU_Address@P_LONP_CCkSport@ */ Record_FLOAT32_IEEE 0 autosar_swc_vmp_CM_single -10.000000 10.000000 /end CHARACTERISTIC
/begin CHARACTERISTIC P_LONP_CCtStepVelPlan "" VALUE 0xfe829210 /* @ECU_Address@P_LONP_CCtStepVelPlan@ */ Record_FLOAT32_IEEE 0 autosar_swc_vmp_CM_single_s 0.000000 10.000000 /end CHARACTERISTIC
/begin CHARACTERISTIC P_LONP_CCtTotVelPlan "" VALUE 0xfe829214 /* @ECU_Address@P_LONP_CCtTotVelPlan@ */ Record_FLOAT32_IEEE 0 autosar_swc_vmp_CM_single_s 0.000000 10.000000 /end CHARACTERISTIC
/begin CHARACTERISTIC P_LONP_Center2LineValue "" VALUE 0xfe829218 /* @ECU_Address@P_LONP_Center2LineValue@ */ Record_FLOAT32_IEEE 0 autosar_swc_vmp_CM_single -3.4E+38 3.4E+38 /end CHARACTERISTIC
/begin CHARACTERISTIC P_LONP_ComfortExitAccJerkValue "" VALUE 0xfe82921c /* @ECU_Address@P_LONP_ComfortExitAccJerkValue@ */ Record_FLOAT32_IEEE 0 autosar_swc_vmp_CM_single -3.4E+38 3.4E+38 /end CHARACTERISTIC
/begin CHARACTERISTIC P_LONP_ComfortExitDecJerkValue "" VALUE 0xfe829220 /* @ECU_Address@P_LONP_ComfortExitDecJerkValue@ */ Record_FLOAT32_IEEE 0 autosar_swc_vmp_CM_single -3.4E+38 3.4E+38 /end CHARACTERISTIC
/begin CHARACTERISTIC P_LONP_CompareKapType "" VALUE 0xfe829507 /* @ECU_Address@P_LONP_CompareKapType@ */ Record_UBYTE 0 autosar_swc_vmp_CM_uint8 0 255 /end CHARACTERISTIC
/begin CHARACTERISTIC P_LONP_CutinMinVaildDistance "" VALUE 0xfe829224 /* @ECU_Address@P_LONP_CutinMinVaildDistance@ */ Record_FLOAT32_IEEE 0 autosar_swc_vmp_CM_single -3.4E+38 3.4E+38 /end CHARACTERISTIC
/begin CHARACTERISTIC P_LONP_CutinTTCThrethold "" VALUE 0xfe829228 /* @ECU_Address@P_LONP_CutinTTCThrethold@ */ Record_FLOAT32_IEEE 0 autosar_swc_vmp_CM_single -3.4E+38 3.4E+38 /end CHARACTERISTIC
/begin CHARACTERISTIC P_LONP_DecVParamPts "" VAL_BLK 0xfe829c2c /* @ECU_Address@P_LONP_DecVParamPts@ */ Record_FLOAT32_IEEE 0 autosar_swc_vmp_CM_single -3.4E+38 3.4E+38 MATRIX_DIM 5 1 /end CHARACTERISTIC
/begin CHARACTERISTIC P_LONP_DecVParamValue "" VAL_BLK 0xfe829c40 /* @ECU_Address@P_LONP_DecVParamValue@ */ Record_FLOAT32_IEEE 0 autosar_swc_vmp_CM_single -3.4E+38 3.4E+38 MATRIX_DIM 5 1 /end CHARACTERISTIC
/begin CHARACTERISTIC P_LONP_DistDesTnresStopCtrl "m" CURVE 0xfe829584 /* @ECU_Address@P_LONP_DistDesTnresStopCtrl@ */ Record_FLOAT32_IEEE 0 autosar_swc_vmp_CM_single -3.4E+38 3.4E+38
 /begin AXIS_DESCR COM_AXIS NO_INPUT_QUANTITY autosar_swc_vmp_CM_single 6 -3.4E+38 3.4E+38 AXIS_PTS_REF P_LONP_axvRoadSlopeMs2StopCtrl /end AXIS_DESCR
/end CHARACTERISTIC
/begin CHARACTERISTIC P_LONP_DistSwitchCofEnable "" VALUE 0xfe829508 /* @ECU_Address@P_LONP_DistSwitchCofEnable@ */ Record_BOOLEAN 0 autosar_swc_vmp_CM_boolean 0 1 /end CHARACTERISTIC
/begin CHARACTERISTIC P_LONP_DistTerCofYAxis "" MAP 0xfe82a020 /* @ECU_Address@P_LONP_DistTerCofYAxis@ */ Record_FLOAT32_IEEE 0 autosar_swc_vmp_CM_single -3.4E+38 3.4E+38
 /begin AXIS_DESCR COM_AXIS autosar_swc_vmp_rtARID_DEF.TmpSignalConversionAtvxvRefMsOutport1 autosar_swc_vmp_CM_single 11 -3.4E+38 3.4E+38 AXIS_PTS_REF P_LONP_DistTerCofX2Axis /end AXIS_DESCR
 /begin AXIS_DESCR COM_AXIS autosar_swc_vmp_rtARID_DEF.TmpSignalConversionAtvxvRefMsOutport1 autosar_swc_vmp_CM_single 10 -3.4E+38 3.4E+38 AXIS_PTS_REF P_LONP_DistTerCofX1Axis /end AXIS_DESCR
/end CHARACTERISTIC
/begin CHARACTERISTIC P_LONP_ENDlowerJerk "" CURVE 0xfe8295c4 /* @ECU_Address@P_LONP_ENDlowerJerk@ */ Record_FLOAT32_IEEE 0 autosar_swc_vmp_CM_single -3.4E+38 3.4E+38
 /begin AXIS_DESCR COM_AXIS NO_INPUT_QUANTITY autosar_swc_vmp_CM_single 4 -3.4E+38 3.4E+38 AXIS_PTS_REF P_LONP_roadEndDis /end AXIS_DESCR
/end CHARACTERISTIC
/begin CHARACTERISTIC P_LONP_FollowAccelAddSlopeAssistYAxis "" CURVE 0xfe829050 /* @ECU_Address@P_LONP_FollowAccelAddSlopeAssistYAxis@ */ Record_FLOAT32_IEEE 0 autosar_swc_vmp_CM_single_m_per_s_2 0.000000 1.000000
 /begin AXIS_DESCR COM_AXIS NO_INPUT_QUANTITY autosar_swc_vmp_CM_single_m_per_s_2 2 0.000000 4.000000 AXIS_PTS_REF P_LONP_FollowAccelAddSlopeAssistXAxis /end AXIS_DESCR
/end CHARACTERISTIC
/begin CHARACTERISTIC P_LONP_FollowAccelDesThresStartUpAssistEnable "" VALUE 0xfe829238 /* @ECU_Address@P_LONP_FollowAccelDesThresStartUpAssistEnable@ */ Record_FLOAT32_IEEE 0 autosar_swc_vmp_CM_single_m_per_s_2 0.000000 1.000000 /end CHARACTERISTIC
/begin CHARACTERISTIC P_LONP_FollowAccelJerkNegFollowAccel "" VALUE 0xfe82923c /* @ECU_Address@P_LONP_FollowAccelJerkNegFollowAccel@ */ Record_FLOAT32_IEEE 0 autosar_swc_vmp_CM_single_m_per_s_3 0.000000 3.000000 /end CHARACTERISTIC
/begin CHARACTERISTIC P_LONP_FollowCoefCharCoefEnlargeAccelJerkYAxis "" CURVE 0xfe829c8c /* @ECU_Address@P_LONP_FollowCoefCharCoefEnlargeAccelJerkYAxis@ */ Record_FLOAT32_IEEE 0 autosar_swc_vmp_CM_single 0.000000 5.000000
 /begin AXIS_DESCR COM_AXIS autosar_swc_vmp_rtARID_DEF.UnitDelay1 autosar_swc_vmp_CM_single_m_per_s_2 3 -5.000000 3.000000 AXIS_PTS_REF P_LONP_FollowAccelCharNegVlcAcc2CoefEnlargeAccelJerkXAxis /end AXIS_DESCR
/end CHARACTERISTIC
/begin CHARACTERISTIC P_LONP_FollowCoefStartUpAssistFadeOut "" VALUE 0xfe829240 /* @ECU_Address@P_LONP_FollowCoefStartUpAssistFadeOut@ */ Record_FLOAT32_IEEE 0 autosar_swc_vmp_CM_single 0.000000 0.990000 /end CHARACTERISTIC
/begin CHARACTERISTIC P_LONP_FollowDecelAccMinLimitBySpd "" CURVE 0xfe8295d4 /* @ECU_Address@P_LONP_FollowDecelAccMinLimitBySpd@ */ Record_FLOAT32_IEEE 0 autosar_swc_vmp_CM_single -3.4E+38 3.4E+38
 /begin AXIS_DESCR COM_AXIS autosar_swc_vmp_rtARID_DEF.TmpSignalConversionAtvxvRefMsOutport1 autosar_swc_vmp_CM_single 4 -3.4E+38 3.4E+38 AXIS_PTS_REF P_LONP_SpdForFollowDecelCal /end AXIS_DESCR
/end CHARACTERISTIC
/begin CHARACTERISTIC P_LONP_FollowDecelJerkDiffTTC2GapCorrEnableTTCThres "" VALUE 0xfe829244 /* @ECU_Address@P_LONP_FollowDecelJerkDiffTTC2GapCorrEnableTTCThres@ */ Record_FLOAT32_IEEE 0 autosar_swc_vmp_CM_single_s 2.000000 15.000000 /end CHARACTERISTIC
/begin CHARACTERISTIC P_LONP_FollowDecelJerkDiffTTC2GapCorrEnableVelSubjThres "" VALUE 0xfe829248 /* @ECU_Address@P_LONP_FollowDecelJerkDiffTTC2GapCorrEnableVelSubjThres@ */ Record_FLOAT32_IEEE 0 autosar_swc_vmp_CM_single_m_per_s 1.000000 200.000000 /end CHARACTERISTIC
/begin CHARACTERISTIC P_LONP_FollowDecelJerkDiffTTC2GapCorrYAxis "" CURVE 0xfe829070 /* @ECU_Address@P_LONP_FollowDecelJerkDiffTTC2GapCorrYAxis@ */ Record_FLOAT32_IEEE 0 autosar_swc_vmp_CM_single 0.010000 1.000000
 /begin AXIS_DESCR COM_AXIS NO_INPUT_QUANTITY autosar_swc_vmp_CM_single_s 2 0.000000 25.000000 AXIS_PTS_REF P_LONP_FollowDecelJerkDiffTTC2GapCorrXAxis /end AXIS_DESCR
/end CHARACTERISTIC
/begin CHARACTERISTIC P_LONP_FollowDecelJerkForceSlopeYAxis "" CURVE 0xfe829080 /* @ECU_Address@P_LONP_FollowDecelJerkForceSlopeYAxis@ */ Record_FLOAT32_IEEE 0 autosar_swc_vmp_CM_single_m_per_s_3 -50.000000 0.000000
 /begin AXIS_DESCR COM_AXIS NO_INPUT_QUANTITY autosar_swc_vmp_CM_single_m_per_s_2 2 0.000000 4.000000 AXIS_PTS_REF P_LONP_FollowDecelJerkForceSlopeXAxis /end AXIS_DESCR
/end CHARACTERISTIC
/begin CHARACTERISTIC P_LONP_FollowDesDistAddP0Lost "" VALUE 0xfe82924c /* @ECU_Address@P_LONP_FollowDesDistAddP0Lost@ */ Record_FLOAT32_IEEE 0 autosar_swc_vmp_CM_single -3.4E+38 3.4E+38 /end CHARACTERISTIC
/begin CHARACTERISTIC P_LONP_FollowDistDesAddForceStop "" VALUE 0xfe829250 /* @ECU_Address@P_LONP_FollowDistDesAddForceStop@ */ Record_FLOAT32_IEEE 0 autosar_swc_vmp_CM_single_m -2.000000 3.000000 /end CHARACTERISTIC
/begin CHARACTERISTIC P_LONP_FollowDistDesCompensionVelRelThresMax "" VALUE 0xfe829254 /* @ECU_Address@P_LONP_FollowDistDesCompensionVelRelThresMax@ */ Record_FLOAT32_IEEE 0 autosar_swc_vmp_CM_single_km_per_h 0.000000 20.000000 /end CHARACTERISTIC
/begin CHARACTERISTIC P_LONP_FollowDistDesCompensionVelRelThresMin "" VALUE 0xfe829258 /* @ECU_Address@P_LONP_FollowDistDesCompensionVelRelThresMin@ */ Record_FLOAT32_IEEE 0 autosar_swc_vmp_CM_single_km_per_h -5.000000 2.000000 /end CHARACTERISTIC
/begin CHARACTERISTIC P_LONP_FollowDistDiff2VelSubjThresEnableStop "" VAL_BLK 0xfe829088 /* @ECU_Address@P_LONP_FollowDistDiff2VelSubjThresEnableStop@ */ Record_FLOAT32_IEEE 0 autosar_swc_vmp_CM_single_m -5.000000 5.000000 MATRIX_DIM 2 1 /end CHARACTERISTIC
/begin CHARACTERISTIC P_LONP_FollowDrvOffDistCorrDistFullFillOverride "" VALUE 0xfe82925c /* @ECU_Address@P_LONP_FollowDrvOffDistCorrDistFullFillOverride@ */ Record_FLOAT32_IEEE 0 autosar_swc_vmp_CM_single_m 0.000000 10.000000 /end CHARACTERISTIC
/begin CHARACTERISTIC P_LONP_FollowDrvOffDistCorrVelFullFillOverride "" VALUE 0xfe829260 /* @ECU_Address@P_LONP_FollowDrvOffDistCorrVelFullFillOverride@ */ Record_FLOAT32_IEEE 0 autosar_swc_vmp_CM_single_m 0.000000 5.000000 /end CHARACTERISTIC
/begin CHARACTERISTIC P_LONP_FollowDrvOffDistExitNoOverride "" VALUE 0xfe829264 /* @ECU_Address@P_LONP_FollowDrvOffDistExitNoOverride@ */ Record_FLOAT32_IEEE 0 autosar_swc_vmp_CM_single_m 0.000000 5.000000 /end CHARACTERISTIC
/begin CHARACTERISTIC P_LONP_FollowDrvOffDistExitOverride "" VALUE 0xfe829268 /* @ECU_Address@P_LONP_FollowDrvOffDistExitOverride@ */ Record_FLOAT32_IEEE 0 autosar_swc_vmp_CM_single_m 0.000000 5.000000 /end CHARACTERISTIC
/begin CHARACTERISTIC P_LONP_FollowDrvOffDistOffsetdDesiredAutoDrvOff "" VALUE 0xfe82926c /* @ECU_Address@P_LONP_FollowDrvOffDistOffsetdDesiredAutoDrvOff@ */ Record_FLOAT32_IEEE 0 autosar_swc_vmp_CM_single_m 0.000000 4.000000 /end CHARACTERISTIC
/begin CHARACTERISTIC P_LONP_FollowDrvOffStandstillVelThres "" VALUE 0xfe829270 /* @ECU_Address@P_LONP_FollowDrvOffStandstillVelThres@ */ Record_FLOAT32_IEEE 0 autosar_swc_vmp_CM_single_m_per_s 0.000000 5.000000 /end CHARACTERISTIC
/begin CHARACTERISTIC P_LONP_FollowDrvOffVelCorrVelFullFillOverride "" VALUE 0xfe829274 /* @ECU_Address@P_LONP_FollowDrvOffVelCorrVelFullFillOverride@ */ Record_FLOAT32_IEEE 0 autosar_swc_vmp_CM_single_m_per_s 0.000000 1.000000 /end CHARACTERISTIC
/begin CHARACTERISTIC P_LONP_FollowDrvOffVelExitDistCorrNoOverride "" VALUE 0xfe829278 /* @ECU_Address@P_LONP_FollowDrvOffVelExitDistCorrNoOverride@ */ Record_FLOAT32_IEEE 0 autosar_swc_vmp_CM_single_m 0.000000 5.000000 /end CHARACTERISTIC
/begin CHARACTERISTIC P_LONP_FollowDrvOffVelExitDistCorrOverride "" VALUE 0xfe82927c /* @ECU_Address@P_LONP_FollowDrvOffVelExitDistCorrOverride@ */ Record_FLOAT32_IEEE 0 autosar_swc_vmp_CM_single_m 0.000000 5.000000 /end CHARACTERISTIC
/begin CHARACTERISTIC P_LONP_FollowDrvOffVelExitVelCorrNoOverride "" VALUE 0xfe829280 /* @ECU_Address@P_LONP_FollowDrvOffVelExitVelCorrNoOverride@ */ Record_FLOAT32_IEEE 0 autosar_swc_vmp_CM_single_m_per_s 0.000000 2.000000 /end CHARACTERISTIC
/begin CHARACTERISTIC P_LONP_FollowDrvOffVelExitVelCorrOverride "" VALUE 0xfe829284 /* @ECU_Address@P_LONP_FollowDrvOffVelExitVelCorrOverride@ */ Record_FLOAT32_IEEE 0 autosar_swc_vmp_CM_single_m_per_s 0.000000 2.000000 /end CHARACTERISTIC
/begin CHARACTERISTIC P_LONP_FollowDrvOffVelRelMinAutoDrvOff "" VALUE 0xfe829288 /* @ECU_Address@P_LONP_FollowDrvOffVelRelMinAutoDrvOff@ */ Record_FLOAT32_IEEE 0 autosar_swc_vmp_CM_single_m_per_s 0.000000 2.000000 /end CHARACTERISTIC
/begin CHARACTERISTIC P_LONP_FollowDrvOffVelRelMinAutoDrvOffSecond "" VALUE 0xfe82928c /* @ECU_Address@P_LONP_FollowDrvOffVelRelMinAutoDrvOffSecond@ */ Record_FLOAT32_IEEE 0 autosar_swc_vmp_CM_single -3.4E+38 3.4E+38 /end CHARACTERISTIC
/begin CHARACTERISTIC P_LONP_FollowDrvOffdistRelMinAutoDrvOff "" VALUE 0xfe829290 /* @ECU_Address@P_LONP_FollowDrvOffdistRelMinAutoDrvOff@ */ Record_FLOAT32_IEEE 0 autosar_swc_vmp_CM_single_m 2.000000 6.000000 /end CHARACTERISTIC
/begin CHARACTERISTIC P_LONP_FollowDrvOffvSetMinDriveOffConditions "" VALUE 0xfe829294 /* @ECU_Address@P_LONP_FollowDrvOffvSetMinDriveOffConditions@ */ Record_FLOAT32_IEEE 0 autosar_swc_vmp_CM_single_m_per_s 0.000000 10.000000 /end CHARACTERISTIC
/begin CHARACTERISTIC P_LONP_FollowJerkCharAccelJerkYAxis "" CURVE 0xfe829c98 /* @ECU_Address@P_LONP_FollowJerkCharAccelJerkYAxis@ */ Record_FLOAT32_IEEE 0 autosar_swc_vmp_CM_single_m_per_s_3 0.000000 3.000000
 /begin AXIS_DESCR COM_AXIS autosar_swc_vmp_rtARID_DEF.TmpSignalConversionAtvxvRefMsOutport1 autosar_swc_vmp_CM_single_m_per_s 7 0.000000 60.000000 AXIS_PTS_REF P_LONP_FollowVelCharAccelJerkXAxis /end AXIS_DESCR
/end CHARACTERISTIC
/begin CHARACTERISTIC P_LONP_FollowQuickAccelTargAbsEnableThres "" VALUE 0xfe829298 /* @ECU_Address@P_LONP_FollowQuickAccelTargAbsEnableThres@ */ Record_FLOAT32_IEEE 0 autosar_swc_vmp_CM_single_m_per_s_2 -3.000000 0.000000 /end CHARACTERISTIC
/begin CHARACTERISTIC P_LONP_FollowQuickDecelAccelDesMax "" VALUE 0xfe82929c /* @ECU_Address@P_LONP_FollowQuickDecelAccelDesMax@ */ Record_FLOAT32_IEEE 0 autosar_swc_vmp_CM_single_m_per_s_2 -3.000000 0.000000 /end CHARACTERISTIC
/begin CHARACTERISTIC P_LONP_FollowQuickDecelDiffDistRel2DesThres "" VALUE 0xfe8292a0 /* @ECU_Address@P_LONP_FollowQuickDecelDiffDistRel2DesThres@ */ Record_FLOAT32_IEEE 0 autosar_swc_vmp_CM_single_m -20.000000 5.000000 /end CHARACTERISTIC
/begin CHARACTERISTIC P_LONP_FollowQuickDecelVelSubjThres "" VALUE 0xfe8292a4 /* @ECU_Address@P_LONP_FollowQuickDecelVelSubjThres@ */ Record_FLOAT32_IEEE 0 autosar_swc_vmp_CM_single_m_per_s 0.000000 100.000000 /end CHARACTERISTIC
/begin CHARACTERISTIC P_LONP_FollowQuickDecelVelTargRelThres "" VALUE 0xfe8292a8 /* @ECU_Address@P_LONP_FollowQuickDecelVelTargRelThres@ */ Record_FLOAT32_IEEE 0 autosar_swc_vmp_CM_single_m_per_s -10.000000 0.000000 /end CHARACTERISTIC
/begin CHARACTERISTIC P_LONP_FollowRateJConditionStep "" VALUE 0xfe8292ac /* @ECU_Address@P_LONP_FollowRateJConditionStep@ */ Record_FLOAT32_IEEE 0 autosar_swc_vmp_CM_single 0.000000 1.000000 /end CHARACTERISTIC
/begin CHARACTERISTIC P_LONP_FollowRateJDirStep "" VALUE 0xfe8292b0 /* @ECU_Address@P_LONP_FollowRateJDirStep@ */ Record_FLOAT32_IEEE 0 autosar_swc_vmp_CM_single 0.000000 1.000000 /end CHARACTERISTIC
/begin CHARACTERISTIC P_LONP_FollowStartUpAssist "" VALUE 0xfe82950b /* @ECU_Address@P_LONP_FollowStartUpAssist@ */ Record_BOOLEAN 0 autosar_swc_vmp_CM_boolean 0.000000 1.000000 /end CHARACTERISTIC
/begin CHARACTERISTIC P_LONP_FollowSwitch "" VALUE 0xfe82950c /* @ECU_Address@P_LONP_FollowSwitch@ */ Record_UBYTE 0 autosar_swc_vmp_CM_uint8 0 255 /end CHARACTERISTIC
/begin CHARACTERISTIC P_LONP_FollowVelSubjForceStopEnable "" VALUE 0xfe82950d /* @ECU_Address@P_LONP_FollowVelSubjForceStopEnable@ */ Record_BOOLEAN 0 autosar_swc_vmp_CM_boolean 0.000000 1.000000 /end CHARACTERISTIC
/begin CHARACTERISTIC P_LONP_FollowVelSubjNegToleranceAddYAxis "" MAP 0xfe8295e4 /* @ECU_Address@P_LONP_FollowVelSubjNegToleranceAddYAxis@ */ Record_FLOAT32_IEEE 0 autosar_swc_vmp_CM_single_m_per_s -10.000000 0.000000
 /begin AXIS_DESCR COM_AXIS NO_INPUT_QUANTITY autosar_swc_vmp_CM_single_m_per_s 2 -10.000000 0.000000 AXIS_PTS_REF P_LONP_FollowVelSubjNegToleranceAddX2Axis /end AXIS_DESCR
 /begin AXIS_DESCR COM_AXIS NO_INPUT_QUANTITY autosar_swc_vmp_CM_single_m 2 0.000000 20.000000 AXIS_PTS_REF P_LONP_FollowVelSubjNegToleranceAddX1Axis /end AXIS_DESCR
/end CHARACTERISTIC
/begin CHARACTERISTIC P_LONP_FollowVelSubjThresForceStopYAxis "" CURVE 0xfe8290c8 /* @ECU_Address@P_LONP_FollowVelSubjThresForceStopYAxis@ */ Record_FLOAT32_IEEE 0 autosar_swc_vmp_CM_single_m_per_s 0.000000 3.000000
 /begin AXIS_DESCR COM_AXIS NO_INPUT_QUANTITY autosar_swc_vmp_CM_single_m_per_s_2 2 0.000000 4.000000 AXIS_PTS_REF P_LONP_FollowVelSubjThresForceStopXAxis /end AXIS_DESCR
/end CHARACTERISTIC
/begin CHARACTERISTIC P_LONP_FollowVelSubjThresStartUpAssistEnable "" VALUE 0xfe8292b4 /* @ECU_Address@P_LONP_FollowVelSubjThresStartUpAssistEnable@ */ Record_FLOAT32_IEEE 0 autosar_swc_vmp_CM_single_m_per_s 0.000000 10.000000 /end CHARACTERISTIC
/begin CHARACTERISTIC P_LONP_FollowVelTargAbsThresStartUpAssistEnable "" VALUE 0xfe8292b8 /* @ECU_Address@P_LONP_FollowVelTargAbsThresStartUpAssistEnable@ */ Record_FLOAT32_IEEE 0 autosar_swc_vmp_CM_single_m_per_s 0.000000 3.000000 /end CHARACTERISTIC
/begin CHARACTERISTIC P_LONP_FollowVelTargetAbsSmoothNum "" VALUE 0xfe8292bc /* @ECU_Address@P_LONP_FollowVelTargetAbsSmoothNum@ */ Record_FLOAT32_IEEE 0 autosar_swc_vmp_CM_single_m_per_s 0.000000 60.000000 /end CHARACTERISTIC
/begin CHARACTERISTIC P_LONP_FollowWdCoefYAxis "" CURVE 0xfe829ce4 /* @ECU_Address@P_LONP_FollowWdCoefYAxis@ */ Record_FLOAT32_IEEE 0 autosar_swc_vmp_CM_single 0.000000 5.000000
 /begin AXIS_DESCR COM_AXIS NO_INPUT_QUANTITY autosar_swc_vmp_CM_single 5 0.000000 20.000000 AXIS_PTS_REF P_LONP_FollowWdCoefXAxis /end AXIS_DESCR
/end CHARACTERISTIC
/begin CHARACTERISTIC P_LONP_FollowWvCoefYAxis "" CURVE 0xfe829d14 /* @ECU_Address@P_LONP_FollowWvCoefYAxis@ */ Record_FLOAT32_IEEE 0 autosar_swc_vmp_CM_single 0.000000 20.000000
 /begin AXIS_DESCR COM_AXIS NO_INPUT_QUANTITY autosar_swc_vmp_CM_single 7 -20.000000 20.000000 AXIS_PTS_REF P_LONP_FollowWvCoefXAxis /end AXIS_DESCR
/end CHARACTERISTIC
/begin CHARACTERISTIC P_LONP_FollowaccelFollowDesThresEnableStopYAxis "" CURVE 0xfe8290d8 /* @ECU_Address@P_LONP_FollowaccelFollowDesThresEnableStopYAxis@ */ Record_FLOAT32_IEEE 0 autosar_swc_vmp_CM_single_m_per_s_2 0.000000 1.000000
 /begin AXIS_DESCR COM_AXIS NO_INPUT_QUANTITY autosar_swc_vmp_CM_single_m 2 0.000000 5.500000 AXIS_PTS_REF P_LONP_FollowaccelFollowDesThresEnableStopXAxis /end AXIS_DESCR
/end CHARACTERISTIC
/begin CHARACTERISTIC P_LONP_FollowaccelForceStopMinCharYAxis "" CURVE 0xfe8290e8 /* @ECU_Address@P_LONP_FollowaccelForceStopMinCharYAxis@ */ Record_FLOAT32_IEEE 0 autosar_swc_vmp_CM_single_m_per_s_2 -6.000000 -2.000000
 /begin AXIS_DESCR COM_AXIS NO_INPUT_QUANTITY autosar_swc_vmp_CM_single_m_per_s_2 2 0.000000 5.000000 AXIS_PTS_REF P_LONP_FollowaccelForceStopMinCharXAxis /end AXIS_DESCR
/end CHARACTERISTIC
/begin CHARACTERISTIC P_LONP_FollowaccelStopMax "" VALUE 0xfe8292c0 /* @ECU_Address@P_LONP_FollowaccelStopMax@ */ Record_FLOAT32_IEEE 0 autosar_swc_vmp_CM_single_m_per_s_2 -1.000000 0.000000 /end CHARACTERISTIC
/begin CHARACTERISTIC P_LONP_FollowaccelTargAbsEnableNegJerk "" VALUE 0xfe8292c4 /* @ECU_Address@P_LONP_FollowaccelTargAbsEnableNegJerk@ */ Record_FLOAT32_IEEE 0 autosar_swc_vmp_CM_single_m_per_s_3 -10.000000 0.000000 /end CHARACTERISTIC
/begin CHARACTERISTIC P_LONP_FollowaccelTargAbsEnableNegMax "" VALUE 0xfe8292c8 /* @ECU_Address@P_LONP_FollowaccelTargAbsEnableNegMax@ */ Record_FLOAT32_IEEE 0 autosar_swc_vmp_CM_single_m_per_s_2 -1.000000 3.000000 /end CHARACTERISTIC
/begin CHARACTERISTIC P_LONP_FollowaccelTargAbsEnablePosJerk "" VALUE 0xfe8292cc /* @ECU_Address@P_LONP_FollowaccelTargAbsEnablePosJerk@ */ Record_FLOAT32_IEEE 0 autosar_swc_vmp_CM_single_m_per_s_3 0.000000 10.000000 /end CHARACTERISTIC
/begin CHARACTERISTIC P_LONP_FollowaccelTargAbsEnableRangeMax "" VALUE 0xfe8292d0 /* @ECU_Address@P_LONP_FollowaccelTargAbsEnableRangeMax@ */ Record_FLOAT32_IEEE 0 autosar_swc_vmp_CM_single_m_per_s_2 -2.000000 2.000000 /end CHARACTERISTIC
/begin CHARACTERISTIC P_LONP_FollowaccelTargAbsExitNegMin "" VALUE 0xfe8292d4 /* @ECU_Address@P_LONP_FollowaccelTargAbsExitNegMin@ */ Record_FLOAT32_IEEE 0 autosar_swc_vmp_CM_single_m_per_s_2 -3.000000 0.000000 /end CHARACTERISTIC
/begin CHARACTERISTIC P_LONP_FollowaccelTargThresEnableStop "" VALUE 0xfe8292d8 /* @ECU_Address@P_LONP_FollowaccelTargThresEnableStop@ */ Record_FLOAT32_IEEE 0 autosar_swc_vmp_CM_single_m_per_s_2 0.000000 2.000000 /end CHARACTERISTIC
/begin CHARACTERISTIC P_LONP_FollowaccelTargThresForceStop "" VALUE 0xfe8292dc /* @ECU_Address@P_LONP_FollowaccelTargThresForceStop@ */ Record_FLOAT32_IEEE 0 autosar_swc_vmp_CM_single_m_per_s_2 0.000000 1.000000 /end CHARACTERISTIC
/begin CHARACTERISTIC P_LONP_FollowaccelThresActiveTOR "" VALUE 0xfe8292e0 /* @ECU_Address@P_LONP_FollowaccelThresActiveTOR@ */ Record_FLOAT32_IEEE 0 autosar_swc_vmp_CM_single_m_per_s_2 -10.000000 0.000000 /end CHARACTERISTIC
/begin CHARACTERISTIC P_LONP_FollowaccelThresActiveTORHazerdObj "" VALUE 0xfe8292e4 /* @ECU_Address@P_LONP_FollowaccelThresActiveTORHazerdObj@ */ Record_FLOAT32_IEEE 0 autosar_swc_vmp_CM_single -3.4E+38 3.4E+38 /end CHARACTERISTIC
/begin CHARACTERISTIC P_LONP_FollowcoefAccelFadeOutPlauCheck "" VALUE 0xfe8292e8 /* @ECU_Address@P_LONP_FollowcoefAccelFadeOutPlauCheck@ */ Record_FLOAT32_IEEE 0 autosar_swc_vmp_CM_single 0.000000 1.000000 /end CHARACTERISTIC
/begin CHARACTERISTIC P_LONP_FollowcoefAccelStandstillOverride "" VALUE 0xfe8292ec /* @ECU_Address@P_LONP_FollowcoefAccelStandstillOverride@ */ Record_FLOAT32_IEEE 0 autosar_swc_vmp_CM_single 1.000000 5.000000 /end CHARACTERISTIC
/begin CHARACTERISTIC P_LONP_FollowcoefDistEnlargeDecToStop "" VALUE 0xfe8292f0 /* @ECU_Address@P_LONP_FollowcoefDistEnlargeDecToStop@ */ Record_FLOAT32_IEEE 0 autosar_swc_vmp_CM_single 1.000000 20.000000 /end CHARACTERISTIC
/begin CHARACTERISTIC P_LONP_FollowcoefDistRelThresActiveTOR "" VALUE 0xfe8292f4 /* @ECU_Address@P_LONP_FollowcoefDistRelThresActiveTOR@ */ Record_FLOAT32_IEEE 0 autosar_swc_vmp_CM_single 0.000000 2.000000 /end CHARACTERISTIC
/begin CHARACTERISTIC P_LONP_FollowcoefVelEnlargeDecToStop "" VALUE 0xfe8292f8 /* @ECU_Address@P_LONP_FollowcoefVelEnlargeDecToStop@ */ Record_FLOAT32_IEEE 0 autosar_swc_vmp_CM_single 1.000000 20.000000 /end CHARACTERISTIC
/begin CHARACTERISTIC P_LONP_FollowdecelJerkCharYAxis "" CURVE 0xfe82960c /* @ECU_Address@P_LONP_FollowdecelJerkCharYAxis@ */ Record_FLOAT32_IEEE 0 autosar_swc_vmp_CM_single_m_per_s_3 -10.000000 0.000000
 /begin AXIS_DESCR COM_AXIS NO_INPUT_QUANTITY autosar_swc_vmp_CM_single_s 6 0.000000 20.000000 AXIS_PTS_REF P_LONP_FollowdecelJerkCharXAxis /end AXIS_DESCR
/end CHARACTERISTIC
/begin CHARACTERISTIC P_LONP_FollowdistDesCompensionYAxis "" CURVE 0xfe8290f8 /* @ECU_Address@P_LONP_FollowdistDesCompensionYAxis@ */ Record_FLOAT32_IEEE 0 autosar_swc_vmp_CM_single_m 0.000000 50.000000
 /begin AXIS_DESCR COM_AXIS autosar_swc_vmp_rtARID_DEF.TmpSignalConversionAtvxvRefMsOutport1 autosar_swc_vmp_CM_single_m_per_s 2 0.000000 70.000000 AXIS_PTS_REF P_LONP_FollowdistDesCompensionXAxis /end AXIS_DESCR
/end CHARACTERISTIC
/begin CHARACTERISTIC P_LONP_FollowdistDesStopMin "" VALUE 0xfe8292fc /* @ECU_Address@P_LONP_FollowdistDesStopMin@ */ Record_FLOAT32_IEEE 0 autosar_swc_vmp_CM_single_m 1.500000 5.500000 /end CHARACTERISTIC
/begin CHARACTERISTIC P_LONP_FollowdistDesYAxis "" MAP 0xfe82a1d8 /* @ECU_Address@P_LONP_FollowdistDesYAxis@ */ Record_FLOAT32_IEEE 0 autosar_swc_vmp_CM_single 2.000000 150.000000
 /begin AXIS_DESCR COM_AXIS autosar_swc_vmp_rtARID_DEF.TmpSignalConversionAtCSM_CTRLOutport1 autosar_swc_vmp_CM_single_m_per_s 10 0.000000 70.000000 AXIS_PTS_REF P_LONP_FollowdistDesX2Axis /end AXIS_DESCR
 /begin AXIS_DESCR COM_AXIS autosar_swc_vmp_rtARID_DEF.TmpSignalConversionAtCSM_CTRLOutport1 autosar_swc_vmp_CM_single 10 -3.4E+38 3.4E+38 AXIS_PTS_REF P_LONP_FollowdistDesTimegapLevel /end AXIS_DESCR
/end CHARACTERISTIC
/begin CHARACTERISTIC P_LONP_FollowdistRelDevCalcDistConst "" VALUE 0xfe829300 /* @ECU_Address@P_LONP_FollowdistRelDevCalcDistConst@ */ Record_FLOAT32_IEEE 0 autosar_swc_vmp_CM_single_m 0.000000 10.000000 /end CHARACTERISTIC
/begin CHARACTERISTIC P_LONP_FollowdistRelMaxJudgeStationaryTarget "" VALUE 0xfe829304 /* @ECU_Address@P_LONP_FollowdistRelMaxJudgeStationaryTarget@ */ Record_FLOAT32_IEEE 0 autosar_swc_vmp_CM_single_m 0.000000 10.000000 /end CHARACTERISTIC
/begin CHARACTERISTIC P_LONP_FollowdistRelThresEnablePlauCheck "" VALUE 0xfe829308 /* @ECU_Address@P_LONP_FollowdistRelThresEnablePlauCheck@ */ Record_FLOAT32_IEEE 0 autosar_swc_vmp_CM_single_m 0.000000 20.000000 /end CHARACTERISTIC
/begin CHARACTERISTIC P_LONP_FollowdistTargRelEnableAccelTargAbsThres "" VALUE 0xfe82930c /* @ECU_Address@P_LONP_FollowdistTargRelEnableAccelTargAbsThres@ */ Record_FLOAT32_IEEE 0 autosar_swc_vmp_CM_single_m 0.000000 50.000000 /end CHARACTERISTIC
/begin CHARACTERISTIC P_LONP_FollowdistThresEnableStop "" VALUE 0xfe829310 /* @ECU_Address@P_LONP_FollowdistThresEnableStop@ */ Record_FLOAT32_IEEE 0 autosar_swc_vmp_CM_single_m 1.000000 10.000000 /end CHARACTERISTIC
/begin CHARACTERISTIC P_LONP_FollowgapThresActiveTOR "" VALUE 0xfe829314 /* @ECU_Address@P_LONP_FollowgapThresActiveTOR@ */ Record_FLOAT32_IEEE 0 autosar_swc_vmp_CM_single_s 0.000000 10.000000 /end CHARACTERISTIC
/begin CHARACTERISTIC P_LONP_FollowjerkForceStopCharYAxis "" CURVE 0xfe829d3c /* @ECU_Address@P_LONP_FollowjerkForceStopCharYAxis@ */ Record_FLOAT32_IEEE 0 autosar_swc_vmp_CM_single_m_per_s_3 -5.000000 0.000000
 /begin AXIS_DESCR COM_AXIS NO_INPUT_QUANTITY autosar_swc_vmp_CM_single_m_per_s_2 3 0.000000 4.000000 AXIS_PTS_REF P_LONP_FollowjerkForceStopCharXAxis /end AXIS_DESCR
/end CHARACTERISTIC
/begin CHARACTERISTIC P_LONP_FollowtStartUpAssistEnableMax "" VALUE 0xfe829318 /* @ECU_Address@P_LONP_FollowtStartUpAssistEnableMax@ */ Record_FLOAT32_IEEE 0 autosar_swc_vmp_CM_single 0.000000 60.000000 /end CHARACTERISTIC
/begin CHARACTERISTIC P_LONP_FollowttcCorrDecelJerkYAxis "" CURVE 0xfe829d64 /* @ECU_Address@P_LONP_FollowttcCorrDecelJerkYAxis@ */ Record_FLOAT32_IEEE 0 autosar_swc_vmp_CM_single 0.000000 5.000000
 /begin AXIS_DESCR COM_AXIS NO_INPUT_QUANTITY autosar_swc_vmp_CM_single_s 7 0.000000 200.000000 AXIS_PTS_REF P_LONP_FollowttcCorrDecelJerkXAxis /end AXIS_DESCR
/end CHARACTERISTIC
/begin CHARACTERISTIC P_LONP_FollowvelRelThresEnablePlauCheck "" VALUE 0xfe82931c /* @ECU_Address@P_LONP_FollowvelRelThresEnablePlauCheck@ */ Record_FLOAT32_IEEE 0 autosar_swc_vmp_CM_single_m_per_s -5.000000 1.000000 /end CHARACTERISTIC
/begin CHARACTERISTIC P_LONP_FollowvelSubjMaxEnablePlauCheck "" VALUE 0xfe829320 /* @ECU_Address@P_LONP_FollowvelSubjMaxEnablePlauCheck@ */ Record_FLOAT32_IEEE 0 autosar_swc_vmp_CM_single_m_per_s 0.000000 20.000000 /end CHARACTERISTIC
/begin CHARACTERISTIC P_LONP_FollowvelSubjThresEnablePlauCheck "" VALUE 0xfe829324 /* @ECU_Address@P_LONP_FollowvelSubjThresEnablePlauCheck@ */ Record_FLOAT32_IEEE 0 autosar_swc_vmp_CM_single_m_per_s 0.000000 5.000000 /end CHARACTERISTIC
/begin CHARACTERISTIC P_LONP_FollowvelSubjThresEnableStop "" VALUE 0xfe829328 /* @ECU_Address@P_LONP_FollowvelSubjThresEnableStop@ */ Record_FLOAT32_IEEE 0 autosar_swc_vmp_CM_single_m_per_s 0.200000 2.000000 /end CHARACTERISTIC
/begin CHARACTERISTIC P_LONP_FollowvelSubjThresEnableStopAddYAxis "" CURVE 0xfe829108 /* @ECU_Address@P_LONP_FollowvelSubjThresEnableStopAddYAxis@ */ Record_FLOAT32_IEEE 0 autosar_swc_vmp_CM_single_m_per_s 0.000000 3.000000
 /begin AXIS_DESCR COM_AXIS NO_INPUT_QUANTITY autosar_swc_vmp_CM_single_m 2 0.000000 3.500000 AXIS_PTS_REF P_LONP_FollowvelSubjThresEnableStopAddXAxis /end AXIS_DESCR
/end CHARACTERISTIC
/begin CHARACTERISTIC P_LONP_FollowvelTarAbsThresForceStop "" VALUE 0xfe82932c /* @ECU_Address@P_LONP_FollowvelTarAbsThresForceStop@ */ Record_FLOAT32_IEEE 0 autosar_swc_vmp_CM_single_m_per_s 0.100000 1.000000 /end CHARACTERISTIC
/begin CHARACTERISTIC P_LONP_FollowvelTargAbsMaxJudgeStationaryTarget "" VALUE 0xfe829330 /* @ECU_Address@P_LONP_FollowvelTargAbsMaxJudgeStationaryTarget@ */ Record_FLOAT32_IEEE 0 autosar_swc_vmp_CM_single_m_per_s 0.000000 1.000000 /end CHARACTERISTIC
/begin CHARACTERISTIC P_LONP_FollowvelTargRelThresActiveTOR "" VALUE 0xfe829334 /* @ECU_Address@P_LONP_FollowvelTargRelThresActiveTOR@ */ Record_FLOAT32_IEEE 0 autosar_swc_vmp_CM_single_m_per_s -5.000000 0.000000 /end CHARACTERISTIC
/begin CHARACTERISTIC P_LONP_FollowvelTargRelThresActiveTORHazerdObj "" VALUE 0xfe829338 /* @ECU_Address@P_LONP_FollowvelTargRelThresActiveTORHazerdObj@ */ Record_FLOAT32_IEEE 0 autosar_swc_vmp_CM_single -3.4E+38 3.4E+38 /end CHARACTERISTIC
/begin CHARACTERISTIC P_LONP_ICCurvatureLimitSpdYAxis "" CURVE 0xfe829dbc /* @ECU_Address@P_LONP_ICCurvatureLimitSpdYAxis@ */ Record_FLOAT32_IEEE 0 autosar_swc_vmp_CM_single_km_per_h 0.000000 150.000000
 /begin AXIS_DESCR COM_AXIS NO_INPUT_QUANTITY autosar_swc_vmp_CM_single 15 0.000000 1.000000 AXIS_PTS_REF P_LONP_ICCurvatureLimitSpdXAxis /end AXIS_DESCR
/end CHARACTERISTIC
/begin CHARACTERISTIC P_LONP_ICCurveDecelEnable "" VALUE 0xfe82950e /* @ECU_Address@P_LONP_ICCurveDecelEnable@ */ Record_BOOLEAN 0 autosar_swc_vmp_CM_boolean 0.000000 1.000000 /end CHARACTERISTIC
/begin CHARACTERISTIC P_LONP_ICKapLimitAccelYAxis "" CURVE 0xfe8296ec /* @ECU_Address@P_LONP_ICKapLimitAccelYAxis@ */ Record_FLOAT32_IEEE 0 autosar_swc_vmp_CM_single 0.000000 16.000000
 /begin AXIS_DESCR COM_AXIS NO_INPUT_QUANTITY autosar_swc_vmp_CM_single 10 0.000000 1.000000 AXIS_PTS_REF P_LONP_ICKapLimitAccelXAxis /end AXIS_DESCR
/end CHARACTERISTIC
/begin CHARACTERISTIC P_LONP_ICKapLimitSpdYAxis "" CURVE 0xfe829e34 /* @ECU_Address@P_LONP_ICKapLimitSpdYAxis@ */ Record_FLOAT32_IEEE 0 autosar_swc_vmp_CM_single 0.000000 150.000000
 /begin AXIS_DESCR COM_AXIS NO_INPUT_QUANTITY autosar_swc_vmp_CM_single 15 0.000000 1.000000 AXIS_PTS_REF P_LONP_ICKapLimitSpdXAxis /end AXIS_DESCR
/end CHARACTERISTIC
/begin CHARACTERISTIC P_LONP_ICKapUpperJerkMin "" VALUE 0xfe82933c /* @ECU_Address@P_LONP_ICKapUpperJerkMin@ */ Record_FLOAT32_IEEE 0 autosar_swc_vmp_CM_single -3.4E+38 3.4E+38 /end CHARACTERISTIC
/begin CHARACTERISTIC P_LONP_ICLineLengthCheck "" VALUE 0xfe829340 /* @ECU_Address@P_LONP_ICLineLengthCheck@ */ Record_FLOAT32_IEEE 0 autosar_swc_vmp_CM_single -3.4E+38 3.4E+38 /end CHARACTERISTIC
/begin CHARACTERISTIC P_LONP_ICUpperJerkNegVLCInternalAcc "" VALUE 0xfe829344 /* @ECU_Address@P_LONP_ICUpperJerkNegVLCInternalAcc@ */ Record_FLOAT32_IEEE 0 autosar_swc_vmp_CM_single_m_per_s_3 0.000000 10.000000 /end CHARACTERISTIC
/begin CHARACTERISTIC P_LONP_IC_HDMapAccelLimitYAxis "" CURVE 0xfe829118 /* @ECU_Address@P_LONP_IC_HDMapAccelLimitYAxis@ */ Record_FLOAT32_IEEE 0 autosar_swc_vmp_CM_single -3.4E+38 3.4E+38
 /begin AXIS_DESCR COM_AXIS NO_INPUT_QUANTITY autosar_swc_vmp_CM_single 2 -3.4E+38 3.4E+38 AXIS_PTS_REF P_LONP_IC_HDMapAccelLimitXAxis /end AXIS_DESCR
/end CHARACTERISTIC
/begin CHARACTERISTIC P_LONP_IC_HDMap_AccelICEnterThrd "m/s^2" VALUE 0xfe829348 /* @ECU_Address@P_LONP_IC_HDMap_AccelICEnterThrd@ */ Record_FLOAT32_IEEE 0 autosar_swc_vmp_CM_single -16.000000 16.000000 /end CHARACTERISTIC
/begin CHARACTERISTIC P_LONP_IC_HDMap_AccelICExitThrd "m/s^2" VALUE 0xfe82934c /* @ECU_Address@P_LONP_IC_HDMap_AccelICExitThrd@ */ Record_FLOAT32_IEEE 0 autosar_swc_vmp_CM_single -16.000000 16.000000 /end CHARACTERISTIC
/begin CHARACTERISTIC P_LONP_IC_HDMap_EHRV2Enable "" VALUE 0xfe82950f /* @ECU_Address@P_LONP_IC_HDMap_EHRV2Enable@ */ Record_BOOLEAN 0 autosar_swc_vmp_CM_boolean 0.000000 1.000000 /end CHARACTERISTIC
/begin CHARACTERISTIC P_LONP_IC_HDMap_PreviewDistLowerbandMax "" VALUE 0xfe829350 /* @ECU_Address@P_LONP_IC_HDMap_PreviewDistLowerbandMax@ */ Record_FLOAT32_IEEE 0 autosar_swc_vmp_CM_single -3.4E+38 3.4E+38 /end CHARACTERISTIC
/begin CHARACTERISTIC P_LONP_IC_HDMap_PreviewDistLowerbandMin "" VALUE 0xfe829354 /* @ECU_Address@P_LONP_IC_HDMap_PreviewDistLowerbandMin@ */ Record_FLOAT32_IEEE 0 autosar_swc_vmp_CM_single -3.4E+38 3.4E+38 /end CHARACTERISTIC
/begin CHARACTERISTIC P_LONP_IC_HDMap_PreviewDistUpperbandMax "" VALUE 0xfe829358 /* @ECU_Address@P_LONP_IC_HDMap_PreviewDistUpperbandMax@ */ Record_FLOAT32_IEEE 0 autosar_swc_vmp_CM_single -3.4E+38 3.4E+38 /end CHARACTERISTIC
/begin CHARACTERISTIC P_LONP_IC_HDMap_PreviewDistUpperbandMin "" VALUE 0xfe82935c /* @ECU_Address@P_LONP_IC_HDMap_PreviewDistUpperbandMin@ */ Record_FLOAT32_IEEE 0 autosar_swc_vmp_CM_single -3.4E+38 3.4E+38 /end CHARACTERISTIC
/begin CHARACTERISTIC P_LONP_IC_HDMap_PreviewTimeLowerband "" VALUE 0xfe829360 /* @ECU_Address@P_LONP_IC_HDMap_PreviewTimeLowerband@ */ Record_FLOAT32_IEEE 0 autosar_swc_vmp_CM_single -3.4E+38 3.4E+38 /end CHARACTERISTIC
/begin CHARACTERISTIC P_LONP_IC_HDMap_PreviewTimeUpperband "" VALUE 0xfe829364 /* @ECU_Address@P_LONP_IC_HDMap_PreviewTimeUpperband@ */ Record_FLOAT32_IEEE 0 autosar_swc_vmp_CM_single -3.4E+38 3.4E+38 /end CHARACTERISTIC
/begin CHARACTERISTIC P_LONP_ICaccelCurvDistEnable "" VALUE 0xfe829510 /* @ECU_Address@P_LONP_ICaccelCurvDistEnable@ */ Record_BOOLEAN 0 autosar_swc_vmp_CM_boolean 0 1 /end CHARACTERISTIC
/begin CHARACTERISTIC P_LONP_ICaccelThresEnableLine "" VALUE 0xfe829368 /* @ECU_Address@P_LONP_ICaccelThresEnableLine@ */ Record_FLOAT32_IEEE 0 autosar_swc_vmp_CM_single_m_per_s_2 -2.000000 1.000000 /end CHARACTERISTIC
/begin CHARACTERISTIC P_LONP_ICcoefCurvatureCharY "" MAP 0xfe829734 /* @ECU_Address@P_LONP_ICcoefCurvatureCharY@ */ Record_FLOAT32_IEEE 0 autosar_swc_vmp_CM_single 0.000000 1.000000
 /begin AXIS_DESCR COM_AXIS NO_INPUT_QUANTITY autosar_swc_vmp_CM_single_1_per_m 4 0.000000 1.000000 AXIS_PTS_REF P_LONP_ICcoefCurvatureCharX2 /end AXIS_DESCR
 /begin AXIS_DESCR COM_AXIS NO_INPUT_QUANTITY autosar_swc_vmp_CM_single_1_per_m 4 0.000000 1.000000 AXIS_PTS_REF P_LONP_ICcoefCurvatureCharX1 /end AXIS_DESCR
/end CHARACTERISTIC
/begin CHARACTERISTIC P_LONP_ICdeltaAccelLowerBand "" VALUE 0xfe82936c /* @ECU_Address@P_LONP_ICdeltaAccelLowerBand@ */ Record_FLOAT32_IEEE 0 autosar_swc_vmp_CM_single_m_per_s_2 0.000000 0.500000 /end CHARACTERISTIC
/begin CHARACTERISTIC P_LONP_ICdeltaAccelUpperBand "" VALUE 0xfe829370 /* @ECU_Address@P_LONP_ICdeltaAccelUpperBand@ */ Record_FLOAT32_IEEE 0 autosar_swc_vmp_CM_single_m_per_s_2 0.000000 0.500000 /end CHARACTERISTIC
/begin CHARACTERISTIC P_LONP_IClowerJerkICCharYAxis "" CURVE 0xfe829e7c /* @ECU_Address@P_LONP_IClowerJerkICCharYAxis@ */ Record_FLOAT32_IEEE 0 autosar_swc_vmp_CM_single_m_per_s_3 -5.000000 0.000000
 /begin AXIS_DESCR COM_AXIS NO_INPUT_QUANTITY autosar_swc_vmp_CM_single_m_per_s_2 3 -5.000000 2.000000 AXIS_PTS_REF P_LONP_IClowerJerkICCharXAxis /end AXIS_DESCR
/end CHARACTERISTIC
/begin CHARACTERISTIC P_LONP_IClowerJerkPosVLCInternalAccMax "" VALUE 0xfe829374 /* @ECU_Address@P_LONP_IClowerJerkPosVLCInternalAccMax@ */ Record_FLOAT32_IEEE 0 autosar_swc_vmp_CM_single_m_per_s_3 -5.000000 0.000000 /end CHARACTERISTIC
/begin CHARACTERISTIC P_LONP_IClowerJerkPosVLCInternalAccMin "" VALUE 0xfe829378 /* @ECU_Address@P_LONP_IClowerJerkPosVLCInternalAccMin@ */ Record_FLOAT32_IEEE 0 autosar_swc_vmp_CM_single_m_per_s_3 -5.000000 0.000000 /end CHARACTERISTIC
/begin CHARACTERISTIC P_LONP_ICtDecel "" VALUE 0xfe82937c /* @ECU_Address@P_LONP_ICtDecel@ */ Record_FLOAT32_IEEE 0 autosar_swc_vmp_CM_single_s 2.000000 10.000000 /end CHARACTERISTIC
/begin CHARACTERISTIC P_LONP_ICupperJerkICCharYAxis "" CURVE 0xfe829784 /* @ECU_Address@P_LONP_ICupperJerkICCharYAxis@ */ Record_FLOAT32_IEEE 0 autosar_swc_vmp_CM_single_m_per_s_3 0.000000 3.000000
 /begin AXIS_DESCR COM_AXIS NO_INPUT_QUANTITY autosar_swc_vmp_CM_single_m_per_s_2 4 -2.000000 2.000000 AXIS_PTS_REF P_LONP_ICupperJerkICCharXAxis /end AXIS_DESCR
/end CHARACTERISTIC
/begin CHARACTERISTIC P_LONP_IICAcceMinLimitValue "" VALUE 0xfe829380 /* @ECU_Address@P_LONP_IICAcceMinLimitValue@ */ Record_FLOAT32_IEEE 0 autosar_swc_vmp_CM_single -3.4E+38 3.4E+38 /end CHARACTERISTIC
/begin CHARACTERISTIC P_LONP_KapTarLineCoef "" VALUE 0xfe829384 /* @ECU_Address@P_LONP_KapTarLineCoef@ */ Record_FLOAT32_IEEE 0 autosar_swc_vmp_CM_single -3.4E+38 3.4E+38 /end CHARACTERISTIC
/begin CHARACTERISTIC P_LONP_KeepLaneSurDis "" VALUE 0xfe829388 /* @ECU_Address@P_LONP_KeepLaneSurDis@ */ Record_FLOAT32_IEEE 0 autosar_swc_vmp_CM_single_m 0.000000 100.000000 /end CHARACTERISTIC
/begin CHARACTERISTIC P_LONP_KeepLaneTime "" VALUE 0xfe82938c /* @ECU_Address@P_LONP_KeepLaneTime@ */ Record_FLOAT32_IEEE 0 autosar_swc_vmp_CM_single_s 0.000000 5.000000 /end CHARACTERISTIC
/begin CHARACTERISTIC P_LONP_LaneAvailDis "" VALUE 0xfe829390 /* @ECU_Address@P_LONP_LaneAvailDis@ */ Record_FLOAT32_IEEE 0 autosar_swc_vmp_CM_single 0.000000 100.000000 /end CHARACTERISTIC
/begin CHARACTERISTIC P_LONP_LaneAvailStd "" VALUE 0xfe829394 /* @ECU_Address@P_LONP_LaneAvailStd@ */ Record_FLOAT32_IEEE 0 autosar_swc_vmp_CM_single 0.000000 1.000000 /end CHARACTERISTIC
/begin CHARACTERISTIC P_LONP_LaneAvailStdAverage "" VALUE 0xfe829398 /* @ECU_Address@P_LONP_LaneAvailStdAverage@ */ Record_FLOAT32_IEEE 0 autosar_swc_vmp_CM_single 0.000000 1.000000 /end CHARACTERISTIC
/begin CHARACTERISTIC P_LONP_LaneAvailStdMax "" VALUE 0xfe82939c /* @ECU_Address@P_LONP_LaneAvailStdMax@ */ Record_FLOAT32_IEEE 0 autosar_swc_vmp_CM_single 0.000000 1.000000 /end CHARACTERISTIC
/begin CHARACTERISTIC P_LONP_LaneAvailTime "" VALUE 0xfe8293a0 /* @ECU_Address@P_LONP_LaneAvailTime@ */ Record_FLOAT32_IEEE 0 autosar_swc_vmp_CM_single 0.000000 10.000000 /end CHARACTERISTIC
/begin CHARACTERISTIC P_LONP_MaxAveAForSpdPlan "" VALUE 0xfe8293a4 /* @ECU_Address@P_LONP_MaxAveAForSpdPlan@ */ Record_FLOAT32_IEEE 0 autosar_swc_vmp_CM_single -3.4E+38 3.4E+38 /end CHARACTERISTIC
/begin CHARACTERISTIC P_LONP_MaxAveVForSpdPlan "" VALUE 0xfe8293a8 /* @ECU_Address@P_LONP_MaxAveVForSpdPlan@ */ Record_FLOAT32_IEEE 0 autosar_swc_vmp_CM_single -3.4E+38 3.4E+38 /end CHARACTERISTIC
/begin CHARACTERISTIC P_LONP_MinKapReqVehValue "" VALUE 0xfe8293ac /* @ECU_Address@P_LONP_MinKapReqVehValue@ */ Record_FLOAT32_IEEE 0 autosar_swc_vmp_CM_single -3.4E+38 3.4E+38 /end CHARACTERISTIC
/begin CHARACTERISTIC P_LONP_MiniAveAForSpdPlan "" VALUE 0xfe8293b0 /* @ECU_Address@P_LONP_MiniAveAForSpdPlan@ */ Record_FLOAT32_IEEE 0 autosar_swc_vmp_CM_single -3.4E+38 3.4E+38 /end CHARACTERISTIC
/begin CHARACTERISTIC P_LONP_MiniAveVForSpdPlan "" VALUE 0xfe8293b4 /* @ECU_Address@P_LONP_MiniAveVForSpdPlan@ */ Record_FLOAT32_IEEE 0 autosar_swc_vmp_CM_single -3.4E+38 3.4E+38 /end CHARACTERISTIC
/begin CHARACTERISTIC P_LONP_NewDvAFolFac "" VAL_BLK 0xfe829e88 /* @ECU_Address@P_LONP_NewDvAFolFac@ */ Record_FLOAT32_IEEE 0 autosar_swc_vmp_CM_single -3.4E+38 3.4E+38 MATRIX_DIM 3 1 /end CHARACTERISTIC
/begin CHARACTERISTIC P_LONP_NewDvDfdXpt "" VAL_BLK 0xfe829120 /* @ECU_Address@P_LONP_NewDvDfdXpt@ */ Record_FLOAT32_IEEE 0 autosar_swc_vmp_CM_single -3.4E+38 3.4E+38 MATRIX_DIM 2 1 /end CHARACTERISTIC
/begin CHARACTERISTIC P_LONP_NewDvDfdYpt "" VAL_BLK 0xfe829128 /* @ECU_Address@P_LONP_NewDvDfdYpt@ */ Record_FLOAT32_IEEE 0 autosar_swc_vmp_CM_single -3.4E+38 3.4E+38 MATRIX_DIM 2 1 /end CHARACTERISTIC
/begin CHARACTERISTIC P_LONP_NewDvDfiXpt "" VAL_BLK 0xfe829130 /* @ECU_Address@P_LONP_NewDvDfiXpt@ */ Record_FLOAT32_IEEE 0 autosar_swc_vmp_CM_single -3.4E+38 3.4E+38 MATRIX_DIM 2 1 /end CHARACTERISTIC
/begin CHARACTERISTIC P_LONP_NewDvDfiYpt "" VAL_BLK 0xfe829138 /* @ECU_Address@P_LONP_NewDvDfiYpt@ */ Record_FLOAT32_IEEE 0 autosar_swc_vmp_CM_single -3.4E+38 3.4E+38 MATRIX_DIM 2 1 /end CHARACTERISTIC
/begin CHARACTERISTIC P_LONP_NewDvDfpXpt "" VAL_BLK 0xfe829794 /* @ECU_Address@P_LONP_NewDvDfpXpt@ */ Record_FLOAT32_IEEE 0 autosar_swc_vmp_CM_single -3.4E+38 3.4E+38 MATRIX_DIM 8 1 /end CHARACTERISTIC
/begin CHARACTERISTIC P_LONP_NewDvDfpYpt "" VAL_BLK 0xfe8297b4 /* @ECU_Address@P_LONP_NewDvDfpYpt@ */ Record_FLOAT32_IEEE 0 autosar_swc_vmp_CM_single -3.4E+38 3.4E+38 MATRIX_DIM 8 1 /end CHARACTERISTIC
/begin CHARACTERISTIC P_LONP_NewDvFollowTime "" VAL_BLK 0xfe82a368 /* @ECU_Address@P_LONP_NewDvFollowTime@ */ Record_FLOAT64_IEEE 0 autosar_swc_vmp_CM_double -1.7E+308 1.7E+308 MATRIX_DIM 10 1 /end CHARACTERISTIC
/begin CHARACTERISTIC P_LONP_NewDvSafeDis "" VALUE 0xfe8293b8 /* @ECU_Address@P_LONP_NewDvSafeDis@ */ Record_FLOAT32_IEEE 0 autosar_swc_vmp_CM_single -3.4E+38 3.4E+38 /end CHARACTERISTIC
/begin CHARACTERISTIC P_LONP_NewDvVfdXpt "" VAL_BLK 0xfe829140 /* @ECU_Address@P_LONP_NewDvVfdXpt@ */ Record_FLOAT32_IEEE 0 autosar_swc_vmp_CM_single -3.4E+38 3.4E+38 MATRIX_DIM 2 1 /end CHARACTERISTIC
/begin CHARACTERISTIC P_LONP_NewDvVfdYpt "" VAL_BLK 0xfe829148 /* @ECU_Address@P_LONP_NewDvVfdYpt@ */ Record_FLOAT32_IEEE 0 autosar_swc_vmp_CM_single -3.4E+38 3.4E+38 MATRIX_DIM 2 1 /end CHARACTERISTIC
/begin CHARACTERISTIC P_LONP_NewDvVfiXpt "" VAL_BLK 0xfe829150 /* @ECU_Address@P_LONP_NewDvVfiXpt@ */ Record_FLOAT32_IEEE 0 autosar_swc_vmp_CM_single -3.4E+38 3.4E+38 MATRIX_DIM 2 1 /end CHARACTERISTIC
/begin CHARACTERISTIC P_LONP_NewDvVfiYpt "" VAL_BLK 0xfe829158 /* @ECU_Address@P_LONP_NewDvVfiYpt@ */ Record_FLOAT32_IEEE 0 autosar_swc_vmp_CM_single -3.4E+38 3.4E+38 MATRIX_DIM 2 1 /end CHARACTERISTIC
/begin CHARACTERISTIC P_LONP_NewDvVfpXpt "" VAL_BLK 0xfe829e94 /* @ECU_Address@P_LONP_NewDvVfpXpt@ */ Record_FLOAT32_IEEE 0 autosar_swc_vmp_CM_single -3.4E+38 3.4E+38 MATRIX_DIM 7 1 /end CHARACTERISTIC
/begin CHARACTERISTIC P_LONP_NewDvVfpYpt "" VAL_BLK 0xfe829eb0 /* @ECU_Address@P_LONP_NewDvVfpYpt@ */ Record_FLOAT32_IEEE 0 autosar_swc_vmp_CM_single -3.4E+38 3.4E+38 MATRIX_DIM 7 1 /end CHARACTERISTIC
/begin CHARACTERISTIC P_LONP_ORDAccelThrdSpdYAxis "" CURVE 0xfe829ee8 /* @ECU_Address@P_LONP_ORDAccelThrdSpdYAxis@ */ Record_FLOAT32_IEEE 0 autosar_swc_vmp_CM_single_m_per_s_2 -10.000000 10.000000
 /begin AXIS_DESCR COM_AXIS NO_INPUT_QUANTITY autosar_swc_vmp_CM_single_km_per_h 7 0.000000 200.000000 AXIS_PTS_REF P_LONP_ORDAccelThrdSpdXAxis /end AXIS_DESCR
/end CHARACTERISTIC
/begin CHARACTERISTIC P_LONP_ORDaccelDevLowerBand "" VALUE 0xfe8293bc /* @ECU_Address@P_LONP_ORDaccelDevLowerBand@ */ Record_FLOAT32_IEEE 0 autosar_swc_vmp_CM_single_m_per_s_2 0.000000 1.000000 /end CHARACTERISTIC
/begin CHARACTERISTIC P_LONP_ORDaccelDevUpperBand "" VALUE 0xfe8293c0 /* @ECU_Address@P_LONP_ORDaccelDevUpperBand@ */ Record_FLOAT32_IEEE 0 autosar_swc_vmp_CM_single_m_per_s_2 0.000000 1.000000 /end CHARACTERISTIC
/begin CHARACTERISTIC P_LONP_ORDdecelEnable "" VALUE 0xfe829511 /* @ECU_Address@P_LONP_ORDdecelEnable@ */ Record_BOOLEAN 0 autosar_swc_vmp_CM_boolean 0.000000 1.000000 /end CHARACTERISTIC
/begin CHARACTERISTIC P_LONP_ORDlowerJerk "m/s^3" VALUE 0xfe8293c4 /* @ECU_Address@P_LONP_ORDlowerJerk@ */ Record_FLOAT32_IEEE 0 autosar_swc_vmp_CM_single -5.000000 0.000000 /end CHARACTERISTIC
/begin CHARACTERISTIC P_LONP_ORDupperJerk "" VALUE 0xfe8293cc /* @ECU_Address@P_LONP_ORDupperJerk@ */ Record_FLOAT32_IEEE 0 autosar_swc_vmp_CM_single_m_per_s_3 0.000000 5.000000 /end CHARACTERISTIC
/begin CHARACTERISTIC P_LONP_ORDvelDeltaEnableThres "" VALUE 0xfe8293d0 /* @ECU_Address@P_LONP_ORDvelDeltaEnableThres@ */ Record_FLOAT32_IEEE 0 autosar_swc_vmp_CM_single_m_per_s 0.000000 3.000000 /end CHARACTERISTIC
/begin CHARACTERISTIC P_LONP_ObjVehVel "m/s" VALUE 0xfe8293d4 /* @ECU_Address@P_LONP_ObjVehVel@ */ Record_FLOAT32_IEEE 0 autosar_swc_vmp_CM_single -3.4E+38 3.4E+38 /end CHARACTERISTIC
/begin CHARACTERISTIC P_LONP_Overide2ActiveTimeCancelValue "" VALUE 0xfe8293d8 /* @ECU_Address@P_LONP_Overide2ActiveTimeCancelValue@ */ Record_FLOAT32_IEEE 0 autosar_swc_vmp_CM_single -3.4E+38 3.4E+38 /end CHARACTERISTIC
/begin CHARACTERISTIC P_LONP_Override2ActiveAccJerk "" CURVE 0xfe829f04 /* @ECU_Address@P_LONP_Override2ActiveAccJerk@ */ Record_FLOAT32_IEEE 0 autosar_swc_vmp_CM_single -3.4E+38 3.4E+38
 /begin AXIS_DESCR COM_AXIS autosar_swc_vmp_rtARID_DEF.Overide2ActiveTimeCnt autosar_swc_vmp_CM_single 11 -3.4E+38 3.4E+38 AXIS_PTS_REF P_LONP_Override2ActiveTimeCnt /end AXIS_DESCR
/end CHARACTERISTIC
/begin CHARACTERISTIC P_LONP_Override2ActiveDecelJerk "" CURVE 0xfe829f30 /* @ECU_Address@P_LONP_Override2ActiveDecelJerk@ */ Record_FLOAT32_IEEE 0 autosar_swc_vmp_CM_single -3.4E+38 3.4E+38
 /begin AXIS_DESCR COM_AXIS autosar_swc_vmp_rtARID_DEF.Overide2ActiveTimeCnt autosar_swc_vmp_CM_single 11 -3.4E+38 3.4E+38 AXIS_PTS_REF P_LONP_Override2ActiveTimeCnt /end AXIS_DESCR
/end CHARACTERISTIC
/begin CHARACTERISTIC P_LONP_P0axAbsFilterGain "" CURVE 0xfe829f88 /* @ECU_Address@P_LONP_P0axAbsFilterGain@ */ Record_FLOAT32_IEEE 0 autosar_swc_vmp_CM_single -3.4E+38 3.4E+38
 /begin AXIS_DESCR COM_AXIS NO_INPUT_QUANTITY autosar_swc_vmp_CM_single 5 -3.4E+38 3.4E+38 AXIS_PTS_REF P_LONP_P0axAbsValueforFilter /end AXIS_DESCR
/end CHARACTERISTIC
/begin CHARACTERISTIC P_LONP_P1ObjActiveEnable "" VALUE 0xfe829512 /* @ECU_Address@P_LONP_P1ObjActiveEnable@ */ Record_BOOLEAN 0 autosar_swc_vmp_CM_boolean 0 1 /end CHARACTERISTIC
/begin CHARACTERISTIC P_LONP_P1ObjSafeDist "m" VALUE 0xfe8293dc /* @ECU_Address@P_LONP_P1ObjSafeDist@ */ Record_FLOAT32_IEEE 0 autosar_swc_vmp_CM_single -3.4E+38 3.4E+38 /end CHARACTERISTIC
/begin CHARACTERISTIC P_LONP_P2DistDesCurOffSet "" VALUE 0xfe8293e0 /* @ECU_Address@P_LONP_P2DistDesCurOffSet@ */ Record_FLOAT32_IEEE 0 autosar_swc_vmp_CM_single -3.4E+38 3.4E+38 /end CHARACTERISTIC
/begin CHARACTERISTIC P_LONP_P3DistDesCurOffSet "" VALUE 0xfe8293e4 /* @ECU_Address@P_LONP_P3DistDesCurOffSet@ */ Record_FLOAT32_IEEE 0 autosar_swc_vmp_CM_single -3.4E+38 3.4E+38 /end CHARACTERISTIC
/begin CHARACTERISTIC P_LONP_PedestrianDistThrd "" VALUE 0xfe8293e8 /* @ECU_Address@P_LONP_PedestrianDistThrd@ */ Record_FLOAT32_IEEE 0 autosar_swc_vmp_CM_single -3.4E+38 3.4E+38 /end CHARACTERISTIC
/begin CHARACTERISTIC P_LONP_PreTime "s" VALUE 0xfe8293f0 /* @ECU_Address@P_LONP_PreTime@ */ Record_FLOAT32_IEEE 0 autosar_swc_vmp_CM_single -3.4E+38 3.4E+38 /end CHARACTERISTIC
/begin CHARACTERISTIC P_LONP_RangeThresValueSW "" VALUE 0xfe829513 /* @ECU_Address@P_LONP_RangeThresValueSW@ */ Record_BOOLEAN 0 autosar_swc_vmp_CM_boolean 0 1 /end CHARACTERISTIC
/begin CHARACTERISTIC P_LONP_SJVlcInternalAccThresEnableBrkPrefer "" VALUE 0xfe8293f4 /* @ECU_Address@P_LONP_SJVlcInternalAccThresEnableBrkPrefer@ */ Record_FLOAT32_IEEE 0 autosar_swc_vmp_CM_single_m_per_s_2 -1.000000 2.000000 /end CHARACTERISTIC
/begin CHARACTERISTIC P_LONP_SJaccelFollowThresEnableBrkPrefer "" VALUE 0xfe8293f8 /* @ECU_Address@P_LONP_SJaccelFollowThresEnableBrkPrefer@ */ Record_FLOAT32_IEEE 0 autosar_swc_vmp_CM_single_m_per_s_2 -3.000000 1.000000 /end CHARACTERISTIC
/begin CHARACTERISTIC P_LONP_SJaccelSubjPlanOptThresEnableBrkPrefer "" VALUE 0xfe8293fc /* @ECU_Address@P_LONP_SJaccelSubjPlanOptThresEnableBrkPrefer@ */ Record_FLOAT32_IEEE 0 autosar_swc_vmp_CM_single_m_per_s_2 -5.000000 0.000000 /end CHARACTERISTIC
/begin CHARACTERISTIC P_LONP_SJaccelSubjThresEnableBrkPrefer "" VALUE 0xfe829400 /* @ECU_Address@P_LONP_SJaccelSubjThresEnableBrkPrefer@ */ Record_FLOAT32_IEEE 0 autosar_swc_vmp_CM_single_m_per_s_2 -2.000000 1.000000 /end CHARACTERISTIC
/begin CHARACTERISTIC P_LONP_SJaxvRoadSlopeThresEnableBrkPrefer "" VALUE 0xfe829404 /* @ECU_Address@P_LONP_SJaxvRoadSlopeThresEnableBrkPrefer@ */ Record_FLOAT32_IEEE 0 autosar_swc_vmp_CM_single_m_per_s_2 -3.000000 4.000000 /end CHARACTERISTIC
/begin CHARACTERISTIC P_LONP_SJttcThresEnableBrkPrefer "" VALUE 0xfe82940c /* @ECU_Address@P_LONP_SJttcThresEnableBrkPrefer@ */ Record_FLOAT32_IEEE 0 autosar_swc_vmp_CM_single_s 0.000000 20.000000 /end CHARACTERISTIC
/begin CHARACTERISTIC P_LONP_SJvelSubjThresEnableBrkPrefer "" VALUE 0xfe829410 /* @ECU_Address@P_LONP_SJvelSubjThresEnableBrkPrefer@ */ Record_FLOAT32_IEEE 0 autosar_swc_vmp_CM_single_m_per_s 0.000000 30.000000 /end CHARACTERISTIC
/begin CHARACTERISTIC P_LONP_SSCaDtIsLaneChange "" VALUE 0xfe829414 /* @ECU_Address@P_LONP_SSCaDtIsLaneChange@ */ Record_FLOAT32_IEEE 0 autosar_swc_vmp_CM_single -3.4E+38 3.4E+38 /end CHARACTERISTIC
/begin CHARACTERISTIC P_LONP_SW2P1_P0HightThrd "" VALUE 0xfe829160 /* @ECU_Address@P_LONP_SW2P1_P0HightThrd@ */ Record_FLOAT64_IEEE 0 autosar_swc_vmp_CM_double -1.7E+308 1.7E+308 /end CHARACTERISTIC
/begin CHARACTERISTIC P_LONP_SetSpdAddCancelEnable "" VALUE 0xfe829514 /* @ECU_Address@P_LONP_SetSpdAddCancelEnable@ */ Record_BOOLEAN 0 autosar_swc_vmp_CM_boolean 0 1 /end CHARACTERISTIC
/begin CHARACTERISTIC P_LONP_SetSpdSlopLimDecStep_ratio "" VALUE 0xfe829418 /* @ECU_Address@P_LONP_SetSpdSlopLimDecStep_ratio@ */ Record_FLOAT32_IEEE 0 autosar_swc_vmp_CM_single -3.4E+38 3.4E+38 /end CHARACTERISTIC
/begin CHARACTERISTIC P_LONP_SetSpdSlopLimIncStep_ratio "" VALUE 0xfe82941c /* @ECU_Address@P_LONP_SetSpdSlopLimIncStep_ratio@ */ Record_FLOAT32_IEEE 0 autosar_swc_vmp_CM_single -3.4E+38 3.4E+38 /end CHARACTERISTIC
/begin CHARACTERISTIC P_LONP_SpdStopCtrlDistThrdYAxis "m" CURVE 0xfe829fb0 /* @ECU_Address@P_LONP_SpdStopCtrlDistThrdYAxis@ */ Record_FLOAT32_IEEE 0 autosar_swc_vmp_CM_single -3.4E+38 3.4E+38
 /begin AXIS_DESCR COM_AXIS NO_INPUT_QUANTITY autosar_swc_vmp_CM_single 11 -3.4E+38 3.4E+38 AXIS_PTS_REF P_LONP_SpdStopCtrlVehSpdXAxis /end AXIS_DESCR
/end CHARACTERISTIC
/begin CHARACTERISTIC P_LONP_StpPtOverAccelValue "m/s^2" VALUE 0xfe829424 /* @ECU_Address@P_LONP_StpPtOverAccelValue@ */ Record_FLOAT32_IEEE 0 autosar_swc_vmp_CM_single -3.4E+38 3.4E+38 /end CHARACTERISTIC
/begin CHARACTERISTIC P_LONP_TJAstsConfrmSwt "" VALUE 0xfe829515 /* @ECU_Address@P_LONP_TJAstsConfrmSwt@ */ Record_BOOLEAN 0 autosar_swc_vmp_CM_boolean 0 1 /end CHARACTERISTIC
/begin CHARACTERISTIC P_LONP_TTCConsiderAccelTimeYaxis "" CURVE 0xfe829814 /* @ECU_Address@P_LONP_TTCConsiderAccelTimeYaxis@ */ Record_FLOAT32_IEEE 0 autosar_swc_vmp_CM_single -3.4E+38 3.4E+38
 /begin AXIS_DESCR COM_AXIS NO_INPUT_QUANTITY autosar_swc_vmp_CM_single 12 -3.4E+38 3.4E+38 AXIS_PTS_REF P_LONP_TTCConsiderAccelTimeXaxis /end AXIS_DESCR
/end CHARACTERISTIC
/begin CHARACTERISTIC P_LONP_TarLineICEnable "" VALUE 0xfe829516 /* @ECU_Address@P_LONP_TarLineICEnable@ */ Record_BOOLEAN 0 autosar_swc_vmp_CM_boolean 0 1 /end CHARACTERISTIC
/begin CHARACTERISTIC P_LONP_TimeSwitch "" VALUE 0xfe829168 /* @ECU_Address@P_LONP_TimeSwitch@ */ Record_FLOAT64_IEEE 0 autosar_swc_vmp_CM_double -1.7E+308 1.7E+308 /end CHARACTERISTIC
/begin CHARACTERISTIC P_LONP_TorTTCThrd "" VALUE 0xfe829428 /* @ECU_Address@P_LONP_TorTTCThrd@ */ Record_FLOAT32_IEEE 0 autosar_swc_vmp_CM_single_s 0.000000 20.000000 /end CHARACTERISTIC
/begin CHARACTERISTIC P_LONP_TruckFollowdistDesYAxis "" CURVE 0xfe82986c /* @ECU_Address@P_LONP_TruckFollowdistDesYAxis@ */ Record_FLOAT32_IEEE 0 autosar_swc_vmp_CM_single -3.4E+38 3.4E+38
 /begin AXIS_DESCR COM_AXIS NO_INPUT_QUANTITY autosar_swc_vmp_CM_single 10 -3.4E+38 3.4E+38 AXIS_PTS_REF P_LONP_TruckFollowdistDesX2Axis /end AXIS_DESCR
/end CHARACTERISTIC
/begin CHARACTERISTIC P_LONP_UseDecSwitch "" VALUE 0xfe829517 /* @ECU_Address@P_LONP_UseDecSwitch@ */ Record_UBYTE 0 autosar_swc_vmp_CM_uint8 0 255 /end CHARACTERISTIC
/begin CHARACTERISTIC P_LONP_UseICFilt "" VALUE 0xfe829518 /* @ECU_Address@P_LONP_UseICFilt@ */ Record_UBYTE 0 autosar_swc_vmp_CM_uint8 0 255 /end CHARACTERISTIC
/begin CHARACTERISTIC P_LONP_UsePTableSW "" VALUE 0xfe829519 /* @ECU_Address@P_LONP_UsePTableSW@ */ Record_UBYTE 0 autosar_swc_vmp_CM_uint8 0 255 /end CHARACTERISTIC
/begin CHARACTERISTIC P_LONP_UsePreLookupTable "" VALUE 0xfe82951a /* @ECU_Address@P_LONP_UsePreLookupTable@ */ Record_UBYTE 0 autosar_swc_vmp_CM_uint8 0 255 /end CHARACTERISTIC
/begin CHARACTERISTIC P_LONP_VelRelP0DistCofY "" CURVE 0xfe8298a4 /* @ECU_Address@P_LONP_VelRelP0DistCofY@ */ Record_FLOAT32_IEEE 0 autosar_swc_vmp_CM_single -3.4E+38 3.4E+38
 /begin AXIS_DESCR COM_AXIS NO_INPUT_QUANTITY autosar_swc_vmp_CM_single 4 -3.4E+38 3.4E+38 AXIS_PTS_REF P_LONP_VelRelP0DistCofX /end AXIS_DESCR
/end CHARACTERISTIC
/begin CHARACTERISTIC P_LONP_accelForceMinStopCtrl "m/s^2" CURVE 0xfe8298b4 /* @ECU_Address@P_LONP_accelForceMinStopCtrl@ */ Record_FLOAT32_IEEE 0 autosar_swc_vmp_CM_single -3.4E+38 3.4E+38
 /begin AXIS_DESCR COM_AXIS NO_INPUT_QUANTITY autosar_swc_vmp_CM_single 6 -3.4E+38 3.4E+38 AXIS_PTS_REF P_LONP_axvRoadSlopeMs2StopCtrl /end AXIS_DESCR
/end CHARACTERISTIC
/begin CHARACTERISTIC P_LONP_accelMapLowerJerk "m/s^3" VALUE 0xfe829430 /* @ECU_Address@P_LONP_accelMapLowerJerk@ */ Record_FLOAT32_IEEE 0 autosar_swc_vmp_CM_single -3.4E+38 3.4E+38 /end CHARACTERISTIC
/begin CHARACTERISTIC P_LONP_accelMapUpperJerk "m/s^3" VALUE 0xfe829434 /* @ECU_Address@P_LONP_accelMapUpperJerk@ */ Record_FLOAT32_IEEE 0 autosar_swc_vmp_CM_single -3.4E+38 3.4E+38 /end CHARACTERISTIC
/begin CHARACTERISTIC P_LONP_accelTargAbsFiltThrd "" VALUE 0xfe829438 /* @ECU_Address@P_LONP_accelTargAbsFiltThrd@ */ Record_FLOAT32_IEEE 0 autosar_swc_vmp_CM_single_m_per_s_2 -5.000000 5.000000 /end CHARACTERISTIC
/begin CHARACTERISTIC P_LONP_cofEnable "" VALUE 0xfe82951c /* @ECU_Address@P_LONP_cofEnable@ */ Record_BOOLEAN 0 autosar_swc_vmp_CM_boolean 0 1 /end CHARACTERISTIC
/begin CHARACTERISTIC P_LONP_cofJerk "" VALUE 0xfe82943c /* @ECU_Address@P_LONP_cofJerk@ */ Record_FLOAT32_IEEE 0 autosar_swc_vmp_CM_single -3.4E+38 3.4E+38 /end CHARACTERISTIC
/begin CHARACTERISTIC P_LONP_decelFollowJerkTTCSwitchEnable "" VALUE 0xfe82951d /* @ECU_Address@P_LONP_decelFollowJerkTTCSwitchEnable@ */ Record_BOOLEAN 0 autosar_swc_vmp_CM_boolean 0 1 /end CHARACTERISTIC
/begin CHARACTERISTIC P_LONP_distDesAddForceStopP0Lost "" VALUE 0xfe829440 /* @ECU_Address@P_LONP_distDesAddForceStopP0Lost@ */ Record_FLOAT32_IEEE 0 autosar_swc_vmp_CM_single -3.4E+38 3.4E+38 /end CHARACTERISTIC
/begin CHARACTERISTIC P_LONP_distRelDesCorrPlanEnlargeCof "" VALUE 0xfe829444 /* @ECU_Address@P_LONP_distRelDesCorrPlanEnlargeCof@ */ Record_FLOAT32_IEEE 0 autosar_swc_vmp_CM_single -3.4E+38 3.4E+38 /end CHARACTERISTIC
/begin CHARACTERISTIC P_LONP_distTargRelChgValueMax "m" VALUE 0xfe829448 /* @ECU_Address@P_LONP_distTargRelChgValueMax@ */ Record_FLOAT32_IEEE 0 autosar_swc_vmp_CM_single -3.4E+38 3.4E+38 /end CHARACTERISTIC
/begin CHARACTERISTIC P_LONP_distTargRelChgValueMin "m" VALUE 0xfe82944c /* @ECU_Address@P_LONP_distTargRelChgValueMin@ */ Record_FLOAT32_IEEE 0 autosar_swc_vmp_CM_single -3.4E+38 3.4E+38 /end CHARACTERISTIC
/begin CHARACTERISTIC P_LONP_distTargRelValueThrd "" VALUE 0xfe829450 /* @ECU_Address@P_LONP_distTargRelValueThrd@ */ Record_FLOAT32_IEEE 0 autosar_swc_vmp_CM_single -3.4E+38 3.4E+38 /end CHARACTERISTIC
/begin CHARACTERISTIC P_LONP_distThreDecToStopYAxis "" CURVE 0xfe82a014 /* @ECU_Address@P_LONP_distThreDecToStopYAxis@ */ Record_FLOAT32_IEEE 0 autosar_swc_vmp_CM_single_m 0.000000 30.000000
 /begin AXIS_DESCR COM_AXIS NO_INPUT_QUANTITY autosar_swc_vmp_CM_single_m_per_s_2 3 0.000000 5.000000 AXIS_PTS_REF P_LONP_distThreDecToStopXAxis /end AXIS_DESCR
/end CHARACTERISTIC
/begin CHARACTERISTIC P_LONP_facDelay "" VALUE 0xfe829454 /* @ECU_Address@P_LONP_facDelay@ */ Record_FLOAT32_IEEE 0 autosar_swc_vmp_CM_single -3.4E+38 3.4E+38 /end CHARACTERISTIC
/begin CHARACTERISTIC P_LONP_hightHazardMinCtrl "" VALUE 0xfe829458 /* @ECU_Address@P_LONP_hightHazardMinCtrl@ */ Record_FLOAT32_IEEE 0 autosar_swc_vmp_CM_single -3.4E+38 3.4E+38 /end CHARACTERISTIC
/begin CHARACTERISTIC P_LONP_iEnd "" VALUE 0xfe82951e /* @ECU_Address@P_LONP_iEnd@ */ Record_UBYTE 0 autosar_swc_vmp_CM_uint8 0 255 /end CHARACTERISTIC
/begin CHARACTERISTIC P_LONP_iStart "" VALUE 0xfe82951f /* @ECU_Address@P_LONP_iStart@ */ Record_UBYTE 0 autosar_swc_vmp_CM_uint8 0 255 /end CHARACTERISTIC
/begin CHARACTERISTIC P_LONP_jerkStopCtrl "m/s^3" CURVE 0xfe8298e4 /* @ECU_Address@P_LONP_jerkStopCtrl@ */ Record_FLOAT32_IEEE 0 autosar_swc_vmp_CM_single -3.4E+38 3.4E+38
 /begin AXIS_DESCR COM_AXIS NO_INPUT_QUANTITY autosar_swc_vmp_CM_single 6 -3.4E+38 3.4E+38 AXIS_PTS_REF P_LONP_axvRoadSlopeMs2StopCtrl /end AXIS_DESCR
/end CHARACTERISTIC
/begin CHARACTERISTIC P_LONP_tCycle "" VALUE 0xfe829460 /* @ECU_Address@P_LONP_tCycle@ */ Record_FLOAT32_IEEE 0 autosar_swc_vmp_CM_single_s 0.020000 0.100000 /end CHARACTERISTIC
/begin CHARACTERISTIC P_LONP_tDecelYAxis "" CURVE 0xfe82991c /* @ECU_Address@P_LONP_tDecelYAxis@ */ Record_FLOAT32_IEEE 0 autosar_swc_vmp_CM_single -3.4E+38 3.4E+38
 /begin AXIS_DESCR COM_AXIS NO_INPUT_QUANTITY autosar_swc_vmp_CM_single 4 -3.4E+38 3.4E+38 AXIS_PTS_REF P_LONP_tDecelXAxis /end AXIS_DESCR
/end CHARACTERISTIC
/begin CHARACTERISTIC P_LONP_velOffRampLimitMin "" VALUE 0xfe829464 /* @ECU_Address@P_LONP_velOffRampLimitMin@ */ Record_FLOAT32_IEEE 0 autosar_swc_vmp_CM_single -3.4E+38 3.4E+38 /end CHARACTERISTIC
/begin CHARACTERISTIC P_LONP_velSubjThreDecToStop "" VALUE 0xfe829468 /* @ECU_Address@P_LONP_velSubjThreDecToStop@ */ Record_FLOAT32_IEEE 0 autosar_swc_vmp_CM_single_m_per_s 0.000000 10.000000 /end CHARACTERISTIC
/begin CHARACTERISTIC P_LONP_velSubjThresStopCtrl "m/s" CURVE 0xfe82992c /* @ECU_Address@P_LONP_velSubjThresStopCtrl@ */ Record_FLOAT32_IEEE 0 autosar_swc_vmp_CM_single -3.4E+38 3.4E+38
 /begin AXIS_DESCR COM_AXIS NO_INPUT_QUANTITY autosar_swc_vmp_CM_single 6 -3.4E+38 3.4E+38 AXIS_PTS_REF P_LONP_axvRoadSlopeMs2StopCtrl /end AXIS_DESCR
/end CHARACTERISTIC
/begin CHARACTERISTIC P_LONP_velTargetThreDecleToStop "" VALUE 0xfe82946c /* @ECU_Address@P_LONP_velTargetThreDecleToStop@ */ Record_FLOAT32_IEEE 0 autosar_swc_vmp_CM_single_m_per_s 0.000000 10.000000 /end CHARACTERISTIC
/begin CHARACTERISTIC P_Longctrl_Follow_CASws "" VALUE 0xfe829520 /* @ECU_Address@P_Longctrl_Follow_CASws@ */ Record_BOOLEAN 0 autosar_swc_vmp_CM_boolean 0.000000 1.000000 /end CHARACTERISTIC
/begin CHARACTERISTIC P_Longctrl_Follow_CAaccelSubjIsDecel "" VALUE 0xfe829470 /* @ECU_Address@P_Longctrl_Follow_CAaccelSubjIsDecel@ */ Record_FLOAT32_IEEE 0 autosar_swc_vmp_CM_single_m_per_s_2 -3.000000 0.500000 /end CHARACTERISTIC
/begin CHARACTERISTIC P_Longctrl_Follow_CAdevAcceleLowerBand "CA¹¦ÄÜÏÂLowerBandÆ«ÒÆÁ¿" VALUE 0xfe829474 /* @ECU_Address@P_Longctrl_Follow_CAdevAcceleLowerBand@ */ Record_FLOAT32_IEEE 0 autosar_swc_vmp_CM_single_m_per_s_2 0.000000 1.000000 /end CHARACTERISTIC
/begin CHARACTERISTIC P_Longctrl_Follow_CAdevAcceleUpperBand "CA¹¦ÄÜÏÂUpperBandÆ«ÒÆÁ¿" VALUE 0xfe829478 /* @ECU_Address@P_Longctrl_Follow_CAdevAcceleUpperBand@ */ Record_FLOAT32_IEEE 0 autosar_swc_vmp_CM_single_m_per_s_2 0.000000 1.000000 /end CHARACTERISTIC
/begin CHARACTERISTIC P_Longctrl_Follow_CAdistSafe "" VALUE 0xfe82947c /* @ECU_Address@P_Longctrl_Follow_CAdistSafe@ */ Record_FLOAT32_IEEE 0 autosar_swc_vmp_CM_single_m 0.000000 30.000000 /end CHARACTERISTIC
/begin CHARACTERISTIC P_Longctrl_Follow_CAtKeepSpeed "" VALUE 0xfe829480 /* @ECU_Address@P_Longctrl_Follow_CAtKeepSpeed@ */ Record_FLOAT32_IEEE 0 autosar_swc_vmp_CM_single_s 0.000000 3.000000 /end CHARACTERISTIC
/begin CHARACTERISTIC P_Longctrl_Follow_CAtTargPass "" VALUE 0xfe829484 /* @ECU_Address@P_Longctrl_Follow_CAtTargPass@ */ Record_FLOAT32_IEEE 0 autosar_swc_vmp_CM_single_m 0.000000 10.000000 /end CHARACTERISTIC
/begin CHARACTERISTIC P_Longctrl_Follow_CAupperJerk "CA¹¦ÄÜUpperJerk" VALUE 0xfe829488 /* @ECU_Address@P_Longctrl_Follow_CAupperJerk@ */ Record_FLOAT32_IEEE 0 autosar_swc_vmp_CM_single_m_per_s_3 0.000000 5.000000 /end CHARACTERISTIC
/begin CHARACTERISTIC P_PLAN_DPC_FrontObj_DX_03 "" CURVE 0xfe82a3b8 /* @ECU_Address@P_PLAN_DPC_FrontObj_DX_03@ */ Record_FLOAT32_IEEE 0 autosar_swc_vmp_CM_single -3.4E+38 3.4E+38
 /begin AXIS_DESCR COM_AXIS NO_INPUT_QUANTITY autosar_swc_vmp_CM_single 24 -3.4E+38 3.4E+38 AXIS_PTS_REF P_PLAN_DPC_xiangduisudu_kmh /end AXIS_DESCR
/end CHARACTERISTIC
/begin MEASUREMENT InsertIOut_InsertSpace_St "" UBYTE autosar_swc_vmp_CM_uint8 0 0 0 255 ECU_ADDRESS 0xfe4cdb30 /* @ECU_Address@InsertIOut_InsertSpace_St@ */ /end MEASUREMENT
/begin MEASUREMENT InsertIOut_accelDesInsertSpaceLC_Out "" FLOAT32_IEEE autosar_swc_vmp_CM_single 0 0 -3.4E+38 3.4E+38 ECU_ADDRESS 0xfe4cd850 /* @ECU_Address@InsertIOut_accelDesInsertSpaceLC_Out@ */ /end MEASUREMENT
/begin MEASUREMENT LONP_ACCTgtObjVy "" FLOAT32_IEEE autosar_swc_vmp_CM_single 0 0 -3.4E+38 3.4E+38 ECU_ADDRESS 0xfe4cd854 /* @ECU_Address@LONP_ACCTgtObjVy@ */ /end MEASUREMENT
/begin MEASUREMENT LONP_Follow_Counter "" UBYTE autosar_swc_vmp_CM_uint8 0 0 0 255 ECU_ADDRESS 0xfe4cdb32 /* @ECU_Address@LONP_Follow_Counter@ */ /end MEASUREMENT
/begin MEASUREMENT LONP_VlcInternalAccK20 "" FLOAT32_IEEE autosar_swc_vmp_CM_single 0 0 -3.4E+38 3.4E+38 ECU_ADDRESS 0xfe4cd858 /* @ECU_Address@LONP_VlcInternalAccK20@ */ /end MEASUREMENT
/begin MEASUREMENT LONP_accelArb "" FLOAT32_IEEE autosar_swc_vmp_CM_single 0 0 -3.4E+38 3.4E+38 ECU_ADDRESS 0xfe4cd860 /* @ECU_Address@LONP_accelArb@ */ /end MEASUREMENT
/begin MEASUREMENT autosar_swc_vmp_rtARID_DEF.ACCAge "" FLOAT64_IEEE autosar_swc_vmp_CM_double 0 0 -1.7E+308 1.7E+308 ECU_ADDRESS 0xfe4ce620 /* @ECU_Address@autosar_swc_vmp_rtARID_DEF.ACCAge@ */ /end MEASUREMENT
/begin MEASUREMENT autosar_swc_vmp_rtARID_DEF.ACCAge2 "" FLOAT64_IEEE autosar_swc_vmp_CM_double 0 0 -1.7E+308 1.7E+308 ECU_ADDRESS 0xfe4ce628 /* @ECU_Address@autosar_swc_vmp_rtARID_DEF.ACCAge2@ */ /end MEASUREMENT
/begin MEASUREMENT autosar_swc_vmp_rtARID_DEF.ACCModeK1 "" UBYTE autosar_swc_vmp_CM_uint8 0 0 0 255 ECU_ADDRESS 0xfe4d4251 /* @ECU_Address@autosar_swc_vmp_rtARID_DEF.ACCModeK1@ */ /end MEASUREMENT
/begin MEASUREMENT autosar_swc_vmp_rtARID_DEF.ACCModeStateFullFill "" UBYTE autosar_swc_vmp_CM_logical 0 0 0 1 ECU_ADDRESS 0xfe4d429e /* @ECU_Address@autosar_swc_vmp_rtARID_DEF.ACCModeStateFullFill@ */ /end MEASUREMENT
/begin MEASUREMENT autosar_swc_vmp_rtARID_DEF.ACCModeStsK1 "" UBYTE autosar_swc_vmp_CM_uint8 0 0 0 255 ECU_ADDRESS 0xfe4d4250 /* @ECU_Address@autosar_swc_vmp_rtARID_DEF.ACCModeStsK1@ */ /end MEASUREMENT
/begin MEASUREMENT autosar_swc_vmp_rtARID_DEF.ACCModeStsK1_j "" UBYTE autosar_swc_vmp_CM_uint8 0 0 0 255 ECU_ADDRESS 0xfe4d4252 /* @ECU_Address@autosar_swc_vmp_rtARID_DEF.ACCModeStsK1_j@ */ /end MEASUREMENT
/begin MEASUREMENT autosar_swc_vmp_rtARID_DEF.Add1 "" FLOAT32_IEEE autosar_swc_vmp_CM_single 0 0 -3.4E+38 3.4E+38 ECU_ADDRESS 0xfe4d4044 /* @ECU_Address@autosar_swc_vmp_rtARID_DEF.Add1@ */ /end MEASUREMENT
/begin MEASUREMENT autosar_swc_vmp_rtARID_DEF.CCSetSpdK1 "" FLOAT64_IEEE autosar_swc_vmp_CM_double 0 0 -1.7E+308 1.7E+308 ECU_ADDRESS 0xfe4ce640 /* @ECU_Address@autosar_swc_vmp_rtARID_DEF.CCSetSpdK1@ */ /end MEASUREMENT
/begin MEASUREMENT autosar_swc_vmp_rtARID_DEF.DeceAge "" FLOAT64_IEEE autosar_swc_vmp_CM_double 0 0 -1.7E+308 1.7E+308 ECU_ADDRESS 0xfe4ce610 /* @ECU_Address@autosar_swc_vmp_rtARID_DEF.DeceAge@ */ /end MEASUREMENT
/begin MEASUREMENT autosar_swc_vmp_rtARID_DEF.DeceAge2 "" FLOAT64_IEEE autosar_swc_vmp_CM_double 0 0 -1.7E+308 1.7E+308 ECU_ADDRESS 0xfe4ce618 /* @ECU_Address@autosar_swc_vmp_rtARID_DEF.DeceAge2@ */ /end MEASUREMENT
/begin MEASUREMENT autosar_swc_vmp_rtARID_DEF.DesiredDistGap "" FLOAT32_IEEE autosar_swc_vmp_CM_single 0 0 -3.4E+38 3.4E+38 ECU_ADDRESS 0xfe4d4128 /* @ECU_Address@autosar_swc_vmp_rtARID_DEF.DesiredDistGap@ */ /end MEASUREMENT
/begin MEASUREMENT autosar_swc_vmp_rtARID_DEF.DriveOffConditonFulfilled "" UBYTE autosar_swc_vmp_CM_uint8 0 0 0 255 ECU_ADDRESS 0xfe4d4232 /* @ECU_Address@autosar_swc_vmp_rtARID_DEF.DriveOffConditonFulfilled@ */ /end MEASUREMENT
/begin MEASUREMENT autosar_swc_vmp_rtARID_DEF.Flag "" UBYTE autosar_swc_vmp_CM_logical 0 0 0 1 ECU_ADDRESS 0xfe4d42a0 /* @ECU_Address@autosar_swc_vmp_rtARID_DEF.Flag@ */ /end MEASUREMENT
/begin MEASUREMENT autosar_swc_vmp_rtARID_DEF.GoAge "" FLOAT64_IEEE autosar_swc_vmp_CM_double 0 0 -1.7E+308 1.7E+308 ECU_ADDRESS 0xfe4ce638 /* @ECU_Address@autosar_swc_vmp_rtARID_DEF.GoAge@ */ /end MEASUREMENT
/begin MEASUREMENT autosar_swc_vmp_rtARID_DEF.InsertIOut_lowerBandInsertSpace "" FLOAT32_IEEE autosar_swc_vmp_CM_single 0 0 -3.4E+38 3.4E+38 ECU_ADDRESS 0xfe4d4080 /* @ECU_Address@autosar_swc_vmp_rtARID_DEF.InsertIOut_lowerBandInsertSpace@ */ /end MEASUREMENT
/begin MEASUREMENT autosar_swc_vmp_rtARID_DEF.InsertIOut_lowerJerkInsertSpace "" FLOAT64_IEEE autosar_swc_vmp_CM_double 0 0 -1.7E+308 1.7E+308 ECU_ADDRESS 0xfe4ce5f0 /* @ECU_Address@autosar_swc_vmp_rtARID_DEF.InsertIOut_lowerJerkInsertSpace@ */ /end MEASUREMENT
/begin MEASUREMENT autosar_swc_vmp_rtARID_DEF.InsertIOut_upperBandInsertSpace "" FLOAT32_IEEE autosar_swc_vmp_CM_single 0 0 -3.4E+38 3.4E+38 ECU_ADDRESS 0xfe4d4084 /* @ECU_Address@autosar_swc_vmp_rtARID_DEF.InsertIOut_upperBandInsertSpace@ */ /end MEASUREMENT
/begin MEASUREMENT autosar_swc_vmp_rtARID_DEF.InsertIOut_upperJerkInsertSpace "" FLOAT64_IEEE autosar_swc_vmp_CM_double 0 0 -1.7E+308 1.7E+308 ECU_ADDRESS 0xfe4ce5f8 /* @ECU_Address@autosar_swc_vmp_rtARID_DEF.InsertIOut_upperJerkInsertSpace@ */ /end MEASUREMENT
/begin MEASUREMENT autosar_swc_vmp_rtARID_DEF.Insert_CollsnCheck_Letgo "" FLOAT32_IEEE autosar_swc_vmp_CM_single 0 0 -3.4E+38 3.4E+38 ECU_ADDRESS 0xfe4d4078 /* @ECU_Address@autosar_swc_vmp_rtARID_DEF.Insert_CollsnCheck_Letgo@ */ /end MEASUREMENT
/begin MEASUREMENT autosar_swc_vmp_rtARID_DEF.LastSpacenum "" UBYTE autosar_swc_vmp_CM_uint8 0 0 0 255 ECU_ADDRESS 0xfe4d425a /* @ECU_Address@autosar_swc_vmp_rtARID_DEF.LastSpacenum@ */ /end MEASUREMENT
/begin MEASUREMENT autosar_swc_vmp_rtARID_DEF.MultiportSwitch "" ULONG autosar_swc_vmp_CM_uint32 0 0 0 4294967295 MATRIX_DIM 1 1 ECU_ADDRESS 0xfe4d4184 /* @ECU_Address@autosar_swc_vmp_rtARID_DEF.MultiportSwitch@ */ /end MEASUREMENT
/begin MEASUREMENT autosar_swc_vmp_rtARID_DEF.Output_DSTATE_d "" UBYTE autosar_swc_vmp_CM_uint8 0 0 0 255 ECU_ADDRESS 0xfe4d4242 /* @ECU_Address@autosar_swc_vmp_rtARID_DEF.Output_DSTATE_d@ */ /end MEASUREMENT
/begin MEASUREMENT autosar_swc_vmp_rtARID_DEF.Overide2ActiveTimeCnt "" FLOAT32_IEEE autosar_swc_vmp_CM_single 0 0 -3.4E+38 3.4E+38 MATRIX_DIM 1 1 ECU_ADDRESS 0xfe4d4074 /* @ECU_Address@autosar_swc_vmp_rtARID_DEF.Overide2ActiveTimeCnt@ */ /end MEASUREMENT
/begin MEASUREMENT autosar_swc_vmp_rtARID_DEF.P0ax "" FLOAT32_IEEE autosar_swc_vmp_CM_single 0 0 -3.4E+38 3.4E+38 MATRIX_DIM 1 1 ECU_ADDRESS 0xfe4d4090 /* @ECU_Address@autosar_swc_vmp_rtARID_DEF.P0ax@ */ /end MEASUREMENT
/begin MEASUREMENT autosar_swc_vmp_rtARID_DEF.P0dx "" FLOAT32_IEEE autosar_swc_vmp_CM_single 0 0 -3.4E+38 3.4E+38 MATRIX_DIM 1 1 ECU_ADDRESS 0xfe4d4088 /* @ECU_Address@autosar_swc_vmp_rtARID_DEF.P0dx@ */ /end MEASUREMENT
/begin MEASUREMENT autosar_swc_vmp_rtARID_DEF.P0vx "" FLOAT32_IEEE autosar_swc_vmp_CM_single 0 0 -3.4E+38 3.4E+38 MATRIX_DIM 1 1 ECU_ADDRESS 0xfe4d408c /* @ECU_Address@autosar_swc_vmp_rtARID_DEF.P0vx@ */ /end MEASUREMENT
/begin MEASUREMENT autosar_swc_vmp_rtARID_DEF.SpdIntentionOn "" FLOAT32_IEEE autosar_swc_vmp_CM_single 0 0 -3.4E+38 3.4E+38 ECU_ADDRESS 0xfe4d4164 /* @ECU_Address@autosar_swc_vmp_rtARID_DEF.SpdIntentionOn@ */ /end MEASUREMENT
/begin MEASUREMENT autosar_swc_vmp_rtARID_DEF.StpAge "" FLOAT64_IEEE autosar_swc_vmp_CM_double 0 0 -1.7E+308 1.7E+308 ECU_ADDRESS 0xfe4ce600 /* @ECU_Address@autosar_swc_vmp_rtARID_DEF.StpAge@ */ /end MEASUREMENT
/begin MEASUREMENT autosar_swc_vmp_rtARID_DEF.StpAge2 "" FLOAT64_IEEE autosar_swc_vmp_CM_double 0 0 -1.7E+308 1.7E+308 ECU_ADDRESS 0xfe4ce608 /* @ECU_Address@autosar_swc_vmp_rtARID_DEF.StpAge2@ */ /end MEASUREMENT
/begin MEASUREMENT autosar_swc_vmp_rtARID_DEF.TappedDelay1_X_d "" FLOAT32_IEEE autosar_swc_vmp_CM_single 0 0 -3.4E+38 3.4E+38 ECU_ADDRESS 0xfe4d4118 /* @ECU_Address@autosar_swc_vmp_rtARID_DEF.TappedDelay1_X_d@ */ /end MEASUREMENT
/begin MEASUREMENT autosar_swc_vmp_rtARID_DEF.TappedDelay1_X_e "" ULONG autosar_swc_vmp_CM_uint32 0 0 0 4294967295 ECU_ADDRESS 0xfe4d419c /* @ECU_Address@autosar_swc_vmp_rtARID_DEF.TappedDelay1_X_e@ */ /end MEASUREMENT
/begin MEASUREMENT autosar_swc_vmp_rtARID_DEF.TappedDelay1_X_g "" UBYTE autosar_swc_vmp_CM_uint8 0 0 0 255 ECU_ADDRESS 0xfe4d423a /* @ECU_Address@autosar_swc_vmp_rtARID_DEF.TappedDelay1_X_g@ */ /end MEASUREMENT
/begin MEASUREMENT autosar_swc_vmp_rtARID_DEF.TappedDelay1_X_i "" FLOAT32_IEEE autosar_swc_vmp_CM_single 0 0 -3.4E+38 3.4E+38 LAYOUT COLUMN_DIR MATRIX_DIM 25 ECU_ADDRESS 0xfe4ce7cc /* @ECU_Address@autosar_swc_vmp_rtARID_DEF.TappedDelay1_X_i@ */ /end MEASUREMENT
/begin MEASUREMENT autosar_swc_vmp_rtARID_DEF.TappedDelay2_X "" FLOAT32_IEEE autosar_swc_vmp_CM_single 0 0 -3.4E+38 3.4E+38 LAYOUT COLUMN_DIR MATRIX_DIM 3 ECU_ADDRESS 0xfe4ce830 /* @ECU_Address@autosar_swc_vmp_rtARID_DEF.TappedDelay2_X@ */ /end MEASUREMENT
/begin MEASUREMENT autosar_swc_vmp_rtARID_DEF.TappedDelay2_X_i "" ULONG autosar_swc_vmp_CM_uint32 0 0 0 4294967295 ECU_ADDRESS 0xfe4d41a0 /* @ECU_Address@autosar_swc_vmp_rtARID_DEF.TappedDelay2_X_i@ */ /end MEASUREMENT
/begin MEASUREMENT autosar_swc_vmp_rtARID_DEF.TappedDelay2_X_o "" ULONG autosar_swc_vmp_CM_uint32 0 0 0 4294967295 ECU_ADDRESS 0xfe4d41a8 /* @ECU_Address@autosar_swc_vmp_rtARID_DEF.TappedDelay2_X_o@ */ /end MEASUREMENT
/begin MEASUREMENT autosar_swc_vmp_rtARID_DEF.TappedDelay3_X "" ULONG autosar_swc_vmp_CM_uint32 0 0 0 4294967295 ECU_ADDRESS 0xfe4d4198 /* @ECU_Address@autosar_swc_vmp_rtARID_DEF.TappedDelay3_X@ */ /end MEASUREMENT
/begin MEASUREMENT autosar_swc_vmp_rtARID_DEF.TappedDelay3_X_b "" ULONG autosar_swc_vmp_CM_uint32 0 0 0 4294967295 ECU_ADDRESS 0xfe4d41ac /* @ECU_Address@autosar_swc_vmp_rtARID_DEF.TappedDelay3_X_b@ */ /end MEASUREMENT
/begin MEASUREMENT autosar_swc_vmp_rtARID_DEF.TappedDelay4_X "" ULONG autosar_swc_vmp_CM_uint32 0 0 0 4294967295 ECU_ADDRESS 0xfe4d41b0 /* @ECU_Address@autosar_swc_vmp_rtARID_DEF.TappedDelay4_X@ */ /end MEASUREMENT
/begin MEASUREMENT autosar_swc_vmp_rtARID_DEF.TappedDelay_X "" ULONG autosar_swc_vmp_CM_uint32 0 0 0 4294967295 ECU_ADDRESS 0xfe4d4194 /* @ECU_Address@autosar_swc_vmp_rtARID_DEF.TappedDelay_X@ */ /end MEASUREMENT
/begin MEASUREMENT autosar_swc_vmp_rtARID_DEF.TappedDelay_X_a "" ULONG autosar_swc_vmp_CM_uint32 0 0 0 4294967295 ECU_ADDRESS 0xfe4d41c4 /* @ECU_Address@autosar_swc_vmp_rtARID_DEF.TappedDelay_X_a@ */ /end MEASUREMENT
/begin MEASUREMENT autosar_swc_vmp_rtARID_DEF.TappedDelay_X_f "" ULONG autosar_swc_vmp_CM_uint32 0 0 0 4294967295 ECU_ADDRESS 0xfe4d41d4 /* @ECU_Address@autosar_swc_vmp_rtARID_DEF.TappedDelay_X_f@ */ /end MEASUREMENT
/begin MEASUREMENT autosar_swc_vmp_rtARID_DEF.TappedDelay_X_p "" ULONG autosar_swc_vmp_CM_uint32 0 0 0 4294967295 ECU_ADDRESS 0xfe4d41a4 /* @ECU_Address@autosar_swc_vmp_rtARID_DEF.TappedDelay_X_p@ */ /end MEASUREMENT
/begin MEASUREMENT autosar_swc_vmp_rtARID_DEF.UnitDelay10_DSTATE "" UBYTE autosar_swc_vmp_CM_uint8 0 0 0 255 ECU_ADDRESS 0xfe4d423c /* @ECU_Address@autosar_swc_vmp_rtARID_DEF.UnitDelay10_DSTATE@ */ /end MEASUREMENT
/begin MEASUREMENT autosar_swc_vmp_rtARID_DEF.UnitDelay1_DSTATE_a "" ULONG autosar_swc_vmp_CM_uint32 0 0 0 4294967295 ECU_ADDRESS 0xfe4d41b8 /* @ECU_Address@autosar_swc_vmp_rtARID_DEF.UnitDelay1_DSTATE_a@ */ /end MEASUREMENT
/begin MEASUREMENT autosar_swc_vmp_rtARID_DEF.UnitDelay1_DSTATE_aw "" UWORD autosar_swc_vmp_CM_uint16 0 0 0 65535 ECU_ADDRESS 0xfe4d4230 /* @ECU_Address@autosar_swc_vmp_rtARID_DEF.UnitDelay1_DSTATE_aw@ */ /end MEASUREMENT
/begin MEASUREMENT autosar_swc_vmp_rtARID_DEF.UnitDelay1_DSTATE_b "" FLOAT32_IEEE autosar_swc_vmp_CM_single 0 0 -3.4E+38 3.4E+38 LAYOUT COLUMN_DIR MATRIX_DIM 4 ECU_ADDRESS 0xfe4ce7ac /* @ECU_Address@autosar_swc_vmp_rtARID_DEF.UnitDelay1_DSTATE_b@ */ /end MEASUREMENT
/begin MEASUREMENT autosar_swc_vmp_rtARID_DEF.UnitDelay1_DSTATE_b5 "" ULONG autosar_swc_vmp_CM_uint32 0 0 0 4294967295 ECU_ADDRESS 0xfe4d41c8 /* @ECU_Address@autosar_swc_vmp_rtARID_DEF.UnitDelay1_DSTATE_b5@ */ /end MEASUREMENT
/begin MEASUREMENT autosar_swc_vmp_rtARID_DEF.UnitDelay1_DSTATE_c "" FLOAT32_IEEE autosar_swc_vmp_CM_single 0 0 -3.4E+38 3.4E+38 ECU_ADDRESS 0xfe4d40c4 /* @ECU_Address@autosar_swc_vmp_rtARID_DEF.UnitDelay1_DSTATE_c@ */ /end MEASUREMENT
/begin MEASUREMENT autosar_swc_vmp_rtARID_DEF.UnitDelay1_DSTATE_k "" FLOAT32_IEEE autosar_swc_vmp_CM_single 0 0 -3.4E+38 3.4E+38 ECU_ADDRESS 0xfe4d40b8 /* @ECU_Address@autosar_swc_vmp_rtARID_DEF.UnitDelay1_DSTATE_k@ */ /end MEASUREMENT
/begin MEASUREMENT autosar_swc_vmp_rtARID_DEF.UnitDelay1_DSTATE_l "" ULONG autosar_swc_vmp_CM_uint32 0 0 0 4294967295 ECU_ADDRESS 0xfe4d41d0 /* @ECU_Address@autosar_swc_vmp_rtARID_DEF.UnitDelay1_DSTATE_l@ */ /end MEASUREMENT
/begin MEASUREMENT autosar_swc_vmp_rtARID_DEF.UnitDelay1_DSTATE_oa "" UBYTE autosar_swc_vmp_CM_uint8 0 0 0 255 ECU_ADDRESS 0xfe4d4240 /* @ECU_Address@autosar_swc_vmp_rtARID_DEF.UnitDelay1_DSTATE_oa@ */ /end MEASUREMENT
/begin MEASUREMENT autosar_swc_vmp_rtARID_DEF.UnitDelay2_DSTATE "" FLOAT32_IEEE autosar_swc_vmp_CM_single 0 0 -3.4E+38 3.4E+38 ECU_ADDRESS 0xfe4d40c0 /* @ECU_Address@autosar_swc_vmp_rtARID_DEF.UnitDelay2_DSTATE@ */ /end MEASUREMENT
/begin MEASUREMENT autosar_swc_vmp_rtARID_DEF.UnitDelay2_DSTATE_a "" ULONG autosar_swc_vmp_CM_uint32 0 0 0 4294967295 ECU_ADDRESS 0xfe4d41bc /* @ECU_Address@autosar_swc_vmp_rtARID_DEF.UnitDelay2_DSTATE_a@ */ /end MEASUREMENT
/begin MEASUREMENT autosar_swc_vmp_rtARID_DEF.UnitDelay2_DSTATE_f "" UBYTE autosar_swc_vmp_CM_uint8 0 0 0 255 ECU_ADDRESS 0xfe4d4243 /* @ECU_Address@autosar_swc_vmp_rtARID_DEF.UnitDelay2_DSTATE_f@ */ /end MEASUREMENT
/begin MEASUREMENT autosar_swc_vmp_rtARID_DEF.UnitDelay2_DSTATE_ly "" UBYTE autosar_swc_vmp_CM_logical 0 0 0 1 ECU_ADDRESS 0xfe4d4297 /* @ECU_Address@autosar_swc_vmp_rtARID_DEF.UnitDelay2_DSTATE_ly@ */ /end MEASUREMENT
/begin MEASUREMENT autosar_swc_vmp_rtARID_DEF.UnitDelay2_DSTATE_p "" FLOAT32_IEEE autosar_swc_vmp_CM_single 0 0 -3.4E+38 3.4E+38 LAYOUT COLUMN_DIR MATRIX_DIM 4 ECU_ADDRESS 0xfe4ce79c /* @ECU_Address@autosar_swc_vmp_rtARID_DEF.UnitDelay2_DSTATE_p@ */ /end MEASUREMENT
/begin MEASUREMENT autosar_swc_vmp_rtARID_DEF.UnitDelay3_DSTATE "" FLOAT32_IEEE autosar_swc_vmp_CM_single 0 0 -3.4E+38 3.4E+38 ECU_ADDRESS 0xfe4d40b0 /* @ECU_Address@autosar_swc_vmp_rtARID_DEF.UnitDelay3_DSTATE@ */ /end MEASUREMENT
/begin MEASUREMENT autosar_swc_vmp_rtARID_DEF.UnitDelay3_DSTATE_b "" FLOAT32_IEEE autosar_swc_vmp_CM_single 0 0 -3.4E+38 3.4E+38 LAYOUT COLUMN_DIR MATRIX_DIM 4 ECU_ADDRESS 0xfe4ce7bc /* @ECU_Address@autosar_swc_vmp_rtARID_DEF.UnitDelay3_DSTATE_b@ */ /end MEASUREMENT
/begin MEASUREMENT autosar_swc_vmp_rtARID_DEF.UnitDelay3_DSTATE_d "" FLOAT32_IEEE autosar_swc_vmp_CM_single 0 0 -3.4E+38 3.4E+38 ECU_ADDRESS 0xfe4d4114 /* @ECU_Address@autosar_swc_vmp_rtARID_DEF.UnitDelay3_DSTATE_d@ */ /end MEASUREMENT
/begin MEASUREMENT autosar_swc_vmp_rtARID_DEF.UnitDelay3_DSTATE_g "" FLOAT32_IEEE autosar_swc_vmp_CM_single 0 0 -3.4E+38 3.4E+38 ECU_ADDRESS 0xfe4d4110 /* @ECU_Address@autosar_swc_vmp_rtARID_DEF.UnitDelay3_DSTATE_g@ */ /end MEASUREMENT
/begin MEASUREMENT autosar_swc_vmp_rtARID_DEF.UnitDelay3_DSTATE_i "" FLOAT32_IEEE autosar_swc_vmp_CM_single 0 0 -3.4E+38 3.4E+38 ECU_ADDRESS 0xfe4d40cc /* @ECU_Address@autosar_swc_vmp_rtARID_DEF.UnitDelay3_DSTATE_i@ */ /end MEASUREMENT
/begin MEASUREMENT autosar_swc_vmp_rtARID_DEF.UnitDelay3_DSTATE_ig "" ULONG autosar_swc_vmp_CM_uint32 0 0 0 4294967295 ECU_ADDRESS 0xfe4d41c0 /* @ECU_Address@autosar_swc_vmp_rtARID_DEF.UnitDelay3_DSTATE_ig@ */ /end MEASUREMENT
/begin MEASUREMENT autosar_swc_vmp_rtARID_DEF.UnitDelay42_DSTATE "" UBYTE autosar_swc_vmp_CM_logical 0 0 0 1 ECU_ADDRESS 0xfe4d4298 /* @ECU_Address@autosar_swc_vmp_rtARID_DEF.UnitDelay42_DSTATE@ */ /end MEASUREMENT
/begin MEASUREMENT autosar_swc_vmp_rtARID_DEF.UnitDelay43_DSTATE "" FLOAT32_IEEE autosar_swc_vmp_CM_single 0 0 -3.4E+38 3.4E+38 ECU_ADDRESS 0xfe4d40d0 /* @ECU_Address@autosar_swc_vmp_rtARID_DEF.UnitDelay43_DSTATE@ */ /end MEASUREMENT
/begin MEASUREMENT autosar_swc_vmp_rtARID_DEF.UnitDelay44_DSTATE "" FLOAT32_IEEE autosar_swc_vmp_CM_single 0 0 -3.4E+38 3.4E+38 ECU_ADDRESS 0xfe4d40e4 /* @ECU_Address@autosar_swc_vmp_rtARID_DEF.UnitDelay44_DSTATE@ */ /end MEASUREMENT
/begin MEASUREMENT autosar_swc_vmp_rtARID_DEF.UnitDelay45_DSTATE "" FLOAT32_IEEE autosar_swc_vmp_CM_single 0 0 -3.4E+38 3.4E+38 ECU_ADDRESS 0xfe4d40e0 /* @ECU_Address@autosar_swc_vmp_rtARID_DEF.UnitDelay45_DSTATE@ */ /end MEASUREMENT
/begin MEASUREMENT autosar_swc_vmp_rtARID_DEF.UnitDelay46_DSTATE "" FLOAT32_IEEE autosar_swc_vmp_CM_single 0 0 -3.4E+38 3.4E+38 ECU_ADDRESS 0xfe4d40dc /* @ECU_Address@autosar_swc_vmp_rtARID_DEF.UnitDelay46_DSTATE@ */ /end MEASUREMENT
/begin MEASUREMENT autosar_swc_vmp_rtARID_DEF.UnitDelay47_DSTATE "" FLOAT32_IEEE autosar_swc_vmp_CM_single 0 0 -3.4E+38 3.4E+38 ECU_ADDRESS 0xfe4d40d8 /* @ECU_Address@autosar_swc_vmp_rtARID_DEF.UnitDelay47_DSTATE@ */ /end MEASUREMENT
/begin MEASUREMENT autosar_swc_vmp_rtARID_DEF.UnitDelay48_DSTATE "" FLOAT32_IEEE autosar_swc_vmp_CM_single 0 0 -3.4E+38 3.4E+38 ECU_ADDRESS 0xfe4d40d4 /* @ECU_Address@autosar_swc_vmp_rtARID_DEF.UnitDelay48_DSTATE@ */ /end MEASUREMENT
/begin MEASUREMENT autosar_swc_vmp_rtARID_DEF.UnitDelay4_DSTATE "" FLOAT32_IEEE autosar_swc_vmp_CM_single 0 0 -3.4E+38 3.4E+38 ECU_ADDRESS 0xfe4d40c8 /* @ECU_Address@autosar_swc_vmp_rtARID_DEF.UnitDelay4_DSTATE@ */ /end MEASUREMENT
/begin MEASUREMENT autosar_swc_vmp_rtARID_DEF.UnitDelay4_DSTATE_n "" UBYTE autosar_swc_vmp_CM_logical 0 0 0 1 ECU_ADDRESS 0xfe4d4299 /* @ECU_Address@autosar_swc_vmp_rtARID_DEF.UnitDelay4_DSTATE_n@ */ /end MEASUREMENT
/begin MEASUREMENT autosar_swc_vmp_rtARID_DEF.UnitDelay5_DSTATE "" FLOAT32_IEEE autosar_swc_vmp_CM_single 0 0 -3.4E+38 3.4E+38 ECU_ADDRESS 0xfe4d4104 /* @ECU_Address@autosar_swc_vmp_rtARID_DEF.UnitDelay5_DSTATE@ */ /end MEASUREMENT
/begin MEASUREMENT autosar_swc_vmp_rtARID_DEF.UnitDelay_DSTATE_a "" FLOAT32_IEEE autosar_swc_vmp_CM_single 0 0 -3.4E+38 3.4E+38 ECU_ADDRESS 0xfe4d410c /* @ECU_Address@autosar_swc_vmp_rtARID_DEF.UnitDelay_DSTATE_a@ */ /end MEASUREMENT
/begin MEASUREMENT autosar_swc_vmp_rtARID_DEF.UnitDelay_DSTATE_b "" ULONG autosar_swc_vmp_CM_uint32 0 0 0 4294967295 ECU_ADDRESS 0xfe4d41b4 /* @ECU_Address@autosar_swc_vmp_rtARID_DEF.UnitDelay_DSTATE_b@ */ /end MEASUREMENT
/begin MEASUREMENT autosar_swc_vmp_rtARID_DEF.UnitDelay_DSTATE_d "" FLOAT32_IEEE autosar_swc_vmp_CM_single 0 0 -3.4E+38 3.4E+38 ECU_ADDRESS 0xfe4d40e8 /* @ECU_Address@autosar_swc_vmp_rtARID_DEF.UnitDelay_DSTATE_d@ */ /end MEASUREMENT
/begin MEASUREMENT autosar_swc_vmp_rtARID_DEF.UnitDelay_DSTATE_f "" FLOAT32_IEEE autosar_swc_vmp_CM_single 0 0 -3.4E+38 3.4E+38 LAYOUT COLUMN_DIR MATRIX_DIM 6 ECU_ADDRESS 0xfe4ce738 /* @ECU_Address@autosar_swc_vmp_rtARID_DEF.UnitDelay_DSTATE_f@ */ /end MEASUREMENT
/begin MEASUREMENT autosar_swc_vmp_rtARID_DEF.UnitDelay_DSTATE_g "" FLOAT32_IEEE autosar_swc_vmp_CM_single 0 0 -3.4E+38 3.4E+38 ECU_ADDRESS 0xfe4d40fc /* @ECU_Address@autosar_swc_vmp_rtARID_DEF.UnitDelay_DSTATE_g@ */ /end MEASUREMENT
/begin MEASUREMENT autosar_swc_vmp_rtARID_DEF.UnitDelay_DSTATE_i "" FLOAT32_IEEE autosar_swc_vmp_CM_single 0 0 -3.4E+38 3.4E+38 ECU_ADDRESS 0xfe4d40b4 /* @ECU_Address@autosar_swc_vmp_rtARID_DEF.UnitDelay_DSTATE_i@ */ /end MEASUREMENT
/begin MEASUREMENT autosar_swc_vmp_rtARID_DEF.UnitDelay_DSTATE_ix "" FLOAT32_IEEE autosar_swc_vmp_CM_single 0 0 -3.4E+38 3.4E+38 ECU_ADDRESS 0xfe4d40ec /* @ECU_Address@autosar_swc_vmp_rtARID_DEF.UnitDelay_DSTATE_ix@ */ /end MEASUREMENT
/begin MEASUREMENT autosar_swc_vmp_rtARID_DEF.UnitDelay_DSTATE_j "" FLOAT32_IEEE autosar_swc_vmp_CM_single 0 0 -3.4E+38 3.4E+38 ECU_ADDRESS 0xfe4d40f0 /* @ECU_Address@autosar_swc_vmp_rtARID_DEF.UnitDelay_DSTATE_j@ */ /end MEASUREMENT
/begin MEASUREMENT autosar_swc_vmp_rtARID_DEF.UnitDelay_DSTATE_m "" FLOAT32_IEEE autosar_swc_vmp_CM_single 0 0 -3.4E+38 3.4E+38 ECU_ADDRESS 0xfe4d40f4 /* @ECU_Address@autosar_swc_vmp_rtARID_DEF.UnitDelay_DSTATE_m@ */ /end MEASUREMENT
/begin MEASUREMENT autosar_swc_vmp_rtARID_DEF.UnitDelay_DSTATE_o "" FLOAT32_IEEE autosar_swc_vmp_CM_single 0 0 -3.4E+38 3.4E+38 ECU_ADDRESS 0xfe4d4108 /* @ECU_Address@autosar_swc_vmp_rtARID_DEF.UnitDelay_DSTATE_o@ */ /end MEASUREMENT
/begin MEASUREMENT autosar_swc_vmp_rtARID_DEF.UnitDelay_DSTATE_ol "" UBYTE autosar_swc_vmp_CM_uint8 0 0 0 255 ECU_ADDRESS 0xfe4d423e /* @ECU_Address@autosar_swc_vmp_rtARID_DEF.UnitDelay_DSTATE_ol@ */ /end MEASUREMENT
/begin MEASUREMENT autosar_swc_vmp_rtARID_DEF.UnitDelay_DSTATE_p "" FLOAT32_IEEE autosar_swc_vmp_CM_single 0 0 -3.4E+38 3.4E+38 ECU_ADDRESS 0xfe4d4100 /* @ECU_Address@autosar_swc_vmp_rtARID_DEF.UnitDelay_DSTATE_p@ */ /end MEASUREMENT
/begin MEASUREMENT autosar_swc_vmp_rtARID_DEF.UnitDelay_DSTATE_pl "" FLOAT32_IEEE autosar_swc_vmp_CM_single 0 0 -3.4E+38 3.4E+38 ECU_ADDRESS 0xfe4d411c /* @ECU_Address@autosar_swc_vmp_rtARID_DEF.UnitDelay_DSTATE_pl@ */ /end MEASUREMENT
/begin MEASUREMENT autosar_swc_vmp_rtARID_DEF.accelDesInsertSpace_Out "" FLOAT32_IEEE autosar_swc_vmp_CM_single 0 0 -3.4E+38 3.4E+38 ECU_ADDRESS 0xfe4d407c /* @ECU_Address@autosar_swc_vmp_rtARID_DEF.accelDesInsertSpace_Out@ */ /end MEASUREMENT
/begin MEASUREMENT autosar_swc_vmp_rtARID_DEF.accelForce "" FLOAT32_IEEE autosar_swc_vmp_CM_single 0 0 -3.4E+38 3.4E+38 ECU_ADDRESS 0xfe4d414c /* @ECU_Address@autosar_swc_vmp_rtARID_DEF.accelForce@ */ /end MEASUREMENT
/begin MEASUREMENT autosar_swc_vmp_rtARID_DEF.accelForceClear "" UBYTE autosar_swc_vmp_CM_logical 0 0 0 1 ECU_ADDRESS 0xfe4d429f /* @ECU_Address@autosar_swc_vmp_rtARID_DEF.accelForceClear@ */ /end MEASUREMENT
/begin MEASUREMENT autosar_swc_vmp_rtARID_DEF.accelMaxAL "" FLOAT32_IEEE autosar_swc_vmp_CM_single 0 0 -3.4E+38 3.4E+38 ECU_ADDRESS 0xfe4d4160 /* @ECU_Address@autosar_swc_vmp_rtARID_DEF.accelMaxAL@ */ /end MEASUREMENT
/begin MEASUREMENT autosar_swc_vmp_rtARID_DEF.accelSlopeAssist "" FLOAT32_IEEE autosar_swc_vmp_CM_single 0 0 -3.4E+38 3.4E+38 ECU_ADDRESS 0xfe4d4038 /* @ECU_Address@autosar_swc_vmp_rtARID_DEF.accelSlopeAssist@ */ /end MEASUREMENT
/begin MEASUREMENT autosar_swc_vmp_rtARID_DEF.accelTargAbsFiltP0K1 "" FLOAT32_IEEE autosar_swc_vmp_CM_single 0 0 -3.4E+38 3.4E+38 ECU_ADDRESS 0xfe4d4150 /* @ECU_Address@autosar_swc_vmp_rtARID_DEF.accelTargAbsFiltP0K1@ */ /end MEASUREMENT
/begin MEASUREMENT autosar_swc_vmp_rtARID_DEF.accelTargAbsFiltP1K1 "" FLOAT32_IEEE autosar_swc_vmp_CM_single 0 0 -3.4E+38 3.4E+38 ECU_ADDRESS 0xfe4d415c /* @ECU_Address@autosar_swc_vmp_rtARID_DEF.accelTargAbsFiltP1K1@ */ /end MEASUREMENT
/begin MEASUREMENT autosar_swc_vmp_rtARID_DEF.accelTargAbsFiltP2K1 "" FLOAT32_IEEE autosar_swc_vmp_CM_single 0 0 -3.4E+38 3.4E+38 ECU_ADDRESS 0xfe4d4154 /* @ECU_Address@autosar_swc_vmp_rtARID_DEF.accelTargAbsFiltP2K1@ */ /end MEASUREMENT
/begin MEASUREMENT autosar_swc_vmp_rtARID_DEF.accelTargAbsFiltP3K1 "" FLOAT32_IEEE autosar_swc_vmp_CM_single 0 0 -3.4E+38 3.4E+38 ECU_ADDRESS 0xfe4d4158 /* @ECU_Address@autosar_swc_vmp_rtARID_DEF.accelTargAbsFiltP3K1@ */ /end MEASUREMENT
/begin MEASUREMENT autosar_swc_vmp_rtARID_DEF.acceleratejerk "" FLOAT32_IEEE autosar_swc_vmp_CM_single 0 0 -3.4E+38 3.4E+38 ECU_ADDRESS 0xfe4d406c /* @ECU_Address@autosar_swc_vmp_rtARID_DEF.acceleratejerk@ */ /end MEASUREMENT
/begin MEASUREMENT autosar_swc_vmp_rtARID_DEF.ax "" FLOAT32_IEEE autosar_swc_vmp_CM_single 0 0 -3.4E+38 3.4E+38 LAYOUT COLUMN_DIR MATRIX_DIM 1 10 ECU_ADDRESS 0xfe4ce710 /* @ECU_Address@autosar_swc_vmp_rtARID_DEF.ax@ */ /end MEASUREMENT
/begin MEASUREMENT autosar_swc_vmp_rtARID_DEF.coefStandstillOverride "" FLOAT32_IEEE autosar_swc_vmp_CM_single 0 0 -3.4E+38 3.4E+38 ECU_ADDRESS 0xfe4d403c /* @ECU_Address@autosar_swc_vmp_rtARID_DEF.coefStandstillOverride@ */ /end MEASUREMENT
/begin MEASUREMENT autosar_swc_vmp_rtARID_DEF.coefVelDist2Accel "" FLOAT32_IEEE autosar_swc_vmp_CM_single 0 0 -3.4E+38 3.4E+38 ECU_ADDRESS 0xfe4d4034 /* @ECU_Address@autosar_swc_vmp_rtARID_DEF.coefVelDist2Accel@ */ /end MEASUREMENT
/begin MEASUREMENT autosar_swc_vmp_rtARID_DEF.counter "" FLOAT32_IEEE autosar_swc_vmp_CM_single 0 0 -3.4E+38 3.4E+38 ECU_ADDRESS 0xfe4d4148 /* @ECU_Address@autosar_swc_vmp_rtARID_DEF.counter@ */ /end MEASUREMENT
/begin MEASUREMENT autosar_swc_vmp_rtARID_DEF.ctrlState "" FLOAT64_IEEE autosar_swc_vmp_CM_double 0 0 -1.7E+308 1.7E+308 ECU_ADDRESS 0xfe4ce630 /* @ECU_Address@autosar_swc_vmp_rtARID_DEF.ctrlState@ */ /end MEASUREMENT
/begin MEASUREMENT autosar_swc_vmp_rtARID_DEF.deceleratejerk "" FLOAT32_IEEE autosar_swc_vmp_CM_single 0 0 -3.4E+38 3.4E+38 ECU_ADDRESS 0xfe4d4070 /* @ECU_Address@autosar_swc_vmp_rtARID_DEF.deceleratejerk@ */ /end MEASUREMENT
/begin MEASUREMENT autosar_swc_vmp_rtARID_DEF.disEIntegrate "" FLOAT32_IEEE autosar_swc_vmp_CM_single 0 0 -3.4E+38 3.4E+38 ECU_ADDRESS 0xfe4d4144 /* @ECU_Address@autosar_swc_vmp_rtARID_DEF.disEIntegrate@ */ /end MEASUREMENT
/begin MEASUREMENT autosar_swc_vmp_rtARID_DEF.disErorK1 "" FLOAT32_IEEE autosar_swc_vmp_CM_single 0 0 -3.4E+38 3.4E+38 ECU_ADDRESS 0xfe4d4140 /* @ECU_Address@autosar_swc_vmp_rtARID_DEF.disErorK1@ */ /end MEASUREMENT
/begin MEASUREMENT autosar_swc_vmp_rtARID_DEF.dx "" FLOAT32_IEEE autosar_swc_vmp_CM_single 0 0 -3.4E+38 3.4E+38 LAYOUT COLUMN_DIR MATRIX_DIM 1 10 ECU_ADDRESS 0xfe4ce6c0 /* @ECU_Address@autosar_swc_vmp_rtARID_DEF.dx@ */ /end MEASUREMENT
/begin MEASUREMENT autosar_swc_vmp_rtARID_DEF.dxSensObj_modify "" FLOAT32_IEEE autosar_swc_vmp_CM_single 0 0 -3.4E+38 3.4E+38 ECU_ADDRESS 0xfe4d412c /* @ECU_Address@autosar_swc_vmp_rtARID_DEF.dxSensObj_modify@ */ /end MEASUREMENT
/begin MEASUREMENT autosar_swc_vmp_rtARID_DEF.fastDecelK1 "" FLOAT64_IEEE autosar_swc_vmp_CM_double 0 0 -1.7E+308 1.7E+308 ECU_ADDRESS 0xfe4ce648 /* @ECU_Address@autosar_swc_vmp_rtARID_DEF.fastDecelK1@ */ /end MEASUREMENT
/begin MEASUREMENT autosar_swc_vmp_rtARID_DEF.is_DriveOff_Follow "" UBYTE autosar_swc_vmp_CM_uint8 0 0 0 255 ECU_ADDRESS 0xfe4d424d /* @ECU_Address@autosar_swc_vmp_rtARID_DEF.is_DriveOff_Follow@ */ /end MEASUREMENT
/begin MEASUREMENT autosar_swc_vmp_rtARID_DEF.is_TargetRel "" UBYTE autosar_swc_vmp_CM_uint8 0 0 0 255 ECU_ADDRESS 0xfe4d4255 /* @ECU_Address@autosar_swc_vmp_rtARID_DEF.is_TargetRel@ */ /end MEASUREMENT
/begin MEASUREMENT autosar_swc_vmp_rtARID_DEF.is_active_c32_autosar_swc_vmp "" UBYTE autosar_swc_vmp_CM_uint8 0 0 0 255 ECU_ADDRESS 0xfe4d4256 /* @ECU_Address@autosar_swc_vmp_rtARID_DEF.is_active_c32_autosar_swc_vmp@ */ /end MEASUREMENT
/begin MEASUREMENT autosar_swc_vmp_rtARID_DEF.is_active_c39_autosar_swc_vmp "" UBYTE autosar_swc_vmp_CM_uint8 0 0 0 255 ECU_ADDRESS 0xfe4d4258 /* @ECU_Address@autosar_swc_vmp_rtARID_DEF.is_active_c39_autosar_swc_vmp@ */ /end MEASUREMENT
/begin MEASUREMENT autosar_swc_vmp_rtARID_DEF.is_active_c858_autosar_swc_vmp "" UBYTE autosar_swc_vmp_CM_uint8 0 0 0 255 ECU_ADDRESS 0xfe4d4253 /* @ECU_Address@autosar_swc_vmp_rtARID_DEF.is_active_c858_autosar_swc_vmp@ */ /end MEASUREMENT
/begin MEASUREMENT autosar_swc_vmp_rtARID_DEF.is_active_c891_autosar_swc_vmp "" UBYTE autosar_swc_vmp_CM_uint8 0 0 0 255 ECU_ADDRESS 0xfe4d424e /* @ECU_Address@autosar_swc_vmp_rtARID_DEF.is_active_c891_autosar_swc_vmp@ */ /end MEASUREMENT
/begin MEASUREMENT autosar_swc_vmp_rtARID_DEF.is_active_c892_autosar_swc_vmp "" UBYTE autosar_swc_vmp_CM_uint8 0 0 0 255 ECU_ADDRESS 0xfe4d424b /* @ECU_Address@autosar_swc_vmp_rtARID_DEF.is_active_c892_autosar_swc_vmp@ */ /end MEASUREMENT
/begin MEASUREMENT autosar_swc_vmp_rtARID_DEF.is_c32_autosar_swc_vmp "" UBYTE autosar_swc_vmp_CM_uint8 0 0 0 255 ECU_ADDRESS 0xfe4d4257 /* @ECU_Address@autosar_swc_vmp_rtARID_DEF.is_c32_autosar_swc_vmp@ */ /end MEASUREMENT
/begin MEASUREMENT autosar_swc_vmp_rtARID_DEF.is_c39_autosar_swc_vmp "" UBYTE autosar_swc_vmp_CM_uint8 0 0 0 255 ECU_ADDRESS 0xfe4d4259 /* @ECU_Address@autosar_swc_vmp_rtARID_DEF.is_c39_autosar_swc_vmp@ */ /end MEASUREMENT
/begin MEASUREMENT autosar_swc_vmp_rtARID_DEF.is_c858_autosar_swc_vmp "" UBYTE autosar_swc_vmp_CM_uint8 0 0 0 255 ECU_ADDRESS 0xfe4d4254 /* @ECU_Address@autosar_swc_vmp_rtARID_DEF.is_c858_autosar_swc_vmp@ */ /end MEASUREMENT
/begin MEASUREMENT autosar_swc_vmp_rtARID_DEF.is_c891_autosar_swc_vmp "" UBYTE autosar_swc_vmp_CM_uint8 0 0 0 255 ECU_ADDRESS 0xfe4d424f /* @ECU_Address@autosar_swc_vmp_rtARID_DEF.is_c891_autosar_swc_vmp@ */ /end MEASUREMENT
/begin MEASUREMENT autosar_swc_vmp_rtARID_DEF.is_c892_autosar_swc_vmp "" UBYTE autosar_swc_vmp_CM_uint8 0 0 0 255 ECU_ADDRESS 0xfe4d424c /* @ECU_Address@autosar_swc_vmp_rtARID_DEF.is_c892_autosar_swc_vmp@ */ /end MEASUREMENT
/begin MEASUREMENT autosar_swc_vmp_rtARID_DEF.lowerJerkOverride "" FLOAT32_IEEE autosar_swc_vmp_CM_single 0 0 -3.4E+38 3.4E+38 ECU_ADDRESS 0xfe4d4040 /* @ECU_Address@autosar_swc_vmp_rtARID_DEF.lowerJerkOverride@ */ /end MEASUREMENT
/begin MEASUREMENT autosar_swc_vmp_rtARID_DEF.tStartUpEnable "" FLOAT32_IEEE autosar_swc_vmp_CM_single 0 0 -3.4E+38 3.4E+38 ECU_ADDRESS 0xfe4d4134 /* @ECU_Address@autosar_swc_vmp_rtARID_DEF.tStartUpEnable@ */ /end MEASUREMENT
/begin MEASUREMENT autosar_swc_vmp_rtARID_DEF.timestep "" FLOAT32_IEEE autosar_swc_vmp_CM_single 0 0 -3.4E+38 3.4E+38 ECU_ADDRESS 0xfe4d4130 /* @ECU_Address@autosar_swc_vmp_rtARID_DEF.timestep@ */ /end MEASUREMENT
/begin MEASUREMENT autosar_swc_vmp_rtARID_DEF.velDesArray_kph "" FLOAT32_IEEE autosar_swc_vmp_CM_single 0 0 -3.4E+38 3.4E+38 LAYOUT COLUMN_DIR MATRIX_DIM 10 1 ECU_ADDRESS 0xfe4ce658 /* @ECU_Address@autosar_swc_vmp_rtARID_DEF.velDesArray_kph@ */ /end MEASUREMENT
/begin MEASUREMENT autosar_swc_vmp_rtARID_DEF.velEIntegrate "" FLOAT32_IEEE autosar_swc_vmp_CM_single 0 0 -3.4E+38 3.4E+38 ECU_ADDRESS 0xfe4d4138 /* @ECU_Address@autosar_swc_vmp_rtARID_DEF.velEIntegrate@ */ /end MEASUREMENT
/begin MEASUREMENT autosar_swc_vmp_rtARID_DEF.velErorK1 "" FLOAT32_IEEE autosar_swc_vmp_CM_single 0 0 -3.4E+38 3.4E+38 ECU_ADDRESS 0xfe4d413c /* @ECU_Address@autosar_swc_vmp_rtARID_DEF.velErorK1@ */ /end MEASUREMENT
/begin MEASUREMENT autosar_swc_vmp_rtARID_DEF.vx "" FLOAT32_IEEE autosar_swc_vmp_CM_single 0 0 -3.4E+38 3.4E+38 LAYOUT COLUMN_DIR MATRIX_DIM 1 10 ECU_ADDRESS 0xfe4ce6e8 /* @ECU_Address@autosar_swc_vmp_rtARID_DEF.vx@ */ /end MEASUREMENT
/begin AXIS_PTS P_LONP_ALvAcceleLowerChar "" 0xfe829534 /* @ECU_Address@P_LONP_ALvAcceleLowerChar@ */ NO_INPUT_QUANTITY Axis_FLOAT32_IEEE 0 autosar_swc_vmp_CM_single_m_per_s 4 0.000000 70.000000 /end AXIS_PTS
/begin AXIS_PTS P_LONP_ALvAcceleUpperCharEco "" 0xfe829ac0 /* @ECU_Address@P_LONP_ALvAcceleUpperCharEco@ */ NO_INPUT_QUANTITY Axis_FLOAT32_IEEE 0 autosar_swc_vmp_CM_single_m_per_s 15 0.000000 70.000000 /end AXIS_PTS
/begin AXIS_PTS P_LONP_ALvAcceleUpperCharLaneChange "" 0xfe829afc /* @ECU_Address@P_LONP_ALvAcceleUpperCharLaneChange@ */ NO_INPUT_QUANTITY Axis_FLOAT32_IEEE 0 autosar_swc_vmp_CM_single_m_per_s 15 0.000000 100.000000 /end AXIS_PTS
/begin AXIS_PTS P_LONP_ALvAcceleUpperCharNormal "" 0xfe829b38 /* @ECU_Address@P_LONP_ALvAcceleUpperCharNormal@ */ NO_INPUT_QUANTITY Axis_FLOAT32_IEEE 0 autosar_swc_vmp_CM_single_m_per_s 7 0.000000 70.000000 /end AXIS_PTS
/begin AXIS_PTS P_LONP_ALvAcceleUpperCharRampMerge "" 0xfe829b54 /* @ECU_Address@P_LONP_ALvAcceleUpperCharRampMerge@ */ NO_INPUT_QUANTITY Axis_FLOAT32_IEEE 0 autosar_swc_vmp_CM_single 15 -3.4E+38 3.4E+38 /end AXIS_PTS
/begin AXIS_PTS P_LONP_ALvAcceleUpperCharSport "" 0xfe829b90 /* @ECU_Address@P_LONP_ALvAcceleUpperCharSport@ */ NO_INPUT_QUANTITY Axis_FLOAT32_IEEE 0 autosar_swc_vmp_CM_single_m_per_s 15 0.000000 70.000000 /end AXIS_PTS
/begin AXIS_PTS P_LONP_DistTerCofX1Axis "" 0xfe82959c /* @ECU_Address@P_LONP_DistTerCofX1Axis@ */ NO_INPUT_QUANTITY Axis_FLOAT32_IEEE 0 autosar_swc_vmp_CM_single 10 -3.4E+38 3.4E+38 /end AXIS_PTS
/begin AXIS_PTS P_LONP_DistTerCofX2Axis "" 0xfe829c54 /* @ECU_Address@P_LONP_DistTerCofX2Axis@ */ NO_INPUT_QUANTITY Axis_FLOAT32_IEEE 0 autosar_swc_vmp_CM_single 11 -3.4E+38 3.4E+38 /end AXIS_PTS
/begin AXIS_PTS P_LONP_FollowAccelAddSlopeAssistXAxis "" 0xfe829048 /* @ECU_Address@P_LONP_FollowAccelAddSlopeAssistXAxis@ */ NO_INPUT_QUANTITY Axis_FLOAT32_IEEE 0 autosar_swc_vmp_CM_single_m_per_s_2 2 0.000000 4.000000 /end AXIS_PTS
/begin AXIS_PTS P_LONP_FollowAccelCharNegVlcAcc2CoefEnlargeAccelJerkXAxis "" 0xfe829c80 /* @ECU_Address@P_LONP_FollowAccelCharNegVlcAcc2CoefEnlargeAccelJerkXAxis@ */ NO_INPUT_QUANTITY Axis_FLOAT32_IEEE 0 autosar_swc_vmp_CM_single_m_per_s_2 3 -5.000000 3.000000 /end AXIS_PTS
/begin AXIS_PTS P_LONP_FollowDecelJerkDiffTTC2GapCorrXAxis "" 0xfe829068 /* @ECU_Address@P_LONP_FollowDecelJerkDiffTTC2GapCorrXAxis@ */ NO_INPUT_QUANTITY Axis_FLOAT32_IEEE 0 autosar_swc_vmp_CM_single_s 2 0.000000 25.000000 /end AXIS_PTS
/begin AXIS_PTS P_LONP_FollowDecelJerkForceSlopeXAxis "" 0xfe829078 /* @ECU_Address@P_LONP_FollowDecelJerkForceSlopeXAxis@ */ NO_INPUT_QUANTITY Axis_FLOAT32_IEEE 0 autosar_swc_vmp_CM_single_m_per_s_2 2 0.000000 4.000000 /end AXIS_PTS
/begin AXIS_PTS P_LONP_FollowVelCharAccelJerkXAxis "" 0xfe829cb4 /* @ECU_Address@P_LONP_FollowVelCharAccelJerkXAxis@ */ NO_INPUT_QUANTITY Axis_FLOAT32_IEEE 0 autosar_swc_vmp_CM_single_m_per_s 7 0.000000 60.000000 /end AXIS_PTS
/begin AXIS_PTS P_LONP_FollowVelSubjNegToleranceAddX1Axis "" 0xfe8290b0 /* @ECU_Address@P_LONP_FollowVelSubjNegToleranceAddX1Axis@ */ NO_INPUT_QUANTITY Axis_FLOAT32_IEEE 0 autosar_swc_vmp_CM_single_m 2 0.000000 20.000000 /end AXIS_PTS
/begin AXIS_PTS P_LONP_FollowVelSubjNegToleranceAddX2Axis "" 0xfe8290b8 /* @ECU_Address@P_LONP_FollowVelSubjNegToleranceAddX2Axis@ */ NO_INPUT_QUANTITY Axis_FLOAT32_IEEE 0 autosar_swc_vmp_CM_single_m_per_s 2 -10.000000 0.000000 /end AXIS_PTS
/begin AXIS_PTS P_LONP_FollowVelSubjThresForceStopXAxis "" 0xfe8290c0 /* @ECU_Address@P_LONP_FollowVelSubjThresForceStopXAxis@ */ NO_INPUT_QUANTITY Axis_FLOAT32_IEEE 0 autosar_swc_vmp_CM_single_m_per_s_2 2 0.000000 4.000000 /end AXIS_PTS
/begin AXIS_PTS P_LONP_FollowWdCoefXAxis "" 0xfe829cd0 /* @ECU_Address@P_LONP_FollowWdCoefXAxis@ */ NO_INPUT_QUANTITY Axis_FLOAT32_IEEE 0 autosar_swc_vmp_CM_single 5 0.000000 20.000000 /end AXIS_PTS
/begin AXIS_PTS P_LONP_FollowWvCoefXAxis "" 0xfe829cf8 /* @ECU_Address@P_LONP_FollowWvCoefXAxis@ */ NO_INPUT_QUANTITY Axis_FLOAT32_IEEE 0 autosar_swc_vmp_CM_single 7 -20.000000 20.000000 /end AXIS_PTS
/begin AXIS_PTS P_LONP_FollowaccelFollowDesThresEnableStopXAxis "" 0xfe8290d0 /* @ECU_Address@P_LONP_FollowaccelFollowDesThresEnableStopXAxis@ */ NO_INPUT_QUANTITY Axis_FLOAT32_IEEE 0 autosar_swc_vmp_CM_single_m 2 0.000000 5.500000 /end AXIS_PTS
/begin AXIS_PTS P_LONP_FollowaccelForceStopMinCharXAxis "" 0xfe8290e0 /* @ECU_Address@P_LONP_FollowaccelForceStopMinCharXAxis@ */ NO_INPUT_QUANTITY Axis_FLOAT32_IEEE 0 autosar_swc_vmp_CM_single_m_per_s_2 2 0.000000 5.000000 /end AXIS_PTS
/begin AXIS_PTS P_LONP_FollowdecelJerkCharXAxis "" 0xfe8295f4 /* @ECU_Address@P_LONP_FollowdecelJerkCharXAxis@ */ NO_INPUT_QUANTITY Axis_FLOAT32_IEEE 0 autosar_swc_vmp_CM_single_s 6 0.000000 20.000000 /end AXIS_PTS
/begin AXIS_PTS P_LONP_FollowdistDesCompensionXAxis "" 0xfe8290f0 /* @ECU_Address@P_LONP_FollowdistDesCompensionXAxis@ */ NO_INPUT_QUANTITY Axis_FLOAT32_IEEE 0 autosar_swc_vmp_CM_single_m_per_s 2 0.000000 70.000000 /end AXIS_PTS
/begin AXIS_PTS P_LONP_FollowdistDesTimegapLevel "" 0xfe829624 /* @ECU_Address@P_LONP_FollowdistDesTimegapLevel@ */ NO_INPUT_QUANTITY Axis_FLOAT32_IEEE 0 autosar_swc_vmp_CM_single 10 -3.4E+38 3.4E+38 /end AXIS_PTS
/begin AXIS_PTS P_LONP_FollowdistDesX2Axis "" 0xfe82964c /* @ECU_Address@P_LONP_FollowdistDesX2Axis@ */ NO_INPUT_QUANTITY Axis_FLOAT32_IEEE 0 autosar_swc_vmp_CM_single_m_per_s 10 0.000000 70.000000 /end AXIS_PTS
/begin AXIS_PTS P_LONP_FollowjerkForceStopCharXAxis "" 0xfe829d30 /* @ECU_Address@P_LONP_FollowjerkForceStopCharXAxis@ */ NO_INPUT_QUANTITY Axis_FLOAT32_IEEE 0 autosar_swc_vmp_CM_single_m_per_s_2 3 0.000000 4.000000 /end AXIS_PTS
/begin AXIS_PTS P_LONP_FollowttcCorrDecelJerkXAxis "" 0xfe829d48 /* @ECU_Address@P_LONP_FollowttcCorrDecelJerkXAxis@ */ NO_INPUT_QUANTITY Axis_FLOAT32_IEEE 0 autosar_swc_vmp_CM_single_s 7 0.000000 200.000000 /end AXIS_PTS
/begin AXIS_PTS P_LONP_FollowvelSubjThresEnableStopAddXAxis "" 0xfe829100 /* @ECU_Address@P_LONP_FollowvelSubjThresEnableStopAddXAxis@ */ NO_INPUT_QUANTITY Axis_FLOAT32_IEEE 0 autosar_swc_vmp_CM_single_m 2 0.000000 3.500000 /end AXIS_PTS
/begin AXIS_PTS P_LONP_ICCurvatureLimitSpdXAxis "" 0xfe829d80 /* @ECU_Address@P_LONP_ICCurvatureLimitSpdXAxis@ */ NO_INPUT_QUANTITY Axis_FLOAT32_IEEE 0 autosar_swc_vmp_CM_single 15 0.000000 1.000000 /end AXIS_PTS
/begin AXIS_PTS P_LONP_ICKapLimitAccelXAxis "" 0xfe8296c4 /* @ECU_Address@P_LONP_ICKapLimitAccelXAxis@ */ NO_INPUT_QUANTITY Axis_FLOAT32_IEEE 0 autosar_swc_vmp_CM_single 10 0.000000 1.000000 /end AXIS_PTS
/begin AXIS_PTS P_LONP_ICKapLimitSpdXAxis "" 0xfe829df8 /* @ECU_Address@P_LONP_ICKapLimitSpdXAxis@ */ NO_INPUT_QUANTITY Axis_FLOAT32_IEEE 0 autosar_swc_vmp_CM_single 15 0.000000 1.000000 /end AXIS_PTS
/begin AXIS_PTS P_LONP_IC_HDMapAccelLimitXAxis "" 0xfe829110 /* @ECU_Address@P_LONP_IC_HDMapAccelLimitXAxis@ */ NO_INPUT_QUANTITY Axis_FLOAT32_IEEE 0 autosar_swc_vmp_CM_single 2 -3.4E+38 3.4E+38 /end AXIS_PTS
/begin AXIS_PTS P_LONP_ICcoefCurvatureCharX1 "" 0xfe829714 /* @ECU_Address@P_LONP_ICcoefCurvatureCharX1@ */ NO_INPUT_QUANTITY Axis_FLOAT32_IEEE 0 autosar_swc_vmp_CM_single_1_per_m 4 0.000000 1.000000 /end AXIS_PTS
/begin AXIS_PTS P_LONP_ICcoefCurvatureCharX2 "" 0xfe829724 /* @ECU_Address@P_LONP_ICcoefCurvatureCharX2@ */ NO_INPUT_QUANTITY Axis_FLOAT32_IEEE 0 autosar_swc_vmp_CM_single_1_per_m 4 0.000000 1.000000 /end AXIS_PTS
/begin AXIS_PTS P_LONP_IClowerJerkICCharXAxis "" 0xfe829e70 /* @ECU_Address@P_LONP_IClowerJerkICCharXAxis@ */ NO_INPUT_QUANTITY Axis_FLOAT32_IEEE 0 autosar_swc_vmp_CM_single_m_per_s_2 3 -5.000000 2.000000 /end AXIS_PTS
/begin AXIS_PTS P_LONP_ICupperJerkICCharXAxis "" 0xfe829774 /* @ECU_Address@P_LONP_ICupperJerkICCharXAxis@ */ NO_INPUT_QUANTITY Axis_FLOAT32_IEEE 0 autosar_swc_vmp_CM_single_m_per_s_2 4 -2.000000 2.000000 /end AXIS_PTS
/begin AXIS_PTS P_LONP_ORDAccelThrdSpdXAxis "" 0xfe829ecc /* @ECU_Address@P_LONP_ORDAccelThrdSpdXAxis@ */ NO_INPUT_QUANTITY Axis_FLOAT32_IEEE 0 autosar_swc_vmp_CM_single_km_per_h 7 0.000000 200.000000 /end AXIS_PTS
/begin AXIS_PTS P_LONP_Override2ActiveTimeCnt "" 0xfe829f5c /* @ECU_Address@P_LONP_Override2ActiveTimeCnt@ */ NO_INPUT_QUANTITY Axis_FLOAT32_IEEE 0 autosar_swc_vmp_CM_single 11 -3.4E+38 3.4E+38 /end AXIS_PTS
/begin AXIS_PTS P_LONP_P0axAbsValueforFilter "" 0xfe829f9c /* @ECU_Address@P_LONP_P0axAbsValueforFilter@ */ NO_INPUT_QUANTITY Axis_FLOAT32_IEEE 0 autosar_swc_vmp_CM_single 5 -3.4E+38 3.4E+38 /end AXIS_PTS
/begin AXIS_PTS P_LONP_SpdForFollowDecelCal "" 0xfe8297d4 /* @ECU_Address@P_LONP_SpdForFollowDecelCal@ */ NO_INPUT_QUANTITY Axis_FLOAT32_IEEE 0 autosar_swc_vmp_CM_single 4 -3.4E+38 3.4E+38 /end AXIS_PTS
/begin AXIS_PTS P_LONP_SpdStopCtrlVehSpdXAxis "" 0xfe829fdc /* @ECU_Address@P_LONP_SpdStopCtrlVehSpdXAxis@ */ NO_INPUT_QUANTITY Axis_FLOAT32_IEEE 0 autosar_swc_vmp_CM_single 11 -3.4E+38 3.4E+38 /end AXIS_PTS
/begin AXIS_PTS P_LONP_TTCConsiderAccelTimeXaxis "" 0xfe8297e4 /* @ECU_Address@P_LONP_TTCConsiderAccelTimeXaxis@ */ NO_INPUT_QUANTITY Axis_FLOAT32_IEEE 0 autosar_swc_vmp_CM_single 12 -3.4E+38 3.4E+38 /end AXIS_PTS
/begin AXIS_PTS P_LONP_TruckFollowdistDesX2Axis "" 0xfe829844 /* @ECU_Address@P_LONP_TruckFollowdistDesX2Axis@ */ NO_INPUT_QUANTITY Axis_FLOAT32_IEEE 0 autosar_swc_vmp_CM_single 10 -3.4E+38 3.4E+38 /end AXIS_PTS
/begin AXIS_PTS P_LONP_VelRelP0DistCofX "" 0xfe829894 /* @ECU_Address@P_LONP_VelRelP0DistCofX@ */ NO_INPUT_QUANTITY Axis_FLOAT32_IEEE 0 autosar_swc_vmp_CM_single 4 -3.4E+38 3.4E+38 /end AXIS_PTS
/begin AXIS_PTS P_LONP_axvRoadSlopeMs2StopCtrl "" 0xfe8298cc /* @ECU_Address@P_LONP_axvRoadSlopeMs2StopCtrl@ */ NO_INPUT_QUANTITY Axis_FLOAT32_IEEE 0 autosar_swc_vmp_CM_single 6 -3.4E+38 3.4E+38 /end AXIS_PTS
/begin AXIS_PTS P_LONP_distThreDecToStopXAxis "" 0xfe82a008 /* @ECU_Address@P_LONP_distThreDecToStopXAxis@ */ NO_INPUT_QUANTITY Axis_FLOAT32_IEEE 0 autosar_swc_vmp_CM_single_m_per_s_2 3 0.000000 5.000000 /end AXIS_PTS
/begin AXIS_PTS P_LONP_roadEndDis "" 0xfe8298fc /* @ECU_Address@P_LONP_roadEndDis@ */ NO_INPUT_QUANTITY Axis_FLOAT32_IEEE 0 autosar_swc_vmp_CM_single 4 -3.4E+38 3.4E+38 /end AXIS_PTS
/begin AXIS_PTS P_LONP_tDecelXAxis "" 0xfe82990c /* @ECU_Address@P_LONP_tDecelXAxis@ */ NO_INPUT_QUANTITY Axis_FLOAT32_IEEE 0 autosar_swc_vmp_CM_single 4 -3.4E+38 3.4E+38 /end AXIS_PTS
/begin AXIS_PTS P_PLAN_DPC_xiangduisudu_kmh "" 0xfe82a418 /* @ECU_Address@P_PLAN_DPC_xiangduisudu_kmh@ */ NO_INPUT_QUANTITY Axis_FLOAT32_IEEE 0 autosar_swc_vmp_CM_single 24 -3.4E+38 3.4E+38 /end AXIS_PTS
/begin COMPU_METHOD autosar_swc_vmp_CM_boolean "Q = V" IDENTICAL "%1.0" "" /end COMPU_METHOD
/begin COMPU_METHOD autosar_swc_vmp_CM_double "Q = V" IDENTICAL "%15.10" "" /end COMPU_METHOD
/begin COMPU_METHOD autosar_swc_vmp_CM_logical "Q = V" IDENTICAL "%1.0" "" /end COMPU_METHOD
/begin COMPU_METHOD autosar_swc_vmp_CM_single "Q = V" IDENTICAL "%8.6" "" /end COMPU_METHOD
/begin COMPU_METHOD autosar_swc_vmp_CM_single_1_per_m "Q = V" IDENTICAL "%8.6" "1/m" /end COMPU_METHOD
/begin COMPU_METHOD autosar_swc_vmp_CM_single_km_per_h "Q = V" IDENTICAL "%8.6" "km/h" /end COMPU_METHOD
/begin COMPU_METHOD autosar_swc_vmp_CM_single_m "Q = V" IDENTICAL "%8.6" "m" /end COMPU_METHOD
/begin COMPU_METHOD autosar_swc_vmp_CM_single_m_per_s "Q = V" IDENTICAL "%8.6" "m/s" /end COMPU_METHOD
/begin COMPU_METHOD autosar_swc_vmp_CM_single_m_per_s_2 "Q = V" IDENTICAL "%8.6" "m/s^2" /end COMPU_METHOD
/begin COMPU_METHOD autosar_swc_vmp_CM_single_m_per_s_3 "Q = V" IDENTICAL "%8.6" "m/s^3" /end COMPU_METHOD
/begin COMPU_METHOD autosar_swc_vmp_CM_single_s "Q = V" IDENTICAL "%8.6" "s" /end COMPU_METHOD
/begin COMPU_METHOD autosar_swc_vmp_CM_uint16 "Q = V" IDENTICAL "%5.0" "" /end COMPU_METHOD
/begin COMPU_METHOD autosar_swc_vmp_CM_uint32 "Q = V" IDENTICAL "%10.0" "" /end COMPU_METHOD
/begin COMPU_METHOD autosar_swc_vmp_CM_uint8 "Q = V" IDENTICAL "%3.0" "" /end COMPU_METHOD
/begin RECORD_LAYOUT Record_BOOLEAN FNC_VALUES 1 UBYTE COLUMN_DIR DIRECT /end RECORD_LAYOUT
/begin RECORD_LAYOUT Record_FLOAT32_IEEE FNC_VALUES 1 FLOAT32_IEEE COLUMN_DIR DIRECT /end RECORD_LAYOUT
/begin RECORD_LAYOUT Record_FLOAT64_IEEE FNC_VALUES 1 FLOAT64_IEEE COLUMN_DIR DIRECT /end RECORD_LAYOUT
/begin RECORD_LAYOUT Record_UBYTE FNC_VALUES 1 UBYTE COLUMN_DIR DIRECT /end RECORD_LAYOUT
/begin RECORD_LAYOUT Axis_FLOAT32_IEEE AXIS_PTS_X 1 FLOAT32_IEEE INDEX_INCR DIRECT /end RECORD_LAYOUT
/begin GROUP autosar_swc_vmp_autosar_swc_vmp_Step_sys_lgt_pln_Subsystem2 "autosar_swc_vmp/autosar_swc_vmp_Step_sys/lgt_pln/Subsystem2"
 /begin REF_CHARACTERISTIC P_LONP_P0axAbsFilterGain P_LONP_P0axAbsValueforFilter P_LONP_RangeThresValueSW /end REF_CHARACTERISTIC
/end GROUP
/begin GROUP autosar_swc_vmp_autosar_swc_vmp_Step_sys_lgt_pln_Subsystem3 "autosar_swc_vmp/autosar_swc_vmp_Step_sys/lgt_pln/Subsystem3" /begin REF_CHARACTERISTIC P_LONP_BicycleOrPedP1BrakeSW /end REF_CHARACTERISTIC /end GROUP
/begin GROUP autosar_swc_vmp_autosar_swc_vmp_Step_sys_lgt_pln_Subsystem_Reference "autosar_swc_vmp/autosar_swc_vmp_Step_sys/lgt_pln/Subsystem Reference"
 /begin SUB_GROUP autosar_swc_vmp_autosar_swc_vmp_Step_sys_lgt_pln_Subsystem_Reference_Subsystem autosar_swc_vmp_autosar_swc_vmp_Step_sys_lgt_pln_Subsystem_Reference_Subsystem_Reference /end SUB_GROUP
/end GROUP
/begin GROUP autosar_swc_vmp_autosar_swc_vmp_Step_sys_lgt_pln_Subsystem_Reference_Subsystem "autosar_swc_vmp/autosar_swc_vmp_Step_sys/lgt_pln/Subsystem Reference/Subsystem"
 /begin REF_MEASUREMENT autosar_swc_vmp_rtARID_DEF.InsertIOut_lowerBandInsertSpace autosar_swc_vmp_rtARID_DEF.InsertIOut_lowerJerkInsertSpace autosar_swc_vmp_rtARID_DEF.InsertIOut_upperBandInsertSpace autosar_swc_vmp_rtARID_DEF.InsertIOut_upperJerkInsertSpace autosar_swc_vmp_rtARID_DEF.Insert_CollsnCheck_Letgo autosar_swc_vmp_rtARID_DEF.accelDesInsertSpace_Out /end REF_MEASUREMENT
/end GROUP
/begin GROUP autosar_swc_vmp_autosar_swc_vmp_Step_sys_lgt_pln_Subsystem_Reference_Subsystem_Reference "autosar_swc_vmp/autosar_swc_vmp_Step_sys/lgt_pln/Subsystem Reference/Subsystem Reference"
 /begin SUB_GROUP autosar_swc_vmp_autosar_swc_vmp_Step_sys_lgt_pln_Subsystem_Reference_Subsystem_Reference_Subsystem /end SUB_GROUP
 /begin REF_MEASUREMENT InsertIOut_InsertSpace_St InsertIOut_accelDesInsertSpaceLC_Out autosar_swc_vmp_rtARID_DEF.accelDesInsertSpace_Out /end REF_MEASUREMENT
/end GROUP
/begin GROUP autosar_swc_vmp_autosar_swc_vmp_Step_sys_lgt_pln_Subsystem_Reference_Subsystem_Reference_Subsystem "autosar_swc_vmp/autosar_swc_vmp_Step_sys/lgt_pln/Subsystem Reference/Subsystem Reference/Subsystem"
 /begin SUB_GROUP autosar_swc_vmp_autosar_swc_vmp_Step_sys_lgt_pln_Subsystem_Reference_Subsystem_Reference_Subsystem_Compare_To_Constant1 autosar_swc_vmp_autosar_swc_vmp_Step_sys_lgt_pln_Subsystem_Reference_Subsystem_Reference_Subsystem_Compare_To_Constant2 autosar_swc_vmp_autosar_swc_vmp_Step_sys_lgt_pln_Subsystem_Reference_Subsystem_Reference_Subsystem_Compare_To_Constant3 /end SUB_GROUP
 /begin REF_MEASUREMENT autosar_swc_vmp_rtARID_DEF.InsertIOut_lowerBandInsertSpace autosar_swc_vmp_rtARID_DEF.InsertIOut_lowerJerkInsertSpace autosar_swc_vmp_rtARID_DEF.InsertIOut_upperBandInsertSpace autosar_swc_vmp_rtARID_DEF.InsertIOut_upperJerkInsertSpace autosar_swc_vmp_rtARID_DEF.Insert_CollsnCheck_Letgo autosar_swc_vmp_rtARID_DEF.LastSpacenum autosar_swc_vmp_rtARID_DEF.P0ax autosar_swc_vmp_rtARID_DEF.P0dx autosar_swc_vmp_rtARID_DEF.P0vx autosar_swc_vmp_rtARID_DEF.SpdIntentionOn autosar_swc_vmp_rtARID_DEF.accelDesInsertSpace_Out autosar_swc_vmp_rtARID_DEF.ax autosar_swc_vmp_rtARID_DEF.dx autosar_swc_vmp_rtARID_DEF.vx /end REF_MEASUREMENT
/end GROUP
/begin GROUP autosar_swc_vmp_autosar_swc_vmp_Step_sys_lgt_pln_lonap_accelCruiseCtrlJerkCalc1 "autosar_swc_vmp/autosar_swc_vmp_Step_sys/lgt_pln/lonap_accelCruiseCtrlJerkCalc1"
 /begin SUB_GROUP autosar_swc_vmp_autosar_swc_vmp_Step_sys_lgt_pln_lonap_accelCruiseCtrlJerkCalc1_Compare_To_Constant2 autosar_swc_vmp_autosar_swc_vmp_Step_sys_lgt_pln_lonap_accelCruiseCtrlJerkCalc1_Compare_To_Constant3 /end SUB_GROUP
 /begin REF_CHARACTERISTIC P_LONP_ComfortExitAccJerkValue P_LONP_ComfortExitDecJerkValue P_LONP_Overide2ActiveTimeCancelValue P_LONP_Override2ActiveAccJerk P_LONP_Override2ActiveDecelJerk P_LONP_Override2ActiveTimeCnt P_LONP_tCycle /end REF_CHARACTERISTIC
 /begin REF_MEASUREMENT autosar_swc_vmp_rtARID_DEF.Overide2ActiveTimeCnt autosar_swc_vmp_rtARID_DEF.UnitDelay1_DSTATE_oa autosar_swc_vmp_rtARID_DEF.UnitDelay3_DSTATE_g autosar_swc_vmp_rtARID_DEF.UnitDelay_DSTATE_ol autosar_swc_vmp_rtARID_DEF.is_active_c39_autosar_swc_vmp autosar_swc_vmp_rtARID_DEF.is_c39_autosar_swc_vmp /end REF_MEASUREMENT
/end GROUP
/begin GROUP autosar_swc_vmp_autosar_swc_vmp_Step_sys_lgt_pln_lonap_accelerationLimition "autosar_swc_vmp/autosar_swc_vmp_Step_sys/lgt_pln/lonap_accelerationLimition"
 /begin REF_CHARACTERISTIC P_LONP_ALaLowerChar P_LONP_ALaUpperCharEco P_LONP_ALaUpperCharLaneChange P_LONP_ALaUpperCharNormal P_LONP_ALaUpperCharRampMerge P_LONP_ALaUpperCharSport P_LONP_ALvAcceleLowerChar P_LONP_ALvAcceleUpperCharEco P_LONP_ALvAcceleUpperCharLaneChange P_LONP_ALvAcceleUpperCharNormal P_LONP_ALvAcceleUpperCharRampMerge P_LONP_ALvAcceleUpperCharSport P_LONP_AcceUpperEcoLimitGainByNormalMode P_LONP_AcceUpperSportLimitGainByNormalMode /end REF_CHARACTERISTIC
 /begin REF_MEASUREMENT LONP_accelArb /end REF_MEASUREMENT
/end GROUP
/begin GROUP autosar_swc_vmp_autosar_swc_vmp_Step_sys_lgt_pln_lonap_grp_arbitrate "autosar_swc_vmp/autosar_swc_vmp_Step_sys/lgt_pln/lonap_grp_arbitrate"
 /begin SUB_GROUP autosar_swc_vmp_autosar_swc_vmp_Step_sys_lgt_pln_lonap_grp_arbitrate_lonap_accelAibitrate autosar_swc_vmp_autosar_swc_vmp_Step_sys_lgt_pln_lonap_grp_arbitrate_lonap_ctrlTargetIndex /end SUB_GROUP
/end GROUP
/begin GROUP autosar_swc_vmp_autosar_swc_vmp_Step_sys_lgt_pln_lonap_grp_arbitrate_lonap_accelAibitrate "autosar_swc_vmp/autosar_swc_vmp_Step_sys/lgt_pln/lonap_grp_arbitrate/lonap_accelAibitrate" /begin REF_CHARACTERISTIC P_LONP_hightHazardMinCtrl /end REF_CHARACTERISTIC
 /begin REF_MEASUREMENT LONP_accelArb autosar_swc_vmp_rtARID_DEF.InsertIOut_lowerBandInsertSpace autosar_swc_vmp_rtARID_DEF.InsertIOut_lowerJerkInsertSpace autosar_swc_vmp_rtARID_DEF.InsertIOut_upperBandInsertSpace autosar_swc_vmp_rtARID_DEF.InsertIOut_upperJerkInsertSpace autosar_swc_vmp_rtARID_DEF.accelDesInsertSpace_Out /end REF_MEASUREMENT
/end GROUP
/begin GROUP autosar_swc_vmp_autosar_swc_vmp_Step_sys_lgt_pln_lonap_grp_arbitrate_lonap_ctrlTargetIndex "autosar_swc_vmp/autosar_swc_vmp_Step_sys/lgt_pln/lonap_grp_arbitrate/lonap_ctrlTargetIndex"
 /begin SUB_GROUP autosar_swc_vmp_autosar_swc_vmp_Step_sys_lgt_pln_lonap_grp_arbitrate_lonap_ctrlTargetIndex_Compare_To_Constant /end SUB_GROUP
 /begin REF_MEASUREMENT autosar_swc_vmp_rtARID_DEF.MultiportSwitch /end REF_MEASUREMENT
/end GROUP
/begin GROUP autosar_swc_vmp_autosar_swc_vmp_Step_sys_lgt_pln_lonap_grp_cruiseCtrl "autosar_swc_vmp/autosar_swc_vmp_Step_sys/lgt_pln/lonap_grp_cruiseCtrl"
 /begin SUB_GROUP autosar_swc_vmp_autosar_swc_vmp_Step_sys_lgt_pln_lonap_grp_cruiseCtrl_lonap_accelCruiseCtrlCalc autosar_swc_vmp_autosar_swc_vmp_Step_sys_lgt_pln_lonap_grp_cruiseCtrl_lonap_accelCruiseCtrlJerkCalc1 autosar_swc_vmp_autosar_swc_vmp_Step_sys_lgt_pln_lonap_grp_cruiseCtrl_lonap_accelCruiseCtrlJerkSelect autosar_swc_vmp_autosar_swc_vmp_Step_sys_lgt_pln_lonap_grp_cruiseCtrl_lonap_accelCruiseCtrlLimit autosar_swc_vmp_autosar_swc_vmp_Step_sys_lgt_pln_lonap_grp_cruiseCtrl_lonap_acceleBandCruiseCtrl autosar_swc_vmp_autosar_swc_vmp_Step_sys_lgt_pln_lonap_grp_cruiseCtrl_lonap_laneChangeIncSetSpd autosar_swc_vmp_autosar_swc_vmp_Step_sys_lgt_pln_lonap_grp_cruiseCtrl_lonap_setSpdSmooth autosar_swc_vmp_autosar_swc_vmp_Step_sys_lgt_pln_lonap_grp_cruiseCtrl_lonap_velPlanCruiseCtrl /end SUB_GROUP
/end GROUP
/begin GROUP autosar_swc_vmp_autosar_swc_vmp_Step_sys_lgt_pln_lonap_grp_cruiseCtrl_lonap_accelCruiseCtrlCalc "autosar_swc_vmp/autosar_swc_vmp_Step_sys/lgt_pln/lonap_grp_cruiseCtrl/lonap_accelCruiseCtrlCalc" /begin REF_CHARACTERISTIC C_LongCtrl_0_Uint8 P_LONP_CCResumeDelayDeltaVel /end REF_CHARACTERISTIC
 /begin REF_MEASUREMENT autosar_swc_vmp_rtARID_DEF.CCSetSpdK1 autosar_swc_vmp_rtARID_DEF.fastDecelK1 /end REF_MEASUREMENT
/end GROUP
/begin GROUP autosar_swc_vmp_autosar_swc_vmp_Step_sys_lgt_pln_lonap_grp_cruiseCtrl_lonap_accelCruiseCtrlJerkCalc1 "autosar_swc_vmp/autosar_swc_vmp_Step_sys/lgt_pln/lonap_grp_cruiseCtrl/lonap_accelCruiseCtrlJerkCalc1" /begin REF_CHARACTERISTIC P_LONP_tCycle /end REF_CHARACTERISTIC
 /begin REF_MEASUREMENT autosar_swc_vmp_rtARID_DEF.acceleratejerk autosar_swc_vmp_rtARID_DEF.deceleratejerk autosar_swc_vmp_rtARID_DEF.is_active_c32_autosar_swc_vmp autosar_swc_vmp_rtARID_DEF.is_c32_autosar_swc_vmp /end REF_MEASUREMENT
/end GROUP
/begin GROUP autosar_swc_vmp_autosar_swc_vmp_Step_sys_lgt_pln_lonap_grp_cruiseCtrl_lonap_accelCruiseCtrlJerkSelect "autosar_swc_vmp/autosar_swc_vmp_Step_sys/lgt_pln/lonap_grp_cruiseCtrl/lonap_accelCruiseCtrlJerkSelect"
 /begin SUB_GROUP autosar_swc_vmp_autosar_swc_vmp_Step_sys_lgt_pln_lonap_grp_cruiseCtrl_lonap_accelCruiseCtrlJerkSelect_Compare_To_Constant autosar_swc_vmp_autosar_swc_vmp_Step_sys_lgt_pln_lonap_grp_cruiseCtrl_lonap_accelCruiseCtrlJerkSelect_Compare_To_Constant1 /end SUB_GROUP
 /begin REF_CHARACTERISTIC P_LONP_CCaccelCCNeg2PosJerk P_LONP_CCaccelCCPosJerk P_LONP_CCaccelCCPosJerkRampMerge P_LONP_CCdecelCCJerk P_LONP_CCdecelCCJerkNegVLCInternalAcc P_LONP_CCdecelCCJerkRampMerge /end REF_CHARACTERISTIC
/end GROUP
/begin GROUP autosar_swc_vmp_autosar_swc_vmp_Step_sys_lgt_pln_lonap_grp_cruiseCtrl_lonap_accelCruiseCtrlLimit "autosar_swc_vmp/autosar_swc_vmp_Step_sys/lgt_pln/lonap_grp_cruiseCtrl/lonap_accelCruiseCtrlLimit"
 /begin SUB_GROUP autosar_swc_vmp_autosar_swc_vmp_Step_sys_lgt_pln_lonap_grp_cruiseCtrl_lonap_accelCruiseCtrlLimit_Compare_To_Constant10 autosar_swc_vmp_autosar_swc_vmp_Step_sys_lgt_pln_lonap_grp_cruiseCtrl_lonap_accelCruiseCtrlLimit_TrueDurationTime /end SUB_GROUP
 /begin REF_CHARACTERISTIC P_LONP_CCaccelLowerIsLaneChange P_LONP_CCaccelMinFastDecel P_LONP_CCaccelMinNoFastDecel P_LONP_CCaccelMinRampMerge P_LONP_CCaccelUpperCC P_LONP_CCaccelUpperCCSafeStop P_LONP_CCaccelUpperRampMerge P_LONP_SSCaDtIsLaneChange /end REF_CHARACTERISTIC
/end GROUP
/begin GROUP autosar_swc_vmp_autosar_swc_vmp_Step_sys_lgt_pln_lonap_grp_cruiseCtrl_lonap_accelCruiseCtrlLimit_Compare_To_Constant10 "autosar_swc_vmp/autosar_swc_vmp_Step_sys/lgt_pln/lonap_grp_cruiseCtrl/lonap_accelCruiseCtrlLimit/Compare\nTo Constant10" /begin REF_CHARACTERISTIC P_LONP_CCaccelMaxLCActive /end REF_CHARACTERISTIC /end GROUP
/begin GROUP autosar_swc_vmp_autosar_swc_vmp_Step_sys_lgt_pln_lonap_grp_cruiseCtrl_lonap_accelCruiseCtrlLimit_TrueDurationTime "autosar_swc_vmp/autosar_swc_vmp_Step_sys/lgt_pln/lonap_grp_cruiseCtrl/lonap_accelCruiseCtrlLimit/TrueDurationTime"
 /begin REF_MEASUREMENT autosar_swc_vmp_rtARID_DEF.UnitDelay1_DSTATE_aw autosar_swc_vmp_rtARID_DEF.UnitDelay2_DSTATE_ly /end REF_MEASUREMENT
/end GROUP
/begin GROUP autosar_swc_vmp_autosar_swc_vmp_Step_sys_lgt_pln_lonap_grp_cruiseCtrl_lonap_laneChangeIncSetSpd "autosar_swc_vmp/autosar_swc_vmp_Step_sys/lgt_pln/lonap_grp_cruiseCtrl/lonap_laneChangeIncSetSpd"
 /begin REF_CHARACTERISTIC P_LONP_CCLCIncSetSpdAdd P_LONP_CCLCIncSetSpdAddDecStep P_LONP_CCLCIncSetSpdEnable P_LONP_SetSpdAddCancelEnable /end REF_CHARACTERISTIC
 /begin REF_MEASUREMENT autosar_swc_vmp_rtARID_DEF.UnitDelay1_DSTATE_k autosar_swc_vmp_rtARID_DEF.UnitDelay_DSTATE_i /end REF_MEASUREMENT
/end GROUP
/begin GROUP autosar_swc_vmp_autosar_swc_vmp_Step_sys_lgt_pln_lonap_grp_cruiseCtrl_lonap_setSpdSmooth "autosar_swc_vmp/autosar_swc_vmp_Step_sys/lgt_pln/lonap_grp_cruiseCtrl/lonap_setSpdSmooth"
 /begin REF_CHARACTERISTIC P_LONP_SetSpdSlopLimDecStep_ratio P_LONP_SetSpdSlopLimIncStep_ratio /end REF_CHARACTERISTIC
 /begin REF_MEASUREMENT autosar_swc_vmp_rtARID_DEF.UnitDelay3_DSTATE /end REF_MEASUREMENT
/end GROUP
/begin GROUP autosar_swc_vmp_autosar_swc_vmp_Step_sys_lgt_pln_lonap_grp_cruiseCtrl_lonap_velPlanCruiseCtrl "autosar_swc_vmp/autosar_swc_vmp_Step_sys/lgt_pln/lonap_grp_cruiseCtrl/lonap_velPlanCruiseCtrl"
 /begin REF_CHARACTERISTIC P_LONP_CCaccelCCNeg2PosJerk P_LONP_CCaccelCCPosJerk P_LONP_CCaccelMinECOAL P_LONP_CCaccelMinFastDecel P_LONP_CCaccelMinNoFastDecel P_LONP_CCaccelMinNormAL P_LONP_CCaccelMinSportAL P_LONP_CCbECO P_LONP_CCbNorm P_LONP_CCbSport P_LONP_CCdecelCCJerk P_LONP_CCdecelCCJerkNegVLCInternalAcc P_LONP_CCkECO P_LONP_CCkNorm P_LONP_CCkSport P_LONP_CCtStepVelPlan P_LONP_CCtTotVelPlan /end REF_CHARACTERISTIC
 /begin REF_MEASUREMENT autosar_swc_vmp_rtARID_DEF.accelMaxAL /end REF_MEASUREMENT
/end GROUP
/begin GROUP autosar_swc_vmp_autosar_swc_vmp_Step_sys_lgt_pln_lonap_grp_intelligenceCurve "autosar_swc_vmp/autosar_swc_vmp_Step_sys/lgt_pln/lonap_grp_intelligenceCurve"
 /begin SUB_GROUP autosar_swc_vmp_autosar_swc_vmp_Step_sys_lgt_pln_lonap_grp_intelligenceCurve_Subsystem autosar_swc_vmp_autosar_swc_vmp_Step_sys_lgt_pln_lonap_grp_intelligenceCurve_lonap_accelBandIntelIigenceCurve autosar_swc_vmp_autosar_swc_vmp_Step_sys_lgt_pln_lonap_grp_intelligenceCurve_lonap_accelCurvature1 autosar_swc_vmp_autosar_swc_vmp_Step_sys_lgt_pln_lonap_grp_intelligenceCurve_lonap_accelJerkIntelIigenceCurve autosar_swc_vmp_autosar_swc_vmp_Step_sys_lgt_pln_lonap_grp_intelligenceCurve_lonap_accelKap autosar_swc_vmp_autosar_swc_vmp_Step_sys_lgt_pln_lonap_grp_intelligenceCurve_lonap_curvatureOfRoadCalc autosar_swc_vmp_autosar_swc_vmp_Step_sys_lgt_pln_lonap_grp_intelligenceCurve_lonap_hDMapAccelCalc1 autosar_swc_vmp_autosar_swc_vmp_Step_sys_lgt_pln_lonap_grp_intelligenceCurve_lonap_laneProcss1 /end SUB_GROUP
 /begin REF_MEASUREMENT autosar_swc_vmp_rtARID_DEF.UnitDelay_DSTATE_d /end REF_MEASUREMENT
/end GROUP
/begin GROUP autosar_swc_vmp_autosar_swc_vmp_Step_sys_lgt_pln_lonap_grp_intelligenceCurve_Subsystem "autosar_swc_vmp/autosar_swc_vmp_Step_sys/lgt_pln/lonap_grp_intelligenceCurve/Subsystem"
 /begin SUB_GROUP autosar_swc_vmp_autosar_swc_vmp_Step_sys_lgt_pln_lonap_grp_intelligenceCurve_Subsystem_Compare_To_Constant4 /end SUB_GROUP
/end GROUP
/begin GROUP autosar_swc_vmp_autosar_swc_vmp_Step_sys_lgt_pln_lonap_grp_intelligenceCurve_Subsystem_Compare_To_Constant4 "autosar_swc_vmp/autosar_swc_vmp_Step_sys/lgt_pln/lonap_grp_intelligenceCurve/Subsystem/Compare\nTo Constant4" /begin REF_CHARACTERISTIC P_LONP_ICLineLengthCheck /end REF_CHARACTERISTIC /end GROUP
/begin GROUP autosar_swc_vmp_autosar_swc_vmp_Step_sys_lgt_pln_lonap_grp_intelligenceCurve_lonap_accelBandIntelIigenceCurve "autosar_swc_vmp/autosar_swc_vmp_Step_sys/lgt_pln/lonap_grp_intelligenceCurve/lonap_accelBandIntelIigenceCurve"
 /begin SUB_GROUP autosar_swc_vmp_autosar_swc_vmp_Step_sys_lgt_pln_lonap_grp_intelligenceCurve_lonap_accelBandIntelIigenceCurve_lonap_AccelBandCurvNKap autosar_swc_vmp_autosar_swc_vmp_Step_sys_lgt_pln_lonap_grp_intelligenceCurve_lonap_accelBandIntelIigenceCurve_lonap_AccelBandHDMap /end SUB_GROUP
/end GROUP
/begin GROUP autosar_swc_vmp_autosar_swc_vmp_Step_sys_lgt_pln_lonap_grp_intelligenceCurve_lonap_accelBandIntelIigenceCurve_lonap_AccelBandCurvNKap "autosar_swc_vmp/autosar_swc_vmp_Step_sys/lgt_pln/lonap_grp_intelligenceCurve/lonap_accelBandIntelIigenceCurve/lonap_AccelBandCurvNKap" /begin REF_CHARACTERISTIC P_LONP_ICdeltaAccelLowerBand P_LONP_ICdeltaAccelUpperBand /end REF_CHARACTERISTIC /end GROUP
/begin GROUP autosar_swc_vmp_autosar_swc_vmp_Step_sys_lgt_pln_lonap_grp_intelligenceCurve_lonap_accelCurvature1 "autosar_swc_vmp/autosar_swc_vmp_Step_sys/lgt_pln/lonap_grp_intelligenceCurve/lonap_accelCurvature1"
 /begin REF_CHARACTERISTIC P_LONP_ICCurvatureLimitSpdXAxis P_LONP_ICCurvatureLimitSpdYAxis P_LONP_ICCurveDecelEnable P_LONP_ICKapLimitSpdXAxis P_LONP_ICKapLimitSpdYAxis P_LONP_ICaccelCurvDistEnable P_LONP_ICtDecel P_LONP_UsePreLookupTable /end REF_CHARACTERISTIC
/end GROUP
/begin GROUP autosar_swc_vmp_autosar_swc_vmp_Step_sys_lgt_pln_lonap_grp_intelligenceCurve_lonap_accelJerkIntelIigenceCurve "autosar_swc_vmp/autosar_swc_vmp_Step_sys/lgt_pln/lonap_grp_intelligenceCurve/lonap_accelJerkIntelIigenceCurve"
 /begin REF_CHARACTERISTIC P_LONP_ICKapUpperJerkMin P_LONP_ICUpperJerkNegVLCInternalAcc P_LONP_IClowerJerkICCharXAxis P_LONP_IClowerJerkICCharYAxis P_LONP_IClowerJerkPosVLCInternalAccMax P_LONP_IClowerJerkPosVLCInternalAccMin P_LONP_ICupperJerkICCharXAxis P_LONP_ICupperJerkICCharYAxis P_LONP_IICAcceMinLimitValue P_LONP_UseICFilt P_LONP_accelMapLowerJerk P_LONP_accelMapUpperJerk /end REF_CHARACTERISTIC
/end GROUP
/begin GROUP autosar_swc_vmp_autosar_swc_vmp_Step_sys_lgt_pln_lonap_grp_intelligenceCurve_lonap_accelKap "autosar_swc_vmp/autosar_swc_vmp_Step_sys/lgt_pln/lonap_grp_intelligenceCurve/lonap_accelKap"
 /begin SUB_GROUP autosar_swc_vmp_autosar_swc_vmp_Step_sys_lgt_pln_lonap_grp_intelligenceCurve_lonap_accelKap_LP autosar_swc_vmp_autosar_swc_vmp_Step_sys_lgt_pln_lonap_grp_intelligenceCurve_lonap_accelKap_LP1 /end SUB_GROUP
 /begin REF_CHARACTERISTIC P_LONP_CompareKapType P_LONP_ICKapLimitAccelXAxis P_LONP_ICKapLimitAccelYAxis P_LONP_ICKapLimitSpdXAxis P_LONP_ICKapLimitSpdYAxis P_LONP_ICtDecel P_LONP_KapTarLineCoef P_LONP_MinKapReqVehValue P_LONP_TJAstsConfrmSwt P_LONP_TarLineICEnable P_LONP_UsePTableSW P_LONP_tDecelXAxis P_LONP_tDecelYAxis /end REF_CHARACTERISTIC
/end GROUP
/begin GROUP autosar_swc_vmp_autosar_swc_vmp_Step_sys_lgt_pln_lonap_grp_intelligenceCurve_lonap_accelKap_LP "autosar_swc_vmp/autosar_swc_vmp_Step_sys/lgt_pln/lonap_grp_intelligenceCurve/lonap_accelKap/LP" /begin REF_CHARACTERISTIC P_LONP_tCycle /end REF_CHARACTERISTIC /begin REF_MEASUREMENT autosar_swc_vmp_rtARID_DEF.UnitDelay_DSTATE_m /end REF_MEASUREMENT /end GROUP
/begin GROUP autosar_swc_vmp_autosar_swc_vmp_Step_sys_lgt_pln_lonap_grp_intelligenceCurve_lonap_accelKap_LP1 "autosar_swc_vmp/autosar_swc_vmp_Step_sys/lgt_pln/lonap_grp_intelligenceCurve/lonap_accelKap/LP1" /begin REF_CHARACTERISTIC P_LONP_tCycle /end REF_CHARACTERISTIC /begin REF_MEASUREMENT autosar_swc_vmp_rtARID_DEF.UnitDelay_DSTATE_j /end REF_MEASUREMENT /end GROUP
/begin GROUP autosar_swc_vmp_autosar_swc_vmp_Step_sys_lgt_pln_lonap_grp_intelligenceCurve_lonap_curvatureOfRoadCalc "autosar_swc_vmp/autosar_swc_vmp_Step_sys/lgt_pln/lonap_grp_intelligenceCurve/lonap_curvatureOfRoadCalc"
 /begin SUB_GROUP autosar_swc_vmp_autosar_swc_vmp_Step_sys_lgt_pln_lonap_grp_intelligenceCurve_lonap_curvatureOfRoadCalc_Compare_To_Constant2 autosar_swc_vmp_autosar_swc_vmp_Step_sys_lgt_pln_lonap_grp_intelligenceCurve_lonap_curvatureOfRoadCalc_If_Action_Subsystem autosar_swc_vmp_autosar_swc_vmp_Step_sys_lgt_pln_lonap_grp_intelligenceCurve_lonap_curvatureOfRoadCalc_LP2 /end SUB_GROUP
/end GROUP
/begin GROUP autosar_swc_vmp_autosar_swc_vmp_Step_sys_lgt_pln_lonap_grp_intelligenceCurve_lonap_curvatureOfRoadCalc_Compare_To_Constant2 "autosar_swc_vmp/autosar_swc_vmp_Step_sys/lgt_pln/lonap_grp_intelligenceCurve/lonap_curvatureOfRoadCalc/Compare\nTo Constant2" /begin REF_CHARACTERISTIC P_LONP_ICaccelThresEnableLine /end REF_CHARACTERISTIC /end GROUP
/begin GROUP autosar_swc_vmp_autosar_swc_vmp_Step_sys_lgt_pln_lonap_grp_intelligenceCurve_lonap_curvatureOfRoadCalc_If_Action_Subsystem "autosar_swc_vmp/autosar_swc_vmp_Step_sys/lgt_pln/lonap_grp_intelligenceCurve/lonap_curvatureOfRoadCalc/If Action\nSubsystem"
 /begin SUB_GROUP autosar_swc_vmp_autosar_swc_vmp_Step_sys_lgt_pln_lonap_grp_intelligenceCurve_lonap_curvatureOfRoadCalc_If_Action_Subsystem_CurvatureMix autosar_swc_vmp_autosar_swc_vmp_Step_sys_lgt_pln_lonap_grp_intelligenceCurve_lonap_curvatureOfRoadCalc_If_Action_Subsystem_For_Each_Subsystem /end SUB_GROUP
/end GROUP
/begin GROUP autosar_swc_vmp_autosar_swc_vmp_Step_sys_lgt_pln_lonap_grp_intelligenceCurve_lonap_curvatureOfRoadCalc_If_Action_Subsystem_CurvatureMix "autosar_swc_vmp/autosar_swc_vmp_Step_sys/lgt_pln/lonap_grp_intelligenceCurve/lonap_curvatureOfRoadCalc/If Action\nSubsystem/CurvatureMix"
 /begin SUB_GROUP autosar_swc_vmp_autosar_swc_vmp_Step_sys_lgt_pln_lonap_grp_intelligenceCurve_lonap_curvatureOfRoadCalc_If_Action_Subsystem_CurvatureMix_LP /end SUB_GROUP
 /begin REF_CHARACTERISTIC P_LONP_ICcoefCurvatureCharX1 P_LONP_ICcoefCurvatureCharX2 P_LONP_ICcoefCurvatureCharY /end REF_CHARACTERISTIC
 /begin REF_MEASUREMENT autosar_swc_vmp_rtARID_DEF.Add1 /end REF_MEASUREMENT
/end GROUP
/begin GROUP autosar_swc_vmp_autosar_swc_vmp_Step_sys_lgt_pln_lonap_grp_intelligenceCurve_lonap_curvatureOfRoadCalc_If_Action_Subsystem_CurvatureMix_LP "autosar_swc_vmp/autosar_swc_vmp_Step_sys/lgt_pln/lonap_grp_intelligenceCurve/lonap_curvatureOfRoadCalc/If Action\nSubsystem/CurvatureMix/LP" /begin REF_CHARACTERISTIC P_LONP_tCycle /end REF_CHARACTERISTIC
 /begin REF_MEASUREMENT autosar_swc_vmp_rtARID_DEF.Add1 autosar_swc_vmp_rtARID_DEF.TappedDelay2_X autosar_swc_vmp_rtARID_DEF.UnitDelay_DSTATE_pl /end REF_MEASUREMENT
/end GROUP
/begin GROUP autosar_swc_vmp_autosar_swc_vmp_Step_sys_lgt_pln_lonap_grp_intelligenceCurve_lonap_curvatureOfRoadCalc_LP2 "autosar_swc_vmp/autosar_swc_vmp_Step_sys/lgt_pln/lonap_grp_intelligenceCurve/lonap_curvatureOfRoadCalc/LP2" /begin REF_CHARACTERISTIC P_LONP_tCycle /end REF_CHARACTERISTIC /begin REF_MEASUREMENT autosar_swc_vmp_rtARID_DEF.UnitDelay_DSTATE_ix /end REF_MEASUREMENT /end GROUP
/begin GROUP autosar_swc_vmp_autosar_swc_vmp_Step_sys_lgt_pln_lonap_grp_intelligenceCurve_lonap_hDMapAccelCalc1 "autosar_swc_vmp/autosar_swc_vmp_Step_sys/lgt_pln/lonap_grp_intelligenceCurve/lonap_hDMapAccelCalc1"
 /begin SUB_GROUP autosar_swc_vmp_autosar_swc_vmp_Step_sys_lgt_pln_lonap_grp_intelligenceCurve_lonap_hDMapAccelCalc1_Calc_PreviewDistInterval /end SUB_GROUP
 /begin REF_CHARACTERISTIC P_LONP_IC_HDMapAccelLimitXAxis P_LONP_IC_HDMapAccelLimitYAxis P_LONP_IC_HDMap_AccelICEnterThrd P_LONP_IC_HDMap_AccelICExitThrd P_LONP_IC_HDMap_EHRV2Enable P_LONP_IC_HDMap_PreviewDistUpperbandMax /end REF_CHARACTERISTIC
 /begin REF_MEASUREMENT autosar_swc_vmp_rtARID_DEF.Flag autosar_swc_vmp_rtARID_DEF.velDesArray_kph /end REF_MEASUREMENT
/end GROUP
/begin GROUP autosar_swc_vmp_autosar_swc_vmp_Step_sys_lgt_pln_lonap_grp_intelligenceCurve_lonap_hDMapAccelCalc1_Calc_PreviewDistInterval "autosar_swc_vmp/autosar_swc_vmp_Step_sys/lgt_pln/lonap_grp_intelligenceCurve/lonap_hDMapAccelCalc1/Calc_PreviewDistInterval"
 /begin REF_CHARACTERISTIC P_LONP_IC_HDMap_PreviewDistLowerbandMax P_LONP_IC_HDMap_PreviewDistLowerbandMin P_LONP_IC_HDMap_PreviewDistUpperbandMax P_LONP_IC_HDMap_PreviewDistUpperbandMin P_LONP_IC_HDMap_PreviewTimeLowerband P_LONP_IC_HDMap_PreviewTimeUpperband /end REF_CHARACTERISTIC
/end GROUP
/begin GROUP autosar_swc_vmp_autosar_swc_vmp_Step_sys_lgt_pln_lonap_grp_intelligenceCurve_lonap_laneProcss1 "autosar_swc_vmp/autosar_swc_vmp_Step_sys/lgt_pln/lonap_grp_intelligenceCurve/lonap_laneProcss1"
 /begin SUB_GROUP autosar_swc_vmp_autosar_swc_vmp_Step_sys_lgt_pln_lonap_grp_intelligenceCurve_lonap_laneProcss1_Compare_To_Constant2 autosar_swc_vmp_autosar_swc_vmp_Step_sys_lgt_pln_lonap_grp_intelligenceCurve_lonap_laneProcss1_Compare_To_Constant4 /end SUB_GROUP
 /begin REF_CHARACTERISTIC P_LONP_Center2LineValue P_LONP_KeepLaneSurDis P_LONP_KeepLaneTime P_LONP_LaneAvailStd P_LONP_LaneAvailStdAverage P_LONP_LaneAvailStdMax P_LONP_tCycle /end REF_CHARACTERISTIC
 /begin REF_MEASUREMENT autosar_swc_vmp_rtARID_DEF.TappedDelay1_X_i autosar_swc_vmp_rtARID_DEF.UnitDelay1_DSTATE_c autosar_swc_vmp_rtARID_DEF.UnitDelay2_DSTATE autosar_swc_vmp_rtARID_DEF.UnitDelay3_DSTATE_i autosar_swc_vmp_rtARID_DEF.UnitDelay42_DSTATE autosar_swc_vmp_rtARID_DEF.UnitDelay43_DSTATE autosar_swc_vmp_rtARID_DEF.UnitDelay44_DSTATE autosar_swc_vmp_rtARID_DEF.UnitDelay45_DSTATE autosar_swc_vmp_rtARID_DEF.UnitDelay46_DSTATE autosar_swc_vmp_rtARID_DEF.UnitDelay47_DSTATE autosar_swc_vmp_rtARID_DEF.UnitDelay48_DSTATE autosar_swc_vmp_rtARID_DEF.UnitDelay4_DSTATE autosar_swc_vmp_rtARID_DEF.UnitDelay_DSTATE_f /end REF_MEASUREMENT
/end GROUP
/begin GROUP autosar_swc_vmp_autosar_swc_vmp_Step_sys_lgt_pln_lonap_grp_intelligenceCurve_lonap_laneProcss1_Compare_To_Constant2 "autosar_swc_vmp/autosar_swc_vmp_Step_sys/lgt_pln/lonap_grp_intelligenceCurve/lonap_laneProcss1/Compare\nTo Constant2" /begin REF_CHARACTERISTIC P_LONP_LaneAvailTime /end REF_CHARACTERISTIC /end GROUP
/begin GROUP autosar_swc_vmp_autosar_swc_vmp_Step_sys_lgt_pln_lonap_grp_intelligenceCurve_lonap_laneProcss1_Compare_To_Constant4 "autosar_swc_vmp/autosar_swc_vmp_Step_sys/lgt_pln/lonap_grp_intelligenceCurve/lonap_laneProcss1/Compare\nTo Constant4" /begin REF_CHARACTERISTIC P_LONP_LaneAvailDis /end REF_CHARACTERISTIC /end GROUP
/begin GROUP autosar_swc_vmp_autosar_swc_vmp_Step_sys_lgt_pln_lonap_grp_objectCtrl "autosar_swc_vmp/autosar_swc_vmp_Step_sys/lgt_pln/lonap_grp_objectCtrl"
 /begin SUB_GROUP autosar_swc_vmp_autosar_swc_vmp_Step_sys_lgt_pln_lonap_grp_objectCtrl_lonap_grp_crossAccelCtrl autosar_swc_vmp_autosar_swc_vmp_Step_sys_lgt_pln_lonap_grp_objectCtrl_lonap_grp_followCtrl /end SUB_GROUP
/end GROUP
/begin GROUP autosar_swc_vmp_autosar_swc_vmp_Step_sys_lgt_pln_lonap_grp_objectCtrl_lonap_grp_crossAccelCtrl "autosar_swc_vmp/autosar_swc_vmp_Step_sys/lgt_pln/lonap_grp_objectCtrl/lonap_grp_crossAccelCtrl"
 /begin SUB_GROUP autosar_swc_vmp_autosar_swc_vmp_Step_sys_lgt_pln_lonap_grp_objectCtrl_lonap_grp_crossAccelCtrl_lonap_bandCrossAccel autosar_swc_vmp_autosar_swc_vmp_Step_sys_lgt_pln_lonap_grp_objectCtrl_lonap_grp_crossAccelCtrl_lonap_crossAccelCalc autosar_swc_vmp_autosar_swc_vmp_Step_sys_lgt_pln_lonap_grp_objectCtrl_lonap_grp_crossAccelCtrl_lonap_jerkCrossAccel /end SUB_GROUP
/end GROUP
/begin GROUP autosar_swc_vmp_autosar_swc_vmp_Step_sys_lgt_pln_lonap_grp_objectCtrl_lonap_grp_crossAccelCtrl_lonap_bandCrossAccel "autosar_swc_vmp/autosar_swc_vmp_Step_sys/lgt_pln/lonap_grp_objectCtrl/lonap_grp_crossAccelCtrl/lonap_bandCrossAccel"
 /begin REF_CHARACTERISTIC P_Longctrl_Follow_CAdevAcceleLowerBand P_Longctrl_Follow_CAdevAcceleUpperBand /end REF_CHARACTERISTIC
/end GROUP
/begin GROUP autosar_swc_vmp_autosar_swc_vmp_Step_sys_lgt_pln_lonap_grp_objectCtrl_lonap_grp_crossAccelCtrl_lonap_crossAccelCalc "autosar_swc_vmp/autosar_swc_vmp_Step_sys/lgt_pln/lonap_grp_objectCtrl/lonap_grp_crossAccelCtrl/lonap_crossAccelCalc"
 /begin REF_CHARACTERISTIC P_Longctrl_Follow_CASws P_Longctrl_Follow_CAaccelSubjIsDecel P_Longctrl_Follow_CAdistSafe P_Longctrl_Follow_CAtKeepSpeed P_Longctrl_Follow_CAtTargPass /end REF_CHARACTERISTIC
/end GROUP
/begin GROUP autosar_swc_vmp_autosar_swc_vmp_Step_sys_lgt_pln_lonap_grp_objectCtrl_lonap_grp_crossAccelCtrl_lonap_jerkCrossAccel "autosar_swc_vmp/autosar_swc_vmp_Step_sys/lgt_pln/lonap_grp_objectCtrl/lonap_grp_crossAccelCtrl/lonap_jerkCrossAccel" /begin REF_CHARACTERISTIC P_Longctrl_Follow_CAupperJerk /end REF_CHARACTERISTIC /end GROUP
/begin GROUP autosar_swc_vmp_autosar_swc_vmp_Step_sys_lgt_pln_lonap_grp_objectCtrl_lonap_grp_followCtrl "autosar_swc_vmp/autosar_swc_vmp_Step_sys/lgt_pln/lonap_grp_objectCtrl/lonap_grp_followCtrl"
 /begin SUB_GROUP autosar_swc_vmp_autosar_swc_vmp_Step_sys_lgt_pln_lonap_grp_objectCtrl_lonap_grp_followCtrl_AcceSwitch14 autosar_swc_vmp_autosar_swc_vmp_Step_sys_lgt_pln_lonap_grp_objectCtrl_lonap_grp_followCtrl_Counter_Limited autosar_swc_vmp_autosar_swc_vmp_Step_sys_lgt_pln_lonap_grp_objectCtrl_lonap_grp_followCtrl_Subsystem autosar_swc_vmp_autosar_swc_vmp_Step_sys_lgt_pln_lonap_grp_objectCtrl_lonap_grp_followCtrl_Subsystem1 autosar_swc_vmp_autosar_swc_vmp_Step_sys_lgt_pln_lonap_grp_objectCtrl_lonap_grp_followCtrl_TargetIDUpdate autosar_swc_vmp_autosar_swc_vmp_Step_sys_lgt_pln_lonap_grp_objectCtrl_lonap_grp_followCtrl_lonap_accelTargFilter autosar_swc_vmp_autosar_swc_vmp_Step_sys_lgt_pln_lonap_grp_objectCtrl_lonap_grp_followCtrl_lonap_decelToStopCtrl autosar_swc_vmp_autosar_swc_vmp_Step_sys_lgt_pln_lonap_grp_objectCtrl_lonap_grp_followCtrl_lonap_grp_followAccelCalc autosar_swc_vmp_autosar_swc_vmp_Step_sys_lgt_pln_lonap_grp_objectCtrl_lonap_grp_followCtrl_lonap_grp_plausibilityCheck autosar_swc_vmp_autosar_swc_vmp_Step_sys_lgt_pln_lonap_grp_objectCtrl_lonap_grp_followCtrl_lonap_signalMatrix autosar_swc_vmp_autosar_swc_vmp_Step_sys_lgt_pln_lonap_grp_objectCtrl_lonap_grp_followCtrl_lonap_slopeStartUpAssist /end SUB_GROUP
 /begin REF_MEASUREMENT autosar_swc_vmp_rtARID_DEF.UnitDelay10_DSTATE autosar_swc_vmp_rtARID_DEF.UnitDelay1_DSTATE_b autosar_swc_vmp_rtARID_DEF.UnitDelay2_DSTATE_p autosar_swc_vmp_rtARID_DEF.UnitDelay3_DSTATE_b autosar_swc_vmp_rtARID_DEF.UnitDelay4_DSTATE_n autosar_swc_vmp_rtARID_DEF.UnitDelay5_DSTATE autosar_swc_vmp_rtARID_DEF.UnitDelay_DSTATE_o /end REF_MEASUREMENT
/end GROUP
/begin GROUP autosar_swc_vmp_autosar_swc_vmp_Step_sys_lgt_pln_lonap_grp_objectCtrl_lonap_grp_followCtrl_AcceSwitch14 "autosar_swc_vmp/autosar_swc_vmp_Step_sys/lgt_pln/lonap_grp_objectCtrl/lonap_grp_followCtrl/AcceSwitch14"
 /begin REF_CHARACTERISTIC P_LONP_FollowDecelAccMinLimitBySpd P_LONP_SpdForFollowDecelCal /end REF_CHARACTERISTIC
/end GROUP
/begin GROUP autosar_swc_vmp_autosar_swc_vmp_Step_sys_lgt_pln_lonap_grp_objectCtrl_lonap_grp_followCtrl_Counter_Limited "autosar_swc_vmp/autosar_swc_vmp_Step_sys/lgt_pln/lonap_grp_objectCtrl/lonap_grp_followCtrl/Counter\nLimited"
 /begin SUB_GROUP autosar_swc_vmp_autosar_swc_vmp_Step_sys_lgt_pln_lonap_grp_objectCtrl_lonap_grp_followCtrl_Counter_Limited_Increment_Real_World /end SUB_GROUP
 /begin REF_MEASUREMENT LONP_Follow_Counter autosar_swc_vmp_rtARID_DEF.Output_DSTATE_d /end REF_MEASUREMENT
/end GROUP
/begin GROUP autosar_swc_vmp_autosar_swc_vmp_Step_sys_lgt_pln_lonap_grp_objectCtrl_lonap_grp_followCtrl_Counter_Limited_Increment_Real_World "autosar_swc_vmp/autosar_swc_vmp_Step_sys/lgt_pln/lonap_grp_objectCtrl/lonap_grp_followCtrl/Counter\nLimited/Increment\nReal World" /begin REF_MEASUREMENT LONP_Follow_Counter /end REF_MEASUREMENT /end GROUP
/begin GROUP autosar_swc_vmp_autosar_swc_vmp_Step_sys_lgt_pln_lonap_grp_objectCtrl_lonap_grp_followCtrl_Subsystem "autosar_swc_vmp/autosar_swc_vmp_Step_sys/lgt_pln/lonap_grp_objectCtrl/lonap_grp_followCtrl/Subsystem"
 /begin SUB_GROUP autosar_swc_vmp_autosar_swc_vmp_Step_sys_lgt_pln_lonap_grp_objectCtrl_lonap_grp_followCtrl_Subsystem_lonap_grp_followBandJerkCalc /end SUB_GROUP
/end GROUP
/begin GROUP autosar_swc_vmp_autosar_swc_vmp_Step_sys_lgt_pln_lonap_grp_objectCtrl_lonap_grp_followCtrl_Subsystem1 "autosar_swc_vmp/autosar_swc_vmp_Step_sys/lgt_pln/lonap_grp_objectCtrl/lonap_grp_followCtrl/Subsystem1"
 /begin REF_MEASUREMENT autosar_swc_vmp_rtARID_DEF.UnitDelay1_DSTATE_a autosar_swc_vmp_rtARID_DEF.UnitDelay2_DSTATE_a autosar_swc_vmp_rtARID_DEF.UnitDelay3_DSTATE_ig autosar_swc_vmp_rtARID_DEF.UnitDelay_DSTATE_b /end REF_MEASUREMENT
/end GROUP
/begin GROUP autosar_swc_vmp_autosar_swc_vmp_Step_sys_lgt_pln_lonap_grp_objectCtrl_lonap_grp_followCtrl_Subsystem_lonap_grp_followBandJerkCalc "autosar_swc_vmp/autosar_swc_vmp_Step_sys/lgt_pln/lonap_grp_objectCtrl/lonap_grp_followCtrl/Subsystem/lonap_grp_followBandJerkCalc"
 /begin SUB_GROUP autosar_swc_vmp_autosar_swc_vmp_Step_sys_lgt_pln_lonap_grp_objectCtrl_lonap_grp_followCtrl_Subsystem_lonap_grp_followBandJerkCalc_lonap_accelFollowAfterJerk autosar_swc_vmp_autosar_swc_vmp_Step_sys_lgt_pln_lonap_grp_objectCtrl_lonap_grp_followCtrl_Subsystem_lonap_grp_followBandJerkCalc_lonap_accelFollowJerkCalc autosar_swc_vmp_autosar_swc_vmp_Step_sys_lgt_pln_lonap_grp_objectCtrl_lonap_grp_followCtrl_Subsystem_lonap_grp_followBandJerkCalc_lonap_accelFollowLowPass autosar_swc_vmp_autosar_swc_vmp_Step_sys_lgt_pln_lonap_grp_objectCtrl_lonap_grp_followCtrl_Subsystem_lonap_grp_followBandJerkCalc_lonap_decelFollowJerkCalc1 /end SUB_GROUP
/end GROUP
/begin GROUP autosar_swc_vmp_autosar_swc_vmp_Step_sys_lgt_pln_lonap_grp_objectCtrl_lonap_grp_followCtrl_Subsystem_lonap_grp_followBandJerkCalc_lonap_accelFollowJerkCalc "autosar_swc_vmp/autosar_swc_vmp_Step_sys/lgt_pln/lonap_grp_objectCtrl/lonap_grp_followCtrl/Subsystem/lonap_grp_followBandJerkCalc/lonap_accelFollowJerkCalc"
 /begin REF_CHARACTERISTIC P_LONP_FollowAccelCharNegVlcAcc2CoefEnlargeAccelJerkXAxis P_LONP_FollowAccelJerkNegFollowAccel P_LONP_FollowCoefCharCoefEnlargeAccelJerkYAxis P_LONP_FollowJerkCharAccelJerkYAxis P_LONP_FollowVelCharAccelJerkXAxis /end REF_CHARACTERISTIC
/end GROUP
/begin GROUP autosar_swc_vmp_autosar_swc_vmp_Step_sys_lgt_pln_lonap_grp_objectCtrl_lonap_grp_followCtrl_Subsystem_lonap_grp_followBandJerkCalc_lonap_accelFollowLowPass "autosar_swc_vmp/autosar_swc_vmp_Step_sys/lgt_pln/lonap_grp_objectCtrl/lonap_grp_followCtrl/Subsystem/lonap_grp_followBandJerkCalc/lonap_accelFollowLowPass"
 /begin REF_MEASUREMENT autosar_swc_vmp_rtARID_DEF.UnitDelay1_DSTATE_b5 autosar_swc_vmp_rtARID_DEF.UnitDelay_DSTATE_a /end REF_MEASUREMENT
/end GROUP
/begin GROUP autosar_swc_vmp_autosar_swc_vmp_Step_sys_lgt_pln_lonap_grp_objectCtrl_lonap_grp_followCtrl_Subsystem_lonap_grp_followBandJerkCalc_lonap_decelFollowJerkCalc1 "autosar_swc_vmp/autosar_swc_vmp_Step_sys/lgt_pln/lonap_grp_objectCtrl/lonap_grp_followCtrl/Subsystem/lonap_grp_followBandJerkCalc/lonap_decelFollowJerkCalc1"
 /begin SUB_GROUP autosar_swc_vmp_autosar_swc_vmp_Step_sys_lgt_pln_lonap_grp_objectCtrl_lonap_grp_followCtrl_Subsystem_lonap_grp_followBandJerkCalc_lonap_decelFollowJerkCalc1_Compare_To_Constant autosar_swc_vmp_autosar_swc_vmp_Step_sys_lgt_pln_lonap_grp_objectCtrl_lonap_grp_followCtrl_Subsystem_lonap_grp_followBandJerkCalc_lonap_decelFollowJerkCalc1_Compare_To_Constant1 autosar_swc_vmp_autosar_swc_vmp_Step_sys_lgt_pln_lonap_grp_objectCtrl_lonap_grp_followCtrl_Subsystem_lonap_grp_followBandJerkCalc_lonap_decelFollowJerkCalc1_Compare_To_Constant2 /end SUB_GROUP
 /begin REF_CHARACTERISTIC LONP_JerkForDecelToStopFac P_LONP_FollowDecelJerkDiffTTC2GapCorrXAxis P_LONP_FollowDecelJerkDiffTTC2GapCorrYAxis P_LONP_FollowDecelJerkForceSlopeXAxis P_LONP_FollowDecelJerkForceSlopeYAxis P_LONP_FollowdecelJerkCharXAxis P_LONP_FollowdecelJerkCharYAxis P_LONP_FollowttcCorrDecelJerkXAxis P_LONP_FollowttcCorrDecelJerkYAxis P_LONP_accelTargAbsFiltThrd /end REF_CHARACTERISTIC
 /begin REF_MEASUREMENT autosar_swc_vmp_rtARID_DEF.lowerJerkOverride /end REF_MEASUREMENT
/end GROUP
/begin GROUP autosar_swc_vmp_autosar_swc_vmp_Step_sys_lgt_pln_lonap_grp_objectCtrl_lonap_grp_followCtrl_Subsystem_lonap_grp_followBandJerkCalc_lonap_decelFollowJerkCalc1_Compare_To_Constant1 "autosar_swc_vmp/autosar_swc_vmp_Step_sys/lgt_pln/lonap_grp_objectCtrl/lonap_grp_followCtrl/Subsystem/lonap_grp_followBandJerkCalc/lonap_decelFollowJerkCalc1/Compare\nTo Constant1" /begin REF_CHARACTERISTIC P_LONP_FollowDecelJerkDiffTTC2GapCorrEnableVelSubjThres /end REF_CHARACTERISTIC /end GROUP
/begin GROUP autosar_swc_vmp_autosar_swc_vmp_Step_sys_lgt_pln_lonap_grp_objectCtrl_lonap_grp_followCtrl_Subsystem_lonap_grp_followBandJerkCalc_lonap_decelFollowJerkCalc1_Compare_To_Constant2 "autosar_swc_vmp/autosar_swc_vmp_Step_sys/lgt_pln/lonap_grp_objectCtrl/lonap_grp_followCtrl/Subsystem/lonap_grp_followBandJerkCalc/lonap_decelFollowJerkCalc1/Compare\nTo Constant2" /begin REF_CHARACTERISTIC P_LONP_FollowDecelJerkDiffTTC2GapCorrEnableTTCThres /end REF_CHARACTERISTIC /end GROUP
/begin GROUP autosar_swc_vmp_autosar_swc_vmp_Step_sys_lgt_pln_lonap_grp_objectCtrl_lonap_grp_followCtrl_TargetIDUpdate "autosar_swc_vmp/autosar_swc_vmp_Step_sys/lgt_pln/lonap_grp_objectCtrl/lonap_grp_followCtrl/TargetIDUpdate"
 /begin SUB_GROUP autosar_swc_vmp_autosar_swc_vmp_Step_sys_lgt_pln_lonap_grp_objectCtrl_lonap_grp_followCtrl_TargetIDUpdate_AtomicSubsystem /end SUB_GROUP
 /begin REF_MEASUREMENT autosar_swc_vmp_rtARID_DEF.is_TargetRel autosar_swc_vmp_rtARID_DEF.is_active_c858_autosar_swc_vmp autosar_swc_vmp_rtARID_DEF.is_c858_autosar_swc_vmp /end REF_MEASUREMENT
/end GROUP
/begin GROUP autosar_swc_vmp_autosar_swc_vmp_Step_sys_lgt_pln_lonap_grp_objectCtrl_lonap_grp_followCtrl_TargetIDUpdate_AtomicSubsystem "autosar_swc_vmp/autosar_swc_vmp_Step_sys/lgt_pln/lonap_grp_objectCtrl/lonap_grp_followCtrl/TargetIDUpdate/AtomicSubsystem"
 /begin SUB_GROUP autosar_swc_vmp_autosar_swc_vmp_Step_sys_lgt_pln_lonap_grp_objectCtrl_lonap_grp_followCtrl_TargetIDUpdate_AtomicSubsystem_L__P /end SUB_GROUP
 /begin REF_CHARACTERISTIC P_LONP_P1ObjActiveEnable P_LONP_P1ObjSafeDist P_LONP_PreTime P_LONP_SW2P1_P0HightThrd /end REF_CHARACTERISTIC
 /begin REF_MEASUREMENT LONP_ACCTgtObjVy autosar_swc_vmp_rtARID_DEF.UnitDelay_DSTATE_g /end REF_MEASUREMENT
/end GROUP
/begin GROUP autosar_swc_vmp_autosar_swc_vmp_Step_sys_lgt_pln_lonap_grp_objectCtrl_lonap_grp_followCtrl_TargetIDUpdate_AtomicSubsystem_L__P "autosar_swc_vmp/autosar_swc_vmp_Step_sys/lgt_pln/lonap_grp_objectCtrl/lonap_grp_followCtrl/TargetIDUpdate/AtomicSubsystem/L  P" /begin REF_MEASUREMENT autosar_swc_vmp_rtARID_DEF.UnitDelay_DSTATE_p /end REF_MEASUREMENT /end GROUP
/begin GROUP autosar_swc_vmp_autosar_swc_vmp_Step_sys_lgt_pln_lonap_grp_objectCtrl_lonap_grp_followCtrl_lonap_accelTargFilter "autosar_swc_vmp/autosar_swc_vmp_Step_sys/lgt_pln/lonap_grp_objectCtrl/lonap_grp_followCtrl/lonap_accelTargFilter"
 /begin REF_MEASUREMENT autosar_swc_vmp_rtARID_DEF.TappedDelay1_X_e autosar_swc_vmp_rtARID_DEF.TappedDelay2_X_i autosar_swc_vmp_rtARID_DEF.TappedDelay3_X autosar_swc_vmp_rtARID_DEF.TappedDelay_X autosar_swc_vmp_rtARID_DEF.accelTargAbsFiltP0K1 autosar_swc_vmp_rtARID_DEF.accelTargAbsFiltP1K1 autosar_swc_vmp_rtARID_DEF.accelTargAbsFiltP2K1 autosar_swc_vmp_rtARID_DEF.accelTargAbsFiltP3K1 /end REF_MEASUREMENT
/end GROUP
/begin GROUP autosar_swc_vmp_autosar_swc_vmp_Step_sys_lgt_pln_lonap_grp_objectCtrl_lonap_grp_followCtrl_lonap_decelToStopCtrl "autosar_swc_vmp/autosar_swc_vmp_Step_sys/lgt_pln/lonap_grp_objectCtrl/lonap_grp_followCtrl/lonap_decelToStopCtrl"
 /begin SUB_GROUP autosar_swc_vmp_autosar_swc_vmp_Step_sys_lgt_pln_lonap_grp_objectCtrl_lonap_grp_followCtrl_lonap_decelToStopCtrl_P_LongCtrl_velSubjThresEnableStopAdd /end SUB_GROUP
 /begin REF_CHARACTERISTIC P_LONP_FollowDistDesAddForceStop P_LONP_FollowVelSubjThresForceStopXAxis P_LONP_FollowVelSubjThresForceStopYAxis P_LONP_FollowaccelForceStopMinCharXAxis P_LONP_FollowaccelForceStopMinCharYAxis P_LONP_FollowaccelStopMax P_LONP_FollowaccelTargThresEnableStop P_LONP_FollowaccelTargThresForceStop P_LONP_FollowdistThresEnableStop P_LONP_FollowjerkForceStopCharXAxis P_LONP_FollowjerkForceStopCharYAxis P_LONP_FollowvelSubjThresEnableStop P_LONP_FollowvelTarAbsThresForceStop P_LONP_distDesAddForceStopP0Lost /end REF_CHARACTERISTIC
 /begin REF_MEASUREMENT autosar_swc_vmp_rtARID_DEF.ACCModeStsK1_j autosar_swc_vmp_rtARID_DEF.accelForce autosar_swc_vmp_rtARID_DEF.accelForceClear autosar_swc_vmp_rtARID_DEF.counter /end REF_MEASUREMENT
/end GROUP
/begin GROUP autosar_swc_vmp_autosar_swc_vmp_Step_sys_lgt_pln_lonap_grp_objectCtrl_lonap_grp_followCtrl_lonap_decelToStopCtrl_P_LongCtrl_velSubjThresEnableStopAdd "autosar_swc_vmp/autosar_swc_vmp_Step_sys/lgt_pln/lonap_grp_objectCtrl/lonap_grp_followCtrl/lonap_decelToStopCtrl/P_LongCtrl_velSubjThresEnableStopAdd"
 /begin REF_CHARACTERISTIC P_LONP_FollowDistDiff2VelSubjThresEnableStop P_LONP_FollowVelSubjForceStopEnable P_LONP_FollowaccelFollowDesThresEnableStopXAxis P_LONP_FollowaccelFollowDesThresEnableStopYAxis P_LONP_FollowdistDesStopMin P_LONP_FollowvelSubjThresEnableStop P_LONP_FollowvelSubjThresEnableStopAddXAxis P_LONP_FollowvelSubjThresEnableStopAddYAxis /end REF_CHARACTERISTIC
/end GROUP
/begin GROUP autosar_swc_vmp_autosar_swc_vmp_Step_sys_lgt_pln_lonap_grp_objectCtrl_lonap_grp_followCtrl_lonap_grp_followAccelCalc "autosar_swc_vmp/autosar_swc_vmp_Step_sys/lgt_pln/lonap_grp_objectCtrl/lonap_grp_followCtrl/lonap_grp_followAccelCalc"
 /begin SUB_GROUP autosar_swc_vmp_autosar_swc_vmp_Step_sys_lgt_pln_lonap_grp_objectCtrl_lonap_grp_followCtrl_lonap_grp_followAccelCalc_lonap_accelTargAbsEnableJudge autosar_swc_vmp_autosar_swc_vmp_Step_sys_lgt_pln_lonap_grp_objectCtrl_lonap_grp_followCtrl_lonap_grp_followAccelCalc_lonap_advanceBraking autosar_swc_vmp_autosar_swc_vmp_Step_sys_lgt_pln_lonap_grp_objectCtrl_lonap_grp_followCtrl_lonap_grp_followAccelCalc_lonap_distDesCalc autosar_swc_vmp_autosar_swc_vmp_Step_sys_lgt_pln_lonap_grp_objectCtrl_lonap_grp_followCtrl_lonap_grp_followAccelCalc_lonap_distRelPlanTerminateCalc autosar_swc_vmp_autosar_swc_vmp_Step_sys_lgt_pln_lonap_grp_objectCtrl_lonap_grp_followCtrl_lonap_grp_followAccelCalc_lonap_grp_velPlan autosar_swc_vmp_autosar_swc_vmp_Step_sys_lgt_pln_lonap_grp_objectCtrl_lonap_grp_followCtrl_lonap_grp_followAccelCalc_lonap_timeToCollision1 autosar_swc_vmp_autosar_swc_vmp_Step_sys_lgt_pln_lonap_grp_objectCtrl_lonap_grp_followCtrl_lonap_grp_followAccelCalc_lonap_velTargPlanTerminateCalc /end SUB_GROUP
/end GROUP
/begin GROUP autosar_swc_vmp_autosar_swc_vmp_Step_sys_lgt_pln_lonap_grp_objectCtrl_lonap_grp_followCtrl_lonap_grp_followAccelCalc_lonap_accelTargAbsEnableJudge "autosar_swc_vmp/autosar_swc_vmp_Step_sys/lgt_pln/lonap_grp_objectCtrl/lonap_grp_followCtrl/lonap_grp_followAccelCalc/lonap_accelTargAbsEnableJudge"
 /begin REF_CHARACTERISTIC P_LONP_FollowaccelTargAbsEnableNegJerk P_LONP_FollowaccelTargAbsEnableNegMax P_LONP_FollowaccelTargAbsEnablePosJerk P_LONP_FollowaccelTargAbsEnableRangeMax P_LONP_FollowaccelTargAbsExitNegMin P_LONP_FollowdistTargRelEnableAccelTargAbsThres /end REF_CHARACTERISTIC
/end GROUP
/begin GROUP autosar_swc_vmp_autosar_swc_vmp_Step_sys_lgt_pln_lonap_grp_objectCtrl_lonap_grp_followCtrl_lonap_grp_followAccelCalc_lonap_advanceBraking "autosar_swc_vmp/autosar_swc_vmp_Step_sys/lgt_pln/lonap_grp_objectCtrl/lonap_grp_followCtrl/lonap_grp_followAccelCalc/lonap_advanceBraking"
 /begin REF_CHARACTERISTIC P_LONP_DistSwitchCofEnable P_LONP_DistTerCofX1Axis P_LONP_DistTerCofX2Axis P_LONP_DistTerCofYAxis /end REF_CHARACTERISTIC
/end GROUP
/begin GROUP autosar_swc_vmp_autosar_swc_vmp_Step_sys_lgt_pln_lonap_grp_objectCtrl_lonap_grp_followCtrl_lonap_grp_followAccelCalc_lonap_distDesCalc "autosar_swc_vmp/autosar_swc_vmp_Step_sys/lgt_pln/lonap_grp_objectCtrl/lonap_grp_followCtrl/lonap_grp_followAccelCalc/lonap_distDesCalc"
 /begin SUB_GROUP autosar_swc_vmp_autosar_swc_vmp_Step_sys_lgt_pln_lonap_grp_objectCtrl_lonap_grp_followCtrl_lonap_grp_followAccelCalc_lonap_distDesCalc_If_Action_Subsystem2 autosar_swc_vmp_autosar_swc_vmp_Step_sys_lgt_pln_lonap_grp_objectCtrl_lonap_grp_followCtrl_lonap_grp_followAccelCalc_lonap_distDesCalc_If_Action_Subsystem3 autosar_swc_vmp_autosar_swc_vmp_Step_sys_lgt_pln_lonap_grp_objectCtrl_lonap_grp_followCtrl_lonap_grp_followAccelCalc_lonap_distDesCalc_Subsystem autosar_swc_vmp_autosar_swc_vmp_Step_sys_lgt_pln_lonap_grp_objectCtrl_lonap_grp_followCtrl_lonap_grp_followAccelCalc_lonap_distDesCalc_Subsystem1 /end SUB_GROUP
/end GROUP
/begin GROUP autosar_swc_vmp_autosar_swc_vmp_Step_sys_lgt_pln_lonap_grp_objectCtrl_lonap_grp_followCtrl_lonap_grp_followAccelCalc_lonap_distDesCalc_If_Action_Subsystem2 "autosar_swc_vmp/autosar_swc_vmp_Step_sys/lgt_pln/lonap_grp_objectCtrl/lonap_grp_followCtrl/lonap_grp_followAccelCalc/lonap_distDesCalc/If Action\nSubsystem2"
 /begin REF_CHARACTERISTIC P_LONP_P2DistDesCurOffSet P_PLAN_DPC_FrontObj_DX_03 P_PLAN_DPC_xiangduisudu_kmh /end REF_CHARACTERISTIC
/end GROUP
/begin GROUP autosar_swc_vmp_autosar_swc_vmp_Step_sys_lgt_pln_lonap_grp_objectCtrl_lonap_grp_followCtrl_lonap_grp_followAccelCalc_lonap_distDesCalc_If_Action_Subsystem3 "autosar_swc_vmp/autosar_swc_vmp_Step_sys/lgt_pln/lonap_grp_objectCtrl/lonap_grp_followCtrl/lonap_grp_followAccelCalc/lonap_distDesCalc/If Action\nSubsystem3"
 /begin REF_CHARACTERISTIC P_LONP_P3DistDesCurOffSet P_PLAN_DPC_FrontObj_DX_03 P_PLAN_DPC_xiangduisudu_kmh /end REF_CHARACTERISTIC
/end GROUP
/begin GROUP autosar_swc_vmp_autosar_swc_vmp_Step_sys_lgt_pln_lonap_grp_objectCtrl_lonap_grp_followCtrl_lonap_grp_followAccelCalc_lonap_distDesCalc_Subsystem "autosar_swc_vmp/autosar_swc_vmp_Step_sys/lgt_pln/lonap_grp_objectCtrl/lonap_grp_followCtrl/lonap_grp_followAccelCalc/lonap_distDesCalc/Subsystem"
 /begin REF_CHARACTERISTIC P_LONP_CutinMinVaildDistance P_LONP_CutinTTCThrethold P_LONP_FollowDesDistAddP0Lost P_LONP_FollowDistDesCompensionVelRelThresMax P_LONP_FollowDistDesCompensionVelRelThresMin P_LONP_FollowdistDesCompensionXAxis P_LONP_FollowdistDesCompensionYAxis P_LONP_FollowdistDesTimegapLevel P_LONP_FollowdistDesX2Axis P_LONP_FollowdistDesYAxis P_LONP_TTCConsiderAccelTimeXaxis P_LONP_TTCConsiderAccelTimeYaxis P_LONP_TruckFollowdistDesX2Axis P_LONP_TruckFollowdistDesYAxis P_LONP_VelRelP0DistCofX P_LONP_VelRelP0DistCofY P_LONP_cofEnable P_LONP_cofJerk P_LONP_distRelDesCorrPlanEnlargeCof /end REF_CHARACTERISTIC
/end GROUP
/begin GROUP autosar_swc_vmp_autosar_swc_vmp_Step_sys_lgt_pln_lonap_grp_objectCtrl_lonap_grp_followCtrl_lonap_grp_followAccelCalc_lonap_distDesCalc_Subsystem1 "autosar_swc_vmp/autosar_swc_vmp_Step_sys/lgt_pln/lonap_grp_objectCtrl/lonap_grp_followCtrl/lonap_grp_followAccelCalc/lonap_distDesCalc/Subsystem1"
 /begin REF_CHARACTERISTIC P_LONP_FollowDistDesCompensionVelRelThresMax P_LONP_FollowDistDesCompensionVelRelThresMin P_LONP_FollowdistDesCompensionXAxis P_LONP_FollowdistDesCompensionYAxis P_LONP_FollowdistDesX2Axis P_LONP_FollowdistDesYAxis /end REF_CHARACTERISTIC
/end GROUP
/begin GROUP autosar_swc_vmp_autosar_swc_vmp_Step_sys_lgt_pln_lonap_grp_objectCtrl_lonap_grp_followCtrl_lonap_grp_followAccelCalc_lonap_grp_velPlan "autosar_swc_vmp/autosar_swc_vmp_Step_sys/lgt_pln/lonap_grp_objectCtrl/lonap_grp_followCtrl/lonap_grp_followAccelCalc/lonap_grp_velPlan"
 /begin SUB_GROUP autosar_swc_vmp_autosar_swc_vmp_Step_sys_lgt_pln_lonap_grp_objectCtrl_lonap_grp_followCtrl_lonap_grp_followAccelCalc_lonap_grp_velPlan_lonap_costCoefEnlarge autosar_swc_vmp_autosar_swc_vmp_Step_sys_lgt_pln_lonap_grp_objectCtrl_lonap_grp_followCtrl_lonap_grp_followAccelCalc_lonap_grp_velPlan_lonap_numSmooth autosar_swc_vmp_autosar_swc_vmp_Step_sys_lgt_pln_lonap_grp_objectCtrl_lonap_grp_followCtrl_lonap_grp_followAccelCalc_lonap_grp_velPlan_lonap_numUpdateDecision autosar_swc_vmp_autosar_swc_vmp_Step_sys_lgt_pln_lonap_grp_objectCtrl_lonap_grp_followCtrl_lonap_grp_followAccelCalc_lonap_grp_velPlan_lonap_spdPlanning /end SUB_GROUP
/end GROUP
/begin GROUP autosar_swc_vmp_autosar_swc_vmp_Step_sys_lgt_pln_lonap_grp_objectCtrl_lonap_grp_followCtrl_lonap_grp_followAccelCalc_lonap_grp_velPlan_lonap_numSmooth "autosar_swc_vmp/autosar_swc_vmp_Step_sys/lgt_pln/lonap_grp_objectCtrl/lonap_grp_followCtrl/lonap_grp_followAccelCalc/lonap_grp_velPlan/lonap_numSmooth" /begin REF_CHARACTERISTIC P_LONP_FollowVelTargetAbsSmoothNum /end REF_CHARACTERISTIC /end GROUP
/begin GROUP autosar_swc_vmp_autosar_swc_vmp_Step_sys_lgt_pln_lonap_grp_objectCtrl_lonap_grp_followCtrl_lonap_grp_followAccelCalc_lonap_grp_velPlan_lonap_numUpdateDecision "autosar_swc_vmp/autosar_swc_vmp_Step_sys/lgt_pln/lonap_grp_objectCtrl/lonap_grp_followCtrl/lonap_grp_followAccelCalc/lonap_grp_velPlan/lonap_numUpdateDecision" /begin REF_CHARACTERISTIC P_LONP_FollowRateJConditionStep P_LONP_FollowRateJDirStep /end REF_CHARACTERISTIC /end GROUP
/begin GROUP autosar_swc_vmp_autosar_swc_vmp_Step_sys_lgt_pln_lonap_grp_objectCtrl_lonap_grp_followCtrl_lonap_grp_followAccelCalc_lonap_grp_velPlan_lonap_spdPlanning "autosar_swc_vmp/autosar_swc_vmp_Step_sys/lgt_pln/lonap_grp_objectCtrl/lonap_grp_followCtrl/lonap_grp_followAccelCalc/lonap_grp_velPlan/lonap_spdPlanning"
 /begin REF_CHARACTERISTIC P_LONP_DecVParamPts P_LONP_DecVParamValue P_LONP_FollowRateJConditionStep P_LONP_FollowRateJDirStep P_LONP_FollowSwitch P_LONP_FollowVelSubjNegToleranceAddX1Axis P_LONP_FollowVelSubjNegToleranceAddX2Axis P_LONP_FollowVelSubjNegToleranceAddYAxis P_LONP_FollowVelTargetAbsSmoothNum P_LONP_FollowWdCoefXAxis P_LONP_FollowWdCoefYAxis P_LONP_FollowWvCoefXAxis P_LONP_FollowWvCoefYAxis P_LONP_FollowcoefDistEnlargeDecToStop P_LONP_FollowcoefVelEnlargeDecToStop P_LONP_MaxAveAForSpdPlan P_LONP_MaxAveVForSpdPlan P_LONP_MiniAveAForSpdPlan P_LONP_MiniAveVForSpdPlan P_LONP_iEnd P_LONP_iStart /end REF_CHARACTERISTIC
 /begin REF_MEASUREMENT LONP_VlcInternalAccK20 /end REF_MEASUREMENT
/end GROUP
/begin GROUP autosar_swc_vmp_autosar_swc_vmp_Step_sys_lgt_pln_lonap_grp_objectCtrl_lonap_grp_followCtrl_lonap_grp_followAccelCalc_lonap_timeToCollision1 "autosar_swc_vmp/autosar_swc_vmp_Step_sys/lgt_pln/lonap_grp_objectCtrl/lonap_grp_followCtrl/lonap_grp_followAccelCalc/lonap_timeToCollision1" /begin REF_CHARACTERISTIC P_LONP_decelFollowJerkTTCSwitchEnable /end REF_CHARACTERISTIC /begin REF_MEASUREMENT LONP_VlcInternalAccK20 /end REF_MEASUREMENT /end GROUP
/begin GROUP autosar_swc_vmp_autosar_swc_vmp_Step_sys_lgt_pln_lonap_grp_objectCtrl_lonap_grp_followCtrl_lonap_grp_plausibilityCheck "autosar_swc_vmp/autosar_swc_vmp_Step_sys/lgt_pln/lonap_grp_objectCtrl/lonap_grp_followCtrl/lonap_grp_plausibilityCheck"
 /begin SUB_GROUP autosar_swc_vmp_autosar_swc_vmp_Step_sys_lgt_pln_lonap_grp_objectCtrl_lonap_grp_followCtrl_lonap_grp_plausibilityCheck_lonap_plauCheckEnable autosar_swc_vmp_autosar_swc_vmp_Step_sys_lgt_pln_lonap_grp_objectCtrl_lonap_grp_followCtrl_lonap_grp_plausibilityCheck_lonap_quickDecel autosar_swc_vmp_autosar_swc_vmp_Step_sys_lgt_pln_lonap_grp_objectCtrl_lonap_grp_followCtrl_lonap_grp_plausibilityCheck_lonap_standstillOverrideAccelLimit autosar_swc_vmp_autosar_swc_vmp_Step_sys_lgt_pln_lonap_grp_objectCtrl_lonap_grp_followCtrl_lonap_grp_plausibilityCheck_lonap_standstillOverrideCondition /end SUB_GROUP
/end GROUP
/begin GROUP autosar_swc_vmp_autosar_swc_vmp_Step_sys_lgt_pln_lonap_grp_objectCtrl_lonap_grp_followCtrl_lonap_grp_plausibilityCheck_lonap_plauCheckEnable "autosar_swc_vmp/autosar_swc_vmp_Step_sys/lgt_pln/lonap_grp_objectCtrl/lonap_grp_followCtrl/lonap_grp_plausibilityCheck/lonap_plauCheckEnable"
 /begin REF_CHARACTERISTIC P_LONP_DecVParamPts P_LONP_DecVParamValue P_LONP_FollowcoefAccelFadeOutPlauCheck P_LONP_FollowdistRelDevCalcDistConst P_LONP_FollowdistRelThresEnablePlauCheck P_LONP_FollowvelRelThresEnablePlauCheck P_LONP_FollowvelSubjMaxEnablePlauCheck P_LONP_FollowvelSubjThresEnablePlauCheck P_LONP_NewDvAFolFac P_LONP_NewDvDfdXpt P_LONP_NewDvDfdYpt P_LONP_NewDvDfiXpt P_LONP_NewDvDfiYpt P_LONP_NewDvDfpXpt P_LONP_NewDvDfpYpt P_LONP_NewDvFollowTime P_LONP_NewDvSafeDis P_LONP_NewDvVfdXpt P_LONP_NewDvVfdYpt P_LONP_NewDvVfiXpt P_LONP_NewDvVfiYpt P_LONP_NewDvVfpXpt P_LONP_NewDvVfpYpt P_LONP_TimeSwitch P_LONP_UseDecSwitch P_LONP_facDelay /end REF_CHARACTERISTIC
 /begin REF_MEASUREMENT autosar_swc_vmp_rtARID_DEF.ACCAge autosar_swc_vmp_rtARID_DEF.ACCAge2 autosar_swc_vmp_rtARID_DEF.DeceAge autosar_swc_vmp_rtARID_DEF.DeceAge2 autosar_swc_vmp_rtARID_DEF.GoAge autosar_swc_vmp_rtARID_DEF.StpAge autosar_swc_vmp_rtARID_DEF.StpAge2 autosar_swc_vmp_rtARID_DEF.TappedDelay_X_a autosar_swc_vmp_rtARID_DEF.ctrlState autosar_swc_vmp_rtARID_DEF.disEIntegrate autosar_swc_vmp_rtARID_DEF.disErorK1 autosar_swc_vmp_rtARID_DEF.velEIntegrate autosar_swc_vmp_rtARID_DEF.velErorK1 /end REF_MEASUREMENT
/end GROUP
/begin GROUP autosar_swc_vmp_autosar_swc_vmp_Step_sys_lgt_pln_lonap_grp_objectCtrl_lonap_grp_followCtrl_lonap_grp_plausibilityCheck_lonap_quickDecel "autosar_swc_vmp/autosar_swc_vmp_Step_sys/lgt_pln/lonap_grp_objectCtrl/lonap_grp_followCtrl/lonap_grp_plausibilityCheck/lonap_quickDecel"
 /begin SUB_GROUP autosar_swc_vmp_autosar_swc_vmp_Step_sys_lgt_pln_lonap_grp_objectCtrl_lonap_grp_followCtrl_lonap_grp_plausibilityCheck_lonap_quickDecel_Compare_To_Constant autosar_swc_vmp_autosar_swc_vmp_Step_sys_lgt_pln_lonap_grp_objectCtrl_lonap_grp_followCtrl_lonap_grp_plausibilityCheck_lonap_quickDecel_Compare_To_Constant3 autosar_swc_vmp_autosar_swc_vmp_Step_sys_lgt_pln_lonap_grp_objectCtrl_lonap_grp_followCtrl_lonap_grp_plausibilityCheck_lonap_quickDecel_Compare_To_Constant4 /end SUB_GROUP
 /begin REF_CHARACTERISTIC P_LONP_FollowQuickDecelDiffDistRel2DesThres /end REF_CHARACTERISTIC
/end GROUP
/begin GROUP autosar_swc_vmp_autosar_swc_vmp_Step_sys_lgt_pln_lonap_grp_objectCtrl_lonap_grp_followCtrl_lonap_grp_plausibilityCheck_lonap_quickDecel_Compare_To_Constant "autosar_swc_vmp/autosar_swc_vmp_Step_sys/lgt_pln/lonap_grp_objectCtrl/lonap_grp_followCtrl/lonap_grp_plausibilityCheck/lonap_quickDecel/Compare\nTo Constant" /begin REF_CHARACTERISTIC P_LONP_FollowQuickDecelVelTargRelThres /end REF_CHARACTERISTIC /end GROUP
/begin GROUP autosar_swc_vmp_autosar_swc_vmp_Step_sys_lgt_pln_lonap_grp_objectCtrl_lonap_grp_followCtrl_lonap_grp_plausibilityCheck_lonap_quickDecel_Compare_To_Constant3 "autosar_swc_vmp/autosar_swc_vmp_Step_sys/lgt_pln/lonap_grp_objectCtrl/lonap_grp_followCtrl/lonap_grp_plausibilityCheck/lonap_quickDecel/Compare\nTo Constant3" /begin REF_CHARACTERISTIC P_LONP_FollowQuickDecelVelSubjThres /end REF_CHARACTERISTIC /end GROUP
/begin GROUP autosar_swc_vmp_autosar_swc_vmp_Step_sys_lgt_pln_lonap_grp_objectCtrl_lonap_grp_followCtrl_lonap_grp_plausibilityCheck_lonap_quickDecel_Compare_To_Constant4 "autosar_swc_vmp/autosar_swc_vmp_Step_sys/lgt_pln/lonap_grp_objectCtrl/lonap_grp_followCtrl/lonap_grp_plausibilityCheck/lonap_quickDecel/Compare\nTo Constant4" /begin REF_CHARACTERISTIC P_LONP_FollowQuickAccelTargAbsEnableThres /end REF_CHARACTERISTIC /end GROUP
/begin GROUP autosar_swc_vmp_autosar_swc_vmp_Step_sys_lgt_pln_lonap_grp_objectCtrl_lonap_grp_followCtrl_lonap_grp_plausibilityCheck_lonap_standstillOverrideAccelLimit "autosar_swc_vmp/autosar_swc_vmp_Step_sys/lgt_pln/lonap_grp_objectCtrl/lonap_grp_followCtrl/lonap_grp_plausibilityCheck/lonap_standstillOverrideAccelLimit" /begin REF_CHARACTERISTIC P_LONP_FollowQuickDecelAccelDesMax /end REF_CHARACTERISTIC /begin REF_MEASUREMENT autosar_swc_vmp_rtARID_DEF.coefStandstillOverride /end REF_MEASUREMENT /end GROUP
/begin GROUP autosar_swc_vmp_autosar_swc_vmp_Step_sys_lgt_pln_lonap_grp_objectCtrl_lonap_grp_followCtrl_lonap_grp_plausibilityCheck_lonap_standstillOverrideCondition "autosar_swc_vmp/autosar_swc_vmp_Step_sys/lgt_pln/lonap_grp_objectCtrl/lonap_grp_followCtrl/lonap_grp_plausibilityCheck/lonap_standstillOverrideCondition"
 /begin REF_CHARACTERISTIC P_LONP_FollowcoefAccelStandstillOverride P_LONP_FollowdistRelMaxJudgeStationaryTarget P_LONP_FollowvelTargAbsMaxJudgeStationaryTarget /end REF_CHARACTERISTIC
 /begin REF_MEASUREMENT autosar_swc_vmp_rtARID_DEF.ACCModeK1 autosar_swc_vmp_rtARID_DEF.ACCModeStateFullFill autosar_swc_vmp_rtARID_DEF.coefStandstillOverride /end REF_MEASUREMENT
/end GROUP
/begin GROUP autosar_swc_vmp_autosar_swc_vmp_Step_sys_lgt_pln_lonap_grp_objectCtrl_lonap_grp_followCtrl_lonap_signalMatrix "autosar_swc_vmp/autosar_swc_vmp_Step_sys/lgt_pln/lonap_grp_objectCtrl/lonap_grp_followCtrl/lonap_signalMatrix"
 /begin REF_MEASUREMENT autosar_swc_vmp_rtARID_DEF.TappedDelay1_X_g autosar_swc_vmp_rtARID_DEF.TappedDelay2_X_o autosar_swc_vmp_rtARID_DEF.TappedDelay3_X_b autosar_swc_vmp_rtARID_DEF.TappedDelay4_X autosar_swc_vmp_rtARID_DEF.TappedDelay_X_p /end REF_MEASUREMENT
/end GROUP
/begin GROUP autosar_swc_vmp_autosar_swc_vmp_Step_sys_lgt_pln_lonap_grp_objectCtrl_lonap_grp_followCtrl_lonap_slopeStartUpAssist "autosar_swc_vmp/autosar_swc_vmp_Step_sys/lgt_pln/lonap_grp_objectCtrl/lonap_grp_followCtrl/lonap_slopeStartUpAssist"
 /begin SUB_GROUP autosar_swc_vmp_autosar_swc_vmp_Step_sys_lgt_pln_lonap_grp_objectCtrl_lonap_grp_followCtrl_lonap_slopeStartUpAssist_Compare_To_Constant /end SUB_GROUP
 /begin REF_CHARACTERISTIC P_LONP_FollowAccelAddSlopeAssistXAxis P_LONP_FollowAccelAddSlopeAssistYAxis P_LONP_FollowAccelDesThresStartUpAssistEnable P_LONP_FollowCoefStartUpAssistFadeOut P_LONP_FollowStartUpAssist P_LONP_FollowVelSubjThresStartUpAssistEnable P_LONP_FollowVelTargAbsThresStartUpAssistEnable P_LONP_FollowtStartUpAssistEnableMax /end REF_CHARACTERISTIC
 /begin REF_MEASUREMENT autosar_swc_vmp_rtARID_DEF.ACCModeStsK1 autosar_swc_vmp_rtARID_DEF.accelSlopeAssist autosar_swc_vmp_rtARID_DEF.coefVelDist2Accel autosar_swc_vmp_rtARID_DEF.tStartUpEnable /end REF_MEASUREMENT
/end GROUP
/begin GROUP autosar_swc_vmp_autosar_swc_vmp_Step_sys_lgt_pln_lonap_grp_offRampDistance "autosar_swc_vmp/autosar_swc_vmp_Step_sys/lgt_pln/lonap_grp_offRampDistance"
 /begin SUB_GROUP autosar_swc_vmp_autosar_swc_vmp_Step_sys_lgt_pln_lonap_grp_offRampDistance_lonap_accelOffRampCalc autosar_swc_vmp_autosar_swc_vmp_Step_sys_lgt_pln_lonap_grp_offRampDistance_lonap_ordBandJerkCalc autosar_swc_vmp_autosar_swc_vmp_Step_sys_lgt_pln_lonap_grp_offRampDistance_lonap_ordCtrlState autosar_swc_vmp_autosar_swc_vmp_Step_sys_lgt_pln_lonap_grp_offRampDistance_lonap_ordForceStopCtrl /end SUB_GROUP
/end GROUP
/begin GROUP autosar_swc_vmp_autosar_swc_vmp_Step_sys_lgt_pln_lonap_grp_offRampDistance1 "autosar_swc_vmp/autosar_swc_vmp_Step_sys/lgt_pln/lonap_grp_offRampDistance1"
 /begin SUB_GROUP autosar_swc_vmp_autosar_swc_vmp_Step_sys_lgt_pln_lonap_grp_offRampDistance1_lonap_accelOffRampCalc autosar_swc_vmp_autosar_swc_vmp_Step_sys_lgt_pln_lonap_grp_offRampDistance1_lonap_ordBandJerkCalc autosar_swc_vmp_autosar_swc_vmp_Step_sys_lgt_pln_lonap_grp_offRampDistance1_lonap_ordCtrlState autosar_swc_vmp_autosar_swc_vmp_Step_sys_lgt_pln_lonap_grp_offRampDistance1_lonap_ordForceStopCtrl /end SUB_GROUP
/end GROUP
/begin GROUP autosar_swc_vmp_autosar_swc_vmp_Step_sys_lgt_pln_lonap_grp_offRampDistance1_lonap_accelOffRampCalc "autosar_swc_vmp/autosar_swc_vmp_Step_sys/lgt_pln/lonap_grp_offRampDistance1/lonap_accelOffRampCalc"
 /begin REF_CHARACTERISTIC P_LONP_ORDdecelEnable P_LONP_ORDvelDeltaEnableThres P_LONP_StpPtOverAccelValue /end REF_CHARACTERISTIC
/end GROUP
/begin GROUP autosar_swc_vmp_autosar_swc_vmp_Step_sys_lgt_pln_lonap_grp_offRampDistance1_lonap_ordBandJerkCalc "autosar_swc_vmp/autosar_swc_vmp_Step_sys/lgt_pln/lonap_grp_offRampDistance1/lonap_ordBandJerkCalc"
 /begin REF_CHARACTERISTIC P_LONP_ENDlowerJerk P_LONP_ORDaccelDevLowerBand P_LONP_ORDaccelDevUpperBand P_LONP_ORDupperJerk P_LONP_roadEndDis /end REF_CHARACTERISTIC
/end GROUP
/begin GROUP autosar_swc_vmp_autosar_swc_vmp_Step_sys_lgt_pln_lonap_grp_offRampDistance1_lonap_ordCtrlState "autosar_swc_vmp/autosar_swc_vmp_Step_sys/lgt_pln/lonap_grp_offRampDistance1/lonap_ordCtrlState"
 /begin REF_CHARACTERISTIC P_LONP_ORDAccelThrdSpdXAxis P_LONP_ORDAccelThrdSpdYAxis P_LONP_ORDdecelEnable P_LONP_ORDvelDeltaEnableThres P_LONP_SpdStopCtrlDistThrdYAxis P_LONP_SpdStopCtrlVehSpdXAxis P_LONP_velOffRampLimitMin /end REF_CHARACTERISTIC
/end GROUP
/begin GROUP autosar_swc_vmp_autosar_swc_vmp_Step_sys_lgt_pln_lonap_grp_offRampDistance1_lonap_ordForceStopCtrl "autosar_swc_vmp/autosar_swc_vmp_Step_sys/lgt_pln/lonap_grp_offRampDistance1/lonap_ordForceStopCtrl"
 /begin SUB_GROUP autosar_swc_vmp_autosar_swc_vmp_Step_sys_lgt_pln_lonap_grp_offRampDistance1_lonap_ordForceStopCtrl_Atomic_Subsystem /end SUB_GROUP
/end GROUP
/begin GROUP autosar_swc_vmp_autosar_swc_vmp_Step_sys_lgt_pln_lonap_grp_offRampDistance1_lonap_ordForceStopCtrl_Atomic_Subsystem "autosar_swc_vmp/autosar_swc_vmp_Step_sys/lgt_pln/lonap_grp_offRampDistance1/lonap_ordForceStopCtrl/Atomic Subsystem"
 /begin REF_CHARACTERISTIC P_LONP_DistDesTnresStopCtrl P_LONP_accelForceMinStopCtrl P_LONP_axvRoadSlopeMs2StopCtrl P_LONP_jerkStopCtrl P_LONP_velSubjThresStopCtrl /end REF_CHARACTERISTIC
/end GROUP
/begin GROUP autosar_swc_vmp_autosar_swc_vmp_Step_sys_lgt_pln_lonap_grp_offRampDistance2 "autosar_swc_vmp/autosar_swc_vmp_Step_sys/lgt_pln/lonap_grp_offRampDistance2"
 /begin SUB_GROUP autosar_swc_vmp_autosar_swc_vmp_Step_sys_lgt_pln_lonap_grp_offRampDistance2_lonap_accelOffRampCalc autosar_swc_vmp_autosar_swc_vmp_Step_sys_lgt_pln_lonap_grp_offRampDistance2_lonap_ordBandJerkCalc autosar_swc_vmp_autosar_swc_vmp_Step_sys_lgt_pln_lonap_grp_offRampDistance2_lonap_ordCtrlState autosar_swc_vmp_autosar_swc_vmp_Step_sys_lgt_pln_lonap_grp_offRampDistance2_lonap_ordForceStopCtrl /end SUB_GROUP
/end GROUP
/begin GROUP autosar_swc_vmp_autosar_swc_vmp_Step_sys_lgt_pln_lonap_grp_offRampDistance2_lonap_accelOffRampCalc "autosar_swc_vmp/autosar_swc_vmp_Step_sys/lgt_pln/lonap_grp_offRampDistance2/lonap_accelOffRampCalc"
 /begin REF_CHARACTERISTIC P_LONP_ORDdecelEnable P_LONP_ORDvelDeltaEnableThres P_LONP_StpPtOverAccelValue /end REF_CHARACTERISTIC
/end GROUP
/begin GROUP autosar_swc_vmp_autosar_swc_vmp_Step_sys_lgt_pln_lonap_grp_offRampDistance2_lonap_ordBandJerkCalc "autosar_swc_vmp/autosar_swc_vmp_Step_sys/lgt_pln/lonap_grp_offRampDistance2/lonap_ordBandJerkCalc"
 /begin REF_CHARACTERISTIC P_LONP_ORDaccelDevLowerBand P_LONP_ORDaccelDevUpperBand P_LONP_ORDlowerJerk P_LONP_ORDupperJerk /end REF_CHARACTERISTIC
/end GROUP
/begin GROUP autosar_swc_vmp_autosar_swc_vmp_Step_sys_lgt_pln_lonap_grp_offRampDistance2_lonap_ordCtrlState "autosar_swc_vmp/autosar_swc_vmp_Step_sys/lgt_pln/lonap_grp_offRampDistance2/lonap_ordCtrlState"
 /begin REF_CHARACTERISTIC P_LONP_ORDAccelThrdSpdXAxis P_LONP_ORDAccelThrdSpdYAxis P_LONP_ORDdecelEnable P_LONP_ORDvelDeltaEnableThres P_LONP_SpdStopCtrlDistThrdYAxis P_LONP_SpdStopCtrlVehSpdXAxis P_LONP_velOffRampLimitMin /end REF_CHARACTERISTIC
/end GROUP
/begin GROUP autosar_swc_vmp_autosar_swc_vmp_Step_sys_lgt_pln_lonap_grp_offRampDistance2_lonap_ordForceStopCtrl "autosar_swc_vmp/autosar_swc_vmp_Step_sys/lgt_pln/lonap_grp_offRampDistance2/lonap_ordForceStopCtrl"
 /begin SUB_GROUP autosar_swc_vmp_autosar_swc_vmp_Step_sys_lgt_pln_lonap_grp_offRampDistance2_lonap_ordForceStopCtrl_Atomic_Subsystem /end SUB_GROUP
/end GROUP
/begin GROUP autosar_swc_vmp_autosar_swc_vmp_Step_sys_lgt_pln_lonap_grp_offRampDistance2_lonap_ordForceStopCtrl_Atomic_Subsystem "autosar_swc_vmp/autosar_swc_vmp_Step_sys/lgt_pln/lonap_grp_offRampDistance2/lonap_ordForceStopCtrl/Atomic Subsystem"
 /begin REF_CHARACTERISTIC P_LONP_DistDesTnresStopCtrl P_LONP_accelForceMinStopCtrl P_LONP_axvRoadSlopeMs2StopCtrl P_LONP_jerkStopCtrl P_LONP_velSubjThresStopCtrl /end REF_CHARACTERISTIC
/end GROUP
/begin GROUP autosar_swc_vmp_autosar_swc_vmp_Step_sys_lgt_pln_lonap_grp_offRampDistance_lonap_accelOffRampCalc "autosar_swc_vmp/autosar_swc_vmp_Step_sys/lgt_pln/lonap_grp_offRampDistance/lonap_accelOffRampCalc"
 /begin REF_CHARACTERISTIC P_LONP_ORDdecelEnable P_LONP_ORDvelDeltaEnableThres P_LONP_StpPtOverAccelValue /end REF_CHARACTERISTIC
/end GROUP
/begin GROUP autosar_swc_vmp_autosar_swc_vmp_Step_sys_lgt_pln_lonap_grp_offRampDistance_lonap_ordBandJerkCalc "autosar_swc_vmp/autosar_swc_vmp_Step_sys/lgt_pln/lonap_grp_offRampDistance/lonap_ordBandJerkCalc"
 /begin REF_CHARACTERISTIC P_LONP_ORDaccelDevLowerBand P_LONP_ORDaccelDevUpperBand P_LONP_ORDlowerJerk P_LONP_ORDupperJerk /end REF_CHARACTERISTIC
/end GROUP
/begin GROUP autosar_swc_vmp_autosar_swc_vmp_Step_sys_lgt_pln_lonap_grp_offRampDistance_lonap_ordCtrlState "autosar_swc_vmp/autosar_swc_vmp_Step_sys/lgt_pln/lonap_grp_offRampDistance/lonap_ordCtrlState"
 /begin REF_CHARACTERISTIC P_LONP_ORDAccelThrdSpdXAxis P_LONP_ORDAccelThrdSpdYAxis P_LONP_ORDdecelEnable P_LONP_ORDvelDeltaEnableThres P_LONP_SpdStopCtrlDistThrdYAxis P_LONP_SpdStopCtrlVehSpdXAxis P_LONP_velOffRampLimitMin /end REF_CHARACTERISTIC
/end GROUP
/begin GROUP autosar_swc_vmp_autosar_swc_vmp_Step_sys_lgt_pln_lonap_grp_offRampDistance_lonap_ordForceStopCtrl "autosar_swc_vmp/autosar_swc_vmp_Step_sys/lgt_pln/lonap_grp_offRampDistance/lonap_ordForceStopCtrl"
 /begin SUB_GROUP autosar_swc_vmp_autosar_swc_vmp_Step_sys_lgt_pln_lonap_grp_offRampDistance_lonap_ordForceStopCtrl_Atomic_Subsystem /end SUB_GROUP
/end GROUP
/begin GROUP autosar_swc_vmp_autosar_swc_vmp_Step_sys_lgt_pln_lonap_grp_offRampDistance_lonap_ordForceStopCtrl_Atomic_Subsystem "autosar_swc_vmp/autosar_swc_vmp_Step_sys/lgt_pln/lonap_grp_offRampDistance/lonap_ordForceStopCtrl/Atomic Subsystem"
 /begin REF_CHARACTERISTIC P_LONP_DistDesTnresStopCtrl P_LONP_accelForceMinStopCtrl P_LONP_axvRoadSlopeMs2StopCtrl P_LONP_jerkStopCtrl P_LONP_velSubjThresStopCtrl /end REF_CHARACTERISTIC
/end GROUP
/begin GROUP autosar_swc_vmp_autosar_swc_vmp_Step_sys_lgt_pln_lonap_grp_stateJudge "autosar_swc_vmp/autosar_swc_vmp_Step_sys/lgt_pln/lonap_grp_stateJudge"
 /begin SUB_GROUP autosar_swc_vmp_autosar_swc_vmp_Step_sys_lgt_pln_lonap_grp_stateJudge_lonap_brakePreferJudge autosar_swc_vmp_autosar_swc_vmp_Step_sys_lgt_pln_lonap_grp_stateJudge_lonap_deceleToStop autosar_swc_vmp_autosar_swc_vmp_Step_sys_lgt_pln_lonap_grp_stateJudge_lonap_driverOffConditionFulfilled autosar_swc_vmp_autosar_swc_vmp_Step_sys_lgt_pln_lonap_grp_stateJudge_lonap_takeOver_ttc_2_5 autosar_swc_vmp_autosar_swc_vmp_Step_sys_lgt_pln_lonap_grp_stateJudge_ttc_3 /end SUB_GROUP
/end GROUP
/begin GROUP autosar_swc_vmp_autosar_swc_vmp_Step_sys_lgt_pln_lonap_grp_stateJudge_lonap_brakePreferJudge "autosar_swc_vmp/autosar_swc_vmp_Step_sys/lgt_pln/lonap_grp_stateJudge/lonap_brakePreferJudge"
 /begin SUB_GROUP autosar_swc_vmp_autosar_swc_vmp_Step_sys_lgt_pln_lonap_grp_stateJudge_lonap_brakePreferJudge_Compare_To_Constant1 autosar_swc_vmp_autosar_swc_vmp_Step_sys_lgt_pln_lonap_grp_stateJudge_lonap_brakePreferJudge_Compare_To_Constant2 autosar_swc_vmp_autosar_swc_vmp_Step_sys_lgt_pln_lonap_grp_stateJudge_lonap_brakePreferJudge_Compare_To_Constant3 autosar_swc_vmp_autosar_swc_vmp_Step_sys_lgt_pln_lonap_grp_stateJudge_lonap_brakePreferJudge_Compare_To_Constant4 autosar_swc_vmp_autosar_swc_vmp_Step_sys_lgt_pln_lonap_grp_stateJudge_lonap_brakePreferJudge_Compare_To_Constant5 autosar_swc_vmp_autosar_swc_vmp_Step_sys_lgt_pln_lonap_grp_stateJudge_lonap_brakePreferJudge_Compare_To_Constant6 autosar_swc_vmp_autosar_swc_vmp_Step_sys_lgt_pln_lonap_grp_stateJudge_lonap_brakePreferJudge_Compare_To_Constant7 autosar_swc_vmp_autosar_swc_vmp_Step_sys_lgt_pln_lonap_grp_stateJudge_lonap_brakePreferJudge_Compare_To_Constant8 /end SUB_GROUP
/end GROUP
/begin GROUP autosar_swc_vmp_autosar_swc_vmp_Step_sys_lgt_pln_lonap_grp_stateJudge_lonap_brakePreferJudge_Compare_To_Constant1 "autosar_swc_vmp/autosar_swc_vmp_Step_sys/lgt_pln/lonap_grp_stateJudge/lonap_brakePreferJudge/Compare\nTo Constant1" /begin REF_CHARACTERISTIC P_LONP_SJaccelFollowThresEnableBrkPrefer /end REF_CHARACTERISTIC /end GROUP
/begin GROUP autosar_swc_vmp_autosar_swc_vmp_Step_sys_lgt_pln_lonap_grp_stateJudge_lonap_brakePreferJudge_Compare_To_Constant2 "autosar_swc_vmp/autosar_swc_vmp_Step_sys/lgt_pln/lonap_grp_stateJudge/lonap_brakePreferJudge/Compare\nTo Constant2" /begin REF_CHARACTERISTIC P_LONP_SJaccelSubjPlanOptThresEnableBrkPrefer /end REF_CHARACTERISTIC /end GROUP
/begin GROUP autosar_swc_vmp_autosar_swc_vmp_Step_sys_lgt_pln_lonap_grp_stateJudge_lonap_brakePreferJudge_Compare_To_Constant3 "autosar_swc_vmp/autosar_swc_vmp_Step_sys/lgt_pln/lonap_grp_stateJudge/lonap_brakePreferJudge/Compare\nTo Constant3" /begin REF_CHARACTERISTIC P_LONP_SJVlcInternalAccThresEnableBrkPrefer /end REF_CHARACTERISTIC /end GROUP
/begin GROUP autosar_swc_vmp_autosar_swc_vmp_Step_sys_lgt_pln_lonap_grp_stateJudge_lonap_brakePreferJudge_Compare_To_Constant4 "autosar_swc_vmp/autosar_swc_vmp_Step_sys/lgt_pln/lonap_grp_stateJudge/lonap_brakePreferJudge/Compare\nTo Constant4" /begin REF_CHARACTERISTIC P_LONP_SJaxvRoadSlopeThresEnableBrkPrefer /end REF_CHARACTERISTIC /end GROUP
/begin GROUP autosar_swc_vmp_autosar_swc_vmp_Step_sys_lgt_pln_lonap_grp_stateJudge_lonap_brakePreferJudge_Compare_To_Constant5 "autosar_swc_vmp/autosar_swc_vmp_Step_sys/lgt_pln/lonap_grp_stateJudge/lonap_brakePreferJudge/Compare\nTo Constant5" /begin REF_CHARACTERISTIC P_LONP_SJaccelSubjThresEnableBrkPrefer /end REF_CHARACTERISTIC /end GROUP
/begin GROUP autosar_swc_vmp_autosar_swc_vmp_Step_sys_lgt_pln_lonap_grp_stateJudge_lonap_brakePreferJudge_Compare_To_Constant6 "autosar_swc_vmp/autosar_swc_vmp_Step_sys/lgt_pln/lonap_grp_stateJudge/lonap_brakePreferJudge/Compare\nTo Constant6" /begin REF_CHARACTERISTIC P_LONP_SJttcThresEnableBrkPrefer /end REF_CHARACTERISTIC /end GROUP
/begin GROUP autosar_swc_vmp_autosar_swc_vmp_Step_sys_lgt_pln_lonap_grp_stateJudge_lonap_brakePreferJudge_Compare_To_Constant8 "autosar_swc_vmp/autosar_swc_vmp_Step_sys/lgt_pln/lonap_grp_stateJudge/lonap_brakePreferJudge/Compare\nTo Constant8" /begin REF_CHARACTERISTIC P_LONP_SJvelSubjThresEnableBrkPrefer /end REF_CHARACTERISTIC /end GROUP
/begin GROUP autosar_swc_vmp_autosar_swc_vmp_Step_sys_lgt_pln_lonap_grp_stateJudge_lonap_deceleToStop "autosar_swc_vmp/autosar_swc_vmp_Step_sys/lgt_pln/lonap_grp_stateJudge/lonap_deceleToStop"
 /begin REF_CHARACTERISTIC P_LONP_distThreDecToStopXAxis P_LONP_distThreDecToStopYAxis P_LONP_velSubjThreDecToStop P_LONP_velTargetThreDecleToStop /end REF_CHARACTERISTIC
/end GROUP
/begin GROUP autosar_swc_vmp_autosar_swc_vmp_Step_sys_lgt_pln_lonap_grp_stateJudge_lonap_driverOffConditionFulfilled "autosar_swc_vmp/autosar_swc_vmp_Step_sys/lgt_pln/lonap_grp_stateJudge/lonap_driverOffConditionFulfilled"
 /begin SUB_GROUP autosar_swc_vmp_autosar_swc_vmp_Step_sys_lgt_pln_lonap_grp_stateJudge_lonap_driverOffConditionFulfilled_Atomic_Subsystem2 autosar_swc_vmp_autosar_swc_vmp_Step_sys_lgt_pln_lonap_grp_stateJudge_lonap_driverOffConditionFulfilled_Subsystem /end SUB_GROUP
 /begin REF_CHARACTERISTIC P_LONP_FollowDrvOffDistCorrDistFullFillOverride P_LONP_FollowDrvOffDistCorrVelFullFillOverride P_LONP_FollowDrvOffDistExitNoOverride P_LONP_FollowDrvOffDistExitOverride P_LONP_FollowDrvOffDistOffsetdDesiredAutoDrvOff P_LONP_FollowDrvOffStandstillVelThres P_LONP_FollowDrvOffVelCorrVelFullFillOverride P_LONP_FollowDrvOffVelExitDistCorrNoOverride P_LONP_FollowDrvOffVelExitDistCorrOverride P_LONP_FollowDrvOffVelExitVelCorrNoOverride P_LONP_FollowDrvOffVelExitVelCorrOverride P_LONP_FollowDrvOffVelRelMinAutoDrvOff P_LONP_FollowDrvOffVelRelMinAutoDrvOffSecond P_LONP_FollowDrvOffdistRelMinAutoDrvOff P_LONP_FollowDrvOffvSetMinDriveOffConditions P_LONP_PedestrianDistThrd /end REF_CHARACTERISTIC
 /begin REF_MEASUREMENT autosar_swc_vmp_rtARID_DEF.DesiredDistGap autosar_swc_vmp_rtARID_DEF.DriveOffConditonFulfilled autosar_swc_vmp_rtARID_DEF.dxSensObj_modify autosar_swc_vmp_rtARID_DEF.is_DriveOff_Follow autosar_swc_vmp_rtARID_DEF.is_active_c892_autosar_swc_vmp autosar_swc_vmp_rtARID_DEF.is_c892_autosar_swc_vmp autosar_swc_vmp_rtARID_DEF.timestep /end REF_MEASUREMENT
/end GROUP
/begin GROUP autosar_swc_vmp_autosar_swc_vmp_Step_sys_lgt_pln_lonap_grp_stateJudge_lonap_driverOffConditionFulfilled_Atomic_Subsystem2 "autosar_swc_vmp/autosar_swc_vmp_Step_sys/lgt_pln/lonap_grp_stateJudge/lonap_driverOffConditionFulfilled/Atomic Subsystem2"
 /begin REF_CHARACTERISTIC P_LONP_ObjVehVel P_LONP_distTargRelChgValueMax P_LONP_distTargRelChgValueMin P_LONP_distTargRelValueThrd /end REF_CHARACTERISTIC
 /begin REF_MEASUREMENT autosar_swc_vmp_rtARID_DEF.TappedDelay1_X_d autosar_swc_vmp_rtARID_DEF.TappedDelay_X_f autosar_swc_vmp_rtARID_DEF.UnitDelay1_DSTATE_l autosar_swc_vmp_rtARID_DEF.UnitDelay2_DSTATE_f autosar_swc_vmp_rtARID_DEF.UnitDelay3_DSTATE_d autosar_swc_vmp_rtARID_DEF.is_active_c891_autosar_swc_vmp autosar_swc_vmp_rtARID_DEF.is_c891_autosar_swc_vmp /end REF_MEASUREMENT
/end GROUP
/begin GROUP autosar_swc_vmp_autosar_swc_vmp_Step_sys_lgt_pln_lonap_grp_stateJudge_lonap_driverOffConditionFulfilled_Subsystem "autosar_swc_vmp/autosar_swc_vmp_Step_sys/lgt_pln/lonap_grp_stateJudge/lonap_driverOffConditionFulfilled/Subsystem"
 /begin SUB_GROUP autosar_swc_vmp_autosar_swc_vmp_Step_sys_lgt_pln_lonap_grp_stateJudge_lonap_driverOffConditionFulfilled_Subsystem_Compare_To_Constant3 autosar_swc_vmp_autosar_swc_vmp_Step_sys_lgt_pln_lonap_grp_stateJudge_lonap_driverOffConditionFulfilled_Subsystem_Compare_To_Constant4 /end SUB_GROUP
/end GROUP
/begin GROUP autosar_swc_vmp_autosar_swc_vmp_Step_sys_lgt_pln_lonap_grp_stateJudge_lonap_driverOffConditionFulfilled_Subsystem_Compare_To_Constant3 "autosar_swc_vmp/autosar_swc_vmp_Step_sys/lgt_pln/lonap_grp_stateJudge/lonap_driverOffConditionFulfilled/Subsystem/Compare\nTo Constant3" /begin REF_MEASUREMENT autosar_swc_vmp_rtARID_DEF.DriveOffConditonFulfilled /end REF_MEASUREMENT /end GROUP
/begin GROUP autosar_swc_vmp_autosar_swc_vmp_Step_sys_lgt_pln_lonap_grp_stateJudge_lonap_driverOffConditionFulfilled_Subsystem_Compare_To_Constant4 "autosar_swc_vmp/autosar_swc_vmp_Step_sys/lgt_pln/lonap_grp_stateJudge/lonap_driverOffConditionFulfilled/Subsystem/Compare\nTo Constant4" /begin REF_MEASUREMENT autosar_swc_vmp_rtARID_DEF.DriveOffConditonFulfilled /end REF_MEASUREMENT /end GROUP
/begin GROUP autosar_swc_vmp_autosar_swc_vmp_Step_sys_lgt_pln_lonap_grp_stateJudge_lonap_takeOver_ttc_2_5 "autosar_swc_vmp/autosar_swc_vmp_Step_sys/lgt_pln/lonap_grp_stateJudge/lonap_takeOver ttc<2.5"
 /begin SUB_GROUP autosar_swc_vmp_autosar_swc_vmp_Step_sys_lgt_pln_lonap_grp_stateJudge_lonap_takeOver_ttc_2_5_If_Action_Subsystem autosar_swc_vmp_autosar_swc_vmp_Step_sys_lgt_pln_lonap_grp_stateJudge_lonap_takeOver_ttc_2_5_Subsystem /end SUB_GROUP
/end GROUP
/begin GROUP autosar_swc_vmp_autosar_swc_vmp_Step_sys_lgt_pln_lonap_grp_stateJudge_lonap_takeOver_ttc_2_5_If_Action_Subsystem "autosar_swc_vmp/autosar_swc_vmp_Step_sys/lgt_pln/lonap_grp_stateJudge/lonap_takeOver ttc<2.5/If Action\nSubsystem"
 /begin SUB_GROUP autosar_swc_vmp_autosar_swc_vmp_Step_sys_lgt_pln_lonap_grp_stateJudge_lonap_takeOver_ttc_2_5_If_Action_Subsystem_ActiveTORThrd autosar_swc_vmp_autosar_swc_vmp_Step_sys_lgt_pln_lonap_grp_stateJudge_lonap_takeOver_ttc_2_5_If_Action_Subsystem_Gap autosar_swc_vmp_autosar_swc_vmp_Step_sys_lgt_pln_lonap_grp_stateJudge_lonap_takeOver_ttc_2_5_If_Action_Subsystem_Subsystem1 /end SUB_GROUP
 /begin REF_CHARACTERISTIC P_LONP_FollowaccelThresActiveTOR P_LONP_FollowcoefDistRelThresActiveTOR P_LONP_FollowgapThresActiveTOR P_LONP_FollowvelTargRelThresActiveTOR P_LONP_TorTTCThrd /end REF_CHARACTERISTIC
/end GROUP
/begin GROUP autosar_swc_vmp_autosar_swc_vmp_Step_sys_lgt_pln_lonap_grp_stateJudge_lonap_takeOver_ttc_2_5_If_Action_Subsystem_ActiveTORThrd "autosar_swc_vmp/autosar_swc_vmp_Step_sys/lgt_pln/lonap_grp_stateJudge/lonap_takeOver ttc<2.5/If Action\nSubsystem/ActiveTORThrd"
 /begin REF_CHARACTERISTIC P_LONP_FollowaccelThresActiveTOR P_LONP_FollowaccelThresActiveTORHazerdObj P_LONP_FollowvelTargRelThresActiveTOR P_LONP_FollowvelTargRelThresActiveTORHazerdObj /end REF_CHARACTERISTIC
/end GROUP
/begin GROUP autosar_swc_vmp_autosar_swc_vmp_Step_sys_lgt_pln_lonap_grp_stateJudge_lonap_takeOver_ttc_2_5_If_Action_Subsystem_Subsystem1 "autosar_swc_vmp/autosar_swc_vmp_Step_sys/lgt_pln/lonap_grp_stateJudge/lonap_takeOver ttc<2.5/If Action\nSubsystem/Subsystem1" /begin REF_CHARACTERISTIC P_LONP_FollowcoefDistRelThresActiveTOR P_LONP_tCycle /end REF_CHARACTERISTIC /end GROUP
/begin GROUP autosar_swc_vmp_autosar_swc_vmp_Step_sys_lgt_pln_lonap_grp_stateJudge_ttc_3_If_Action_Subsystem "autosar_swc_vmp/autosar_swc_vmp_Step_sys/lgt_pln/lonap_grp_stateJudge/ttc<3/If Action\nSubsystem"
 /begin REF_CHARACTERISTIC P_LONP_FollowaccelThresActiveTOR P_LONP_FollowcoefDistRelThresActiveTOR P_LONP_FollowgapThresActiveTOR P_LONP_FollowvelTargRelThresActiveTOR P_LONP_TorTTCThrd /end REF_CHARACTERISTIC
/end GROUP
/begin GROUP autosar_swc_vmp_autosar_swc_vmp_Step_sys_lgt_pln_lonap_grp_stateJudge_ttc_3_If_Action_Subsystem_ActiveTORThrd "autosar_swc_vmp/autosar_swc_vmp_Step_sys/lgt_pln/lonap_grp_stateJudge/ttc<3/If Action\nSubsystem/ActiveTORThrd"
 /begin REF_CHARACTERISTIC P_LONP_FollowaccelThresActiveTOR P_LONP_FollowaccelThresActiveTORHazerdObj P_LONP_FollowvelTargRelThresActiveTOR P_LONP_FollowvelTargRelThresActiveTORHazerdObj /end REF_CHARACTERISTIC
/end GROUP
/begin GROUP autosar_swc_vmp_autosar_swc_vmp_Step_sys_lgt_pln_lonap_grp_stateJudge_ttc_3_If_Action_Subsystem_Subsystem "autosar_swc_vmp/autosar_swc_vmp_Step_sys/lgt_pln/lonap_grp_stateJudge/ttc<3/If Action\nSubsystem/Subsystem" /begin REF_CHARACTERISTIC P_LONP_FollowcoefDistRelThresActiveTOR P_LONP_tCycle /end REF_CHARACTERISTIC /end GROUP
/begin GROUP autosar_swc_vmp_autosar_swc_vmp_Step_sys_lgt_pln_lonap_vlcInternalAccCalc "autosar_swc_vmp/autosar_swc_vmp_Step_sys/lgt_pln/lonap_vlcInternalAccCalc" /begin REF_CHARACTERISTIC P_LONP_tCycle /end REF_CHARACTERISTIC /begin REF_MEASUREMENT LONP_VlcInternalAccK20 /end REF_MEASUREMENT /end GROUP
/begin RECORD_LAYOUT Record_BOOLEAN FNC_VALUES 1 UBYTE COLUMN_DIR DIRECT /end RECORD_LAYOUT
/begin RECORD_LAYOUT Record_FLOAT32_IEEE FNC_VALUES 1 FLOAT32_IEEE COLUMN_DIR DIRECT /end RECORD_LAYOUT
/begin RECORD_LAYOUT Record_FLOAT64_IEEE FNC_VALUES 1 FLOAT64_IEEE COLUMN_DIR DIRECT /end RECORD_LAYOUT
/begin RECORD_LAYOUT Record_UBYTE FNC_VALUES 1 UBYTE COLUMN_DIR DIRECT /end RECORD_LAYOUT
/begin RECORD_LAYOUT Axis_FLOAT32_IEEE AXIS_PTS_X 1 FLOAT32_IEEE INDEX_INCR DIRECT /end RECORD_LAYOUT
/end MODULE
/end PROJECT
