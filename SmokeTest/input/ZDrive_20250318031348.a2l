ASAP2_VERSION 1 71
/begin PROJECT ProjectName ""
/begin MODULE ModuleName ""
/begin MOD_COMMON "" BYTE_ORDER MSB_LAST ALIGNMENT_BYTE 1 ALIGNMENT_WORD 1 ALIGNMENT_LONG 1 ALIGNMENT_INT64 1 ALIGNMENT_FLOAT16_IEEE 1 ALIGNMENT_FLOAT32_IEEE 1 ALIGNMENT_FLOAT64_IEEE 1 /end MOD_COMMON
/begin RECORD_LAYOUT __UWORD_Z FNC_VALUES 1 UWORD ROW_DIR DIRECT /end RECORD_LAYOUT
/begin RECORD_LAYOUT __ULONG_Z FNC_VALUES 1 ULONG ROW_DIR DIRECT /end RECORD_LAYOUT
/begin CHARACTERISTIC CLTS_ALatThdInAsyEvlrCritEve_Ca "Threshold for detectable lateral acceleration." VALUE 0xfe503cbc /* @ECU_Address@CLTS_ALatThdInAsyEvlrCritEve_Ca@ */ Record_FLOAT32_IEEE 0 autosar_swc_aeb_CM_single_m_per_s 0.000000 1.000000 /end CHARACTERISTIC
/begin CHARACTERISTIC CLTS_ALgtThdForDrvrBrkgForLoVehStDlyInAsyEvlrCritEve_Ca "Driver deceleration request threshold in LTAP for detecting when driver is braking firmly" VALUE 0xfe503cd4 /* @ECU_Address@CLTS_ALgtThdForDrvrBrkgForLoVehStDlyInAsyEvlrCritEve_Ca@ */ Record_FLOAT32_IEEE 0 autosar_swc_aeb_CM_single_m_per_s 0.000000 20.000000 /end CHARACTERISTIC
/begin CHARACTERISTIC CLTS_AccTarCfmDlyEnadInAsyEvlrCritEve_Ca "Enables confirmation time before an ACC target is considered valid" VALUE 0xfe504188 /* @ECU_Address@CLTS_AccTarCfmDlyEnadInAsyEvlrCritEve_Ca@ */ Record_BOOLEAN 0 autosar_swc_aeb_CM_logical 0 1 /end CHARACTERISTIC
/begin CHARACTERISTIC CLTS_AccTarCfmDlyInAsyEvlrCritEve_Ca "Confirmation time before an ACC target is considered valid" VALUE 0xfe503ce4 /* @ECU_Address@CLTS_AccTarCfmDlyInAsyEvlrCritEve_Ca@ */ Record_FLOAT32_IEEE 0 autosar_swc_aeb_CM_single_s 0.000000 10.000000 /end CHARACTERISTIC
/begin CHARACTERISTIC CLTS_AgDirForBrkgMinInAsyEvlrCritEve_Ca "Minimum object heading angle for evaluation of braking out of path." VALUE 0xfe503cec /* @ECU_Address@CLTS_AgDirForBrkgMinInAsyEvlrCritEve_Ca@ */ Record_FLOAT32_IEEE 0 autosar_swc_aeb_CM_single_rad 0.000000 3.140000 /end CHARACTERISTIC
/begin CHARACTERISTIC CLTS_AltvMdlSteerAgMaxInAsyEvlrCritEve_Ca "Maximum steering angle, used in LTAP." VALUE 0xfe503cfc /* @ECU_Address@CLTS_AltvMdlSteerAgMaxInAsyEvlrCritEve_Ca@ */ Record_FLOAT32_IEEE 0 autosar_swc_aeb_CM_single_rad 0.000000 2.000000 /end CHARACTERISTIC
/begin CHARACTERISTIC CLTS_AltvMdlSteerWhlAgRateMaxInAsyEvlrCritEve_Ca "Maximum steering wheel angle rate, used in LTAP." VALUE 0xfe503d00 /* @ECU_Address@CLTS_AltvMdlSteerWhlAgRateMaxInAsyEvlrCritEve_Ca@ */ Record_FLOAT32_IEEE 0 autosar_swc_aeb_CM_single_rad_per_s 0.000000 20.000000 /end CHARACTERISTIC
/begin CHARACTERISTIC CLTS_AnimEnaInAsyEvlrCritEve_Ca "Enable animals in front for evaluation." VALUE 0xfe504189 /* @ECU_Address@CLTS_AnimEnaInAsyEvlrCritEve_Ca@ */ Record_BOOLEAN 0 autosar_swc_aeb_CM_logical 0 1 /end CHARACTERISTIC
/begin CHARACTERISTIC CLTS_AnimLenDftInAsyEvlrCritEve_Ca "Default length of animals." VALUE 0xfe503d04 /* @ECU_Address@CLTS_AnimLenDftInAsyEvlrCritEve_Ca@ */ Record_FLOAT32_IEEE 0 autosar_swc_aeb_CM_single_m 0.000000 5.000000 /end CHARACTERISTIC
/begin CHARACTERISTIC CLTS_BicycleEnaInAsyEvlrCritEve_Ca "Enable bicycles in front for evaluation." VALUE 0xfe50418a /* @ECU_Address@CLTS_BicycleEnaInAsyEvlrCritEve_Ca@ */ Record_BOOLEAN 0 autosar_swc_aeb_CM_logical 0 1 /end CHARACTERISTIC
/begin CHARACTERISTIC CLTS_BicycleLenDftInAsyEvlrCritEve_Ca "Default length of bicycles." VALUE 0xfe503d10 /* @ECU_Address@CLTS_BicycleLenDftInAsyEvlrCritEve_Ca@ */ Record_FLOAT32_IEEE 0 autosar_swc_aeb_CM_single_m 0.000000 5.000000 /end CHARACTERISTIC
/begin CHARACTERISTIC CLTS_BicycleSpdThdForSpdLoInAsyEvlrCritEve_Ca "The speed threshold for treating bicycles as pedestrians or vehicles" VALUE 0xfe503d14 /* @ECU_Address@CLTS_BicycleSpdThdForSpdLoInAsyEvlrCritEve_Ca@ */ Record_FLOAT32_IEEE 0 autosar_swc_aeb_CM_single_m_per_s 0.500000 5.000000 /end CHARACTERISTIC
/begin CHARACTERISTIC CLTS_BicycleWidthDftInAsyEvlrCritEve_Ca "Default width of bicycles" VALUE 0xfe503d20 /* @ECU_Address@CLTS_BicycleWidthDftInAsyEvlrCritEve_Ca@ */ Record_FLOAT32_IEEE 0 autosar_swc_aeb_CM_single_m 0.000000 4.000000 /end CHARACTERISTIC
/begin CHARACTERISTIC CLTS_BrkDlyLTAPInAsyEvlrCritEve_Ca "Delay values in lookup table for brake delay calculation" CURVE 0xfe504218 /* @ECU_Address@CLTS_BrkDlyLTAPInAsyEvlrCritEve_Ca@ */ Record_FLOAT32_IEEE 0 autosar_swc_aeb_CM_single_s 0.000000 1.000000
 /begin AXIS_DESCR COM_AXIS NO_INPUT_QUANTITY autosar_swc_aeb_CM_single_m_per_s 10 -20.000000 20.000000 AXIS_PTS_REF CLTS_AForBrkDlyInAsyEvlrCritEve_Ca /end AXIS_DESCR
/end CHARACTERISTIC
/begin CHARACTERISTIC CLTS_CarEnaInAsyEvlrCritEve_Ca "Enable cars in front for evaluation." VALUE 0xfe50418b /* @ECU_Address@CLTS_CarEnaInAsyEvlrCritEve_Ca@ */ Record_BOOLEAN 0 autosar_swc_aeb_CM_logical 0 1 /end CHARACTERISTIC
/begin CHARACTERISTIC CLTS_CarLenDftInAsyEvlrCritEve_Ca "Default length of cars." VALUE 0xfe503d2c /* @ECU_Address@CLTS_CarLenDftInAsyEvlrCritEve_Ca@ */ Record_FLOAT32_IEEE 0 autosar_swc_aeb_CM_single_m 0.000000 10.000000 /end CHARACTERISTIC
/begin CHARACTERISTIC CLTS_CrvtUpprLimInAsyEvlrCritEve_Ca "Upper limit of curvature output from TA." VALUE 0xfe503d30 /* @ECU_Address@CLTS_CrvtUpprLimInAsyEvlrCritEve_Ca@ */ Record_FLOAT32_IEEE 0 autosar_swc_aeb_CM_single_1_per_m 0.000000 1.000000 /end CHARACTERISTIC
/begin CHARACTERISTIC CLTS_DrvgSideDifMaxInAsyEvlrCritEve_Ca "" VALUE 0xfe5041af /* @ECU_Address@CLTS_DrvgSideDifMaxInAsyEvlrCritEve_Ca@ */ Record_SBYTE 0 autosar_swc_aeb_CM_int8 0.000000 100.000000 /end CHARACTERISTIC
/begin CHARACTERISTIC CLTS_DstAddlFromWhlAxleReToVehReInIntscnInAsyEvlrCritEve_Ca "The distance from rear wheel base to the assumed rear of host when checking if acceleration out of an intersection is possible" VALUE 0xfe503d38 /* @ECU_Address@CLTS_DstAddlFromWhlAxleReToVehReInIntscnInAsyEvlrCritEve_Ca@ */ Record_FLOAT32_IEEE 0 autosar_swc_aeb_CM_single_m -10.000000 2.000000 /end CHARACTERISTIC
/begin CHARACTERISTIC CLTS_DstForEvlnOfDrvgSideInAsyEvlrCritEve_Ca "Distance to object for evaluation of driving side." VALUE 0xfe503d3c /* @ECU_Address@CLTS_DstForEvlnOfDrvgSideInAsyEvlrCritEve_Ca@ */ Record_FLOAT32_IEEE 0 autosar_swc_aeb_CM_single_m 0.000000 100.000000 /end CHARACTERISTIC
/begin CHARACTERISTIC CLTS_JerkLowrLimInAsyEvlrCritEve_Ca "Lower limit of jerk output from TA." VALUE 0xfe503d50 /* @ECU_Address@CLTS_JerkLowrLimInAsyEvlrCritEve_Ca@ */ Record_FLOAT32_IEEE 0 autosar_swc_aeb_CM_single_m_per_s -100.000000 0.000000 /end CHARACTERISTIC
/begin CHARACTERISTIC CLTS_JerkMinDurnInAsyEvlrCritEve_Ca "The minimum time needed to reach ALatMax, ALatMin, ALgtMax or ALgtMin." VALUE 0xfe503d54 /* @ECU_Address@CLTS_JerkMinDurnInAsyEvlrCritEve_Ca@ */ Record_FLOAT32_IEEE 0 autosar_swc_aeb_CM_single_s 0.010000 5.000000 /end CHARACTERISTIC
/begin CHARACTERISTIC CLTS_MotorcycleEnaInAsyEvlrCritEve_Ca "Enable motorcycles in front for evaluation." VALUE 0xfe50418c /* @ECU_Address@CLTS_MotorcycleEnaInAsyEvlrCritEve_Ca@ */ Record_BOOLEAN 0 autosar_swc_aeb_CM_logical 0 1 /end CHARACTERISTIC
/begin CHARACTERISTIC CLTS_MotorcycleLenDftInAsyEvlrCritEve_Ca "Default length of motorcycles." VALUE 0xfe503d60 /* @ECU_Address@CLTS_MotorcycleLenDftInAsyEvlrCritEve_Ca@ */ Record_FLOAT32_IEEE 0 autosar_swc_aeb_CM_single_m 0.000000 5.000000 /end CHARACTERISTIC
/begin CHARACTERISTIC CLTS_ObjCrvtRotThdInAsyEvlrCritEve_Ca "Minimum object curvature for using circular prediction model." VALUE 0xfe503d64 /* @ECU_Address@CLTS_ObjCrvtRotThdInAsyEvlrCritEve_Ca@ */ Record_FLOAT32_IEEE 0 autosar_swc_aeb_CM_single_1_per_m 0.000100 0.010000 /end CHARACTERISTIC
/begin CHARACTERISTIC CLTS_ObjGenEnaInAsyEvlrCritEve_Ca "Enable general objects in front for evaluation." VALUE 0xfe50418d /* @ECU_Address@CLTS_ObjGenEnaInAsyEvlrCritEve_Ca@ */ Record_BOOLEAN 0 autosar_swc_aeb_CM_logical 0 1 /end CHARACTERISTIC
/begin CHARACTERISTIC CLTS_ObjLenDftInAsyEvlrCritEve_Ca "Default length of unclassified objects." VALUE 0xfe503d68 /* @ECU_Address@CLTS_ObjLenDftInAsyEvlrCritEve_Ca@ */ Record_FLOAT32_IEEE 0 autosar_swc_aeb_CM_single_m 0.000000 20.000000 /end CHARACTERISTIC
/begin CHARACTERISTIC CLTS_ObjPosnChkEnadInAsyEvlrCritEve_Ca "Enable check of whether objects are outside of the ego vehicle boundary." VALUE 0xfe50418e /* @ECU_Address@CLTS_ObjPosnChkEnadInAsyEvlrCritEve_Ca@ */ Record_BOOLEAN 0 autosar_swc_aeb_CM_logical 0 1 /end CHARACTERISTIC
/begin CHARACTERISTIC CLTS_PedEnaInAsyEvlrCritEve_Ca "Enable pedestrians in front for evaluation." VALUE 0xfe50418f /* @ECU_Address@CLTS_PedEnaInAsyEvlrCritEve_Ca@ */ Record_BOOLEAN 0 autosar_swc_aeb_CM_logical 0 1 /end CHARACTERISTIC
/begin CHARACTERISTIC CLTS_PedLenDftInAsyEvlrCritEve_Ca "Default length of pedestrians." VALUE 0xfe503d90 /* @ECU_Address@CLTS_PedLenDftInAsyEvlrCritEve_Ca@ */ Record_FLOAT32_IEEE 0 autosar_swc_aeb_CM_single_m 0.000000 1.000000 /end CHARACTERISTIC
/begin CHARACTERISTIC CLTS_PosnLatMaxForEvlnOfDrvgSideInAsyEvlrCritEve_Ca "Maximum lateral position for evaluation of driving side." VALUE 0xfe503d9c /* @ECU_Address@CLTS_PosnLatMaxForEvlnOfDrvgSideInAsyEvlrCritEve_Ca@ */ Record_FLOAT32_IEEE 0 autosar_swc_aeb_CM_single_m 0.000000 50.000000 /end CHARACTERISTIC
/begin CHARACTERISTIC CLTS_SeldTarInBypModInAsyEvlrCritEve_Ca "Object id that should be evaluated in bypass mode. Zero if no object should be bypassed." VALUE 0xfe5041b0 /* @ECU_Address@CLTS_SeldTarInBypModInAsyEvlrCritEve_Ca@ */ Record_SBYTE 0 autosar_swc_aeb_CM_int8 0.000000 32.000000 /end CHARACTERISTIC
/begin CHARACTERISTIC CLTS_SpdLimHiForAnimInAsyEvlrCritEve_Ca "Maximum allowed host vehicle speed for evaluation of animals." VALUE 0xfe503da8 /* @ECU_Address@CLTS_SpdLimHiForAnimInAsyEvlrCritEve_Ca@ */ Record_FLOAT32_IEEE 0 autosar_swc_aeb_CM_single_m_per_s 0.000000 100.000000 /end CHARACTERISTIC
/begin CHARACTERISTIC CLTS_SpdLimHiForPedInAsyEvlrCritEve_Ca "Maximum allowed host vehicle speed for evaluation of pedestrians." VALUE 0xfe503dac /* @ECU_Address@CLTS_SpdLimHiForPedInAsyEvlrCritEve_Ca@ */ Record_FLOAT32_IEEE 0 autosar_swc_aeb_CM_single_m_per_s 0.000000 100.000000 /end CHARACTERISTIC
/begin CHARACTERISTIC CLTS_SpdLimHiInAsyEvlrCritEve_Ca "Maximum allowed host vehicle speed for threat assessment." VALUE 0xfe503db0 /* @ECU_Address@CLTS_SpdLimHiInAsyEvlrCritEve_Ca@ */ Record_FLOAT32_IEEE 0 autosar_swc_aeb_CM_single_m_per_s 0.000000 100.000000 /end CHARACTERISTIC
/begin CHARACTERISTIC CLTS_SpdMinForEvlnOfDrvgSideInAsyEvlrCritEve_Ca "Minimum speed for evaluation of driving side." VALUE 0xfe503dbc /* @ECU_Address@CLTS_SpdMinForEvlnOfDrvgSideInAsyEvlrCritEve_Ca@ */ Record_FLOAT32_IEEE 0 autosar_swc_aeb_CM_single_m_per_s 0.000000 50.000000 /end CHARACTERISTIC
/begin CHARACTERISTIC CLTS_TruckEnaInAsyEvlrCritEve_Ca "Enable trucks in front for evaluation." VALUE 0xfe504190 /* @ECU_Address@CLTS_TruckEnaInAsyEvlrCritEve_Ca@ */ Record_BOOLEAN 0 autosar_swc_aeb_CM_logical 0 1 /end CHARACTERISTIC
/begin CHARACTERISTIC CLTS_TruckLenDftInAsyEvlrCritEve_Ca "Default length of trucks." VALUE 0xfe503de4 /* @ECU_Address@CLTS_TruckLenDftInAsyEvlrCritEve_Ca@ */ Record_FLOAT32_IEEE 0 autosar_swc_aeb_CM_single_m 0.000000 40.000000 /end CHARACTERISTIC
/begin CHARACTERISTIC CLTS_UkwnClassEnaInAsyEvlrCritEve_Ca "Enable unknown front objects for evaluation." VALUE 0xfe504191 /* @ECU_Address@CLTS_UkwnClassEnaInAsyEvlrCritEve_Ca@ */ Record_BOOLEAN 0 autosar_swc_aeb_CM_logical 0 1 /end CHARACTERISTIC
/begin CHARACTERISTIC CLTS_VehLenDftInAsyEvlrCritEve_Ca "Default length for vehicles of unknown class." VALUE 0xfe503dfc /* @ECU_Address@CLTS_VehLenDftInAsyEvlrCritEve_Ca@ */ Record_FLOAT32_IEEE 0 autosar_swc_aeb_CM_single_m 0.000000 5.000000 /end CHARACTERISTIC
/begin CHARACTERISTIC CLTS_VehOfUkwnClassEnaInAsyEvlrCritEve_Ca "Enable unknown vehicles in front for evaluation." VALUE 0xfe504194 /* @ECU_Address@CLTS_VehOfUkwnClassEnaInAsyEvlrCritEve_Ca@ */ Record_BOOLEAN 0 autosar_swc_aeb_CM_logical 0 1 /end CHARACTERISTIC
/begin CHARACTERISTIC CLTS_VehSelfCrvtMaxInAsyEvlrCritEve_Ca "Maximum curvature allowed for host vehicle" VALUE 0xfe503e08 /* @ECU_Address@CLTS_VehSelfCrvtMaxInAsyEvlrCritEve_Ca@ */ Record_FLOAT32_IEEE 0 autosar_swc_aeb_CM_single_1_per_m 0.001000 0.200000 /end CHARACTERISTIC
/begin CHARACTERISTIC CLTS_VehStDlyForDrvrBrkgInAsyEvlrCritEve_Ca "Vehicle system delay in LTAP when driver is braking firmly" VALUE 0xfe503e0c /* @ECU_Address@CLTS_VehStDlyForDrvrBrkgInAsyEvlrCritEve_Ca@ */ Record_FLOAT32_IEEE 0 autosar_swc_aeb_CM_single_s 0.000000 1.000000 /end CHARACTERISTIC
/begin CHARACTERISTIC P_AEB_CPTAAddComp "" CURVE 0xfe820184 /* @ECU_Address@P_AEB_CPTAAddComp@ */ Record_FLOAT32_IEEE 0 autosar_swc_aeb_CM_single -3.4E+38 3.4E+38
 /begin AXIS_DESCR FIX_AXIS NO_INPUT_QUANTITY autosar_swc_aeb_CM_single 3 2.777778 8.333333 FIX_AXIS_PAR_DIST 2.7778 2.7778 3 /end AXIS_DESCR
/end CHARACTERISTIC
/begin CHARACTERISTIC P_AEB_CalTTRThrethold "" VALUE 0xfe820000 /* @ECU_Address@P_AEB_CalTTRThrethold@ */ Record_FLOAT64_IEEE 0 autosar_swc_aeb_CM_double -1.7E+308 1.7E+308 /end CHARACTERISTIC
/begin CHARACTERISTIC P_AEB_CircleCalTTRTivector "Acceleration values in lookup table for brake delay calculation." VAL_BLK 0xfe8201e0 /* @ECU_Address@P_AEB_CircleCalTTRTivector@ */ Record_FLOAT32_IEEE 0 autosar_swc_aeb_CM_single_m_per_s -20.000000 20.000000 MATRIX_DIM 37 1 /end CHARACTERISTIC
/begin CHARACTERISTIC P_AEB_CrvtRqrdComp "" VALUE 0xfe8200b8 /* @ECU_Address@P_AEB_CrvtRqrdComp@ */ Record_FLOAT32_IEEE 0 autosar_swc_aeb_CM_single -5.000000 5.000000 /end CHARACTERISTIC
/begin CHARACTERISTIC P_AEB_SeperateSwitch "" VALUE 0xfe8200ec /* @ECU_Address@P_AEB_SeperateSwitch@ */ Record_BOOLEAN 0 autosar_swc_aeb_CM_boolean 0 1 /end CHARACTERISTIC
/begin MEASUREMENT autosar_swc_aeb_rtARID_DEF.ALatRqrd "" FLOAT32_IEEE autosar_swc_aeb_CM_single 0 0 -3.4E+38 3.4E+38 ECU_ADDRESS 0xfe4ab780 /* @ECU_Address@autosar_swc_aeb_rtARID_DEF.ALatRqrd@ */ /end MEASUREMENT
/begin MEASUREMENT autosar_swc_aeb_rtARID_DEF.ALatRqrd_a "" FLOAT32_IEEE autosar_swc_aeb_CM_single 0 0 -3.4E+38 3.4E+38 ECU_ADDRESS 0xfe4ab784 /* @ECU_Address@autosar_swc_aeb_rtARID_DEF.ALatRqrd_a@ */ /end MEASUREMENT
/begin MEASUREMENT autosar_swc_aeb_rtARID_DEF.ALatRqrd_b "" FLOAT32_IEEE autosar_swc_aeb_CM_single 0 0 -3.4E+38 3.4E+38 ECU_ADDRESS 0xfe4ab788 /* @ECU_Address@autosar_swc_aeb_rtARID_DEF.ALatRqrd_b@ */ /end MEASUREMENT
/begin MEASUREMENT autosar_swc_aeb_rtARID_DEF.ALgtRqrd "" FLOAT32_IEEE autosar_swc_aeb_CM_single 0 0 -3.4E+38 3.4E+38 ECU_ADDRESS 0xfe4ab77c /* @ECU_Address@autosar_swc_aeb_rtARID_DEF.ALgtRqrd@ */ /end MEASUREMENT
/begin MEASUREMENT autosar_swc_aeb_rtARID_DEF.If2_ActiveSubsystem "" SBYTE autosar_swc_aeb_CM_int8 0 0 -128 127 ECU_ADDRESS 0xfe4aba26 /* @ECU_Address@autosar_swc_aeb_rtARID_DEF.If2_ActiveSubsystem@ */ /end MEASUREMENT
/begin MEASUREMENT autosar_swc_aeb_rtARID_DEF.IfEnabled1_ActiveSubsystem "" SBYTE autosar_swc_aeb_CM_int8 0 0 -128 127 ECU_ADDRESS 0xfe4aba1c /* @ECU_Address@autosar_swc_aeb_rtARID_DEF.IfEnabled1_ActiveSubsystem@ */ /end MEASUREMENT
/begin MEASUREMENT autosar_swc_aeb_rtARID_DEF.IfEnabled1_ActiveSubsystem_g "" SBYTE autosar_swc_aeb_CM_int8 0 0 -128 127 ECU_ADDRESS 0xfe4aba1e /* @ECU_Address@autosar_swc_aeb_rtARID_DEF.IfEnabled1_ActiveSubsystem_g@ */ /end MEASUREMENT
/begin MEASUREMENT autosar_swc_aeb_rtARID_DEF.IfEnabled_ActiveSubsystem "" SBYTE autosar_swc_aeb_CM_int8 0 0 -128 127 ECU_ADDRESS 0xfe4aba1b /* @ECU_Address@autosar_swc_aeb_rtARID_DEF.IfEnabled_ActiveSubsystem@ */ /end MEASUREMENT
/begin MEASUREMENT autosar_swc_aeb_rtARID_DEF.IfEnabled_ActiveSubsystem_f "" SBYTE autosar_swc_aeb_CM_int8 0 0 -128 127 ECU_ADDRESS 0xfe4aba1d /* @ECU_Address@autosar_swc_aeb_rtARID_DEF.IfEnabled_ActiveSubsystem_f@ */ /end MEASUREMENT
/begin MEASUREMENT autosar_swc_aeb_rtARID_DEF.LastSegment "" UBYTE autosar_swc_aeb_CM_uint8 0 0 0 255 ECU_ADDRESS 0xfe4aba4f /* @ECU_Address@autosar_swc_aeb_rtARID_DEF.LastSegment@ */ /end MEASUREMENT
/begin MEASUREMENT autosar_swc_aeb_rtARID_DEF.LastSegment_a "" UBYTE autosar_swc_aeb_CM_uint8 0 0 0 255 ECU_ADDRESS 0xfe4aba54 /* @ECU_Address@autosar_swc_aeb_rtARID_DEF.LastSegment_a@ */ /end MEASUREMENT
/begin MEASUREMENT autosar_swc_aeb_rtARID_DEF.LastSegment_i "" UBYTE autosar_swc_aeb_CM_uint8 0 0 0 255 ECU_ADDRESS 0xfe4aba55 /* @ECU_Address@autosar_swc_aeb_rtARID_DEF.LastSegment_i@ */ /end MEASUREMENT
/begin MEASUREMENT autosar_swc_aeb_rtARID_DEF.LastSegment_p "" UBYTE autosar_swc_aeb_CM_uint8 0 0 0 255 ECU_ADDRESS 0xfe4aba57 /* @ECU_Address@autosar_swc_aeb_rtARID_DEF.LastSegment_p@ */ /end MEASUREMENT
/begin MEASUREMENT autosar_swc_aeb_rtARID_DEF.PredALatObj "" FLOAT32_IEEE autosar_swc_aeb_CM_single 0 0 -3.4E+38 3.4E+38 ECU_ADDRESS 0xfe4ab778 /* @ECU_Address@autosar_swc_aeb_rtARID_DEF.PredALatObj@ */ /end MEASUREMENT
/begin MEASUREMENT autosar_swc_aeb_rtARID_DEF.PredALatObj_g "" FLOAT32_IEEE autosar_swc_aeb_CM_single 0 0 -3.4E+38 3.4E+38 ECU_ADDRESS 0xfe4ab7a8 /* @ECU_Address@autosar_swc_aeb_rtARID_DEF.PredALatObj_g@ */ /end MEASUREMENT
/begin MEASUREMENT autosar_swc_aeb_rtARID_DEF.PredALgtObj "" FLOAT32_IEEE autosar_swc_aeb_CM_single 0 0 -3.4E+38 3.4E+38 ECU_ADDRESS 0xfe4ab76c /* @ECU_Address@autosar_swc_aeb_rtARID_DEF.PredALgtObj@ */ /end MEASUREMENT
/begin MEASUREMENT autosar_swc_aeb_rtARID_DEF.PredALgtObj_f "" FLOAT32_IEEE autosar_swc_aeb_CM_single 0 0 -3.4E+38 3.4E+38 ECU_ADDRESS 0xfe4ab79c /* @ECU_Address@autosar_swc_aeb_rtARID_DEF.PredALgtObj_f@ */ /end MEASUREMENT
/begin MEASUREMENT autosar_swc_aeb_rtARID_DEF.PredPosnLat "" FLOAT32_IEEE autosar_swc_aeb_CM_single 0 0 -3.4E+38 3.4E+38 ECU_ADDRESS 0xfe4ab770 /* @ECU_Address@autosar_swc_aeb_rtARID_DEF.PredPosnLat@ */ /end MEASUREMENT
/begin MEASUREMENT autosar_swc_aeb_rtARID_DEF.PredPosnLat_i "" FLOAT32_IEEE autosar_swc_aeb_CM_single 0 0 -3.4E+38 3.4E+38 ECU_ADDRESS 0xfe4ab7a0 /* @ECU_Address@autosar_swc_aeb_rtARID_DEF.PredPosnLat_i@ */ /end MEASUREMENT
/begin MEASUREMENT autosar_swc_aeb_rtARID_DEF.PredPosnLgt "" FLOAT32_IEEE autosar_swc_aeb_CM_single 0 0 -3.4E+38 3.4E+38 ECU_ADDRESS 0xfe4ab764 /* @ECU_Address@autosar_swc_aeb_rtARID_DEF.PredPosnLgt@ */ /end MEASUREMENT
/begin MEASUREMENT autosar_swc_aeb_rtARID_DEF.PredPosnLgt_m "" FLOAT32_IEEE autosar_swc_aeb_CM_single 0 0 -3.4E+38 3.4E+38 ECU_ADDRESS 0xfe4ab794 /* @ECU_Address@autosar_swc_aeb_rtARID_DEF.PredPosnLgt_m@ */ /end MEASUREMENT
/begin MEASUREMENT autosar_swc_aeb_rtARID_DEF.PredVLatObj "" FLOAT32_IEEE autosar_swc_aeb_CM_single 0 0 -3.4E+38 3.4E+38 ECU_ADDRESS 0xfe4ab774 /* @ECU_Address@autosar_swc_aeb_rtARID_DEF.PredVLatObj@ */ /end MEASUREMENT
/begin MEASUREMENT autosar_swc_aeb_rtARID_DEF.PredVLatObj_f "" FLOAT32_IEEE autosar_swc_aeb_CM_single 0 0 -3.4E+38 3.4E+38 ECU_ADDRESS 0xfe4ab7a4 /* @ECU_Address@autosar_swc_aeb_rtARID_DEF.PredVLatObj_f@ */ /end MEASUREMENT
/begin MEASUREMENT autosar_swc_aeb_rtARID_DEF.PredVLgtObj "" FLOAT32_IEEE autosar_swc_aeb_CM_single 0 0 -3.4E+38 3.4E+38 ECU_ADDRESS 0xfe4ab768 /* @ECU_Address@autosar_swc_aeb_rtARID_DEF.PredVLgtObj@ */ /end MEASUREMENT
/begin MEASUREMENT autosar_swc_aeb_rtARID_DEF.PredVLgtObj_e "" FLOAT32_IEEE autosar_swc_aeb_CM_single 0 0 -3.4E+38 3.4E+38 ECU_ADDRESS 0xfe4ab798 /* @ECU_Address@autosar_swc_aeb_rtARID_DEF.PredVLgtObj_e@ */ /end MEASUREMENT
/begin MEASUREMENT autosar_swc_aeb_rtARID_DEF.ThreatFoundForIntv "" UBYTE autosar_swc_aeb_CM_logical 0 0 0 1 ECU_ADDRESS 0xfe4abac7 /* @ECU_Address@autosar_swc_aeb_rtARID_DEF.ThreatFoundForIntv@ */ /end MEASUREMENT
/begin MEASUREMENT autosar_swc_aeb_rtARID_DEF.UnitDelay1_DSTATE_n "" UBYTE autosar_swc_aeb_CM_logical 0 0 0 1 LAYOUT COLUMN_DIR MATRIX_DIM 20 ECU_ADDRESS 0xfe4abaac /* @ECU_Address@autosar_swc_aeb_rtARID_DEF.UnitDelay1_DSTATE_n@ */ /end MEASUREMENT
/begin MEASUREMENT autosar_swc_aeb_rtARID_DEF.UnitDelay2_DSTATE_oo "" UBYTE autosar_swc_aeb_CM_uint8 0 0 0 255 LAYOUT COLUMN_DIR MATRIX_DIM 20 ECU_ADDRESS 0xfe4aba3b /* @ECU_Address@autosar_swc_aeb_rtARID_DEF.UnitDelay2_DSTATE_oo@ */ /end MEASUREMENT
/begin MEASUREMENT autosar_swc_aeb_rtARID_DEF.UnitDelay3_DSTATE_a "" UBYTE autosar_swc_aeb_CM_uint8 0 0 0 255 LAYOUT COLUMN_DIR MATRIX_DIM 20 ECU_ADDRESS 0xfe4aba27 /* @ECU_Address@autosar_swc_aeb_rtARID_DEF.UnitDelay3_DSTATE_a@ */ /end MEASUREMENT
/begin MEASUREMENT autosar_swc_aeb_rtARID_DEF.UnitDelay_DSTATE_ag "" ULONG autosar_swc_aeb_CM_uint32 0 0 0 4294967295 ECU_ADDRESS 0xfe4ab9e4 /* @ECU_Address@autosar_swc_aeb_rtARID_DEF.UnitDelay_DSTATE_ag@ */ /end MEASUREMENT
/begin MEASUREMENT autosar_swc_aeb_rtARID_DEF.UnitDelay_DSTATE_i "" FLOAT32_IEEE autosar_swc_aeb_CM_single 0 0 -3.4E+38 3.4E+38 ECU_ADDRESS 0xfe4ab804 /* @ECU_Address@autosar_swc_aeb_rtARID_DEF.UnitDelay_DSTATE_i@ */ /end MEASUREMENT
/begin MEASUREMENT autosar_swc_aeb_rtARID_DEF.UnitDelay_DSTATE_mf "" SBYTE autosar_swc_aeb_CM_int8 0 0 -128 127 ECU_ADDRESS 0xfe4aba1a /* @ECU_Address@autosar_swc_aeb_rtARID_DEF.UnitDelay_DSTATE_mf@ */ /end MEASUREMENT
/begin MEASUREMENT autosar_swc_aeb_rtARID_DEF.Width "" FLOAT64_IEEE autosar_swc_aeb_CM_double 0 0 -1.7E+308 1.7E+308 ECU_ADDRESS 0xfe4aa3d8 /* @ECU_Address@autosar_swc_aeb_rtARID_DEF.Width@ */ /end MEASUREMENT
/begin MEASUREMENT autosar_swc_aeb_rtARID_DEF.Width_p "" FLOAT64_IEEE autosar_swc_aeb_CM_double 0 0 -1.7E+308 1.7E+308 ECU_ADDRESS 0xfe4aa3e0 /* @ECU_Address@autosar_swc_aeb_rtARID_DEF.Width_p@ */ /end MEASUREMENT
/begin AXIS_PTS CLTS_AForBrkDlyInAsyEvlrCritEve_Ca "" 0xfe5041c8 /* @ECU_Address@CLTS_AForBrkDlyInAsyEvlrCritEve_Ca@ */ NO_INPUT_QUANTITY Axis_FLOAT32_IEEE 0 autosar_swc_aeb_CM_single_m_per_s 10 -20.000000 20.000000 /end AXIS_PTS
/begin COMPU_METHOD autosar_swc_aeb_CM_boolean "Q = V" IDENTICAL "%1.0" "" /end COMPU_METHOD
/begin COMPU_METHOD autosar_swc_aeb_CM_double "Q = V" IDENTICAL "%15.10" "" /end COMPU_METHOD
/begin COMPU_METHOD autosar_swc_aeb_CM_int8 "Q = V" IDENTICAL "%3.0" "" /end COMPU_METHOD
/begin COMPU_METHOD autosar_swc_aeb_CM_logical "Q = V" IDENTICAL "%1.0" "" /end COMPU_METHOD
/begin COMPU_METHOD autosar_swc_aeb_CM_single "Q = V" IDENTICAL "%8.6" "" /end COMPU_METHOD
/begin COMPU_METHOD autosar_swc_aeb_CM_single_1_per_m "Q = V" IDENTICAL "%8.6" "1/m" /end COMPU_METHOD
/begin COMPU_METHOD autosar_swc_aeb_CM_single_m "Q = V" IDENTICAL "%8.6" "m" /end COMPU_METHOD
/begin COMPU_METHOD autosar_swc_aeb_CM_single_m_per_s "Q = V" IDENTICAL "%8.6" "m/s" /end COMPU_METHOD
/begin COMPU_METHOD autosar_swc_aeb_CM_single_rad "Q = V" IDENTICAL "%8.6" "rad" /end COMPU_METHOD
/begin COMPU_METHOD autosar_swc_aeb_CM_single_rad_per_s "Q = V" IDENTICAL "%8.6" "rad/s" /end COMPU_METHOD
/begin COMPU_METHOD autosar_swc_aeb_CM_single_s "Q = V" IDENTICAL "%8.6" "s" /end COMPU_METHOD
/begin COMPU_METHOD autosar_swc_aeb_CM_uint32 "Q = V" IDENTICAL "%10.0" "" /end COMPU_METHOD
/begin COMPU_METHOD autosar_swc_aeb_CM_uint8 "Q = V" IDENTICAL "%3.0" "" /end COMPU_METHOD
/begin RECORD_LAYOUT Record_BOOLEAN FNC_VALUES 1 UBYTE COLUMN_DIR DIRECT /end RECORD_LAYOUT
/begin RECORD_LAYOUT Record_FLOAT32_IEEE FNC_VALUES 1 FLOAT32_IEEE COLUMN_DIR DIRECT /end RECORD_LAYOUT
/begin RECORD_LAYOUT Record_FLOAT64_IEEE FNC_VALUES 1 FLOAT64_IEEE COLUMN_DIR DIRECT /end RECORD_LAYOUT
/begin RECORD_LAYOUT Record_SBYTE FNC_VALUES 1 SBYTE COLUMN_DIR DIRECT /end RECORD_LAYOUT
/begin RECORD_LAYOUT Axis_FLOAT32_IEEE AXIS_PTS_X 1 FLOAT32_IEEE INDEX_INCR DIRECT /end RECORD_LAYOUT
/begin GROUP autosar_swc_aeb_autosar_swc_aeb_Step_sys_Subsystem_Reference_AEB_Function_Run_AsyEvlrCritEve_Step_Func_Run_AsyEvlrCritEve_Step_Func_TAWrapper_LongitudinalThreatAssessor_SingleTargetThreatAssessor_PrimaryTargetForWarn_RequiredLongitudinalAccelerationComputerForWarn_PredictHostPositionAtTime "autosar_swc_aeb/autosar_swc_aeb_Step_sys/Subsystem Reference/AEB Function/Run_AsyEvlrCritEve_Step_Func/Run_AsyEvlrCritEve_Step_Func/TAWrapper/LongitudinalThreatAssessor/SingleTargetThreatAssessor/PrimaryTargetForWarn/RequiredLongitudinalAccelerationComputerForWarn/PredictHostPositionAtTime"
 /begin SUB_GROUP autosar_swc_aeb_autosar_swc_aeb_Step_sys_Subsystem_Reference_AEB_Function_Run_AsyEvlrCritEve_Step_Func_Run_AsyEvlrCritEve_Step_Func_TAWrapper_LongitudinalThreatAssessor_SingleTargetThreatAssessor_PrimaryTargetForWarn_RequiredLongitudinalAccelerationComputerForWarn_PredictHostPositionAtTime_CalculateHeading autosar_swc_aeb_autosar_swc_aeb_Step_sys_Subsystem_Reference_AEB_Function_Run_AsyEvlrCritEve_Step_Func_Run_AsyEvlrCritEve_Step_Func_TAWrapper_LongitudinalThreatAssessor_SingleTargetThreatAssessor_PrimaryTargetForWarn_RequiredLongitudinalAccelerationComputerForWarn_PredictHostPositionAtTime_SelectSegment /end SUB_GROUP
/end GROUP
/begin GROUP autosar_swc_aeb_autosar_swc_aeb_Step_sys_Subsystem_Reference_AEB_Function_Run_AsyEvlrCritEve_Step_Func_Run_AsyEvlrCritEve_Step_Func_TAWrapper_LongitudinalThreatAssessor_SingleTargetThreatAssessor_PrimaryTargetForWarn_RequiredLongitudinalAccelerationComputerForWarn_PredictHostPositionAtTime_CalculateHeading "autosar_swc_aeb/autosar_swc_aeb_Step_sys/Subsystem Reference/AEB Function/Run_AsyEvlrCritEve_Step_Func/Run_AsyEvlrCritEve_Step_Func/TAWrapper/LongitudinalThreatAssessor/SingleTargetThreatAssessor/PrimaryTargetForWarn/RequiredLongitudinalAccelerationComputerForWarn/PredictHostPositionAtTime/CalculateHeading"
 /begin SUB_GROUP autosar_swc_aeb_autosar_swc_aeb_Step_sys_Subsystem_Reference_AEB_Function_Run_AsyEvlrCritEve_Step_Func_Run_AsyEvlrCritEve_Step_Func_TAWrapper_LongitudinalThreatAssessor_SingleTargetThreatAssessor_PrimaryTargetForWarn_RequiredLongitudinalAccelerationComputerForWarn_PredictHostPositionAtTime_CalculateHeading_CheckSpeed autosar_swc_aeb_autosar_swc_aeb_Step_sys_Subsystem_Reference_AEB_Function_Run_AsyEvlrCritEve_Step_Func_Run_AsyEvlrCritEve_Step_Func_TAWrapper_LongitudinalThreatAssessor_SingleTargetThreatAssessor_PrimaryTargetForWarn_RequiredLongitudinalAccelerationComputerForWarn_PredictHostPositionAtTime_CalculateHeading_ExtractVelocitiesAtStartOfSegments /end SUB_GROUP
/end GROUP
/begin GROUP autosar_swc_aeb_autosar_swc_aeb_Step_sys_Subsystem_Reference_AEB_Function_Run_AsyEvlrCritEve_Step_Func_Run_AsyEvlrCritEve_Step_Func_TAWrapper_LongitudinalThreatAssessor_SingleTargetThreatAssessor_PrimaryTargetForWarn_RequiredLongitudinalAccelerationComputerForWarn_PredictHostPositionAtTime_CalculateHeading_ExtractVelocitiesAtStartOfSegments "autosar_swc_aeb/autosar_swc_aeb_Step_sys/Subsystem Reference/AEB Function/Run_AsyEvlrCritEve_Step_Func/Run_AsyEvlrCritEve_Step_Func/TAWrapper/LongitudinalThreatAssessor/SingleTargetThreatAssessor/PrimaryTargetForWarn/RequiredLongitudinalAccelerationComputerForWarn/PredictHostPositionAtTime/CalculateHeading/ExtractVelocitiesAtStartOfSegments"
 /begin SUB_GROUP autosar_swc_aeb_autosar_swc_aeb_Step_sys_Subsystem_Reference_AEB_Function_Run_AsyEvlrCritEve_Step_Func_Run_AsyEvlrCritEve_Step_Func_TAWrapper_LongitudinalThreatAssessor_SingleTargetThreatAssessor_PrimaryTargetForWarn_RequiredLongitudinalAccelerationComputerForWarn_PredictHostPositionAtTime_CalculateHeading_ExtractVelocitiesAtStartOfSegments_CheckSpeed /end SUB_GROUP
/end GROUP
/begin GROUP autosar_swc_aeb_autosar_swc_aeb_Step_sys_Subsystem_Reference_AEB_Function_Run_AsyEvlrCritEve_Step_Func_Run_AsyEvlrCritEve_Step_Func_TAWrapper_LongitudinalThreatAssessor_SingleTargetThreatAssessor_PrimaryTargetForWarn_RequiredLongitudinalAccelerationComputerForWarn_PredictHostPositionAtTime_SelectSegment "autosar_swc_aeb/autosar_swc_aeb_Step_sys/Subsystem Reference/AEB Function/Run_AsyEvlrCritEve_Step_Func/Run_AsyEvlrCritEve_Step_Func/TAWrapper/LongitudinalThreatAssessor/SingleTargetThreatAssessor/PrimaryTargetForWarn/RequiredLongitudinalAccelerationComputerForWarn/PredictHostPositionAtTime/SelectSegment" /begin REF_MEASUREMENT autosar_swc_aeb_rtARID_DEF.LastSegment_p /end REF_MEASUREMENT /end GROUP
/begin GROUP autosar_swc_aeb_autosar_swc_aeb_Step_sys_Subsystem_Reference_AEB_Function_Run_AsyEvlrCritEve_Step_Func_Run_AsyEvlrCritEve_Step_Func_TAWrapper_LongitudinalThreatAssessor_SingleTargetThreatAssessor_PrimaryTargetForWarn_RequiredLongitudinalAccelerationComputerForWarn_PredictObject "autosar_swc_aeb/autosar_swc_aeb_Step_sys/Subsystem Reference/AEB Function/Run_AsyEvlrCritEve_Step_Func/Run_AsyEvlrCritEve_Step_Func/TAWrapper/LongitudinalThreatAssessor/SingleTargetThreatAssessor/PrimaryTargetForWarn/RequiredLongitudinalAccelerationComputerForWarn/PredictObject"
 /begin SUB_GROUP autosar_swc_aeb_autosar_swc_aeb_Step_sys_Subsystem_Reference_AEB_Function_Run_AsyEvlrCritEve_Step_Func_Run_AsyEvlrCritEve_Step_Func_TAWrapper_LongitudinalThreatAssessor_SingleTargetThreatAssessor_PrimaryTargetForWarn_RequiredLongitudinalAccelerationComputerForWarn_PredictObject_CircularPrediction autosar_swc_aeb_autosar_swc_aeb_Step_sys_Subsystem_Reference_AEB_Function_Run_AsyEvlrCritEve_Step_Func_Run_AsyEvlrCritEve_Step_Func_TAWrapper_LongitudinalThreatAssessor_SingleTargetThreatAssessor_PrimaryTargetForWarn_RequiredLongitudinalAccelerationComputerForWarn_PredictObject_LinearPrediction /end SUB_GROUP
 /begin REF_MEASUREMENT autosar_swc_aeb_rtARID_DEF.If2_ActiveSubsystem /end REF_MEASUREMENT
/end GROUP
/begin GROUP autosar_swc_aeb_autosar_swc_aeb_Step_sys_Subsystem_Reference_AEB_Function_Run_AsyEvlrCritEve_Step_Func_Run_AsyEvlrCritEve_Step_Func_TAWrapper_LongitudinalThreatAssessor_SingleTargetThreatAssessor_PrimaryTargetForWarn_RequiredLongitudinalAccelerationComputerForWarn_PredictObject_CircularPrediction "autosar_swc_aeb/autosar_swc_aeb_Step_sys/Subsystem Reference/AEB Function/Run_AsyEvlrCritEve_Step_Func/Run_AsyEvlrCritEve_Step_Func/TAWrapper/LongitudinalThreatAssessor/SingleTargetThreatAssessor/PrimaryTargetForWarn/RequiredLongitudinalAccelerationComputerForWarn/PredictObject/CircularPrediction"
 /begin SUB_GROUP autosar_swc_aeb_autosar_swc_aeb_Step_sys_Subsystem_Reference_AEB_Function_Run_AsyEvlrCritEve_Step_Func_Run_AsyEvlrCritEve_Step_Func_TAWrapper_LongitudinalThreatAssessor_SingleTargetThreatAssessor_PrimaryTargetForWarn_RequiredLongitudinalAccelerationComputerForWarn_PredictObject_CircularPrediction_PredictedCartesianMovement autosar_swc_aeb_autosar_swc_aeb_Step_sys_Subsystem_Reference_AEB_Function_Run_AsyEvlrCritEve_Step_Func_Run_AsyEvlrCritEve_Step_Func_TAWrapper_LongitudinalThreatAssessor_SingleTargetThreatAssessor_PrimaryTargetForWarn_RequiredLongitudinalAccelerationComputerForWarn_PredictObject_CircularPrediction_PredictedPositionAtTimeHeadingAngleAndCurvatureBased /end SUB_GROUP
/end GROUP
/begin GROUP autosar_swc_aeb_autosar_swc_aeb_Step_sys_Subsystem_Reference_AEB_Function_Run_AsyEvlrCritEve_Step_Func_Run_AsyEvlrCritEve_Step_Func_TAWrapper_LongitudinalThreatAssessor_SingleTargetThreatAssessor_PrimaryTargetForWarn_RequiredLongitudinalAccelerationComputerForWarn_PredictObject_CircularPrediction_PredictedCartesianMovement "autosar_swc_aeb/autosar_swc_aeb_Step_sys/Subsystem Reference/AEB Function/Run_AsyEvlrCritEve_Step_Func/Run_AsyEvlrCritEve_Step_Func/TAWrapper/LongitudinalThreatAssessor/SingleTargetThreatAssessor/PrimaryTargetForWarn/RequiredLongitudinalAccelerationComputerForWarn/PredictObject/CircularPrediction/PredictedCartesianMovement"
 /begin SUB_GROUP autosar_swc_aeb_autosar_swc_aeb_Step_sys_Subsystem_Reference_AEB_Function_Run_AsyEvlrCritEve_Step_Func_Run_AsyEvlrCritEve_Step_Func_TAWrapper_LongitudinalThreatAssessor_SingleTargetThreatAssessor_PrimaryTargetForWarn_RequiredLongitudinalAccelerationComputerForWarn_PredictObject_CircularPrediction_PredictedCartesianMovement_ComputeCartesianMovement /end SUB_GROUP
/end GROUP
/begin GROUP autosar_swc_aeb_autosar_swc_aeb_Step_sys_Subsystem_Reference_AEB_Function_Run_AsyEvlrCritEve_Step_Func_Run_AsyEvlrCritEve_Step_Func_TAWrapper_LongitudinalThreatAssessor_SingleTargetThreatAssessor_PrimaryTargetForWarn_RequiredLongitudinalAccelerationComputerForWarn_PredictObject_CircularPrediction_PredictedCartesianMovement_ComputeCartesianMovement "autosar_swc_aeb/autosar_swc_aeb_Step_sys/Subsystem Reference/AEB Function/Run_AsyEvlrCritEve_Step_Func/Run_AsyEvlrCritEve_Step_Func/TAWrapper/LongitudinalThreatAssessor/SingleTargetThreatAssessor/PrimaryTargetForWarn/RequiredLongitudinalAccelerationComputerForWarn/PredictObject/CircularPrediction/PredictedCartesianMovement/ComputeCartesianMovement"
 /begin REF_MEASUREMENT autosar_swc_aeb_rtARID_DEF.PredALatObj_g autosar_swc_aeb_rtARID_DEF.PredALgtObj_f autosar_swc_aeb_rtARID_DEF.PredVLatObj_f autosar_swc_aeb_rtARID_DEF.PredVLgtObj_e /end REF_MEASUREMENT
/end GROUP
/begin GROUP autosar_swc_aeb_autosar_swc_aeb_Step_sys_Subsystem_Reference_AEB_Function_Run_AsyEvlrCritEve_Step_Func_Run_AsyEvlrCritEve_Step_Func_TAWrapper_LongitudinalThreatAssessor_SingleTargetThreatAssessor_PrimaryTargetForWarn_RequiredLongitudinalAccelerationComputerForWarn_PredictObject_CircularPrediction_PredictedPositionAtTimeHeadingAngleAndCurvatureBased "autosar_swc_aeb/autosar_swc_aeb_Step_sys/Subsystem Reference/AEB Function/Run_AsyEvlrCritEve_Step_Func/Run_AsyEvlrCritEve_Step_Func/TAWrapper/LongitudinalThreatAssessor/SingleTargetThreatAssessor/PrimaryTargetForWarn/RequiredLongitudinalAccelerationComputerForWarn/PredictObject/CircularPrediction/PredictedPositionAtTimeHeadingAngleAndCurvatureBased"
 /begin REF_MEASUREMENT autosar_swc_aeb_rtARID_DEF.PredPosnLat_i autosar_swc_aeb_rtARID_DEF.PredPosnLgt_m /end REF_MEASUREMENT
/end GROUP
/begin GROUP autosar_swc_aeb_autosar_swc_aeb_Step_sys_Subsystem_Reference_AEB_Function_Run_AsyEvlrCritEve_Step_Func_Run_AsyEvlrCritEve_Step_Func_TAWrapper_LongitudinalThreatAssessor_SingleTargetThreatAssessor_PrimaryTargetForWarn_RequiredLongitudinalAccelerationComputerForWarn_PredictObject_LinearPrediction "autosar_swc_aeb/autosar_swc_aeb_Step_sys/Subsystem Reference/AEB Function/Run_AsyEvlrCritEve_Step_Func/Run_AsyEvlrCritEve_Step_Func/TAWrapper/LongitudinalThreatAssessor/SingleTargetThreatAssessor/PrimaryTargetForWarn/RequiredLongitudinalAccelerationComputerForWarn/PredictObject/LinearPrediction"
 /begin SUB_GROUP autosar_swc_aeb_autosar_swc_aeb_Step_sys_Subsystem_Reference_AEB_Function_Run_AsyEvlrCritEve_Step_Func_Run_AsyEvlrCritEve_Step_Func_TAWrapper_LongitudinalThreatAssessor_SingleTargetThreatAssessor_PrimaryTargetForWarn_RequiredLongitudinalAccelerationComputerForWarn_PredictObject_LinearPrediction_LinearMovementPredictorWithStopObjLongitudinal autosar_swc_aeb_autosar_swc_aeb_Step_sys_Subsystem_Reference_AEB_Function_Run_AsyEvlrCritEve_Step_Func_Run_AsyEvlrCritEve_Step_Func_TAWrapper_LongitudinalThreatAssessor_SingleTargetThreatAssessor_PrimaryTargetForWarn_RequiredLongitudinalAccelerationComputerForWarn_PredictObject_LinearPrediction_LinearPredictorLateralMovement autosar_swc_aeb_autosar_swc_aeb_Step_sys_Subsystem_Reference_AEB_Function_Run_AsyEvlrCritEve_Step_Func_Run_AsyEvlrCritEve_Step_Func_TAWrapper_LongitudinalThreatAssessor_SingleTargetThreatAssessor_PrimaryTargetForWarn_RequiredLongitudinalAccelerationComputerForWarn_PredictObject_LinearPrediction_NoOperation autosar_swc_aeb_autosar_swc_aeb_Step_sys_Subsystem_Reference_AEB_Function_Run_AsyEvlrCritEve_Step_Func_Run_AsyEvlrCritEve_Step_Func_TAWrapper_LongitudinalThreatAssessor_SingleTargetThreatAssessor_PrimaryTargetForWarn_RequiredLongitudinalAccelerationComputerForWarn_PredictObject_LinearPrediction_NoOperation1 autosar_swc_aeb_autosar_swc_aeb_Step_sys_Subsystem_Reference_AEB_Function_Run_AsyEvlrCritEve_Step_Func_Run_AsyEvlrCritEve_Step_Func_TAWrapper_LongitudinalThreatAssessor_SingleTargetThreatAssessor_PrimaryTargetForWarn_RequiredLongitudinalAccelerationComputerForWarn_PredictObject_LinearPrediction_NoOperation2 /end SUB_GROUP
/end GROUP
/begin GROUP autosar_swc_aeb_autosar_swc_aeb_Step_sys_Subsystem_Reference_AEB_Function_Run_AsyEvlrCritEve_Step_Func_Run_AsyEvlrCritEve_Step_Func_TAWrapper_LongitudinalThreatAssessor_SingleTargetThreatAssessor_PrimaryTargetForWarn_RequiredLongitudinalAccelerationComputerForWarn_PredictObject_LinearPrediction_LinearMovementPredictorWithStopObjLongitudinal "autosar_swc_aeb/autosar_swc_aeb_Step_sys/Subsystem Reference/AEB Function/Run_AsyEvlrCritEve_Step_Func/Run_AsyEvlrCritEve_Step_Func/TAWrapper/LongitudinalThreatAssessor/SingleTargetThreatAssessor/PrimaryTargetForWarn/RequiredLongitudinalAccelerationComputerForWarn/PredictObject/LinearPrediction/LinearMovementPredictorWithStopObjLongitudinal"
 /begin SUB_GROUP autosar_swc_aeb_autosar_swc_aeb_Step_sys_Subsystem_Reference_AEB_Function_Run_AsyEvlrCritEve_Step_Func_Run_AsyEvlrCritEve_Step_Func_TAWrapper_LongitudinalThreatAssessor_SingleTargetThreatAssessor_PrimaryTargetForWarn_RequiredLongitudinalAccelerationComputerForWarn_PredictObject_LinearPrediction_LinearMovementPredictorWithStopObjLongitudinal_LinearMovementPredictor /end SUB_GROUP
 /begin REF_MEASUREMENT autosar_swc_aeb_rtARID_DEF.PredALgtObj_f /end REF_MEASUREMENT
/end GROUP
/begin GROUP autosar_swc_aeb_autosar_swc_aeb_Step_sys_Subsystem_Reference_AEB_Function_Run_AsyEvlrCritEve_Step_Func_Run_AsyEvlrCritEve_Step_Func_TAWrapper_LongitudinalThreatAssessor_SingleTargetThreatAssessor_PrimaryTargetForWarn_RequiredLongitudinalAccelerationComputerForWarn_PredictObject_LinearPrediction_LinearMovementPredictorWithStopObjLongitudinal_LinearMovementPredictor "autosar_swc_aeb/autosar_swc_aeb_Step_sys/Subsystem Reference/AEB Function/Run_AsyEvlrCritEve_Step_Func/Run_AsyEvlrCritEve_Step_Func/TAWrapper/LongitudinalThreatAssessor/SingleTargetThreatAssessor/PrimaryTargetForWarn/RequiredLongitudinalAccelerationComputerForWarn/PredictObject/LinearPrediction/LinearMovementPredictorWithStopObjLongitudinal/LinearMovementPredictor" /begin REF_MEASUREMENT autosar_swc_aeb_rtARID_DEF.PredPosnLgt_m /end REF_MEASUREMENT /end GROUP
/begin GROUP autosar_swc_aeb_autosar_swc_aeb_Step_sys_Subsystem_Reference_AEB_Function_Run_AsyEvlrCritEve_Step_Func_Run_AsyEvlrCritEve_Step_Func_TAWrapper_LongitudinalThreatAssessor_SingleTargetThreatAssessor_PrimaryTargetForWarn_RequiredLongitudinalAccelerationComputerForWarn_PredictObject_LinearPrediction_LinearPredictorLateralMovement "autosar_swc_aeb/autosar_swc_aeb_Step_sys/Subsystem Reference/AEB Function/Run_AsyEvlrCritEve_Step_Func/Run_AsyEvlrCritEve_Step_Func/TAWrapper/LongitudinalThreatAssessor/SingleTargetThreatAssessor/PrimaryTargetForWarn/RequiredLongitudinalAccelerationComputerForWarn/PredictObject/LinearPrediction/LinearPredictorLateralMovement" /begin REF_MEASUREMENT autosar_swc_aeb_rtARID_DEF.PredPosnLat_i /end REF_MEASUREMENT /end GROUP
/begin GROUP autosar_swc_aeb_autosar_swc_aeb_Step_sys_Subsystem_Reference_AEB_Function_Run_AsyEvlrCritEve_Step_Func_Run_AsyEvlrCritEve_Step_Func_TAWrapper_LongitudinalThreatAssessor_SingleTargetThreatAssessor_PrimaryTargetForWarn_RequiredLongitudinalAccelerationComputerForWarn_PredictObject_LinearPrediction_NoOperation "autosar_swc_aeb/autosar_swc_aeb_Step_sys/Subsystem Reference/AEB Function/Run_AsyEvlrCritEve_Step_Func/Run_AsyEvlrCritEve_Step_Func/TAWrapper/LongitudinalThreatAssessor/SingleTargetThreatAssessor/PrimaryTargetForWarn/RequiredLongitudinalAccelerationComputerForWarn/PredictObject/LinearPrediction/NoOperation" /begin REF_MEASUREMENT autosar_swc_aeb_rtARID_DEF.PredVLgtObj_e /end REF_MEASUREMENT /end GROUP
/begin GROUP autosar_swc_aeb_autosar_swc_aeb_Step_sys_Subsystem_Reference_AEB_Function_Run_AsyEvlrCritEve_Step_Func_Run_AsyEvlrCritEve_Step_Func_TAWrapper_LongitudinalThreatAssessor_SingleTargetThreatAssessor_PrimaryTargetForWarn_RequiredLongitudinalAccelerationComputerForWarn_PredictObject_LinearPrediction_NoOperation1 "autosar_swc_aeb/autosar_swc_aeb_Step_sys/Subsystem Reference/AEB Function/Run_AsyEvlrCritEve_Step_Func/Run_AsyEvlrCritEve_Step_Func/TAWrapper/LongitudinalThreatAssessor/SingleTargetThreatAssessor/PrimaryTargetForWarn/RequiredLongitudinalAccelerationComputerForWarn/PredictObject/LinearPrediction/NoOperation1" /begin REF_MEASUREMENT autosar_swc_aeb_rtARID_DEF.PredVLatObj_f /end REF_MEASUREMENT /end GROUP
/begin GROUP autosar_swc_aeb_autosar_swc_aeb_Step_sys_Subsystem_Reference_AEB_Function_Run_AsyEvlrCritEve_Step_Func_Run_AsyEvlrCritEve_Step_Func_TAWrapper_LongitudinalThreatAssessor_SingleTargetThreatAssessor_PrimaryTargetForWarn_RequiredLongitudinalAccelerationComputerForWarn_PredictObject_LinearPrediction_NoOperation2 "autosar_swc_aeb/autosar_swc_aeb_Step_sys/Subsystem Reference/AEB Function/Run_AsyEvlrCritEve_Step_Func/Run_AsyEvlrCritEve_Step_Func/TAWrapper/LongitudinalThreatAssessor/SingleTargetThreatAssessor/PrimaryTargetForWarn/RequiredLongitudinalAccelerationComputerForWarn/PredictObject/LinearPrediction/NoOperation2" /begin REF_MEASUREMENT autosar_swc_aeb_rtARID_DEF.PredALatObj_g /end REF_MEASUREMENT /end GROUP
/begin GROUP autosar_swc_aeb_autosar_swc_aeb_Step_sys_Subsystem_Reference_AEB_Function_Run_AsyEvlrCritEve_Step_Func_Run_AsyEvlrCritEve_Step_Func_TAWrapper_LongitudinalThreatAssessor_SingleTargetThreatAssessor_PrimaryTargetForWarn_RequiredLongitudinalAccelerationComputerForWarn_RequiredLongitudinalAccelerationCalculator "autosar_swc_aeb/autosar_swc_aeb_Step_sys/Subsystem Reference/AEB Function/Run_AsyEvlrCritEve_Step_Func/Run_AsyEvlrCritEve_Step_Func/TAWrapper/LongitudinalThreatAssessor/SingleTargetThreatAssessor/PrimaryTargetForWarn/RequiredLongitudinalAccelerationComputerForWarn/RequiredLongitudinalAccelerationCalculator"
 /begin SUB_GROUP autosar_swc_aeb_autosar_swc_aeb_Step_sys_Subsystem_Reference_AEB_Function_Run_AsyEvlrCritEve_Step_Func_Run_AsyEvlrCritEve_Step_Func_TAWrapper_LongitudinalThreatAssessor_SingleTargetThreatAssessor_PrimaryTargetForWarn_RequiredLongitudinalAccelerationComputerForWarn_RequiredLongitudinalAccelerationCalculator_CalculateLateralTTRandTTP autosar_swc_aeb_autosar_swc_aeb_Step_sys_Subsystem_Reference_AEB_Function_Run_AsyEvlrCritEve_Step_Func_Run_AsyEvlrCritEve_Step_Func_TAWrapper_LongitudinalThreatAssessor_SingleTargetThreatAssessor_PrimaryTargetForWarn_RequiredLongitudinalAccelerationComputerForWarn_RequiredLongitudinalAccelerationCalculator_CalculateRequiredAcceleration /end SUB_GROUP
/end GROUP
/begin GROUP autosar_swc_aeb_autosar_swc_aeb_Step_sys_Subsystem_Reference_AEB_Function_Run_AsyEvlrCritEve_Step_Func_Run_AsyEvlrCritEve_Step_Func_TAWrapper_LongitudinalThreatAssessor_SingleTargetThreatAssessor_PrimaryTargetForWarn_RequiredLongitudinalAccelerationComputerForWarn_RequiredLongitudinalAccelerationCalculator_CalculateLateralTTRandTTP "autosar_swc_aeb/autosar_swc_aeb_Step_sys/Subsystem Reference/AEB Function/Run_AsyEvlrCritEve_Step_Func/Run_AsyEvlrCritEve_Step_Func/TAWrapper/LongitudinalThreatAssessor/SingleTargetThreatAssessor/PrimaryTargetForWarn/RequiredLongitudinalAccelerationComputerForWarn/RequiredLongitudinalAccelerationCalculator/CalculateLateralTTRandTTP"
 /begin SUB_GROUP autosar_swc_aeb_autosar_swc_aeb_Step_sys_Subsystem_Reference_AEB_Function_Run_AsyEvlrCritEve_Step_Func_Run_AsyEvlrCritEve_Step_Func_TAWrapper_LongitudinalThreatAssessor_SingleTargetThreatAssessor_PrimaryTargetForWarn_RequiredLongitudinalAccelerationComputerForWarn_RequiredLongitudinalAccelerationCalculator_CalculateLateralTTRandTTP_LateralTTPComputer autosar_swc_aeb_autosar_swc_aeb_Step_sys_Subsystem_Reference_AEB_Function_Run_AsyEvlrCritEve_Step_Func_Run_AsyEvlrCritEve_Step_Func_TAWrapper_LongitudinalThreatAssessor_SingleTargetThreatAssessor_PrimaryTargetForWarn_RequiredLongitudinalAccelerationComputerForWarn_RequiredLongitudinalAccelerationCalculator_CalculateLateralTTRandTTP_LateralTTRComputer autosar_swc_aeb_autosar_swc_aeb_Step_sys_Subsystem_Reference_AEB_Function_Run_AsyEvlrCritEve_Step_Func_Run_AsyEvlrCritEve_Step_Func_TAWrapper_LongitudinalThreatAssessor_SingleTargetThreatAssessor_PrimaryTargetForWarn_RequiredLongitudinalAccelerationComputerForWarn_RequiredLongitudinalAccelerationCalculator_CalculateLateralTTRandTTP_ModifyTTPAtSameSpeedAndAcceleration autosar_swc_aeb_autosar_swc_aeb_Step_sys_Subsystem_Reference_AEB_Function_Run_AsyEvlrCritEve_Step_Func_Run_AsyEvlrCritEve_Step_Func_TAWrapper_LongitudinalThreatAssessor_SingleTargetThreatAssessor_PrimaryTargetForWarn_RequiredLongitudinalAccelerationComputerForWarn_RequiredLongitudinalAccelerationCalculator_CalculateLateralTTRandTTP_ModifyTTRAtSameSpeedAndAcceleration /end SUB_GROUP
/end GROUP
/begin GROUP autosar_swc_aeb_autosar_swc_aeb_Step_sys_Subsystem_Reference_AEB_Function_Run_AsyEvlrCritEve_Step_Func_Run_AsyEvlrCritEve_Step_Func_TAWrapper_LongitudinalThreatAssessor_SingleTargetThreatAssessor_PrimaryTargetForWarn_RequiredLongitudinalAccelerationComputerForWarn_RequiredLongitudinalAccelerationCalculator_CalculateLateralTTRandTTP_LateralTTPComputer "autosar_swc_aeb/autosar_swc_aeb_Step_sys/Subsystem Reference/AEB Function/Run_AsyEvlrCritEve_Step_Func/Run_AsyEvlrCritEve_Step_Func/TAWrapper/LongitudinalThreatAssessor/SingleTargetThreatAssessor/PrimaryTargetForWarn/RequiredLongitudinalAccelerationComputerForWarn/RequiredLongitudinalAccelerationCalculator/CalculateLateralTTRandTTP/LateralTTPComputer"
 /begin SUB_GROUP autosar_swc_aeb_autosar_swc_aeb_Step_sys_Subsystem_Reference_AEB_Function_Run_AsyEvlrCritEve_Step_Func_Run_AsyEvlrCritEve_Step_Func_TAWrapper_LongitudinalThreatAssessor_SingleTargetThreatAssessor_PrimaryTargetForWarn_RequiredLongitudinalAccelerationComputerForWarn_RequiredLongitudinalAccelerationCalculator_CalculateLateralTTRandTTP_LateralTTPComputer_LeftClosest autosar_swc_aeb_autosar_swc_aeb_Step_sys_Subsystem_Reference_AEB_Function_Run_AsyEvlrCritEve_Step_Func_Run_AsyEvlrCritEve_Step_Func_TAWrapper_LongitudinalThreatAssessor_SingleTargetThreatAssessor_PrimaryTargetForWarn_RequiredLongitudinalAccelerationComputerForWarn_RequiredLongitudinalAccelerationCalculator_CalculateLateralTTRandTTP_LateralTTPComputer_RightClosest /end SUB_GROUP
/end GROUP
/begin GROUP autosar_swc_aeb_autosar_swc_aeb_Step_sys_Subsystem_Reference_AEB_Function_Run_AsyEvlrCritEve_Step_Func_Run_AsyEvlrCritEve_Step_Func_TAWrapper_LongitudinalThreatAssessor_SingleTargetThreatAssessor_PrimaryTargetForWarn_RequiredLongitudinalAccelerationComputerForWarn_RequiredLongitudinalAccelerationCalculator_CalculateLateralTTRandTTP_LateralTTPComputer_LeftClosest "autosar_swc_aeb/autosar_swc_aeb_Step_sys/Subsystem Reference/AEB Function/Run_AsyEvlrCritEve_Step_Func/Run_AsyEvlrCritEve_Step_Func/TAWrapper/LongitudinalThreatAssessor/SingleTargetThreatAssessor/PrimaryTargetForWarn/RequiredLongitudinalAccelerationComputerForWarn/RequiredLongitudinalAccelerationCalculator/CalculateLateralTTRandTTP/LateralTTPComputer/LeftClosest"
 /begin SUB_GROUP autosar_swc_aeb_autosar_swc_aeb_Step_sys_Subsystem_Reference_AEB_Function_Run_AsyEvlrCritEve_Step_Func_Run_AsyEvlrCritEve_Step_Func_TAWrapper_LongitudinalThreatAssessor_SingleTargetThreatAssessor_PrimaryTargetForWarn_RequiredLongitudinalAccelerationComputerForWarn_RequiredLongitudinalAccelerationCalculator_CalculateLateralTTRandTTP_LateralTTPComputer_LeftClosest_TimeToIntersectionComputer /end SUB_GROUP
/end GROUP
/begin GROUP autosar_swc_aeb_autosar_swc_aeb_Step_sys_Subsystem_Reference_AEB_Function_Run_AsyEvlrCritEve_Step_Func_Run_AsyEvlrCritEve_Step_Func_TAWrapper_LongitudinalThreatAssessor_SingleTargetThreatAssessor_PrimaryTargetForWarn_RequiredLongitudinalAccelerationComputerForWarn_RequiredLongitudinalAccelerationCalculator_CalculateLateralTTRandTTP_LateralTTPComputer_RightClosest "autosar_swc_aeb/autosar_swc_aeb_Step_sys/Subsystem Reference/AEB Function/Run_AsyEvlrCritEve_Step_Func/Run_AsyEvlrCritEve_Step_Func/TAWrapper/LongitudinalThreatAssessor/SingleTargetThreatAssessor/PrimaryTargetForWarn/RequiredLongitudinalAccelerationComputerForWarn/RequiredLongitudinalAccelerationCalculator/CalculateLateralTTRandTTP/LateralTTPComputer/RightClosest"
 /begin SUB_GROUP autosar_swc_aeb_autosar_swc_aeb_Step_sys_Subsystem_Reference_AEB_Function_Run_AsyEvlrCritEve_Step_Func_Run_AsyEvlrCritEve_Step_Func_TAWrapper_LongitudinalThreatAssessor_SingleTargetThreatAssessor_PrimaryTargetForWarn_RequiredLongitudinalAccelerationComputerForWarn_RequiredLongitudinalAccelerationCalculator_CalculateLateralTTRandTTP_LateralTTPComputer_RightClosest_TimeToIntersectionComputer /end SUB_GROUP
/end GROUP
/begin GROUP autosar_swc_aeb_autosar_swc_aeb_Step_sys_Subsystem_Reference_AEB_Function_Run_AsyEvlrCritEve_Step_Func_Run_AsyEvlrCritEve_Step_Func_TAWrapper_LongitudinalThreatAssessor_SingleTargetThreatAssessor_PrimaryTargetForWarn_RequiredLongitudinalAccelerationComputerForWarn_RequiredLongitudinalAccelerationCalculator_CalculateLateralTTRandTTP_LateralTTRComputer "autosar_swc_aeb/autosar_swc_aeb_Step_sys/Subsystem Reference/AEB Function/Run_AsyEvlrCritEve_Step_Func/Run_AsyEvlrCritEve_Step_Func/TAWrapper/LongitudinalThreatAssessor/SingleTargetThreatAssessor/PrimaryTargetForWarn/RequiredLongitudinalAccelerationComputerForWarn/RequiredLongitudinalAccelerationCalculator/CalculateLateralTTRandTTP/LateralTTRComputer"
 /begin SUB_GROUP autosar_swc_aeb_autosar_swc_aeb_Step_sys_Subsystem_Reference_AEB_Function_Run_AsyEvlrCritEve_Step_Func_Run_AsyEvlrCritEve_Step_Func_TAWrapper_LongitudinalThreatAssessor_SingleTargetThreatAssessor_PrimaryTargetForWarn_RequiredLongitudinalAccelerationComputerForWarn_RequiredLongitudinalAccelerationCalculator_CalculateLateralTTRandTTP_LateralTTRComputer_LeftClosest autosar_swc_aeb_autosar_swc_aeb_Step_sys_Subsystem_Reference_AEB_Function_Run_AsyEvlrCritEve_Step_Func_Run_AsyEvlrCritEve_Step_Func_TAWrapper_LongitudinalThreatAssessor_SingleTargetThreatAssessor_PrimaryTargetForWarn_RequiredLongitudinalAccelerationComputerForWarn_RequiredLongitudinalAccelerationCalculator_CalculateLateralTTRandTTP_LateralTTRComputer_RightClosest /end SUB_GROUP
/end GROUP
/begin GROUP autosar_swc_aeb_autosar_swc_aeb_Step_sys_Subsystem_Reference_AEB_Function_Run_AsyEvlrCritEve_Step_Func_Run_AsyEvlrCritEve_Step_Func_TAWrapper_LongitudinalThreatAssessor_SingleTargetThreatAssessor_PrimaryTargetForWarn_RequiredLongitudinalAccelerationComputerForWarn_RequiredLongitudinalAccelerationCalculator_CalculateLateralTTRandTTP_LateralTTRComputer_LeftClosest "autosar_swc_aeb/autosar_swc_aeb_Step_sys/Subsystem Reference/AEB Function/Run_AsyEvlrCritEve_Step_Func/Run_AsyEvlrCritEve_Step_Func/TAWrapper/LongitudinalThreatAssessor/SingleTargetThreatAssessor/PrimaryTargetForWarn/RequiredLongitudinalAccelerationComputerForWarn/RequiredLongitudinalAccelerationCalculator/CalculateLateralTTRandTTP/LateralTTRComputer/LeftClosest"
 /begin SUB_GROUP autosar_swc_aeb_autosar_swc_aeb_Step_sys_Subsystem_Reference_AEB_Function_Run_AsyEvlrCritEve_Step_Func_Run_AsyEvlrCritEve_Step_Func_TAWrapper_LongitudinalThreatAssessor_SingleTargetThreatAssessor_PrimaryTargetForWarn_RequiredLongitudinalAccelerationComputerForWarn_RequiredLongitudinalAccelerationCalculator_CalculateLateralTTRandTTP_LateralTTRComputer_LeftClosest_TimeToIntersectionComputer /end SUB_GROUP
/end GROUP
/begin GROUP autosar_swc_aeb_autosar_swc_aeb_Step_sys_Subsystem_Reference_AEB_Function_Run_AsyEvlrCritEve_Step_Func_Run_AsyEvlrCritEve_Step_Func_TAWrapper_LongitudinalThreatAssessor_SingleTargetThreatAssessor_PrimaryTargetForWarn_RequiredLongitudinalAccelerationComputerForWarn_RequiredLongitudinalAccelerationCalculator_CalculateLateralTTRandTTP_LateralTTRComputer_RightClosest "autosar_swc_aeb/autosar_swc_aeb_Step_sys/Subsystem Reference/AEB Function/Run_AsyEvlrCritEve_Step_Func/Run_AsyEvlrCritEve_Step_Func/TAWrapper/LongitudinalThreatAssessor/SingleTargetThreatAssessor/PrimaryTargetForWarn/RequiredLongitudinalAccelerationComputerForWarn/RequiredLongitudinalAccelerationCalculator/CalculateLateralTTRandTTP/LateralTTRComputer/RightClosest"
 /begin SUB_GROUP autosar_swc_aeb_autosar_swc_aeb_Step_sys_Subsystem_Reference_AEB_Function_Run_AsyEvlrCritEve_Step_Func_Run_AsyEvlrCritEve_Step_Func_TAWrapper_LongitudinalThreatAssessor_SingleTargetThreatAssessor_PrimaryTargetForWarn_RequiredLongitudinalAccelerationComputerForWarn_RequiredLongitudinalAccelerationCalculator_CalculateLateralTTRandTTP_LateralTTRComputer_RightClosest_TimeToIntersectionComputer /end SUB_GROUP
/end GROUP
/begin GROUP autosar_swc_aeb_autosar_swc_aeb_Step_sys_Subsystem_Reference_AEB_Function_Run_AsyEvlrCritEve_Step_Func_Run_AsyEvlrCritEve_Step_Func_TAWrapper_LongitudinalThreatAssessor_SingleTargetThreatAssessor_PrimaryTargetForWarn_RequiredLongitudinalAccelerationComputerForWarn_RequiredLongitudinalAccelerationCalculator_CalculateRequiredAcceleration "autosar_swc_aeb/autosar_swc_aeb_Step_sys/Subsystem Reference/AEB Function/Run_AsyEvlrCritEve_Step_Func/Run_AsyEvlrCritEve_Step_Func/TAWrapper/LongitudinalThreatAssessor/SingleTargetThreatAssessor/PrimaryTargetForWarn/RequiredLongitudinalAccelerationComputerForWarn/RequiredLongitudinalAccelerationCalculator/CalculateRequiredAcceleration"
 /begin SUB_GROUP autosar_swc_aeb_autosar_swc_aeb_Step_sys_Subsystem_Reference_AEB_Function_Run_AsyEvlrCritEve_Step_Func_Run_AsyEvlrCritEve_Step_Func_TAWrapper_LongitudinalThreatAssessor_SingleTargetThreatAssessor_PrimaryTargetForWarn_RequiredLongitudinalAccelerationComputerForWarn_RequiredLongitudinalAccelerationCalculator_CalculateRequiredAcceleration_AlgorithmChooser autosar_swc_aeb_autosar_swc_aeb_Step_sys_Subsystem_Reference_AEB_Function_Run_AsyEvlrCritEve_Step_Func_Run_AsyEvlrCritEve_Step_Func_TAWrapper_LongitudinalThreatAssessor_SingleTargetThreatAssessor_PrimaryTargetForWarn_RequiredLongitudinalAccelerationComputerForWarn_RequiredLongitudinalAccelerationCalculator_CalculateRequiredAcceleration_RequiredAccelerationForInPathObject /end SUB_GROUP
/end GROUP
/begin GROUP autosar_swc_aeb_autosar_swc_aeb_Step_sys_Subsystem_Reference_AEB_Function_Run_AsyEvlrCritEve_Step_Func_Run_AsyEvlrCritEve_Step_Func_TAWrapper_LongitudinalThreatAssessor_SingleTargetThreatAssessor_PrimaryTargetForWarn_RequiredLongitudinalAccelerationComputerForWarn_RequiredLongitudinalAccelerationCalculator_CalculateRequiredAcceleration_AlgorithmChooser "autosar_swc_aeb/autosar_swc_aeb_Step_sys/Subsystem Reference/AEB Function/Run_AsyEvlrCritEve_Step_Func/Run_AsyEvlrCritEve_Step_Func/TAWrapper/LongitudinalThreatAssessor/SingleTargetThreatAssessor/PrimaryTargetForWarn/RequiredLongitudinalAccelerationComputerForWarn/RequiredLongitudinalAccelerationCalculator/CalculateRequiredAcceleration/AlgorithmChooser"
 /begin SUB_GROUP autosar_swc_aeb_autosar_swc_aeb_Step_sys_Subsystem_Reference_AEB_Function_Run_AsyEvlrCritEve_Step_Func_Run_AsyEvlrCritEve_Step_Func_TAWrapper_LongitudinalThreatAssessor_SingleTargetThreatAssessor_PrimaryTargetForWarn_RequiredLongitudinalAccelerationComputerForWarn_RequiredLongitudinalAccelerationCalculator_CalculateRequiredAcceleration_AlgorithmChooser_CheckIfObjectWillEnterPath /end SUB_GROUP
/end GROUP
/begin GROUP autosar_swc_aeb_autosar_swc_aeb_Step_sys_Subsystem_Reference_AEB_Function_Run_AsyEvlrCritEve_Step_Func_Run_AsyEvlrCritEve_Step_Func_TAWrapper_LongitudinalThreatAssessor_SingleTargetThreatAssessor_PrimaryTargetForWarn_RequiredLongitudinalAccelerationComputerForWarn_RequiredLongitudinalAccelerationCalculator_CalculateRequiredAcceleration_RequiredAccelerationForInPathObject "autosar_swc_aeb/autosar_swc_aeb_Step_sys/Subsystem Reference/AEB Function/Run_AsyEvlrCritEve_Step_Func/Run_AsyEvlrCritEve_Step_Func/TAWrapper/LongitudinalThreatAssessor/SingleTargetThreatAssessor/PrimaryTargetForWarn/RequiredLongitudinalAccelerationComputerForWarn/RequiredLongitudinalAccelerationCalculator/CalculateRequiredAcceleration/RequiredAccelerationForInPathObject"
 /begin SUB_GROUP autosar_swc_aeb_autosar_swc_aeb_Step_sys_Subsystem_Reference_AEB_Function_Run_AsyEvlrCritEve_Step_Func_Run_AsyEvlrCritEve_Step_Func_TAWrapper_LongitudinalThreatAssessor_SingleTargetThreatAssessor_PrimaryTargetForWarn_RequiredLongitudinalAccelerationComputerForWarn_RequiredLongitudinalAccelerationCalculator_CalculateRequiredAcceleration_RequiredAccelerationForInPathObject_ObjectIsBraking /end SUB_GROUP
/end GROUP
/begin GROUP autosar_swc_aeb_autosar_swc_aeb_Step_sys_Subsystem_Reference_AEB_Function_Run_AsyEvlrCritEve_Step_Func_Run_AsyEvlrCritEve_Step_Func_TAWrapper_LongitudinalThreatAssessor_SingleTargetThreatAssessor_PrimaryTargetForWarn_RequiredLongitudinalAccelerationComputerForWarn_RequiredLongitudinalAccelerationCalculator_CalculateRequiredAcceleration_RequiredAccelerationForInPathObject_ObjectIsBraking "autosar_swc_aeb/autosar_swc_aeb_Step_sys/Subsystem Reference/AEB Function/Run_AsyEvlrCritEve_Step_Func/Run_AsyEvlrCritEve_Step_Func/TAWrapper/LongitudinalThreatAssessor/SingleTargetThreatAssessor/PrimaryTargetForWarn/RequiredLongitudinalAccelerationComputerForWarn/RequiredLongitudinalAccelerationCalculator/CalculateRequiredAcceleration/RequiredAccelerationForInPathObject/ObjectIsBraking"
 /begin SUB_GROUP autosar_swc_aeb_autosar_swc_aeb_Step_sys_Subsystem_Reference_AEB_Function_Run_AsyEvlrCritEve_Step_Func_Run_AsyEvlrCritEve_Step_Func_TAWrapper_LongitudinalThreatAssessor_SingleTargetThreatAssessor_PrimaryTargetForWarn_RequiredLongitudinalAccelerationComputerForWarn_RequiredLongitudinalAccelerationCalculator_CalculateRequiredAcceleration_RequiredAccelerationForInPathObject_ObjectIsBraking_ObjectStopsBeforeCollision /end SUB_GROUP
/end GROUP
/begin GROUP autosar_swc_aeb_autosar_swc_aeb_Step_sys_Subsystem_Reference_AEB_Function_Run_AsyEvlrCritEve_Step_Func_Run_AsyEvlrCritEve_Step_Func_TAWrapper_LongitudinalThreatAssessor_SingleTargetThreatAssessor_PrimaryTargetForWarn_RequiredLongitudinalAccelerationComputerForWarn_RequiredLongitudinalAccelerationCalculator_CalculateRequiredAcceleration_RequiredAccelerationForInPathObject_ObjectIsBraking_ObjectStopsBeforeCollision "autosar_swc_aeb/autosar_swc_aeb_Step_sys/Subsystem Reference/AEB Function/Run_AsyEvlrCritEve_Step_Func/Run_AsyEvlrCritEve_Step_Func/TAWrapper/LongitudinalThreatAssessor/SingleTargetThreatAssessor/PrimaryTargetForWarn/RequiredLongitudinalAccelerationComputerForWarn/RequiredLongitudinalAccelerationCalculator/CalculateRequiredAcceleration/RequiredAccelerationForInPathObject/ObjectIsBraking/ObjectStopsBeforeCollision"
 /begin SUB_GROUP autosar_swc_aeb_autosar_swc_aeb_Step_sys_Subsystem_Reference_AEB_Function_Run_AsyEvlrCritEve_Step_Func_Run_AsyEvlrCritEve_Step_Func_TAWrapper_LongitudinalThreatAssessor_SingleTargetThreatAssessor_PrimaryTargetForWarn_RequiredLongitudinalAccelerationComputerForWarn_RequiredLongitudinalAccelerationCalculator_CalculateRequiredAcceleration_RequiredAccelerationForInPathObject_ObjectIsBraking_ObjectStopsBeforeCollision_ObjectNotStoppingBeforeTTR /end SUB_GROUP
/end GROUP
/begin GROUP autosar_swc_aeb_autosar_swc_aeb_Step_sys_Subsystem_Reference_AEB_Function_Run_AsyEvlrCritEve_Step_Func_Run_AsyEvlrCritEve_Step_Func_TAWrapper_LongitudinalThreatAssessor_SingleTargetThreatAssessor_PrimaryTargetForWarn_RequiredLongitudinalAccelerationComputerForWarn_TranslateAndRotateCoordSys "autosar_swc_aeb/autosar_swc_aeb_Step_sys/Subsystem Reference/AEB Function/Run_AsyEvlrCritEve_Step_Func/Run_AsyEvlrCritEve_Step_Func/TAWrapper/LongitudinalThreatAssessor/SingleTargetThreatAssessor/PrimaryTargetForWarn/RequiredLongitudinalAccelerationComputerForWarn/TranslateAndRotateCoordSys"
 /begin REF_MEASUREMENT autosar_swc_aeb_rtARID_DEF.PredALatObj_g autosar_swc_aeb_rtARID_DEF.PredALgtObj_f autosar_swc_aeb_rtARID_DEF.PredPosnLat_i autosar_swc_aeb_rtARID_DEF.PredPosnLgt_m autosar_swc_aeb_rtARID_DEF.PredVLatObj_f autosar_swc_aeb_rtARID_DEF.PredVLgtObj_e /end REF_MEASUREMENT
/end GROUP
/begin GROUP autosar_swc_aeb_autosar_swc_aeb_Step_sys_Subsystem_Reference_AEB_Function_Run_AsyEvlrCritEve_Step_Func_Run_AsyEvlrCritEve_Step_Func_TAWrapper_LongitudinalThreatAssessor_ThreatAssessorForIntv "autosar_swc_aeb/autosar_swc_aeb_Step_sys/Subsystem Reference/AEB Function/Run_AsyEvlrCritEve_Step_Func/Run_AsyEvlrCritEve_Step_Func/TAWrapper/LongitudinalThreatAssessor/ThreatAssessorForIntv"
 /begin SUB_GROUP autosar_swc_aeb_autosar_swc_aeb_Step_sys_Subsystem_Reference_AEB_Function_Run_AsyEvlrCritEve_Step_Func_Run_AsyEvlrCritEve_Step_Func_TAWrapper_LongitudinalThreatAssessor_ThreatAssessorForIntv_ThreatAssessor autosar_swc_aeb_autosar_swc_aeb_Step_sys_Subsystem_Reference_AEB_Function_Run_AsyEvlrCritEve_Step_Func_Run_AsyEvlrCritEve_Step_Func_TAWrapper_LongitudinalThreatAssessor_ThreatAssessorForIntv_ThreatFoundAndValidObj /end SUB_GROUP
/end GROUP
/begin GROUP autosar_swc_aeb_autosar_swc_aeb_Step_sys_Subsystem_Reference_AEB_Function_Run_AsyEvlrCritEve_Step_Func_Run_AsyEvlrCritEve_Step_Func_TAWrapper_LongitudinalThreatAssessor_ThreatAssessorForIntv_ThreatAssessor "autosar_swc_aeb/autosar_swc_aeb_Step_sys/Subsystem Reference/AEB Function/Run_AsyEvlrCritEve_Step_Func/Run_AsyEvlrCritEve_Step_Func/TAWrapper/LongitudinalThreatAssessor/ThreatAssessorForIntv/ThreatAssessor"
 /begin SUB_GROUP autosar_swc_aeb_autosar_swc_aeb_Step_sys_Subsystem_Reference_AEB_Function_Run_AsyEvlrCritEve_Step_Func_Run_AsyEvlrCritEve_Step_Func_TAWrapper_LongitudinalThreatAssessor_ThreatAssessorForIntv_ThreatAssessor_CreateMtnRqrdIntv autosar_swc_aeb_autosar_swc_aeb_Step_sys_Subsystem_Reference_AEB_Function_Run_AsyEvlrCritEve_Step_Func_Run_AsyEvlrCritEve_Step_Func_TAWrapper_LongitudinalThreatAssessor_ThreatAssessorForIntv_ThreatAssessor_DefaultValues autosar_swc_aeb_autosar_swc_aeb_Step_sys_Subsystem_Reference_AEB_Function_Run_AsyEvlrCritEve_Step_Func_Run_AsyEvlrCritEve_Step_Func_TAWrapper_LongitudinalThreatAssessor_ThreatAssessorForIntv_ThreatAssessor_FindHighestThreat autosar_swc_aeb_autosar_swc_aeb_Step_sys_Subsystem_Reference_AEB_Function_Run_AsyEvlrCritEve_Step_Func_Run_AsyEvlrCritEve_Step_Func_TAWrapper_LongitudinalThreatAssessor_ThreatAssessorForIntv_ThreatAssessor_LTAPAssessor /end SUB_GROUP
 /begin REF_CHARACTERISTIC P_AEB_CalTTRThrethold /end REF_CHARACTERISTIC
/end GROUP
/begin GROUP autosar_swc_aeb_autosar_swc_aeb_Step_sys_Subsystem_Reference_AEB_Function_Run_AsyEvlrCritEve_Step_Func_Run_AsyEvlrCritEve_Step_Func_TAWrapper_LongitudinalThreatAssessor_ThreatAssessorForIntv_ThreatAssessor_CreateMtnRqrdIntv "autosar_swc_aeb/autosar_swc_aeb_Step_sys/Subsystem Reference/AEB Function/Run_AsyEvlrCritEve_Step_Func/Run_AsyEvlrCritEve_Step_Func/TAWrapper/LongitudinalThreatAssessor/ThreatAssessorForIntv/ThreatAssessor/CreateMtnRqrdIntv"
 /begin REF_CHARACTERISTIC CLTS_CrvtUpprLimInAsyEvlrCritEve_Ca CLTS_JerkLowrLimInAsyEvlrCritEve_Ca /end REF_CHARACTERISTIC
/end GROUP
/begin GROUP autosar_swc_aeb_autosar_swc_aeb_Step_sys_Subsystem_Reference_AEB_Function_Run_AsyEvlrCritEve_Step_Func_Run_AsyEvlrCritEve_Step_Func_TAWrapper_LongitudinalThreatAssessor_ThreatAssessorForIntv_ThreatAssessor_FindHighestThreat "autosar_swc_aeb/autosar_swc_aeb_Step_sys/Subsystem Reference/AEB Function/Run_AsyEvlrCritEve_Step_Func/Run_AsyEvlrCritEve_Step_Func/TAWrapper/LongitudinalThreatAssessor/ThreatAssessorForIntv/ThreatAssessor/FindHighestThreat"
 /begin SUB_GROUP autosar_swc_aeb_autosar_swc_aeb_Step_sys_Subsystem_Reference_AEB_Function_Run_AsyEvlrCritEve_Step_Func_Run_AsyEvlrCritEve_Step_Func_TAWrapper_LongitudinalThreatAssessor_ThreatAssessorForIntv_ThreatAssessor_FindHighestThreat_SimpleLateralAccelerationEstimator autosar_swc_aeb_autosar_swc_aeb_Step_sys_Subsystem_Reference_AEB_Function_Run_AsyEvlrCritEve_Step_Func_Run_AsyEvlrCritEve_Step_Func_TAWrapper_LongitudinalThreatAssessor_ThreatAssessorForIntv_ThreatAssessor_FindHighestThreat_SimpleLateralAccelerationEstimator1 /end SUB_GROUP
 /begin REF_MEASUREMENT autosar_swc_aeb_rtARID_DEF.ALatRqrd_a autosar_swc_aeb_rtARID_DEF.ALatRqrd_b autosar_swc_aeb_rtARID_DEF.IfEnabled1_ActiveSubsystem autosar_swc_aeb_rtARID_DEF.IfEnabled_ActiveSubsystem /end REF_MEASUREMENT
/end GROUP
/begin GROUP autosar_swc_aeb_autosar_swc_aeb_Step_sys_Subsystem_Reference_AEB_Function_Run_AsyEvlrCritEve_Step_Func_Run_AsyEvlrCritEve_Step_Func_TAWrapper_LongitudinalThreatAssessor_ThreatAssessorForIntv_ThreatAssessor_FindHighestThreat_SimpleLateralAccelerationEstimator "autosar_swc_aeb/autosar_swc_aeb_Step_sys/Subsystem Reference/AEB Function/Run_AsyEvlrCritEve_Step_Func/Run_AsyEvlrCritEve_Step_Func/TAWrapper/LongitudinalThreatAssessor/ThreatAssessorForIntv/ThreatAssessor/FindHighestThreat/SimpleLateralAccelerationEstimator"
 /begin SUB_GROUP autosar_swc_aeb_autosar_swc_aeb_Step_sys_Subsystem_Reference_AEB_Function_Run_AsyEvlrCritEve_Step_Func_Run_AsyEvlrCritEve_Step_Func_TAWrapper_LongitudinalThreatAssessor_ThreatAssessorForIntv_ThreatAssessor_FindHighestThreat_SimpleLateralAccelerationEstimator_CalculateRequiredALat /end SUB_GROUP
 /begin REF_MEASUREMENT autosar_swc_aeb_rtARID_DEF.ALatRqrd_b /end REF_MEASUREMENT
/end GROUP
/begin GROUP autosar_swc_aeb_autosar_swc_aeb_Step_sys_Subsystem_Reference_AEB_Function_Run_AsyEvlrCritEve_Step_Func_Run_AsyEvlrCritEve_Step_Func_TAWrapper_LongitudinalThreatAssessor_ThreatAssessorForIntv_ThreatAssessor_FindHighestThreat_SimpleLateralAccelerationEstimator1 "autosar_swc_aeb/autosar_swc_aeb_Step_sys/Subsystem Reference/AEB Function/Run_AsyEvlrCritEve_Step_Func/Run_AsyEvlrCritEve_Step_Func/TAWrapper/LongitudinalThreatAssessor/ThreatAssessorForIntv/ThreatAssessor/FindHighestThreat/SimpleLateralAccelerationEstimator1"
 /begin SUB_GROUP autosar_swc_aeb_autosar_swc_aeb_Step_sys_Subsystem_Reference_AEB_Function_Run_AsyEvlrCritEve_Step_Func_Run_AsyEvlrCritEve_Step_Func_TAWrapper_LongitudinalThreatAssessor_ThreatAssessorForIntv_ThreatAssessor_FindHighestThreat_SimpleLateralAccelerationEstimator1_CalculateRequiredALat /end SUB_GROUP
 /begin REF_MEASUREMENT autosar_swc_aeb_rtARID_DEF.ALatRqrd_a /end REF_MEASUREMENT
/end GROUP
/begin GROUP autosar_swc_aeb_autosar_swc_aeb_Step_sys_Subsystem_Reference_AEB_Function_Run_AsyEvlrCritEve_Step_Func_Run_AsyEvlrCritEve_Step_Func_TAWrapper_LongitudinalThreatAssessor_ThreatAssessorForIntv_ThreatAssessor_FindHighestThreat_SimpleLateralAccelerationEstimator1_CalculateRequiredALat "autosar_swc_aeb/autosar_swc_aeb_Step_sys/Subsystem Reference/AEB Function/Run_AsyEvlrCritEve_Step_Func/Run_AsyEvlrCritEve_Step_Func/TAWrapper/LongitudinalThreatAssessor/ThreatAssessorForIntv/ThreatAssessor/FindHighestThreat/SimpleLateralAccelerationEstimator1/CalculateRequiredALat" /begin REF_MEASUREMENT autosar_swc_aeb_rtARID_DEF.ALatRqrd_a /end REF_MEASUREMENT /end GROUP
/begin GROUP autosar_swc_aeb_autosar_swc_aeb_Step_sys_Subsystem_Reference_AEB_Function_Run_AsyEvlrCritEve_Step_Func_Run_AsyEvlrCritEve_Step_Func_TAWrapper_LongitudinalThreatAssessor_ThreatAssessorForIntv_ThreatAssessor_FindHighestThreat_SimpleLateralAccelerationEstimator_CalculateRequiredALat "autosar_swc_aeb/autosar_swc_aeb_Step_sys/Subsystem Reference/AEB Function/Run_AsyEvlrCritEve_Step_Func/Run_AsyEvlrCritEve_Step_Func/TAWrapper/LongitudinalThreatAssessor/ThreatAssessorForIntv/ThreatAssessor/FindHighestThreat/SimpleLateralAccelerationEstimator/CalculateRequiredALat" /begin REF_MEASUREMENT autosar_swc_aeb_rtARID_DEF.ALatRqrd_b /end REF_MEASUREMENT /end GROUP
/begin GROUP autosar_swc_aeb_autosar_swc_aeb_Step_sys_Subsystem_Reference_AEB_Function_Run_AsyEvlrCritEve_Step_Func_Run_AsyEvlrCritEve_Step_Func_TAWrapper_LongitudinalThreatAssessor_ThreatAssessorForIntv_ThreatAssessor_LTAPAssessor "autosar_swc_aeb/autosar_swc_aeb_Step_sys/Subsystem Reference/AEB Function/Run_AsyEvlrCritEve_Step_Func/Run_AsyEvlrCritEve_Step_Func/TAWrapper/LongitudinalThreatAssessor/ThreatAssessorForIntv/ThreatAssessor/LTAPAssessor"
 /begin SUB_GROUP autosar_swc_aeb_autosar_swc_aeb_Step_sys_Subsystem_Reference_AEB_Function_Run_AsyEvlrCritEve_Step_Func_Run_AsyEvlrCritEve_Step_Func_TAWrapper_LongitudinalThreatAssessor_ThreatAssessorForIntv_ThreatAssessor_LTAPAssessor_CreateHostAndObjectData autosar_swc_aeb_autosar_swc_aeb_Step_sys_Subsystem_Reference_AEB_Function_Run_AsyEvlrCritEve_Step_Func_Run_AsyEvlrCritEve_Step_Func_TAWrapper_LongitudinalThreatAssessor_ThreatAssessorForIntv_ThreatAssessor_LTAPAssessor_ThreatAssessment /end SUB_GROUP
/end GROUP
/begin GROUP autosar_swc_aeb_autosar_swc_aeb_Step_sys_Subsystem_Reference_AEB_Function_Run_AsyEvlrCritEve_Step_Func_Run_AsyEvlrCritEve_Step_Func_TAWrapper_LongitudinalThreatAssessor_ThreatAssessorForIntv_ThreatAssessor_LTAPAssessor_CreateHostAndObjectData "autosar_swc_aeb/autosar_swc_aeb_Step_sys/Subsystem Reference/AEB Function/Run_AsyEvlrCritEve_Step_Func/Run_AsyEvlrCritEve_Step_Func/TAWrapper/LongitudinalThreatAssessor/ThreatAssessorForIntv/ThreatAssessor/LTAPAssessor/CreateHostAndObjectData"
 /begin SUB_GROUP autosar_swc_aeb_autosar_swc_aeb_Step_sys_Subsystem_Reference_AEB_Function_Run_AsyEvlrCritEve_Step_Func_Run_AsyEvlrCritEve_Step_Func_TAWrapper_LongitudinalThreatAssessor_ThreatAssessorForIntv_ThreatAssessor_LTAPAssessor_CreateHostAndObjectData_CollectHostData autosar_swc_aeb_autosar_swc_aeb_Step_sys_Subsystem_Reference_AEB_Function_Run_AsyEvlrCritEve_Step_Func_Run_AsyEvlrCritEve_Step_Func_TAWrapper_LongitudinalThreatAssessor_ThreatAssessorForIntv_ThreatAssessor_LTAPAssessor_CreateHostAndObjectData_CollectObjectData autosar_swc_aeb_autosar_swc_aeb_Step_sys_Subsystem_Reference_AEB_Function_Run_AsyEvlrCritEve_Step_Func_Run_AsyEvlrCritEve_Step_Func_TAWrapper_LongitudinalThreatAssessor_ThreatAssessorForIntv_ThreatAssessor_LTAPAssessor_CreateHostAndObjectData_DetermineVehStDly autosar_swc_aeb_autosar_swc_aeb_Step_sys_Subsystem_Reference_AEB_Function_Run_AsyEvlrCritEve_Step_Func_Run_AsyEvlrCritEve_Step_Func_TAWrapper_LongitudinalThreatAssessor_ThreatAssessorForIntv_ThreatAssessor_LTAPAssessor_CreateHostAndObjectData_PredictHostState autosar_swc_aeb_autosar_swc_aeb_Step_sys_Subsystem_Reference_AEB_Function_Run_AsyEvlrCritEve_Step_Func_Run_AsyEvlrCritEve_Step_Func_TAWrapper_LongitudinalThreatAssessor_ThreatAssessorForIntv_ThreatAssessor_LTAPAssessor_CreateHostAndObjectData_TransformObject /end SUB_GROUP
/end GROUP
/begin GROUP autosar_swc_aeb_autosar_swc_aeb_Step_sys_Subsystem_Reference_AEB_Function_Run_AsyEvlrCritEve_Step_Func_Run_AsyEvlrCritEve_Step_Func_TAWrapper_LongitudinalThreatAssessor_ThreatAssessorForIntv_ThreatAssessor_LTAPAssessor_CreateHostAndObjectData_CollectHostData "autosar_swc_aeb/autosar_swc_aeb_Step_sys/Subsystem Reference/AEB Function/Run_AsyEvlrCritEve_Step_Func/Run_AsyEvlrCritEve_Step_Func/TAWrapper/LongitudinalThreatAssessor/ThreatAssessorForIntv/ThreatAssessor/LTAPAssessor/CreateHostAndObjectData/CollectHostData"
 /begin REF_CHARACTERISTIC CLTS_AltvMdlSteerAgMaxInAsyEvlrCritEve_Ca CLTS_AltvMdlSteerWhlAgRateMaxInAsyEvlrCritEve_Ca CLTS_JerkMinDurnInAsyEvlrCritEve_Ca /end REF_CHARACTERISTIC
/end GROUP
/begin GROUP autosar_swc_aeb_autosar_swc_aeb_Step_sys_Subsystem_Reference_AEB_Function_Run_AsyEvlrCritEve_Step_Func_Run_AsyEvlrCritEve_Step_Func_TAWrapper_LongitudinalThreatAssessor_ThreatAssessorForIntv_ThreatAssessor_LTAPAssessor_CreateHostAndObjectData_CollectObjectData "autosar_swc_aeb/autosar_swc_aeb_Step_sys/Subsystem Reference/AEB Function/Run_AsyEvlrCritEve_Step_Func/Run_AsyEvlrCritEve_Step_Func/TAWrapper/LongitudinalThreatAssessor/ThreatAssessorForIntv/ThreatAssessor/LTAPAssessor/CreateHostAndObjectData/CollectObjectData"
 /begin SUB_GROUP autosar_swc_aeb_autosar_swc_aeb_Step_sys_Subsystem_Reference_AEB_Function_Run_AsyEvlrCritEve_Step_Func_Run_AsyEvlrCritEve_Step_Func_TAWrapper_LongitudinalThreatAssessor_ThreatAssessorForIntv_ThreatAssessor_LTAPAssessor_CreateHostAndObjectData_CollectObjectData_ObjectWidthAndLength autosar_swc_aeb_autosar_swc_aeb_Step_sys_Subsystem_Reference_AEB_Function_Run_AsyEvlrCritEve_Step_Func_Run_AsyEvlrCritEve_Step_Func_TAWrapper_LongitudinalThreatAssessor_ThreatAssessorForIntv_ThreatAssessor_LTAPAssessor_CreateHostAndObjectData_CollectObjectData_SelectOffsLat /end SUB_GROUP
/end GROUP
/begin GROUP autosar_swc_aeb_autosar_swc_aeb_Step_sys_Subsystem_Reference_AEB_Function_Run_AsyEvlrCritEve_Step_Func_Run_AsyEvlrCritEve_Step_Func_TAWrapper_LongitudinalThreatAssessor_ThreatAssessorForIntv_ThreatAssessor_LTAPAssessor_CreateHostAndObjectData_CollectObjectData_ObjectWidthAndLength "autosar_swc_aeb/autosar_swc_aeb_Step_sys/Subsystem Reference/AEB Function/Run_AsyEvlrCritEve_Step_Func/Run_AsyEvlrCritEve_Step_Func/TAWrapper/LongitudinalThreatAssessor/ThreatAssessorForIntv/ThreatAssessor/LTAPAssessor/CreateHostAndObjectData/CollectObjectData/ObjectWidthAndLength" /begin REF_CHARACTERISTIC P_AEB_CPTAAddComp P_AEB_CalTTRThrethold /end REF_CHARACTERISTIC /end GROUP
/begin GROUP autosar_swc_aeb_autosar_swc_aeb_Step_sys_Subsystem_Reference_AEB_Function_Run_AsyEvlrCritEve_Step_Func_Run_AsyEvlrCritEve_Step_Func_TAWrapper_LongitudinalThreatAssessor_ThreatAssessorForIntv_ThreatAssessor_LTAPAssessor_CreateHostAndObjectData_CollectObjectData_SelectOffsLat "autosar_swc_aeb/autosar_swc_aeb_Step_sys/Subsystem Reference/AEB Function/Run_AsyEvlrCritEve_Step_Func/Run_AsyEvlrCritEve_Step_Func/TAWrapper/LongitudinalThreatAssessor/ThreatAssessorForIntv/ThreatAssessor/LTAPAssessor/CreateHostAndObjectData/CollectObjectData/SelectOffsLat" /begin REF_CHARACTERISTIC CLTS_AgDirForBrkgMinInAsyEvlrCritEve_Ca /end REF_CHARACTERISTIC /end GROUP
/begin GROUP autosar_swc_aeb_autosar_swc_aeb_Step_sys_Subsystem_Reference_AEB_Function_Run_AsyEvlrCritEve_Step_Func_Run_AsyEvlrCritEve_Step_Func_TAWrapper_LongitudinalThreatAssessor_ThreatAssessorForIntv_ThreatAssessor_LTAPAssessor_CreateHostAndObjectData_DetermineVehStDly "autosar_swc_aeb/autosar_swc_aeb_Step_sys/Subsystem Reference/AEB Function/Run_AsyEvlrCritEve_Step_Func/Run_AsyEvlrCritEve_Step_Func/TAWrapper/LongitudinalThreatAssessor/ThreatAssessorForIntv/ThreatAssessor/LTAPAssessor/CreateHostAndObjectData/DetermineVehStDly"
 /begin REF_CHARACTERISTIC CLTS_ALgtThdForDrvrBrkgForLoVehStDlyInAsyEvlrCritEve_Ca CLTS_BrkDlyLTAPInAsyEvlrCritEve_Ca CLTS_VehStDlyForDrvrBrkgInAsyEvlrCritEve_Ca /end REF_CHARACTERISTIC
/end GROUP
/begin GROUP autosar_swc_aeb_autosar_swc_aeb_Step_sys_Subsystem_Reference_AEB_Function_Run_AsyEvlrCritEve_Step_Func_Run_AsyEvlrCritEve_Step_Func_TAWrapper_LongitudinalThreatAssessor_ThreatAssessorForIntv_ThreatAssessor_LTAPAssessor_CreateHostAndObjectData_PredictHostState "autosar_swc_aeb/autosar_swc_aeb_Step_sys/Subsystem Reference/AEB Function/Run_AsyEvlrCritEve_Step_Func/Run_AsyEvlrCritEve_Step_Func/TAWrapper/LongitudinalThreatAssessor/ThreatAssessorForIntv/ThreatAssessor/LTAPAssessor/CreateHostAndObjectData/PredictHostState"
 /begin REF_CHARACTERISTIC CLTS_ObjCrvtRotThdInAsyEvlrCritEve_Ca CLTS_VehSelfCrvtMaxInAsyEvlrCritEve_Ca /end REF_CHARACTERISTIC
/end GROUP
/begin GROUP autosar_swc_aeb_autosar_swc_aeb_Step_sys_Subsystem_Reference_AEB_Function_Run_AsyEvlrCritEve_Step_Func_Run_AsyEvlrCritEve_Step_Func_TAWrapper_LongitudinalThreatAssessor_ThreatAssessorForIntv_ThreatAssessor_LTAPAssessor_CreateHostAndObjectData_TransformObject "autosar_swc_aeb/autosar_swc_aeb_Step_sys/Subsystem Reference/AEB Function/Run_AsyEvlrCritEve_Step_Func/Run_AsyEvlrCritEve_Step_Func/TAWrapper/LongitudinalThreatAssessor/ThreatAssessorForIntv/ThreatAssessor/LTAPAssessor/CreateHostAndObjectData/TransformObject"
 /begin SUB_GROUP autosar_swc_aeb_autosar_swc_aeb_Step_sys_Subsystem_Reference_AEB_Function_Run_AsyEvlrCritEve_Step_Func_Run_AsyEvlrCritEve_Step_Func_TAWrapper_LongitudinalThreatAssessor_ThreatAssessorForIntv_ThreatAssessor_LTAPAssessor_CreateHostAndObjectData_TransformObject_TransformLinearObject /end SUB_GROUP
/end GROUP
/begin GROUP autosar_swc_aeb_autosar_swc_aeb_Step_sys_Subsystem_Reference_AEB_Function_Run_AsyEvlrCritEve_Step_Func_Run_AsyEvlrCritEve_Step_Func_TAWrapper_LongitudinalThreatAssessor_ThreatAssessorForIntv_ThreatAssessor_LTAPAssessor_ThreatAssessment "autosar_swc_aeb/autosar_swc_aeb_Step_sys/Subsystem Reference/AEB Function/Run_AsyEvlrCritEve_Step_Func/Run_AsyEvlrCritEve_Step_Func/TAWrapper/LongitudinalThreatAssessor/ThreatAssessorForIntv/ThreatAssessor/LTAPAssessor/ThreatAssessment"
 /begin SUB_GROUP autosar_swc_aeb_autosar_swc_aeb_Step_sys_Subsystem_Reference_AEB_Function_Run_AsyEvlrCritEve_Step_Func_Run_AsyEvlrCritEve_Step_Func_TAWrapper_LongitudinalThreatAssessor_ThreatAssessorForIntv_ThreatAssessor_LTAPAssessor_ThreatAssessment_CreateObjectEdgesSteering autosar_swc_aeb_autosar_swc_aeb_Step_sys_Subsystem_Reference_AEB_Function_Run_AsyEvlrCritEve_Step_Func_Run_AsyEvlrCritEve_Step_Func_TAWrapper_LongitudinalThreatAssessor_ThreatAssessorForIntv_ThreatAssessor_LTAPAssessor_ThreatAssessment_EstimateObjectLongPosInPath /end SUB_GROUP
 /begin REF_CHARACTERISTIC P_AEB_CalTTRThrethold P_AEB_CrvtRqrdComp /end REF_CHARACTERISTIC
/end GROUP
/begin GROUP autosar_swc_aeb_autosar_swc_aeb_Step_sys_Subsystem_Reference_AEB_Function_Run_AsyEvlrCritEve_Step_Func_Run_AsyEvlrCritEve_Step_Func_TAWrapper_LongitudinalThreatAssessor_ThreatAssessorForIntv_ThreatAssessor_LTAPAssessor_ThreatAssessment_CreateObjectEdgesSteering "autosar_swc_aeb/autosar_swc_aeb_Step_sys/Subsystem Reference/AEB Function/Run_AsyEvlrCritEve_Step_Func/Run_AsyEvlrCritEve_Step_Func/TAWrapper/LongitudinalThreatAssessor/ThreatAssessorForIntv/ThreatAssessor/LTAPAssessor/ThreatAssessment/CreateObjectEdgesSteering"
 /begin SUB_GROUP autosar_swc_aeb_autosar_swc_aeb_Step_sys_Subsystem_Reference_AEB_Function_Run_AsyEvlrCritEve_Step_Func_Run_AsyEvlrCritEve_Step_Func_TAWrapper_LongitudinalThreatAssessor_ThreatAssessorForIntv_ThreatAssessor_LTAPAssessor_ThreatAssessment_CreateObjectEdgesSteering_FindEdgePositionAtTimeAroundTTR /end SUB_GROUP
/end GROUP
/begin GROUP autosar_swc_aeb_autosar_swc_aeb_Step_sys_Subsystem_Reference_AEB_Function_Run_AsyEvlrCritEve_Step_Func_Run_AsyEvlrCritEve_Step_Func_TAWrapper_LongitudinalThreatAssessor_ThreatAssessorForIntv_ThreatAssessor_LTAPAssessor_ThreatAssessment_CreateObjectEdgesSteering_FindEdgePositionAtTimeAroundTTR "autosar_swc_aeb/autosar_swc_aeb_Step_sys/Subsystem Reference/AEB Function/Run_AsyEvlrCritEve_Step_Func/Run_AsyEvlrCritEve_Step_Func/TAWrapper/LongitudinalThreatAssessor/ThreatAssessorForIntv/ThreatAssessor/LTAPAssessor/ThreatAssessment/CreateObjectEdgesSteering/FindEdgePositionAtTimeAroundTTR"
 /begin SUB_GROUP autosar_swc_aeb_autosar_swc_aeb_Step_sys_Subsystem_Reference_AEB_Function_Run_AsyEvlrCritEve_Step_Func_Run_AsyEvlrCritEve_Step_Func_TAWrapper_LongitudinalThreatAssessor_ThreatAssessorForIntv_ThreatAssessor_LTAPAssessor_ThreatAssessment_CreateObjectEdgesSteering_FindEdgePositionAtTimeAroundTTR_FindClosestEdgesAtTTI /end SUB_GROUP
/end GROUP
/begin GROUP autosar_swc_aeb_autosar_swc_aeb_Step_sys_Subsystem_Reference_AEB_Function_Run_AsyEvlrCritEve_Step_Func_Run_AsyEvlrCritEve_Step_Func_TAWrapper_LongitudinalThreatAssessor_ThreatAssessorForIntv_ThreatAssessor_LTAPAssessor_ThreatAssessment_CreateObjectEdgesSteering_FindEdgePositionAtTimeAroundTTR_FindClosestEdgesAtTTI "autosar_swc_aeb/autosar_swc_aeb_Step_sys/Subsystem Reference/AEB Function/Run_AsyEvlrCritEve_Step_Func/Run_AsyEvlrCritEve_Step_Func/TAWrapper/LongitudinalThreatAssessor/ThreatAssessorForIntv/ThreatAssessor/LTAPAssessor/ThreatAssessment/CreateObjectEdgesSteering/FindEdgePositionAtTimeAroundTTR/FindClosestEdgesAtTTI"
 /begin SUB_GROUP autosar_swc_aeb_autosar_swc_aeb_Step_sys_Subsystem_Reference_AEB_Function_Run_AsyEvlrCritEve_Step_Func_Run_AsyEvlrCritEve_Step_Func_TAWrapper_LongitudinalThreatAssessor_ThreatAssessorForIntv_ThreatAssessor_LTAPAssessor_ThreatAssessment_CreateObjectEdgesSteering_FindEdgePositionAtTimeAroundTTR_FindClosestEdgesAtTTI_PredictHostPosition /end SUB_GROUP
/end GROUP
/begin GROUP autosar_swc_aeb_autosar_swc_aeb_Step_sys_Subsystem_Reference_AEB_Function_Run_AsyEvlrCritEve_Step_Func_Run_AsyEvlrCritEve_Step_Func_TAWrapper_LongitudinalThreatAssessor_ThreatAssessorForIntv_ThreatAssessor_LTAPAssessor_ThreatAssessment_CreateObjectEdgesSteering_FindEdgePositionAtTimeAroundTTR_FindClosestEdgesAtTTI_PredictHostPosition "autosar_swc_aeb/autosar_swc_aeb_Step_sys/Subsystem Reference/AEB Function/Run_AsyEvlrCritEve_Step_Func/Run_AsyEvlrCritEve_Step_Func/TAWrapper/LongitudinalThreatAssessor/ThreatAssessorForIntv/ThreatAssessor/LTAPAssessor/ThreatAssessment/CreateObjectEdgesSteering/FindEdgePositionAtTimeAroundTTR/FindClosestEdgesAtTTI/PredictHostPosition"
 /begin SUB_GROUP autosar_swc_aeb_autosar_swc_aeb_Step_sys_Subsystem_Reference_AEB_Function_Run_AsyEvlrCritEve_Step_Func_Run_AsyEvlrCritEve_Step_Func_TAWrapper_LongitudinalThreatAssessor_ThreatAssessorForIntv_ThreatAssessor_LTAPAssessor_ThreatAssessment_CreateObjectEdgesSteering_FindEdgePositionAtTimeAroundTTR_FindClosestEdgesAtTTI_PredictHostPosition_CalculateHeading autosar_swc_aeb_autosar_swc_aeb_Step_sys_Subsystem_Reference_AEB_Function_Run_AsyEvlrCritEve_Step_Func_Run_AsyEvlrCritEve_Step_Func_TAWrapper_LongitudinalThreatAssessor_ThreatAssessorForIntv_ThreatAssessor_LTAPAssessor_ThreatAssessment_CreateObjectEdgesSteering_FindEdgePositionAtTimeAroundTTR_FindClosestEdgesAtTTI_PredictHostPosition_SelectSegment /end SUB_GROUP
/end GROUP
/begin GROUP autosar_swc_aeb_autosar_swc_aeb_Step_sys_Subsystem_Reference_AEB_Function_Run_AsyEvlrCritEve_Step_Func_Run_AsyEvlrCritEve_Step_Func_TAWrapper_LongitudinalThreatAssessor_ThreatAssessorForIntv_ThreatAssessor_LTAPAssessor_ThreatAssessment_CreateObjectEdgesSteering_FindEdgePositionAtTimeAroundTTR_FindClosestEdgesAtTTI_PredictHostPosition_CalculateHeading "autosar_swc_aeb/autosar_swc_aeb_Step_sys/Subsystem Reference/AEB Function/Run_AsyEvlrCritEve_Step_Func/Run_AsyEvlrCritEve_Step_Func/TAWrapper/LongitudinalThreatAssessor/ThreatAssessorForIntv/ThreatAssessor/LTAPAssessor/ThreatAssessment/CreateObjectEdgesSteering/FindEdgePositionAtTimeAroundTTR/FindClosestEdgesAtTTI/PredictHostPosition/CalculateHeading"
 /begin SUB_GROUP autosar_swc_aeb_autosar_swc_aeb_Step_sys_Subsystem_Reference_AEB_Function_Run_AsyEvlrCritEve_Step_Func_Run_AsyEvlrCritEve_Step_Func_TAWrapper_LongitudinalThreatAssessor_ThreatAssessorForIntv_ThreatAssessor_LTAPAssessor_ThreatAssessment_CreateObjectEdgesSteering_FindEdgePositionAtTimeAroundTTR_FindClosestEdgesAtTTI_PredictHostPosition_CalculateHeading_CheckSpeed autosar_swc_aeb_autosar_swc_aeb_Step_sys_Subsystem_Reference_AEB_Function_Run_AsyEvlrCritEve_Step_Func_Run_AsyEvlrCritEve_Step_Func_TAWrapper_LongitudinalThreatAssessor_ThreatAssessorForIntv_ThreatAssessor_LTAPAssessor_ThreatAssessment_CreateObjectEdgesSteering_FindEdgePositionAtTimeAroundTTR_FindClosestEdgesAtTTI_PredictHostPosition_CalculateHeading_ExtractVelocitiesAtStartOfSegments /end SUB_GROUP
/end GROUP
/begin GROUP autosar_swc_aeb_autosar_swc_aeb_Step_sys_Subsystem_Reference_AEB_Function_Run_AsyEvlrCritEve_Step_Func_Run_AsyEvlrCritEve_Step_Func_TAWrapper_LongitudinalThreatAssessor_ThreatAssessorForIntv_ThreatAssessor_LTAPAssessor_ThreatAssessment_CreateObjectEdgesSteering_FindEdgePositionAtTimeAroundTTR_FindClosestEdgesAtTTI_PredictHostPosition_CalculateHeading_ExtractVelocitiesAtStartOfSegments "autosar_swc_aeb/autosar_swc_aeb_Step_sys/Subsystem Reference/AEB Function/Run_AsyEvlrCritEve_Step_Func/Run_AsyEvlrCritEve_Step_Func/TAWrapper/LongitudinalThreatAssessor/ThreatAssessorForIntv/ThreatAssessor/LTAPAssessor/ThreatAssessment/CreateObjectEdgesSteering/FindEdgePositionAtTimeAroundTTR/FindClosestEdgesAtTTI/PredictHostPosition/CalculateHeading/ExtractVelocitiesAtStartOfSegments"
 /begin SUB_GROUP autosar_swc_aeb_autosar_swc_aeb_Step_sys_Subsystem_Reference_AEB_Function_Run_AsyEvlrCritEve_Step_Func_Run_AsyEvlrCritEve_Step_Func_TAWrapper_LongitudinalThreatAssessor_ThreatAssessorForIntv_ThreatAssessor_LTAPAssessor_ThreatAssessment_CreateObjectEdgesSteering_FindEdgePositionAtTimeAroundTTR_FindClosestEdgesAtTTI_PredictHostPosition_CalculateHeading_ExtractVelocitiesAtStartOfSegments_CheckSpeed /end SUB_GROUP
/end GROUP
/begin GROUP autosar_swc_aeb_autosar_swc_aeb_Step_sys_Subsystem_Reference_AEB_Function_Run_AsyEvlrCritEve_Step_Func_Run_AsyEvlrCritEve_Step_Func_TAWrapper_LongitudinalThreatAssessor_ThreatAssessorForIntv_ThreatAssessor_LTAPAssessor_ThreatAssessment_CreateObjectEdgesSteering_FindEdgePositionAtTimeAroundTTR_FindClosestEdgesAtTTI_PredictHostPosition_SelectSegment "autosar_swc_aeb/autosar_swc_aeb_Step_sys/Subsystem Reference/AEB Function/Run_AsyEvlrCritEve_Step_Func/Run_AsyEvlrCritEve_Step_Func/TAWrapper/LongitudinalThreatAssessor/ThreatAssessorForIntv/ThreatAssessor/LTAPAssessor/ThreatAssessment/CreateObjectEdgesSteering/FindEdgePositionAtTimeAroundTTR/FindClosestEdgesAtTTI/PredictHostPosition/SelectSegment" /begin REF_MEASUREMENT autosar_swc_aeb_rtARID_DEF.LastSegment /end REF_MEASUREMENT /end GROUP
/begin GROUP autosar_swc_aeb_autosar_swc_aeb_Step_sys_Subsystem_Reference_AEB_Function_Run_AsyEvlrCritEve_Step_Func_Run_AsyEvlrCritEve_Step_Func_TAWrapper_LongitudinalThreatAssessor_ThreatAssessorForIntv_ThreatAssessor_LTAPAssessor_ThreatAssessment_EstimateObjectLongPosInPath "autosar_swc_aeb/autosar_swc_aeb_Step_sys/Subsystem Reference/AEB Function/Run_AsyEvlrCritEve_Step_Func/Run_AsyEvlrCritEve_Step_Func/TAWrapper/LongitudinalThreatAssessor/ThreatAssessorForIntv/ThreatAssessor/LTAPAssessor/ThreatAssessment/EstimateObjectLongPosInPath"
 /begin REF_CHARACTERISTIC CLTS_ALatThdInAsyEvlrCritEve_Ca CLTS_DstAddlFromWhlAxleReToVehReInIntscnInAsyEvlrCritEve_Ca /end REF_CHARACTERISTIC
/end GROUP
/begin GROUP autosar_swc_aeb_autosar_swc_aeb_Step_sys_Subsystem_Reference_AEB_Function_Run_AsyEvlrCritEve_Step_Func_Run_AsyEvlrCritEve_Step_Func_TAWrapper_LongitudinalThreatAssessor_ThreatAssessorForIntv_ThreatFoundAndValidObj "autosar_swc_aeb/autosar_swc_aeb_Step_sys/Subsystem Reference/AEB Function/Run_AsyEvlrCritEve_Step_Func/Run_AsyEvlrCritEve_Step_Func/TAWrapper/LongitudinalThreatAssessor/ThreatAssessorForIntv/ThreatFoundAndValidObj" /begin REF_MEASUREMENT autosar_swc_aeb_rtARID_DEF.ThreatFoundForIntv /end REF_MEASUREMENT /end GROUP
/begin GROUP autosar_swc_aeb_autosar_swc_aeb_Step_sys_Subsystem_Reference_AEB_Function_Run_AsyEvlrCritEve_Step_Func_Run_AsyEvlrCritEve_Step_Func_TAWrapper_LongitudinalThreatAssessor_ThreatAssessorForWarn "autosar_swc_aeb/autosar_swc_aeb_Step_sys/Subsystem Reference/AEB Function/Run_AsyEvlrCritEve_Step_Func/Run_AsyEvlrCritEve_Step_Func/TAWrapper/LongitudinalThreatAssessor/ThreatAssessorForWarn"
 /begin SUB_GROUP autosar_swc_aeb_autosar_swc_aeb_Step_sys_Subsystem_Reference_AEB_Function_Run_AsyEvlrCritEve_Step_Func_Run_AsyEvlrCritEve_Step_Func_TAWrapper_LongitudinalThreatAssessor_ThreatAssessorForWarn_ThreatAssessor autosar_swc_aeb_autosar_swc_aeb_Step_sys_Subsystem_Reference_AEB_Function_Run_AsyEvlrCritEve_Step_Func_Run_AsyEvlrCritEve_Step_Func_TAWrapper_LongitudinalThreatAssessor_ThreatAssessorForWarn_ThreatFoundAndValidObj /end SUB_GROUP
/end GROUP
/begin GROUP autosar_swc_aeb_autosar_swc_aeb_Step_sys_Subsystem_Reference_AEB_Function_Run_AsyEvlrCritEve_Step_Func_Run_AsyEvlrCritEve_Step_Func_TAWrapper_LongitudinalThreatAssessor_ThreatAssessorForWarn_ThreatAssessor "autosar_swc_aeb/autosar_swc_aeb_Step_sys/Subsystem Reference/AEB Function/Run_AsyEvlrCritEve_Step_Func/Run_AsyEvlrCritEve_Step_Func/TAWrapper/LongitudinalThreatAssessor/ThreatAssessorForWarn/ThreatAssessor"
 /begin SUB_GROUP autosar_swc_aeb_autosar_swc_aeb_Step_sys_Subsystem_Reference_AEB_Function_Run_AsyEvlrCritEve_Step_Func_Run_AsyEvlrCritEve_Step_Func_TAWrapper_LongitudinalThreatAssessor_ThreatAssessorForWarn_ThreatAssessor_RequiredLongitudinalAccelerationForIntv autosar_swc_aeb_autosar_swc_aeb_Step_sys_Subsystem_Reference_AEB_Function_Run_AsyEvlrCritEve_Step_Func_Run_AsyEvlrCritEve_Step_Func_TAWrapper_LongitudinalThreatAssessor_ThreatAssessorForWarn_ThreatAssessor_SimpleLateralAccelerationEstimator /end SUB_GROUP
 /begin REF_MEASUREMENT autosar_swc_aeb_rtARID_DEF.ALatRqrd autosar_swc_aeb_rtARID_DEF.ALgtRqrd autosar_swc_aeb_rtARID_DEF.IfEnabled1_ActiveSubsystem_g autosar_swc_aeb_rtARID_DEF.IfEnabled_ActiveSubsystem_f /end REF_MEASUREMENT
/end GROUP
/begin GROUP autosar_swc_aeb_autosar_swc_aeb_Step_sys_Subsystem_Reference_AEB_Function_Run_AsyEvlrCritEve_Step_Func_Run_AsyEvlrCritEve_Step_Func_TAWrapper_LongitudinalThreatAssessor_ThreatAssessorForWarn_ThreatAssessor_RequiredLongitudinalAccelerationForIntv "autosar_swc_aeb/autosar_swc_aeb_Step_sys/Subsystem Reference/AEB Function/Run_AsyEvlrCritEve_Step_Func/Run_AsyEvlrCritEve_Step_Func/TAWrapper/LongitudinalThreatAssessor/ThreatAssessorForWarn/ThreatAssessor/RequiredLongitudinalAccelerationForIntv"
 /begin SUB_GROUP autosar_swc_aeb_autosar_swc_aeb_Step_sys_Subsystem_Reference_AEB_Function_Run_AsyEvlrCritEve_Step_Func_Run_AsyEvlrCritEve_Step_Func_TAWrapper_LongitudinalThreatAssessor_ThreatAssessorForWarn_ThreatAssessor_RequiredLongitudinalAccelerationForIntv_CheckPredictionValidity autosar_swc_aeb_autosar_swc_aeb_Step_sys_Subsystem_Reference_AEB_Function_Run_AsyEvlrCritEve_Step_Func_Run_AsyEvlrCritEve_Step_Func_TAWrapper_LongitudinalThreatAssessor_ThreatAssessorForWarn_ThreatAssessor_RequiredLongitudinalAccelerationForIntv_PredictHostPositionAtTime autosar_swc_aeb_autosar_swc_aeb_Step_sys_Subsystem_Reference_AEB_Function_Run_AsyEvlrCritEve_Step_Func_Run_AsyEvlrCritEve_Step_Func_TAWrapper_LongitudinalThreatAssessor_ThreatAssessorForWarn_ThreatAssessor_RequiredLongitudinalAccelerationForIntv_PredictObject autosar_swc_aeb_autosar_swc_aeb_Step_sys_Subsystem_Reference_AEB_Function_Run_AsyEvlrCritEve_Step_Func_Run_AsyEvlrCritEve_Step_Func_TAWrapper_LongitudinalThreatAssessor_ThreatAssessorForWarn_ThreatAssessor_RequiredLongitudinalAccelerationForIntv_RequiredLongitudinalAccelerationCalculator autosar_swc_aeb_autosar_swc_aeb_Step_sys_Subsystem_Reference_AEB_Function_Run_AsyEvlrCritEve_Step_Func_Run_AsyEvlrCritEve_Step_Func_TAWrapper_LongitudinalThreatAssessor_ThreatAssessorForWarn_ThreatAssessor_RequiredLongitudinalAccelerationForIntv_TranslateAndRotateCoordSys /end SUB_GROUP
 /begin REF_MEASUREMENT autosar_swc_aeb_rtARID_DEF.ALgtRqrd /end REF_MEASUREMENT
/end GROUP
/begin GROUP autosar_swc_aeb_autosar_swc_aeb_Step_sys_Subsystem_Reference_AEB_Function_Run_AsyEvlrCritEve_Step_Func_Run_AsyEvlrCritEve_Step_Func_TAWrapper_LongitudinalThreatAssessor_ThreatAssessorForWarn_ThreatAssessor_RequiredLongitudinalAccelerationForIntv_CheckPredictionValidity "autosar_swc_aeb/autosar_swc_aeb_Step_sys/Subsystem Reference/AEB Function/Run_AsyEvlrCritEve_Step_Func/Run_AsyEvlrCritEve_Step_Func/TAWrapper/LongitudinalThreatAssessor/ThreatAssessorForWarn/ThreatAssessor/RequiredLongitudinalAccelerationForIntv/CheckPredictionValidity"
 /begin SUB_GROUP autosar_swc_aeb_autosar_swc_aeb_Step_sys_Subsystem_Reference_AEB_Function_Run_AsyEvlrCritEve_Step_Func_Run_AsyEvlrCritEve_Step_Func_TAWrapper_LongitudinalThreatAssessor_ThreatAssessorForWarn_ThreatAssessor_RequiredLongitudinalAccelerationForIntv_CheckPredictionValidity_CheckConfidenceForHeading autosar_swc_aeb_autosar_swc_aeb_Step_sys_Subsystem_Reference_AEB_Function_Run_AsyEvlrCritEve_Step_Func_Run_AsyEvlrCritEve_Step_Func_TAWrapper_LongitudinalThreatAssessor_ThreatAssessorForWarn_ThreatAssessor_RequiredLongitudinalAccelerationForIntv_CheckPredictionValidity_CheckPredictionDistanceBelowThreshold autosar_swc_aeb_autosar_swc_aeb_Step_sys_Subsystem_Reference_AEB_Function_Run_AsyEvlrCritEve_Step_Func_Run_AsyEvlrCritEve_Step_Func_TAWrapper_LongitudinalThreatAssessor_ThreatAssessorForWarn_ThreatAssessor_RequiredLongitudinalAccelerationForIntv_CheckPredictionValidity_CheckPredictionTimeBelowThreshold autosar_swc_aeb_autosar_swc_aeb_Step_sys_Subsystem_Reference_AEB_Function_Run_AsyEvlrCritEve_Step_Func_Run_AsyEvlrCritEve_Step_Func_TAWrapper_LongitudinalThreatAssessor_ThreatAssessorForWarn_ThreatAssessor_RequiredLongitudinalAccelerationForIntv_CheckPredictionValidity_CheckSpeedAboveThreshold /end SUB_GROUP
/end GROUP
/begin GROUP autosar_swc_aeb_autosar_swc_aeb_Step_sys_Subsystem_Reference_AEB_Function_Run_AsyEvlrCritEve_Step_Func_Run_AsyEvlrCritEve_Step_Func_TAWrapper_LongitudinalThreatAssessor_ThreatAssessorForWarn_ThreatAssessor_RequiredLongitudinalAccelerationForIntv_PredictHostPositionAtTime "autosar_swc_aeb/autosar_swc_aeb_Step_sys/Subsystem Reference/AEB Function/Run_AsyEvlrCritEve_Step_Func/Run_AsyEvlrCritEve_Step_Func/TAWrapper/LongitudinalThreatAssessor/ThreatAssessorForWarn/ThreatAssessor/RequiredLongitudinalAccelerationForIntv/PredictHostPositionAtTime"
 /begin SUB_GROUP autosar_swc_aeb_autosar_swc_aeb_Step_sys_Subsystem_Reference_AEB_Function_Run_AsyEvlrCritEve_Step_Func_Run_AsyEvlrCritEve_Step_Func_TAWrapper_LongitudinalThreatAssessor_ThreatAssessorForWarn_ThreatAssessor_RequiredLongitudinalAccelerationForIntv_PredictHostPositionAtTime_CalculateHeading autosar_swc_aeb_autosar_swc_aeb_Step_sys_Subsystem_Reference_AEB_Function_Run_AsyEvlrCritEve_Step_Func_Run_AsyEvlrCritEve_Step_Func_TAWrapper_LongitudinalThreatAssessor_ThreatAssessorForWarn_ThreatAssessor_RequiredLongitudinalAccelerationForIntv_PredictHostPositionAtTime_SelectSegment /end SUB_GROUP
/end GROUP
/begin GROUP autosar_swc_aeb_autosar_swc_aeb_Step_sys_Subsystem_Reference_AEB_Function_Run_AsyEvlrCritEve_Step_Func_Run_AsyEvlrCritEve_Step_Func_TAWrapper_LongitudinalThreatAssessor_ThreatAssessorForWarn_ThreatAssessor_RequiredLongitudinalAccelerationForIntv_PredictHostPositionAtTime_CalculateHeading "autosar_swc_aeb/autosar_swc_aeb_Step_sys/Subsystem Reference/AEB Function/Run_AsyEvlrCritEve_Step_Func/Run_AsyEvlrCritEve_Step_Func/TAWrapper/LongitudinalThreatAssessor/ThreatAssessorForWarn/ThreatAssessor/RequiredLongitudinalAccelerationForIntv/PredictHostPositionAtTime/CalculateHeading"
 /begin SUB_GROUP autosar_swc_aeb_autosar_swc_aeb_Step_sys_Subsystem_Reference_AEB_Function_Run_AsyEvlrCritEve_Step_Func_Run_AsyEvlrCritEve_Step_Func_TAWrapper_LongitudinalThreatAssessor_ThreatAssessorForWarn_ThreatAssessor_RequiredLongitudinalAccelerationForIntv_PredictHostPositionAtTime_CalculateHeading_CheckSpeed autosar_swc_aeb_autosar_swc_aeb_Step_sys_Subsystem_Reference_AEB_Function_Run_AsyEvlrCritEve_Step_Func_Run_AsyEvlrCritEve_Step_Func_TAWrapper_LongitudinalThreatAssessor_ThreatAssessorForWarn_ThreatAssessor_RequiredLongitudinalAccelerationForIntv_PredictHostPositionAtTime_CalculateHeading_ExtractVelocitiesAtStartOfSegments /end SUB_GROUP
/end GROUP
/begin GROUP autosar_swc_aeb_autosar_swc_aeb_Step_sys_Subsystem_Reference_AEB_Function_Run_AsyEvlrCritEve_Step_Func_Run_AsyEvlrCritEve_Step_Func_TAWrapper_LongitudinalThreatAssessor_ThreatAssessorForWarn_ThreatAssessor_RequiredLongitudinalAccelerationForIntv_PredictHostPositionAtTime_CalculateHeading_ExtractVelocitiesAtStartOfSegments "autosar_swc_aeb/autosar_swc_aeb_Step_sys/Subsystem Reference/AEB Function/Run_AsyEvlrCritEve_Step_Func/Run_AsyEvlrCritEve_Step_Func/TAWrapper/LongitudinalThreatAssessor/ThreatAssessorForWarn/ThreatAssessor/RequiredLongitudinalAccelerationForIntv/PredictHostPositionAtTime/CalculateHeading/ExtractVelocitiesAtStartOfSegments"
 /begin SUB_GROUP autosar_swc_aeb_autosar_swc_aeb_Step_sys_Subsystem_Reference_AEB_Function_Run_AsyEvlrCritEve_Step_Func_Run_AsyEvlrCritEve_Step_Func_TAWrapper_LongitudinalThreatAssessor_ThreatAssessorForWarn_ThreatAssessor_RequiredLongitudinalAccelerationForIntv_PredictHostPositionAtTime_CalculateHeading_ExtractVelocitiesAtStartOfSegments_CheckSpeed /end SUB_GROUP
/end GROUP
/begin GROUP autosar_swc_aeb_autosar_swc_aeb_Step_sys_Subsystem_Reference_AEB_Function_Run_AsyEvlrCritEve_Step_Func_Run_AsyEvlrCritEve_Step_Func_TAWrapper_LongitudinalThreatAssessor_ThreatAssessorForWarn_ThreatAssessor_RequiredLongitudinalAccelerationForIntv_PredictHostPositionAtTime_SelectSegment "autosar_swc_aeb/autosar_swc_aeb_Step_sys/Subsystem Reference/AEB Function/Run_AsyEvlrCritEve_Step_Func/Run_AsyEvlrCritEve_Step_Func/TAWrapper/LongitudinalThreatAssessor/ThreatAssessorForWarn/ThreatAssessor/RequiredLongitudinalAccelerationForIntv/PredictHostPositionAtTime/SelectSegment" /begin REF_MEASUREMENT autosar_swc_aeb_rtARID_DEF.LastSegment_i /end REF_MEASUREMENT /end GROUP
/begin GROUP autosar_swc_aeb_autosar_swc_aeb_Step_sys_Subsystem_Reference_AEB_Function_Run_AsyEvlrCritEve_Step_Func_Run_AsyEvlrCritEve_Step_Func_TAWrapper_LongitudinalThreatAssessor_ThreatAssessorForWarn_ThreatAssessor_RequiredLongitudinalAccelerationForIntv_PredictObject "autosar_swc_aeb/autosar_swc_aeb_Step_sys/Subsystem Reference/AEB Function/Run_AsyEvlrCritEve_Step_Func/Run_AsyEvlrCritEve_Step_Func/TAWrapper/LongitudinalThreatAssessor/ThreatAssessorForWarn/ThreatAssessor/RequiredLongitudinalAccelerationForIntv/PredictObject"
 /begin SUB_GROUP autosar_swc_aeb_autosar_swc_aeb_Step_sys_Subsystem_Reference_AEB_Function_Run_AsyEvlrCritEve_Step_Func_Run_AsyEvlrCritEve_Step_Func_TAWrapper_LongitudinalThreatAssessor_ThreatAssessorForWarn_ThreatAssessor_RequiredLongitudinalAccelerationForIntv_PredictObject_CircularPrediction autosar_swc_aeb_autosar_swc_aeb_Step_sys_Subsystem_Reference_AEB_Function_Run_AsyEvlrCritEve_Step_Func_Run_AsyEvlrCritEve_Step_Func_TAWrapper_LongitudinalThreatAssessor_ThreatAssessorForWarn_ThreatAssessor_RequiredLongitudinalAccelerationForIntv_PredictObject_LinearPrediction /end SUB_GROUP
/end GROUP
/begin GROUP autosar_swc_aeb_autosar_swc_aeb_Step_sys_Subsystem_Reference_AEB_Function_Run_AsyEvlrCritEve_Step_Func_Run_AsyEvlrCritEve_Step_Func_TAWrapper_LongitudinalThreatAssessor_ThreatAssessorForWarn_ThreatAssessor_RequiredLongitudinalAccelerationForIntv_PredictObject_CircularPrediction "autosar_swc_aeb/autosar_swc_aeb_Step_sys/Subsystem Reference/AEB Function/Run_AsyEvlrCritEve_Step_Func/Run_AsyEvlrCritEve_Step_Func/TAWrapper/LongitudinalThreatAssessor/ThreatAssessorForWarn/ThreatAssessor/RequiredLongitudinalAccelerationForIntv/PredictObject/CircularPrediction"
 /begin SUB_GROUP autosar_swc_aeb_autosar_swc_aeb_Step_sys_Subsystem_Reference_AEB_Function_Run_AsyEvlrCritEve_Step_Func_Run_AsyEvlrCritEve_Step_Func_TAWrapper_LongitudinalThreatAssessor_ThreatAssessorForWarn_ThreatAssessor_RequiredLongitudinalAccelerationForIntv_PredictObject_CircularPrediction_PredictedCartesianMovement autosar_swc_aeb_autosar_swc_aeb_Step_sys_Subsystem_Reference_AEB_Function_Run_AsyEvlrCritEve_Step_Func_Run_AsyEvlrCritEve_Step_Func_TAWrapper_LongitudinalThreatAssessor_ThreatAssessorForWarn_ThreatAssessor_RequiredLongitudinalAccelerationForIntv_PredictObject_CircularPrediction_PredictedPositionAtTimeHeadingAngleAndCurvatureBased /end SUB_GROUP
/end GROUP
/begin GROUP autosar_swc_aeb_autosar_swc_aeb_Step_sys_Subsystem_Reference_AEB_Function_Run_AsyEvlrCritEve_Step_Func_Run_AsyEvlrCritEve_Step_Func_TAWrapper_LongitudinalThreatAssessor_ThreatAssessorForWarn_ThreatAssessor_RequiredLongitudinalAccelerationForIntv_PredictObject_CircularPrediction_PredictedCartesianMovement "autosar_swc_aeb/autosar_swc_aeb_Step_sys/Subsystem Reference/AEB Function/Run_AsyEvlrCritEve_Step_Func/Run_AsyEvlrCritEve_Step_Func/TAWrapper/LongitudinalThreatAssessor/ThreatAssessorForWarn/ThreatAssessor/RequiredLongitudinalAccelerationForIntv/PredictObject/CircularPrediction/PredictedCartesianMovement"
 /begin SUB_GROUP autosar_swc_aeb_autosar_swc_aeb_Step_sys_Subsystem_Reference_AEB_Function_Run_AsyEvlrCritEve_Step_Func_Run_AsyEvlrCritEve_Step_Func_TAWrapper_LongitudinalThreatAssessor_ThreatAssessorForWarn_ThreatAssessor_RequiredLongitudinalAccelerationForIntv_PredictObject_CircularPrediction_PredictedCartesianMovement_ComputeCartesianMovement /end SUB_GROUP
/end GROUP
/begin GROUP autosar_swc_aeb_autosar_swc_aeb_Step_sys_Subsystem_Reference_AEB_Function_Run_AsyEvlrCritEve_Step_Func_Run_AsyEvlrCritEve_Step_Func_TAWrapper_LongitudinalThreatAssessor_ThreatAssessorForWarn_ThreatAssessor_RequiredLongitudinalAccelerationForIntv_PredictObject_CircularPrediction_PredictedCartesianMovement_ComputeCartesianMovement "autosar_swc_aeb/autosar_swc_aeb_Step_sys/Subsystem Reference/AEB Function/Run_AsyEvlrCritEve_Step_Func/Run_AsyEvlrCritEve_Step_Func/TAWrapper/LongitudinalThreatAssessor/ThreatAssessorForWarn/ThreatAssessor/RequiredLongitudinalAccelerationForIntv/PredictObject/CircularPrediction/PredictedCartesianMovement/ComputeCartesianMovement"
 /begin REF_MEASUREMENT autosar_swc_aeb_rtARID_DEF.PredALatObj autosar_swc_aeb_rtARID_DEF.PredALgtObj autosar_swc_aeb_rtARID_DEF.PredVLatObj autosar_swc_aeb_rtARID_DEF.PredVLgtObj /end REF_MEASUREMENT
/end GROUP
/begin GROUP autosar_swc_aeb_autosar_swc_aeb_Step_sys_Subsystem_Reference_AEB_Function_Run_AsyEvlrCritEve_Step_Func_Run_AsyEvlrCritEve_Step_Func_TAWrapper_LongitudinalThreatAssessor_ThreatAssessorForWarn_ThreatAssessor_RequiredLongitudinalAccelerationForIntv_PredictObject_CircularPrediction_PredictedPositionAtTimeHeadingAngleAndCurvatureBased "autosar_swc_aeb/autosar_swc_aeb_Step_sys/Subsystem Reference/AEB Function/Run_AsyEvlrCritEve_Step_Func/Run_AsyEvlrCritEve_Step_Func/TAWrapper/LongitudinalThreatAssessor/ThreatAssessorForWarn/ThreatAssessor/RequiredLongitudinalAccelerationForIntv/PredictObject/CircularPrediction/PredictedPositionAtTimeHeadingAngleAndCurvatureBased"
 /begin REF_MEASUREMENT autosar_swc_aeb_rtARID_DEF.PredPosnLat autosar_swc_aeb_rtARID_DEF.PredPosnLgt /end REF_MEASUREMENT
/end GROUP
/begin GROUP autosar_swc_aeb_autosar_swc_aeb_Step_sys_Subsystem_Reference_AEB_Function_Run_AsyEvlrCritEve_Step_Func_Run_AsyEvlrCritEve_Step_Func_TAWrapper_LongitudinalThreatAssessor_ThreatAssessorForWarn_ThreatAssessor_RequiredLongitudinalAccelerationForIntv_PredictObject_LinearPrediction "autosar_swc_aeb/autosar_swc_aeb_Step_sys/Subsystem Reference/AEB Function/Run_AsyEvlrCritEve_Step_Func/Run_AsyEvlrCritEve_Step_Func/TAWrapper/LongitudinalThreatAssessor/ThreatAssessorForWarn/ThreatAssessor/RequiredLongitudinalAccelerationForIntv/PredictObject/LinearPrediction"
 /begin SUB_GROUP autosar_swc_aeb_autosar_swc_aeb_Step_sys_Subsystem_Reference_AEB_Function_Run_AsyEvlrCritEve_Step_Func_Run_AsyEvlrCritEve_Step_Func_TAWrapper_LongitudinalThreatAssessor_ThreatAssessorForWarn_ThreatAssessor_RequiredLongitudinalAccelerationForIntv_PredictObject_LinearPrediction_LinearMovementPredictorWithStopObjLongitudinal autosar_swc_aeb_autosar_swc_aeb_Step_sys_Subsystem_Reference_AEB_Function_Run_AsyEvlrCritEve_Step_Func_Run_AsyEvlrCritEve_Step_Func_TAWrapper_LongitudinalThreatAssessor_ThreatAssessorForWarn_ThreatAssessor_RequiredLongitudinalAccelerationForIntv_PredictObject_LinearPrediction_LinearPredictorLateralMovement autosar_swc_aeb_autosar_swc_aeb_Step_sys_Subsystem_Reference_AEB_Function_Run_AsyEvlrCritEve_Step_Func_Run_AsyEvlrCritEve_Step_Func_TAWrapper_LongitudinalThreatAssessor_ThreatAssessorForWarn_ThreatAssessor_RequiredLongitudinalAccelerationForIntv_PredictObject_LinearPrediction_NoOperation autosar_swc_aeb_autosar_swc_aeb_Step_sys_Subsystem_Reference_AEB_Function_Run_AsyEvlrCritEve_Step_Func_Run_AsyEvlrCritEve_Step_Func_TAWrapper_LongitudinalThreatAssessor_ThreatAssessorForWarn_ThreatAssessor_RequiredLongitudinalAccelerationForIntv_PredictObject_LinearPrediction_NoOperation1 autosar_swc_aeb_autosar_swc_aeb_Step_sys_Subsystem_Reference_AEB_Function_Run_AsyEvlrCritEve_Step_Func_Run_AsyEvlrCritEve_Step_Func_TAWrapper_LongitudinalThreatAssessor_ThreatAssessorForWarn_ThreatAssessor_RequiredLongitudinalAccelerationForIntv_PredictObject_LinearPrediction_NoOperation2 /end SUB_GROUP
/end GROUP
/begin GROUP autosar_swc_aeb_autosar_swc_aeb_Step_sys_Subsystem_Reference_AEB_Function_Run_AsyEvlrCritEve_Step_Func_Run_AsyEvlrCritEve_Step_Func_TAWrapper_LongitudinalThreatAssessor_ThreatAssessorForWarn_ThreatAssessor_RequiredLongitudinalAccelerationForIntv_PredictObject_LinearPrediction_LinearMovementPredictorWithStopObjLongitudinal "autosar_swc_aeb/autosar_swc_aeb_Step_sys/Subsystem Reference/AEB Function/Run_AsyEvlrCritEve_Step_Func/Run_AsyEvlrCritEve_Step_Func/TAWrapper/LongitudinalThreatAssessor/ThreatAssessorForWarn/ThreatAssessor/RequiredLongitudinalAccelerationForIntv/PredictObject/LinearPrediction/LinearMovementPredictorWithStopObjLongitudinal"
 /begin SUB_GROUP autosar_swc_aeb_autosar_swc_aeb_Step_sys_Subsystem_Reference_AEB_Function_Run_AsyEvlrCritEve_Step_Func_Run_AsyEvlrCritEve_Step_Func_TAWrapper_LongitudinalThreatAssessor_ThreatAssessorForWarn_ThreatAssessor_RequiredLongitudinalAccelerationForIntv_PredictObject_LinearPrediction_LinearMovementPredictorWithStopObjLongitudinal_LinearMovementPredictor /end SUB_GROUP
 /begin REF_MEASUREMENT autosar_swc_aeb_rtARID_DEF.PredALgtObj /end REF_MEASUREMENT
/end GROUP
/begin GROUP autosar_swc_aeb_autosar_swc_aeb_Step_sys_Subsystem_Reference_AEB_Function_Run_AsyEvlrCritEve_Step_Func_Run_AsyEvlrCritEve_Step_Func_TAWrapper_LongitudinalThreatAssessor_ThreatAssessorForWarn_ThreatAssessor_RequiredLongitudinalAccelerationForIntv_PredictObject_LinearPrediction_LinearMovementPredictorWithStopObjLongitudinal_LinearMovementPredictor "autosar_swc_aeb/autosar_swc_aeb_Step_sys/Subsystem Reference/AEB Function/Run_AsyEvlrCritEve_Step_Func/Run_AsyEvlrCritEve_Step_Func/TAWrapper/LongitudinalThreatAssessor/ThreatAssessorForWarn/ThreatAssessor/RequiredLongitudinalAccelerationForIntv/PredictObject/LinearPrediction/LinearMovementPredictorWithStopObjLongitudinal/LinearMovementPredictor" /begin REF_MEASUREMENT autosar_swc_aeb_rtARID_DEF.PredPosnLgt /end REF_MEASUREMENT /end GROUP
/begin GROUP autosar_swc_aeb_autosar_swc_aeb_Step_sys_Subsystem_Reference_AEB_Function_Run_AsyEvlrCritEve_Step_Func_Run_AsyEvlrCritEve_Step_Func_TAWrapper_LongitudinalThreatAssessor_ThreatAssessorForWarn_ThreatAssessor_RequiredLongitudinalAccelerationForIntv_PredictObject_LinearPrediction_LinearPredictorLateralMovement "autosar_swc_aeb/autosar_swc_aeb_Step_sys/Subsystem Reference/AEB Function/Run_AsyEvlrCritEve_Step_Func/Run_AsyEvlrCritEve_Step_Func/TAWrapper/LongitudinalThreatAssessor/ThreatAssessorForWarn/ThreatAssessor/RequiredLongitudinalAccelerationForIntv/PredictObject/LinearPrediction/LinearPredictorLateralMovement" /begin REF_MEASUREMENT autosar_swc_aeb_rtARID_DEF.PredPosnLat /end REF_MEASUREMENT /end GROUP
/begin GROUP autosar_swc_aeb_autosar_swc_aeb_Step_sys_Subsystem_Reference_AEB_Function_Run_AsyEvlrCritEve_Step_Func_Run_AsyEvlrCritEve_Step_Func_TAWrapper_LongitudinalThreatAssessor_ThreatAssessorForWarn_ThreatAssessor_RequiredLongitudinalAccelerationForIntv_PredictObject_LinearPrediction_NoOperation "autosar_swc_aeb/autosar_swc_aeb_Step_sys/Subsystem Reference/AEB Function/Run_AsyEvlrCritEve_Step_Func/Run_AsyEvlrCritEve_Step_Func/TAWrapper/LongitudinalThreatAssessor/ThreatAssessorForWarn/ThreatAssessor/RequiredLongitudinalAccelerationForIntv/PredictObject/LinearPrediction/NoOperation" /begin REF_MEASUREMENT autosar_swc_aeb_rtARID_DEF.PredVLgtObj /end REF_MEASUREMENT /end GROUP
/begin GROUP autosar_swc_aeb_autosar_swc_aeb_Step_sys_Subsystem_Reference_AEB_Function_Run_AsyEvlrCritEve_Step_Func_Run_AsyEvlrCritEve_Step_Func_TAWrapper_LongitudinalThreatAssessor_ThreatAssessorForWarn_ThreatAssessor_RequiredLongitudinalAccelerationForIntv_PredictObject_LinearPrediction_NoOperation1 "autosar_swc_aeb/autosar_swc_aeb_Step_sys/Subsystem Reference/AEB Function/Run_AsyEvlrCritEve_Step_Func/Run_AsyEvlrCritEve_Step_Func/TAWrapper/LongitudinalThreatAssessor/ThreatAssessorForWarn/ThreatAssessor/RequiredLongitudinalAccelerationForIntv/PredictObject/LinearPrediction/NoOperation1" /begin REF_MEASUREMENT autosar_swc_aeb_rtARID_DEF.PredVLatObj /end REF_MEASUREMENT /end GROUP
/begin GROUP autosar_swc_aeb_autosar_swc_aeb_Step_sys_Subsystem_Reference_AEB_Function_Run_AsyEvlrCritEve_Step_Func_Run_AsyEvlrCritEve_Step_Func_TAWrapper_LongitudinalThreatAssessor_ThreatAssessorForWarn_ThreatAssessor_RequiredLongitudinalAccelerationForIntv_PredictObject_LinearPrediction_NoOperation2 "autosar_swc_aeb/autosar_swc_aeb_Step_sys/Subsystem Reference/AEB Function/Run_AsyEvlrCritEve_Step_Func/Run_AsyEvlrCritEve_Step_Func/TAWrapper/LongitudinalThreatAssessor/ThreatAssessorForWarn/ThreatAssessor/RequiredLongitudinalAccelerationForIntv/PredictObject/LinearPrediction/NoOperation2" /begin REF_MEASUREMENT autosar_swc_aeb_rtARID_DEF.PredALatObj /end REF_MEASUREMENT /end GROUP
/begin GROUP autosar_swc_aeb_autosar_swc_aeb_Step_sys_Subsystem_Reference_AEB_Function_Run_AsyEvlrCritEve_Step_Func_Run_AsyEvlrCritEve_Step_Func_TAWrapper_LongitudinalThreatAssessor_ThreatAssessorForWarn_ThreatAssessor_RequiredLongitudinalAccelerationForIntv_RequiredLongitudinalAccelerationCalculator "autosar_swc_aeb/autosar_swc_aeb_Step_sys/Subsystem Reference/AEB Function/Run_AsyEvlrCritEve_Step_Func/Run_AsyEvlrCritEve_Step_Func/TAWrapper/LongitudinalThreatAssessor/ThreatAssessorForWarn/ThreatAssessor/RequiredLongitudinalAccelerationForIntv/RequiredLongitudinalAccelerationCalculator"
 /begin SUB_GROUP autosar_swc_aeb_autosar_swc_aeb_Step_sys_Subsystem_Reference_AEB_Function_Run_AsyEvlrCritEve_Step_Func_Run_AsyEvlrCritEve_Step_Func_TAWrapper_LongitudinalThreatAssessor_ThreatAssessorForWarn_ThreatAssessor_RequiredLongitudinalAccelerationForIntv_RequiredLongitudinalAccelerationCalculator_CalculateLateralTTRandTTP autosar_swc_aeb_autosar_swc_aeb_Step_sys_Subsystem_Reference_AEB_Function_Run_AsyEvlrCritEve_Step_Func_Run_AsyEvlrCritEve_Step_Func_TAWrapper_LongitudinalThreatAssessor_ThreatAssessorForWarn_ThreatAssessor_RequiredLongitudinalAccelerationForIntv_RequiredLongitudinalAccelerationCalculator_CalculateRequiredAcceleration /end SUB_GROUP
/end GROUP
/begin GROUP autosar_swc_aeb_autosar_swc_aeb_Step_sys_Subsystem_Reference_AEB_Function_Run_AsyEvlrCritEve_Step_Func_Run_AsyEvlrCritEve_Step_Func_TAWrapper_LongitudinalThreatAssessor_ThreatAssessorForWarn_ThreatAssessor_RequiredLongitudinalAccelerationForIntv_RequiredLongitudinalAccelerationCalculator_CalculateLateralTTRandTTP "autosar_swc_aeb/autosar_swc_aeb_Step_sys/Subsystem Reference/AEB Function/Run_AsyEvlrCritEve_Step_Func/Run_AsyEvlrCritEve_Step_Func/TAWrapper/LongitudinalThreatAssessor/ThreatAssessorForWarn/ThreatAssessor/RequiredLongitudinalAccelerationForIntv/RequiredLongitudinalAccelerationCalculator/CalculateLateralTTRandTTP"
 /begin SUB_GROUP autosar_swc_aeb_autosar_swc_aeb_Step_sys_Subsystem_Reference_AEB_Function_Run_AsyEvlrCritEve_Step_Func_Run_AsyEvlrCritEve_Step_Func_TAWrapper_LongitudinalThreatAssessor_ThreatAssessorForWarn_ThreatAssessor_RequiredLongitudinalAccelerationForIntv_RequiredLongitudinalAccelerationCalculator_CalculateLateralTTRandTTP_LateralTTPComputer autosar_swc_aeb_autosar_swc_aeb_Step_sys_Subsystem_Reference_AEB_Function_Run_AsyEvlrCritEve_Step_Func_Run_AsyEvlrCritEve_Step_Func_TAWrapper_LongitudinalThreatAssessor_ThreatAssessorForWarn_ThreatAssessor_RequiredLongitudinalAccelerationForIntv_RequiredLongitudinalAccelerationCalculator_CalculateLateralTTRandTTP_LateralTTRComputer autosar_swc_aeb_autosar_swc_aeb_Step_sys_Subsystem_Reference_AEB_Function_Run_AsyEvlrCritEve_Step_Func_Run_AsyEvlrCritEve_Step_Func_TAWrapper_LongitudinalThreatAssessor_ThreatAssessorForWarn_ThreatAssessor_RequiredLongitudinalAccelerationForIntv_RequiredLongitudinalAccelerationCalculator_CalculateLateralTTRandTTP_ModifyTTPAtSameSpeedAndAcceleration autosar_swc_aeb_autosar_swc_aeb_Step_sys_Subsystem_Reference_AEB_Function_Run_AsyEvlrCritEve_Step_Func_Run_AsyEvlrCritEve_Step_Func_TAWrapper_LongitudinalThreatAssessor_ThreatAssessorForWarn_ThreatAssessor_RequiredLongitudinalAccelerationForIntv_RequiredLongitudinalAccelerationCalculator_CalculateLateralTTRandTTP_ModifyTTRAtSameSpeedAndAcceleration /end SUB_GROUP
/end GROUP
/begin GROUP autosar_swc_aeb_autosar_swc_aeb_Step_sys_Subsystem_Reference_AEB_Function_Run_AsyEvlrCritEve_Step_Func_Run_AsyEvlrCritEve_Step_Func_TAWrapper_LongitudinalThreatAssessor_ThreatAssessorForWarn_ThreatAssessor_RequiredLongitudinalAccelerationForIntv_RequiredLongitudinalAccelerationCalculator_CalculateLateralTTRandTTP_LateralTTPComputer "autosar_swc_aeb/autosar_swc_aeb_Step_sys/Subsystem Reference/AEB Function/Run_AsyEvlrCritEve_Step_Func/Run_AsyEvlrCritEve_Step_Func/TAWrapper/LongitudinalThreatAssessor/ThreatAssessorForWarn/ThreatAssessor/RequiredLongitudinalAccelerationForIntv/RequiredLongitudinalAccelerationCalculator/CalculateLateralTTRandTTP/LateralTTPComputer"
 /begin SUB_GROUP autosar_swc_aeb_autosar_swc_aeb_Step_sys_Subsystem_Reference_AEB_Function_Run_AsyEvlrCritEve_Step_Func_Run_AsyEvlrCritEve_Step_Func_TAWrapper_LongitudinalThreatAssessor_ThreatAssessorForWarn_ThreatAssessor_RequiredLongitudinalAccelerationForIntv_RequiredLongitudinalAccelerationCalculator_CalculateLateralTTRandTTP_LateralTTPComputer_LeftClosest autosar_swc_aeb_autosar_swc_aeb_Step_sys_Subsystem_Reference_AEB_Function_Run_AsyEvlrCritEve_Step_Func_Run_AsyEvlrCritEve_Step_Func_TAWrapper_LongitudinalThreatAssessor_ThreatAssessorForWarn_ThreatAssessor_RequiredLongitudinalAccelerationForIntv_RequiredLongitudinalAccelerationCalculator_CalculateLateralTTRandTTP_LateralTTPComputer_RightClosest /end SUB_GROUP
/end GROUP
/begin GROUP autosar_swc_aeb_autosar_swc_aeb_Step_sys_Subsystem_Reference_AEB_Function_Run_AsyEvlrCritEve_Step_Func_Run_AsyEvlrCritEve_Step_Func_TAWrapper_LongitudinalThreatAssessor_ThreatAssessorForWarn_ThreatAssessor_RequiredLongitudinalAccelerationForIntv_RequiredLongitudinalAccelerationCalculator_CalculateLateralTTRandTTP_LateralTTPComputer_LeftClosest "autosar_swc_aeb/autosar_swc_aeb_Step_sys/Subsystem Reference/AEB Function/Run_AsyEvlrCritEve_Step_Func/Run_AsyEvlrCritEve_Step_Func/TAWrapper/LongitudinalThreatAssessor/ThreatAssessorForWarn/ThreatAssessor/RequiredLongitudinalAccelerationForIntv/RequiredLongitudinalAccelerationCalculator/CalculateLateralTTRandTTP/LateralTTPComputer/LeftClosest"
 /begin SUB_GROUP autosar_swc_aeb_autosar_swc_aeb_Step_sys_Subsystem_Reference_AEB_Function_Run_AsyEvlrCritEve_Step_Func_Run_AsyEvlrCritEve_Step_Func_TAWrapper_LongitudinalThreatAssessor_ThreatAssessorForWarn_ThreatAssessor_RequiredLongitudinalAccelerationForIntv_RequiredLongitudinalAccelerationCalculator_CalculateLateralTTRandTTP_LateralTTPComputer_LeftClosest_TimeToIntersectionComputer /end SUB_GROUP
/end GROUP
/begin GROUP autosar_swc_aeb_autosar_swc_aeb_Step_sys_Subsystem_Reference_AEB_Function_Run_AsyEvlrCritEve_Step_Func_Run_AsyEvlrCritEve_Step_Func_TAWrapper_LongitudinalThreatAssessor_ThreatAssessorForWarn_ThreatAssessor_RequiredLongitudinalAccelerationForIntv_RequiredLongitudinalAccelerationCalculator_CalculateLateralTTRandTTP_LateralTTPComputer_RightClosest "autosar_swc_aeb/autosar_swc_aeb_Step_sys/Subsystem Reference/AEB Function/Run_AsyEvlrCritEve_Step_Func/Run_AsyEvlrCritEve_Step_Func/TAWrapper/LongitudinalThreatAssessor/ThreatAssessorForWarn/ThreatAssessor/RequiredLongitudinalAccelerationForIntv/RequiredLongitudinalAccelerationCalculator/CalculateLateralTTRandTTP/LateralTTPComputer/RightClosest"
 /begin SUB_GROUP autosar_swc_aeb_autosar_swc_aeb_Step_sys_Subsystem_Reference_AEB_Function_Run_AsyEvlrCritEve_Step_Func_Run_AsyEvlrCritEve_Step_Func_TAWrapper_LongitudinalThreatAssessor_ThreatAssessorForWarn_ThreatAssessor_RequiredLongitudinalAccelerationForIntv_RequiredLongitudinalAccelerationCalculator_CalculateLateralTTRandTTP_LateralTTPComputer_RightClosest_TimeToIntersectionComputer /end SUB_GROUP
/end GROUP
/begin GROUP autosar_swc_aeb_autosar_swc_aeb_Step_sys_Subsystem_Reference_AEB_Function_Run_AsyEvlrCritEve_Step_Func_Run_AsyEvlrCritEve_Step_Func_TAWrapper_LongitudinalThreatAssessor_ThreatAssessorForWarn_ThreatAssessor_RequiredLongitudinalAccelerationForIntv_RequiredLongitudinalAccelerationCalculator_CalculateLateralTTRandTTP_LateralTTRComputer "autosar_swc_aeb/autosar_swc_aeb_Step_sys/Subsystem Reference/AEB Function/Run_AsyEvlrCritEve_Step_Func/Run_AsyEvlrCritEve_Step_Func/TAWrapper/LongitudinalThreatAssessor/ThreatAssessorForWarn/ThreatAssessor/RequiredLongitudinalAccelerationForIntv/RequiredLongitudinalAccelerationCalculator/CalculateLateralTTRandTTP/LateralTTRComputer"
 /begin SUB_GROUP autosar_swc_aeb_autosar_swc_aeb_Step_sys_Subsystem_Reference_AEB_Function_Run_AsyEvlrCritEve_Step_Func_Run_AsyEvlrCritEve_Step_Func_TAWrapper_LongitudinalThreatAssessor_ThreatAssessorForWarn_ThreatAssessor_RequiredLongitudinalAccelerationForIntv_RequiredLongitudinalAccelerationCalculator_CalculateLateralTTRandTTP_LateralTTRComputer_LeftClosest autosar_swc_aeb_autosar_swc_aeb_Step_sys_Subsystem_Reference_AEB_Function_Run_AsyEvlrCritEve_Step_Func_Run_AsyEvlrCritEve_Step_Func_TAWrapper_LongitudinalThreatAssessor_ThreatAssessorForWarn_ThreatAssessor_RequiredLongitudinalAccelerationForIntv_RequiredLongitudinalAccelerationCalculator_CalculateLateralTTRandTTP_LateralTTRComputer_RightClosest /end SUB_GROUP
/end GROUP
/begin GROUP autosar_swc_aeb_autosar_swc_aeb_Step_sys_Subsystem_Reference_AEB_Function_Run_AsyEvlrCritEve_Step_Func_Run_AsyEvlrCritEve_Step_Func_TAWrapper_LongitudinalThreatAssessor_ThreatAssessorForWarn_ThreatAssessor_RequiredLongitudinalAccelerationForIntv_RequiredLongitudinalAccelerationCalculator_CalculateLateralTTRandTTP_LateralTTRComputer_LeftClosest "autosar_swc_aeb/autosar_swc_aeb_Step_sys/Subsystem Reference/AEB Function/Run_AsyEvlrCritEve_Step_Func/Run_AsyEvlrCritEve_Step_Func/TAWrapper/LongitudinalThreatAssessor/ThreatAssessorForWarn/ThreatAssessor/RequiredLongitudinalAccelerationForIntv/RequiredLongitudinalAccelerationCalculator/CalculateLateralTTRandTTP/LateralTTRComputer/LeftClosest"
 /begin SUB_GROUP autosar_swc_aeb_autosar_swc_aeb_Step_sys_Subsystem_Reference_AEB_Function_Run_AsyEvlrCritEve_Step_Func_Run_AsyEvlrCritEve_Step_Func_TAWrapper_LongitudinalThreatAssessor_ThreatAssessorForWarn_ThreatAssessor_RequiredLongitudinalAccelerationForIntv_RequiredLongitudinalAccelerationCalculator_CalculateLateralTTRandTTP_LateralTTRComputer_LeftClosest_TimeToIntersectionComputer /end SUB_GROUP
/end GROUP
/begin GROUP autosar_swc_aeb_autosar_swc_aeb_Step_sys_Subsystem_Reference_AEB_Function_Run_AsyEvlrCritEve_Step_Func_Run_AsyEvlrCritEve_Step_Func_TAWrapper_LongitudinalThreatAssessor_ThreatAssessorForWarn_ThreatAssessor_RequiredLongitudinalAccelerationForIntv_RequiredLongitudinalAccelerationCalculator_CalculateLateralTTRandTTP_LateralTTRComputer_RightClosest "autosar_swc_aeb/autosar_swc_aeb_Step_sys/Subsystem Reference/AEB Function/Run_AsyEvlrCritEve_Step_Func/Run_AsyEvlrCritEve_Step_Func/TAWrapper/LongitudinalThreatAssessor/ThreatAssessorForWarn/ThreatAssessor/RequiredLongitudinalAccelerationForIntv/RequiredLongitudinalAccelerationCalculator/CalculateLateralTTRandTTP/LateralTTRComputer/RightClosest"
 /begin SUB_GROUP autosar_swc_aeb_autosar_swc_aeb_Step_sys_Subsystem_Reference_AEB_Function_Run_AsyEvlrCritEve_Step_Func_Run_AsyEvlrCritEve_Step_Func_TAWrapper_LongitudinalThreatAssessor_ThreatAssessorForWarn_ThreatAssessor_RequiredLongitudinalAccelerationForIntv_RequiredLongitudinalAccelerationCalculator_CalculateLateralTTRandTTP_LateralTTRComputer_RightClosest_TimeToIntersectionComputer /end SUB_GROUP
/end GROUP
/begin GROUP autosar_swc_aeb_autosar_swc_aeb_Step_sys_Subsystem_Reference_AEB_Function_Run_AsyEvlrCritEve_Step_Func_Run_AsyEvlrCritEve_Step_Func_TAWrapper_LongitudinalThreatAssessor_ThreatAssessorForWarn_ThreatAssessor_RequiredLongitudinalAccelerationForIntv_RequiredLongitudinalAccelerationCalculator_CalculateRequiredAcceleration "autosar_swc_aeb/autosar_swc_aeb_Step_sys/Subsystem Reference/AEB Function/Run_AsyEvlrCritEve_Step_Func/Run_AsyEvlrCritEve_Step_Func/TAWrapper/LongitudinalThreatAssessor/ThreatAssessorForWarn/ThreatAssessor/RequiredLongitudinalAccelerationForIntv/RequiredLongitudinalAccelerationCalculator/CalculateRequiredAcceleration"
 /begin SUB_GROUP autosar_swc_aeb_autosar_swc_aeb_Step_sys_Subsystem_Reference_AEB_Function_Run_AsyEvlrCritEve_Step_Func_Run_AsyEvlrCritEve_Step_Func_TAWrapper_LongitudinalThreatAssessor_ThreatAssessorForWarn_ThreatAssessor_RequiredLongitudinalAccelerationForIntv_RequiredLongitudinalAccelerationCalculator_CalculateRequiredAcceleration_AlgorithmChooser autosar_swc_aeb_autosar_swc_aeb_Step_sys_Subsystem_Reference_AEB_Function_Run_AsyEvlrCritEve_Step_Func_Run_AsyEvlrCritEve_Step_Func_TAWrapper_LongitudinalThreatAssessor_ThreatAssessorForWarn_ThreatAssessor_RequiredLongitudinalAccelerationForIntv_RequiredLongitudinalAccelerationCalculator_CalculateRequiredAcceleration_RequiredAccelerationForInPathObject /end SUB_GROUP
/end GROUP
/begin GROUP autosar_swc_aeb_autosar_swc_aeb_Step_sys_Subsystem_Reference_AEB_Function_Run_AsyEvlrCritEve_Step_Func_Run_AsyEvlrCritEve_Step_Func_TAWrapper_LongitudinalThreatAssessor_ThreatAssessorForWarn_ThreatAssessor_RequiredLongitudinalAccelerationForIntv_RequiredLongitudinalAccelerationCalculator_CalculateRequiredAcceleration_AlgorithmChooser "autosar_swc_aeb/autosar_swc_aeb_Step_sys/Subsystem Reference/AEB Function/Run_AsyEvlrCritEve_Step_Func/Run_AsyEvlrCritEve_Step_Func/TAWrapper/LongitudinalThreatAssessor/ThreatAssessorForWarn/ThreatAssessor/RequiredLongitudinalAccelerationForIntv/RequiredLongitudinalAccelerationCalculator/CalculateRequiredAcceleration/AlgorithmChooser"
 /begin SUB_GROUP autosar_swc_aeb_autosar_swc_aeb_Step_sys_Subsystem_Reference_AEB_Function_Run_AsyEvlrCritEve_Step_Func_Run_AsyEvlrCritEve_Step_Func_TAWrapper_LongitudinalThreatAssessor_ThreatAssessorForWarn_ThreatAssessor_RequiredLongitudinalAccelerationForIntv_RequiredLongitudinalAccelerationCalculator_CalculateRequiredAcceleration_AlgorithmChooser_CheckIfObjectWillEnterPath /end SUB_GROUP
 /begin REF_MEASUREMENT autosar_swc_aeb_rtARID_DEF.ALgtRqrd /end REF_MEASUREMENT
/end GROUP
/begin GROUP autosar_swc_aeb_autosar_swc_aeb_Step_sys_Subsystem_Reference_AEB_Function_Run_AsyEvlrCritEve_Step_Func_Run_AsyEvlrCritEve_Step_Func_TAWrapper_LongitudinalThreatAssessor_ThreatAssessorForWarn_ThreatAssessor_RequiredLongitudinalAccelerationForIntv_RequiredLongitudinalAccelerationCalculator_CalculateRequiredAcceleration_RequiredAccelerationForInPathObject "autosar_swc_aeb/autosar_swc_aeb_Step_sys/Subsystem Reference/AEB Function/Run_AsyEvlrCritEve_Step_Func/Run_AsyEvlrCritEve_Step_Func/TAWrapper/LongitudinalThreatAssessor/ThreatAssessorForWarn/ThreatAssessor/RequiredLongitudinalAccelerationForIntv/RequiredLongitudinalAccelerationCalculator/CalculateRequiredAcceleration/RequiredAccelerationForInPathObject"
 /begin SUB_GROUP autosar_swc_aeb_autosar_swc_aeb_Step_sys_Subsystem_Reference_AEB_Function_Run_AsyEvlrCritEve_Step_Func_Run_AsyEvlrCritEve_Step_Func_TAWrapper_LongitudinalThreatAssessor_ThreatAssessorForWarn_ThreatAssessor_RequiredLongitudinalAccelerationForIntv_RequiredLongitudinalAccelerationCalculator_CalculateRequiredAcceleration_RequiredAccelerationForInPathObject_ObjectIsBraking /end SUB_GROUP
/end GROUP
/begin GROUP autosar_swc_aeb_autosar_swc_aeb_Step_sys_Subsystem_Reference_AEB_Function_Run_AsyEvlrCritEve_Step_Func_Run_AsyEvlrCritEve_Step_Func_TAWrapper_LongitudinalThreatAssessor_ThreatAssessorForWarn_ThreatAssessor_RequiredLongitudinalAccelerationForIntv_RequiredLongitudinalAccelerationCalculator_CalculateRequiredAcceleration_RequiredAccelerationForInPathObject_ObjectIsBraking "autosar_swc_aeb/autosar_swc_aeb_Step_sys/Subsystem Reference/AEB Function/Run_AsyEvlrCritEve_Step_Func/Run_AsyEvlrCritEve_Step_Func/TAWrapper/LongitudinalThreatAssessor/ThreatAssessorForWarn/ThreatAssessor/RequiredLongitudinalAccelerationForIntv/RequiredLongitudinalAccelerationCalculator/CalculateRequiredAcceleration/RequiredAccelerationForInPathObject/ObjectIsBraking"
 /begin SUB_GROUP autosar_swc_aeb_autosar_swc_aeb_Step_sys_Subsystem_Reference_AEB_Function_Run_AsyEvlrCritEve_Step_Func_Run_AsyEvlrCritEve_Step_Func_TAWrapper_LongitudinalThreatAssessor_ThreatAssessorForWarn_ThreatAssessor_RequiredLongitudinalAccelerationForIntv_RequiredLongitudinalAccelerationCalculator_CalculateRequiredAcceleration_RequiredAccelerationForInPathObject_ObjectIsBraking_ObjectStopsBeforeCollision /end SUB_GROUP
/end GROUP
/begin GROUP autosar_swc_aeb_autosar_swc_aeb_Step_sys_Subsystem_Reference_AEB_Function_Run_AsyEvlrCritEve_Step_Func_Run_AsyEvlrCritEve_Step_Func_TAWrapper_LongitudinalThreatAssessor_ThreatAssessorForWarn_ThreatAssessor_RequiredLongitudinalAccelerationForIntv_RequiredLongitudinalAccelerationCalculator_CalculateRequiredAcceleration_RequiredAccelerationForInPathObject_ObjectIsBraking_ObjectStopsBeforeCollision "autosar_swc_aeb/autosar_swc_aeb_Step_sys/Subsystem Reference/AEB Function/Run_AsyEvlrCritEve_Step_Func/Run_AsyEvlrCritEve_Step_Func/TAWrapper/LongitudinalThreatAssessor/ThreatAssessorForWarn/ThreatAssessor/RequiredLongitudinalAccelerationForIntv/RequiredLongitudinalAccelerationCalculator/CalculateRequiredAcceleration/RequiredAccelerationForInPathObject/ObjectIsBraking/ObjectStopsBeforeCollision"
 /begin SUB_GROUP autosar_swc_aeb_autosar_swc_aeb_Step_sys_Subsystem_Reference_AEB_Function_Run_AsyEvlrCritEve_Step_Func_Run_AsyEvlrCritEve_Step_Func_TAWrapper_LongitudinalThreatAssessor_ThreatAssessorForWarn_ThreatAssessor_RequiredLongitudinalAccelerationForIntv_RequiredLongitudinalAccelerationCalculator_CalculateRequiredAcceleration_RequiredAccelerationForInPathObject_ObjectIsBraking_ObjectStopsBeforeCollision_ObjectNotStoppingBeforeTTR /end SUB_GROUP
/end GROUP
/begin GROUP autosar_swc_aeb_autosar_swc_aeb_Step_sys_Subsystem_Reference_AEB_Function_Run_AsyEvlrCritEve_Step_Func_Run_AsyEvlrCritEve_Step_Func_TAWrapper_LongitudinalThreatAssessor_ThreatAssessorForWarn_ThreatAssessor_RequiredLongitudinalAccelerationForIntv_TranslateAndRotateCoordSys "autosar_swc_aeb/autosar_swc_aeb_Step_sys/Subsystem Reference/AEB Function/Run_AsyEvlrCritEve_Step_Func/Run_AsyEvlrCritEve_Step_Func/TAWrapper/LongitudinalThreatAssessor/ThreatAssessorForWarn/ThreatAssessor/RequiredLongitudinalAccelerationForIntv/TranslateAndRotateCoordSys"
 /begin REF_MEASUREMENT autosar_swc_aeb_rtARID_DEF.PredALatObj autosar_swc_aeb_rtARID_DEF.PredALgtObj autosar_swc_aeb_rtARID_DEF.PredPosnLat autosar_swc_aeb_rtARID_DEF.PredPosnLgt autosar_swc_aeb_rtARID_DEF.PredVLatObj autosar_swc_aeb_rtARID_DEF.PredVLgtObj /end REF_MEASUREMENT
/end GROUP
/begin GROUP autosar_swc_aeb_autosar_swc_aeb_Step_sys_Subsystem_Reference_AEB_Function_Run_AsyEvlrCritEve_Step_Func_Run_AsyEvlrCritEve_Step_Func_TAWrapper_LongitudinalThreatAssessor_ThreatAssessorForWarn_ThreatAssessor_SimpleLateralAccelerationEstimator "autosar_swc_aeb/autosar_swc_aeb_Step_sys/Subsystem Reference/AEB Function/Run_AsyEvlrCritEve_Step_Func/Run_AsyEvlrCritEve_Step_Func/TAWrapper/LongitudinalThreatAssessor/ThreatAssessorForWarn/ThreatAssessor/SimpleLateralAccelerationEstimator"
 /begin SUB_GROUP autosar_swc_aeb_autosar_swc_aeb_Step_sys_Subsystem_Reference_AEB_Function_Run_AsyEvlrCritEve_Step_Func_Run_AsyEvlrCritEve_Step_Func_TAWrapper_LongitudinalThreatAssessor_ThreatAssessorForWarn_ThreatAssessor_SimpleLateralAccelerationEstimator_CalculateRequiredALat /end SUB_GROUP
 /begin REF_MEASUREMENT autosar_swc_aeb_rtARID_DEF.ALatRqrd /end REF_MEASUREMENT
/end GROUP
/begin GROUP autosar_swc_aeb_autosar_swc_aeb_Step_sys_Subsystem_Reference_AEB_Function_Run_AsyEvlrCritEve_Step_Func_Run_AsyEvlrCritEve_Step_Func_TAWrapper_LongitudinalThreatAssessor_ThreatAssessorForWarn_ThreatAssessor_SimpleLateralAccelerationEstimator_CalculateRequiredALat "autosar_swc_aeb/autosar_swc_aeb_Step_sys/Subsystem Reference/AEB Function/Run_AsyEvlrCritEve_Step_Func/Run_AsyEvlrCritEve_Step_Func/TAWrapper/LongitudinalThreatAssessor/ThreatAssessorForWarn/ThreatAssessor/SimpleLateralAccelerationEstimator/CalculateRequiredALat" /begin REF_MEASUREMENT autosar_swc_aeb_rtARID_DEF.ALatRqrd /end REF_MEASUREMENT /end GROUP
/begin GROUP autosar_swc_aeb_autosar_swc_aeb_Step_sys_Subsystem_Reference_AEB_Function_Run_AsyEvlrCritEve_Step_Func_Run_AsyEvlrCritEve_Step_Func_TAWrapper_PreProcessor "autosar_swc_aeb/autosar_swc_aeb_Step_sys/Subsystem Reference/AEB Function/Run_AsyEvlrCritEve_Step_Func/Run_AsyEvlrCritEve_Step_Func/TAWrapper/PreProcessor"
 /begin SUB_GROUP autosar_swc_aeb_autosar_swc_aeb_Step_sys_Subsystem_Reference_AEB_Function_Run_AsyEvlrCritEve_Step_Func_Run_AsyEvlrCritEve_Step_Func_TAWrapper_PreProcessor_ExtractAccTargetIdIfAccActive autosar_swc_aeb_autosar_swc_aeb_Step_sys_Subsystem_Reference_AEB_Function_Run_AsyEvlrCritEve_Step_Func_Run_AsyEvlrCritEve_Step_Func_TAWrapper_PreProcessor_FindIndicesOfValidFrontObjects autosar_swc_aeb_autosar_swc_aeb_Step_sys_Subsystem_Reference_AEB_Function_Run_AsyEvlrCritEve_Step_Func_Run_AsyEvlrCritEve_Step_Func_TAWrapper_PreProcessor_ModifyObjBusAndDetectDrivingSide autosar_swc_aeb_autosar_swc_aeb_Step_sys_Subsystem_Reference_AEB_Function_Run_AsyEvlrCritEve_Step_Func_Run_AsyEvlrCritEve_Step_Func_TAWrapper_PreProcessor_ObjectPreProcessor autosar_swc_aeb_autosar_swc_aeb_Step_sys_Subsystem_Reference_AEB_Function_Run_AsyEvlrCritEve_Step_Func_Run_AsyEvlrCritEve_Step_Func_TAWrapper_PreProcessor_VehiclePreProcessor /end SUB_GROUP
/end GROUP
/begin GROUP autosar_swc_aeb_autosar_swc_aeb_Step_sys_Subsystem_Reference_AEB_Function_Run_AsyEvlrCritEve_Step_Func_Run_AsyEvlrCritEve_Step_Func_TAWrapper_PreProcessor_ExtractAccTargetIdIfAccActive "autosar_swc_aeb/autosar_swc_aeb_Step_sys/Subsystem Reference/AEB Function/Run_AsyEvlrCritEve_Step_Func/Run_AsyEvlrCritEve_Step_Func/TAWrapper/PreProcessor/ExtractAccTargetIdIfAccActive"
 /begin SUB_GROUP autosar_swc_aeb_autosar_swc_aeb_Step_sys_Subsystem_Reference_AEB_Function_Run_AsyEvlrCritEve_Step_Func_Run_AsyEvlrCritEve_Step_Func_TAWrapper_PreProcessor_ExtractAccTargetIdIfAccActive_ConfirmAccId /end SUB_GROUP
/end GROUP
/begin GROUP autosar_swc_aeb_autosar_swc_aeb_Step_sys_Subsystem_Reference_AEB_Function_Run_AsyEvlrCritEve_Step_Func_Run_AsyEvlrCritEve_Step_Func_TAWrapper_PreProcessor_ExtractAccTargetIdIfAccActive_ConfirmAccId "autosar_swc_aeb/autosar_swc_aeb_Step_sys/Subsystem Reference/AEB Function/Run_AsyEvlrCritEve_Step_Func/Run_AsyEvlrCritEve_Step_Func/TAWrapper/PreProcessor/ExtractAccTargetIdIfAccActive/ConfirmAccId"
 /begin SUB_GROUP autosar_swc_aeb_autosar_swc_aeb_Step_sys_Subsystem_Reference_AEB_Function_Run_AsyEvlrCritEve_Step_Func_Run_AsyEvlrCritEve_Step_Func_TAWrapper_PreProcessor_ExtractAccTargetIdIfAccActive_ConfirmAccId_OnDelayBlock /end SUB_GROUP
 /begin REF_CHARACTERISTIC CLTS_AccTarCfmDlyEnadInAsyEvlrCritEve_Ca CLTS_AccTarCfmDlyInAsyEvlrCritEve_Ca /end REF_CHARACTERISTIC
 /begin REF_MEASUREMENT autosar_swc_aeb_rtARID_DEF.UnitDelay_DSTATE_ag /end REF_MEASUREMENT
/end GROUP
/begin GROUP autosar_swc_aeb_autosar_swc_aeb_Step_sys_Subsystem_Reference_AEB_Function_Run_AsyEvlrCritEve_Step_Func_Run_AsyEvlrCritEve_Step_Func_TAWrapper_PreProcessor_ExtractAccTargetIdIfAccActive_ConfirmAccId_OnDelayBlock "autosar_swc_aeb/autosar_swc_aeb_Step_sys/Subsystem Reference/AEB Function/Run_AsyEvlrCritEve_Step_Func/Run_AsyEvlrCritEve_Step_Func/TAWrapper/PreProcessor/ExtractAccTargetIdIfAccActive/ConfirmAccId/OnDelayBlock" /begin REF_MEASUREMENT autosar_swc_aeb_rtARID_DEF.UnitDelay_DSTATE_i /end REF_MEASUREMENT /end GROUP
/begin GROUP autosar_swc_aeb_autosar_swc_aeb_Step_sys_Subsystem_Reference_AEB_Function_Run_AsyEvlrCritEve_Step_Func_Run_AsyEvlrCritEve_Step_Func_TAWrapper_PreProcessor_FindIndicesOfValidFrontObjects "autosar_swc_aeb/autosar_swc_aeb_Step_sys/Subsystem Reference/AEB Function/Run_AsyEvlrCritEve_Step_Func/Run_AsyEvlrCritEve_Step_Func/TAWrapper/PreProcessor/FindIndicesOfValidFrontObjects"
 /begin SUB_GROUP autosar_swc_aeb_autosar_swc_aeb_Step_sys_Subsystem_Reference_AEB_Function_Run_AsyEvlrCritEve_Step_Func_Run_AsyEvlrCritEve_Step_Func_TAWrapper_PreProcessor_FindIndicesOfValidFrontObjects_ObjUtilityAndInPath /end SUB_GROUP
 /begin REF_CHARACTERISTIC CLTS_SeldTarInBypModInAsyEvlrCritEve_Ca /end REF_CHARACTERISTIC
/end GROUP
/begin GROUP autosar_swc_aeb_autosar_swc_aeb_Step_sys_Subsystem_Reference_AEB_Function_Run_AsyEvlrCritEve_Step_Func_Run_AsyEvlrCritEve_Step_Func_TAWrapper_PreProcessor_FindIndicesOfValidFrontObjects_ObjUtilityAndInPath "autosar_swc_aeb/autosar_swc_aeb_Step_sys/Subsystem Reference/AEB Function/Run_AsyEvlrCritEve_Step_Func/Run_AsyEvlrCritEve_Step_Func/TAWrapper/PreProcessor/FindIndicesOfValidFrontObjects/ObjUtilityAndInPath"
 /begin SUB_GROUP autosar_swc_aeb_autosar_swc_aeb_Step_sys_Subsystem_Reference_AEB_Function_Run_AsyEvlrCritEve_Step_Func_Run_AsyEvlrCritEve_Step_Func_TAWrapper_PreProcessor_FindIndicesOfValidFrontObjects_ObjUtilityAndInPath_ComputeUtilityAndInPath autosar_swc_aeb_autosar_swc_aeb_Step_sys_Subsystem_Reference_AEB_Function_Run_AsyEvlrCritEve_Step_Func_Run_AsyEvlrCritEve_Step_Func_TAWrapper_PreProcessor_FindIndicesOfValidFrontObjects_ObjUtilityAndInPath_ValidateObject /end SUB_GROUP
 /begin REF_MEASUREMENT autosar_swc_aeb_rtARID_DEF.Width_p /end REF_MEASUREMENT
/end GROUP
/begin GROUP autosar_swc_aeb_autosar_swc_aeb_Step_sys_Subsystem_Reference_AEB_Function_Run_AsyEvlrCritEve_Step_Func_Run_AsyEvlrCritEve_Step_Func_TAWrapper_PreProcessor_FindIndicesOfValidFrontObjects_ObjUtilityAndInPath_ComputeUtilityAndInPath "autosar_swc_aeb/autosar_swc_aeb_Step_sys/Subsystem Reference/AEB Function/Run_AsyEvlrCritEve_Step_Func/Run_AsyEvlrCritEve_Step_Func/TAWrapper/PreProcessor/FindIndicesOfValidFrontObjects/ObjUtilityAndInPath/ComputeUtilityAndInPath"
 /begin SUB_GROUP autosar_swc_aeb_autosar_swc_aeb_Step_sys_Subsystem_Reference_AEB_Function_Run_AsyEvlrCritEve_Step_Func_Run_AsyEvlrCritEve_Step_Func_TAWrapper_PreProcessor_FindIndicesOfValidFrontObjects_ObjUtilityAndInPath_ComputeUtilityAndInPath_DetermineAdjacent autosar_swc_aeb_autosar_swc_aeb_Step_sys_Subsystem_Reference_AEB_Function_Run_AsyEvlrCritEve_Step_Func_Run_AsyEvlrCritEve_Step_Func_TAWrapper_PreProcessor_FindIndicesOfValidFrontObjects_ObjUtilityAndInPath_ComputeUtilityAndInPath_DetermineInPath /end SUB_GROUP
/end GROUP
/begin GROUP autosar_swc_aeb_autosar_swc_aeb_Step_sys_Subsystem_Reference_AEB_Function_Run_AsyEvlrCritEve_Step_Func_Run_AsyEvlrCritEve_Step_Func_TAWrapper_PreProcessor_FindIndicesOfValidFrontObjects_ObjUtilityAndInPath_ComputeUtilityAndInPath_DetermineAdjacent "autosar_swc_aeb/autosar_swc_aeb_Step_sys/Subsystem Reference/AEB Function/Run_AsyEvlrCritEve_Step_Func/Run_AsyEvlrCritEve_Step_Func/TAWrapper/PreProcessor/FindIndicesOfValidFrontObjects/ObjUtilityAndInPath/ComputeUtilityAndInPath/DetermineAdjacent"
 /begin SUB_GROUP autosar_swc_aeb_autosar_swc_aeb_Step_sys_Subsystem_Reference_AEB_Function_Run_AsyEvlrCritEve_Step_Func_Run_AsyEvlrCritEve_Step_Func_TAWrapper_PreProcessor_FindIndicesOfValidFrontObjects_ObjUtilityAndInPath_ComputeUtilityAndInPath_DetermineAdjacent_GetEstimatedObjLength /end SUB_GROUP
/end GROUP
/begin GROUP autosar_swc_aeb_autosar_swc_aeb_Step_sys_Subsystem_Reference_AEB_Function_Run_AsyEvlrCritEve_Step_Func_Run_AsyEvlrCritEve_Step_Func_TAWrapper_PreProcessor_FindIndicesOfValidFrontObjects_ObjUtilityAndInPath_ComputeUtilityAndInPath_DetermineAdjacent_GetEstimatedObjLength "autosar_swc_aeb/autosar_swc_aeb_Step_sys/Subsystem Reference/AEB Function/Run_AsyEvlrCritEve_Step_Func/Run_AsyEvlrCritEve_Step_Func/TAWrapper/PreProcessor/FindIndicesOfValidFrontObjects/ObjUtilityAndInPath/ComputeUtilityAndInPath/DetermineAdjacent/GetEstimatedObjLength"
 /begin REF_CHARACTERISTIC CLTS_AnimLenDftInAsyEvlrCritEve_Ca CLTS_BicycleLenDftInAsyEvlrCritEve_Ca CLTS_CarLenDftInAsyEvlrCritEve_Ca CLTS_MotorcycleLenDftInAsyEvlrCritEve_Ca CLTS_ObjLenDftInAsyEvlrCritEve_Ca CLTS_PedLenDftInAsyEvlrCritEve_Ca CLTS_TruckLenDftInAsyEvlrCritEve_Ca CLTS_VehLenDftInAsyEvlrCritEve_Ca /end REF_CHARACTERISTIC
/end GROUP
/begin GROUP autosar_swc_aeb_autosar_swc_aeb_Step_sys_Subsystem_Reference_AEB_Function_Run_AsyEvlrCritEve_Step_Func_Run_AsyEvlrCritEve_Step_Func_TAWrapper_PreProcessor_FindIndicesOfValidFrontObjects_ObjUtilityAndInPath_ComputeUtilityAndInPath_DetermineInPath "autosar_swc_aeb/autosar_swc_aeb_Step_sys/Subsystem Reference/AEB Function/Run_AsyEvlrCritEve_Step_Func/Run_AsyEvlrCritEve_Step_Func/TAWrapper/PreProcessor/FindIndicesOfValidFrontObjects/ObjUtilityAndInPath/ComputeUtilityAndInPath/DetermineInPath"
 /begin SUB_GROUP autosar_swc_aeb_autosar_swc_aeb_Step_sys_Subsystem_Reference_AEB_Function_Run_AsyEvlrCritEve_Step_Func_Run_AsyEvlrCritEve_Step_Func_TAWrapper_PreProcessor_FindIndicesOfValidFrontObjects_ObjUtilityAndInPath_ComputeUtilityAndInPath_DetermineInPath_PredictHostLateralPositionAtTTR /end SUB_GROUP
/end GROUP
/begin GROUP autosar_swc_aeb_autosar_swc_aeb_Step_sys_Subsystem_Reference_AEB_Function_Run_AsyEvlrCritEve_Step_Func_Run_AsyEvlrCritEve_Step_Func_TAWrapper_PreProcessor_FindIndicesOfValidFrontObjects_ObjUtilityAndInPath_ComputeUtilityAndInPath_DetermineInPath_PredictHostLateralPositionAtTTR "autosar_swc_aeb/autosar_swc_aeb_Step_sys/Subsystem Reference/AEB Function/Run_AsyEvlrCritEve_Step_Func/Run_AsyEvlrCritEve_Step_Func/TAWrapper/PreProcessor/FindIndicesOfValidFrontObjects/ObjUtilityAndInPath/ComputeUtilityAndInPath/DetermineInPath/PredictHostLateralPositionAtTTR"
 /begin SUB_GROUP autosar_swc_aeb_autosar_swc_aeb_Step_sys_Subsystem_Reference_AEB_Function_Run_AsyEvlrCritEve_Step_Func_Run_AsyEvlrCritEve_Step_Func_TAWrapper_PreProcessor_FindIndicesOfValidFrontObjects_ObjUtilityAndInPath_ComputeUtilityAndInPath_DetermineInPath_PredictHostLateralPositionAtTTR_CalculateHeading autosar_swc_aeb_autosar_swc_aeb_Step_sys_Subsystem_Reference_AEB_Function_Run_AsyEvlrCritEve_Step_Func_Run_AsyEvlrCritEve_Step_Func_TAWrapper_PreProcessor_FindIndicesOfValidFrontObjects_ObjUtilityAndInPath_ComputeUtilityAndInPath_DetermineInPath_PredictHostLateralPositionAtTTR_SelectSegment /end SUB_GROUP
/end GROUP
/begin GROUP autosar_swc_aeb_autosar_swc_aeb_Step_sys_Subsystem_Reference_AEB_Function_Run_AsyEvlrCritEve_Step_Func_Run_AsyEvlrCritEve_Step_Func_TAWrapper_PreProcessor_FindIndicesOfValidFrontObjects_ObjUtilityAndInPath_ComputeUtilityAndInPath_DetermineInPath_PredictHostLateralPositionAtTTR_CalculateHeading "autosar_swc_aeb/autosar_swc_aeb_Step_sys/Subsystem Reference/AEB Function/Run_AsyEvlrCritEve_Step_Func/Run_AsyEvlrCritEve_Step_Func/TAWrapper/PreProcessor/FindIndicesOfValidFrontObjects/ObjUtilityAndInPath/ComputeUtilityAndInPath/DetermineInPath/PredictHostLateralPositionAtTTR/CalculateHeading"
 /begin SUB_GROUP autosar_swc_aeb_autosar_swc_aeb_Step_sys_Subsystem_Reference_AEB_Function_Run_AsyEvlrCritEve_Step_Func_Run_AsyEvlrCritEve_Step_Func_TAWrapper_PreProcessor_FindIndicesOfValidFrontObjects_ObjUtilityAndInPath_ComputeUtilityAndInPath_DetermineInPath_PredictHostLateralPositionAtTTR_CalculateHeading_CheckSpeed autosar_swc_aeb_autosar_swc_aeb_Step_sys_Subsystem_Reference_AEB_Function_Run_AsyEvlrCritEve_Step_Func_Run_AsyEvlrCritEve_Step_Func_TAWrapper_PreProcessor_FindIndicesOfValidFrontObjects_ObjUtilityAndInPath_ComputeUtilityAndInPath_DetermineInPath_PredictHostLateralPositionAtTTR_CalculateHeading_ExtractVelocitiesAtStartOfSegments /end SUB_GROUP
/end GROUP
/begin GROUP autosar_swc_aeb_autosar_swc_aeb_Step_sys_Subsystem_Reference_AEB_Function_Run_AsyEvlrCritEve_Step_Func_Run_AsyEvlrCritEve_Step_Func_TAWrapper_PreProcessor_FindIndicesOfValidFrontObjects_ObjUtilityAndInPath_ComputeUtilityAndInPath_DetermineInPath_PredictHostLateralPositionAtTTR_CalculateHeading_ExtractVelocitiesAtStartOfSegments "autosar_swc_aeb/autosar_swc_aeb_Step_sys/Subsystem Reference/AEB Function/Run_AsyEvlrCritEve_Step_Func/Run_AsyEvlrCritEve_Step_Func/TAWrapper/PreProcessor/FindIndicesOfValidFrontObjects/ObjUtilityAndInPath/ComputeUtilityAndInPath/DetermineInPath/PredictHostLateralPositionAtTTR/CalculateHeading/ExtractVelocitiesAtStartOfSegments"
 /begin SUB_GROUP autosar_swc_aeb_autosar_swc_aeb_Step_sys_Subsystem_Reference_AEB_Function_Run_AsyEvlrCritEve_Step_Func_Run_AsyEvlrCritEve_Step_Func_TAWrapper_PreProcessor_FindIndicesOfValidFrontObjects_ObjUtilityAndInPath_ComputeUtilityAndInPath_DetermineInPath_PredictHostLateralPositionAtTTR_CalculateHeading_ExtractVelocitiesAtStartOfSegments_CheckSpeed /end SUB_GROUP
/end GROUP
/begin GROUP autosar_swc_aeb_autosar_swc_aeb_Step_sys_Subsystem_Reference_AEB_Function_Run_AsyEvlrCritEve_Step_Func_Run_AsyEvlrCritEve_Step_Func_TAWrapper_PreProcessor_FindIndicesOfValidFrontObjects_ObjUtilityAndInPath_ComputeUtilityAndInPath_DetermineInPath_PredictHostLateralPositionAtTTR_SelectSegment "autosar_swc_aeb/autosar_swc_aeb_Step_sys/Subsystem Reference/AEB Function/Run_AsyEvlrCritEve_Step_Func/Run_AsyEvlrCritEve_Step_Func/TAWrapper/PreProcessor/FindIndicesOfValidFrontObjects/ObjUtilityAndInPath/ComputeUtilityAndInPath/DetermineInPath/PredictHostLateralPositionAtTTR/SelectSegment" /begin REF_MEASUREMENT autosar_swc_aeb_rtARID_DEF.LastSegment_a /end REF_MEASUREMENT /end GROUP
/begin GROUP autosar_swc_aeb_autosar_swc_aeb_Step_sys_Subsystem_Reference_AEB_Function_Run_AsyEvlrCritEve_Step_Func_Run_AsyEvlrCritEve_Step_Func_TAWrapper_PreProcessor_FindIndicesOfValidFrontObjects_ObjUtilityAndInPath_ValidateObject "autosar_swc_aeb/autosar_swc_aeb_Step_sys/Subsystem Reference/AEB Function/Run_AsyEvlrCritEve_Step_Func/Run_AsyEvlrCritEve_Step_Func/TAWrapper/PreProcessor/FindIndicesOfValidFrontObjects/ObjUtilityAndInPath/ValidateObject"
 /begin SUB_GROUP autosar_swc_aeb_autosar_swc_aeb_Step_sys_Subsystem_Reference_AEB_Function_Run_AsyEvlrCritEve_Step_Func_Run_AsyEvlrCritEve_Step_Func_TAWrapper_PreProcessor_FindIndicesOfValidFrontObjects_ObjUtilityAndInPath_ValidateObject_CheckPosition autosar_swc_aeb_autosar_swc_aeb_Step_sys_Subsystem_Reference_AEB_Function_Run_AsyEvlrCritEve_Step_Func_Run_AsyEvlrCritEve_Step_Func_TAWrapper_PreProcessor_FindIndicesOfValidFrontObjects_ObjUtilityAndInPath_ValidateObject_CheckType autosar_swc_aeb_autosar_swc_aeb_Step_sys_Subsystem_Reference_AEB_Function_Run_AsyEvlrCritEve_Step_Func_Run_AsyEvlrCritEve_Step_Func_TAWrapper_PreProcessor_FindIndicesOfValidFrontObjects_ObjUtilityAndInPath_ValidateObject_CheckVehicleSpeed /end SUB_GROUP
/end GROUP
/begin GROUP autosar_swc_aeb_autosar_swc_aeb_Step_sys_Subsystem_Reference_AEB_Function_Run_AsyEvlrCritEve_Step_Func_Run_AsyEvlrCritEve_Step_Func_TAWrapper_PreProcessor_FindIndicesOfValidFrontObjects_ObjUtilityAndInPath_ValidateObject_CheckPosition "autosar_swc_aeb/autosar_swc_aeb_Step_sys/Subsystem Reference/AEB Function/Run_AsyEvlrCritEve_Step_Func/Run_AsyEvlrCritEve_Step_Func/TAWrapper/PreProcessor/FindIndicesOfValidFrontObjects/ObjUtilityAndInPath/ValidateObject/CheckPosition" /begin REF_CHARACTERISTIC CLTS_ObjPosnChkEnadInAsyEvlrCritEve_Ca /end REF_CHARACTERISTIC /end GROUP
/begin GROUP autosar_swc_aeb_autosar_swc_aeb_Step_sys_Subsystem_Reference_AEB_Function_Run_AsyEvlrCritEve_Step_Func_Run_AsyEvlrCritEve_Step_Func_TAWrapper_PreProcessor_FindIndicesOfValidFrontObjects_ObjUtilityAndInPath_ValidateObject_CheckType "autosar_swc_aeb/autosar_swc_aeb_Step_sys/Subsystem Reference/AEB Function/Run_AsyEvlrCritEve_Step_Func/Run_AsyEvlrCritEve_Step_Func/TAWrapper/PreProcessor/FindIndicesOfValidFrontObjects/ObjUtilityAndInPath/ValidateObject/CheckType"
 /begin REF_CHARACTERISTIC CLTS_AnimEnaInAsyEvlrCritEve_Ca CLTS_BicycleEnaInAsyEvlrCritEve_Ca CLTS_CarEnaInAsyEvlrCritEve_Ca CLTS_MotorcycleEnaInAsyEvlrCritEve_Ca CLTS_ObjGenEnaInAsyEvlrCritEve_Ca CLTS_PedEnaInAsyEvlrCritEve_Ca CLTS_TruckEnaInAsyEvlrCritEve_Ca CLTS_UkwnClassEnaInAsyEvlrCritEve_Ca CLTS_VehOfUkwnClassEnaInAsyEvlrCritEve_Ca /end REF_CHARACTERISTIC
/end GROUP
/begin GROUP autosar_swc_aeb_autosar_swc_aeb_Step_sys_Subsystem_Reference_AEB_Function_Run_AsyEvlrCritEve_Step_Func_Run_AsyEvlrCritEve_Step_Func_TAWrapper_PreProcessor_FindIndicesOfValidFrontObjects_ObjUtilityAndInPath_ValidateObject_CheckVehicleSpeed "autosar_swc_aeb/autosar_swc_aeb_Step_sys/Subsystem Reference/AEB Function/Run_AsyEvlrCritEve_Step_Func/Run_AsyEvlrCritEve_Step_Func/TAWrapper/PreProcessor/FindIndicesOfValidFrontObjects/ObjUtilityAndInPath/ValidateObject/CheckVehicleSpeed"
 /begin REF_CHARACTERISTIC CLTS_SpdLimHiForAnimInAsyEvlrCritEve_Ca CLTS_SpdLimHiForPedInAsyEvlrCritEve_Ca CLTS_SpdLimHiInAsyEvlrCritEve_Ca /end REF_CHARACTERISTIC
/end GROUP
/begin GROUP autosar_swc_aeb_autosar_swc_aeb_Step_sys_Subsystem_Reference_AEB_Function_Run_AsyEvlrCritEve_Step_Func_Run_AsyEvlrCritEve_Step_Func_TAWrapper_PreProcessor_ModifyObjBusAndDetectDrivingSide "autosar_swc_aeb/autosar_swc_aeb_Step_sys/Subsystem Reference/AEB Function/Run_AsyEvlrCritEve_Step_Func/Run_AsyEvlrCritEve_Step_Func/TAWrapper/PreProcessor/ModifyObjBusAndDetectDrivingSide"
 /begin SUB_GROUP autosar_swc_aeb_autosar_swc_aeb_Step_sys_Subsystem_Reference_AEB_Function_Run_AsyEvlrCritEve_Step_Func_Run_AsyEvlrCritEve_Step_Func_TAWrapper_PreProcessor_ModifyObjBusAndDetectDrivingSide_LoopOverObjects /end SUB_GROUP
 /begin REF_CHARACTERISTIC CLTS_DrvgSideDifMaxInAsyEvlrCritEve_Ca CLTS_SpdMinForEvlnOfDrvgSideInAsyEvlrCritEve_Ca /end REF_CHARACTERISTIC
 /begin REF_MEASUREMENT autosar_swc_aeb_rtARID_DEF.UnitDelay1_DSTATE_n autosar_swc_aeb_rtARID_DEF.UnitDelay2_DSTATE_oo autosar_swc_aeb_rtARID_DEF.UnitDelay3_DSTATE_a autosar_swc_aeb_rtARID_DEF.UnitDelay_DSTATE_mf /end REF_MEASUREMENT
/end GROUP
/begin GROUP autosar_swc_aeb_autosar_swc_aeb_Step_sys_Subsystem_Reference_AEB_Function_Run_AsyEvlrCritEve_Step_Func_Run_AsyEvlrCritEve_Step_Func_TAWrapper_PreProcessor_ModifyObjBusAndDetectDrivingSide_LoopOverObjects "autosar_swc_aeb/autosar_swc_aeb_Step_sys/Subsystem Reference/AEB Function/Run_AsyEvlrCritEve_Step_Func/Run_AsyEvlrCritEve_Step_Func/TAWrapper/PreProcessor/ModifyObjBusAndDetectDrivingSide/LoopOverObjects"
 /begin SUB_GROUP autosar_swc_aeb_autosar_swc_aeb_Step_sys_Subsystem_Reference_AEB_Function_Run_AsyEvlrCritEve_Step_Func_Run_AsyEvlrCritEve_Step_Func_TAWrapper_PreProcessor_ModifyObjBusAndDetectDrivingSide_LoopOverObjects_CountOncomingObjectsOnEachSide /end SUB_GROUP
 /begin REF_MEASUREMENT autosar_swc_aeb_rtARID_DEF.Width /end REF_MEASUREMENT
/end GROUP
/begin GROUP autosar_swc_aeb_autosar_swc_aeb_Step_sys_Subsystem_Reference_AEB_Function_Run_AsyEvlrCritEve_Step_Func_Run_AsyEvlrCritEve_Step_Func_TAWrapper_PreProcessor_ModifyObjBusAndDetectDrivingSide_LoopOverObjects_CountOncomingObjectsOnEachSide "autosar_swc_aeb/autosar_swc_aeb_Step_sys/Subsystem Reference/AEB Function/Run_AsyEvlrCritEve_Step_Func/Run_AsyEvlrCritEve_Step_Func/TAWrapper/PreProcessor/ModifyObjBusAndDetectDrivingSide/LoopOverObjects/CountOncomingObjectsOnEachSide"
 /begin REF_CHARACTERISTIC CLTS_DstForEvlnOfDrvgSideInAsyEvlrCritEve_Ca CLTS_PosnLatMaxForEvlnOfDrvgSideInAsyEvlrCritEve_Ca CLTS_SpdMinForEvlnOfDrvgSideInAsyEvlrCritEve_Ca /end REF_CHARACTERISTIC
/end GROUP
/begin GROUP autosar_swc_aeb_autosar_swc_aeb_Step_sys_Subsystem_Reference_AEB_Function_Run_AsyEvlrCritEve_Step_Func_Run_AsyEvlrCritEve_Step_Func_TAWrapper_PreProcessor_ObjectPreProcessor "autosar_swc_aeb/autosar_swc_aeb_Step_sys/Subsystem Reference/AEB Function/Run_AsyEvlrCritEve_Step_Func/Run_AsyEvlrCritEve_Step_Func/TAWrapper/PreProcessor/ObjectPreProcessor"
 /begin SUB_GROUP autosar_swc_aeb_autosar_swc_aeb_Step_sys_Subsystem_Reference_AEB_Function_Run_AsyEvlrCritEve_Step_Func_Run_AsyEvlrCritEve_Step_Func_TAWrapper_PreProcessor_ObjectPreProcessor_ObjectPreProcessorLoop /end SUB_GROUP
/end GROUP
/begin GROUP autosar_swc_aeb_autosar_swc_aeb_Step_sys_Subsystem_Reference_AEB_Function_Run_AsyEvlrCritEve_Step_Func_Run_AsyEvlrCritEve_Step_Func_TAWrapper_PreProcessor_ObjectPreProcessor_ObjectPreProcessorLoop "autosar_swc_aeb/autosar_swc_aeb_Step_sys/Subsystem Reference/AEB Function/Run_AsyEvlrCritEve_Step_Func/Run_AsyEvlrCritEve_Step_Func/TAWrapper/PreProcessor/ObjectPreProcessor/ObjectPreProcessorLoop"
 /begin SUB_GROUP autosar_swc_aeb_autosar_swc_aeb_Step_sys_Subsystem_Reference_AEB_Function_Run_AsyEvlrCritEve_Step_Func_Run_AsyEvlrCritEve_Step_Func_TAWrapper_PreProcessor_ObjectPreProcessor_ObjectPreProcessorLoop_InvalidObject autosar_swc_aeb_autosar_swc_aeb_Step_sys_Subsystem_Reference_AEB_Function_Run_AsyEvlrCritEve_Step_Func_Run_AsyEvlrCritEve_Step_Func_TAWrapper_PreProcessor_ObjectPreProcessor_ObjectPreProcessorLoop_ValidObject /end SUB_GROUP
/end GROUP
/begin GROUP autosar_swc_aeb_autosar_swc_aeb_Step_sys_Subsystem_Reference_AEB_Function_Run_AsyEvlrCritEve_Step_Func_Run_AsyEvlrCritEve_Step_Func_TAWrapper_PreProcessor_ObjectPreProcessor_ObjectPreProcessorLoop_InvalidObject "autosar_swc_aeb/autosar_swc_aeb_Step_sys/Subsystem Reference/AEB Function/Run_AsyEvlrCritEve_Step_Func/Run_AsyEvlrCritEve_Step_Func/TAWrapper/PreProcessor/ObjectPreProcessor/ObjectPreProcessorLoop/InvalidObject"
 /begin SUB_GROUP autosar_swc_aeb_autosar_swc_aeb_Step_sys_Subsystem_Reference_AEB_Function_Run_AsyEvlrCritEve_Step_Func_Run_AsyEvlrCritEve_Step_Func_TAWrapper_PreProcessor_ObjectPreProcessor_ObjectPreProcessorLoop_InvalidObject_DefaultObjData /end SUB_GROUP
/end GROUP
/begin GROUP autosar_swc_aeb_autosar_swc_aeb_Step_sys_Subsystem_Reference_AEB_Function_Run_AsyEvlrCritEve_Step_Func_Run_AsyEvlrCritEve_Step_Func_TAWrapper_PreProcessor_ObjectPreProcessor_ObjectPreProcessorLoop_ValidObject "autosar_swc_aeb/autosar_swc_aeb_Step_sys/Subsystem Reference/AEB Function/Run_AsyEvlrCritEve_Step_Func/Run_AsyEvlrCritEve_Step_Func/TAWrapper/PreProcessor/ObjectPreProcessor/ObjectPreProcessorLoop/ValidObject"
 /begin SUB_GROUP autosar_swc_aeb_autosar_swc_aeb_Step_sys_Subsystem_Reference_AEB_Function_Run_AsyEvlrCritEve_Step_Func_Run_AsyEvlrCritEve_Step_Func_TAWrapper_PreProcessor_ObjectPreProcessor_ObjectPreProcessorLoop_ValidObject_BoundingBox autosar_swc_aeb_autosar_swc_aeb_Step_sys_Subsystem_Reference_AEB_Function_Run_AsyEvlrCritEve_Step_Func_Run_AsyEvlrCritEve_Step_Func_TAWrapper_PreProcessor_ObjectPreProcessor_ObjectPreProcessorLoop_ValidObject_CalculateTTRAndTTM autosar_swc_aeb_autosar_swc_aeb_Step_sys_Subsystem_Reference_AEB_Function_Run_AsyEvlrCritEve_Step_Func_Run_AsyEvlrCritEve_Step_Func_TAWrapper_PreProcessor_ObjectPreProcessor_ObjectPreProcessorLoop_ValidObject_DetermineMotionType autosar_swc_aeb_autosar_swc_aeb_Step_sys_Subsystem_Reference_AEB_Function_Run_AsyEvlrCritEve_Step_Func_Run_AsyEvlrCritEve_Step_Func_TAWrapper_PreProcessor_ObjectPreProcessor_ObjectPreProcessorLoop_ValidObject_SafetyMarginFrontObjects autosar_swc_aeb_autosar_swc_aeb_Step_sys_Subsystem_Reference_AEB_Function_Run_AsyEvlrCritEve_Step_Func_Run_AsyEvlrCritEve_Step_Func_TAWrapper_PreProcessor_ObjectPreProcessor_ObjectPreProcessorLoop_ValidObject_Subsystem /end SUB_GROUP
 /begin REF_CHARACTERISTIC P_AEB_CalTTRThrethold P_AEB_CircleCalTTRTivector P_AEB_SeperateSwitch /end REF_CHARACTERISTIC
/end GROUP
/begin GROUP autosar_swc_aeb_autosar_swc_aeb_Step_sys_Subsystem_Reference_AEB_Function_Run_AsyEvlrCritEve_Step_Func_Run_AsyEvlrCritEve_Step_Func_TAWrapper_PreProcessor_ObjectPreProcessor_ObjectPreProcessorLoop_ValidObject_BoundingBox "autosar_swc_aeb/autosar_swc_aeb_Step_sys/Subsystem Reference/AEB Function/Run_AsyEvlrCritEve_Step_Func/Run_AsyEvlrCritEve_Step_Func/TAWrapper/PreProcessor/ObjectPreProcessor/ObjectPreProcessorLoop/ValidObject/BoundingBox"
 /begin SUB_GROUP autosar_swc_aeb_autosar_swc_aeb_Step_sys_Subsystem_Reference_AEB_Function_Run_AsyEvlrCritEve_Step_Func_Run_AsyEvlrCritEve_Step_Func_TAWrapper_PreProcessor_ObjectPreProcessor_ObjectPreProcessorLoop_ValidObject_BoundingBox_MinimumBoundingBoxVehicles autosar_swc_aeb_autosar_swc_aeb_Step_sys_Subsystem_Reference_AEB_Function_Run_AsyEvlrCritEve_Step_Func_Run_AsyEvlrCritEve_Step_Func_TAWrapper_PreProcessor_ObjectPreProcessor_ObjectPreProcessorLoop_ValidObject_BoundingBox_SelectBicycleBoundingBox /end SUB_GROUP
/end GROUP
/begin GROUP autosar_swc_aeb_autosar_swc_aeb_Step_sys_Subsystem_Reference_AEB_Function_Run_AsyEvlrCritEve_Step_Func_Run_AsyEvlrCritEve_Step_Func_TAWrapper_PreProcessor_ObjectPreProcessor_ObjectPreProcessorLoop_ValidObject_BoundingBox_MinimumBoundingBoxVehicles "autosar_swc_aeb/autosar_swc_aeb_Step_sys/Subsystem Reference/AEB Function/Run_AsyEvlrCritEve_Step_Func/Run_AsyEvlrCritEve_Step_Func/TAWrapper/PreProcessor/ObjectPreProcessor/ObjectPreProcessorLoop/ValidObject/BoundingBox/MinimumBoundingBoxVehicles"
 /begin SUB_GROUP autosar_swc_aeb_autosar_swc_aeb_Step_sys_Subsystem_Reference_AEB_Function_Run_AsyEvlrCritEve_Step_Func_Run_AsyEvlrCritEve_Step_Func_TAWrapper_PreProcessor_ObjectPreProcessor_ObjectPreProcessorLoop_ValidObject_BoundingBox_MinimumBoundingBoxVehicles_MovingOncomingVehicleWhenActive autosar_swc_aeb_autosar_swc_aeb_Step_sys_Subsystem_Reference_AEB_Function_Run_AsyEvlrCritEve_Step_Func_Run_AsyEvlrCritEve_Step_Func_TAWrapper_PreProcessor_ObjectPreProcessor_ObjectPreProcessorLoop_ValidObject_BoundingBox_MinimumBoundingBoxVehicles_MovingVehicle autosar_swc_aeb_autosar_swc_aeb_Step_sys_Subsystem_Reference_AEB_Function_Run_AsyEvlrCritEve_Step_Func_Run_AsyEvlrCritEve_Step_Func_TAWrapper_PreProcessor_ObjectPreProcessor_ObjectPreProcessorLoop_ValidObject_BoundingBox_MinimumBoundingBoxVehicles_StationaryVehicle /end SUB_GROUP
/end GROUP
/begin GROUP autosar_swc_aeb_autosar_swc_aeb_Step_sys_Subsystem_Reference_AEB_Function_Run_AsyEvlrCritEve_Step_Func_Run_AsyEvlrCritEve_Step_Func_TAWrapper_PreProcessor_ObjectPreProcessor_ObjectPreProcessorLoop_ValidObject_BoundingBox_MinimumBoundingBoxVehicles_MovingOncomingVehicleWhenActive "autosar_swc_aeb/autosar_swc_aeb_Step_sys/Subsystem Reference/AEB Function/Run_AsyEvlrCritEve_Step_Func/Run_AsyEvlrCritEve_Step_Func/TAWrapper/PreProcessor/ObjectPreProcessor/ObjectPreProcessorLoop/ValidObject/BoundingBox/MinimumBoundingBoxVehicles/MovingOncomingVehicleWhenActive"
 /begin SUB_GROUP autosar_swc_aeb_autosar_swc_aeb_Step_sys_Subsystem_Reference_AEB_Function_Run_AsyEvlrCritEve_Step_Func_Run_AsyEvlrCritEve_Step_Func_TAWrapper_PreProcessor_ObjectPreProcessor_ObjectPreProcessorLoop_ValidObject_BoundingBox_MinimumBoundingBoxVehicles_MovingOncomingVehicleWhenActive_GetEstimatedObjLength /end SUB_GROUP
/end GROUP
/begin GROUP autosar_swc_aeb_autosar_swc_aeb_Step_sys_Subsystem_Reference_AEB_Function_Run_AsyEvlrCritEve_Step_Func_Run_AsyEvlrCritEve_Step_Func_TAWrapper_PreProcessor_ObjectPreProcessor_ObjectPreProcessorLoop_ValidObject_BoundingBox_MinimumBoundingBoxVehicles_MovingOncomingVehicleWhenActive_GetEstimatedObjLength "autosar_swc_aeb/autosar_swc_aeb_Step_sys/Subsystem Reference/AEB Function/Run_AsyEvlrCritEve_Step_Func/Run_AsyEvlrCritEve_Step_Func/TAWrapper/PreProcessor/ObjectPreProcessor/ObjectPreProcessorLoop/ValidObject/BoundingBox/MinimumBoundingBoxVehicles/MovingOncomingVehicleWhenActive/GetEstimatedObjLength"
 /begin REF_CHARACTERISTIC CLTS_AnimLenDftInAsyEvlrCritEve_Ca CLTS_BicycleLenDftInAsyEvlrCritEve_Ca CLTS_CarLenDftInAsyEvlrCritEve_Ca CLTS_MotorcycleLenDftInAsyEvlrCritEve_Ca CLTS_ObjLenDftInAsyEvlrCritEve_Ca CLTS_PedLenDftInAsyEvlrCritEve_Ca CLTS_TruckLenDftInAsyEvlrCritEve_Ca /end REF_CHARACTERISTIC
/end GROUP
/begin GROUP autosar_swc_aeb_autosar_swc_aeb_Step_sys_Subsystem_Reference_AEB_Function_Run_AsyEvlrCritEve_Step_Func_Run_AsyEvlrCritEve_Step_Func_TAWrapper_PreProcessor_ObjectPreProcessor_ObjectPreProcessorLoop_ValidObject_BoundingBox_MinimumBoundingBoxVehicles_MovingVehicle "autosar_swc_aeb/autosar_swc_aeb_Step_sys/Subsystem Reference/AEB Function/Run_AsyEvlrCritEve_Step_Func/Run_AsyEvlrCritEve_Step_Func/TAWrapper/PreProcessor/ObjectPreProcessor/ObjectPreProcessorLoop/ValidObject/BoundingBox/MinimumBoundingBoxVehicles/MovingVehicle"
 /begin SUB_GROUP autosar_swc_aeb_autosar_swc_aeb_Step_sys_Subsystem_Reference_AEB_Function_Run_AsyEvlrCritEve_Step_Func_Run_AsyEvlrCritEve_Step_Func_TAWrapper_PreProcessor_ObjectPreProcessor_ObjectPreProcessorLoop_ValidObject_BoundingBox_MinimumBoundingBoxVehicles_MovingVehicle_GetEstimatedObjLength /end SUB_GROUP
/end GROUP
/begin GROUP autosar_swc_aeb_autosar_swc_aeb_Step_sys_Subsystem_Reference_AEB_Function_Run_AsyEvlrCritEve_Step_Func_Run_AsyEvlrCritEve_Step_Func_TAWrapper_PreProcessor_ObjectPreProcessor_ObjectPreProcessorLoop_ValidObject_BoundingBox_MinimumBoundingBoxVehicles_MovingVehicle_GetEstimatedObjLength "autosar_swc_aeb/autosar_swc_aeb_Step_sys/Subsystem Reference/AEB Function/Run_AsyEvlrCritEve_Step_Func/Run_AsyEvlrCritEve_Step_Func/TAWrapper/PreProcessor/ObjectPreProcessor/ObjectPreProcessorLoop/ValidObject/BoundingBox/MinimumBoundingBoxVehicles/MovingVehicle/GetEstimatedObjLength"
 /begin REF_CHARACTERISTIC CLTS_AnimLenDftInAsyEvlrCritEve_Ca CLTS_BicycleLenDftInAsyEvlrCritEve_Ca CLTS_CarLenDftInAsyEvlrCritEve_Ca CLTS_MotorcycleLenDftInAsyEvlrCritEve_Ca CLTS_ObjLenDftInAsyEvlrCritEve_Ca CLTS_PedLenDftInAsyEvlrCritEve_Ca CLTS_TruckLenDftInAsyEvlrCritEve_Ca CLTS_VehLenDftInAsyEvlrCritEve_Ca /end REF_CHARACTERISTIC
/end GROUP
/begin GROUP autosar_swc_aeb_autosar_swc_aeb_Step_sys_Subsystem_Reference_AEB_Function_Run_AsyEvlrCritEve_Step_Func_Run_AsyEvlrCritEve_Step_Func_TAWrapper_PreProcessor_ObjectPreProcessor_ObjectPreProcessorLoop_ValidObject_BoundingBox_MinimumBoundingBoxVehicles_StationaryVehicle "autosar_swc_aeb/autosar_swc_aeb_Step_sys/Subsystem Reference/AEB Function/Run_AsyEvlrCritEve_Step_Func/Run_AsyEvlrCritEve_Step_Func/TAWrapper/PreProcessor/ObjectPreProcessor/ObjectPreProcessorLoop/ValidObject/BoundingBox/MinimumBoundingBoxVehicles/StationaryVehicle"
 /begin SUB_GROUP autosar_swc_aeb_autosar_swc_aeb_Step_sys_Subsystem_Reference_AEB_Function_Run_AsyEvlrCritEve_Step_Func_Run_AsyEvlrCritEve_Step_Func_TAWrapper_PreProcessor_ObjectPreProcessor_ObjectPreProcessorLoop_ValidObject_BoundingBox_MinimumBoundingBoxVehicles_StationaryVehicle_GetEstimatedObjLength /end SUB_GROUP
/end GROUP
/begin GROUP autosar_swc_aeb_autosar_swc_aeb_Step_sys_Subsystem_Reference_AEB_Function_Run_AsyEvlrCritEve_Step_Func_Run_AsyEvlrCritEve_Step_Func_TAWrapper_PreProcessor_ObjectPreProcessor_ObjectPreProcessorLoop_ValidObject_BoundingBox_MinimumBoundingBoxVehicles_StationaryVehicle_GetEstimatedObjLength "autosar_swc_aeb/autosar_swc_aeb_Step_sys/Subsystem Reference/AEB Function/Run_AsyEvlrCritEve_Step_Func/Run_AsyEvlrCritEve_Step_Func/TAWrapper/PreProcessor/ObjectPreProcessor/ObjectPreProcessorLoop/ValidObject/BoundingBox/MinimumBoundingBoxVehicles/StationaryVehicle/GetEstimatedObjLength"
 /begin REF_CHARACTERISTIC CLTS_AnimLenDftInAsyEvlrCritEve_Ca CLTS_BicycleLenDftInAsyEvlrCritEve_Ca CLTS_CarLenDftInAsyEvlrCritEve_Ca CLTS_MotorcycleLenDftInAsyEvlrCritEve_Ca CLTS_ObjLenDftInAsyEvlrCritEve_Ca CLTS_PedLenDftInAsyEvlrCritEve_Ca CLTS_TruckLenDftInAsyEvlrCritEve_Ca CLTS_VehLenDftInAsyEvlrCritEve_Ca /end REF_CHARACTERISTIC
/end GROUP
/begin GROUP autosar_swc_aeb_autosar_swc_aeb_Step_sys_Subsystem_Reference_AEB_Function_Run_AsyEvlrCritEve_Step_Func_Run_AsyEvlrCritEve_Step_Func_TAWrapper_PreProcessor_ObjectPreProcessor_ObjectPreProcessorLoop_ValidObject_BoundingBox_SelectBicycleBoundingBox "autosar_swc_aeb/autosar_swc_aeb_Step_sys/Subsystem Reference/AEB Function/Run_AsyEvlrCritEve_Step_Func/Run_AsyEvlrCritEve_Step_Func/TAWrapper/PreProcessor/ObjectPreProcessor/ObjectPreProcessorLoop/ValidObject/BoundingBox/SelectBicycleBoundingBox"
 /begin REF_CHARACTERISTIC CLTS_BicycleSpdThdForSpdLoInAsyEvlrCritEve_Ca CLTS_BicycleWidthDftInAsyEvlrCritEve_Ca /end REF_CHARACTERISTIC
/end GROUP
/begin GROUP autosar_swc_aeb_autosar_swc_aeb_Step_sys_Subsystem_Reference_AEB_Function_Run_AsyEvlrCritEve_Step_Func_Run_AsyEvlrCritEve_Step_Func_TAWrapper_PreProcessor_ObjectPreProcessor_ObjectPreProcessorLoop_ValidObject_CalculateTTRAndTTM "autosar_swc_aeb/autosar_swc_aeb_Step_sys/Subsystem Reference/AEB Function/Run_AsyEvlrCritEve_Step_Func/Run_AsyEvlrCritEve_Step_Func/TAWrapper/PreProcessor/ObjectPreProcessor/ObjectPreProcessorLoop/ValidObject/CalculateTTRAndTTM"
 /begin SUB_GROUP autosar_swc_aeb_autosar_swc_aeb_Step_sys_Subsystem_Reference_AEB_Function_Run_AsyEvlrCritEve_Step_Func_Run_AsyEvlrCritEve_Step_Func_TAWrapper_PreProcessor_ObjectPreProcessor_ObjectPreProcessorLoop_ValidObject_CalculateTTRAndTTM_LongitudinalTTMComputer autosar_swc_aeb_autosar_swc_aeb_Step_sys_Subsystem_Reference_AEB_Function_Run_AsyEvlrCritEve_Step_Func_Run_AsyEvlrCritEve_Step_Func_TAWrapper_PreProcessor_ObjectPreProcessor_ObjectPreProcessorLoop_ValidObject_CalculateTTRAndTTM_LongitudinalTTRComputer autosar_swc_aeb_autosar_swc_aeb_Step_sys_Subsystem_Reference_AEB_Function_Run_AsyEvlrCritEve_Step_Func_Run_AsyEvlrCritEve_Step_Func_TAWrapper_PreProcessor_ObjectPreProcessor_ObjectPreProcessorLoop_ValidObject_CalculateTTRAndTTM_ModifyTTMAtSameSpeedAndAcceleration autosar_swc_aeb_autosar_swc_aeb_Step_sys_Subsystem_Reference_AEB_Function_Run_AsyEvlrCritEve_Step_Func_Run_AsyEvlrCritEve_Step_Func_TAWrapper_PreProcessor_ObjectPreProcessor_ObjectPreProcessorLoop_ValidObject_CalculateTTRAndTTM_ModifyTTRAtSameSpeedAndAcceleration autosar_swc_aeb_autosar_swc_aeb_Step_sys_Subsystem_Reference_AEB_Function_Run_AsyEvlrCritEve_Step_Func_Run_AsyEvlrCritEve_Step_Func_TAWrapper_PreProcessor_ObjectPreProcessor_ObjectPreProcessorLoop_ValidObject_CalculateTTRAndTTM_SetCorrectSign1 autosar_swc_aeb_autosar_swc_aeb_Step_sys_Subsystem_Reference_AEB_Function_Run_AsyEvlrCritEve_Step_Func_Run_AsyEvlrCritEve_Step_Func_TAWrapper_PreProcessor_ObjectPreProcessor_ObjectPreProcessorLoop_ValidObject_CalculateTTRAndTTM_SetCorrectSign2 /end SUB_GROUP
/end GROUP
/begin GROUP autosar_swc_aeb_autosar_swc_aeb_Step_sys_Subsystem_Reference_AEB_Function_Run_AsyEvlrCritEve_Step_Func_Run_AsyEvlrCritEve_Step_Func_TAWrapper_PreProcessor_ObjectPreProcessor_ObjectPreProcessorLoop_ValidObject_CalculateTTRAndTTM_LongitudinalTTMComputer "autosar_swc_aeb/autosar_swc_aeb_Step_sys/Subsystem Reference/AEB Function/Run_AsyEvlrCritEve_Step_Func/Run_AsyEvlrCritEve_Step_Func/TAWrapper/PreProcessor/ObjectPreProcessor/ObjectPreProcessorLoop/ValidObject/CalculateTTRAndTTM/LongitudinalTTMComputer"
 /begin SUB_GROUP autosar_swc_aeb_autosar_swc_aeb_Step_sys_Subsystem_Reference_AEB_Function_Run_AsyEvlrCritEve_Step_Func_Run_AsyEvlrCritEve_Step_Func_TAWrapper_PreProcessor_ObjectPreProcessor_ObjectPreProcessorLoop_ValidObject_CalculateTTRAndTTM_LongitudinalTTMComputer_CalculateTTI autosar_swc_aeb_autosar_swc_aeb_Step_sys_Subsystem_Reference_AEB_Function_Run_AsyEvlrCritEve_Step_Func_Run_AsyEvlrCritEve_Step_Func_TAWrapper_PreProcessor_ObjectPreProcessor_ObjectPreProcessorLoop_ValidObject_CalculateTTRAndTTM_LongitudinalTTMComputer_SelectTTI /end SUB_GROUP
/end GROUP
/begin GROUP autosar_swc_aeb_autosar_swc_aeb_Step_sys_Subsystem_Reference_AEB_Function_Run_AsyEvlrCritEve_Step_Func_Run_AsyEvlrCritEve_Step_Func_TAWrapper_PreProcessor_ObjectPreProcessor_ObjectPreProcessorLoop_ValidObject_CalculateTTRAndTTM_LongitudinalTTMComputer_CalculateTTI "autosar_swc_aeb/autosar_swc_aeb_Step_sys/Subsystem Reference/AEB Function/Run_AsyEvlrCritEve_Step_Func/Run_AsyEvlrCritEve_Step_Func/TAWrapper/PreProcessor/ObjectPreProcessor/ObjectPreProcessorLoop/ValidObject/CalculateTTRAndTTM/LongitudinalTTMComputer/CalculateTTI"
 /begin SUB_GROUP autosar_swc_aeb_autosar_swc_aeb_Step_sys_Subsystem_Reference_AEB_Function_Run_AsyEvlrCritEve_Step_Func_Run_AsyEvlrCritEve_Step_Func_TAWrapper_PreProcessor_ObjectPreProcessor_ObjectPreProcessorLoop_ValidObject_CalculateTTRAndTTM_LongitudinalTTMComputer_CalculateTTI_HostAndObjectMoving autosar_swc_aeb_autosar_swc_aeb_Step_sys_Subsystem_Reference_AEB_Function_Run_AsyEvlrCritEve_Step_Func_Run_AsyEvlrCritEve_Step_Func_TAWrapper_PreProcessor_ObjectPreProcessor_ObjectPreProcessorLoop_ValidObject_CalculateTTRAndTTM_LongitudinalTTMComputer_CalculateTTI_StationaryHost autosar_swc_aeb_autosar_swc_aeb_Step_sys_Subsystem_Reference_AEB_Function_Run_AsyEvlrCritEve_Step_Func_Run_AsyEvlrCritEve_Step_Func_TAWrapper_PreProcessor_ObjectPreProcessor_ObjectPreProcessorLoop_ValidObject_CalculateTTRAndTTM_LongitudinalTTMComputer_CalculateTTI_StationaryObject /end SUB_GROUP
/end GROUP
/begin GROUP autosar_swc_aeb_autosar_swc_aeb_Step_sys_Subsystem_Reference_AEB_Function_Run_AsyEvlrCritEve_Step_Func_Run_AsyEvlrCritEve_Step_Func_TAWrapper_PreProcessor_ObjectPreProcessor_ObjectPreProcessorLoop_ValidObject_CalculateTTRAndTTM_LongitudinalTTMComputer_CalculateTTI_HostAndObjectMoving "autosar_swc_aeb/autosar_swc_aeb_Step_sys/Subsystem Reference/AEB Function/Run_AsyEvlrCritEve_Step_Func/Run_AsyEvlrCritEve_Step_Func/TAWrapper/PreProcessor/ObjectPreProcessor/ObjectPreProcessorLoop/ValidObject/CalculateTTRAndTTM/LongitudinalTTMComputer/CalculateTTI/HostAndObjectMoving"
 /begin SUB_GROUP autosar_swc_aeb_autosar_swc_aeb_Step_sys_Subsystem_Reference_AEB_Function_Run_AsyEvlrCritEve_Step_Func_Run_AsyEvlrCritEve_Step_Func_TAWrapper_PreProcessor_ObjectPreProcessor_ObjectPreProcessorLoop_ValidObject_CalculateTTRAndTTM_LongitudinalTTMComputer_CalculateTTI_HostAndObjectMoving_TimeToIntersectionComputer /end SUB_GROUP
/end GROUP
/begin GROUP autosar_swc_aeb_autosar_swc_aeb_Step_sys_Subsystem_Reference_AEB_Function_Run_AsyEvlrCritEve_Step_Func_Run_AsyEvlrCritEve_Step_Func_TAWrapper_PreProcessor_ObjectPreProcessor_ObjectPreProcessorLoop_ValidObject_CalculateTTRAndTTM_LongitudinalTTMComputer_CalculateTTI_StationaryHost "autosar_swc_aeb/autosar_swc_aeb_Step_sys/Subsystem Reference/AEB Function/Run_AsyEvlrCritEve_Step_Func/Run_AsyEvlrCritEve_Step_Func/TAWrapper/PreProcessor/ObjectPreProcessor/ObjectPreProcessorLoop/ValidObject/CalculateTTRAndTTM/LongitudinalTTMComputer/CalculateTTI/StationaryHost"
 /begin SUB_GROUP autosar_swc_aeb_autosar_swc_aeb_Step_sys_Subsystem_Reference_AEB_Function_Run_AsyEvlrCritEve_Step_Func_Run_AsyEvlrCritEve_Step_Func_TAWrapper_PreProcessor_ObjectPreProcessor_ObjectPreProcessorLoop_ValidObject_CalculateTTRAndTTM_LongitudinalTTMComputer_CalculateTTI_StationaryHost_TimeToIntersectionComputer /end SUB_GROUP
/end GROUP
/begin GROUP autosar_swc_aeb_autosar_swc_aeb_Step_sys_Subsystem_Reference_AEB_Function_Run_AsyEvlrCritEve_Step_Func_Run_AsyEvlrCritEve_Step_Func_TAWrapper_PreProcessor_ObjectPreProcessor_ObjectPreProcessorLoop_ValidObject_CalculateTTRAndTTM_LongitudinalTTMComputer_CalculateTTI_StationaryObject "autosar_swc_aeb/autosar_swc_aeb_Step_sys/Subsystem Reference/AEB Function/Run_AsyEvlrCritEve_Step_Func/Run_AsyEvlrCritEve_Step_Func/TAWrapper/PreProcessor/ObjectPreProcessor/ObjectPreProcessorLoop/ValidObject/CalculateTTRAndTTM/LongitudinalTTMComputer/CalculateTTI/StationaryObject"
 /begin SUB_GROUP autosar_swc_aeb_autosar_swc_aeb_Step_sys_Subsystem_Reference_AEB_Function_Run_AsyEvlrCritEve_Step_Func_Run_AsyEvlrCritEve_Step_Func_TAWrapper_PreProcessor_ObjectPreProcessor_ObjectPreProcessorLoop_ValidObject_CalculateTTRAndTTM_LongitudinalTTMComputer_CalculateTTI_StationaryObject_TimeToIntersectionComputer /end SUB_GROUP
/end GROUP
/begin GROUP autosar_swc_aeb_autosar_swc_aeb_Step_sys_Subsystem_Reference_AEB_Function_Run_AsyEvlrCritEve_Step_Func_Run_AsyEvlrCritEve_Step_Func_TAWrapper_PreProcessor_ObjectPreProcessor_ObjectPreProcessorLoop_ValidObject_CalculateTTRAndTTM_LongitudinalTTMComputer_SelectTTI "autosar_swc_aeb/autosar_swc_aeb_Step_sys/Subsystem Reference/AEB Function/Run_AsyEvlrCritEve_Step_Func/Run_AsyEvlrCritEve_Step_Func/TAWrapper/PreProcessor/ObjectPreProcessor/ObjectPreProcessorLoop/ValidObject/CalculateTTRAndTTM/LongitudinalTTMComputer/SelectTTI"
 /begin SUB_GROUP autosar_swc_aeb_autosar_swc_aeb_Step_sys_Subsystem_Reference_AEB_Function_Run_AsyEvlrCritEve_Step_Func_Run_AsyEvlrCritEve_Step_Func_TAWrapper_PreProcessor_ObjectPreProcessor_ObjectPreProcessorLoop_ValidObject_CalculateTTRAndTTM_LongitudinalTTMComputer_SelectTTI_CheckIfVehicleStops autosar_swc_aeb_autosar_swc_aeb_Step_sys_Subsystem_Reference_AEB_Function_Run_AsyEvlrCritEve_Step_Func_Run_AsyEvlrCritEve_Step_Func_TAWrapper_PreProcessor_ObjectPreProcessor_ObjectPreProcessorLoop_ValidObject_CalculateTTRAndTTM_LongitudinalTTMComputer_SelectTTI_CheckIfVehicleStops1 /end SUB_GROUP
/end GROUP
/begin GROUP autosar_swc_aeb_autosar_swc_aeb_Step_sys_Subsystem_Reference_AEB_Function_Run_AsyEvlrCritEve_Step_Func_Run_AsyEvlrCritEve_Step_Func_TAWrapper_PreProcessor_ObjectPreProcessor_ObjectPreProcessorLoop_ValidObject_CalculateTTRAndTTM_LongitudinalTTRComputer "autosar_swc_aeb/autosar_swc_aeb_Step_sys/Subsystem Reference/AEB Function/Run_AsyEvlrCritEve_Step_Func/Run_AsyEvlrCritEve_Step_Func/TAWrapper/PreProcessor/ObjectPreProcessor/ObjectPreProcessorLoop/ValidObject/CalculateTTRAndTTM/LongitudinalTTRComputer"
 /begin SUB_GROUP autosar_swc_aeb_autosar_swc_aeb_Step_sys_Subsystem_Reference_AEB_Function_Run_AsyEvlrCritEve_Step_Func_Run_AsyEvlrCritEve_Step_Func_TAWrapper_PreProcessor_ObjectPreProcessor_ObjectPreProcessorLoop_ValidObject_CalculateTTRAndTTM_LongitudinalTTRComputer_CalculateTTI autosar_swc_aeb_autosar_swc_aeb_Step_sys_Subsystem_Reference_AEB_Function_Run_AsyEvlrCritEve_Step_Func_Run_AsyEvlrCritEve_Step_Func_TAWrapper_PreProcessor_ObjectPreProcessor_ObjectPreProcessorLoop_ValidObject_CalculateTTRAndTTM_LongitudinalTTRComputer_SelectTTI /end SUB_GROUP
/end GROUP
/begin GROUP autosar_swc_aeb_autosar_swc_aeb_Step_sys_Subsystem_Reference_AEB_Function_Run_AsyEvlrCritEve_Step_Func_Run_AsyEvlrCritEve_Step_Func_TAWrapper_PreProcessor_ObjectPreProcessor_ObjectPreProcessorLoop_ValidObject_CalculateTTRAndTTM_LongitudinalTTRComputer_CalculateTTI "autosar_swc_aeb/autosar_swc_aeb_Step_sys/Subsystem Reference/AEB Function/Run_AsyEvlrCritEve_Step_Func/Run_AsyEvlrCritEve_Step_Func/TAWrapper/PreProcessor/ObjectPreProcessor/ObjectPreProcessorLoop/ValidObject/CalculateTTRAndTTM/LongitudinalTTRComputer/CalculateTTI"
 /begin SUB_GROUP autosar_swc_aeb_autosar_swc_aeb_Step_sys_Subsystem_Reference_AEB_Function_Run_AsyEvlrCritEve_Step_Func_Run_AsyEvlrCritEve_Step_Func_TAWrapper_PreProcessor_ObjectPreProcessor_ObjectPreProcessorLoop_ValidObject_CalculateTTRAndTTM_LongitudinalTTRComputer_CalculateTTI_HostAndObjectMoving autosar_swc_aeb_autosar_swc_aeb_Step_sys_Subsystem_Reference_AEB_Function_Run_AsyEvlrCritEve_Step_Func_Run_AsyEvlrCritEve_Step_Func_TAWrapper_PreProcessor_ObjectPreProcessor_ObjectPreProcessorLoop_ValidObject_CalculateTTRAndTTM_LongitudinalTTRComputer_CalculateTTI_StationaryHost autosar_swc_aeb_autosar_swc_aeb_Step_sys_Subsystem_Reference_AEB_Function_Run_AsyEvlrCritEve_Step_Func_Run_AsyEvlrCritEve_Step_Func_TAWrapper_PreProcessor_ObjectPreProcessor_ObjectPreProcessorLoop_ValidObject_CalculateTTRAndTTM_LongitudinalTTRComputer_CalculateTTI_StationaryObject /end SUB_GROUP
/end GROUP
/begin GROUP autosar_swc_aeb_autosar_swc_aeb_Step_sys_Subsystem_Reference_AEB_Function_Run_AsyEvlrCritEve_Step_Func_Run_AsyEvlrCritEve_Step_Func_TAWrapper_PreProcessor_ObjectPreProcessor_ObjectPreProcessorLoop_ValidObject_CalculateTTRAndTTM_LongitudinalTTRComputer_CalculateTTI_HostAndObjectMoving "autosar_swc_aeb/autosar_swc_aeb_Step_sys/Subsystem Reference/AEB Function/Run_AsyEvlrCritEve_Step_Func/Run_AsyEvlrCritEve_Step_Func/TAWrapper/PreProcessor/ObjectPreProcessor/ObjectPreProcessorLoop/ValidObject/CalculateTTRAndTTM/LongitudinalTTRComputer/CalculateTTI/HostAndObjectMoving"
 /begin SUB_GROUP autosar_swc_aeb_autosar_swc_aeb_Step_sys_Subsystem_Reference_AEB_Function_Run_AsyEvlrCritEve_Step_Func_Run_AsyEvlrCritEve_Step_Func_TAWrapper_PreProcessor_ObjectPreProcessor_ObjectPreProcessorLoop_ValidObject_CalculateTTRAndTTM_LongitudinalTTRComputer_CalculateTTI_HostAndObjectMoving_TimeToIntersectionComputer /end SUB_GROUP
/end GROUP
/begin GROUP autosar_swc_aeb_autosar_swc_aeb_Step_sys_Subsystem_Reference_AEB_Function_Run_AsyEvlrCritEve_Step_Func_Run_AsyEvlrCritEve_Step_Func_TAWrapper_PreProcessor_ObjectPreProcessor_ObjectPreProcessorLoop_ValidObject_CalculateTTRAndTTM_LongitudinalTTRComputer_CalculateTTI_StationaryHost "autosar_swc_aeb/autosar_swc_aeb_Step_sys/Subsystem Reference/AEB Function/Run_AsyEvlrCritEve_Step_Func/Run_AsyEvlrCritEve_Step_Func/TAWrapper/PreProcessor/ObjectPreProcessor/ObjectPreProcessorLoop/ValidObject/CalculateTTRAndTTM/LongitudinalTTRComputer/CalculateTTI/StationaryHost"
 /begin SUB_GROUP autosar_swc_aeb_autosar_swc_aeb_Step_sys_Subsystem_Reference_AEB_Function_Run_AsyEvlrCritEve_Step_Func_Run_AsyEvlrCritEve_Step_Func_TAWrapper_PreProcessor_ObjectPreProcessor_ObjectPreProcessorLoop_ValidObject_CalculateTTRAndTTM_LongitudinalTTRComputer_CalculateTTI_StationaryHost_TimeToIntersectionComputer /end SUB_GROUP
/end GROUP
/begin GROUP autosar_swc_aeb_autosar_swc_aeb_Step_sys_Subsystem_Reference_AEB_Function_Run_AsyEvlrCritEve_Step_Func_Run_AsyEvlrCritEve_Step_Func_TAWrapper_PreProcessor_ObjectPreProcessor_ObjectPreProcessorLoop_ValidObject_CalculateTTRAndTTM_LongitudinalTTRComputer_CalculateTTI_StationaryObject "autosar_swc_aeb/autosar_swc_aeb_Step_sys/Subsystem Reference/AEB Function/Run_AsyEvlrCritEve_Step_Func/Run_AsyEvlrCritEve_Step_Func/TAWrapper/PreProcessor/ObjectPreProcessor/ObjectPreProcessorLoop/ValidObject/CalculateTTRAndTTM/LongitudinalTTRComputer/CalculateTTI/StationaryObject"
 /begin SUB_GROUP autosar_swc_aeb_autosar_swc_aeb_Step_sys_Subsystem_Reference_AEB_Function_Run_AsyEvlrCritEve_Step_Func_Run_AsyEvlrCritEve_Step_Func_TAWrapper_PreProcessor_ObjectPreProcessor_ObjectPreProcessorLoop_ValidObject_CalculateTTRAndTTM_LongitudinalTTRComputer_CalculateTTI_StationaryObject_TimeToIntersectionComputer /end SUB_GROUP
/end GROUP
/begin GROUP autosar_swc_aeb_autosar_swc_aeb_Step_sys_Subsystem_Reference_AEB_Function_Run_AsyEvlrCritEve_Step_Func_Run_AsyEvlrCritEve_Step_Func_TAWrapper_PreProcessor_ObjectPreProcessor_ObjectPreProcessorLoop_ValidObject_DetermineMotionType "autosar_swc_aeb/autosar_swc_aeb_Step_sys/Subsystem Reference/AEB Function/Run_AsyEvlrCritEve_Step_Func/Run_AsyEvlrCritEve_Step_Func/TAWrapper/PreProcessor/ObjectPreProcessor/ObjectPreProcessorLoop/ValidObject/DetermineMotionType" /begin REF_CHARACTERISTIC CLTS_ObjCrvtRotThdInAsyEvlrCritEve_Ca /end REF_CHARACTERISTIC /end GROUP
/begin GROUP autosar_swc_aeb_autosar_swc_aeb_Step_sys_Subsystem_Reference_AEB_Function_Run_AsyEvlrCritEve_Step_Func_Run_AsyEvlrCritEve_Step_Func_TAWrapper_PreProcessor_ObjectPreProcessor_ObjectPreProcessorLoop_ValidObject_SafetyMarginFrontObjects_DetermineOffsets_LateralInPathOffset_SelectObjectWidth "autosar_swc_aeb/autosar_swc_aeb_Step_sys/Subsystem Reference/AEB Function/Run_AsyEvlrCritEve_Step_Func/Run_AsyEvlrCritEve_Step_Func/TAWrapper/PreProcessor/ObjectPreProcessor/ObjectPreProcessorLoop/ValidObject/SafetyMarginFrontObjects/DetermineOffsets/LateralInPathOffset/SelectObjectWidth" /begin REF_CHARACTERISTIC CLTS_BicycleWidthDftInAsyEvlrCritEve_Ca /end REF_CHARACTERISTIC /end GROUP
/begin GROUP autosar_swc_aeb_autosar_swc_aeb_Step_sys_Subsystem_Reference_AEB_Function_Run_AsyEvlrCritEve_Step_Func_Run_AsyEvlrCritEve_Step_Func_TAWrapper_PreProcessor_ObjectPreProcessor_ObjectPreProcessorLoop_ValidObject_SafetyMarginFrontObjects_DetermineOffsets_LateralInPathOffset_VerifyOffsetOverlap "autosar_swc_aeb/autosar_swc_aeb_Step_sys/Subsystem Reference/AEB Function/Run_AsyEvlrCritEve_Step_Func/Run_AsyEvlrCritEve_Step_Func/TAWrapper/PreProcessor/ObjectPreProcessor/ObjectPreProcessorLoop/ValidObject/SafetyMarginFrontObjects/DetermineOffsets/LateralInPathOffset/VerifyOffsetOverlap" /begin REF_CHARACTERISTIC CLTS_BicycleSpdThdForSpdLoInAsyEvlrCritEve_Ca /end REF_CHARACTERISTIC /end GROUP
/begin GROUP autosar_swc_aeb_autosar_swc_aeb_Step_sys_Subsystem_Reference_AEB_Function_Run_AsyEvlrCritEve_Step_Func_Run_AsyEvlrCritEve_Step_Func_TAWrapper_PreProcessor_ObjectPreProcessor_ObjectPreProcessorLoop_ValidObject_SafetyMarginFrontObjects_InPathCalculationWithCurrentObjPositions_CheckSteeringOutOfPath_CheckIfObjectTriesToManoeuver "autosar_swc_aeb/autosar_swc_aeb_Step_sys/Subsystem Reference/AEB Function/Run_AsyEvlrCritEve_Step_Func/Run_AsyEvlrCritEve_Step_Func/TAWrapper/PreProcessor/ObjectPreProcessor/ObjectPreProcessorLoop/ValidObject/SafetyMarginFrontObjects/InPathCalculationWithCurrentObjPositions/CheckSteeringOutOfPath/CheckIfObjectTriesToManoeuver" /begin REF_CHARACTERISTIC CLTS_AgDirForBrkgMinInAsyEvlrCritEve_Ca /end REF_CHARACTERISTIC /end GROUP
/begin GROUP autosar_swc_aeb_autosar_swc_aeb_Step_sys_Subsystem_Reference_AEB_Function_Run_AsyEvlrCritEve_Step_Func_Run_AsyEvlrCritEve_Step_Func_TAWrapper_PreProcessor_ObjectPreProcessor_ObjectPreProcessorLoop_ValidObject_SafetyMarginFrontObjects_InPathCalculationWithPredictedObjPositions_CreateInPathDataTTM_CalculateAccelerationAndPredictPosition_CircularPrediction_AccelerationCalculationAndCircularPredictionOfTurningObjAtTTR1_CalculateCurvature "autosar_swc_aeb/autosar_swc_aeb_Step_sys/Subsystem Reference/AEB Function/Run_AsyEvlrCritEve_Step_Func/Run_AsyEvlrCritEve_Step_Func/TAWrapper/PreProcessor/ObjectPreProcessor/ObjectPreProcessorLoop/ValidObject/SafetyMarginFrontObjects/InPathCalculationWithPredictedObjPositions/CreateInPathDataTTM/CalculateAccelerationAndPredictPosition/CircularPrediction/AccelerationCalculationAndCircularPredictionOfTurningObjAtTTR1/CalculateCurvature" /begin REF_CHARACTERISTIC CLTS_ObjCrvtRotThdInAsyEvlrCritEve_Ca /end REF_CHARACTERISTIC /end GROUP
/begin GROUP autosar_swc_aeb_autosar_swc_aeb_Step_sys_Subsystem_Reference_AEB_Function_Run_AsyEvlrCritEve_Step_Func_Run_AsyEvlrCritEve_Step_Func_TAWrapper_PreProcessor_ObjectPreProcessor_ObjectPreProcessorLoop_ValidObject_SafetyMarginFrontObjects_InPathCalculationWithPredictedObjPositions_CreateInPathDataTTM_CalculateAccelerationAndPredictPosition_CircularPrediction_AccelerationCalculationAndCircularPredictionOfTurningObjAtTTR_CalculateCurvature "autosar_swc_aeb/autosar_swc_aeb_Step_sys/Subsystem Reference/AEB Function/Run_AsyEvlrCritEve_Step_Func/Run_AsyEvlrCritEve_Step_Func/TAWrapper/PreProcessor/ObjectPreProcessor/ObjectPreProcessorLoop/ValidObject/SafetyMarginFrontObjects/InPathCalculationWithPredictedObjPositions/CreateInPathDataTTM/CalculateAccelerationAndPredictPosition/CircularPrediction/AccelerationCalculationAndCircularPredictionOfTurningObjAtTTR/CalculateCurvature" /begin REF_CHARACTERISTIC CLTS_ObjCrvtRotThdInAsyEvlrCritEve_Ca /end REF_CHARACTERISTIC /end GROUP
/begin GROUP autosar_swc_aeb_autosar_swc_aeb_Step_sys_Subsystem_Reference_AEB_Function_Run_AsyEvlrCritEve_Step_Func_Run_AsyEvlrCritEve_Step_Func_TAWrapper_PreProcessor_ObjectPreProcessor_ObjectPreProcessorLoop_ValidObject_SafetyMarginFrontObjects_InPathCalculationWithPredictedObjPositions_CreateInPathDataTTM_CheckBrakingAndSteering_CheckIfObjectTriesToManoeuver "autosar_swc_aeb/autosar_swc_aeb_Step_sys/Subsystem Reference/AEB Function/Run_AsyEvlrCritEve_Step_Func/Run_AsyEvlrCritEve_Step_Func/TAWrapper/PreProcessor/ObjectPreProcessor/ObjectPreProcessorLoop/ValidObject/SafetyMarginFrontObjects/InPathCalculationWithPredictedObjPositions/CreateInPathDataTTM/CheckBrakingAndSteering/CheckIfObjectTriesToManoeuver" /begin REF_CHARACTERISTIC CLTS_AgDirForBrkgMinInAsyEvlrCritEve_Ca /end REF_CHARACTERISTIC /end GROUP
/begin GROUP autosar_swc_aeb_autosar_swc_aeb_Step_sys_Subsystem_Reference_AEB_Function_Run_AsyEvlrCritEve_Step_Func_Run_AsyEvlrCritEve_Step_Func_TAWrapper_PreProcessor_ObjectPreProcessor_ObjectPreProcessorLoop_ValidObject_SafetyMarginFrontObjects_InPathCalculationWithPredictedObjPositions_CreateInPathDataTTR_CalculateAccelerationAndPredictPosition_CircularPrediction_AccelerationCalculationAndCircularPredictionOfTurningObjAtTTR1_CalculateCurvature "autosar_swc_aeb/autosar_swc_aeb_Step_sys/Subsystem Reference/AEB Function/Run_AsyEvlrCritEve_Step_Func/Run_AsyEvlrCritEve_Step_Func/TAWrapper/PreProcessor/ObjectPreProcessor/ObjectPreProcessorLoop/ValidObject/SafetyMarginFrontObjects/InPathCalculationWithPredictedObjPositions/CreateInPathDataTTR/CalculateAccelerationAndPredictPosition/CircularPrediction/AccelerationCalculationAndCircularPredictionOfTurningObjAtTTR1/CalculateCurvature" /begin REF_CHARACTERISTIC CLTS_ObjCrvtRotThdInAsyEvlrCritEve_Ca /end REF_CHARACTERISTIC /end GROUP
/begin GROUP autosar_swc_aeb_autosar_swc_aeb_Step_sys_Subsystem_Reference_AEB_Function_Run_AsyEvlrCritEve_Step_Func_Run_AsyEvlrCritEve_Step_Func_TAWrapper_PreProcessor_ObjectPreProcessor_ObjectPreProcessorLoop_ValidObject_SafetyMarginFrontObjects_InPathCalculationWithPredictedObjPositions_CreateInPathDataTTR_CalculateAccelerationAndPredictPosition_CircularPrediction_AccelerationCalculationAndCircularPredictionOfTurningObjAtTTR_CalculateCurvature "autosar_swc_aeb/autosar_swc_aeb_Step_sys/Subsystem Reference/AEB Function/Run_AsyEvlrCritEve_Step_Func/Run_AsyEvlrCritEve_Step_Func/TAWrapper/PreProcessor/ObjectPreProcessor/ObjectPreProcessorLoop/ValidObject/SafetyMarginFrontObjects/InPathCalculationWithPredictedObjPositions/CreateInPathDataTTR/CalculateAccelerationAndPredictPosition/CircularPrediction/AccelerationCalculationAndCircularPredictionOfTurningObjAtTTR/CalculateCurvature" /begin REF_CHARACTERISTIC CLTS_ObjCrvtRotThdInAsyEvlrCritEve_Ca /end REF_CHARACTERISTIC /end GROUP
/begin GROUP autosar_swc_aeb_autosar_swc_aeb_Step_sys_Subsystem_Reference_AEB_Function_Run_AsyEvlrCritEve_Step_Func_Run_AsyEvlrCritEve_Step_Func_TAWrapper_PreProcessor_ObjectPreProcessor_ObjectPreProcessorLoop_ValidObject_SafetyMarginFrontObjects_InPathCalculationWithPredictedObjPositions_CreateInPathDataTTR_CheckBrakingAndSteering_CheckIfObjectTriesToManoeuver "autosar_swc_aeb/autosar_swc_aeb_Step_sys/Subsystem Reference/AEB Function/Run_AsyEvlrCritEve_Step_Func/Run_AsyEvlrCritEve_Step_Func/TAWrapper/PreProcessor/ObjectPreProcessor/ObjectPreProcessorLoop/ValidObject/SafetyMarginFrontObjects/InPathCalculationWithPredictedObjPositions/CreateInPathDataTTR/CheckBrakingAndSteering/CheckIfObjectTriesToManoeuver" /begin REF_CHARACTERISTIC CLTS_AgDirForBrkgMinInAsyEvlrCritEve_Ca /end REF_CHARACTERISTIC /end GROUP
/begin GROUP autosar_swc_aeb_autosar_swc_aeb_Step_sys_Subsystem_Reference_AEB_Function_Run_CllsnRednByBrkgCtrl_Step_Func_Run_CllsnRednByBrkg_Step_CollisionMitigationSystem_EvaluationCMbBInput_CritLgtEvaluation_Deactivate_HighTTCTime "autosar_swc_aeb/autosar_swc_aeb_Step_sys/Subsystem Reference/AEB Function/Run_CllsnRednByBrkgCtrl_Step_Func/Run_CllsnRednByBrkg_Step/CollisionMitigationSystem/EvaluationCMbBInput/CritLgtEvaluation/Deactivate/HighTTCTime" /begin REF_CHARACTERISTIC P_AEB_CalTTRThrethold /end REF_CHARACTERISTIC /end GROUP
/begin GROUP autosar_swc_aeb_autosar_swc_aeb_Step_sys_Subsystem_Reference_AEB_Function_Run_CllsnRednByBrkgCtrl_Step_Func_Run_CllsnRednByBrkg_Step_CollisionMitigationSystem_EvaluationCMbBInput_CritLgtEvaluation_EvaluateFullBrakingConditions "autosar_swc_aeb/autosar_swc_aeb_Step_sys/Subsystem Reference/AEB Function/Run_CllsnRednByBrkgCtrl_Step_Func/Run_CllsnRednByBrkg_Step/CollisionMitigationSystem/EvaluationCMbBInput/CritLgtEvaluation/EvaluateFullBrakingConditions" /begin REF_CHARACTERISTIC P_AEB_CalTTRThrethold /end REF_CHARACTERISTIC /end GROUP
/begin GROUP autosar_swc_aeb_autosar_swc_aeb_Step_sys_Subsystem_Reference_AEB_Function_Run_CllsnRednByBrkgCtrl_Step_Func_Run_CllsnRednByBrkg_Step_CollisionMitigationSystem_EvaluationCMbBInput_CritLgtEvaluation_EvaluateFullBrakingConditions_BrakingThreat "autosar_swc_aeb/autosar_swc_aeb_Step_sys/Subsystem Reference/AEB Function/Run_CllsnRednByBrkgCtrl_Step_Func/Run_CllsnRednByBrkg_Step/CollisionMitigationSystem/EvaluationCMbBInput/CritLgtEvaluation/EvaluateFullBrakingConditions/BrakingThreat" /begin REF_CHARACTERISTIC P_AEB_CalTTRThrethold /end REF_CHARACTERISTIC /end GROUP
/begin GROUP autosar_swc_aeb_autosar_swc_aeb_Step_sys_Subsystem_Reference_AEB_Function_Run_CllsnRednByBrkgCtrl_Step_Func_Run_CllsnRednByBrkg_Step_CollisionMitigationSystem_EvaluationCMbBInput_CritLgtEvaluation_EvaluatePreBrakingConditions "autosar_swc_aeb/autosar_swc_aeb_Step_sys/Subsystem Reference/AEB Function/Run_CllsnRednByBrkgCtrl_Step_Func/Run_CllsnRednByBrkg_Step/CollisionMitigationSystem/EvaluationCMbBInput/CritLgtEvaluation/EvaluatePreBrakingConditions" /begin REF_CHARACTERISTIC P_AEB_CalTTRThrethold /end REF_CHARACTERISTIC /end GROUP
/begin GROUP autosar_swc_aeb_autosar_swc_aeb_Step_sys_Subsystem_Reference_AEB_Function_Run_CllsnRednByBrkgCtrl_Step_Func_Run_CllsnRednByBrkg_Step_CollisionMitigationSystem_EvaluationCMbBInput_CritLgtEvaluation_EvaluatePreBrakingConditions_BrakingThreat "autosar_swc_aeb/autosar_swc_aeb_Step_sys/Subsystem Reference/AEB Function/Run_CllsnRednByBrkgCtrl_Step_Func/Run_CllsnRednByBrkg_Step/CollisionMitigationSystem/EvaluationCMbBInput/CritLgtEvaluation/EvaluatePreBrakingConditions/BrakingThreat" /begin REF_CHARACTERISTIC P_AEB_CalTTRThrethold /end REF_CHARACTERISTIC /end GROUP
/begin GROUP autosar_swc_aeb_autosar_swc_aeb_Step_sys_Subsystem_Reference_AEB_Function_Sceniaro_Analysis "autosar_swc_aeb/autosar_swc_aeb_Step_sys/Subsystem Reference/AEB Function/Sceniaro Analysis" /begin REF_CHARACTERISTIC P_AEB_CalTTRThrethold /end REF_CHARACTERISTIC /end GROUP
/begin RECORD_LAYOUT Record_BOOLEAN FNC_VALUES 1 UBYTE COLUMN_DIR DIRECT /end RECORD_LAYOUT
/begin RECORD_LAYOUT Record_FLOAT32_IEEE FNC_VALUES 1 FLOAT32_IEEE COLUMN_DIR DIRECT /end RECORD_LAYOUT
/begin RECORD_LAYOUT Axis_FLOAT32_IEEE AXIS_PTS_X 1 FLOAT32_IEEE INDEX_INCR DIRECT /end RECORD_LAYOUT
/begin RECORD_LAYOUT Record_BOOLEAN FNC_VALUES 1 UBYTE COLUMN_DIR DIRECT /end RECORD_LAYOUT
/begin RECORD_LAYOUT Record_FLOAT32_IEEE FNC_VALUES 1 FLOAT32_IEEE COLUMN_DIR DIRECT /end RECORD_LAYOUT
/begin RECORD_LAYOUT Record_FLOAT64_IEEE FNC_VALUES 1 FLOAT64_IEEE COLUMN_DIR DIRECT /end RECORD_LAYOUT
/begin RECORD_LAYOUT Record_BOOLEAN FNC_VALUES 1 UBYTE COLUMN_DIR DIRECT /end RECORD_LAYOUT
/begin RECORD_LAYOUT Record_FLOAT32_IEEE FNC_VALUES 1 FLOAT32_IEEE COLUMN_DIR DIRECT /end RECORD_LAYOUT
/begin RECORD_LAYOUT Record_SBYTE FNC_VALUES 1 SBYTE COLUMN_DIR DIRECT /end RECORD_LAYOUT
/begin RECORD_LAYOUT Axis_FLOAT32_IEEE AXIS_PTS_X 1 FLOAT32_IEEE INDEX_INCR DIRECT /end RECORD_LAYOUT
/begin RECORD_LAYOUT Record_BOOLEAN FNC_VALUES 1 UBYTE COLUMN_DIR DIRECT /end RECORD_LAYOUT
/begin RECORD_LAYOUT Record_FLOAT32_IEEE FNC_VALUES 1 FLOAT32_IEEE COLUMN_DIR DIRECT /end RECORD_LAYOUT
/begin RECORD_LAYOUT Record_FLOAT64_IEEE FNC_VALUES 1 FLOAT64_IEEE COLUMN_DIR DIRECT /end RECORD_LAYOUT
/begin RECORD_LAYOUT Record_SBYTE FNC_VALUES 1 SBYTE COLUMN_DIR DIRECT /end RECORD_LAYOUT
/begin RECORD_LAYOUT Axis_FLOAT32_IEEE AXIS_PTS_X 1 FLOAT32_IEEE INDEX_INCR DIRECT /end RECORD_LAYOUT
/begin RECORD_LAYOUT Record_BOOLEAN FNC_VALUES 1 UBYTE COLUMN_DIR DIRECT /end RECORD_LAYOUT
/begin RECORD_LAYOUT Record_FLOAT32_IEEE FNC_VALUES 1 FLOAT32_IEEE COLUMN_DIR DIRECT /end RECORD_LAYOUT
/begin RECORD_LAYOUT Record_FLOAT64_IEEE FNC_VALUES 1 FLOAT64_IEEE COLUMN_DIR DIRECT /end RECORD_LAYOUT
/begin RECORD_LAYOUT Record_SBYTE FNC_VALUES 1 SBYTE COLUMN_DIR DIRECT /end RECORD_LAYOUT
/begin RECORD_LAYOUT Axis_FLOAT32_IEEE AXIS_PTS_X 1 FLOAT32_IEEE INDEX_INCR DIRECT /end RECORD_LAYOUT
/begin RECORD_LAYOUT Record_BOOLEAN FNC_VALUES 1 UBYTE COLUMN_DIR DIRECT /end RECORD_LAYOUT
/begin RECORD_LAYOUT Record_FLOAT32_IEEE FNC_VALUES 1 FLOAT32_IEEE COLUMN_DIR DIRECT /end RECORD_LAYOUT
/begin RECORD_LAYOUT Record_FLOAT64_IEEE FNC_VALUES 1 FLOAT64_IEEE COLUMN_DIR DIRECT /end RECORD_LAYOUT
/begin RECORD_LAYOUT Record_SBYTE FNC_VALUES 1 SBYTE COLUMN_DIR DIRECT /end RECORD_LAYOUT
/begin RECORD_LAYOUT Record_BOOLEAN FNC_VALUES 1 UBYTE COLUMN_DIR DIRECT /end RECORD_LAYOUT
/begin RECORD_LAYOUT Record_FLOAT32_IEEE FNC_VALUES 1 FLOAT32_IEEE COLUMN_DIR DIRECT /end RECORD_LAYOUT
/begin RECORD_LAYOUT Record_FLOAT64_IEEE FNC_VALUES 1 FLOAT64_IEEE COLUMN_DIR DIRECT /end RECORD_LAYOUT
/begin RECORD_LAYOUT Record_SBYTE FNC_VALUES 1 SBYTE COLUMN_DIR DIRECT /end RECORD_LAYOUT
/begin RECORD_LAYOUT Axis_FLOAT32_IEEE AXIS_PTS_X 1 FLOAT32_IEEE INDEX_INCR DIRECT /end RECORD_LAYOUT
/begin RECORD_LAYOUT Record_BOOLEAN FNC_VALUES 1 UBYTE COLUMN_DIR DIRECT /end RECORD_LAYOUT
/begin RECORD_LAYOUT Record_FLOAT32_IEEE FNC_VALUES 1 FLOAT32_IEEE COLUMN_DIR DIRECT /end RECORD_LAYOUT
/begin RECORD_LAYOUT Record_FLOAT64_IEEE FNC_VALUES 1 FLOAT64_IEEE COLUMN_DIR DIRECT /end RECORD_LAYOUT
/begin RECORD_LAYOUT Record_SBYTE FNC_VALUES 1 SBYTE COLUMN_DIR DIRECT /end RECORD_LAYOUT
/begin RECORD_LAYOUT Axis_FLOAT32_IEEE AXIS_PTS_X 1 FLOAT32_IEEE INDEX_INCR DIRECT /end RECORD_LAYOUT
/begin RECORD_LAYOUT Record_BOOLEAN FNC_VALUES 1 UBYTE COLUMN_DIR DIRECT /end RECORD_LAYOUT
/begin RECORD_LAYOUT Record_FLOAT32_IEEE FNC_VALUES 1 FLOAT32_IEEE COLUMN_DIR DIRECT /end RECORD_LAYOUT
/begin RECORD_LAYOUT Record_FLOAT64_IEEE FNC_VALUES 1 FLOAT64_IEEE COLUMN_DIR DIRECT /end RECORD_LAYOUT
/begin RECORD_LAYOUT Record_SBYTE FNC_VALUES 1 SBYTE COLUMN_DIR DIRECT /end RECORD_LAYOUT
/begin RECORD_LAYOUT Axis_FLOAT32_IEEE AXIS_PTS_X 1 FLOAT32_IEEE INDEX_INCR DIRECT /end RECORD_LAYOUT
/begin RECORD_LAYOUT Record_BOOLEAN FNC_VALUES 1 UBYTE COLUMN_DIR DIRECT /end RECORD_LAYOUT
/begin RECORD_LAYOUT Record_FLOAT32_IEEE FNC_VALUES 1 FLOAT32_IEEE COLUMN_DIR DIRECT /end RECORD_LAYOUT
/begin RECORD_LAYOUT Record_FLOAT64_IEEE FNC_VALUES 1 FLOAT64_IEEE COLUMN_DIR DIRECT /end RECORD_LAYOUT
/begin RECORD_LAYOUT Record_SBYTE FNC_VALUES 1 SBYTE COLUMN_DIR DIRECT /end RECORD_LAYOUT
/begin RECORD_LAYOUT Axis_FLOAT32_IEEE AXIS_PTS_X 1 FLOAT32_IEEE INDEX_INCR DIRECT /end RECORD_LAYOUT
/end MODULE
/end PROJECT
