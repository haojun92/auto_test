ASAP2_VERSION 1 71
/begin PROJECT ProjectName ""
/begin MODULE ModuleName ""
/begin MOD_COMMON "" BYTE_ORDER MSB_LAST ALIGNMENT_BYTE 1 ALIGNMENT_WORD 1 ALIGNMENT_LONG 1 ALIGNMENT_INT64 1 ALIGNMENT_FLOAT16_IEEE 1 ALIGNMENT_FLOAT32_IEEE 1 ALIGNMENT_FLOAT64_IEEE 1 /end MOD_COMMON
/begin RECORD_LAYOUT __SLONG_Z FNC_VALUES 1 SLONG ROW_DIR DIRECT /end RECORD_LAYOUT
/begin CHARACTERISTIC CLTS_ALgtFiltParam1InAsyEvlrCritEve_Ca "See describtion for further details" VALUE 0xfe503cc0 /* @ECU_Address@CLTS_ALgtFiltParam1InAsyEvlrCritEve_Ca@ */ Record_FLOAT32_IEEE 0 autosar_swc_aeb_CM_single -5.000000 5.000000 /end CHARACTERISTIC
/begin CHARACTERISTIC CLTS_ALgtFiltParam2InAsyEvlrCritEve_Ca "See describtion for further details" VALUE 0xfe503cc4 /* @ECU_Address@CLTS_ALgtFiltParam2InAsyEvlrCritEve_Ca@ */ Record_FLOAT32_IEEE 0 autosar_swc_aeb_CM_single -5.000000 5.000000 /end CHARACTERISTIC
/begin CHARACTERISTIC CLTS_ALgtFiltParam3InAsyEvlrCritEve_Ca "See describtion for further details" VALUE 0xfe503cc8 /* @ECU_Address@CLTS_ALgtFiltParam3InAsyEvlrCritEve_Ca@ */ Record_FLOAT32_IEEE 0 autosar_swc_aeb_CM_single -5.000000 5.000000 /end CHARACTERISTIC
/begin CHARACTERISTIC CLTS_ALgtFiltParam4InAsyEvlrCritEve_Ca "See describtion for further details" VALUE 0xfe503ccc /* @ECU_Address@CLTS_ALgtFiltParam4InAsyEvlrCritEve_Ca@ */ Record_FLOAT32_IEEE 0 autosar_swc_aeb_CM_single -5.000000 5.000000 /end CHARACTERISTIC
/begin CHARACTERISTIC CLTS_ALgtFiltParam5InAsyEvlrCritEve_Ca "See describtion for further details" VALUE 0xfe503cd0 /* @ECU_Address@CLTS_ALgtFiltParam5InAsyEvlrCritEve_Ca@ */ Record_FLOAT32_IEEE 0 autosar_swc_aeb_CM_single -5.000000 5.000000 /end CHARACTERISTIC
/begin CHARACTERISTIC CLTS_BicycleSpdThdLatInPahInAsyEvlrCritEve_Ca "Bicycle lateral speed threshold for strict in path calculation." VALUE 0xfe503d18 /* @ECU_Address@CLTS_BicycleSpdThdLatInPahInAsyEvlrCritEve_Ca@ */ Record_FLOAT32_IEEE 0 autosar_swc_aeb_CM_single_m_per_s 0.000000 5.000000 /end CHARACTERISTIC
/begin CHARACTERISTIC CLTS_CrvtTypTblInAsyEvlrCritEve_Ca "Weight factor when mixing yaw rate based and pinion angle based curvature." CURVE 0xfe503c9c /* @ECU_Address@CLTS_CrvtTypTblInAsyEvlrCritEve_Ca@ */ Record_FLOAT32_IEEE 0 autosar_swc_aeb_CM_single 0.000000 1.000000
 /begin AXIS_DESCR COM_AXIS NO_INPUT_QUANTITY autosar_swc_aeb_CM_single_m_per_s 2 0.000000 100.000000 AXIS_PTS_REF CLTS_VLgtValForCrvtTypTblInAsyEvlrCritEve_Ca /end AXIS_DESCR
/end CHARACTERISTIC
/begin CHARACTERISTIC CLTS_ObjSpdThdLatInPahInAsyEvlrCritEve_Ca "Object lateral speed threshold for strict in path calculation." VALUE 0xfe503d78 /* @ECU_Address@CLTS_ObjSpdThdLatInPahInAsyEvlrCritEve_Ca@ */ Record_FLOAT32_IEEE 0 autosar_swc_aeb_CM_single_m_per_s 0.000000 5.000000 /end CHARACTERISTIC
/begin CHARACTERISTIC CLTS_PinionAgRateFilConInAsyEvlrCritEve_Ca "Filter constant in low pass filter for pinion angle rate." VALUE 0xfe503d98 /* @ECU_Address@CLTS_PinionAgRateFilConInAsyEvlrCritEve_Ca@ */ Record_FLOAT32_IEEE 0 autosar_swc_aeb_CM_single 0.000000 1.000000 /end CHARACTERISTIC
/begin CHARACTERISTIC CLTS_SpdLimLoForChkPreBrkActvInAsyEvlrCritEve_Ca "The lower speed limit below which pre brake does not trigger CMbB Active." VALUE 0xfe503db4 /* @ECU_Address@CLTS_SpdLimLoForChkPreBrkActvInAsyEvlrCritEve_Ca@ */ Record_FLOAT32_IEEE 0 autosar_swc_aeb_CM_single_m_per_s 0.000000 8.300000 /end CHARACTERISTIC
/begin CHARACTERISTIC CLTS_TiDlyForCllsnRednByBrkgActvInAsyEvlrCritEve_Ca "The time delay from CMbB active until TA regards CMbB as active" VALUE 0xfe503dd0 /* @ECU_Address@CLTS_TiDlyForCllsnRednByBrkgActvInAsyEvlrCritEve_Ca@ */ Record_FLOAT32_IEEE 0 autosar_swc_aeb_CM_single_s 0.000000 10.000000 /end CHARACTERISTIC
/begin CHARACTERISTIC CLTS_TiUpprLimCMbBActvInAsyEvlrCritEve_Ca "Upper limit for TimeToReach used in InPath decision" VALUE 0xfe503ddc /* @ECU_Address@CLTS_TiUpprLimCMbBActvInAsyEvlrCritEve_Ca@ */ Record_FLOAT32_IEEE 0 autosar_swc_aeb_CM_single_s 0.000000 100.000000 /end CHARACTERISTIC
/begin CHARACTERISTIC FCW_ALatRqrdMaxForSteerInCllsnFwdWarnCtrl_Ca "Absolute lateral acceleration required to avoid collision threshold for when the driver can steer away easily. Below this value it is easy to steer away. Above this value it is not easy to steer away." CURVE 0xfe5047c0 /* @ECU_Address@FCW_ALatRqrdMaxForSteerInCllsnFwdWarnCtrl_Ca@ */ Record_FLOAT32_IEEE 0 autosar_swc_aeb_CM_single_m_per_s_ 0.000000 20.000000
 /begin AXIS_DESCR COM_AXIS NO_INPUT_QUANTITY autosar_swc_aeb_CM_single_rad_per_s 6 0.000000 50.000000 AXIS_PTS_REF FCW_PinionSteerWhlAgVectForALatThdInCllsn_Ca /end AXIS_DESCR
/end CHARACTERISTIC
/begin CHARACTERISTIC FCW_ALgtFiltParam1InCllsnFwdWarnCtrl_Ca "Butterworth filter parameter describing c_x0 in equation y(n) = c_x0*x(n) + c_x1*x(n-1) + c_x2*x(n-2) + c_y1*y(n-1) + c_y2*y(n-2). See describtion for further details on equation." VALUE 0xfe504020 /* @ECU_Address@FCW_ALgtFiltParam1InCllsnFwdWarnCtrl_Ca@ */ Record_FLOAT32_IEEE 0 autosar_swc_aeb_CM_single -5.000000 5.000000 /end CHARACTERISTIC
/begin CHARACTERISTIC FCW_ALgtFiltParam2InCllsnFwdWarnCtrl_Ca "Butterworth filter parameter describing c_x1 in equation y(n) = c_x0*x(n) + c_x1*x(n-1) + c_x2*x(n-2) + c_y1*y(n-1) + c_y2*y(n-2). See Description for more details." VALUE 0xfe504024 /* @ECU_Address@FCW_ALgtFiltParam2InCllsnFwdWarnCtrl_Ca@ */ Record_FLOAT32_IEEE 0 autosar_swc_aeb_CM_single -5.000000 5.000000 /end CHARACTERISTIC
/begin CHARACTERISTIC FCW_ALgtFiltParam3InCllsnFwdWarnCtrl_Ca "Butterworth filter parameter describing c_x2 in equation y(n) = c_x0*x(n) + c_x1*x(n-1) + c_x2*x(n-2) + c_y1*y(n-1) + c_y2*y(n-2). See Description for more details." VALUE 0xfe504028 /* @ECU_Address@FCW_ALgtFiltParam3InCllsnFwdWarnCtrl_Ca@ */ Record_FLOAT32_IEEE 0 autosar_swc_aeb_CM_single -5.000000 5.000000 /end CHARACTERISTIC
/begin CHARACTERISTIC FCW_ALgtFiltParam4InCllsnFwdWarnCtrl_Ca "Butterworth filter parameter describing c_y1 in equation y(n) = c_x0*x(n) + c_x1*x(n-1) + c_x2*x(n-2) + c_y1*y(n-1) + c_y2*y(n-2). See Description for more details." VALUE 0xfe50402c /* @ECU_Address@FCW_ALgtFiltParam4InCllsnFwdWarnCtrl_Ca@ */ Record_FLOAT32_IEEE 0 autosar_swc_aeb_CM_single -5.000000 5.000000 /end CHARACTERISTIC
/begin CHARACTERISTIC FCW_ALgtFiltParam5InCllsnFwdWarnCtrl_Ca "Butterworth filter parameter describing  c_y2 in equation y(n) = c_x0*x(n) + c_x1*x(n-1) + c_x2*x(n-2) + c_y1*y(n-1) + c_y2*y(n-2). See Description for more details." VALUE 0xfe504030 /* @ECU_Address@FCW_ALgtFiltParam5InCllsnFwdWarnCtrl_Ca@ */ Record_FLOAT32_IEEE 0 autosar_swc_aeb_CM_single -5.000000 5.000000 /end CHARACTERISTIC
/begin CHARACTERISTIC FCW_ALgtMaxForBrkPlsInCllsnFwdWarnCtrl_Ca "Maximum acceleration above which Brake Pulse is not allowed to be issued." VALUE 0xfe504034 /* @ECU_Address@FCW_ALgtMaxForBrkPlsInCllsnFwdWarnCtrl_Ca@ */ Record_FLOAT32_IEEE 0 autosar_swc_aeb_CM_single_m_per_s_ 0.000000 12.000000 /end CHARACTERISTIC
/begin CHARACTERISTIC FCW_AccBrkCpActvdInCllsnFwdWarnCtrl_Ca "Parameter to control whether or not the Acc Brake Capacity shall be used when ACC is active. If set to \"false\" the drivers brake capacity is used when ACC is active as well." VALUE 0xfe504199 /* @ECU_Address@FCW_AccBrkCpActvdInCllsnFwdWarnCtrl_Ca@ */ Record_BOOLEAN 0 autosar_swc_aeb_CM_logical 0 1 /end CHARACTERISTIC
/begin CHARACTERISTIC FCW_AmpForBrkPlsVrnt0InCllsnFwdWarnCtrl_Ca "Amplitude of the single brake pulse request. Calibration variant 0: V526, Combustion engine + ACC brake aggregate." CURVE 0xfe504b60 /* @ECU_Address@FCW_AmpForBrkPlsVrnt0InCllsnFwdWarnCtrl_Ca@ */ Record_FLOAT32_IEEE 0 autosar_swc_aeb_CM_single_m_per_s_ 0.000000 5.000000
 /begin AXIS_DESCR COM_AXIS NO_INPUT_QUANTITY autosar_swc_aeb_CM_single_m_per_s 5 0.000000 83.000000 AXIS_PTS_REF FCW_SpdInpThdVectForBrkPlsInCllsnFwdWarnCtrl_Ca /end AXIS_DESCR
/end CHARACTERISTIC
/begin CHARACTERISTIC FCW_AmpForBrkPlsVrnt1InCllsnFwdWarnCtrl_Ca "Amplitude of the single brake pulse request. Calibration variant 1: V526, Hybrid vehicle + ACC brake aggregate." CURVE 0xfe504b74 /* @ECU_Address@FCW_AmpForBrkPlsVrnt1InCllsnFwdWarnCtrl_Ca@ */ Record_FLOAT32_IEEE 0 autosar_swc_aeb_CM_single_m_per_s_ 0.000000 5.000000
 /begin AXIS_DESCR COM_AXIS NO_INPUT_QUANTITY autosar_swc_aeb_CM_single_m_per_s 5 0.000000 83.000000 AXIS_PTS_REF FCW_SpdInpThdVectForBrkPlsInCllsnFwdWarnCtrl_Ca /end AXIS_DESCR
/end CHARACTERISTIC
/begin CHARACTERISTIC FCW_AmpForBrkPlsVrnt2InCllsnFwdWarnCtrl_Ca "Amplitude of the single brake pulse request. Calibration variant 2: V526, Combustion engine + FSA brake aggregate." CURVE 0xfe504b88 /* @ECU_Address@FCW_AmpForBrkPlsVrnt2InCllsnFwdWarnCtrl_Ca@ */ Record_FLOAT32_IEEE 0 autosar_swc_aeb_CM_single_m_per_s_ 0.000000 5.000000
 /begin AXIS_DESCR COM_AXIS NO_INPUT_QUANTITY autosar_swc_aeb_CM_single_m_per_s 5 0.000000 83.000000 AXIS_PTS_REF FCW_SpdInpThdVectForBrkPlsInCllsnFwdWarnCtrl_Ca /end AXIS_DESCR
/end CHARACTERISTIC
/begin CHARACTERISTIC FCW_AmpForBrkPlsVrnt3InCllsnFwdWarnCtrl_Ca "Amplitude of the single brake pulse request. Calibration variant 3: V526, Hybrid vehicle + FSA brake aggregate." CURVE 0xfe504b9c /* @ECU_Address@FCW_AmpForBrkPlsVrnt3InCllsnFwdWarnCtrl_Ca@ */ Record_FLOAT32_IEEE 0 autosar_swc_aeb_CM_single_m_per_s_ 0.000000 5.000000
 /begin AXIS_DESCR COM_AXIS NO_INPUT_QUANTITY autosar_swc_aeb_CM_single_m_per_s 5 0.000000 83.000000 AXIS_PTS_REF FCW_SpdInpThdVectForBrkPlsInCllsnFwdWarnCtrl_Ca /end AXIS_DESCR
/end CHARACTERISTIC
/begin CHARACTERISTIC FCW_AmpForBrkPlsVrnt4InCllsnFwdWarnCtrl_Ca "Amplitude of the single brake pulse request. Calibration variant 4: V54X, Combustion engine + ACC brake aggregate." CURVE 0xfe504bb0 /* @ECU_Address@FCW_AmpForBrkPlsVrnt4InCllsnFwdWarnCtrl_Ca@ */ Record_FLOAT32_IEEE 0 autosar_swc_aeb_CM_single_m_per_s_ 0.000000 5.000000
 /begin AXIS_DESCR COM_AXIS NO_INPUT_QUANTITY autosar_swc_aeb_CM_single_m_per_s 5 0.000000 83.000000 AXIS_PTS_REF FCW_SpdInpThdVectForBrkPlsInCllsnFwdWarnCtrl_Ca /end AXIS_DESCR
/end CHARACTERISTIC
/begin CHARACTERISTIC FCW_AmpForBrkPlsVrnt5InCllsnFwdWarnCtrl_Ca "Amplitude of the single brake pulse request. Calibration variant 5: V54X, Hybrid vehicle + ACC brake aggregate." CURVE 0xfe504bc4 /* @ECU_Address@FCW_AmpForBrkPlsVrnt5InCllsnFwdWarnCtrl_Ca@ */ Record_FLOAT32_IEEE 0 autosar_swc_aeb_CM_single_m_per_s_ 0.000000 5.000000
 /begin AXIS_DESCR COM_AXIS NO_INPUT_QUANTITY autosar_swc_aeb_CM_single_m_per_s 5 0.000000 83.000000 AXIS_PTS_REF FCW_SpdInpThdVectForBrkPlsInCllsnFwdWarnCtrl_Ca /end AXIS_DESCR
/end CHARACTERISTIC
/begin CHARACTERISTIC FCW_AmpForBrkPlsVrnt6InCllsnFwdWarnCtrl_Ca "Amplitude of the single brake pulse request. Calibration variant 6: V54X, Combustion engine + FSA brake aggregate." CURVE 0xfe504bd8 /* @ECU_Address@FCW_AmpForBrkPlsVrnt6InCllsnFwdWarnCtrl_Ca@ */ Record_FLOAT32_IEEE 0 autosar_swc_aeb_CM_single_m_per_s_ 0.000000 5.000000
 /begin AXIS_DESCR COM_AXIS NO_INPUT_QUANTITY autosar_swc_aeb_CM_single_m_per_s 5 0.000000 83.000000 AXIS_PTS_REF FCW_SpdInpThdVectForBrkPlsInCllsnFwdWarnCtrl_Ca /end AXIS_DESCR
/end CHARACTERISTIC
/begin CHARACTERISTIC FCW_AmpForBrkPlsVrnt7InCllsnFwdWarnCtrl_Ca "Amplitude of the single brake pulse request. Calibration variant 7: V54X, Hybrid vehicle + FSA brake aggregate." CURVE 0xfe504bec /* @ECU_Address@FCW_AmpForBrkPlsVrnt7InCllsnFwdWarnCtrl_Ca@ */ Record_FLOAT32_IEEE 0 autosar_swc_aeb_CM_single_m_per_s_ 0.000000 5.000000
 /begin AXIS_DESCR COM_AXIS NO_INPUT_QUANTITY autosar_swc_aeb_CM_single_m_per_s 5 0.000000 83.000000 AXIS_PTS_REF FCW_SpdInpThdVectForBrkPlsInCllsnFwdWarnCtrl_Ca /end AXIS_DESCR
/end CHARACTERISTIC
/begin CHARACTERISTIC FCW_AudAndVisWarnDurnInCllsnFwdWarnCtrl_Ca "Audio and Visual Warning length. Equal to for how long the warning enable output is enabled." VALUE 0xfe504038 /* @ECU_Address@FCW_AudAndVisWarnDurnInCllsnFwdWarnCtrl_Ca@ */ Record_FLOAT32_IEEE 0 autosar_swc_aeb_CM_single_s 0.025000 1.300000 /end CHARACTERISTIC
/begin CHARACTERISTIC FCW_BrkGainActvdInCllsnFwdWarnCtrl_Ca "Flag used to activate/deactivate brake gain." VALUE 0xfe50419a /* @ECU_Address@FCW_BrkGainActvdInCllsnFwdWarnCtrl_Ca@ */ Record_BOOLEAN 0 autosar_swc_aeb_CM_logical 0 1 /end CHARACTERISTIC
/begin CHARACTERISTIC FCW_BrkGainHldTiInCllsnFwdWarnCtrl_Ca "Hold time for confirmed brake gain decel request when FCW target disappears." VALUE 0xfe50403c /* @ECU_Address@FCW_BrkGainHldTiInCllsnFwdWarnCtrl_Ca@ */ Record_FLOAT32_IEEE 0 autosar_swc_aeb_CM_single_s 0.000000 1.000000 /end CHARACTERISTIC
/begin CHARACTERISTIC FCW_BrkGainMaxDecelLimInCllsnFwdWarnReq_Ca "The upper limit for a brake gain maximum deceleration request" VALUE 0xfe504040 /* @ECU_Address@FCW_BrkGainMaxDecelLimInCllsnFwdWarnReq_Ca@ */ Record_FLOAT32_IEEE 0 autosar_swc_aeb_CM_single_m_per_s_ 0.000000 12.000000 /end CHARACTERISTIC
/begin CHARACTERISTIC FCW_BrkGainReqHiInCllsnFwdWarnReq_Ca "The brake gain value to request when high brake gain is required/allowed." VALUE 0xfe504044 /* @ECU_Address@FCW_BrkGainReqHiInCllsnFwdWarnReq_Ca@ */ Record_FLOAT32_IEEE 0 autosar_swc_aeb_CM_single 1.000000 3.000000 /end CHARACTERISTIC
/begin CHARACTERISTIC FCW_BrkGainReqNormInCllsnFwdWarnReq_Ca "The brake gain value to request when normal brake gain is required/allowed." VALUE 0xfe504048 /* @ECU_Address@FCW_BrkGainReqNormInCllsnFwdWarnReq_Ca@ */ Record_FLOAT32_IEEE 0 autosar_swc_aeb_CM_single 1.000000 3.000000 /end CHARACTERISTIC
/begin CHARACTERISTIC FCW_BrkGainReqOffInCllsnFwdWarnReq_Ca "The brake gain value to request when no brake gain is required/allowed." VALUE 0xfe50404c /* @ECU_Address@FCW_BrkGainReqOffInCllsnFwdWarnReq_Ca@ */ Record_FLOAT32_IEEE 0 autosar_swc_aeb_CM_single 1.000000 3.000000 /end CHARACTERISTIC
/begin CHARACTERISTIC FCW_BrkPlsActvdInCllsnFwdWarnCtrl_Ca "" VALUE 0xfe50419b /* @ECU_Address@FCW_BrkPlsActvdInCllsnFwdWarnCtrl_Ca@ */ Record_BOOLEAN 0 autosar_swc_aeb_CM_logical 0 1 /end CHARACTERISTIC
/begin CHARACTERISTIC FCW_BrkPlsCmpFacMaxForJerkUpInCllsnFwdWarnCtrl_Ca "The Brake Pulse Jerk Up is compensated by the Brake Pulse Amplitude" VALUE 0xfe504050 /* @ECU_Address@FCW_BrkPlsCmpFacMaxForJerkUpInCllsnFwdWarnCtrl_Ca@ */ Record_FLOAT32_IEEE 0 autosar_swc_aeb_CM_single 0.000000 10.000000 /end CHARACTERISTIC
/begin CHARACTERISTIC FCW_BrkPlsCmpFacMinForJerkUpInCllsnFwdWarnCtrl_Ca "The Brake Pulse Jerk Up is compensated by the Brake Pulse Amplitude" VALUE 0xfe504054 /* @ECU_Address@FCW_BrkPlsCmpFacMinForJerkUpInCllsnFwdWarnCtrl_Ca@ */ Record_FLOAT32_IEEE 0 autosar_swc_aeb_CM_single 0.000000 10.000000 /end CHARACTERISTIC
/begin CHARACTERISTIC FCW_BrkPlsDlyFromSpdInCllsnFwdWarnCtrl_Ca "Brake pulse delay for each vehicle speed breakpoint." CURVE 0xfe5047d8 /* @ECU_Address@FCW_BrkPlsDlyFromSpdInCllsnFwdWarnCtrl_Ca@ */ Record_FLOAT32_IEEE 0 autosar_swc_aeb_CM_single_s 0.000000 2.000000
 /begin AXIS_DESCR COM_AXIS NO_INPUT_QUANTITY autosar_swc_aeb_CM_single_m_per_s 8 0.000000 70.000000 AXIS_PTS_REF FCW_SpdInpThdVectForBrkPlsDlyInCllsnFwdWarnCtrl_Ca /end AXIS_DESCR
/end CHARACTERISTIC
/begin CHARACTERISTIC FCW_BrkPlsDlySrcInCllsnFwdWarnCtrl_Ca "Source selection for the brake pulse delay where: 1 = No delay (Brake Pulse is issued at the same time as the Audio and Visual Warning), 2 = Delay based on driver sensitivity level, 3 = Delay based on vehicle speed, 4 = Equal to the drivers reaction time" VALUE 0xfe5041c3 /* @ECU_Address@FCW_BrkPlsDlySrcInCllsnFwdWarnCtrl_Ca@ */ Record_UBYTE 0 autosar_swc_aeb_CM_uint8 1.000000 4.000000 /end CHARACTERISTIC
/begin CHARACTERISTIC FCW_CfmTiForBrkGainHldInCllsnFwdWarnCtrl_Ca "Confirmation time to allow hold for brake gain decel request" VALUE 0xfe504058 /* @ECU_Address@FCW_CfmTiForBrkGainHldInCllsnFwdWarnCtrl_Ca@ */ Record_FLOAT32_IEEE 0 autosar_swc_aeb_CM_single_s 0.000000 10.000000 /end CHARACTERISTIC
/begin CHARACTERISTIC FCW_DlyForBrkPlsForLvl1OfSnvtyInCllsnFwdWarnCtrl_Ca "Delay between visual/audio warning signal start and brake pulse for Sensitivity Level 1 (Low Sensitivity that equals short warning distance)." VALUE 0xfe504060 /* @ECU_Address@FCW_DlyForBrkPlsForLvl1OfSnvtyInCllsnFwdWarnCtrl_Ca@ */ Record_FLOAT32_IEEE 0 autosar_swc_aeb_CM_single_s 0.000000 2.000000 /end CHARACTERISTIC
/begin CHARACTERISTIC FCW_DlyForBrkPlsForLvl2OfSnvtyInCllsnFwdWarnCtrl_Ca "Delay between visual/audio warning signal start and brake pulse for Sensitivity Level 2 (Normal Sensitivity that equals normal warning distance)." VALUE 0xfe504064 /* @ECU_Address@FCW_DlyForBrkPlsForLvl2OfSnvtyInCllsnFwdWarnCtrl_Ca@ */ Record_FLOAT32_IEEE 0 autosar_swc_aeb_CM_single_s 0.000000 2.000000 /end CHARACTERISTIC
/begin CHARACTERISTIC FCW_DlyForBrkPlsForLvl3OfSnvtyInCllsnFwdWarnCtrl_Ca "Delay between visual/audio warning signal start and brake pulse for Sensitivity Level 3 (High Sensitivity that equals long warning distance)." VALUE 0xfe504068 /* @ECU_Address@FCW_DlyForBrkPlsForLvl3OfSnvtyInCllsnFwdWarnCtrl_Ca@ */ Record_FLOAT32_IEEE 0 autosar_swc_aeb_CM_single_s 0.000000 2.000000 /end CHARACTERISTIC
/begin CHARACTERISTIC FCW_DrvrDecelThdForBrkGainInCllsnFwdWarnCtrl_Ca "The threshold for driver deceleration request above which brake gain is enabled." VALUE 0xfe50406c /* @ECU_Address@FCW_DrvrDecelThdForBrkGainInCllsnFwdWarnCtrl_Ca@ */ Record_FLOAT32_IEEE 0 autosar_swc_aeb_CM_single_m_per_s_ 0.000000 12.000000 /end CHARACTERISTIC
/begin CHARACTERISTIC FCW_DrvrDecelThdForBrkGainOffInCllsnFwdWarnCtrl_Ca "The threshold for driver deceleration request below which brake gain is disabled." VALUE 0xfe504070 /* @ECU_Address@FCW_DrvrDecelThdForBrkGainOffInCllsnFwdWarnCtrl_Ca@ */ Record_FLOAT32_IEEE 0 autosar_swc_aeb_CM_single_m_per_s_ 0.100000 12.000000 /end CHARACTERISTIC
/begin CHARACTERISTIC FCW_DstCmftActvdForObjTyp10InCllsnFwdWarnCtrl_Ca "Parameter controlling whether or not to issue an FCW based on \"Comfort Distance\" for object type \"VehOfUnkwnClass\"." VALUE 0xfe50419c /* @ECU_Address@FCW_DstCmftActvdForObjTyp10InCllsnFwdWarnCtrl_Ca@ */ Record_BOOLEAN 0 autosar_swc_aeb_CM_logical 0 1 /end CHARACTERISTIC
/begin CHARACTERISTIC FCW_DstCmftActvdForObjTyp1InCllsnFwdWarnCtrl_Ca "Parameter controlling whether or not to issue FCW Events based on \"Comfort Distance\" for object type \"Car\"." VALUE 0xfe50419d /* @ECU_Address@FCW_DstCmftActvdForObjTyp1InCllsnFwdWarnCtrl_Ca@ */ Record_BOOLEAN 0 autosar_swc_aeb_CM_logical 0 1 /end CHARACTERISTIC
/begin CHARACTERISTIC FCW_DstCmftActvdForObjTyp2InCllsnFwdWarnCtrl_Ca "Parameter controlling whether or not to issue an FCW based on \"Comfort Distance\" for object type \"Motorcycle\"." VALUE 0xfe50419e /* @ECU_Address@FCW_DstCmftActvdForObjTyp2InCllsnFwdWarnCtrl_Ca@ */ Record_BOOLEAN 0 autosar_swc_aeb_CM_logical 0 1 /end CHARACTERISTIC
/begin CHARACTERISTIC FCW_DstCmftActvdForObjTyp3InCllsnFwdWarnCtrl_Ca "Parameter controlling whether or not to issue an FCW based on \"Comfort Distance\" for object type \"Truck\"." VALUE 0xfe50419f /* @ECU_Address@FCW_DstCmftActvdForObjTyp3InCllsnFwdWarnCtrl_Ca@ */ Record_BOOLEAN 0 autosar_swc_aeb_CM_logical 0 1 /end CHARACTERISTIC
/begin CHARACTERISTIC FCW_DstCmftActvdForObjTyp4InCllsnFwdWarnCtrl_Ca "Parameter controlling whether or not to issue an FCW based on \"Comfort Distance\" for object type \"Ped\"." VALUE 0xfe5041a0 /* @ECU_Address@FCW_DstCmftActvdForObjTyp4InCllsnFwdWarnCtrl_Ca@ */ Record_BOOLEAN 0 autosar_swc_aeb_CM_logical 0 1 /end CHARACTERISTIC
/begin CHARACTERISTIC FCW_DstCmftActvdForObjTyp7InCllsnFwdWarnCtrl_Ca "Parameter controlling whether or not to issue an FCW based on \"Comfort Distance\" for object type \"Anim\"." VALUE 0xfe5041a1 /* @ECU_Address@FCW_DstCmftActvdForObjTyp7InCllsnFwdWarnCtrl_Ca@ */ Record_BOOLEAN 0 autosar_swc_aeb_CM_logical 0 1 /end CHARACTERISTIC
/begin CHARACTERISTIC FCW_DstCmftActvdForObjTyp8InCllsnFwdWarnCtrl_Ca "Parameter controlling whether or not to issue an FCW based on \"Comfort Distance\" for object type \"ObjGen\"." VALUE 0xfe5041a2 /* @ECU_Address@FCW_DstCmftActvdForObjTyp8InCllsnFwdWarnCtrl_Ca@ */ Record_BOOLEAN 0 autosar_swc_aeb_CM_logical 0 1 /end CHARACTERISTIC
/begin CHARACTERISTIC FCW_DstCmftActvdForObjTyp9InCllsnFwdWarnCtrl_Ca "Parameter controlling whether or not to issue an FCW based on \"Comfort Distance\" for object type \"Bicycle\"." VALUE 0xfe5041a3 /* @ECU_Address@FCW_DstCmftActvdForObjTyp9InCllsnFwdWarnCtrl_Ca@ */ Record_BOOLEAN 0 autosar_swc_aeb_CM_logical 0 1 /end CHARACTERISTIC
/begin CHARACTERISTIC FCW_DstCmftActvdInCllsnFwdWarnCtrl_Ca "Flag to enable/disable the use of Comfort Distance for FCW events." VALUE 0xfe5041a4 /* @ECU_Address@FCW_DstCmftActvdInCllsnFwdWarnCtrl_Ca@ */ Record_BOOLEAN 0 autosar_swc_aeb_CM_logical 0 1 /end CHARACTERISTIC
/begin CHARACTERISTIC FCW_DstCmftForLvl1OfSnvtyInCllsnFwdWarnCtrl_Ca "Comfort distance for each vehicle speed breakpoint when FCW Sensitivity Level is \"Low\"." CURVE 0xfe5047f8 /* @ECU_Address@FCW_DstCmftForLvl1OfSnvtyInCllsnFwdWarnCtrl_Ca@ */ Record_FLOAT32_IEEE 0 autosar_swc_aeb_CM_single_m 0.000000 70.000000
 /begin AXIS_DESCR COM_AXIS NO_INPUT_QUANTITY autosar_swc_aeb_CM_single_m_per_s 8 0.000000 44.440000 AXIS_PTS_REF FCW_SpdInpThdVectForDstCmftInCllsnFwdWarnCtrl_Ca /end AXIS_DESCR
/end CHARACTERISTIC
/begin CHARACTERISTIC FCW_DstCmftForLvl2OfSnvtyInCllsnFwdWarnCtrl_Ca "Comfort distance for each vehicle speed breakpoint when FCW Sensitivity Level is \"Normal\"." CURVE 0xfe504818 /* @ECU_Address@FCW_DstCmftForLvl2OfSnvtyInCllsnFwdWarnCtrl_Ca@ */ Record_FLOAT32_IEEE 0 autosar_swc_aeb_CM_single_m 0.000000 70.000000
 /begin AXIS_DESCR COM_AXIS NO_INPUT_QUANTITY autosar_swc_aeb_CM_single_m_per_s 8 0.000000 44.440000 AXIS_PTS_REF FCW_SpdInpThdVectForDstCmftInCllsnFwdWarnCtrl_Ca /end AXIS_DESCR
/end CHARACTERISTIC
/begin CHARACTERISTIC FCW_DstCmftForLvl3OfSnvtyInCllsnFwdWarnCtrl_Ca "Comfort distance for each vehicle speed breakpoint when FCW Sensitivity Level is \"High\"." CURVE 0xfe504838 /* @ECU_Address@FCW_DstCmftForLvl3OfSnvtyInCllsnFwdWarnCtrl_Ca@ */ Record_FLOAT32_IEEE 0 autosar_swc_aeb_CM_single_m 0.000000 70.000000
 /begin AXIS_DESCR COM_AXIS NO_INPUT_QUANTITY autosar_swc_aeb_CM_single_m_per_s 8 0.000000 44.440000 AXIS_PTS_REF FCW_SpdInpThdVectForDstCmftInCllsnFwdWarnCtrl_Ca /end AXIS_DESCR
/end CHARACTERISTIC
/begin CHARACTERISTIC FCW_HldTiChgRateFromVehAForBrkPlsVrnt0InCllsnFwdWarnCtrl_Ca "Dependancy between vehicle acceleration and hold time of a single brake pulse actuation. Calibration variant 0: V526, Combustion engine + ACC brake aggregate." VALUE 0xfe504074 /* @ECU_Address@FCW_HldTiChgRateFromVehAForBrkPlsVrnt0InCllsnFwdWarnCtrl_Ca@ */ Record_FLOAT32_IEEE 0 autosar_swc_aeb_CM_single 0.000000 1.000000 /end CHARACTERISTIC
/begin CHARACTERISTIC FCW_HldTiChgRateFromVehAForBrkPlsVrnt1InCllsnFwdWarnCtrl_Ca "Dependancy between vehicle acceleration and hold time of a single brake pulse actuation. Calibration variant 1: V526, Hybrid vehicle + ACC brake aggregate." VALUE 0xfe504078 /* @ECU_Address@FCW_HldTiChgRateFromVehAForBrkPlsVrnt1InCllsnFwdWarnCtrl_Ca@ */ Record_FLOAT32_IEEE 0 autosar_swc_aeb_CM_single 0.000000 1.000000 /end CHARACTERISTIC
/begin CHARACTERISTIC FCW_HldTiChgRateFromVehAForBrkPlsVrnt2InCllsnFwdWarnCtrl_Ca "Dependancy between vehicle acceleration and hold time of a single brake pulse actuation. Calibration variant 2: V526, Combustion engine + FSA brake aggregate." VALUE 0xfe50407c /* @ECU_Address@FCW_HldTiChgRateFromVehAForBrkPlsVrnt2InCllsnFwdWarnCtrl_Ca@ */ Record_FLOAT32_IEEE 0 autosar_swc_aeb_CM_single 0.000000 1.000000 /end CHARACTERISTIC
/begin CHARACTERISTIC FCW_HldTiChgRateFromVehAForBrkPlsVrnt3InCllsnFwdWarnCtrl_Ca "Dependancy between vehicle acceleration and hold time of a single brake pulse actuation. Calibration variant 3: V526, Hybrid vehicle + FSA brake aggregate." VALUE 0xfe504080 /* @ECU_Address@FCW_HldTiChgRateFromVehAForBrkPlsVrnt3InCllsnFwdWarnCtrl_Ca@ */ Record_FLOAT32_IEEE 0 autosar_swc_aeb_CM_single 0.000000 1.000000 /end CHARACTERISTIC
/begin CHARACTERISTIC FCW_HldTiChgRateFromVehAForBrkPlsVrnt4InCllsnFwdWarnCtrl_Ca "Dependancy between vehicle acceleration and hold time of a single brake pulse actuation. Calibration variant 4: V54X, Combustion engine + ACC brake aggregate." VALUE 0xfe504084 /* @ECU_Address@FCW_HldTiChgRateFromVehAForBrkPlsVrnt4InCllsnFwdWarnCtrl_Ca@ */ Record_FLOAT32_IEEE 0 autosar_swc_aeb_CM_single 0.000000 1.000000 /end CHARACTERISTIC
/begin CHARACTERISTIC FCW_HldTiChgRateFromVehAForBrkPlsVrnt5InCllsnFwdWarnCtrl_Ca "Dependancy between vehicle acceleration and hold time of a single brake pulse actuation. Calibration variant 5: V54X, Hybrid vehicle + ACC brake aggregate." VALUE 0xfe504088 /* @ECU_Address@FCW_HldTiChgRateFromVehAForBrkPlsVrnt5InCllsnFwdWarnCtrl_Ca@ */ Record_FLOAT32_IEEE 0 autosar_swc_aeb_CM_single 0.000000 1.000000 /end CHARACTERISTIC
/begin CHARACTERISTIC FCW_HldTiChgRateFromVehAForBrkPlsVrnt6InCllsnFwdWarnCtrl_Ca "Dependancy between vehicle acceleration and hold time of a single brake pulse actuation. Calibration variant 6: V54X, Combustion engine + FSA brake aggregate." VALUE 0xfe50408c /* @ECU_Address@FCW_HldTiChgRateFromVehAForBrkPlsVrnt6InCllsnFwdWarnCtrl_Ca@ */ Record_FLOAT32_IEEE 0 autosar_swc_aeb_CM_single 0.000000 1.000000 /end CHARACTERISTIC
/begin CHARACTERISTIC FCW_HldTiChgRateFromVehAForBrkPlsVrnt7InCllsnFwdWarnCtrl_Ca "Dependancy between vehicle acceleration and hold time of a single brake pulse actuation. Calibration variant 7: V54X, Hybrid vehicle + FSA brake aggregate." VALUE 0xfe504090 /* @ECU_Address@FCW_HldTiChgRateFromVehAForBrkPlsVrnt7InCllsnFwdWarnCtrl_Ca@ */ Record_FLOAT32_IEEE 0 autosar_swc_aeb_CM_single 0.000000 1.000000 /end CHARACTERISTIC
/begin CHARACTERISTIC FCW_HldTiChgRateFromVehSpdForBrkPlsVrnt0InCllsnFwdWarnCtrl_Ca "Dependancy between vehicle speed and hold time of a single brake pulse actuation. Calibration variant 0: V526, Combustion engine + ACC brake aggregate." VALUE 0xfe504094 /* @ECU_Address@FCW_HldTiChgRateFromVehSpdForBrkPlsVrnt0InCllsnFwdWarnCtrl_Ca@ */ Record_FLOAT32_IEEE 0 autosar_swc_aeb_CM_single 0.000000 2.000000 /end CHARACTERISTIC
/begin CHARACTERISTIC FCW_HldTiChgRateFromVehSpdForBrkPlsVrnt1InCllsnFwdWarnCtrl_Ca "Dependancy between vehicle speed and hold time of a single brake pulse actuation. Calibration variant 1: V526, Hybrid vehicle + ACC brake aggregate." VALUE 0xfe504098 /* @ECU_Address@FCW_HldTiChgRateFromVehSpdForBrkPlsVrnt1InCllsnFwdWarnCtrl_Ca@ */ Record_FLOAT32_IEEE 0 autosar_swc_aeb_CM_single 0.000000 2.000000 /end CHARACTERISTIC
/begin CHARACTERISTIC FCW_HldTiChgRateFromVehSpdForBrkPlsVrnt2InCllsnFwdWarnCtrl_Ca "Dependancy between vehicle speed and hold time of a single brake pulse actuation. Calibration variant 2: V526, Combustion engine + FSA brake aggregate." VALUE 0xfe50409c /* @ECU_Address@FCW_HldTiChgRateFromVehSpdForBrkPlsVrnt2InCllsnFwdWarnCtrl_Ca@ */ Record_FLOAT32_IEEE 0 autosar_swc_aeb_CM_single 0.000000 2.000000 /end CHARACTERISTIC
/begin CHARACTERISTIC FCW_HldTiChgRateFromVehSpdForBrkPlsVrnt3InCllsnFwdWarnCtrl_Ca "Dependancy between vehicle speed and hold time of a single brake pulse actuation. Calibration variant 3: V526, Hybrid vehicle + FSA brake aggregate." VALUE 0xfe5040a0 /* @ECU_Address@FCW_HldTiChgRateFromVehSpdForBrkPlsVrnt3InCllsnFwdWarnCtrl_Ca@ */ Record_FLOAT32_IEEE 0 autosar_swc_aeb_CM_single 0.000000 2.000000 /end CHARACTERISTIC
/begin CHARACTERISTIC FCW_HldTiChgRateFromVehSpdForBrkPlsVrnt4InCllsnFwdWarnCtrl_Ca "Dependancy between vehicle speed and hold time of a single brake pulse actuation. Calibration variant 4: V54X, Combustion engine + ACC brake aggregate." VALUE 0xfe5040a4 /* @ECU_Address@FCW_HldTiChgRateFromVehSpdForBrkPlsVrnt4InCllsnFwdWarnCtrl_Ca@ */ Record_FLOAT32_IEEE 0 autosar_swc_aeb_CM_single 0.000000 2.000000 /end CHARACTERISTIC
/begin CHARACTERISTIC FCW_HldTiChgRateFromVehSpdForBrkPlsVrnt5InCllsnFwdWarnCtrl_Ca "Dependancy between vehicle speed and hold time of a single brake pulse actuation. Calibration variant 5: V54X, Hybrid vehicle + ACC brake aggregate." VALUE 0xfe5040a8 /* @ECU_Address@FCW_HldTiChgRateFromVehSpdForBrkPlsVrnt5InCllsnFwdWarnCtrl_Ca@ */ Record_FLOAT32_IEEE 0 autosar_swc_aeb_CM_single 0.000000 2.000000 /end CHARACTERISTIC
/begin CHARACTERISTIC FCW_HldTiChgRateFromVehSpdForBrkPlsVrnt6InCllsnFwdWarnCtrl_Ca "Dependancy between vehicle speed and hold time of a single brake pulse actuation. Calibration variant 6: V54X, Combustion engine + FSA brake aggregate." VALUE 0xfe5040ac /* @ECU_Address@FCW_HldTiChgRateFromVehSpdForBrkPlsVrnt6InCllsnFwdWarnCtrl_Ca@ */ Record_FLOAT32_IEEE 0 autosar_swc_aeb_CM_single 0.000000 2.000000 /end CHARACTERISTIC
/begin CHARACTERISTIC FCW_HldTiChgRateFromVehSpdForBrkPlsVrnt7InCllsnFwdWarnCtrl_Ca "Dependancy between vehicle speed and hold time of a single brake pulse actuation. Calibration variant 7: V54X, Hybrid vehicle + FSA brake aggregate." VALUE 0xfe5040b0 /* @ECU_Address@FCW_HldTiChgRateFromVehSpdForBrkPlsVrnt7InCllsnFwdWarnCtrl_Ca@ */ Record_FLOAT32_IEEE 0 autosar_swc_aeb_CM_single 0.000000 2.000000 /end CHARACTERISTIC
/begin CHARACTERISTIC FCW_HldTiCmpByJerkThdInCllsnFwdWarnCtrl_Ca "If the Brake Pulse Amplitude is higher than this threshold Hold Time should NOT be compensated by Jerk" VALUE 0xfe5040b4 /* @ECU_Address@FCW_HldTiCmpByJerkThdInCllsnFwdWarnCtrl_Ca@ */ Record_FLOAT32_IEEE 0 autosar_swc_aeb_CM_single_m_per_s_ 0.000000 10.000000 /end CHARACTERISTIC
/begin CHARACTERISTIC FCW_HldTiCmpByVehMtnThdInCllsnFwdWarnCtrl_Ca "If the Brake Pulse Amplitude is higher than this threshold Hold Time should NOT be compensated by Vehicle Motion" VALUE 0xfe5040b8 /* @ECU_Address@FCW_HldTiCmpByVehMtnThdInCllsnFwdWarnCtrl_Ca@ */ Record_FLOAT32_IEEE 0 autosar_swc_aeb_CM_single_m_per_s_ 0.000000 10.000000 /end CHARACTERISTIC
/begin CHARACTERISTIC FCW_HldTiMaxForBrkPlsInCllsnFwdWarnCtrl_Ca "The maximum time to hold brake request at the set amplitude in the single brake pulse request." VALUE 0xfe5040bc /* @ECU_Address@FCW_HldTiMaxForBrkPlsInCllsnFwdWarnCtrl_Ca@ */ Record_FLOAT32_IEEE 0 autosar_swc_aeb_CM_single_s 0.000000 2.000000 /end CHARACTERISTIC
/begin CHARACTERISTIC FCW_HldTiMinForBrkPlsVrnt0InCllsnFwdWarnCtrl_Ca "The hold time in the standard brake pulse scenario. Calibration variant 0: V526, Combustion engine + ACC brake aggregate." VALUE 0xfe5040c0 /* @ECU_Address@FCW_HldTiMinForBrkPlsVrnt0InCllsnFwdWarnCtrl_Ca@ */ Record_FLOAT32_IEEE 0 autosar_swc_aeb_CM_single_s 0.000000 2.000000 /end CHARACTERISTIC
/begin CHARACTERISTIC FCW_HldTiMinForBrkPlsVrnt1InCllsnFwdWarnCtrl_Ca "The hold time in the standard brake pulse scenario. Calibration variant 1: V526, Hybrid vehicle + ACC brake aggregate." VALUE 0xfe5040c4 /* @ECU_Address@FCW_HldTiMinForBrkPlsVrnt1InCllsnFwdWarnCtrl_Ca@ */ Record_FLOAT32_IEEE 0 autosar_swc_aeb_CM_single_s 0.000000 2.000000 /end CHARACTERISTIC
/begin CHARACTERISTIC FCW_HldTiMinForBrkPlsVrnt2InCllsnFwdWarnCtrl_Ca "The hold time in the standard brake pulse scenario. Calibration variant 2: V526, Combustion engine + FSA brake aggregate." VALUE 0xfe5040c8 /* @ECU_Address@FCW_HldTiMinForBrkPlsVrnt2InCllsnFwdWarnCtrl_Ca@ */ Record_FLOAT32_IEEE 0 autosar_swc_aeb_CM_single_s 0.000000 2.000000 /end CHARACTERISTIC
/begin CHARACTERISTIC FCW_HldTiMinForBrkPlsVrnt3InCllsnFwdWarnCtrl_Ca "The hold time in the standard brake pulse scenario. Calibration variant 3: V526, Hybrid vehicle + FSA brake aggregate." VALUE 0xfe5040cc /* @ECU_Address@FCW_HldTiMinForBrkPlsVrnt3InCllsnFwdWarnCtrl_Ca@ */ Record_FLOAT32_IEEE 0 autosar_swc_aeb_CM_single_s 0.000000 2.000000 /end CHARACTERISTIC
/begin CHARACTERISTIC FCW_HldTiMinForBrkPlsVrnt4InCllsnFwdWarnCtrl_Ca "The hold time in the standard brake pulse scenario. Calibration variant 4: V54X, Combustion engine + ACC brake aggregate." VALUE 0xfe5040d0 /* @ECU_Address@FCW_HldTiMinForBrkPlsVrnt4InCllsnFwdWarnCtrl_Ca@ */ Record_FLOAT32_IEEE 0 autosar_swc_aeb_CM_single_s 0.000000 2.000000 /end CHARACTERISTIC
/begin CHARACTERISTIC FCW_HldTiMinForBrkPlsVrnt5InCllsnFwdWarnCtrl_Ca "The hold time in the standard brake pulse scenario. Calibration variant 5: V54X, Hybrid vehicle + ACC brake aggregate." VALUE 0xfe5040d4 /* @ECU_Address@FCW_HldTiMinForBrkPlsVrnt5InCllsnFwdWarnCtrl_Ca@ */ Record_FLOAT32_IEEE 0 autosar_swc_aeb_CM_single_s 0.000000 2.000000 /end CHARACTERISTIC
/begin CHARACTERISTIC FCW_HldTiMinForBrkPlsVrnt6InCllsnFwdWarnCtrl_Ca "The hold time in the standard brake pulse scenario. Calibration variant 6: V54X, Combustion engine + FSA brake aggregate." VALUE 0xfe5040d8 /* @ECU_Address@FCW_HldTiMinForBrkPlsVrnt6InCllsnFwdWarnCtrl_Ca@ */ Record_FLOAT32_IEEE 0 autosar_swc_aeb_CM_single_s 0.000000 2.000000 /end CHARACTERISTIC
/begin CHARACTERISTIC FCW_HldTiMinForBrkPlsVrnt7InCllsnFwdWarnCtrl_Ca "The hold time in the standard brake pulse scenario. Calibration variant 7: V54X, Hybrid vehicle + FSA brake aggregate." VALUE 0xfe5040dc /* @ECU_Address@FCW_HldTiMinForBrkPlsVrnt7InCllsnFwdWarnCtrl_Ca@ */ Record_FLOAT32_IEEE 0 autosar_swc_aeb_CM_single_s 0.000000 2.000000 /end CHARACTERISTIC
/begin CHARACTERISTIC FCW_JerkDwnForBrkPlsVrnt0InCllsnFwdWarnCtrl_Ca "Jerk used when ramping down the single brake pulse request. Calibration variant 0: V526, Combustion engine + ACC brake aggregate." CURVE 0xfe504c00 /* @ECU_Address@FCW_JerkDwnForBrkPlsVrnt0InCllsnFwdWarnCtrl_Ca@ */ Record_FLOAT32_IEEE 0 autosar_swc_aeb_CM_single_m_per_s_ 0.000000 300.000000
 /begin AXIS_DESCR COM_AXIS NO_INPUT_QUANTITY autosar_swc_aeb_CM_single_m_per_s 5 0.000000 83.000000 AXIS_PTS_REF FCW_SpdInpThdVectForBrkPlsInCllsnFwdWarnCtrl_Ca /end AXIS_DESCR
/end CHARACTERISTIC
/begin CHARACTERISTIC FCW_JerkDwnForBrkPlsVrnt1InCllsnFwdWarnCtrl_Ca "Jerk used when ramping down the single brake pulse request. Calibration variant 1: V526, Hybrid vehicle + ACC brake aggregate." CURVE 0xfe504c14 /* @ECU_Address@FCW_JerkDwnForBrkPlsVrnt1InCllsnFwdWarnCtrl_Ca@ */ Record_FLOAT32_IEEE 0 autosar_swc_aeb_CM_single_m_per_s_ 0.000000 300.000000
 /begin AXIS_DESCR COM_AXIS NO_INPUT_QUANTITY autosar_swc_aeb_CM_single_m_per_s 5 0.000000 83.000000 AXIS_PTS_REF FCW_SpdInpThdVectForBrkPlsInCllsnFwdWarnCtrl_Ca /end AXIS_DESCR
/end CHARACTERISTIC
/begin CHARACTERISTIC FCW_JerkDwnForBrkPlsVrnt2InCllsnFwdWarnCtrl_Ca "Jerk used when ramping down the single brake pulse request. Calibration variant 2: V526, Combustion engine + FSA brake aggregate." CURVE 0xfe504c28 /* @ECU_Address@FCW_JerkDwnForBrkPlsVrnt2InCllsnFwdWarnCtrl_Ca@ */ Record_FLOAT32_IEEE 0 autosar_swc_aeb_CM_single_m_per_s_ 0.000000 300.000000
 /begin AXIS_DESCR COM_AXIS NO_INPUT_QUANTITY autosar_swc_aeb_CM_single_m_per_s 5 0.000000 83.000000 AXIS_PTS_REF FCW_SpdInpThdVectForBrkPlsInCllsnFwdWarnCtrl_Ca /end AXIS_DESCR
/end CHARACTERISTIC
/begin CHARACTERISTIC FCW_JerkDwnForBrkPlsVrnt3InCllsnFwdWarnCtrl_Ca "Jerk used when ramping down the single brake pulse request. Calibration variant 3: V526, Hybrid vehicle + FSA brake aggregate." CURVE 0xfe504c3c /* @ECU_Address@FCW_JerkDwnForBrkPlsVrnt3InCllsnFwdWarnCtrl_Ca@ */ Record_FLOAT32_IEEE 0 autosar_swc_aeb_CM_single_m_per_s_ 0.000000 300.000000
 /begin AXIS_DESCR COM_AXIS NO_INPUT_QUANTITY autosar_swc_aeb_CM_single_m_per_s 5 0.000000 83.000000 AXIS_PTS_REF FCW_SpdInpThdVectForBrkPlsInCllsnFwdWarnCtrl_Ca /end AXIS_DESCR
/end CHARACTERISTIC
/begin CHARACTERISTIC FCW_JerkDwnForBrkPlsVrnt4InCllsnFwdWarnCtrl_Ca "Jerk used when ramping down the single brake pulse request. Calibration variant 4: Combustion engine + ACC brake aggregate." CURVE 0xfe504c50 /* @ECU_Address@FCW_JerkDwnForBrkPlsVrnt4InCllsnFwdWarnCtrl_Ca@ */ Record_FLOAT32_IEEE 0 autosar_swc_aeb_CM_single_m_per_s_ 0.000000 300.000000
 /begin AXIS_DESCR COM_AXIS NO_INPUT_QUANTITY autosar_swc_aeb_CM_single_m_per_s 5 0.000000 83.000000 AXIS_PTS_REF FCW_SpdInpThdVectForBrkPlsInCllsnFwdWarnCtrl_Ca /end AXIS_DESCR
/end CHARACTERISTIC
/begin CHARACTERISTIC FCW_JerkDwnForBrkPlsVrnt5InCllsnFwdWarnCtrl_Ca "Jerk used when ramping down the single brake pulse request. Calibration variant 5: V54X, Hybrid vehicle + ACC brake aggregate." CURVE 0xfe504c64 /* @ECU_Address@FCW_JerkDwnForBrkPlsVrnt5InCllsnFwdWarnCtrl_Ca@ */ Record_FLOAT32_IEEE 0 autosar_swc_aeb_CM_single_m_per_s_ 0.000000 300.000000
 /begin AXIS_DESCR COM_AXIS NO_INPUT_QUANTITY autosar_swc_aeb_CM_single_m_per_s 5 0.000000 83.000000 AXIS_PTS_REF FCW_SpdInpThdVectForBrkPlsInCllsnFwdWarnCtrl_Ca /end AXIS_DESCR
/end CHARACTERISTIC
/begin CHARACTERISTIC FCW_JerkDwnForBrkPlsVrnt6InCllsnFwdWarnCtrl_Ca "Jerk used when ramping down the single brake pulse request. Calibration variant 6: V54X, Combustion engine + FSA brake aggregate." CURVE 0xfe504c78 /* @ECU_Address@FCW_JerkDwnForBrkPlsVrnt6InCllsnFwdWarnCtrl_Ca@ */ Record_FLOAT32_IEEE 0 autosar_swc_aeb_CM_single_m_per_s_ 0.000000 300.000000
 /begin AXIS_DESCR COM_AXIS NO_INPUT_QUANTITY autosar_swc_aeb_CM_single_m_per_s 5 0.000000 83.000000 AXIS_PTS_REF FCW_SpdInpThdVectForBrkPlsInCllsnFwdWarnCtrl_Ca /end AXIS_DESCR
/end CHARACTERISTIC
/begin CHARACTERISTIC FCW_JerkDwnForBrkPlsVrnt7InCllsnFwdWarnCtrl_Ca "Jerk used when ramping down the single brake pulse request. Calibration variant 7: V54X, Hybrid vehicle + FSA brake aggregate." CURVE 0xfe504c8c /* @ECU_Address@FCW_JerkDwnForBrkPlsVrnt7InCllsnFwdWarnCtrl_Ca@ */ Record_FLOAT32_IEEE 0 autosar_swc_aeb_CM_single_m_per_s_ 0.000000 300.000000
 /begin AXIS_DESCR COM_AXIS NO_INPUT_QUANTITY autosar_swc_aeb_CM_single_m_per_s 5 0.000000 83.000000 AXIS_PTS_REF FCW_SpdInpThdVectForBrkPlsInCllsnFwdWarnCtrl_Ca /end AXIS_DESCR
/end CHARACTERISTIC
/begin CHARACTERISTIC FCW_JerkUpTiForBrkPlsVrnt0InCllsnFwdWarnCtrl_Ca "Jerk up time-factor used when ramping up the single brake pulse request. Calibration variant 0: V526, Combustion engine + ACC brake aggregate." VALUE 0xfe5040e0 /* @ECU_Address@FCW_JerkUpTiForBrkPlsVrnt0InCllsnFwdWarnCtrl_Ca@ */ Record_FLOAT32_IEEE 0 autosar_swc_aeb_CM_single 1.000000 30.000000 /end CHARACTERISTIC
/begin CHARACTERISTIC FCW_JerkUpTiForBrkPlsVrnt1InCllsnFwdWarnCtrl_Ca "Jerk up time-factor used when ramping up the single brake pulse request. Calibration variant 1: V526, Hybrid vehicle + ACC brake aggregate." VALUE 0xfe5040e4 /* @ECU_Address@FCW_JerkUpTiForBrkPlsVrnt1InCllsnFwdWarnCtrl_Ca@ */ Record_FLOAT32_IEEE 0 autosar_swc_aeb_CM_single 1.000000 30.000000 /end CHARACTERISTIC
/begin CHARACTERISTIC FCW_JerkUpTiForBrkPlsVrnt2InCllsnFwdWarnCtrl_Ca "Jerk up time-factor used when ramping up the single brake pulse request. Calibration variant 2: V526, Combustion engine + FSA brake aggregate." VALUE 0xfe5040e8 /* @ECU_Address@FCW_JerkUpTiForBrkPlsVrnt2InCllsnFwdWarnCtrl_Ca@ */ Record_FLOAT32_IEEE 0 autosar_swc_aeb_CM_single 1.000000 30.000000 /end CHARACTERISTIC
/begin CHARACTERISTIC FCW_JerkUpTiForBrkPlsVrnt3InCllsnFwdWarnCtrl_Ca "Jerk up time-factor used when ramping up the single brake pulse request. Calibration variant 3: V526, Hybrid vehicle + FSA brake aggregate." VALUE 0xfe5040ec /* @ECU_Address@FCW_JerkUpTiForBrkPlsVrnt3InCllsnFwdWarnCtrl_Ca@ */ Record_FLOAT32_IEEE 0 autosar_swc_aeb_CM_single 1.000000 30.000000 /end CHARACTERISTIC
/begin CHARACTERISTIC FCW_JerkUpTiForBrkPlsVrnt4InCllsnFwdWarnCtrl_Ca "Jerk up time-factor used when ramping up the single brake pulse request. Calibration variant 4: Combustion engine + ACC brake aggregate." VALUE 0xfe5040f0 /* @ECU_Address@FCW_JerkUpTiForBrkPlsVrnt4InCllsnFwdWarnCtrl_Ca@ */ Record_FLOAT32_IEEE 0 autosar_swc_aeb_CM_single 1.000000 30.000000 /end CHARACTERISTIC
/begin CHARACTERISTIC FCW_JerkUpTiForBrkPlsVrnt5InCllsnFwdWarnCtrl_Ca "Jerk up time-factor used when ramping up the single brake pulse request. Calibration variant 5: V54X, Hybrid vehicle + ACC brake aggregate." VALUE 0xfe5040f4 /* @ECU_Address@FCW_JerkUpTiForBrkPlsVrnt5InCllsnFwdWarnCtrl_Ca@ */ Record_FLOAT32_IEEE 0 autosar_swc_aeb_CM_single 1.000000 30.000000 /end CHARACTERISTIC
/begin CHARACTERISTIC FCW_JerkUpTiForBrkPlsVrnt6InCllsnFwdWarnCtrl_Ca "Jerk up time-factor used when ramping up the single brake pulse request. Calibration variant 6: V54X, Combustion engine + FSA brake aggregate." VALUE 0xfe5040f8 /* @ECU_Address@FCW_JerkUpTiForBrkPlsVrnt6InCllsnFwdWarnCtrl_Ca@ */ Record_FLOAT32_IEEE 0 autosar_swc_aeb_CM_single 1.000000 30.000000 /end CHARACTERISTIC
/begin CHARACTERISTIC FCW_JerkUpTiForBrkPlsVrnt7InCllsnFwdWarnCtrl_Ca "Jerk up time-factor used when ramping up the single brake pulse request. Calibration variant 7: V54X, Hybrid vehicle + FSA brake aggregate." VALUE 0xfe5040fc /* @ECU_Address@FCW_JerkUpTiForBrkPlsVrnt7InCllsnFwdWarnCtrl_Ca@ */ Record_FLOAT32_IEEE 0 autosar_swc_aeb_CM_single 1.000000 30.000000 /end CHARACTERISTIC
/begin CHARACTERISTIC FCW_ManWarnDlyInCllsnFwdWarnCtrl_Ca "Delay from rising edge of \"TrigManWarnInCllsnFwdWarnCtrl\" until the warning is issued." VALUE 0xfe504100 /* @ECU_Address@FCW_ManWarnDlyInCllsnFwdWarnCtrl_Ca@ */ Record_FLOAT32_IEEE 0 autosar_swc_aeb_CM_single_s 0.000000 15.000000 /end CHARACTERISTIC
/begin CHARACTERISTIC FCW_ManWarnDurnInCllsnFwdWarnCtrl_Ca "Manual warning length. Equal to for how long the FCW start conditions are met." VALUE 0xfe504104 /* @ECU_Address@FCW_ManWarnDurnInCllsnFwdWarnCtrl_Ca@ */ Record_FLOAT32_IEEE 0 autosar_swc_aeb_CM_single_s 0.000000 6.000000 /end CHARACTERISTIC
/begin CHARACTERISTIC FCW_MaxAmpForBrkPlsInCllsnFwdWarnCtrl_Ca "Maximum amplitude of brake pulse in the single brake pulse request." VALUE 0xfe504108 /* @ECU_Address@FCW_MaxAmpForBrkPlsInCllsnFwdWarnCtrl_Ca@ */ Record_FLOAT32_IEEE 0 autosar_swc_aeb_CM_single_m_per_s_ 0.000000 10.000000 /end CHARACTERISTIC
/begin CHARACTERISTIC FCW_MinActvAmpForBrkPlsInCllsnFwdWarnCtrl_Ca "Minimum active amplitude of brake pulse in the single brake pulse request." VALUE 0xfe50410c /* @ECU_Address@FCW_MinActvAmpForBrkPlsInCllsnFwdWarnCtrl_Ca@ */ Record_FLOAT32_IEEE 0 autosar_swc_aeb_CM_single_m_per_s_ 0.000000 10.000000 /end CHARACTERISTIC
/begin CHARACTERISTIC FCW_MinAmpForBrkPlsInCllsnFwdWarnCtrl_Ca "Minimum amplitude of brake pulse in the single brake pulse request." VALUE 0xfe504110 /* @ECU_Address@FCW_MinAmpForBrkPlsInCllsnFwdWarnCtrl_Ca@ */ Record_FLOAT32_IEEE 0 autosar_swc_aeb_CM_single_m_per_s_ 0.000000 10.000000 /end CHARACTERISTIC
/begin CHARACTERISTIC FCW_MinWarnDplInCllsnFwdWarnCtrl_Ca "The minimum time that must pass between FCW warnings." VALUE 0xfe504114 /* @ECU_Address@FCW_MinWarnDplInCllsnFwdWarnCtrl_Ca@ */ Record_FLOAT32_IEEE 0 autosar_swc_aeb_CM_single_s 0.000000 10.000000 /end CHARACTERISTIC
/begin CHARACTERISTIC FCW_NrOfCycAtNoReqAndAForBrkPlsVrnt0InCllsnFwdWarnCtrl_Ca "The number of execution cycles that the Decel Request Enable signal will be held high when Deceleration Request is 0 m/s^2 and Host is accelerating." VALUE 0xfe5041b2 /* @ECU_Address@FCW_NrOfCycAtNoReqAndAForBrkPlsVrnt0InCllsnFwdWarnCtrl_Ca@ */ Record_SBYTE 0 autosar_swc_aeb_CM_int8 0.000000 10.000000 /end CHARACTERISTIC
/begin CHARACTERISTIC FCW_NrOfCycAtNoReqAndAForBrkPlsVrnt1InCllsnFwdWarnCtrl_Ca "The number of execution cycles that the Decel Request Enable signal will be held high when Deceleration Request is 0 m/s^2 and Host is accelerating." VALUE 0xfe5041b3 /* @ECU_Address@FCW_NrOfCycAtNoReqAndAForBrkPlsVrnt1InCllsnFwdWarnCtrl_Ca@ */ Record_SBYTE 0 autosar_swc_aeb_CM_int8 0.000000 10.000000 /end CHARACTERISTIC
/begin CHARACTERISTIC FCW_NrOfCycAtNoReqAndAForBrkPlsVrnt2InCllsnFwdWarnCtrl_Ca "The number of execution cycles that the Decel Request Enable signal will be held high when Deceleration Request is 0 m/s^2 and Host is accelerating." VALUE 0xfe5041b4 /* @ECU_Address@FCW_NrOfCycAtNoReqAndAForBrkPlsVrnt2InCllsnFwdWarnCtrl_Ca@ */ Record_SBYTE 0 autosar_swc_aeb_CM_int8 0.000000 10.000000 /end CHARACTERISTIC
/begin CHARACTERISTIC FCW_NrOfCycAtNoReqAndAForBrkPlsVrnt3InCllsnFwdWarnCtrl_Ca "The number of execution cycles that the Decel Request Enable signal will be held high when Deceleration Request is 0 m/s^2 and Host is accelerating." VALUE 0xfe5041b5 /* @ECU_Address@FCW_NrOfCycAtNoReqAndAForBrkPlsVrnt3InCllsnFwdWarnCtrl_Ca@ */ Record_SBYTE 0 autosar_swc_aeb_CM_int8 0.000000 10.000000 /end CHARACTERISTIC
/begin CHARACTERISTIC FCW_NrOfCycAtNoReqAndAForBrkPlsVrnt4InCllsnFwdWarnCtrl_Ca "The number of execution cycles that the Decel Request Enable signal will be held high when Deceleration Request is 0 m/s^2 and Host is accelerating." VALUE 0xfe5041b6 /* @ECU_Address@FCW_NrOfCycAtNoReqAndAForBrkPlsVrnt4InCllsnFwdWarnCtrl_Ca@ */ Record_SBYTE 0 autosar_swc_aeb_CM_int8 0.000000 10.000000 /end CHARACTERISTIC
/begin CHARACTERISTIC FCW_NrOfCycAtNoReqAndAForBrkPlsVrnt5InCllsnFwdWarnCtrl_Ca "The number of execution cycles that the Decel Request Enable signal will be held high when Deceleration Request is 0 m/s^2 and Host is accelerating." VALUE 0xfe5041b7 /* @ECU_Address@FCW_NrOfCycAtNoReqAndAForBrkPlsVrnt5InCllsnFwdWarnCtrl_Ca@ */ Record_SBYTE 0 autosar_swc_aeb_CM_int8 0.000000 10.000000 /end CHARACTERISTIC
/begin CHARACTERISTIC FCW_NrOfCycAtNoReqAndAForBrkPlsVrnt6InCllsnFwdWarnCtrl_Ca "The number of execution cycles that the Decel Request Enable signal will be held high when Deceleration Request is 0 m/s^2 and Host is accelerating." VALUE 0xfe5041b8 /* @ECU_Address@FCW_NrOfCycAtNoReqAndAForBrkPlsVrnt6InCllsnFwdWarnCtrl_Ca@ */ Record_SBYTE 0 autosar_swc_aeb_CM_int8 0.000000 10.000000 /end CHARACTERISTIC
/begin CHARACTERISTIC FCW_NrOfCycAtNoReqAndAForBrkPlsVrnt7InCllsnFwdWarnCtrl_Ca "The number of execution cycles that the Decel Request Enable signal will be held high when Deceleration Request is 0 m/s^2 and Host is accelerating." VALUE 0xfe5041b9 /* @ECU_Address@FCW_NrOfCycAtNoReqAndAForBrkPlsVrnt7InCllsnFwdWarnCtrl_Ca@ */ Record_SBYTE 0 autosar_swc_aeb_CM_int8 0.000000 10.000000 /end CHARACTERISTIC
/begin CHARACTERISTIC FCW_NrOfCycAtNoReqForBrkPlsVrnt0InCllsnFwdWarnCtrl_Ca "The number of execution cycles that the Decel Request Enable signal will be held high when Deceleration Request is 0 m/s^2." VALUE 0xfe5041ba /* @ECU_Address@FCW_NrOfCycAtNoReqForBrkPlsVrnt0InCllsnFwdWarnCtrl_Ca@ */ Record_SBYTE 0 autosar_swc_aeb_CM_int8 0.000000 10.000000 /end CHARACTERISTIC
/begin CHARACTERISTIC FCW_NrOfCycAtNoReqForBrkPlsVrnt1InCllsnFwdWarnCtrl_Ca "The number of execution cycles that the Decel Request Enable signal will be held high when Deceleration Request is 0 m/s^2." VALUE 0xfe5041bb /* @ECU_Address@FCW_NrOfCycAtNoReqForBrkPlsVrnt1InCllsnFwdWarnCtrl_Ca@ */ Record_SBYTE 0 autosar_swc_aeb_CM_int8 0.000000 10.000000 /end CHARACTERISTIC
/begin CHARACTERISTIC FCW_NrOfCycAtNoReqForBrkPlsVrnt2InCllsnFwdWarnCtrl_Ca "The number of execution cycles that the Decel Request Enable signal will be held high when Deceleration Request is 0 m/s^2." VALUE 0xfe5041bc /* @ECU_Address@FCW_NrOfCycAtNoReqForBrkPlsVrnt2InCllsnFwdWarnCtrl_Ca@ */ Record_SBYTE 0 autosar_swc_aeb_CM_int8 0.000000 10.000000 /end CHARACTERISTIC
/begin CHARACTERISTIC FCW_NrOfCycAtNoReqForBrkPlsVrnt3InCllsnFwdWarnCtrl_Ca "The number of execution cycles that the Decel Request Enable signal will be held high when Deceleration Request is 0 m/s^2." VALUE 0xfe5041bd /* @ECU_Address@FCW_NrOfCycAtNoReqForBrkPlsVrnt3InCllsnFwdWarnCtrl_Ca@ */ Record_SBYTE 0 autosar_swc_aeb_CM_int8 0.000000 10.000000 /end CHARACTERISTIC
/begin CHARACTERISTIC FCW_NrOfCycAtNoReqForBrkPlsVrnt4InCllsnFwdWarnCtrl_Ca "The number of execution cycles that the Decel Request Enable signal will be held high when Deceleration Request is 0 m/s^2." VALUE 0xfe5041be /* @ECU_Address@FCW_NrOfCycAtNoReqForBrkPlsVrnt4InCllsnFwdWarnCtrl_Ca@ */ Record_SBYTE 0 autosar_swc_aeb_CM_int8 0.000000 10.000000 /end CHARACTERISTIC
/begin CHARACTERISTIC FCW_NrOfCycAtNoReqForBrkPlsVrnt5InCllsnFwdWarnCtrl_Ca "The number of execution cycles that the Decel Request Enable signal will be held high when Deceleration Request is 0 m/s^2." VALUE 0xfe5041bf /* @ECU_Address@FCW_NrOfCycAtNoReqForBrkPlsVrnt5InCllsnFwdWarnCtrl_Ca@ */ Record_SBYTE 0 autosar_swc_aeb_CM_int8 0.000000 10.000000 /end CHARACTERISTIC
/begin CHARACTERISTIC FCW_NrOfCycAtNoReqForBrkPlsVrnt6InCllsnFwdWarnCtrl_Ca "The number of execution cycles that the Decel Request Enable signal will be held high when Deceleration Request is 0 m/s^2." VALUE 0xfe5041c0 /* @ECU_Address@FCW_NrOfCycAtNoReqForBrkPlsVrnt6InCllsnFwdWarnCtrl_Ca@ */ Record_SBYTE 0 autosar_swc_aeb_CM_int8 0.000000 10.000000 /end CHARACTERISTIC
/begin CHARACTERISTIC FCW_NrOfCycAtNoReqForBrkPlsVrnt7InCllsnFwdWarnCtrl_Ca "The number of execution cycles that the Decel Request Enable signal will be held high when Deceleration Request is 0 m/s^2." VALUE 0xfe5041c1 /* @ECU_Address@FCW_NrOfCycAtNoReqForBrkPlsVrnt7InCllsnFwdWarnCtrl_Ca@ */ Record_SBYTE 0 autosar_swc_aeb_CM_int8 0.000000 10.000000 /end CHARACTERISTIC
/begin CHARACTERISTIC FCW_NrOfCycCmpByVehMtnThdInCllsnFwdWarnCtrl_Ca "If the Brake Pulse Amplitude is higher than this threshold the number of cycles to keep enable high at change request shall be different." VALUE 0xfe504118 /* @ECU_Address@FCW_NrOfCycCmpByVehMtnThdInCllsnFwdWarnCtrl_Ca@ */ Record_FLOAT32_IEEE 0 autosar_swc_aeb_CM_single_m_per_s_2 0.000000 3.000000 /end CHARACTERISTIC
/begin CHARACTERISTIC FCW_PinionSteerAgSpdFilConInCllsnFwdWarnCtrl_Ca "Filter constant in low pass filter for Pinion Steering Angle Speed." VALUE 0xfe50411c /* @ECU_Address@FCW_PinionSteerAgSpdFilConInCllsnFwdWarnCtrl_Ca@ */ Record_FLOAT32_IEEE 0 autosar_swc_aeb_CM_single 0.000000 1.000000 /end CHARACTERISTIC
/begin CHARACTERISTIC FCW_PinionSteerAgSpdMinInCllsnFwdWarnCtrl_Ca "Minimum absolute value of steering angle speed to consider using reuired lateral acceleration for FCW." VALUE 0xfe504120 /* @ECU_Address@FCW_PinionSteerAgSpdMinInCllsnFwdWarnCtrl_Ca@ */ Record_FLOAT32_IEEE 0 autosar_swc_aeb_CM_single_rad_per_s 0.000000 50.000000 /end CHARACTERISTIC
/begin CHARACTERISTIC FCW_PosnLatMaxForDstCmftInCllsnFwdWarnCtrl_Ca "The parameter controls the end point for the cosine curve that is multiplied with the Range Rate and Range Acceleration factor. Maximum lateral distance for Comfort Distance." VALUE 0xfe504124 /* @ECU_Address@FCW_PosnLatMaxForDstCmftInCllsnFwdWarnCtrl_Ca@ */ Record_FLOAT32_IEEE 0 autosar_swc_aeb_CM_single_m 0.000000 50.000000 /end CHARACTERISTIC
/begin CHARACTERISTIC FCW_PosnLgtMaxForBicycleInCllsnFwdWarnCtrl_Ca "The maximum longitudinal position for a bicyclist to issue a warning." VALUE 0xfe504128 /* @ECU_Address@FCW_PosnLgtMaxForBicycleInCllsnFwdWarnCtrl_Ca@ */ Record_FLOAT32_IEEE 0 autosar_swc_aeb_CM_single_m 0.000000 200.000000 /end CHARACTERISTIC
/begin CHARACTERISTIC FCW_PosnLgtMaxForNoVisnVehInCllsnFwdWarnCtrl_Ca "The maximum longitudinal position for a vehicle, without vision classification, to issue a warning." VALUE 0xfe50412c /* @ECU_Address@FCW_PosnLgtMaxForNoVisnVehInCllsnFwdWarnCtrl_Ca@ */ Record_FLOAT32_IEEE 0 autosar_swc_aeb_CM_single_m 0.000000 200.000000 /end CHARACTERISTIC
/begin CHARACTERISTIC FCW_PosnLgtMaxForObjTyp7InCllsnFwdWarnCtrl_Ca "The maximum longitudinal position for an animal to issue a warning." VALUE 0xfe504130 /* @ECU_Address@FCW_PosnLgtMaxForObjTyp7InCllsnFwdWarnCtrl_Ca@ */ Record_FLOAT32_IEEE 0 autosar_swc_aeb_CM_single_m 0.000000 200.000000 /end CHARACTERISTIC
/begin CHARACTERISTIC FCW_PosnLgtMaxForObjTyp8InCllsnFwdWarnCtrl_Ca "The maximum longitudinal position for a general object to issue a warning." VALUE 0xfe504134 /* @ECU_Address@FCW_PosnLgtMaxForObjTyp8InCllsnFwdWarnCtrl_Ca@ */ Record_FLOAT32_IEEE 0 autosar_swc_aeb_CM_single_m 0.000000 200.000000 /end CHARACTERISTIC
/begin CHARACTERISTIC FCW_PosnLgtMaxForPedInCllsnFwdWarnCtrl_Ca "The maximum longitudinal position for a pedestrian to issue a warning." VALUE 0xfe504138 /* @ECU_Address@FCW_PosnLgtMaxForPedInCllsnFwdWarnCtrl_Ca@ */ Record_FLOAT32_IEEE 0 autosar_swc_aeb_CM_single_m 0.000000 200.000000 /end CHARACTERISTIC
/begin CHARACTERISTIC FCW_PosnLgtMaxForVehInCllsnFwdWarnCtrl_Ca "The maximum longitudinal position for a vehicle, with vision classification, to issue a warning." VALUE 0xfe50413c /* @ECU_Address@FCW_PosnLgtMaxForVehInCllsnFwdWarnCtrl_Ca@ */ Record_FLOAT32_IEEE 0 autosar_swc_aeb_CM_single_m 0.000000 200.000000 /end CHARACTERISTIC
/begin CHARACTERISTIC FCW_RatThdForCritEveInCllsnFwdWarnCtrl_Ca "Break Threat Number threshold (ratio between required and available longitudinal acceleration) above which an FCW is issued." VALUE 0xfe504140 /* @ECU_Address@FCW_RatThdForCritEveInCllsnFwdWarnCtrl_Ca@ */ Record_FLOAT32_IEEE 0 autosar_swc_aeb_CM_single 0.000000 2.000000 /end CHARACTERISTIC
/begin CHARACTERISTIC FCW_RatThdHysForCritEveInCllsnFwdWarnCtrl_Ca "Break Threat Number hysteresis to retract from Break Threat Number threshold in order to prevent bouncing." VALUE 0xfe504144 /* @ECU_Address@FCW_RatThdHysForCritEveInCllsnFwdWarnCtrl_Ca@ */ Record_FLOAT32_IEEE 0 autosar_swc_aeb_CM_single 0.000000 0.500000 /end CHARACTERISTIC
/begin CHARACTERISTIC FCW_SpdLimLowrInCllsnFwdWarnCtrl_Ca "Minimum allowed vehicle speed for collision warning." VALUE 0xfe504148 /* @ECU_Address@FCW_SpdLimLowrInCllsnFwdWarnCtrl_Ca@ */ Record_FLOAT32_IEEE 0 autosar_swc_aeb_CM_single_m_per_s 0.000000 10.000000 /end CHARACTERISTIC
/begin CHARACTERISTIC FCW_SpdLoThdForBrkGainHldInCllsnFwdWarnCtrl_Ca "Threshold for low speed based coasting of brake gain." VALUE 0xfe50414c /* @ECU_Address@FCW_SpdLoThdForBrkGainHldInCllsnFwdWarnCtrl_Ca@ */ Record_FLOAT32_IEEE 0 autosar_swc_aeb_CM_single_m_per_s 0.000000 10.000000 /end CHARACTERISTIC
/begin CHARACTERISTIC FCW_SpdMaxForSteerCdnInCllsnFwdWarnCtrl_Ca "Maximum vehicle speed for considering Steering Threat for FCW." VALUE 0xfe504150 /* @ECU_Address@FCW_SpdMaxForSteerCdnInCllsnFwdWarnCtrl_Ca@ */ Record_FLOAT32_IEEE 0 autosar_swc_aeb_CM_single_m_per_s 0.000000 70.000000 /end CHARACTERISTIC
/begin CHARACTERISTIC FCW_SteerCdnActvForAnimalInCllsnFwdWarnCtrl_Ca "Control whether or not the steering conditions logic for objects of type \"Animal\"." VALUE 0xfe5041a5 /* @ECU_Address@FCW_SteerCdnActvForAnimalInCllsnFwdWarnCtrl_Ca@ */ Record_BOOLEAN 0 autosar_swc_aeb_CM_logical 0 1 /end CHARACTERISTIC
/begin CHARACTERISTIC FCW_SteerCdnActvForBicycleInCllsnFwdWarnCtrl_Ca "Control whether or not the steering conditions logic for objects of type \"Bicycle\"." VALUE 0xfe5041a6 /* @ECU_Address@FCW_SteerCdnActvForBicycleInCllsnFwdWarnCtrl_Ca@ */ Record_BOOLEAN 0 autosar_swc_aeb_CM_logical 0 1 /end CHARACTERISTIC
/begin CHARACTERISTIC FCW_SteerCdnActvForCarInCllsnFwdWarnCtrl_Ca "Control whether or not the steering conditions logic for objects of type \"Car\"." VALUE 0xfe5041a7 /* @ECU_Address@FCW_SteerCdnActvForCarInCllsnFwdWarnCtrl_Ca@ */ Record_BOOLEAN 0 autosar_swc_aeb_CM_logical 0 1 /end CHARACTERISTIC
/begin CHARACTERISTIC FCW_SteerCdnActvForGenObjInCllsnFwdWarnCtrl_Ca "Control whether or not the steering conditions logic for objects of type \"General Object\"." VALUE 0xfe5041a8 /* @ECU_Address@FCW_SteerCdnActvForGenObjInCllsnFwdWarnCtrl_Ca@ */ Record_BOOLEAN 0 autosar_swc_aeb_CM_logical 0 1 /end CHARACTERISTIC
/begin CHARACTERISTIC FCW_SteerCdnActvForMotCycInCllsnFwdWarnCtrl_Ca "Control whether or not the steering conditions logic for objects of type \"Motor Cycle\"." VALUE 0xfe5041a9 /* @ECU_Address@FCW_SteerCdnActvForMotCycInCllsnFwdWarnCtrl_Ca@ */ Record_BOOLEAN 0 autosar_swc_aeb_CM_logical 0 1 /end CHARACTERISTIC
/begin CHARACTERISTIC FCW_SteerCdnActvForPedInCllsnFwdWarnCtrl_Ca "Control whether or not the steering conditions logic for objects of type \"Pedestrian\"." VALUE 0xfe5041aa /* @ECU_Address@FCW_SteerCdnActvForPedInCllsnFwdWarnCtrl_Ca@ */ Record_BOOLEAN 0 autosar_swc_aeb_CM_logical 0 1 /end CHARACTERISTIC
/begin CHARACTERISTIC FCW_SteerCdnActvForTruckInCllsnFwdWarnCtrl_Ca "Control whether or not the steering conditions logic for objects of type \"Truck\"." VALUE 0xfe5041ab /* @ECU_Address@FCW_SteerCdnActvForTruckInCllsnFwdWarnCtrl_Ca@ */ Record_BOOLEAN 0 autosar_swc_aeb_CM_logical 0 1 /end CHARACTERISTIC
/begin CHARACTERISTIC FCW_SteerCdnActvForVehOfUkwnClassInCllsnFwdWarnCtrl_Ca "Control whether or not the steering conditions logic for objects of type \"Vehicle Of Unkown Class\"." VALUE 0xfe5041ac /* @ECU_Address@FCW_SteerCdnActvForVehOfUkwnClassInCllsnFwdWarnCtrl_Ca@ */ Record_BOOLEAN 0 autosar_swc_aeb_CM_logical 0 1 /end CHARACTERISTIC
/begin CHARACTERISTIC FCW_SteerRatThdForBrkGainHiInCllsnFwdWarnCtrl_Ca "The value of steering threat number, based on estimation of the drivers lateral acceleration, above which high brake gain is requested, given all other conditions are met as well." VALUE 0xfe504154 /* @ECU_Address@FCW_SteerRatThdForBrkGainHiInCllsnFwdWarnCtrl_Ca@ */ Record_FLOAT32_IEEE 0 autosar_swc_aeb_CM_single 0.000000 2.000000 /end CHARACTERISTIC
/begin CHARACTERISTIC FCW_SteerRatThdHysForBrkGainHiInCllsnFwdWarnCtrl_Ca "The hysteresis to apply on steering threat number when high brake gain is requested to calculate the steering threat number threshold to deactivate high brake gain." VALUE 0xfe504158 /* @ECU_Address@FCW_SteerRatThdHysForBrkGainHiInCllsnFwdWarnCtrl_Ca@ */ Record_FLOAT32_IEEE 0 autosar_swc_aeb_CM_single 0.000000 2.000000 /end CHARACTERISTIC
/begin CHARACTERISTIC FCW_SteerWhlTurnDetnDlyInCllsnFwdWarnCtrl_Ca "Time to consider that the driver has turned the steering wheel. Primarily intended to handle passing through zero situations." VALUE 0xfe50415c /* @ECU_Address@FCW_SteerWhlTurnDetnDlyInCllsnFwdWarnCtrl_Ca@ */ Record_FLOAT32_IEEE 0 autosar_swc_aeb_CM_single_s 0.000000 2.000000 /end CHARACTERISTIC
/begin CHARACTERISTIC FCW_TiToCllsnLimForLvl1OfSnvtyInCllsnFwdWarnCtrl_Ca "Upper TTC limits for warnings on vehicles - FCW sensitivity level 1 (Low Sensitivity)." CURVE 0xfe5048c0 /* @ECU_Address@FCW_TiToCllsnLimForLvl1OfSnvtyInCllsnFwdWarnCtrl_Ca@ */ Record_FLOAT32_IEEE 0 autosar_swc_aeb_CM_single_s 0.000000 100.000000
 /begin AXIS_DESCR COM_AXIS NO_INPUT_QUANTITY autosar_swc_aeb_CM_single_m_per_s 4 0.000000 83.600000 AXIS_PTS_REF FCW_SpdInpThdVectForTiToCllsnInCllsnFwdWarnCtrl_Ca /end AXIS_DESCR
/end CHARACTERISTIC
/begin CHARACTERISTIC FCW_TiToCllsnLimForLvl2OfSnvtyInCllsnFwdWarnCtrl_Ca "Upper TTC limits for warnings on vehicles - FCW sensitivity level 2 (Normal Sensitivity)." CURVE 0xfe5048d0 /* @ECU_Address@FCW_TiToCllsnLimForLvl2OfSnvtyInCllsnFwdWarnCtrl_Ca@ */ Record_FLOAT32_IEEE 0 autosar_swc_aeb_CM_single_s 0.000000 100.000000
 /begin AXIS_DESCR COM_AXIS NO_INPUT_QUANTITY autosar_swc_aeb_CM_single_m_per_s 4 0.000000 83.600000 AXIS_PTS_REF FCW_SpdInpThdVectForTiToCllsnInCllsnFwdWarnCtrl_Ca /end AXIS_DESCR
/end CHARACTERISTIC
/begin CHARACTERISTIC FCW_TiToCllsnLimForLvl3OfSnvtyInCllsnFwdWarnCtrl_Ca "Upper TTC limits for warnings on vehicles - FCW sensitivity level 3 (High Sensitivity)." CURVE 0xfe5048e0 /* @ECU_Address@FCW_TiToCllsnLimForLvl3OfSnvtyInCllsnFwdWarnCtrl_Ca@ */ Record_FLOAT32_IEEE 0 autosar_swc_aeb_CM_single_s 0.000000 100.000000
 /begin AXIS_DESCR COM_AXIS NO_INPUT_QUANTITY autosar_swc_aeb_CM_single_m_per_s 4 0.000000 83.600000 AXIS_PTS_REF FCW_SpdInpThdVectForTiToCllsnInCllsnFwdWarnCtrl_Ca /end AXIS_DESCR
/end CHARACTERISTIC
/begin CHARACTERISTIC FCW_TrigManWarnInCllsnFwdWarnCtrl_Ca "Manual activation of FCW when \"WarnEnagModForInCllsnFwdWarnCtrl\" = 2." VALUE 0xfe5041ad /* @ECU_Address@FCW_TrigManWarnInCllsnFwdWarnCtrl_Ca@ */ Record_BOOLEAN 0 autosar_swc_aeb_CM_logical 0 1 /end CHARACTERISTIC
/begin CHARACTERISTIC FCW_VisnOnlyCfmActvdInCllsnFwdWarnCtrl_Ca "Parameter controlling if the Vision Only Confirmation shall be enabled or not." VALUE 0xfe5041ae /* @ECU_Address@FCW_VisnOnlyCfmActvdInCllsnFwdWarnCtrl_Ca@ */ Record_BOOLEAN 0 autosar_swc_aeb_CM_logical 0 1 /end CHARACTERISTIC
/begin CHARACTERISTIC FCW_WarnEnagModForInCllsnFwdWarnCtrl_Ca "Selection of start condition criteria where [1 = Use TA Based logic, 2 = Manual activation (use \"TrigManWarnInCllsnFwdWarnCtrl\" to activate)]." VALUE 0xfe5041c4 /* @ECU_Address@FCW_WarnEnagModForInCllsnFwdWarnCtrl_Ca@ */ Record_UBYTE 0 autosar_swc_aeb_CM_uint8 1.000000 2.000000 /end CHARACTERISTIC
/begin CHARACTERISTIC P_AEB_CBLACPLAOver60TTC "" VALUE 0xfe820018 /* @ECU_Address@P_AEB_CBLACPLAOver60TTC@ */ Record_FLOAT32_IEEE 0 autosar_swc_aeb_CM_single -3.4E+38 3.4E+38 /end CHARACTERISTIC
/begin CHARACTERISTIC P_AEB_CCRb70kphALgt "" VALUE 0xfe820048 /* @ECU_Address@P_AEB_CCRb70kphALgt@ */ Record_FLOAT32_IEEE 0 autosar_swc_aeb_CM_single -3.4E+38 3.4E+38 /end CHARACTERISTIC
/begin CHARACTERISTIC P_AEB_CCRb70kphTTC "" VALUE 0xfe82004c /* @ECU_Address@P_AEB_CCRb70kphTTC@ */ Record_FLOAT32_IEEE 0 autosar_swc_aeb_CM_single -3.4E+38 3.4E+38 /end CHARACTERISTIC
/begin CHARACTERISTIC P_AEB_CCRm70kphTTC "" VALUE 0xfe820050 /* @ECU_Address@P_AEB_CCRm70kphTTC@ */ Record_FLOAT32_IEEE 0 autosar_swc_aeb_CM_single -3.4E+38 3.4E+38 /end CHARACTERISTIC
/begin CHARACTERISTIC P_AEB_SCP40kphTTC "" VALUE 0xfe8200c8 /* @ECU_Address@P_AEB_SCP40kphTTC@ */ Record_FLOAT32_IEEE 0 autosar_swc_aeb_CM_single -3.4E+38 3.4E+38 /end CHARACTERISTIC
/begin CHARACTERISTIC P_AEB_UseCrvtFormVme "" VALUE 0xfe8200ef /* @ECU_Address@P_AEB_UseCrvtFormVme@ */ Record_BOOLEAN 0 autosar_swc_aeb_CM_boolean 0 1 /end CHARACTERISTIC
/begin MEASUREMENT autosar_swc_aeb_rtARID_DEF.Delay1_DSTATE "" FLOAT32_IEEE autosar_swc_aeb_CM_single 0 0 -3.4E+38 3.4E+38 LAYOUT COLUMN_DIR MATRIX_DIM 2 ECU_ADDRESS 0xfe4aa600 /* @ECU_Address@autosar_swc_aeb_rtARID_DEF.Delay1_DSTATE@ */ /end MEASUREMENT
/begin MEASUREMENT autosar_swc_aeb_rtARID_DEF.Delay1_DSTATE_g "" FLOAT32_IEEE autosar_swc_aeb_CM_single 0 0 -3.4E+38 3.4E+38 LAYOUT COLUMN_DIR MATRIX_DIM 2 ECU_ADDRESS 0xfe4aa630 /* @ECU_Address@autosar_swc_aeb_rtARID_DEF.Delay1_DSTATE_g@ */ /end MEASUREMENT
/begin MEASUREMENT autosar_swc_aeb_rtARID_DEF.Delay3_DSTATE "" FLOAT32_IEEE autosar_swc_aeb_CM_single 0 0 -3.4E+38 3.4E+38 ECU_ADDRESS 0xfe4ab7fc /* @ECU_Address@autosar_swc_aeb_rtARID_DEF.Delay3_DSTATE@ */ /end MEASUREMENT
/begin MEASUREMENT autosar_swc_aeb_rtARID_DEF.Delay3_DSTATE_a "" FLOAT32_IEEE autosar_swc_aeb_CM_single 0 0 -3.4E+38 3.4E+38 ECU_ADDRESS 0xfe4ab884 /* @ECU_Address@autosar_swc_aeb_rtARID_DEF.Delay3_DSTATE_a@ */ /end MEASUREMENT
/begin MEASUREMENT autosar_swc_aeb_rtARID_DEF.Delay5_DSTATE "" FLOAT32_IEEE autosar_swc_aeb_CM_single 0 0 -3.4E+38 3.4E+38 LAYOUT COLUMN_DIR MATRIX_DIM 2 ECU_ADDRESS 0xfe4aa608 /* @ECU_Address@autosar_swc_aeb_rtARID_DEF.Delay5_DSTATE@ */ /end MEASUREMENT
/begin MEASUREMENT autosar_swc_aeb_rtARID_DEF.Delay5_DSTATE_h "" FLOAT32_IEEE autosar_swc_aeb_CM_single 0 0 -3.4E+38 3.4E+38 LAYOUT COLUMN_DIR MATRIX_DIM 2 ECU_ADDRESS 0xfe4aa638 /* @ECU_Address@autosar_swc_aeb_rtARID_DEF.Delay5_DSTATE_h@ */ /end MEASUREMENT
/begin MEASUREMENT autosar_swc_aeb_rtARID_DEF.Delay_DSTATE "" FLOAT32_IEEE autosar_swc_aeb_CM_single 0 0 -3.4E+38 3.4E+38 ECU_ADDRESS 0xfe4ab7f8 /* @ECU_Address@autosar_swc_aeb_rtARID_DEF.Delay_DSTATE@ */ /end MEASUREMENT
/begin MEASUREMENT autosar_swc_aeb_rtARID_DEF.Delay_DSTATE_fk "" FLOAT32_IEEE autosar_swc_aeb_CM_single 0 0 -3.4E+38 3.4E+38 ECU_ADDRESS 0xfe4ab880 /* @ECU_Address@autosar_swc_aeb_rtARID_DEF.Delay_DSTATE_fk@ */ /end MEASUREMENT
/begin MEASUREMENT autosar_swc_aeb_rtARID_DEF.Delay_DSTATE_i "" FLOAT32_IEEE autosar_swc_aeb_CM_single 0 0 -3.4E+38 3.4E+38 ECU_ADDRESS 0xfe4ab86c /* @ECU_Address@autosar_swc_aeb_rtARID_DEF.Delay_DSTATE_i@ */ /end MEASUREMENT
/begin MEASUREMENT autosar_swc_aeb_rtARID_DEF.UD_1_DSTATE "" FLOAT32_IEEE autosar_swc_aeb_CM_single 0 0 -3.4E+38 3.4E+38 ECU_ADDRESS 0xfe4ab7ec /* @ECU_Address@autosar_swc_aeb_rtARID_DEF.UD_1_DSTATE@ */ /end MEASUREMENT
/begin MEASUREMENT autosar_swc_aeb_rtARID_DEF.UD_1_DSTATE_d "" UWORD autosar_swc_aeb_CM_uint16 0 0 0 65535 ECU_ADDRESS 0xfe4aba10 /* @ECU_Address@autosar_swc_aeb_rtARID_DEF.UD_1_DSTATE_d@ */ /end MEASUREMENT
/begin MEASUREMENT autosar_swc_aeb_rtARID_DEF.UD_1_DSTATE_m "" FLOAT32_IEEE autosar_swc_aeb_CM_single 0 0 -3.4E+38 3.4E+38 ECU_ADDRESS 0xfe4ab808 /* @ECU_Address@autosar_swc_aeb_rtARID_DEF.UD_1_DSTATE_m@ */ /end MEASUREMENT
/begin MEASUREMENT autosar_swc_aeb_rtARID_DEF.UD_1_DSTATE_o "" UWORD autosar_swc_aeb_CM_uint16 0 0 0 65535 ECU_ADDRESS 0xfe4aba0e /* @ECU_Address@autosar_swc_aeb_rtARID_DEF.UD_1_DSTATE_o@ */ /end MEASUREMENT
/begin MEASUREMENT autosar_swc_aeb_rtARID_DEF.UnitDelay1_DSTATE_ap "" UBYTE autosar_swc_aeb_CM_logical 0 0 0 1 ECU_ADDRESS 0xfe4abad8 /* @ECU_Address@autosar_swc_aeb_rtARID_DEF.UnitDelay1_DSTATE_ap@ */ /end MEASUREMENT
/begin MEASUREMENT autosar_swc_aeb_rtARID_DEF.UnitDelay1_DSTATE_i "" FLOAT32_IEEE autosar_swc_aeb_CM_single 0 0 -3.4E+38 3.4E+38 ECU_ADDRESS 0xfe4ab854 /* @ECU_Address@autosar_swc_aeb_rtARID_DEF.UnitDelay1_DSTATE_i@ */ /end MEASUREMENT
/begin MEASUREMENT autosar_swc_aeb_rtARID_DEF.UnitDelay1_DSTATE_k5 "" UBYTE autosar_swc_aeb_CM_logical 0 0 0 1 ECU_ADDRESS 0xfe4abad7 /* @ECU_Address@autosar_swc_aeb_rtARID_DEF.UnitDelay1_DSTATE_k5@ */ /end MEASUREMENT
/begin MEASUREMENT autosar_swc_aeb_rtARID_DEF.UnitDelay1_DSTATE_nn "" UBYTE autosar_swc_aeb_CM_logical 0 0 0 1 ECU_ADDRESS 0xfe4abad9 /* @ECU_Address@autosar_swc_aeb_rtARID_DEF.UnitDelay1_DSTATE_nn@ */ /end MEASUREMENT
/begin MEASUREMENT autosar_swc_aeb_rtARID_DEF.UnitDelay_DSTATE_a "" FLOAT32_IEEE autosar_swc_aeb_CM_single 0 0 -3.4E+38 3.4E+38 ECU_ADDRESS 0xfe4ab874 /* @ECU_Address@autosar_swc_aeb_rtARID_DEF.UnitDelay_DSTATE_a@ */ /end MEASUREMENT
/begin MEASUREMENT autosar_swc_aeb_rtARID_DEF.UnitDelay_DSTATE_bn "" FLOAT32_IEEE autosar_swc_aeb_CM_single 0 0 -3.4E+38 3.4E+38 ECU_ADDRESS 0xfe4ab850 /* @ECU_Address@autosar_swc_aeb_rtARID_DEF.UnitDelay_DSTATE_bn@ */ /end MEASUREMENT
/begin MEASUREMENT autosar_swc_aeb_rtARID_DEF.UnitDelay_DSTATE_hx "" UBYTE autosar_swc_aeb_CM_logical 0 0 0 1 ECU_ADDRESS 0xfe4abacb /* @ECU_Address@autosar_swc_aeb_rtARID_DEF.UnitDelay_DSTATE_hx@ */ /end MEASUREMENT
/begin MEASUREMENT autosar_swc_aeb_rtARID_DEF.UnitDelay_DSTATE_lq "" FLOAT32_IEEE autosar_swc_aeb_CM_single 0 0 -3.4E+38 3.4E+38 ECU_ADDRESS 0xfe4ab870 /* @ECU_Address@autosar_swc_aeb_rtARID_DEF.UnitDelay_DSTATE_lq@ */ /end MEASUREMENT
/begin MEASUREMENT autosar_swc_aeb_rtARID_DEF.UnitDelay_DSTATE_m "" FLOAT32_IEEE autosar_swc_aeb_CM_single 0 0 -3.4E+38 3.4E+38 ECU_ADDRESS 0xfe4ab7f0 /* @ECU_Address@autosar_swc_aeb_rtARID_DEF.UnitDelay_DSTATE_m@ */ /end MEASUREMENT
/begin MEASUREMENT autosar_swc_aeb_rtARID_DEF.UnitDelay_DSTATE_o "" FLOAT32_IEEE autosar_swc_aeb_CM_single 0 0 -3.4E+38 3.4E+38 ECU_ADDRESS 0xfe4ab80c /* @ECU_Address@autosar_swc_aeb_rtARID_DEF.UnitDelay_DSTATE_o@ */ /end MEASUREMENT
/begin MEASUREMENT autosar_swc_aeb_rtARID_DEF.brakeGainEnabled "" UBYTE autosar_swc_aeb_CM_logical 0 0 0 1 ECU_ADDRESS 0xfe4abac5 /* @ECU_Address@autosar_swc_aeb_rtARID_DEF.brakeGainEnabled@ */ /end MEASUREMENT
/begin MEASUREMENT autosar_swc_aeb_rtARID_DEF.brakeGainState "" UBYTE autosar_swc_aeb_CM_uint8 0 0 0 255 ECU_ADDRESS 0xfe4aba51 /* @ECU_Address@autosar_swc_aeb_rtARID_DEF.brakeGainState@ */ /end MEASUREMENT
/begin MEASUREMENT autosar_swc_aeb_rtARID_DEF.brakePulseAmplitude "" FLOAT32_IEEE autosar_swc_aeb_CM_single 0 0 -3.4E+38 3.4E+38 ECU_ADDRESS 0xfe4ab958 /* @ECU_Address@autosar_swc_aeb_rtARID_DEF.brakePulseAmplitude@ */ /end MEASUREMENT
/begin MEASUREMENT autosar_swc_aeb_rtARID_DEF.brakePulseFinished "" UBYTE autosar_swc_aeb_CM_logical 0 0 0 1 ECU_ADDRESS 0xfe4abac4 /* @ECU_Address@autosar_swc_aeb_rtARID_DEF.brakePulseFinished@ */ /end MEASUREMENT
/begin MEASUREMENT autosar_swc_aeb_rtARID_DEF.brakePulseHoldTime "" FLOAT32_IEEE autosar_swc_aeb_CM_single 0 0 -3.4E+38 3.4E+38 ECU_ADDRESS 0xfe4ab95c /* @ECU_Address@autosar_swc_aeb_rtARID_DEF.brakePulseHoldTime@ */ /end MEASUREMENT
/begin MEASUREMENT autosar_swc_aeb_rtARID_DEF.brakePulseJerkDown "" FLOAT32_IEEE autosar_swc_aeb_CM_single 0 0 -3.4E+38 3.4E+38 ECU_ADDRESS 0xfe4ab964 /* @ECU_Address@autosar_swc_aeb_rtARID_DEF.brakePulseJerkDown@ */ /end MEASUREMENT
/begin MEASUREMENT autosar_swc_aeb_rtARID_DEF.brakePulseJerkUp "" FLOAT32_IEEE autosar_swc_aeb_CM_single 0 0 -3.4E+38 3.4E+38 ECU_ADDRESS 0xfe4ab960 /* @ECU_Address@autosar_swc_aeb_rtARID_DEF.brakePulseJerkUp@ */ /end MEASUREMENT
/begin MEASUREMENT autosar_swc_aeb_rtARID_DEF.brakePulseRequest "" FLOAT32_IEEE autosar_swc_aeb_CM_single 0 0 -3.4E+38 3.4E+38 ECU_ADDRESS 0xfe4ab644 /* @ECU_Address@autosar_swc_aeb_rtARID_DEF.brakePulseRequest@ */ /end MEASUREMENT
/begin MEASUREMENT autosar_swc_aeb_rtARID_DEF.cyclesAtNoRequest "" SBYTE autosar_swc_aeb_CM_int8 0 0 -128 127 ECU_ADDRESS 0xfe4aba1f /* @ECU_Address@autosar_swc_aeb_rtARID_DEF.cyclesAtNoRequest@ */ /end MEASUREMENT
/begin MEASUREMENT autosar_swc_aeb_rtARID_DEF.delay "" FLOAT32_IEEE autosar_swc_aeb_CM_single 0 0 -3.4E+38 3.4E+38 ECU_ADDRESS 0xfe4ab950 /* @ECU_Address@autosar_swc_aeb_rtARID_DEF.delay@ */ /end MEASUREMENT
/begin MEASUREMENT autosar_swc_aeb_rtARID_DEF.delay_b "" FLOAT32_IEEE autosar_swc_aeb_CM_single 0 0 -3.4E+38 3.4E+38 ECU_ADDRESS 0xfe4ab954 /* @ECU_Address@autosar_swc_aeb_rtARID_DEF.delay_b@ */ /end MEASUREMENT
/begin MEASUREMENT autosar_swc_aeb_rtARID_DEF.delay_f "" FLOAT32_IEEE autosar_swc_aeb_CM_single 0 0 -3.4E+38 3.4E+38 ECU_ADDRESS 0xfe4ab96c /* @ECU_Address@autosar_swc_aeb_rtARID_DEF.delay_f@ */ /end MEASUREMENT
/begin MEASUREMENT autosar_swc_aeb_rtARID_DEF.delay_j "" FLOAT32_IEEE autosar_swc_aeb_CM_single 0 0 -3.4E+38 3.4E+38 ECU_ADDRESS 0xfe4ab968 /* @ECU_Address@autosar_swc_aeb_rtARID_DEF.delay_j@ */ /end MEASUREMENT
/begin MEASUREMENT autosar_swc_aeb_rtARID_DEF.is_ACTIVE "" UBYTE autosar_swc_aeb_CM_uint8 0 0 0 255 ECU_ADDRESS 0xfe4aba86 /* @ECU_Address@autosar_swc_aeb_rtARID_DEF.is_ACTIVE@ */ /end MEASUREMENT
/begin MEASUREMENT autosar_swc_aeb_rtARID_DEF.is_ACTIVE_p "" UBYTE autosar_swc_aeb_CM_uint8 0 0 0 255 ECU_ADDRESS 0xfe4aba8e /* @ECU_Address@autosar_swc_aeb_rtARID_DEF.is_ACTIVE_p@ */ /end MEASUREMENT
/begin MEASUREMENT autosar_swc_aeb_rtARID_DEF.is_StateMachine "" UBYTE autosar_swc_aeb_CM_uint8 0 0 0 255 ECU_ADDRESS 0xfe4aba8b /* @ECU_Address@autosar_swc_aeb_rtARID_DEF.is_StateMachine@ */ /end MEASUREMENT
/begin MEASUREMENT autosar_swc_aeb_rtARID_DEF.is_active_c374_autosar_swc_aeb "" UBYTE autosar_swc_aeb_CM_uint8 0 0 0 255 ECU_ADDRESS 0xfe4aba8c /* @ECU_Address@autosar_swc_aeb_rtARID_DEF.is_active_c374_autosar_swc_aeb@ */ /end MEASUREMENT
/begin MEASUREMENT autosar_swc_aeb_rtARID_DEF.is_active_c375_autosar_swc_aeb "" UBYTE autosar_swc_aeb_CM_uint8 0 0 0 255 ECU_ADDRESS 0xfe4aba89 /* @ECU_Address@autosar_swc_aeb_rtARID_DEF.is_active_c375_autosar_swc_aeb@ */ /end MEASUREMENT
/begin MEASUREMENT autosar_swc_aeb_rtARID_DEF.is_active_c377_autosar_swc_aeb "" UBYTE autosar_swc_aeb_CM_uint8 0 0 0 255 ECU_ADDRESS 0xfe4aba87 /* @ECU_Address@autosar_swc_aeb_rtARID_DEF.is_active_c377_autosar_swc_aeb@ */ /end MEASUREMENT
/begin MEASUREMENT autosar_swc_aeb_rtARID_DEF.is_active_c378_autosar_swc_aeb "" UBYTE autosar_swc_aeb_CM_uint8 0 0 0 255 ECU_ADDRESS 0xfe4aba84 /* @ECU_Address@autosar_swc_aeb_rtARID_DEF.is_active_c378_autosar_swc_aeb@ */ /end MEASUREMENT
/begin MEASUREMENT autosar_swc_aeb_rtARID_DEF.is_c374_autosar_swc_aeb "" UBYTE autosar_swc_aeb_CM_uint8 0 0 0 255 ECU_ADDRESS 0xfe4aba8d /* @ECU_Address@autosar_swc_aeb_rtARID_DEF.is_c374_autosar_swc_aeb@ */ /end MEASUREMENT
/begin MEASUREMENT autosar_swc_aeb_rtARID_DEF.is_c375_autosar_swc_aeb "" UBYTE autosar_swc_aeb_CM_uint8 0 0 0 255 ECU_ADDRESS 0xfe4aba8a /* @ECU_Address@autosar_swc_aeb_rtARID_DEF.is_c375_autosar_swc_aeb@ */ /end MEASUREMENT
/begin MEASUREMENT autosar_swc_aeb_rtARID_DEF.is_c377_autosar_swc_aeb "" UBYTE autosar_swc_aeb_CM_uint8 0 0 0 255 ECU_ADDRESS 0xfe4aba88 /* @ECU_Address@autosar_swc_aeb_rtARID_DEF.is_c377_autosar_swc_aeb@ */ /end MEASUREMENT
/begin MEASUREMENT autosar_swc_aeb_rtARID_DEF.is_c378_autosar_swc_aeb "" UBYTE autosar_swc_aeb_CM_uint8 0 0 0 255 ECU_ADDRESS 0xfe4aba85 /* @ECU_Address@autosar_swc_aeb_rtARID_DEF.is_c378_autosar_swc_aeb@ */ /end MEASUREMENT
/begin MEASUREMENT autosar_swc_aeb_rtARID_DEF.selectedObjectId "" UWORD autosar_swc_aeb_CM_uint16 0 0 0 65535 ECU_ADDRESS 0xfe4ab9fc /* @ECU_Address@autosar_swc_aeb_rtARID_DEF.selectedObjectId@ */ /end MEASUREMENT
/begin AXIS_PTS CLTS_VLgtValForCrvtTypTblInAsyEvlrCritEve_Ca "" 0xfe503ca4 /* @ECU_Address@CLTS_VLgtValForCrvtTypTblInAsyEvlrCritEve_Ca@ */ NO_INPUT_QUANTITY Axis_FLOAT32_IEEE 0 autosar_swc_aeb_CM_single_m_per_s 2 0.000000 100.000000 /end AXIS_PTS
/begin AXIS_PTS FCW_PinionSteerWhlAgVectForALatThdInCllsn_Ca "" 0xfe504858 /* @ECU_Address@FCW_PinionSteerWhlAgVectForALatThdInCllsn_Ca@ */ NO_INPUT_QUANTITY Axis_FLOAT32_IEEE 0 autosar_swc_aeb_CM_single_rad_per_s 6 0.000000 50.000000 /end AXIS_PTS
/begin AXIS_PTS FCW_SpdInpThdVectForBrkPlsDlyInCllsnFwdWarnCtrl_Ca "" 0xfe504870 /* @ECU_Address@FCW_SpdInpThdVectForBrkPlsDlyInCllsnFwdWarnCtrl_Ca@ */ NO_INPUT_QUANTITY Axis_FLOAT32_IEEE 0 autosar_swc_aeb_CM_single_m_per_s 8 0.000000 70.000000 /end AXIS_PTS
/begin AXIS_PTS FCW_SpdInpThdVectForBrkPlsInCllsnFwdWarnCtrl_Ca "" 0xfe504ca0 /* @ECU_Address@FCW_SpdInpThdVectForBrkPlsInCllsnFwdWarnCtrl_Ca@ */ NO_INPUT_QUANTITY Axis_FLOAT32_IEEE 0 autosar_swc_aeb_CM_single_m_per_s 5 0.000000 83.000000 /end AXIS_PTS
/begin AXIS_PTS FCW_SpdInpThdVectForDstCmftInCllsnFwdWarnCtrl_Ca "" 0xfe504890 /* @ECU_Address@FCW_SpdInpThdVectForDstCmftInCllsnFwdWarnCtrl_Ca@ */ NO_INPUT_QUANTITY Axis_FLOAT32_IEEE 0 autosar_swc_aeb_CM_single_m_per_s 8 0.000000 44.440000 /end AXIS_PTS
/begin AXIS_PTS FCW_SpdInpThdVectForTiToCllsnInCllsnFwdWarnCtrl_Ca "" 0xfe5048b0 /* @ECU_Address@FCW_SpdInpThdVectForTiToCllsnInCllsnFwdWarnCtrl_Ca@ */ NO_INPUT_QUANTITY Axis_FLOAT32_IEEE 0 autosar_swc_aeb_CM_single_m_per_s 4 0.000000 83.600000 /end AXIS_PTS
/begin COMPU_METHOD autosar_swc_aeb_CM_boolean "Q = V" IDENTICAL "%1.0" "" /end COMPU_METHOD
/begin COMPU_METHOD autosar_swc_aeb_CM_int8 "Q = V" IDENTICAL "%3.0" "" /end COMPU_METHOD
/begin COMPU_METHOD autosar_swc_aeb_CM_logical "Q = V" IDENTICAL "%1.0" "" /end COMPU_METHOD
/begin COMPU_METHOD autosar_swc_aeb_CM_single "Q = V" IDENTICAL "%8.6" "" /end COMPU_METHOD
/begin COMPU_METHOD autosar_swc_aeb_CM_single_m "Q = V" IDENTICAL "%8.6" "m" /end COMPU_METHOD
/begin COMPU_METHOD autosar_swc_aeb_CM_single_m_per_s "Q = V" IDENTICAL "%8.6" "m/s" /end COMPU_METHOD
/begin COMPU_METHOD autosar_swc_aeb_CM_single_m_per_s_ "Q = V" IDENTICAL "%8.6" "m/s?" /end COMPU_METHOD
/begin COMPU_METHOD autosar_swc_aeb_CM_single_m_per_s_2 "Q = V" IDENTICAL "%8.6" "m/s^2" /end COMPU_METHOD
/begin COMPU_METHOD autosar_swc_aeb_CM_single_rad_per_s "Q = V" IDENTICAL "%8.6" "rad/s" /end COMPU_METHOD
/begin COMPU_METHOD autosar_swc_aeb_CM_single_s "Q = V" IDENTICAL "%8.6" "s" /end COMPU_METHOD
/begin COMPU_METHOD autosar_swc_aeb_CM_uint16 "Q = V" IDENTICAL "%5.0" "" /end COMPU_METHOD
/begin COMPU_METHOD autosar_swc_aeb_CM_uint8 "Q = V" IDENTICAL "%3.0" "" /end COMPU_METHOD
/begin RECORD_LAYOUT Record_BOOLEAN FNC_VALUES 1 UBYTE COLUMN_DIR DIRECT /end RECORD_LAYOUT
/begin RECORD_LAYOUT Record_FLOAT32_IEEE FNC_VALUES 1 FLOAT32_IEEE COLUMN_DIR DIRECT /end RECORD_LAYOUT
/begin RECORD_LAYOUT Record_SBYTE FNC_VALUES 1 SBYTE COLUMN_DIR DIRECT /end RECORD_LAYOUT
/begin RECORD_LAYOUT Record_UBYTE FNC_VALUES 1 UBYTE COLUMN_DIR DIRECT /end RECORD_LAYOUT
/begin RECORD_LAYOUT Axis_FLOAT32_IEEE AXIS_PTS_X 1 FLOAT32_IEEE INDEX_INCR DIRECT /end RECORD_LAYOUT
/begin GROUP autosar_swc_aeb_autosar_swc_aeb_Step_sys_Subsystem_Reference_AEB_Function_Run_AsyEvlrCritEve_Step_Func_Run_AsyEvlrCritEve_Step_Func_TAWrapper_PreProcessor_ObjectPreProcessor_ObjectPreProcessorLoop_ValidObject_SafetyMarginFrontObjects_InPathCalculationWithPredictedObjPositions_CreateInPathDataTTR_ToDiag "autosar_swc_aeb/autosar_swc_aeb_Step_sys/Subsystem Reference/AEB Function/Run_AsyEvlrCritEve_Step_Func/Run_AsyEvlrCritEve_Step_Func/TAWrapper/PreProcessor/ObjectPreProcessor/ObjectPreProcessorLoop/ValidObject/SafetyMarginFrontObjects/InPathCalculationWithPredictedObjPositions/CreateInPathDataTTR/ToDiag"
 /begin SUB_GROUP autosar_swc_aeb_autosar_swc_aeb_Step_sys_Subsystem_Reference_AEB_Function_Run_AsyEvlrCritEve_Step_Func_Run_AsyEvlrCritEve_Step_Func_TAWrapper_PreProcessor_ObjectPreProcessor_ObjectPreProcessorLoop_ValidObject_SafetyMarginFrontObjects_InPathCalculationWithPredictedObjPositions_CreateInPathDataTTR_ToDiag_DIAG_TA_Inpath_PredObjAn autosar_swc_aeb_autosar_swc_aeb_Step_sys_Subsystem_Reference_AEB_Function_Run_AsyEvlrCritEve_Step_Func_Run_AsyEvlrCritEve_Step_Func_TAWrapper_PreProcessor_ObjectPreProcessor_ObjectPreProcessorLoop_ValidObject_SafetyMarginFrontObjects_InPathCalculationWithPredictedObjPositions_CreateInPathDataTTR_ToDiag_DIAG_TA_Inpath_PredObjAnBL autosar_swc_aeb_autosar_swc_aeb_Step_sys_Subsystem_Reference_AEB_Function_Run_AsyEvlrCritEve_Step_Func_Run_AsyEvlrCritEve_Step_Func_TAWrapper_PreProcessor_ObjectPreProcessor_ObjectPreProcessorLoop_ValidObject_SafetyMarginFrontObjects_InPathCalculationWithPredictedObjPositions_CreateInPathDataTTR_ToDiag_DIAG_TA_Inpath_PredObjAnBS autosar_swc_aeb_autosar_swc_aeb_Step_sys_Subsystem_Reference_AEB_Function_Run_AsyEvlrCritEve_Step_Func_Run_AsyEvlrCritEve_Step_Func_TAWrapper_PreProcessor_ObjectPreProcessor_ObjectPreProcessorLoop_ValidObject_SafetyMarginFrontObjects_InPathCalculationWithPredictedObjPositions_CreateInPathDataTTR_ToDiag_DIAG_TA_Inpath_PredObjAn_Le autosar_swc_aeb_autosar_swc_aeb_Step_sys_Subsystem_Reference_AEB_Function_Run_AsyEvlrCritEve_Step_Func_Run_AsyEvlrCritEve_Step_Func_TAWrapper_PreProcessor_ObjectPreProcessor_ObjectPreProcessorLoop_ValidObject_SafetyMarginFrontObjects_InPathCalculationWithPredictedObjPositions_CreateInPathDataTTR_ToDiag_DIAG_TA_Inpath_PredObjAn_Ri autosar_swc_aeb_autosar_swc_aeb_Step_sys_Subsystem_Reference_AEB_Function_Run_AsyEvlrCritEve_Step_Func_Run_AsyEvlrCritEve_Step_Func_TAWrapper_PreProcessor_ObjectPreProcessor_ObjectPreProcessorLoop_ValidObject_SafetyMarginFrontObjects_InPathCalculationWithPredictedObjPositions_CreateInPathDataTTR_ToDiag_DIAG_TA_Inpath_PredObjLat autosar_swc_aeb_autosar_swc_aeb_Step_sys_Subsystem_Reference_AEB_Function_Run_AsyEvlrCritEve_Step_Func_Run_AsyEvlrCritEve_Step_Func_TAWrapper_PreProcessor_ObjectPreProcessor_ObjectPreProcessorLoop_ValidObject_SafetyMarginFrontObjects_InPathCalculationWithPredictedObjPositions_CreateInPathDataTTR_ToDiag_DIAG_TA_Inpath_PredObjLatBL autosar_swc_aeb_autosar_swc_aeb_Step_sys_Subsystem_Reference_AEB_Function_Run_AsyEvlrCritEve_Step_Func_Run_AsyEvlrCritEve_Step_Func_TAWrapper_PreProcessor_ObjectPreProcessor_ObjectPreProcessorLoop_ValidObject_SafetyMarginFrontObjects_InPathCalculationWithPredictedObjPositions_CreateInPathDataTTR_ToDiag_DIAG_TA_Inpath_PredObjLatBS autosar_swc_aeb_autosar_swc_aeb_Step_sys_Subsystem_Reference_AEB_Function_Run_AsyEvlrCritEve_Step_Func_Run_AsyEvlrCritEve_Step_Func_TAWrapper_PreProcessor_ObjectPreProcessor_ObjectPreProcessorLoop_ValidObject_SafetyMarginFrontObjects_InPathCalculationWithPredictedObjPositions_CreateInPathDataTTR_ToDiag_DIAG_TA_Inpath_PredObjLat_Le autosar_swc_aeb_autosar_swc_aeb_Step_sys_Subsystem_Reference_AEB_Function_Run_AsyEvlrCritEve_Step_Func_Run_AsyEvlrCritEve_Step_Func_TAWrapper_PreProcessor_ObjectPreProcessor_ObjectPreProcessorLoop_ValidObject_SafetyMarginFrontObjects_InPathCalculationWithPredictedObjPositions_CreateInPathDataTTR_ToDiag_DIAG_TA_Inpath_PredObjLat_Ri autosar_swc_aeb_autosar_swc_aeb_Step_sys_Subsystem_Reference_AEB_Function_Run_AsyEvlrCritEve_Step_Func_Run_AsyEvlrCritEve_Step_Func_TAWrapper_PreProcessor_ObjectPreProcessor_ObjectPreProcessorLoop_ValidObject_SafetyMarginFrontObjects_InPathCalculationWithPredictedObjPositions_CreateInPathDataTTR_ToDiag_DIAG_TA_Inpath_PredObjLgt autosar_swc_aeb_autosar_swc_aeb_Step_sys_Subsystem_Reference_AEB_Function_Run_AsyEvlrCritEve_Step_Func_Run_AsyEvlrCritEve_Step_Func_TAWrapper_PreProcessor_ObjectPreProcessor_ObjectPreProcessorLoop_ValidObject_SafetyMarginFrontObjects_InPathCalculationWithPredictedObjPositions_CreateInPathDataTTR_ToDiag_DIAG_TA_Inpath_PredObjLgtBS autosar_swc_aeb_autosar_swc_aeb_Step_sys_Subsystem_Reference_AEB_Function_Run_AsyEvlrCritEve_Step_Func_Run_AsyEvlrCritEve_Step_Func_TAWrapper_PreProcessor_ObjectPreProcessor_ObjectPreProcessorLoop_ValidObject_SafetyMarginFrontObjects_InPathCalculationWithPredictedObjPositions_CreateInPathDataTTR_ToDiag_DIAG_TA_Inpath_PredObjLgt_BL autosar_swc_aeb_autosar_swc_aeb_Step_sys_Subsystem_Reference_AEB_Function_Run_AsyEvlrCritEve_Step_Func_Run_AsyEvlrCritEve_Step_Func_TAWrapper_PreProcessor_ObjectPreProcessor_ObjectPreProcessorLoop_ValidObject_SafetyMarginFrontObjects_InPathCalculationWithPredictedObjPositions_CreateInPathDataTTR_ToDiag_DIAG_TA_Inpath_PredObjLgt_Le autosar_swc_aeb_autosar_swc_aeb_Step_sys_Subsystem_Reference_AEB_Function_Run_AsyEvlrCritEve_Step_Func_Run_AsyEvlrCritEve_Step_Func_TAWrapper_PreProcessor_ObjectPreProcessor_ObjectPreProcessorLoop_ValidObject_SafetyMarginFrontObjects_InPathCalculationWithPredictedObjPositions_CreateInPathDataTTR_ToDiag_DIAG_TA_Inpath_PredObjLgt_Ri /end SUB_GROUP
/end GROUP
/begin GROUP autosar_swc_aeb_autosar_swc_aeb_Step_sys_Subsystem_Reference_AEB_Function_Run_AsyEvlrCritEve_Step_Func_Run_AsyEvlrCritEve_Step_Func_TAWrapper_PreProcessor_ObjectPreProcessor_ObjectPreProcessorLoop_ValidObject_SafetyMarginFrontObjects_InPathCalculationWithPredictedObjPositions_CreateInPathDataTTR_ToDiag_DIAG_TA_Inpath_PredObjAn "autosar_swc_aeb/autosar_swc_aeb_Step_sys/Subsystem Reference/AEB Function/Run_AsyEvlrCritEve_Step_Func/Run_AsyEvlrCritEve_Step_Func/TAWrapper/PreProcessor/ObjectPreProcessor/ObjectPreProcessorLoop/ValidObject/SafetyMarginFrontObjects/InPathCalculationWithPredictedObjPositions/CreateInPathDataTTR/ToDiag/DIAG_TA_Inpath_PredObjAn"
 /begin SUB_GROUP autosar_swc_aeb_autosar_swc_aeb_Step_sys_Subsystem_Reference_AEB_Function_Run_AsyEvlrCritEve_Step_Func_Run_AsyEvlrCritEve_Step_Func_TAWrapper_PreProcessor_ObjectPreProcessor_ObjectPreProcessorLoop_ValidObject_SafetyMarginFrontObjects_InPathCalculationWithPredictedObjPositions_CreateInPathDataTTR_ToDiag_DIAG_TA_Inpath_PredObjAn_off /end SUB_GROUP
/end GROUP
/begin GROUP autosar_swc_aeb_autosar_swc_aeb_Step_sys_Subsystem_Reference_AEB_Function_Run_AsyEvlrCritEve_Step_Func_Run_AsyEvlrCritEve_Step_Func_TAWrapper_PreProcessor_ObjectPreProcessor_ObjectPreProcessorLoop_ValidObject_SafetyMarginFrontObjects_InPathCalculationWithPredictedObjPositions_CreateInPathDataTTR_ToDiag_DIAG_TA_Inpath_PredObjAnBL "autosar_swc_aeb/autosar_swc_aeb_Step_sys/Subsystem Reference/AEB Function/Run_AsyEvlrCritEve_Step_Func/Run_AsyEvlrCritEve_Step_Func/TAWrapper/PreProcessor/ObjectPreProcessor/ObjectPreProcessorLoop/ValidObject/SafetyMarginFrontObjects/InPathCalculationWithPredictedObjPositions/CreateInPathDataTTR/ToDiag/DIAG_TA_Inpath_PredObjAnBL"
 /begin SUB_GROUP autosar_swc_aeb_autosar_swc_aeb_Step_sys_Subsystem_Reference_AEB_Function_Run_AsyEvlrCritEve_Step_Func_Run_AsyEvlrCritEve_Step_Func_TAWrapper_PreProcessor_ObjectPreProcessor_ObjectPreProcessorLoop_ValidObject_SafetyMarginFrontObjects_InPathCalculationWithPredictedObjPositions_CreateInPathDataTTR_ToDiag_DIAG_TA_Inpath_PredObjAnBL_off /end SUB_GROUP
/end GROUP
/begin GROUP autosar_swc_aeb_autosar_swc_aeb_Step_sys_Subsystem_Reference_AEB_Function_Run_AsyEvlrCritEve_Step_Func_Run_AsyEvlrCritEve_Step_Func_TAWrapper_PreProcessor_ObjectPreProcessor_ObjectPreProcessorLoop_ValidObject_SafetyMarginFrontObjects_InPathCalculationWithPredictedObjPositions_CreateInPathDataTTR_ToDiag_DIAG_TA_Inpath_PredObjAnBL_off "autosar_swc_aeb/autosar_swc_aeb_Step_sys/Subsystem Reference/AEB Function/Run_AsyEvlrCritEve_Step_Func/Run_AsyEvlrCritEve_Step_Func/TAWrapper/PreProcessor/ObjectPreProcessor/ObjectPreProcessorLoop/ValidObject/SafetyMarginFrontObjects/InPathCalculationWithPredictedObjPositions/CreateInPathDataTTR/ToDiag/DIAG_TA_Inpath_PredObjAnBL/off"
 /begin SUB_GROUP autosar_swc_aeb_autosar_swc_aeb_Step_sys_Subsystem_Reference_AEB_Function_Run_AsyEvlrCritEve_Step_Func_Run_AsyEvlrCritEve_Step_Func_TAWrapper_PreProcessor_ObjectPreProcessor_ObjectPreProcessorLoop_ValidObject_SafetyMarginFrontObjects_InPathCalculationWithPredictedObjPositions_CreateInPathDataTTR_ToDiag_DIAG_TA_Inpath_PredObjAnBL_off_ALVTerm /end SUB_GROUP
/end GROUP
/begin GROUP autosar_swc_aeb_autosar_swc_aeb_Step_sys_Subsystem_Reference_AEB_Function_Run_AsyEvlrCritEve_Step_Func_Run_AsyEvlrCritEve_Step_Func_TAWrapper_PreProcessor_ObjectPreProcessor_ObjectPreProcessorLoop_ValidObject_SafetyMarginFrontObjects_InPathCalculationWithPredictedObjPositions_CreateInPathDataTTR_ToDiag_DIAG_TA_Inpath_PredObjAnBS "autosar_swc_aeb/autosar_swc_aeb_Step_sys/Subsystem Reference/AEB Function/Run_AsyEvlrCritEve_Step_Func/Run_AsyEvlrCritEve_Step_Func/TAWrapper/PreProcessor/ObjectPreProcessor/ObjectPreProcessorLoop/ValidObject/SafetyMarginFrontObjects/InPathCalculationWithPredictedObjPositions/CreateInPathDataTTR/ToDiag/DIAG_TA_Inpath_PredObjAnBS"
 /begin SUB_GROUP autosar_swc_aeb_autosar_swc_aeb_Step_sys_Subsystem_Reference_AEB_Function_Run_AsyEvlrCritEve_Step_Func_Run_AsyEvlrCritEve_Step_Func_TAWrapper_PreProcessor_ObjectPreProcessor_ObjectPreProcessorLoop_ValidObject_SafetyMarginFrontObjects_InPathCalculationWithPredictedObjPositions_CreateInPathDataTTR_ToDiag_DIAG_TA_Inpath_PredObjAnBS_off /end SUB_GROUP
/end GROUP
/begin GROUP autosar_swc_aeb_autosar_swc_aeb_Step_sys_Subsystem_Reference_AEB_Function_Run_AsyEvlrCritEve_Step_Func_Run_AsyEvlrCritEve_Step_Func_TAWrapper_PreProcessor_ObjectPreProcessor_ObjectPreProcessorLoop_ValidObject_SafetyMarginFrontObjects_InPathCalculationWithPredictedObjPositions_CreateInPathDataTTR_ToDiag_DIAG_TA_Inpath_PredObjAnBS_off "autosar_swc_aeb/autosar_swc_aeb_Step_sys/Subsystem Reference/AEB Function/Run_AsyEvlrCritEve_Step_Func/Run_AsyEvlrCritEve_Step_Func/TAWrapper/PreProcessor/ObjectPreProcessor/ObjectPreProcessorLoop/ValidObject/SafetyMarginFrontObjects/InPathCalculationWithPredictedObjPositions/CreateInPathDataTTR/ToDiag/DIAG_TA_Inpath_PredObjAnBS/off"
 /begin SUB_GROUP autosar_swc_aeb_autosar_swc_aeb_Step_sys_Subsystem_Reference_AEB_Function_Run_AsyEvlrCritEve_Step_Func_Run_AsyEvlrCritEve_Step_Func_TAWrapper_PreProcessor_ObjectPreProcessor_ObjectPreProcessorLoop_ValidObject_SafetyMarginFrontObjects_InPathCalculationWithPredictedObjPositions_CreateInPathDataTTR_ToDiag_DIAG_TA_Inpath_PredObjAnBS_off_ALVTerm /end SUB_GROUP
/end GROUP
/begin GROUP autosar_swc_aeb_autosar_swc_aeb_Step_sys_Subsystem_Reference_AEB_Function_Run_AsyEvlrCritEve_Step_Func_Run_AsyEvlrCritEve_Step_Func_TAWrapper_PreProcessor_ObjectPreProcessor_ObjectPreProcessorLoop_ValidObject_SafetyMarginFrontObjects_InPathCalculationWithPredictedObjPositions_CreateInPathDataTTR_ToDiag_DIAG_TA_Inpath_PredObjAn_Le "autosar_swc_aeb/autosar_swc_aeb_Step_sys/Subsystem Reference/AEB Function/Run_AsyEvlrCritEve_Step_Func/Run_AsyEvlrCritEve_Step_Func/TAWrapper/PreProcessor/ObjectPreProcessor/ObjectPreProcessorLoop/ValidObject/SafetyMarginFrontObjects/InPathCalculationWithPredictedObjPositions/CreateInPathDataTTR/ToDiag/DIAG_TA_Inpath_PredObjAn_Le"
 /begin SUB_GROUP autosar_swc_aeb_autosar_swc_aeb_Step_sys_Subsystem_Reference_AEB_Function_Run_AsyEvlrCritEve_Step_Func_Run_AsyEvlrCritEve_Step_Func_TAWrapper_PreProcessor_ObjectPreProcessor_ObjectPreProcessorLoop_ValidObject_SafetyMarginFrontObjects_InPathCalculationWithPredictedObjPositions_CreateInPathDataTTR_ToDiag_DIAG_TA_Inpath_PredObjAn_Le_off /end SUB_GROUP
/end GROUP
/begin GROUP autosar_swc_aeb_autosar_swc_aeb_Step_sys_Subsystem_Reference_AEB_Function_Run_AsyEvlrCritEve_Step_Func_Run_AsyEvlrCritEve_Step_Func_TAWrapper_PreProcessor_ObjectPreProcessor_ObjectPreProcessorLoop_ValidObject_SafetyMarginFrontObjects_InPathCalculationWithPredictedObjPositions_CreateInPathDataTTR_ToDiag_DIAG_TA_Inpath_PredObjAn_Le_off "autosar_swc_aeb/autosar_swc_aeb_Step_sys/Subsystem Reference/AEB Function/Run_AsyEvlrCritEve_Step_Func/Run_AsyEvlrCritEve_Step_Func/TAWrapper/PreProcessor/ObjectPreProcessor/ObjectPreProcessorLoop/ValidObject/SafetyMarginFrontObjects/InPathCalculationWithPredictedObjPositions/CreateInPathDataTTR/ToDiag/DIAG_TA_Inpath_PredObjAn_Le/off"
 /begin SUB_GROUP autosar_swc_aeb_autosar_swc_aeb_Step_sys_Subsystem_Reference_AEB_Function_Run_AsyEvlrCritEve_Step_Func_Run_AsyEvlrCritEve_Step_Func_TAWrapper_PreProcessor_ObjectPreProcessor_ObjectPreProcessorLoop_ValidObject_SafetyMarginFrontObjects_InPathCalculationWithPredictedObjPositions_CreateInPathDataTTR_ToDiag_DIAG_TA_Inpath_PredObjAn_Le_off_ALVTerm /end SUB_GROUP
/end GROUP
/begin GROUP autosar_swc_aeb_autosar_swc_aeb_Step_sys_Subsystem_Reference_AEB_Function_Run_AsyEvlrCritEve_Step_Func_Run_AsyEvlrCritEve_Step_Func_TAWrapper_PreProcessor_ObjectPreProcessor_ObjectPreProcessorLoop_ValidObject_SafetyMarginFrontObjects_InPathCalculationWithPredictedObjPositions_CreateInPathDataTTR_ToDiag_DIAG_TA_Inpath_PredObjAn_Ri "autosar_swc_aeb/autosar_swc_aeb_Step_sys/Subsystem Reference/AEB Function/Run_AsyEvlrCritEve_Step_Func/Run_AsyEvlrCritEve_Step_Func/TAWrapper/PreProcessor/ObjectPreProcessor/ObjectPreProcessorLoop/ValidObject/SafetyMarginFrontObjects/InPathCalculationWithPredictedObjPositions/CreateInPathDataTTR/ToDiag/DIAG_TA_Inpath_PredObjAn_Ri"
 /begin SUB_GROUP autosar_swc_aeb_autosar_swc_aeb_Step_sys_Subsystem_Reference_AEB_Function_Run_AsyEvlrCritEve_Step_Func_Run_AsyEvlrCritEve_Step_Func_TAWrapper_PreProcessor_ObjectPreProcessor_ObjectPreProcessorLoop_ValidObject_SafetyMarginFrontObjects_InPathCalculationWithPredictedObjPositions_CreateInPathDataTTR_ToDiag_DIAG_TA_Inpath_PredObjAn_Ri_off /end SUB_GROUP
/end GROUP
/begin GROUP autosar_swc_aeb_autosar_swc_aeb_Step_sys_Subsystem_Reference_AEB_Function_Run_AsyEvlrCritEve_Step_Func_Run_AsyEvlrCritEve_Step_Func_TAWrapper_PreProcessor_ObjectPreProcessor_ObjectPreProcessorLoop_ValidObject_SafetyMarginFrontObjects_InPathCalculationWithPredictedObjPositions_CreateInPathDataTTR_ToDiag_DIAG_TA_Inpath_PredObjAn_Ri_off "autosar_swc_aeb/autosar_swc_aeb_Step_sys/Subsystem Reference/AEB Function/Run_AsyEvlrCritEve_Step_Func/Run_AsyEvlrCritEve_Step_Func/TAWrapper/PreProcessor/ObjectPreProcessor/ObjectPreProcessorLoop/ValidObject/SafetyMarginFrontObjects/InPathCalculationWithPredictedObjPositions/CreateInPathDataTTR/ToDiag/DIAG_TA_Inpath_PredObjAn_Ri/off"
 /begin SUB_GROUP autosar_swc_aeb_autosar_swc_aeb_Step_sys_Subsystem_Reference_AEB_Function_Run_AsyEvlrCritEve_Step_Func_Run_AsyEvlrCritEve_Step_Func_TAWrapper_PreProcessor_ObjectPreProcessor_ObjectPreProcessorLoop_ValidObject_SafetyMarginFrontObjects_InPathCalculationWithPredictedObjPositions_CreateInPathDataTTR_ToDiag_DIAG_TA_Inpath_PredObjAn_Ri_off_ALVTerm /end SUB_GROUP
/end GROUP
/begin GROUP autosar_swc_aeb_autosar_swc_aeb_Step_sys_Subsystem_Reference_AEB_Function_Run_AsyEvlrCritEve_Step_Func_Run_AsyEvlrCritEve_Step_Func_TAWrapper_PreProcessor_ObjectPreProcessor_ObjectPreProcessorLoop_ValidObject_SafetyMarginFrontObjects_InPathCalculationWithPredictedObjPositions_CreateInPathDataTTR_ToDiag_DIAG_TA_Inpath_PredObjAn_off "autosar_swc_aeb/autosar_swc_aeb_Step_sys/Subsystem Reference/AEB Function/Run_AsyEvlrCritEve_Step_Func/Run_AsyEvlrCritEve_Step_Func/TAWrapper/PreProcessor/ObjectPreProcessor/ObjectPreProcessorLoop/ValidObject/SafetyMarginFrontObjects/InPathCalculationWithPredictedObjPositions/CreateInPathDataTTR/ToDiag/DIAG_TA_Inpath_PredObjAn/off"
 /begin SUB_GROUP autosar_swc_aeb_autosar_swc_aeb_Step_sys_Subsystem_Reference_AEB_Function_Run_AsyEvlrCritEve_Step_Func_Run_AsyEvlrCritEve_Step_Func_TAWrapper_PreProcessor_ObjectPreProcessor_ObjectPreProcessorLoop_ValidObject_SafetyMarginFrontObjects_InPathCalculationWithPredictedObjPositions_CreateInPathDataTTR_ToDiag_DIAG_TA_Inpath_PredObjAn_off_ALVTerm /end SUB_GROUP
/end GROUP
/begin GROUP autosar_swc_aeb_autosar_swc_aeb_Step_sys_Subsystem_Reference_AEB_Function_Run_AsyEvlrCritEve_Step_Func_Run_AsyEvlrCritEve_Step_Func_TAWrapper_PreProcessor_ObjectPreProcessor_ObjectPreProcessorLoop_ValidObject_SafetyMarginFrontObjects_InPathCalculationWithPredictedObjPositions_CreateInPathDataTTR_ToDiag_DIAG_TA_Inpath_PredObjLat "autosar_swc_aeb/autosar_swc_aeb_Step_sys/Subsystem Reference/AEB Function/Run_AsyEvlrCritEve_Step_Func/Run_AsyEvlrCritEve_Step_Func/TAWrapper/PreProcessor/ObjectPreProcessor/ObjectPreProcessorLoop/ValidObject/SafetyMarginFrontObjects/InPathCalculationWithPredictedObjPositions/CreateInPathDataTTR/ToDiag/DIAG_TA_Inpath_PredObjLat"
 /begin SUB_GROUP autosar_swc_aeb_autosar_swc_aeb_Step_sys_Subsystem_Reference_AEB_Function_Run_AsyEvlrCritEve_Step_Func_Run_AsyEvlrCritEve_Step_Func_TAWrapper_PreProcessor_ObjectPreProcessor_ObjectPreProcessorLoop_ValidObject_SafetyMarginFrontObjects_InPathCalculationWithPredictedObjPositions_CreateInPathDataTTR_ToDiag_DIAG_TA_Inpath_PredObjLat_off /end SUB_GROUP
/end GROUP
/begin GROUP autosar_swc_aeb_autosar_swc_aeb_Step_sys_Subsystem_Reference_AEB_Function_Run_AsyEvlrCritEve_Step_Func_Run_AsyEvlrCritEve_Step_Func_TAWrapper_PreProcessor_ObjectPreProcessor_ObjectPreProcessorLoop_ValidObject_SafetyMarginFrontObjects_InPathCalculationWithPredictedObjPositions_CreateInPathDataTTR_ToDiag_DIAG_TA_Inpath_PredObjLatBL "autosar_swc_aeb/autosar_swc_aeb_Step_sys/Subsystem Reference/AEB Function/Run_AsyEvlrCritEve_Step_Func/Run_AsyEvlrCritEve_Step_Func/TAWrapper/PreProcessor/ObjectPreProcessor/ObjectPreProcessorLoop/ValidObject/SafetyMarginFrontObjects/InPathCalculationWithPredictedObjPositions/CreateInPathDataTTR/ToDiag/DIAG_TA_Inpath_PredObjLatBL"
 /begin SUB_GROUP autosar_swc_aeb_autosar_swc_aeb_Step_sys_Subsystem_Reference_AEB_Function_Run_AsyEvlrCritEve_Step_Func_Run_AsyEvlrCritEve_Step_Func_TAWrapper_PreProcessor_ObjectPreProcessor_ObjectPreProcessorLoop_ValidObject_SafetyMarginFrontObjects_InPathCalculationWithPredictedObjPositions_CreateInPathDataTTR_ToDiag_DIAG_TA_Inpath_PredObjLatBL_off /end SUB_GROUP
/end GROUP
/begin GROUP autosar_swc_aeb_autosar_swc_aeb_Step_sys_Subsystem_Reference_AEB_Function_Run_AsyEvlrCritEve_Step_Func_Run_AsyEvlrCritEve_Step_Func_TAWrapper_PreProcessor_ObjectPreProcessor_ObjectPreProcessorLoop_ValidObject_SafetyMarginFrontObjects_InPathCalculationWithPredictedObjPositions_CreateInPathDataTTR_ToDiag_DIAG_TA_Inpath_PredObjLatBL_off "autosar_swc_aeb/autosar_swc_aeb_Step_sys/Subsystem Reference/AEB Function/Run_AsyEvlrCritEve_Step_Func/Run_AsyEvlrCritEve_Step_Func/TAWrapper/PreProcessor/ObjectPreProcessor/ObjectPreProcessorLoop/ValidObject/SafetyMarginFrontObjects/InPathCalculationWithPredictedObjPositions/CreateInPathDataTTR/ToDiag/DIAG_TA_Inpath_PredObjLatBL/off"
 /begin SUB_GROUP autosar_swc_aeb_autosar_swc_aeb_Step_sys_Subsystem_Reference_AEB_Function_Run_AsyEvlrCritEve_Step_Func_Run_AsyEvlrCritEve_Step_Func_TAWrapper_PreProcessor_ObjectPreProcessor_ObjectPreProcessorLoop_ValidObject_SafetyMarginFrontObjects_InPathCalculationWithPredictedObjPositions_CreateInPathDataTTR_ToDiag_DIAG_TA_Inpath_PredObjLatBL_off_ALVTerm /end SUB_GROUP
/end GROUP
/begin GROUP autosar_swc_aeb_autosar_swc_aeb_Step_sys_Subsystem_Reference_AEB_Function_Run_AsyEvlrCritEve_Step_Func_Run_AsyEvlrCritEve_Step_Func_TAWrapper_PreProcessor_ObjectPreProcessor_ObjectPreProcessorLoop_ValidObject_SafetyMarginFrontObjects_InPathCalculationWithPredictedObjPositions_CreateInPathDataTTR_ToDiag_DIAG_TA_Inpath_PredObjLatBS "autosar_swc_aeb/autosar_swc_aeb_Step_sys/Subsystem Reference/AEB Function/Run_AsyEvlrCritEve_Step_Func/Run_AsyEvlrCritEve_Step_Func/TAWrapper/PreProcessor/ObjectPreProcessor/ObjectPreProcessorLoop/ValidObject/SafetyMarginFrontObjects/InPathCalculationWithPredictedObjPositions/CreateInPathDataTTR/ToDiag/DIAG_TA_Inpath_PredObjLatBS"
 /begin SUB_GROUP autosar_swc_aeb_autosar_swc_aeb_Step_sys_Subsystem_Reference_AEB_Function_Run_AsyEvlrCritEve_Step_Func_Run_AsyEvlrCritEve_Step_Func_TAWrapper_PreProcessor_ObjectPreProcessor_ObjectPreProcessorLoop_ValidObject_SafetyMarginFrontObjects_InPathCalculationWithPredictedObjPositions_CreateInPathDataTTR_ToDiag_DIAG_TA_Inpath_PredObjLatBS_off /end SUB_GROUP
/end GROUP
/begin GROUP autosar_swc_aeb_autosar_swc_aeb_Step_sys_Subsystem_Reference_AEB_Function_Run_AsyEvlrCritEve_Step_Func_Run_AsyEvlrCritEve_Step_Func_TAWrapper_PreProcessor_ObjectPreProcessor_ObjectPreProcessorLoop_ValidObject_SafetyMarginFrontObjects_InPathCalculationWithPredictedObjPositions_CreateInPathDataTTR_ToDiag_DIAG_TA_Inpath_PredObjLatBS_off "autosar_swc_aeb/autosar_swc_aeb_Step_sys/Subsystem Reference/AEB Function/Run_AsyEvlrCritEve_Step_Func/Run_AsyEvlrCritEve_Step_Func/TAWrapper/PreProcessor/ObjectPreProcessor/ObjectPreProcessorLoop/ValidObject/SafetyMarginFrontObjects/InPathCalculationWithPredictedObjPositions/CreateInPathDataTTR/ToDiag/DIAG_TA_Inpath_PredObjLatBS/off"
 /begin SUB_GROUP autosar_swc_aeb_autosar_swc_aeb_Step_sys_Subsystem_Reference_AEB_Function_Run_AsyEvlrCritEve_Step_Func_Run_AsyEvlrCritEve_Step_Func_TAWrapper_PreProcessor_ObjectPreProcessor_ObjectPreProcessorLoop_ValidObject_SafetyMarginFrontObjects_InPathCalculationWithPredictedObjPositions_CreateInPathDataTTR_ToDiag_DIAG_TA_Inpath_PredObjLatBS_off_ALVTerm /end SUB_GROUP
/end GROUP
/begin GROUP autosar_swc_aeb_autosar_swc_aeb_Step_sys_Subsystem_Reference_AEB_Function_Run_AsyEvlrCritEve_Step_Func_Run_AsyEvlrCritEve_Step_Func_TAWrapper_PreProcessor_ObjectPreProcessor_ObjectPreProcessorLoop_ValidObject_SafetyMarginFrontObjects_InPathCalculationWithPredictedObjPositions_CreateInPathDataTTR_ToDiag_DIAG_TA_Inpath_PredObjLat_Le "autosar_swc_aeb/autosar_swc_aeb_Step_sys/Subsystem Reference/AEB Function/Run_AsyEvlrCritEve_Step_Func/Run_AsyEvlrCritEve_Step_Func/TAWrapper/PreProcessor/ObjectPreProcessor/ObjectPreProcessorLoop/ValidObject/SafetyMarginFrontObjects/InPathCalculationWithPredictedObjPositions/CreateInPathDataTTR/ToDiag/DIAG_TA_Inpath_PredObjLat_Le"
 /begin SUB_GROUP autosar_swc_aeb_autosar_swc_aeb_Step_sys_Subsystem_Reference_AEB_Function_Run_AsyEvlrCritEve_Step_Func_Run_AsyEvlrCritEve_Step_Func_TAWrapper_PreProcessor_ObjectPreProcessor_ObjectPreProcessorLoop_ValidObject_SafetyMarginFrontObjects_InPathCalculationWithPredictedObjPositions_CreateInPathDataTTR_ToDiag_DIAG_TA_Inpath_PredObjLat_Le_off /end SUB_GROUP
/end GROUP
/begin GROUP autosar_swc_aeb_autosar_swc_aeb_Step_sys_Subsystem_Reference_AEB_Function_Run_AsyEvlrCritEve_Step_Func_Run_AsyEvlrCritEve_Step_Func_TAWrapper_PreProcessor_ObjectPreProcessor_ObjectPreProcessorLoop_ValidObject_SafetyMarginFrontObjects_InPathCalculationWithPredictedObjPositions_CreateInPathDataTTR_ToDiag_DIAG_TA_Inpath_PredObjLat_Le_off "autosar_swc_aeb/autosar_swc_aeb_Step_sys/Subsystem Reference/AEB Function/Run_AsyEvlrCritEve_Step_Func/Run_AsyEvlrCritEve_Step_Func/TAWrapper/PreProcessor/ObjectPreProcessor/ObjectPreProcessorLoop/ValidObject/SafetyMarginFrontObjects/InPathCalculationWithPredictedObjPositions/CreateInPathDataTTR/ToDiag/DIAG_TA_Inpath_PredObjLat_Le/off"
 /begin SUB_GROUP autosar_swc_aeb_autosar_swc_aeb_Step_sys_Subsystem_Reference_AEB_Function_Run_AsyEvlrCritEve_Step_Func_Run_AsyEvlrCritEve_Step_Func_TAWrapper_PreProcessor_ObjectPreProcessor_ObjectPreProcessorLoop_ValidObject_SafetyMarginFrontObjects_InPathCalculationWithPredictedObjPositions_CreateInPathDataTTR_ToDiag_DIAG_TA_Inpath_PredObjLat_Le_off_ALVTerm /end SUB_GROUP
/end GROUP
/begin GROUP autosar_swc_aeb_autosar_swc_aeb_Step_sys_Subsystem_Reference_AEB_Function_Run_AsyEvlrCritEve_Step_Func_Run_AsyEvlrCritEve_Step_Func_TAWrapper_PreProcessor_ObjectPreProcessor_ObjectPreProcessorLoop_ValidObject_SafetyMarginFrontObjects_InPathCalculationWithPredictedObjPositions_CreateInPathDataTTR_ToDiag_DIAG_TA_Inpath_PredObjLat_Ri "autosar_swc_aeb/autosar_swc_aeb_Step_sys/Subsystem Reference/AEB Function/Run_AsyEvlrCritEve_Step_Func/Run_AsyEvlrCritEve_Step_Func/TAWrapper/PreProcessor/ObjectPreProcessor/ObjectPreProcessorLoop/ValidObject/SafetyMarginFrontObjects/InPathCalculationWithPredictedObjPositions/CreateInPathDataTTR/ToDiag/DIAG_TA_Inpath_PredObjLat_Ri"
 /begin SUB_GROUP autosar_swc_aeb_autosar_swc_aeb_Step_sys_Subsystem_Reference_AEB_Function_Run_AsyEvlrCritEve_Step_Func_Run_AsyEvlrCritEve_Step_Func_TAWrapper_PreProcessor_ObjectPreProcessor_ObjectPreProcessorLoop_ValidObject_SafetyMarginFrontObjects_InPathCalculationWithPredictedObjPositions_CreateInPathDataTTR_ToDiag_DIAG_TA_Inpath_PredObjLat_Ri_off /end SUB_GROUP
/end GROUP
/begin GROUP autosar_swc_aeb_autosar_swc_aeb_Step_sys_Subsystem_Reference_AEB_Function_Run_AsyEvlrCritEve_Step_Func_Run_AsyEvlrCritEve_Step_Func_TAWrapper_PreProcessor_ObjectPreProcessor_ObjectPreProcessorLoop_ValidObject_SafetyMarginFrontObjects_InPathCalculationWithPredictedObjPositions_CreateInPathDataTTR_ToDiag_DIAG_TA_Inpath_PredObjLat_Ri_off "autosar_swc_aeb/autosar_swc_aeb_Step_sys/Subsystem Reference/AEB Function/Run_AsyEvlrCritEve_Step_Func/Run_AsyEvlrCritEve_Step_Func/TAWrapper/PreProcessor/ObjectPreProcessor/ObjectPreProcessorLoop/ValidObject/SafetyMarginFrontObjects/InPathCalculationWithPredictedObjPositions/CreateInPathDataTTR/ToDiag/DIAG_TA_Inpath_PredObjLat_Ri/off"
 /begin SUB_GROUP autosar_swc_aeb_autosar_swc_aeb_Step_sys_Subsystem_Reference_AEB_Function_Run_AsyEvlrCritEve_Step_Func_Run_AsyEvlrCritEve_Step_Func_TAWrapper_PreProcessor_ObjectPreProcessor_ObjectPreProcessorLoop_ValidObject_SafetyMarginFrontObjects_InPathCalculationWithPredictedObjPositions_CreateInPathDataTTR_ToDiag_DIAG_TA_Inpath_PredObjLat_Ri_off_ALVTerm /end SUB_GROUP
/end GROUP
/begin GROUP autosar_swc_aeb_autosar_swc_aeb_Step_sys_Subsystem_Reference_AEB_Function_Run_AsyEvlrCritEve_Step_Func_Run_AsyEvlrCritEve_Step_Func_TAWrapper_PreProcessor_ObjectPreProcessor_ObjectPreProcessorLoop_ValidObject_SafetyMarginFrontObjects_InPathCalculationWithPredictedObjPositions_CreateInPathDataTTR_ToDiag_DIAG_TA_Inpath_PredObjLat_off "autosar_swc_aeb/autosar_swc_aeb_Step_sys/Subsystem Reference/AEB Function/Run_AsyEvlrCritEve_Step_Func/Run_AsyEvlrCritEve_Step_Func/TAWrapper/PreProcessor/ObjectPreProcessor/ObjectPreProcessorLoop/ValidObject/SafetyMarginFrontObjects/InPathCalculationWithPredictedObjPositions/CreateInPathDataTTR/ToDiag/DIAG_TA_Inpath_PredObjLat/off"
 /begin SUB_GROUP autosar_swc_aeb_autosar_swc_aeb_Step_sys_Subsystem_Reference_AEB_Function_Run_AsyEvlrCritEve_Step_Func_Run_AsyEvlrCritEve_Step_Func_TAWrapper_PreProcessor_ObjectPreProcessor_ObjectPreProcessorLoop_ValidObject_SafetyMarginFrontObjects_InPathCalculationWithPredictedObjPositions_CreateInPathDataTTR_ToDiag_DIAG_TA_Inpath_PredObjLat_off_ALVTerm /end SUB_GROUP
/end GROUP
/begin GROUP autosar_swc_aeb_autosar_swc_aeb_Step_sys_Subsystem_Reference_AEB_Function_Run_AsyEvlrCritEve_Step_Func_Run_AsyEvlrCritEve_Step_Func_TAWrapper_PreProcessor_ObjectPreProcessor_ObjectPreProcessorLoop_ValidObject_SafetyMarginFrontObjects_InPathCalculationWithPredictedObjPositions_CreateInPathDataTTR_ToDiag_DIAG_TA_Inpath_PredObjLgt "autosar_swc_aeb/autosar_swc_aeb_Step_sys/Subsystem Reference/AEB Function/Run_AsyEvlrCritEve_Step_Func/Run_AsyEvlrCritEve_Step_Func/TAWrapper/PreProcessor/ObjectPreProcessor/ObjectPreProcessorLoop/ValidObject/SafetyMarginFrontObjects/InPathCalculationWithPredictedObjPositions/CreateInPathDataTTR/ToDiag/DIAG_TA_Inpath_PredObjLgt"
 /begin SUB_GROUP autosar_swc_aeb_autosar_swc_aeb_Step_sys_Subsystem_Reference_AEB_Function_Run_AsyEvlrCritEve_Step_Func_Run_AsyEvlrCritEve_Step_Func_TAWrapper_PreProcessor_ObjectPreProcessor_ObjectPreProcessorLoop_ValidObject_SafetyMarginFrontObjects_InPathCalculationWithPredictedObjPositions_CreateInPathDataTTR_ToDiag_DIAG_TA_Inpath_PredObjLgt_off /end SUB_GROUP
/end GROUP
/begin GROUP autosar_swc_aeb_autosar_swc_aeb_Step_sys_Subsystem_Reference_AEB_Function_Run_AsyEvlrCritEve_Step_Func_Run_AsyEvlrCritEve_Step_Func_TAWrapper_PreProcessor_ObjectPreProcessor_ObjectPreProcessorLoop_ValidObject_SafetyMarginFrontObjects_InPathCalculationWithPredictedObjPositions_CreateInPathDataTTR_ToDiag_DIAG_TA_Inpath_PredObjLgtBS "autosar_swc_aeb/autosar_swc_aeb_Step_sys/Subsystem Reference/AEB Function/Run_AsyEvlrCritEve_Step_Func/Run_AsyEvlrCritEve_Step_Func/TAWrapper/PreProcessor/ObjectPreProcessor/ObjectPreProcessorLoop/ValidObject/SafetyMarginFrontObjects/InPathCalculationWithPredictedObjPositions/CreateInPathDataTTR/ToDiag/DIAG_TA_Inpath_PredObjLgtBS"
 /begin SUB_GROUP autosar_swc_aeb_autosar_swc_aeb_Step_sys_Subsystem_Reference_AEB_Function_Run_AsyEvlrCritEve_Step_Func_Run_AsyEvlrCritEve_Step_Func_TAWrapper_PreProcessor_ObjectPreProcessor_ObjectPreProcessorLoop_ValidObject_SafetyMarginFrontObjects_InPathCalculationWithPredictedObjPositions_CreateInPathDataTTR_ToDiag_DIAG_TA_Inpath_PredObjLgtBS_off /end SUB_GROUP
/end GROUP
/begin GROUP autosar_swc_aeb_autosar_swc_aeb_Step_sys_Subsystem_Reference_AEB_Function_Run_AsyEvlrCritEve_Step_Func_Run_AsyEvlrCritEve_Step_Func_TAWrapper_PreProcessor_ObjectPreProcessor_ObjectPreProcessorLoop_ValidObject_SafetyMarginFrontObjects_InPathCalculationWithPredictedObjPositions_CreateInPathDataTTR_ToDiag_DIAG_TA_Inpath_PredObjLgtBS_off "autosar_swc_aeb/autosar_swc_aeb_Step_sys/Subsystem Reference/AEB Function/Run_AsyEvlrCritEve_Step_Func/Run_AsyEvlrCritEve_Step_Func/TAWrapper/PreProcessor/ObjectPreProcessor/ObjectPreProcessorLoop/ValidObject/SafetyMarginFrontObjects/InPathCalculationWithPredictedObjPositions/CreateInPathDataTTR/ToDiag/DIAG_TA_Inpath_PredObjLgtBS/off"
 /begin SUB_GROUP autosar_swc_aeb_autosar_swc_aeb_Step_sys_Subsystem_Reference_AEB_Function_Run_AsyEvlrCritEve_Step_Func_Run_AsyEvlrCritEve_Step_Func_TAWrapper_PreProcessor_ObjectPreProcessor_ObjectPreProcessorLoop_ValidObject_SafetyMarginFrontObjects_InPathCalculationWithPredictedObjPositions_CreateInPathDataTTR_ToDiag_DIAG_TA_Inpath_PredObjLgtBS_off_ALVTerm /end SUB_GROUP
/end GROUP
/begin GROUP autosar_swc_aeb_autosar_swc_aeb_Step_sys_Subsystem_Reference_AEB_Function_Run_AsyEvlrCritEve_Step_Func_Run_AsyEvlrCritEve_Step_Func_TAWrapper_PreProcessor_ObjectPreProcessor_ObjectPreProcessorLoop_ValidObject_SafetyMarginFrontObjects_InPathCalculationWithPredictedObjPositions_CreateInPathDataTTR_ToDiag_DIAG_TA_Inpath_PredObjLgt_BL "autosar_swc_aeb/autosar_swc_aeb_Step_sys/Subsystem Reference/AEB Function/Run_AsyEvlrCritEve_Step_Func/Run_AsyEvlrCritEve_Step_Func/TAWrapper/PreProcessor/ObjectPreProcessor/ObjectPreProcessorLoop/ValidObject/SafetyMarginFrontObjects/InPathCalculationWithPredictedObjPositions/CreateInPathDataTTR/ToDiag/DIAG_TA_Inpath_PredObjLgt_BL"
 /begin SUB_GROUP autosar_swc_aeb_autosar_swc_aeb_Step_sys_Subsystem_Reference_AEB_Function_Run_AsyEvlrCritEve_Step_Func_Run_AsyEvlrCritEve_Step_Func_TAWrapper_PreProcessor_ObjectPreProcessor_ObjectPreProcessorLoop_ValidObject_SafetyMarginFrontObjects_InPathCalculationWithPredictedObjPositions_CreateInPathDataTTR_ToDiag_DIAG_TA_Inpath_PredObjLgt_BL_off /end SUB_GROUP
/end GROUP
/begin GROUP autosar_swc_aeb_autosar_swc_aeb_Step_sys_Subsystem_Reference_AEB_Function_Run_AsyEvlrCritEve_Step_Func_Run_AsyEvlrCritEve_Step_Func_TAWrapper_PreProcessor_ObjectPreProcessor_ObjectPreProcessorLoop_ValidObject_SafetyMarginFrontObjects_InPathCalculationWithPredictedObjPositions_CreateInPathDataTTR_ToDiag_DIAG_TA_Inpath_PredObjLgt_BL_off "autosar_swc_aeb/autosar_swc_aeb_Step_sys/Subsystem Reference/AEB Function/Run_AsyEvlrCritEve_Step_Func/Run_AsyEvlrCritEve_Step_Func/TAWrapper/PreProcessor/ObjectPreProcessor/ObjectPreProcessorLoop/ValidObject/SafetyMarginFrontObjects/InPathCalculationWithPredictedObjPositions/CreateInPathDataTTR/ToDiag/DIAG_TA_Inpath_PredObjLgt_BL/off"
 /begin SUB_GROUP autosar_swc_aeb_autosar_swc_aeb_Step_sys_Subsystem_Reference_AEB_Function_Run_AsyEvlrCritEve_Step_Func_Run_AsyEvlrCritEve_Step_Func_TAWrapper_PreProcessor_ObjectPreProcessor_ObjectPreProcessorLoop_ValidObject_SafetyMarginFrontObjects_InPathCalculationWithPredictedObjPositions_CreateInPathDataTTR_ToDiag_DIAG_TA_Inpath_PredObjLgt_BL_off_ALVTerm /end SUB_GROUP
/end GROUP
/begin GROUP autosar_swc_aeb_autosar_swc_aeb_Step_sys_Subsystem_Reference_AEB_Function_Run_AsyEvlrCritEve_Step_Func_Run_AsyEvlrCritEve_Step_Func_TAWrapper_PreProcessor_ObjectPreProcessor_ObjectPreProcessorLoop_ValidObject_SafetyMarginFrontObjects_InPathCalculationWithPredictedObjPositions_CreateInPathDataTTR_ToDiag_DIAG_TA_Inpath_PredObjLgt_Le "autosar_swc_aeb/autosar_swc_aeb_Step_sys/Subsystem Reference/AEB Function/Run_AsyEvlrCritEve_Step_Func/Run_AsyEvlrCritEve_Step_Func/TAWrapper/PreProcessor/ObjectPreProcessor/ObjectPreProcessorLoop/ValidObject/SafetyMarginFrontObjects/InPathCalculationWithPredictedObjPositions/CreateInPathDataTTR/ToDiag/DIAG_TA_Inpath_PredObjLgt_Le"
 /begin SUB_GROUP autosar_swc_aeb_autosar_swc_aeb_Step_sys_Subsystem_Reference_AEB_Function_Run_AsyEvlrCritEve_Step_Func_Run_AsyEvlrCritEve_Step_Func_TAWrapper_PreProcessor_ObjectPreProcessor_ObjectPreProcessorLoop_ValidObject_SafetyMarginFrontObjects_InPathCalculationWithPredictedObjPositions_CreateInPathDataTTR_ToDiag_DIAG_TA_Inpath_PredObjLgt_Le_off /end SUB_GROUP
/end GROUP
/begin GROUP autosar_swc_aeb_autosar_swc_aeb_Step_sys_Subsystem_Reference_AEB_Function_Run_AsyEvlrCritEve_Step_Func_Run_AsyEvlrCritEve_Step_Func_TAWrapper_PreProcessor_ObjectPreProcessor_ObjectPreProcessorLoop_ValidObject_SafetyMarginFrontObjects_InPathCalculationWithPredictedObjPositions_CreateInPathDataTTR_ToDiag_DIAG_TA_Inpath_PredObjLgt_Le_off "autosar_swc_aeb/autosar_swc_aeb_Step_sys/Subsystem Reference/AEB Function/Run_AsyEvlrCritEve_Step_Func/Run_AsyEvlrCritEve_Step_Func/TAWrapper/PreProcessor/ObjectPreProcessor/ObjectPreProcessorLoop/ValidObject/SafetyMarginFrontObjects/InPathCalculationWithPredictedObjPositions/CreateInPathDataTTR/ToDiag/DIAG_TA_Inpath_PredObjLgt_Le/off"
 /begin SUB_GROUP autosar_swc_aeb_autosar_swc_aeb_Step_sys_Subsystem_Reference_AEB_Function_Run_AsyEvlrCritEve_Step_Func_Run_AsyEvlrCritEve_Step_Func_TAWrapper_PreProcessor_ObjectPreProcessor_ObjectPreProcessorLoop_ValidObject_SafetyMarginFrontObjects_InPathCalculationWithPredictedObjPositions_CreateInPathDataTTR_ToDiag_DIAG_TA_Inpath_PredObjLgt_Le_off_ALVTerm /end SUB_GROUP
/end GROUP
/begin GROUP autosar_swc_aeb_autosar_swc_aeb_Step_sys_Subsystem_Reference_AEB_Function_Run_AsyEvlrCritEve_Step_Func_Run_AsyEvlrCritEve_Step_Func_TAWrapper_PreProcessor_ObjectPreProcessor_ObjectPreProcessorLoop_ValidObject_SafetyMarginFrontObjects_InPathCalculationWithPredictedObjPositions_CreateInPathDataTTR_ToDiag_DIAG_TA_Inpath_PredObjLgt_Ri "autosar_swc_aeb/autosar_swc_aeb_Step_sys/Subsystem Reference/AEB Function/Run_AsyEvlrCritEve_Step_Func/Run_AsyEvlrCritEve_Step_Func/TAWrapper/PreProcessor/ObjectPreProcessor/ObjectPreProcessorLoop/ValidObject/SafetyMarginFrontObjects/InPathCalculationWithPredictedObjPositions/CreateInPathDataTTR/ToDiag/DIAG_TA_Inpath_PredObjLgt_Ri"
 /begin SUB_GROUP autosar_swc_aeb_autosar_swc_aeb_Step_sys_Subsystem_Reference_AEB_Function_Run_AsyEvlrCritEve_Step_Func_Run_AsyEvlrCritEve_Step_Func_TAWrapper_PreProcessor_ObjectPreProcessor_ObjectPreProcessorLoop_ValidObject_SafetyMarginFrontObjects_InPathCalculationWithPredictedObjPositions_CreateInPathDataTTR_ToDiag_DIAG_TA_Inpath_PredObjLgt_Ri_off /end SUB_GROUP
/end GROUP
/begin GROUP autosar_swc_aeb_autosar_swc_aeb_Step_sys_Subsystem_Reference_AEB_Function_Run_AsyEvlrCritEve_Step_Func_Run_AsyEvlrCritEve_Step_Func_TAWrapper_PreProcessor_ObjectPreProcessor_ObjectPreProcessorLoop_ValidObject_SafetyMarginFrontObjects_InPathCalculationWithPredictedObjPositions_CreateInPathDataTTR_ToDiag_DIAG_TA_Inpath_PredObjLgt_Ri_off "autosar_swc_aeb/autosar_swc_aeb_Step_sys/Subsystem Reference/AEB Function/Run_AsyEvlrCritEve_Step_Func/Run_AsyEvlrCritEve_Step_Func/TAWrapper/PreProcessor/ObjectPreProcessor/ObjectPreProcessorLoop/ValidObject/SafetyMarginFrontObjects/InPathCalculationWithPredictedObjPositions/CreateInPathDataTTR/ToDiag/DIAG_TA_Inpath_PredObjLgt_Ri/off"
 /begin SUB_GROUP autosar_swc_aeb_autosar_swc_aeb_Step_sys_Subsystem_Reference_AEB_Function_Run_AsyEvlrCritEve_Step_Func_Run_AsyEvlrCritEve_Step_Func_TAWrapper_PreProcessor_ObjectPreProcessor_ObjectPreProcessorLoop_ValidObject_SafetyMarginFrontObjects_InPathCalculationWithPredictedObjPositions_CreateInPathDataTTR_ToDiag_DIAG_TA_Inpath_PredObjLgt_Ri_off_ALVTerm /end SUB_GROUP
/end GROUP
/begin GROUP autosar_swc_aeb_autosar_swc_aeb_Step_sys_Subsystem_Reference_AEB_Function_Run_AsyEvlrCritEve_Step_Func_Run_AsyEvlrCritEve_Step_Func_TAWrapper_PreProcessor_ObjectPreProcessor_ObjectPreProcessorLoop_ValidObject_SafetyMarginFrontObjects_InPathCalculationWithPredictedObjPositions_CreateInPathDataTTR_ToDiag_DIAG_TA_Inpath_PredObjLgt_off "autosar_swc_aeb/autosar_swc_aeb_Step_sys/Subsystem Reference/AEB Function/Run_AsyEvlrCritEve_Step_Func/Run_AsyEvlrCritEve_Step_Func/TAWrapper/PreProcessor/ObjectPreProcessor/ObjectPreProcessorLoop/ValidObject/SafetyMarginFrontObjects/InPathCalculationWithPredictedObjPositions/CreateInPathDataTTR/ToDiag/DIAG_TA_Inpath_PredObjLgt/off"
 /begin SUB_GROUP autosar_swc_aeb_autosar_swc_aeb_Step_sys_Subsystem_Reference_AEB_Function_Run_AsyEvlrCritEve_Step_Func_Run_AsyEvlrCritEve_Step_Func_TAWrapper_PreProcessor_ObjectPreProcessor_ObjectPreProcessorLoop_ValidObject_SafetyMarginFrontObjects_InPathCalculationWithPredictedObjPositions_CreateInPathDataTTR_ToDiag_DIAG_TA_Inpath_PredObjLgt_off_ALVTerm /end SUB_GROUP
/end GROUP
/begin GROUP autosar_swc_aeb_autosar_swc_aeb_Step_sys_Subsystem_Reference_AEB_Function_Run_AsyEvlrCritEve_Step_Func_Run_AsyEvlrCritEve_Step_Func_TAWrapper_PreProcessor_ObjectPreProcessor_ObjectPreProcessorLoop_ValidObject_SafetyMarginFrontObjects_PosnLatRelByCoordSysTransform "autosar_swc_aeb/autosar_swc_aeb_Step_sys/Subsystem Reference/AEB Function/Run_AsyEvlrCritEve_Step_Func/Run_AsyEvlrCritEve_Step_Func/TAWrapper/PreProcessor/ObjectPreProcessor/ObjectPreProcessorLoop/ValidObject/SafetyMarginFrontObjects/PosnLatRelByCoordSysTransform"
 /begin SUB_GROUP autosar_swc_aeb_autosar_swc_aeb_Step_sys_Subsystem_Reference_AEB_Function_Run_AsyEvlrCritEve_Step_Func_Run_AsyEvlrCritEve_Step_Func_TAWrapper_PreProcessor_ObjectPreProcessor_ObjectPreProcessorLoop_ValidObject_SafetyMarginFrontObjects_PosnLatRelByCoordSysTransform_TransformToCurvedCoordSys /end SUB_GROUP
/end GROUP
/begin GROUP autosar_swc_aeb_autosar_swc_aeb_Step_sys_Subsystem_Reference_AEB_Function_Run_AsyEvlrCritEve_Step_Func_Run_AsyEvlrCritEve_Step_Func_TAWrapper_PreProcessor_ObjectPreProcessor_ObjectPreProcessorLoop_ValidObject_SafetyMarginFrontObjects_SaturateTTR "autosar_swc_aeb/autosar_swc_aeb_Step_sys/Subsystem Reference/AEB Function/Run_AsyEvlrCritEve_Step_Func/Run_AsyEvlrCritEve_Step_Func/TAWrapper/PreProcessor/ObjectPreProcessor/ObjectPreProcessorLoop/ValidObject/SafetyMarginFrontObjects/SaturateTTR" /begin REF_CHARACTERISTIC CLTS_TiUpprLimCMbBActvInAsyEvlrCritEve_Ca /end REF_CHARACTERISTIC /end GROUP
/begin GROUP autosar_swc_aeb_autosar_swc_aeb_Step_sys_Subsystem_Reference_AEB_Function_Run_AsyEvlrCritEve_Step_Func_Run_AsyEvlrCritEve_Step_Func_TAWrapper_PreProcessor_ObjectPreProcessor_ObjectPreProcessorLoop_ValidObject_SafetyMarginFrontObjects_SelectInPathData "autosar_swc_aeb/autosar_swc_aeb_Step_sys/Subsystem Reference/AEB Function/Run_AsyEvlrCritEve_Step_Func/Run_AsyEvlrCritEve_Step_Func/TAWrapper/PreProcessor/ObjectPreProcessor/ObjectPreProcessorLoop/ValidObject/SafetyMarginFrontObjects/SelectInPathData"
 /begin SUB_GROUP autosar_swc_aeb_autosar_swc_aeb_Step_sys_Subsystem_Reference_AEB_Function_Run_AsyEvlrCritEve_Step_Func_Run_AsyEvlrCritEve_Step_Func_TAWrapper_PreProcessor_ObjectPreProcessor_ObjectPreProcessorLoop_ValidObject_SafetyMarginFrontObjects_SelectInPathData_DefineStrictInPathScenarios /end SUB_GROUP
/end GROUP
/begin GROUP autosar_swc_aeb_autosar_swc_aeb_Step_sys_Subsystem_Reference_AEB_Function_Run_AsyEvlrCritEve_Step_Func_Run_AsyEvlrCritEve_Step_Func_TAWrapper_PreProcessor_ObjectPreProcessor_ObjectPreProcessorLoop_ValidObject_SafetyMarginFrontObjects_SelectInPathData_DefineStrictInPathScenarios "autosar_swc_aeb/autosar_swc_aeb_Step_sys/Subsystem Reference/AEB Function/Run_AsyEvlrCritEve_Step_Func/Run_AsyEvlrCritEve_Step_Func/TAWrapper/PreProcessor/ObjectPreProcessor/ObjectPreProcessorLoop/ValidObject/SafetyMarginFrontObjects/SelectInPathData/DefineStrictInPathScenarios"
 /begin SUB_GROUP autosar_swc_aeb_autosar_swc_aeb_Step_sys_Subsystem_Reference_AEB_Function_Run_AsyEvlrCritEve_Step_Func_Run_AsyEvlrCritEve_Step_Func_TAWrapper_PreProcessor_ObjectPreProcessor_ObjectPreProcessorLoop_ValidObject_SafetyMarginFrontObjects_SelectInPathData_DefineStrictInPathScenarios_CheckIfObjectHasLowLateralVelocity /end SUB_GROUP
/end GROUP
/begin GROUP autosar_swc_aeb_autosar_swc_aeb_Step_sys_Subsystem_Reference_AEB_Function_Run_AsyEvlrCritEve_Step_Func_Run_AsyEvlrCritEve_Step_Func_TAWrapper_PreProcessor_ObjectPreProcessor_ObjectPreProcessorLoop_ValidObject_SafetyMarginFrontObjects_SelectInPathData_DefineStrictInPathScenarios_CheckIfObjectHasLowLateralVelocity "autosar_swc_aeb/autosar_swc_aeb_Step_sys/Subsystem Reference/AEB Function/Run_AsyEvlrCritEve_Step_Func/Run_AsyEvlrCritEve_Step_Func/TAWrapper/PreProcessor/ObjectPreProcessor/ObjectPreProcessorLoop/ValidObject/SafetyMarginFrontObjects/SelectInPathData/DefineStrictInPathScenarios/CheckIfObjectHasLowLateralVelocity"
 /begin SUB_GROUP autosar_swc_aeb_autosar_swc_aeb_Step_sys_Subsystem_Reference_AEB_Function_Run_AsyEvlrCritEve_Step_Func_Run_AsyEvlrCritEve_Step_Func_TAWrapper_PreProcessor_ObjectPreProcessor_ObjectPreProcessorLoop_ValidObject_SafetyMarginFrontObjects_SelectInPathData_DefineStrictInPathScenarios_CheckIfObjectHasLowLateralVelocity_TimeActive autosar_swc_aeb_autosar_swc_aeb_Step_sys_Subsystem_Reference_AEB_Function_Run_AsyEvlrCritEve_Step_Func_Run_AsyEvlrCritEve_Step_Func_TAWrapper_PreProcessor_ObjectPreProcessor_ObjectPreProcessorLoop_ValidObject_SafetyMarginFrontObjects_SelectInPathData_DefineStrictInPathScenarios_CheckIfObjectHasLowLateralVelocity_TimeActive1 /end SUB_GROUP
 /begin REF_CHARACTERISTIC CLTS_BicycleSpdThdLatInPahInAsyEvlrCritEve_Ca CLTS_ObjSpdThdLatInPahInAsyEvlrCritEve_Ca /end REF_CHARACTERISTIC
/end GROUP
/begin GROUP autosar_swc_aeb_autosar_swc_aeb_Step_sys_Subsystem_Reference_AEB_Function_Run_AsyEvlrCritEve_Step_Func_Run_AsyEvlrCritEve_Step_Func_TAWrapper_PreProcessor_ObjectPreProcessor_ObjectPreProcessorLoop_ValidObject_SafetyMarginFrontObjects_SelectInPathData_DefineStrictInPathScenarios_CheckIfObjectHasLowLateralVelocity_TimeActive "autosar_swc_aeb/autosar_swc_aeb_Step_sys/Subsystem Reference/AEB Function/Run_AsyEvlrCritEve_Step_Func/Run_AsyEvlrCritEve_Step_Func/TAWrapper/PreProcessor/ObjectPreProcessor/ObjectPreProcessorLoop/ValidObject/SafetyMarginFrontObjects/SelectInPathData/DefineStrictInPathScenarios/CheckIfObjectHasLowLateralVelocity/TimeActive"
 /begin SUB_GROUP autosar_swc_aeb_autosar_swc_aeb_Step_sys_Subsystem_Reference_AEB_Function_Run_AsyEvlrCritEve_Step_Func_Run_AsyEvlrCritEve_Step_Func_TAWrapper_PreProcessor_ObjectPreProcessor_ObjectPreProcessorLoop_ValidObject_SafetyMarginFrontObjects_SelectInPathData_DefineStrictInPathScenarios_CheckIfObjectHasLowLateralVelocity_TimeActive_HICNTR_1 /end SUB_GROUP
/end GROUP
/begin GROUP autosar_swc_aeb_autosar_swc_aeb_Step_sys_Subsystem_Reference_AEB_Function_Run_AsyEvlrCritEve_Step_Func_Run_AsyEvlrCritEve_Step_Func_TAWrapper_PreProcessor_ObjectPreProcessor_ObjectPreProcessorLoop_ValidObject_SafetyMarginFrontObjects_SelectInPathData_DefineStrictInPathScenarios_CheckIfObjectHasLowLateralVelocity_TimeActive1 "autosar_swc_aeb/autosar_swc_aeb_Step_sys/Subsystem Reference/AEB Function/Run_AsyEvlrCritEve_Step_Func/Run_AsyEvlrCritEve_Step_Func/TAWrapper/PreProcessor/ObjectPreProcessor/ObjectPreProcessorLoop/ValidObject/SafetyMarginFrontObjects/SelectInPathData/DefineStrictInPathScenarios/CheckIfObjectHasLowLateralVelocity/TimeActive1"
 /begin SUB_GROUP autosar_swc_aeb_autosar_swc_aeb_Step_sys_Subsystem_Reference_AEB_Function_Run_AsyEvlrCritEve_Step_Func_Run_AsyEvlrCritEve_Step_Func_TAWrapper_PreProcessor_ObjectPreProcessor_ObjectPreProcessorLoop_ValidObject_SafetyMarginFrontObjects_SelectInPathData_DefineStrictInPathScenarios_CheckIfObjectHasLowLateralVelocity_TimeActive1_HICNTR_1 /end SUB_GROUP
/end GROUP
/begin GROUP autosar_swc_aeb_autosar_swc_aeb_Step_sys_Subsystem_Reference_AEB_Function_Run_AsyEvlrCritEve_Step_Func_Run_AsyEvlrCritEve_Step_Func_TAWrapper_PreProcessor_ObjectPreProcessor_ObjectPreProcessorLoop_ValidObject_SafetyMarginFrontObjects_SelectInPathData_DefineStrictInPathScenarios_CheckIfObjectHasLowLateralVelocity_TimeActive1_HICNTR_1 "autosar_swc_aeb/autosar_swc_aeb_Step_sys/Subsystem Reference/AEB Function/Run_AsyEvlrCritEve_Step_Func/Run_AsyEvlrCritEve_Step_Func/TAWrapper/PreProcessor/ObjectPreProcessor/ObjectPreProcessorLoop/ValidObject/SafetyMarginFrontObjects/SelectInPathData/DefineStrictInPathScenarios/CheckIfObjectHasLowLateralVelocity/TimeActive1/HICNTR_1" /begin REF_MEASUREMENT autosar_swc_aeb_rtARID_DEF.UD_1_DSTATE_d /end REF_MEASUREMENT /end GROUP
/begin GROUP autosar_swc_aeb_autosar_swc_aeb_Step_sys_Subsystem_Reference_AEB_Function_Run_AsyEvlrCritEve_Step_Func_Run_AsyEvlrCritEve_Step_Func_TAWrapper_PreProcessor_ObjectPreProcessor_ObjectPreProcessorLoop_ValidObject_SafetyMarginFrontObjects_SelectInPathData_DefineStrictInPathScenarios_CheckIfObjectHasLowLateralVelocity_TimeActive_HICNTR_1 "autosar_swc_aeb/autosar_swc_aeb_Step_sys/Subsystem Reference/AEB Function/Run_AsyEvlrCritEve_Step_Func/Run_AsyEvlrCritEve_Step_Func/TAWrapper/PreProcessor/ObjectPreProcessor/ObjectPreProcessorLoop/ValidObject/SafetyMarginFrontObjects/SelectInPathData/DefineStrictInPathScenarios/CheckIfObjectHasLowLateralVelocity/TimeActive/HICNTR_1" /begin REF_MEASUREMENT autosar_swc_aeb_rtARID_DEF.UD_1_DSTATE_o /end REF_MEASUREMENT /end GROUP
/begin GROUP autosar_swc_aeb_autosar_swc_aeb_Step_sys_Subsystem_Reference_AEB_Function_Run_AsyEvlrCritEve_Step_Func_Run_AsyEvlrCritEve_Step_Func_TAWrapper_PreProcessor_ObjectPreProcessor_ObjectPreProcessorLoop_ValidObject_Subsystem "autosar_swc_aeb/autosar_swc_aeb_Step_sys/Subsystem Reference/AEB Function/Run_AsyEvlrCritEve_Step_Func/Run_AsyEvlrCritEve_Step_Func/TAWrapper/PreProcessor/ObjectPreProcessor/ObjectPreProcessorLoop/ValidObject/Subsystem"
 /begin SUB_GROUP autosar_swc_aeb_autosar_swc_aeb_Step_sys_Subsystem_Reference_AEB_Function_Run_AsyEvlrCritEve_Step_Func_Run_AsyEvlrCritEve_Step_Func_TAWrapper_PreProcessor_ObjectPreProcessor_ObjectPreProcessorLoop_ValidObject_Subsystem_CalculateTTRAndTTM autosar_swc_aeb_autosar_swc_aeb_Step_sys_Subsystem_Reference_AEB_Function_Run_AsyEvlrCritEve_Step_Func_Run_AsyEvlrCritEve_Step_Func_TAWrapper_PreProcessor_ObjectPreProcessor_ObjectPreProcessorLoop_ValidObject_Subsystem_For_Each_Subsystem /end SUB_GROUP
/end GROUP
/begin GROUP autosar_swc_aeb_autosar_swc_aeb_Step_sys_Subsystem_Reference_AEB_Function_Run_AsyEvlrCritEve_Step_Func_Run_AsyEvlrCritEve_Step_Func_TAWrapper_PreProcessor_ObjectPreProcessor_ObjectPreProcessorLoop_ValidObject_Subsystem_CalculateTTRAndTTM "autosar_swc_aeb/autosar_swc_aeb_Step_sys/Subsystem Reference/AEB Function/Run_AsyEvlrCritEve_Step_Func/Run_AsyEvlrCritEve_Step_Func/TAWrapper/PreProcessor/ObjectPreProcessor/ObjectPreProcessorLoop/ValidObject/Subsystem/CalculateTTRAndTTM"
 /begin SUB_GROUP autosar_swc_aeb_autosar_swc_aeb_Step_sys_Subsystem_Reference_AEB_Function_Run_AsyEvlrCritEve_Step_Func_Run_AsyEvlrCritEve_Step_Func_TAWrapper_PreProcessor_ObjectPreProcessor_ObjectPreProcessorLoop_ValidObject_Subsystem_CalculateTTRAndTTM_LongitudinalTTMComputer autosar_swc_aeb_autosar_swc_aeb_Step_sys_Subsystem_Reference_AEB_Function_Run_AsyEvlrCritEve_Step_Func_Run_AsyEvlrCritEve_Step_Func_TAWrapper_PreProcessor_ObjectPreProcessor_ObjectPreProcessorLoop_ValidObject_Subsystem_CalculateTTRAndTTM_LongitudinalTTRComputer autosar_swc_aeb_autosar_swc_aeb_Step_sys_Subsystem_Reference_AEB_Function_Run_AsyEvlrCritEve_Step_Func_Run_AsyEvlrCritEve_Step_Func_TAWrapper_PreProcessor_ObjectPreProcessor_ObjectPreProcessorLoop_ValidObject_Subsystem_CalculateTTRAndTTM_ModifyTTMAtSameSpeedAndAcceleration autosar_swc_aeb_autosar_swc_aeb_Step_sys_Subsystem_Reference_AEB_Function_Run_AsyEvlrCritEve_Step_Func_Run_AsyEvlrCritEve_Step_Func_TAWrapper_PreProcessor_ObjectPreProcessor_ObjectPreProcessorLoop_ValidObject_Subsystem_CalculateTTRAndTTM_ModifyTTRAtSameSpeedAndAcceleration autosar_swc_aeb_autosar_swc_aeb_Step_sys_Subsystem_Reference_AEB_Function_Run_AsyEvlrCritEve_Step_Func_Run_AsyEvlrCritEve_Step_Func_TAWrapper_PreProcessor_ObjectPreProcessor_ObjectPreProcessorLoop_ValidObject_Subsystem_CalculateTTRAndTTM_SetCorrectSign1 autosar_swc_aeb_autosar_swc_aeb_Step_sys_Subsystem_Reference_AEB_Function_Run_AsyEvlrCritEve_Step_Func_Run_AsyEvlrCritEve_Step_Func_TAWrapper_PreProcessor_ObjectPreProcessor_ObjectPreProcessorLoop_ValidObject_Subsystem_CalculateTTRAndTTM_SetCorrectSign2 /end SUB_GROUP
/end GROUP
/begin GROUP autosar_swc_aeb_autosar_swc_aeb_Step_sys_Subsystem_Reference_AEB_Function_Run_AsyEvlrCritEve_Step_Func_Run_AsyEvlrCritEve_Step_Func_TAWrapper_PreProcessor_ObjectPreProcessor_ObjectPreProcessorLoop_ValidObject_Subsystem_CalculateTTRAndTTM_LongitudinalTTMComputer "autosar_swc_aeb/autosar_swc_aeb_Step_sys/Subsystem Reference/AEB Function/Run_AsyEvlrCritEve_Step_Func/Run_AsyEvlrCritEve_Step_Func/TAWrapper/PreProcessor/ObjectPreProcessor/ObjectPreProcessorLoop/ValidObject/Subsystem/CalculateTTRAndTTM/LongitudinalTTMComputer"
 /begin SUB_GROUP autosar_swc_aeb_autosar_swc_aeb_Step_sys_Subsystem_Reference_AEB_Function_Run_AsyEvlrCritEve_Step_Func_Run_AsyEvlrCritEve_Step_Func_TAWrapper_PreProcessor_ObjectPreProcessor_ObjectPreProcessorLoop_ValidObject_Subsystem_CalculateTTRAndTTM_LongitudinalTTMComputer_CalculateTTI autosar_swc_aeb_autosar_swc_aeb_Step_sys_Subsystem_Reference_AEB_Function_Run_AsyEvlrCritEve_Step_Func_Run_AsyEvlrCritEve_Step_Func_TAWrapper_PreProcessor_ObjectPreProcessor_ObjectPreProcessorLoop_ValidObject_Subsystem_CalculateTTRAndTTM_LongitudinalTTMComputer_SelectTTI /end SUB_GROUP
/end GROUP
/begin GROUP autosar_swc_aeb_autosar_swc_aeb_Step_sys_Subsystem_Reference_AEB_Function_Run_AsyEvlrCritEve_Step_Func_Run_AsyEvlrCritEve_Step_Func_TAWrapper_PreProcessor_ObjectPreProcessor_ObjectPreProcessorLoop_ValidObject_Subsystem_CalculateTTRAndTTM_LongitudinalTTMComputer_CalculateTTI "autosar_swc_aeb/autosar_swc_aeb_Step_sys/Subsystem Reference/AEB Function/Run_AsyEvlrCritEve_Step_Func/Run_AsyEvlrCritEve_Step_Func/TAWrapper/PreProcessor/ObjectPreProcessor/ObjectPreProcessorLoop/ValidObject/Subsystem/CalculateTTRAndTTM/LongitudinalTTMComputer/CalculateTTI"
 /begin SUB_GROUP autosar_swc_aeb_autosar_swc_aeb_Step_sys_Subsystem_Reference_AEB_Function_Run_AsyEvlrCritEve_Step_Func_Run_AsyEvlrCritEve_Step_Func_TAWrapper_PreProcessor_ObjectPreProcessor_ObjectPreProcessorLoop_ValidObject_Subsystem_CalculateTTRAndTTM_LongitudinalTTMComputer_CalculateTTI_HostAndObjectMoving autosar_swc_aeb_autosar_swc_aeb_Step_sys_Subsystem_Reference_AEB_Function_Run_AsyEvlrCritEve_Step_Func_Run_AsyEvlrCritEve_Step_Func_TAWrapper_PreProcessor_ObjectPreProcessor_ObjectPreProcessorLoop_ValidObject_Subsystem_CalculateTTRAndTTM_LongitudinalTTMComputer_CalculateTTI_StationaryHost autosar_swc_aeb_autosar_swc_aeb_Step_sys_Subsystem_Reference_AEB_Function_Run_AsyEvlrCritEve_Step_Func_Run_AsyEvlrCritEve_Step_Func_TAWrapper_PreProcessor_ObjectPreProcessor_ObjectPreProcessorLoop_ValidObject_Subsystem_CalculateTTRAndTTM_LongitudinalTTMComputer_CalculateTTI_StationaryObject /end SUB_GROUP
/end GROUP
/begin GROUP autosar_swc_aeb_autosar_swc_aeb_Step_sys_Subsystem_Reference_AEB_Function_Run_AsyEvlrCritEve_Step_Func_Run_AsyEvlrCritEve_Step_Func_TAWrapper_PreProcessor_ObjectPreProcessor_ObjectPreProcessorLoop_ValidObject_Subsystem_CalculateTTRAndTTM_LongitudinalTTMComputer_CalculateTTI_HostAndObjectMoving "autosar_swc_aeb/autosar_swc_aeb_Step_sys/Subsystem Reference/AEB Function/Run_AsyEvlrCritEve_Step_Func/Run_AsyEvlrCritEve_Step_Func/TAWrapper/PreProcessor/ObjectPreProcessor/ObjectPreProcessorLoop/ValidObject/Subsystem/CalculateTTRAndTTM/LongitudinalTTMComputer/CalculateTTI/HostAndObjectMoving"
 /begin SUB_GROUP autosar_swc_aeb_autosar_swc_aeb_Step_sys_Subsystem_Reference_AEB_Function_Run_AsyEvlrCritEve_Step_Func_Run_AsyEvlrCritEve_Step_Func_TAWrapper_PreProcessor_ObjectPreProcessor_ObjectPreProcessorLoop_ValidObject_Subsystem_CalculateTTRAndTTM_LongitudinalTTMComputer_CalculateTTI_HostAndObjectMoving_TimeToIntersectionComputer /end SUB_GROUP
/end GROUP
/begin GROUP autosar_swc_aeb_autosar_swc_aeb_Step_sys_Subsystem_Reference_AEB_Function_Run_AsyEvlrCritEve_Step_Func_Run_AsyEvlrCritEve_Step_Func_TAWrapper_PreProcessor_ObjectPreProcessor_ObjectPreProcessorLoop_ValidObject_Subsystem_CalculateTTRAndTTM_LongitudinalTTMComputer_CalculateTTI_StationaryHost "autosar_swc_aeb/autosar_swc_aeb_Step_sys/Subsystem Reference/AEB Function/Run_AsyEvlrCritEve_Step_Func/Run_AsyEvlrCritEve_Step_Func/TAWrapper/PreProcessor/ObjectPreProcessor/ObjectPreProcessorLoop/ValidObject/Subsystem/CalculateTTRAndTTM/LongitudinalTTMComputer/CalculateTTI/StationaryHost"
 /begin SUB_GROUP autosar_swc_aeb_autosar_swc_aeb_Step_sys_Subsystem_Reference_AEB_Function_Run_AsyEvlrCritEve_Step_Func_Run_AsyEvlrCritEve_Step_Func_TAWrapper_PreProcessor_ObjectPreProcessor_ObjectPreProcessorLoop_ValidObject_Subsystem_CalculateTTRAndTTM_LongitudinalTTMComputer_CalculateTTI_StationaryHost_TimeToIntersectionComputer /end SUB_GROUP
/end GROUP
/begin GROUP autosar_swc_aeb_autosar_swc_aeb_Step_sys_Subsystem_Reference_AEB_Function_Run_AsyEvlrCritEve_Step_Func_Run_AsyEvlrCritEve_Step_Func_TAWrapper_PreProcessor_ObjectPreProcessor_ObjectPreProcessorLoop_ValidObject_Subsystem_CalculateTTRAndTTM_LongitudinalTTMComputer_CalculateTTI_StationaryObject "autosar_swc_aeb/autosar_swc_aeb_Step_sys/Subsystem Reference/AEB Function/Run_AsyEvlrCritEve_Step_Func/Run_AsyEvlrCritEve_Step_Func/TAWrapper/PreProcessor/ObjectPreProcessor/ObjectPreProcessorLoop/ValidObject/Subsystem/CalculateTTRAndTTM/LongitudinalTTMComputer/CalculateTTI/StationaryObject"
 /begin SUB_GROUP autosar_swc_aeb_autosar_swc_aeb_Step_sys_Subsystem_Reference_AEB_Function_Run_AsyEvlrCritEve_Step_Func_Run_AsyEvlrCritEve_Step_Func_TAWrapper_PreProcessor_ObjectPreProcessor_ObjectPreProcessorLoop_ValidObject_Subsystem_CalculateTTRAndTTM_LongitudinalTTMComputer_CalculateTTI_StationaryObject_TimeToIntersectionComputer /end SUB_GROUP
/end GROUP
/begin GROUP autosar_swc_aeb_autosar_swc_aeb_Step_sys_Subsystem_Reference_AEB_Function_Run_AsyEvlrCritEve_Step_Func_Run_AsyEvlrCritEve_Step_Func_TAWrapper_PreProcessor_ObjectPreProcessor_ObjectPreProcessorLoop_ValidObject_Subsystem_CalculateTTRAndTTM_LongitudinalTTMComputer_SelectTTI "autosar_swc_aeb/autosar_swc_aeb_Step_sys/Subsystem Reference/AEB Function/Run_AsyEvlrCritEve_Step_Func/Run_AsyEvlrCritEve_Step_Func/TAWrapper/PreProcessor/ObjectPreProcessor/ObjectPreProcessorLoop/ValidObject/Subsystem/CalculateTTRAndTTM/LongitudinalTTMComputer/SelectTTI"
 /begin SUB_GROUP autosar_swc_aeb_autosar_swc_aeb_Step_sys_Subsystem_Reference_AEB_Function_Run_AsyEvlrCritEve_Step_Func_Run_AsyEvlrCritEve_Step_Func_TAWrapper_PreProcessor_ObjectPreProcessor_ObjectPreProcessorLoop_ValidObject_Subsystem_CalculateTTRAndTTM_LongitudinalTTMComputer_SelectTTI_CheckIfVehicleStops autosar_swc_aeb_autosar_swc_aeb_Step_sys_Subsystem_Reference_AEB_Function_Run_AsyEvlrCritEve_Step_Func_Run_AsyEvlrCritEve_Step_Func_TAWrapper_PreProcessor_ObjectPreProcessor_ObjectPreProcessorLoop_ValidObject_Subsystem_CalculateTTRAndTTM_LongitudinalTTMComputer_SelectTTI_CheckIfVehicleStops1 /end SUB_GROUP
/end GROUP
/begin GROUP autosar_swc_aeb_autosar_swc_aeb_Step_sys_Subsystem_Reference_AEB_Function_Run_AsyEvlrCritEve_Step_Func_Run_AsyEvlrCritEve_Step_Func_TAWrapper_PreProcessor_ObjectPreProcessor_ObjectPreProcessorLoop_ValidObject_Subsystem_CalculateTTRAndTTM_LongitudinalTTRComputer "autosar_swc_aeb/autosar_swc_aeb_Step_sys/Subsystem Reference/AEB Function/Run_AsyEvlrCritEve_Step_Func/Run_AsyEvlrCritEve_Step_Func/TAWrapper/PreProcessor/ObjectPreProcessor/ObjectPreProcessorLoop/ValidObject/Subsystem/CalculateTTRAndTTM/LongitudinalTTRComputer"
 /begin SUB_GROUP autosar_swc_aeb_autosar_swc_aeb_Step_sys_Subsystem_Reference_AEB_Function_Run_AsyEvlrCritEve_Step_Func_Run_AsyEvlrCritEve_Step_Func_TAWrapper_PreProcessor_ObjectPreProcessor_ObjectPreProcessorLoop_ValidObject_Subsystem_CalculateTTRAndTTM_LongitudinalTTRComputer_CalculateTTI autosar_swc_aeb_autosar_swc_aeb_Step_sys_Subsystem_Reference_AEB_Function_Run_AsyEvlrCritEve_Step_Func_Run_AsyEvlrCritEve_Step_Func_TAWrapper_PreProcessor_ObjectPreProcessor_ObjectPreProcessorLoop_ValidObject_Subsystem_CalculateTTRAndTTM_LongitudinalTTRComputer_SelectTTI /end SUB_GROUP
/end GROUP
/begin GROUP autosar_swc_aeb_autosar_swc_aeb_Step_sys_Subsystem_Reference_AEB_Function_Run_AsyEvlrCritEve_Step_Func_Run_AsyEvlrCritEve_Step_Func_TAWrapper_PreProcessor_ObjectPreProcessor_ObjectPreProcessorLoop_ValidObject_Subsystem_CalculateTTRAndTTM_LongitudinalTTRComputer_CalculateTTI "autosar_swc_aeb/autosar_swc_aeb_Step_sys/Subsystem Reference/AEB Function/Run_AsyEvlrCritEve_Step_Func/Run_AsyEvlrCritEve_Step_Func/TAWrapper/PreProcessor/ObjectPreProcessor/ObjectPreProcessorLoop/ValidObject/Subsystem/CalculateTTRAndTTM/LongitudinalTTRComputer/CalculateTTI"
 /begin SUB_GROUP autosar_swc_aeb_autosar_swc_aeb_Step_sys_Subsystem_Reference_AEB_Function_Run_AsyEvlrCritEve_Step_Func_Run_AsyEvlrCritEve_Step_Func_TAWrapper_PreProcessor_ObjectPreProcessor_ObjectPreProcessorLoop_ValidObject_Subsystem_CalculateTTRAndTTM_LongitudinalTTRComputer_CalculateTTI_HostAndObjectMoving autosar_swc_aeb_autosar_swc_aeb_Step_sys_Subsystem_Reference_AEB_Function_Run_AsyEvlrCritEve_Step_Func_Run_AsyEvlrCritEve_Step_Func_TAWrapper_PreProcessor_ObjectPreProcessor_ObjectPreProcessorLoop_ValidObject_Subsystem_CalculateTTRAndTTM_LongitudinalTTRComputer_CalculateTTI_StationaryHost autosar_swc_aeb_autosar_swc_aeb_Step_sys_Subsystem_Reference_AEB_Function_Run_AsyEvlrCritEve_Step_Func_Run_AsyEvlrCritEve_Step_Func_TAWrapper_PreProcessor_ObjectPreProcessor_ObjectPreProcessorLoop_ValidObject_Subsystem_CalculateTTRAndTTM_LongitudinalTTRComputer_CalculateTTI_StationaryObject /end SUB_GROUP
/end GROUP
/begin GROUP autosar_swc_aeb_autosar_swc_aeb_Step_sys_Subsystem_Reference_AEB_Function_Run_AsyEvlrCritEve_Step_Func_Run_AsyEvlrCritEve_Step_Func_TAWrapper_PreProcessor_ObjectPreProcessor_ObjectPreProcessorLoop_ValidObject_Subsystem_CalculateTTRAndTTM_LongitudinalTTRComputer_CalculateTTI_HostAndObjectMoving "autosar_swc_aeb/autosar_swc_aeb_Step_sys/Subsystem Reference/AEB Function/Run_AsyEvlrCritEve_Step_Func/Run_AsyEvlrCritEve_Step_Func/TAWrapper/PreProcessor/ObjectPreProcessor/ObjectPreProcessorLoop/ValidObject/Subsystem/CalculateTTRAndTTM/LongitudinalTTRComputer/CalculateTTI/HostAndObjectMoving"
 /begin SUB_GROUP autosar_swc_aeb_autosar_swc_aeb_Step_sys_Subsystem_Reference_AEB_Function_Run_AsyEvlrCritEve_Step_Func_Run_AsyEvlrCritEve_Step_Func_TAWrapper_PreProcessor_ObjectPreProcessor_ObjectPreProcessorLoop_ValidObject_Subsystem_CalculateTTRAndTTM_LongitudinalTTRComputer_CalculateTTI_HostAndObjectMoving_TimeToIntersectionComputer /end SUB_GROUP
/end GROUP
/begin GROUP autosar_swc_aeb_autosar_swc_aeb_Step_sys_Subsystem_Reference_AEB_Function_Run_AsyEvlrCritEve_Step_Func_Run_AsyEvlrCritEve_Step_Func_TAWrapper_PreProcessor_ObjectPreProcessor_ObjectPreProcessorLoop_ValidObject_Subsystem_CalculateTTRAndTTM_LongitudinalTTRComputer_CalculateTTI_StationaryHost "autosar_swc_aeb/autosar_swc_aeb_Step_sys/Subsystem Reference/AEB Function/Run_AsyEvlrCritEve_Step_Func/Run_AsyEvlrCritEve_Step_Func/TAWrapper/PreProcessor/ObjectPreProcessor/ObjectPreProcessorLoop/ValidObject/Subsystem/CalculateTTRAndTTM/LongitudinalTTRComputer/CalculateTTI/StationaryHost"
 /begin SUB_GROUP autosar_swc_aeb_autosar_swc_aeb_Step_sys_Subsystem_Reference_AEB_Function_Run_AsyEvlrCritEve_Step_Func_Run_AsyEvlrCritEve_Step_Func_TAWrapper_PreProcessor_ObjectPreProcessor_ObjectPreProcessorLoop_ValidObject_Subsystem_CalculateTTRAndTTM_LongitudinalTTRComputer_CalculateTTI_StationaryHost_TimeToIntersectionComputer /end SUB_GROUP
/end GROUP
/begin GROUP autosar_swc_aeb_autosar_swc_aeb_Step_sys_Subsystem_Reference_AEB_Function_Run_AsyEvlrCritEve_Step_Func_Run_AsyEvlrCritEve_Step_Func_TAWrapper_PreProcessor_ObjectPreProcessor_ObjectPreProcessorLoop_ValidObject_Subsystem_CalculateTTRAndTTM_LongitudinalTTRComputer_CalculateTTI_StationaryObject "autosar_swc_aeb/autosar_swc_aeb_Step_sys/Subsystem Reference/AEB Function/Run_AsyEvlrCritEve_Step_Func/Run_AsyEvlrCritEve_Step_Func/TAWrapper/PreProcessor/ObjectPreProcessor/ObjectPreProcessorLoop/ValidObject/Subsystem/CalculateTTRAndTTM/LongitudinalTTRComputer/CalculateTTI/StationaryObject"
 /begin SUB_GROUP autosar_swc_aeb_autosar_swc_aeb_Step_sys_Subsystem_Reference_AEB_Function_Run_AsyEvlrCritEve_Step_Func_Run_AsyEvlrCritEve_Step_Func_TAWrapper_PreProcessor_ObjectPreProcessor_ObjectPreProcessorLoop_ValidObject_Subsystem_CalculateTTRAndTTM_LongitudinalTTRComputer_CalculateTTI_StationaryObject_TimeToIntersectionComputer /end SUB_GROUP
/end GROUP
/begin GROUP autosar_swc_aeb_autosar_swc_aeb_Step_sys_Subsystem_Reference_AEB_Function_Run_AsyEvlrCritEve_Step_Func_Run_AsyEvlrCritEve_Step_Func_TAWrapper_PreProcessor_ObjectPreProcessor_ObjectPreProcessorLoop_ValidObject_Subsystem_CalculateTTRAndTTM_LongitudinalTTRComputer_SelectTTI "autosar_swc_aeb/autosar_swc_aeb_Step_sys/Subsystem Reference/AEB Function/Run_AsyEvlrCritEve_Step_Func/Run_AsyEvlrCritEve_Step_Func/TAWrapper/PreProcessor/ObjectPreProcessor/ObjectPreProcessorLoop/ValidObject/Subsystem/CalculateTTRAndTTM/LongitudinalTTRComputer/SelectTTI"
 /begin SUB_GROUP autosar_swc_aeb_autosar_swc_aeb_Step_sys_Subsystem_Reference_AEB_Function_Run_AsyEvlrCritEve_Step_Func_Run_AsyEvlrCritEve_Step_Func_TAWrapper_PreProcessor_ObjectPreProcessor_ObjectPreProcessorLoop_ValidObject_Subsystem_CalculateTTRAndTTM_LongitudinalTTRComputer_SelectTTI_CheckIfVehicleStops autosar_swc_aeb_autosar_swc_aeb_Step_sys_Subsystem_Reference_AEB_Function_Run_AsyEvlrCritEve_Step_Func_Run_AsyEvlrCritEve_Step_Func_TAWrapper_PreProcessor_ObjectPreProcessor_ObjectPreProcessorLoop_ValidObject_Subsystem_CalculateTTRAndTTM_LongitudinalTTRComputer_SelectTTI_CheckIfVehicleStops1 /end SUB_GROUP
/end GROUP
/begin GROUP autosar_swc_aeb_autosar_swc_aeb_Step_sys_Subsystem_Reference_AEB_Function_Run_AsyEvlrCritEve_Step_Func_Run_AsyEvlrCritEve_Step_Func_TAWrapper_PreProcessor_ObjectPreProcessor_ObjectPreProcessorLoop_ValidObject_Subsystem_For_Each_Subsystem "autosar_swc_aeb/autosar_swc_aeb_Step_sys/Subsystem Reference/AEB Function/Run_AsyEvlrCritEve_Step_Func/Run_AsyEvlrCritEve_Step_Func/TAWrapper/PreProcessor/ObjectPreProcessor/ObjectPreProcessorLoop/ValidObject/Subsystem/For Each\nSubsystem"
 /begin SUB_GROUP autosar_swc_aeb_autosar_swc_aeb_Step_sys_Subsystem_Reference_AEB_Function_Run_AsyEvlrCritEve_Step_Func_Run_AsyEvlrCritEve_Step_Func_TAWrapper_PreProcessor_ObjectPreProcessor_ObjectPreProcessorLoop_ValidObject_Subsystem_For_Each_Subsystem_CalculateHeading /end SUB_GROUP
/end GROUP
/begin GROUP autosar_swc_aeb_autosar_swc_aeb_Step_sys_Subsystem_Reference_AEB_Function_Run_AsyEvlrCritEve_Step_Func_Run_AsyEvlrCritEve_Step_Func_TAWrapper_PreProcessor_ObjectPreProcessor_ObjectPreProcessorLoop_ValidObject_Subsystem_For_Each_Subsystem_CalculateHeading "autosar_swc_aeb/autosar_swc_aeb_Step_sys/Subsystem Reference/AEB Function/Run_AsyEvlrCritEve_Step_Func/Run_AsyEvlrCritEve_Step_Func/TAWrapper/PreProcessor/ObjectPreProcessor/ObjectPreProcessorLoop/ValidObject/Subsystem/For Each\nSubsystem/CalculateHeading"
 /begin SUB_GROUP autosar_swc_aeb_autosar_swc_aeb_Step_sys_Subsystem_Reference_AEB_Function_Run_AsyEvlrCritEve_Step_Func_Run_AsyEvlrCritEve_Step_Func_TAWrapper_PreProcessor_ObjectPreProcessor_ObjectPreProcessorLoop_ValidObject_Subsystem_For_Each_Subsystem_CalculateHeading_CheckSpeed autosar_swc_aeb_autosar_swc_aeb_Step_sys_Subsystem_Reference_AEB_Function_Run_AsyEvlrCritEve_Step_Func_Run_AsyEvlrCritEve_Step_Func_TAWrapper_PreProcessor_ObjectPreProcessor_ObjectPreProcessorLoop_ValidObject_Subsystem_For_Each_Subsystem_CalculateHeading_ExtractVelocitiesAtStartOfSegments /end SUB_GROUP
/end GROUP
/begin GROUP autosar_swc_aeb_autosar_swc_aeb_Step_sys_Subsystem_Reference_AEB_Function_Run_AsyEvlrCritEve_Step_Func_Run_AsyEvlrCritEve_Step_Func_TAWrapper_PreProcessor_ObjectPreProcessor_ObjectPreProcessorLoop_ValidObject_Subsystem_For_Each_Subsystem_CalculateHeading_ExtractVelocitiesAtStartOfSegments "autosar_swc_aeb/autosar_swc_aeb_Step_sys/Subsystem Reference/AEB Function/Run_AsyEvlrCritEve_Step_Func/Run_AsyEvlrCritEve_Step_Func/TAWrapper/PreProcessor/ObjectPreProcessor/ObjectPreProcessorLoop/ValidObject/Subsystem/For Each\nSubsystem/CalculateHeading/ExtractVelocitiesAtStartOfSegments"
 /begin SUB_GROUP autosar_swc_aeb_autosar_swc_aeb_Step_sys_Subsystem_Reference_AEB_Function_Run_AsyEvlrCritEve_Step_Func_Run_AsyEvlrCritEve_Step_Func_TAWrapper_PreProcessor_ObjectPreProcessor_ObjectPreProcessorLoop_ValidObject_Subsystem_For_Each_Subsystem_CalculateHeading_ExtractVelocitiesAtStartOfSegments_CheckSpeed /end SUB_GROUP
/end GROUP
/begin GROUP autosar_swc_aeb_autosar_swc_aeb_Step_sys_Subsystem_Reference_AEB_Function_Run_AsyEvlrCritEve_Step_Func_Run_AsyEvlrCritEve_Step_Func_TAWrapper_PreProcessor_VehiclePreProcessor "autosar_swc_aeb/autosar_swc_aeb_Step_sys/Subsystem Reference/AEB Function/Run_AsyEvlrCritEve_Step_Func/Run_AsyEvlrCritEve_Step_Func/TAWrapper/PreProcessor/VehiclePreProcessor"
 /begin SUB_GROUP autosar_swc_aeb_autosar_swc_aeb_Step_sys_Subsystem_Reference_AEB_Function_Run_AsyEvlrCritEve_Step_Func_Run_AsyEvlrCritEve_Step_Func_TAWrapper_PreProcessor_VehiclePreProcessor_CalculateCurvature autosar_swc_aeb_autosar_swc_aeb_Step_sys_Subsystem_Reference_AEB_Function_Run_AsyEvlrCritEve_Step_Func_Run_AsyEvlrCritEve_Step_Func_TAWrapper_PreProcessor_VehiclePreProcessor_CheckCMbBActive autosar_swc_aeb_autosar_swc_aeb_Step_sys_Subsystem_Reference_AEB_Function_Run_AsyEvlrCritEve_Step_Func_Run_AsyEvlrCritEve_Step_Func_TAWrapper_PreProcessor_VehiclePreProcessor_SafeDivide1 autosar_swc_aeb_autosar_swc_aeb_Step_sys_Subsystem_Reference_AEB_Function_Run_AsyEvlrCritEve_Step_Func_Run_AsyEvlrCritEve_Step_Func_TAWrapper_PreProcessor_VehiclePreProcessor_VehSelfSpdCompensation /end SUB_GROUP
 /begin REF_CHARACTERISTIC P_AEB_UseCrvtFormVme /end REF_CHARACTERISTIC
/end GROUP
/begin GROUP autosar_swc_aeb_autosar_swc_aeb_Step_sys_Subsystem_Reference_AEB_Function_Run_AsyEvlrCritEve_Step_Func_Run_AsyEvlrCritEve_Step_Func_TAWrapper_PreProcessor_VehiclePreProcessor_CalculateCurvature "autosar_swc_aeb/autosar_swc_aeb_Step_sys/Subsystem Reference/AEB Function/Run_AsyEvlrCritEve_Step_Func/Run_AsyEvlrCritEve_Step_Func/TAWrapper/PreProcessor/VehiclePreProcessor/CalculateCurvature"
 /begin SUB_GROUP autosar_swc_aeb_autosar_swc_aeb_Step_sys_Subsystem_Reference_AEB_Function_Run_AsyEvlrCritEve_Step_Func_Run_AsyEvlrCritEve_Step_Func_TAWrapper_PreProcessor_VehiclePreProcessor_CalculateCurvature_LowPassFilter /end SUB_GROUP
 /begin REF_CHARACTERISTIC CLTS_CrvtTypTblInAsyEvlrCritEve_Ca CLTS_VLgtValForCrvtTypTblInAsyEvlrCritEve_Ca /end REF_CHARACTERISTIC
/end GROUP
/begin GROUP autosar_swc_aeb_autosar_swc_aeb_Step_sys_Subsystem_Reference_AEB_Function_Run_AsyEvlrCritEve_Step_Func_Run_AsyEvlrCritEve_Step_Func_TAWrapper_PreProcessor_VehiclePreProcessor_CalculateCurvature_LowPassFilter "autosar_swc_aeb/autosar_swc_aeb_Step_sys/Subsystem Reference/AEB Function/Run_AsyEvlrCritEve_Step_Func/Run_AsyEvlrCritEve_Step_Func/TAWrapper/PreProcessor/VehiclePreProcessor/CalculateCurvature/LowPassFilter"
 /begin SUB_GROUP autosar_swc_aeb_autosar_swc_aeb_Step_sys_Subsystem_Reference_AEB_Function_Run_AsyEvlrCritEve_Step_Func_Run_AsyEvlrCritEve_Step_Func_TAWrapper_PreProcessor_VehiclePreProcessor_CalculateCurvature_LowPassFilter_LP1_1 /end SUB_GROUP
 /begin REF_CHARACTERISTIC CLTS_PinionAgRateFilConInAsyEvlrCritEve_Ca /end REF_CHARACTERISTIC
/end GROUP
/begin GROUP autosar_swc_aeb_autosar_swc_aeb_Step_sys_Subsystem_Reference_AEB_Function_Run_AsyEvlrCritEve_Step_Func_Run_AsyEvlrCritEve_Step_Func_TAWrapper_PreProcessor_VehiclePreProcessor_CalculateCurvature_LowPassFilter_LP1_1 "autosar_swc_aeb/autosar_swc_aeb_Step_sys/Subsystem Reference/AEB Function/Run_AsyEvlrCritEve_Step_Func/Run_AsyEvlrCritEve_Step_Func/TAWrapper/PreProcessor/VehiclePreProcessor/CalculateCurvature/LowPassFilter/LP1_1" /begin REF_MEASUREMENT autosar_swc_aeb_rtARID_DEF.UD_1_DSTATE_m /end REF_MEASUREMENT /end GROUP
/begin GROUP autosar_swc_aeb_autosar_swc_aeb_Step_sys_Subsystem_Reference_AEB_Function_Run_AsyEvlrCritEve_Step_Func_Run_AsyEvlrCritEve_Step_Func_TAWrapper_PreProcessor_VehiclePreProcessor_CheckCMbBActive "autosar_swc_aeb/autosar_swc_aeb_Step_sys/Subsystem Reference/AEB Function/Run_AsyEvlrCritEve_Step_Func/Run_AsyEvlrCritEve_Step_Func/TAWrapper/PreProcessor/VehiclePreProcessor/CheckCMbBActive"
 /begin SUB_GROUP autosar_swc_aeb_autosar_swc_aeb_Step_sys_Subsystem_Reference_AEB_Function_Run_AsyEvlrCritEve_Step_Func_Run_AsyEvlrCritEve_Step_Func_TAWrapper_PreProcessor_VehiclePreProcessor_CheckCMbBActive_OnDelayBlock /end SUB_GROUP
 /begin REF_CHARACTERISTIC CLTS_SpdLimLoForChkPreBrkActvInAsyEvlrCritEve_Ca CLTS_TiDlyForCllsnRednByBrkgActvInAsyEvlrCritEve_Ca /end REF_CHARACTERISTIC
/end GROUP
/begin GROUP autosar_swc_aeb_autosar_swc_aeb_Step_sys_Subsystem_Reference_AEB_Function_Run_AsyEvlrCritEve_Step_Func_Run_AsyEvlrCritEve_Step_Func_TAWrapper_PreProcessor_VehiclePreProcessor_CheckCMbBActive_OnDelayBlock "autosar_swc_aeb/autosar_swc_aeb_Step_sys/Subsystem Reference/AEB Function/Run_AsyEvlrCritEve_Step_Func/Run_AsyEvlrCritEve_Step_Func/TAWrapper/PreProcessor/VehiclePreProcessor/CheckCMbBActive/OnDelayBlock" /begin REF_MEASUREMENT autosar_swc_aeb_rtARID_DEF.UnitDelay_DSTATE_o /end REF_MEASUREMENT /end GROUP
/begin GROUP autosar_swc_aeb_autosar_swc_aeb_Step_sys_Subsystem_Reference_AEB_Function_Run_AsyEvlrCritEve_Step_Func_Run_AsyEvlrCritEve_Step_Func_TAWrapper_PreProcessor_VehiclePreProcessor_VehSelfSpdCompensation "autosar_swc_aeb/autosar_swc_aeb_Step_sys/Subsystem Reference/AEB Function/Run_AsyEvlrCritEve_Step_Func/Run_AsyEvlrCritEve_Step_Func/TAWrapper/PreProcessor/VehiclePreProcessor/VehSelfSpdCompensation"
 /begin SUB_GROUP autosar_swc_aeb_autosar_swc_aeb_Step_sys_Subsystem_Reference_AEB_Function_Run_AsyEvlrCritEve_Step_Func_Run_AsyEvlrCritEve_Step_Func_TAWrapper_PreProcessor_VehiclePreProcessor_VehSelfSpdCompensation_ButterworthFilterALgt /end SUB_GROUP
/end GROUP
/begin GROUP autosar_swc_aeb_autosar_swc_aeb_Step_sys_Subsystem_Reference_AEB_Function_Run_AsyEvlrCritEve_Step_Func_Run_AsyEvlrCritEve_Step_Func_TAWrapper_PreProcessor_VehiclePreProcessor_VehSelfSpdCompensation_ButterworthFilterALgt "autosar_swc_aeb/autosar_swc_aeb_Step_sys/Subsystem Reference/AEB Function/Run_AsyEvlrCritEve_Step_Func/Run_AsyEvlrCritEve_Step_Func/TAWrapper/PreProcessor/VehiclePreProcessor/VehSelfSpdCompensation/ButterworthFilterALgt"
 /begin REF_CHARACTERISTIC CLTS_ALgtFiltParam1InAsyEvlrCritEve_Ca CLTS_ALgtFiltParam2InAsyEvlrCritEve_Ca CLTS_ALgtFiltParam3InAsyEvlrCritEve_Ca CLTS_ALgtFiltParam4InAsyEvlrCritEve_Ca CLTS_ALgtFiltParam5InAsyEvlrCritEve_Ca /end REF_CHARACTERISTIC
 /begin REF_MEASUREMENT autosar_swc_aeb_rtARID_DEF.Delay1_DSTATE autosar_swc_aeb_rtARID_DEF.Delay3_DSTATE autosar_swc_aeb_rtARID_DEF.Delay5_DSTATE autosar_swc_aeb_rtARID_DEF.Delay_DSTATE /end REF_MEASUREMENT
/end GROUP
/begin GROUP autosar_swc_aeb_autosar_swc_aeb_Step_sys_Subsystem_Reference_AEB_Function_Run_CllsnFwdWarnCtrl_Step_Func "autosar_swc_aeb/autosar_swc_aeb_Step_sys/Subsystem Reference/AEB Function/Run_CllsnFwdWarnCtrl_Step_Func"
 /begin SUB_GROUP autosar_swc_aeb_autosar_swc_aeb_Step_sys_Subsystem_Reference_AEB_Function_Run_CllsnFwdWarnCtrl_Step_Func_Run_CllsnFwdWarn_Step /end SUB_GROUP
/end GROUP
/begin GROUP autosar_swc_aeb_autosar_swc_aeb_Step_sys_Subsystem_Reference_AEB_Function_Run_CllsnFwdWarnCtrl_Step_Func_Run_CllsnFwdWarn_Step "autosar_swc_aeb/autosar_swc_aeb_Step_sys/Subsystem Reference/AEB Function/Run_CllsnFwdWarnCtrl_Step_Func/Run_CllsnFwdWarn_Step"
 /begin SUB_GROUP autosar_swc_aeb_autosar_swc_aeb_Step_sys_Subsystem_Reference_AEB_Function_Run_CllsnFwdWarnCtrl_Step_Func_Run_CllsnFwdWarn_Step_FCW autosar_swc_aeb_autosar_swc_aeb_Step_sys_Subsystem_Reference_AEB_Function_Run_CllsnFwdWarnCtrl_Step_Func_Run_CllsnFwdWarn_Step_ReadableSignalsToAutoSar_FCW /end SUB_GROUP
/end GROUP
/begin GROUP autosar_swc_aeb_autosar_swc_aeb_Step_sys_Subsystem_Reference_AEB_Function_Run_CllsnFwdWarnCtrl_Step_Func_Run_CllsnFwdWarn_Step_FCW "autosar_swc_aeb/autosar_swc_aeb_Step_sys/Subsystem Reference/AEB Function/Run_CllsnFwdWarnCtrl_Step_Func/Run_CllsnFwdWarn_Step/FCW"
 /begin SUB_GROUP autosar_swc_aeb_autosar_swc_aeb_Step_sys_Subsystem_Reference_AEB_Function_Run_CllsnFwdWarnCtrl_Step_Func_Run_CllsnFwdWarn_Step_FCW_InhibitConditions autosar_swc_aeb_autosar_swc_aeb_Step_sys_Subsystem_Reference_AEB_Function_Run_CllsnFwdWarnCtrl_Step_Func_Run_CllsnFwdWarn_Step_FCW_StartConditions autosar_swc_aeb_autosar_swc_aeb_Step_sys_Subsystem_Reference_AEB_Function_Run_CllsnFwdWarnCtrl_Step_Func_Run_CllsnFwdWarn_Step_FCW_WarningAndBrakeGainManager /end SUB_GROUP
/end GROUP
/begin GROUP autosar_swc_aeb_autosar_swc_aeb_Step_sys_Subsystem_Reference_AEB_Function_Run_CllsnFwdWarnCtrl_Step_Func_Run_CllsnFwdWarn_Step_FCW_InhibitConditions "autosar_swc_aeb/autosar_swc_aeb_Step_sys/Subsystem Reference/AEB Function/Run_CllsnFwdWarnCtrl_Step_Func/Run_CllsnFwdWarn_Step/FCW/InhibitConditions" /begin REF_CHARACTERISTIC FCW_SpdLimLowrInCllsnFwdWarnCtrl_Ca /end REF_CHARACTERISTIC /end GROUP
/begin GROUP autosar_swc_aeb_autosar_swc_aeb_Step_sys_Subsystem_Reference_AEB_Function_Run_CllsnFwdWarnCtrl_Step_Func_Run_CllsnFwdWarn_Step_FCW_StartConditions "autosar_swc_aeb/autosar_swc_aeb_Step_sys/Subsystem Reference/AEB Function/Run_CllsnFwdWarnCtrl_Step_Func/Run_CllsnFwdWarn_Step/FCW/StartConditions"
 /begin SUB_GROUP autosar_swc_aeb_autosar_swc_aeb_Step_sys_Subsystem_Reference_AEB_Function_Run_CllsnFwdWarnCtrl_Step_Func_Run_CllsnFwdWarn_Step_FCW_StartConditions_BrakeGainStartConditions autosar_swc_aeb_autosar_swc_aeb_Step_sys_Subsystem_Reference_AEB_Function_Run_CllsnFwdWarnCtrl_Step_Func_Run_CllsnFwdWarn_Step_FCW_StartConditions_BtnBasedWarning autosar_swc_aeb_autosar_swc_aeb_Step_sys_Subsystem_Reference_AEB_Function_Run_CllsnFwdWarnCtrl_Step_Func_Run_CllsnFwdWarn_Step_FCW_StartConditions_ComfortDistanceBasedWarning autosar_swc_aeb_autosar_swc_aeb_Step_sys_Subsystem_Reference_AEB_Function_Run_CllsnFwdWarnCtrl_Step_Func_Run_CllsnFwdWarn_Step_FCW_StartConditions_FcwManualMode autosar_swc_aeb_autosar_swc_aeb_Step_sys_Subsystem_Reference_AEB_Function_Run_CllsnFwdWarnCtrl_Step_Func_Run_CllsnFwdWarn_Step_FCW_StartConditions_NCAPCPLA_CBLA autosar_swc_aeb_autosar_swc_aeb_Step_sys_Subsystem_Reference_AEB_Function_Run_CllsnFwdWarnCtrl_Step_Func_Run_CllsnFwdWarn_Step_FCW_StartConditions_StnCondition autosar_swc_aeb_autosar_swc_aeb_Step_sys_Subsystem_Reference_AEB_Function_Run_CllsnFwdWarnCtrl_Step_Func_Run_CllsnFwdWarn_Step_FCW_StartConditions_Tar_CarToCar autosar_swc_aeb_autosar_swc_aeb_Step_sys_Subsystem_Reference_AEB_Function_Run_CllsnFwdWarnCtrl_Step_Func_Run_CllsnFwdWarn_Step_FCW_StartConditions_ValidateObject /end SUB_GROUP
 /begin REF_CHARACTERISTIC FCW_DstCmftActvdInCllsnFwdWarnCtrl_Ca FCW_WarnEnagModForInCllsnFwdWarnCtrl_Ca /end REF_CHARACTERISTIC
/end GROUP
/begin GROUP autosar_swc_aeb_autosar_swc_aeb_Step_sys_Subsystem_Reference_AEB_Function_Run_CllsnFwdWarnCtrl_Step_Func_Run_CllsnFwdWarn_Step_FCW_StartConditions_BrakeGainStartConditions "autosar_swc_aeb/autosar_swc_aeb_Step_sys/Subsystem Reference/AEB Function/Run_CllsnFwdWarnCtrl_Step_Func/Run_CllsnFwdWarn_Step/FCW/StartConditions/BrakeGainStartConditions"
 /begin SUB_GROUP autosar_swc_aeb_autosar_swc_aeb_Step_sys_Subsystem_Reference_AEB_Function_Run_CllsnFwdWarnCtrl_Step_Func_Run_CllsnFwdWarn_Step_FCW_StartConditions_BrakeGainStartConditions_SR_FF /end SUB_GROUP
 /begin REF_CHARACTERISTIC FCW_BrkGainActvdInCllsnFwdWarnCtrl_Ca FCW_DrvrDecelThdForBrkGainInCllsnFwdWarnCtrl_Ca FCW_DrvrDecelThdForBrkGainOffInCllsnFwdWarnCtrl_Ca /end REF_CHARACTERISTIC
/end GROUP
/begin GROUP autosar_swc_aeb_autosar_swc_aeb_Step_sys_Subsystem_Reference_AEB_Function_Run_CllsnFwdWarnCtrl_Step_Func_Run_CllsnFwdWarn_Step_FCW_StartConditions_BrakeGainStartConditions_SR_FF "autosar_swc_aeb/autosar_swc_aeb_Step_sys/Subsystem Reference/AEB Function/Run_CllsnFwdWarnCtrl_Step_Func/Run_CllsnFwdWarn_Step/FCW/StartConditions/BrakeGainStartConditions/SR_FF" /begin REF_MEASUREMENT autosar_swc_aeb_rtARID_DEF.UnitDelay1_DSTATE_k5 /end REF_MEASUREMENT /end GROUP
/begin GROUP autosar_swc_aeb_autosar_swc_aeb_Step_sys_Subsystem_Reference_AEB_Function_Run_CllsnFwdWarnCtrl_Step_Func_Run_CllsnFwdWarn_Step_FCW_StartConditions_BtnBasedWarning "autosar_swc_aeb/autosar_swc_aeb_Step_sys/Subsystem Reference/AEB Function/Run_CllsnFwdWarnCtrl_Step_Func/Run_CllsnFwdWarn_Step/FCW/StartConditions/BtnBasedWarning"
 /begin REF_CHARACTERISTIC FCW_AccBrkCpActvdInCllsnFwdWarnCtrl_Ca FCW_RatThdForCritEveInCllsnFwdWarnCtrl_Ca FCW_RatThdHysForCritEveInCllsnFwdWarnCtrl_Ca /end REF_CHARACTERISTIC
 /begin REF_MEASUREMENT autosar_swc_aeb_rtARID_DEF.UnitDelay_DSTATE_hx /end REF_MEASUREMENT
/end GROUP
/begin GROUP autosar_swc_aeb_autosar_swc_aeb_Step_sys_Subsystem_Reference_AEB_Function_Run_CllsnFwdWarnCtrl_Step_Func_Run_CllsnFwdWarn_Step_FCW_StartConditions_ComfortDistanceBasedWarning "autosar_swc_aeb/autosar_swc_aeb_Step_sys/Subsystem Reference/AEB Function/Run_CllsnFwdWarnCtrl_Step_Func/Run_CllsnFwdWarn_Step/FCW/StartConditions/ComfortDistanceBasedWarning"
 /begin REF_CHARACTERISTIC FCW_DstCmftActvdForObjTyp10InCllsnFwdWarnCtrl_Ca FCW_DstCmftActvdForObjTyp1InCllsnFwdWarnCtrl_Ca FCW_DstCmftActvdForObjTyp2InCllsnFwdWarnCtrl_Ca FCW_DstCmftActvdForObjTyp3InCllsnFwdWarnCtrl_Ca FCW_DstCmftActvdForObjTyp4InCllsnFwdWarnCtrl_Ca FCW_DstCmftActvdForObjTyp7InCllsnFwdWarnCtrl_Ca FCW_DstCmftActvdForObjTyp8InCllsnFwdWarnCtrl_Ca FCW_DstCmftActvdForObjTyp9InCllsnFwdWarnCtrl_Ca FCW_DstCmftForLvl1OfSnvtyInCllsnFwdWarnCtrl_Ca FCW_DstCmftForLvl2OfSnvtyInCllsnFwdWarnCtrl_Ca FCW_DstCmftForLvl3OfSnvtyInCllsnFwdWarnCtrl_Ca FCW_PosnLatMaxForDstCmftInCllsnFwdWarnCtrl_Ca FCW_SpdInpThdVectForDstCmftInCllsnFwdWarnCtrl_Ca /end REF_CHARACTERISTIC
/end GROUP
/begin GROUP autosar_swc_aeb_autosar_swc_aeb_Step_sys_Subsystem_Reference_AEB_Function_Run_CllsnFwdWarnCtrl_Step_Func_Run_CllsnFwdWarn_Step_FCW_StartConditions_FcwManualMode "autosar_swc_aeb/autosar_swc_aeb_Step_sys/Subsystem Reference/AEB Function/Run_CllsnFwdWarnCtrl_Step_Func/Run_CllsnFwdWarn_Step/FCW/StartConditions/FcwManualMode"
 /begin REF_CHARACTERISTIC FCW_ManWarnDlyInCllsnFwdWarnCtrl_Ca FCW_ManWarnDurnInCllsnFwdWarnCtrl_Ca FCW_TrigManWarnInCllsnFwdWarnCtrl_Ca /end REF_CHARACTERISTIC
 /begin REF_MEASUREMENT autosar_swc_aeb_rtARID_DEF.UnitDelay1_DSTATE_i autosar_swc_aeb_rtARID_DEF.UnitDelay_DSTATE_bn /end REF_MEASUREMENT
/end GROUP
/begin GROUP autosar_swc_aeb_autosar_swc_aeb_Step_sys_Subsystem_Reference_AEB_Function_Run_CllsnFwdWarnCtrl_Step_Func_Run_CllsnFwdWarn_Step_FCW_StartConditions_NCAPCPLA_CBLA "autosar_swc_aeb/autosar_swc_aeb_Step_sys/Subsystem Reference/AEB Function/Run_CllsnFwdWarnCtrl_Step_Func/Run_CllsnFwdWarn_Step/FCW/StartConditions/NCAPCPLA_CBLA"
 /begin REF_CHARACTERISTIC FCW_DstCmftActvdForObjTyp10InCllsnFwdWarnCtrl_Ca FCW_DstCmftActvdForObjTyp7InCllsnFwdWarnCtrl_Ca FCW_DstCmftActvdForObjTyp8InCllsnFwdWarnCtrl_Ca P_AEB_CBLACPLAOver60TTC /end REF_CHARACTERISTIC
/end GROUP
/begin GROUP autosar_swc_aeb_autosar_swc_aeb_Step_sys_Subsystem_Reference_AEB_Function_Run_CllsnFwdWarnCtrl_Step_Func_Run_CllsnFwdWarn_Step_FCW_StartConditions_StnCondition "autosar_swc_aeb/autosar_swc_aeb_Step_sys/Subsystem Reference/AEB Function/Run_CllsnFwdWarnCtrl_Step_Func/Run_CllsnFwdWarn_Step/FCW/StartConditions/StnCondition"
 /begin SUB_GROUP autosar_swc_aeb_autosar_swc_aeb_Step_sys_Subsystem_Reference_AEB_Function_Run_CllsnFwdWarnCtrl_Step_Func_Run_CllsnFwdWarn_Step_FCW_StartConditions_StnCondition_LowPassFilter autosar_swc_aeb_autosar_swc_aeb_Step_sys_Subsystem_Reference_AEB_Function_Run_CllsnFwdWarnCtrl_Step_Func_Run_CllsnFwdWarn_Step_FCW_StartConditions_StnCondition_OffDelayBlock /end SUB_GROUP
 /begin REF_CHARACTERISTIC FCW_ALatRqrdMaxForSteerInCllsnFwdWarnCtrl_Ca FCW_PinionSteerAgSpdFilConInCllsnFwdWarnCtrl_Ca FCW_PinionSteerAgSpdMinInCllsnFwdWarnCtrl_Ca FCW_PinionSteerWhlAgVectForALatThdInCllsn_Ca FCW_SpdMaxForSteerCdnInCllsnFwdWarnCtrl_Ca FCW_SteerCdnActvForAnimalInCllsnFwdWarnCtrl_Ca FCW_SteerCdnActvForBicycleInCllsnFwdWarnCtrl_Ca FCW_SteerCdnActvForCarInCllsnFwdWarnCtrl_Ca FCW_SteerCdnActvForGenObjInCllsnFwdWarnCtrl_Ca FCW_SteerCdnActvForMotCycInCllsnFwdWarnCtrl_Ca FCW_SteerCdnActvForPedInCllsnFwdWarnCtrl_Ca FCW_SteerCdnActvForTruckInCllsnFwdWarnCtrl_Ca FCW_SteerCdnActvForVehOfUkwnClassInCllsnFwdWarnCtrl_Ca FCW_SteerWhlTurnDetnDlyInCllsnFwdWarnCtrl_Ca /end REF_CHARACTERISTIC
/end GROUP
/begin GROUP autosar_swc_aeb_autosar_swc_aeb_Step_sys_Subsystem_Reference_AEB_Function_Run_CllsnFwdWarnCtrl_Step_Func_Run_CllsnFwdWarn_Step_FCW_StartConditions_StnCondition_LowPassFilter "autosar_swc_aeb/autosar_swc_aeb_Step_sys/Subsystem Reference/AEB Function/Run_CllsnFwdWarnCtrl_Step_Func/Run_CllsnFwdWarn_Step/FCW/StartConditions/StnCondition/LowPassFilter" /begin REF_MEASUREMENT autosar_swc_aeb_rtARID_DEF.UD_1_DSTATE /end REF_MEASUREMENT /end GROUP
/begin GROUP autosar_swc_aeb_autosar_swc_aeb_Step_sys_Subsystem_Reference_AEB_Function_Run_CllsnFwdWarnCtrl_Step_Func_Run_CllsnFwdWarn_Step_FCW_StartConditions_StnCondition_OffDelayBlock "autosar_swc_aeb/autosar_swc_aeb_Step_sys/Subsystem Reference/AEB Function/Run_CllsnFwdWarnCtrl_Step_Func/Run_CllsnFwdWarn_Step/FCW/StartConditions/StnCondition/OffDelayBlock" /begin REF_MEASUREMENT autosar_swc_aeb_rtARID_DEF.UnitDelay_DSTATE_m /end REF_MEASUREMENT /end GROUP
/begin GROUP autosar_swc_aeb_autosar_swc_aeb_Step_sys_Subsystem_Reference_AEB_Function_Run_CllsnFwdWarnCtrl_Step_Func_Run_CllsnFwdWarn_Step_FCW_StartConditions_Tar_CarToCar "autosar_swc_aeb/autosar_swc_aeb_Step_sys/Subsystem Reference/AEB Function/Run_CllsnFwdWarnCtrl_Step_Func/Run_CllsnFwdWarn_Step/FCW/StartConditions/Tar_CarToCar"
 /begin REF_CHARACTERISTIC FCW_DstCmftActvdForObjTyp10InCllsnFwdWarnCtrl_Ca FCW_DstCmftActvdForObjTyp7InCllsnFwdWarnCtrl_Ca FCW_DstCmftActvdForObjTyp8InCllsnFwdWarnCtrl_Ca P_AEB_CCRb70kphALgt P_AEB_CCRb70kphTTC P_AEB_CCRm70kphTTC P_AEB_SCP40kphTTC /end REF_CHARACTERISTIC
/end GROUP
/begin GROUP autosar_swc_aeb_autosar_swc_aeb_Step_sys_Subsystem_Reference_AEB_Function_Run_CllsnFwdWarnCtrl_Step_Func_Run_CllsnFwdWarn_Step_FCW_StartConditions_ValidateObject "autosar_swc_aeb/autosar_swc_aeb_Step_sys/Subsystem Reference/AEB Function/Run_CllsnFwdWarnCtrl_Step_Func/Run_CllsnFwdWarn_Step/FCW/StartConditions/ValidateObject"
 /begin SUB_GROUP autosar_swc_aeb_autosar_swc_aeb_Step_sys_Subsystem_Reference_AEB_Function_Run_CllsnFwdWarnCtrl_Step_Func_Run_CllsnFwdWarn_Step_FCW_StartConditions_ValidateObject_ValidateLongitudinalPosition autosar_swc_aeb_autosar_swc_aeb_Step_sys_Subsystem_Reference_AEB_Function_Run_CllsnFwdWarnCtrl_Step_Func_Run_CllsnFwdWarn_Step_FCW_StartConditions_ValidateObject_ValidateTimeToCollision autosar_swc_aeb_autosar_swc_aeb_Step_sys_Subsystem_Reference_AEB_Function_Run_CllsnFwdWarnCtrl_Step_Func_Run_CllsnFwdWarn_Step_FCW_StartConditions_ValidateObject_ValidateUsingVisionOnlyWarning /end SUB_GROUP
/end GROUP
/begin GROUP autosar_swc_aeb_autosar_swc_aeb_Step_sys_Subsystem_Reference_AEB_Function_Run_CllsnFwdWarnCtrl_Step_Func_Run_CllsnFwdWarn_Step_FCW_StartConditions_ValidateObject_ValidateLongitudinalPosition "autosar_swc_aeb/autosar_swc_aeb_Step_sys/Subsystem Reference/AEB Function/Run_CllsnFwdWarnCtrl_Step_Func/Run_CllsnFwdWarn_Step/FCW/StartConditions/ValidateObject/ValidateLongitudinalPosition"
 /begin REF_CHARACTERISTIC FCW_PosnLgtMaxForBicycleInCllsnFwdWarnCtrl_Ca FCW_PosnLgtMaxForNoVisnVehInCllsnFwdWarnCtrl_Ca FCW_PosnLgtMaxForObjTyp7InCllsnFwdWarnCtrl_Ca FCW_PosnLgtMaxForObjTyp8InCllsnFwdWarnCtrl_Ca FCW_PosnLgtMaxForPedInCllsnFwdWarnCtrl_Ca FCW_PosnLgtMaxForVehInCllsnFwdWarnCtrl_Ca /end REF_CHARACTERISTIC
/end GROUP
/begin GROUP autosar_swc_aeb_autosar_swc_aeb_Step_sys_Subsystem_Reference_AEB_Function_Run_CllsnFwdWarnCtrl_Step_Func_Run_CllsnFwdWarn_Step_FCW_StartConditions_ValidateObject_ValidateTimeToCollision "autosar_swc_aeb/autosar_swc_aeb_Step_sys/Subsystem Reference/AEB Function/Run_CllsnFwdWarnCtrl_Step_Func/Run_CllsnFwdWarn_Step/FCW/StartConditions/ValidateObject/ValidateTimeToCollision"
 /begin REF_CHARACTERISTIC FCW_SpdInpThdVectForTiToCllsnInCllsnFwdWarnCtrl_Ca FCW_TiToCllsnLimForLvl1OfSnvtyInCllsnFwdWarnCtrl_Ca FCW_TiToCllsnLimForLvl2OfSnvtyInCllsnFwdWarnCtrl_Ca FCW_TiToCllsnLimForLvl3OfSnvtyInCllsnFwdWarnCtrl_Ca /end REF_CHARACTERISTIC
/end GROUP
/begin GROUP autosar_swc_aeb_autosar_swc_aeb_Step_sys_Subsystem_Reference_AEB_Function_Run_CllsnFwdWarnCtrl_Step_Func_Run_CllsnFwdWarn_Step_FCW_StartConditions_ValidateObject_ValidateUsingVisionOnlyWarning "autosar_swc_aeb/autosar_swc_aeb_Step_sys/Subsystem Reference/AEB Function/Run_CllsnFwdWarnCtrl_Step_Func/Run_CllsnFwdWarn_Step/FCW/StartConditions/ValidateObject/ValidateUsingVisionOnlyWarning" /begin REF_CHARACTERISTIC FCW_VisnOnlyCfmActvdInCllsnFwdWarnCtrl_Ca /end REF_CHARACTERISTIC /end GROUP
/begin GROUP autosar_swc_aeb_autosar_swc_aeb_Step_sys_Subsystem_Reference_AEB_Function_Run_CllsnFwdWarnCtrl_Step_Func_Run_CllsnFwdWarn_Step_FCW_WarningAndBrakeGainManager "autosar_swc_aeb/autosar_swc_aeb_Step_sys/Subsystem Reference/AEB Function/Run_CllsnFwdWarnCtrl_Step_Func/Run_CllsnFwdWarn_Step/FCW/WarningAndBrakeGainManager"
 /begin SUB_GROUP autosar_swc_aeb_autosar_swc_aeb_Step_sys_Subsystem_Reference_AEB_Function_Run_CllsnFwdWarnCtrl_Step_Func_Run_CllsnFwdWarn_Step_FCW_WarningAndBrakeGainManager_AudioVisualWarning autosar_swc_aeb_autosar_swc_aeb_Step_sys_Subsystem_Reference_AEB_Function_Run_CllsnFwdWarnCtrl_Step_Func_Run_CllsnFwdWarn_Step_FCW_WarningAndBrakeGainManager_BrakeGainRegulator autosar_swc_aeb_autosar_swc_aeb_Step_sys_Subsystem_Reference_AEB_Function_Run_CllsnFwdWarnCtrl_Step_Func_Run_CllsnFwdWarn_Step_FCW_WarningAndBrakeGainManager_BrakePulseWarning /end SUB_GROUP
/end GROUP
/begin GROUP autosar_swc_aeb_autosar_swc_aeb_Step_sys_Subsystem_Reference_AEB_Function_Run_CllsnFwdWarnCtrl_Step_Func_Run_CllsnFwdWarn_Step_FCW_WarningAndBrakeGainManager_AudioVisualWarning "autosar_swc_aeb/autosar_swc_aeb_Step_sys/Subsystem Reference/AEB Function/Run_CllsnFwdWarnCtrl_Step_Func/Run_CllsnFwdWarn_Step/FCW/WarningAndBrakeGainManager/AudioVisualWarning"
 /begin SUB_GROUP autosar_swc_aeb_autosar_swc_aeb_Step_sys_Subsystem_Reference_AEB_Function_Run_CllsnFwdWarnCtrl_Step_Func_Run_CllsnFwdWarn_Step_FCW_WarningAndBrakeGainManager_AudioVisualWarning_DIAG_FCW_selectedObjectId /end SUB_GROUP
 /begin REF_CHARACTERISTIC FCW_AudAndVisWarnDurnInCllsnFwdWarnCtrl_Ca FCW_MinWarnDplInCllsnFwdWarnCtrl_Ca /end REF_CHARACTERISTIC
 /begin REF_MEASUREMENT autosar_swc_aeb_rtARID_DEF.delay_f autosar_swc_aeb_rtARID_DEF.is_ACTIVE_p autosar_swc_aeb_rtARID_DEF.is_active_c374_autosar_swc_aeb autosar_swc_aeb_rtARID_DEF.is_c374_autosar_swc_aeb autosar_swc_aeb_rtARID_DEF.selectedObjectId /end REF_MEASUREMENT
/end GROUP
/begin GROUP autosar_swc_aeb_autosar_swc_aeb_Step_sys_Subsystem_Reference_AEB_Function_Run_CllsnFwdWarnCtrl_Step_Func_Run_CllsnFwdWarn_Step_FCW_WarningAndBrakeGainManager_AudioVisualWarning_DIAG_FCW_selectedObjectId "autosar_swc_aeb/autosar_swc_aeb_Step_sys/Subsystem Reference/AEB Function/Run_CllsnFwdWarnCtrl_Step_Func/Run_CllsnFwdWarn_Step/FCW/WarningAndBrakeGainManager/AudioVisualWarning/DIAG_FCW_selectedObjectId"
 /begin SUB_GROUP autosar_swc_aeb_autosar_swc_aeb_Step_sys_Subsystem_Reference_AEB_Function_Run_CllsnFwdWarnCtrl_Step_Func_Run_CllsnFwdWarn_Step_FCW_WarningAndBrakeGainManager_AudioVisualWarning_DIAG_FCW_selectedObjectId_off /end SUB_GROUP
/end GROUP
/begin GROUP autosar_swc_aeb_autosar_swc_aeb_Step_sys_Subsystem_Reference_AEB_Function_Run_CllsnFwdWarnCtrl_Step_Func_Run_CllsnFwdWarn_Step_FCW_WarningAndBrakeGainManager_AudioVisualWarning_DIAG_FCW_selectedObjectId_off "autosar_swc_aeb/autosar_swc_aeb_Step_sys/Subsystem Reference/AEB Function/Run_CllsnFwdWarnCtrl_Step_Func/Run_CllsnFwdWarn_Step/FCW/WarningAndBrakeGainManager/AudioVisualWarning/DIAG_FCW_selectedObjectId/off"
 /begin SUB_GROUP autosar_swc_aeb_autosar_swc_aeb_Step_sys_Subsystem_Reference_AEB_Function_Run_CllsnFwdWarnCtrl_Step_Func_Run_CllsnFwdWarn_Step_FCW_WarningAndBrakeGainManager_AudioVisualWarning_DIAG_FCW_selectedObjectId_off_ALVTerm /end SUB_GROUP
/end GROUP
/begin GROUP autosar_swc_aeb_autosar_swc_aeb_Step_sys_Subsystem_Reference_AEB_Function_Run_CllsnFwdWarnCtrl_Step_Func_Run_CllsnFwdWarn_Step_FCW_WarningAndBrakeGainManager_AudioVisualWarning_DIAG_FCW_selectedObjectId_off_ALVTerm "autosar_swc_aeb/autosar_swc_aeb_Step_sys/Subsystem Reference/AEB Function/Run_CllsnFwdWarnCtrl_Step_Func/Run_CllsnFwdWarn_Step/FCW/WarningAndBrakeGainManager/AudioVisualWarning/DIAG_FCW_selectedObjectId/off/ALVTerm" /begin REF_MEASUREMENT autosar_swc_aeb_rtARID_DEF.selectedObjectId /end REF_MEASUREMENT /end GROUP
/begin GROUP autosar_swc_aeb_autosar_swc_aeb_Step_sys_Subsystem_Reference_AEB_Function_Run_CllsnFwdWarnCtrl_Step_Func_Run_CllsnFwdWarn_Step_FCW_WarningAndBrakeGainManager_BrakeGainRegulator "autosar_swc_aeb/autosar_swc_aeb_Step_sys/Subsystem Reference/AEB Function/Run_CllsnFwdWarnCtrl_Step_Func/Run_CllsnFwdWarn_Step/FCW/WarningAndBrakeGainManager/BrakeGainRegulator"
 /begin SUB_GROUP autosar_swc_aeb_autosar_swc_aeb_Step_sys_Subsystem_Reference_AEB_Function_Run_CllsnFwdWarnCtrl_Step_Func_Run_CllsnFwdWarn_Step_FCW_WarningAndBrakeGainManager_BrakeGainRegulator_CalculateBrakeGain autosar_swc_aeb_autosar_swc_aeb_Step_sys_Subsystem_Reference_AEB_Function_Run_CllsnFwdWarnCtrl_Step_Func_Run_CllsnFwdWarn_Step_FCW_WarningAndBrakeGainManager_BrakeGainRegulator_DIAG_FCW_brakeGainState /end SUB_GROUP
 /begin REF_CHARACTERISTIC FCW_MinWarnDplInCllsnFwdWarnCtrl_Ca /end REF_CHARACTERISTIC
 /begin REF_MEASUREMENT autosar_swc_aeb_rtARID_DEF.brakeGainEnabled autosar_swc_aeb_rtARID_DEF.brakeGainState autosar_swc_aeb_rtARID_DEF.delay_j autosar_swc_aeb_rtARID_DEF.is_StateMachine autosar_swc_aeb_rtARID_DEF.is_active_c375_autosar_swc_aeb autosar_swc_aeb_rtARID_DEF.is_c375_autosar_swc_aeb /end REF_MEASUREMENT
/end GROUP
/begin GROUP autosar_swc_aeb_autosar_swc_aeb_Step_sys_Subsystem_Reference_AEB_Function_Run_CllsnFwdWarnCtrl_Step_Func_Run_CllsnFwdWarn_Step_FCW_WarningAndBrakeGainManager_BrakeGainRegulator_CalculateBrakeGain "autosar_swc_aeb/autosar_swc_aeb_Step_sys/Subsystem Reference/AEB Function/Run_CllsnFwdWarnCtrl_Step_Func/Run_CllsnFwdWarn_Step/FCW/WarningAndBrakeGainManager/BrakeGainRegulator/CalculateBrakeGain"
 /begin SUB_GROUP autosar_swc_aeb_autosar_swc_aeb_Step_sys_Subsystem_Reference_AEB_Function_Run_CllsnFwdWarnCtrl_Step_Func_Run_CllsnFwdWarn_Step_FCW_WarningAndBrakeGainManager_BrakeGainRegulator_CalculateBrakeGain_HoldLogicForBrakeGainDecel autosar_swc_aeb_autosar_swc_aeb_Step_sys_Subsystem_Reference_AEB_Function_Run_CllsnFwdWarnCtrl_Step_Func_Run_CllsnFwdWarn_Step_FCW_WarningAndBrakeGainManager_BrakeGainRegulator_CalculateBrakeGain_SR_FF /end SUB_GROUP
 /begin REF_CHARACTERISTIC FCW_BrkGainMaxDecelLimInCllsnFwdWarnReq_Ca FCW_BrkGainReqHiInCllsnFwdWarnReq_Ca FCW_BrkGainReqNormInCllsnFwdWarnReq_Ca FCW_BrkGainReqOffInCllsnFwdWarnReq_Ca FCW_SteerRatThdForBrkGainHiInCllsnFwdWarnCtrl_Ca FCW_SteerRatThdHysForBrkGainHiInCllsnFwdWarnCtrl_Ca /end REF_CHARACTERISTIC
 /begin REF_MEASUREMENT autosar_swc_aeb_rtARID_DEF.brakeGainEnabled /end REF_MEASUREMENT
/end GROUP
/begin GROUP autosar_swc_aeb_autosar_swc_aeb_Step_sys_Subsystem_Reference_AEB_Function_Run_CllsnFwdWarnCtrl_Step_Func_Run_CllsnFwdWarn_Step_FCW_WarningAndBrakeGainManager_BrakeGainRegulator_CalculateBrakeGain_HoldLogicForBrakeGainDecel "autosar_swc_aeb/autosar_swc_aeb_Step_sys/Subsystem Reference/AEB Function/Run_CllsnFwdWarnCtrl_Step_Func/Run_CllsnFwdWarn_Step/FCW/WarningAndBrakeGainManager/BrakeGainRegulator/CalculateBrakeGain/HoldLogicForBrakeGainDecel"
 /begin SUB_GROUP autosar_swc_aeb_autosar_swc_aeb_Step_sys_Subsystem_Reference_AEB_Function_Run_CllsnFwdWarnCtrl_Step_Func_Run_CllsnFwdWarn_Step_FCW_WarningAndBrakeGainManager_BrakeGainRegulator_CalculateBrakeGain_HoldLogicForBrakeGainDecel_OffDelayBlock autosar_swc_aeb_autosar_swc_aeb_Step_sys_Subsystem_Reference_AEB_Function_Run_CllsnFwdWarnCtrl_Step_Func_Run_CllsnFwdWarn_Step_FCW_WarningAndBrakeGainManager_BrakeGainRegulator_CalculateBrakeGain_HoldLogicForBrakeGainDecel_OnDelayBlock1 /end SUB_GROUP
 /begin REF_CHARACTERISTIC FCW_BrkGainHldTiInCllsnFwdWarnCtrl_Ca FCW_CfmTiForBrkGainHldInCllsnFwdWarnCtrl_Ca FCW_SpdLoThdForBrkGainHldInCllsnFwdWarnCtrl_Ca /end REF_CHARACTERISTIC
 /begin REF_MEASUREMENT autosar_swc_aeb_rtARID_DEF.Delay_DSTATE_i /end REF_MEASUREMENT
/end GROUP
/begin GROUP autosar_swc_aeb_autosar_swc_aeb_Step_sys_Subsystem_Reference_AEB_Function_Run_CllsnFwdWarnCtrl_Step_Func_Run_CllsnFwdWarn_Step_FCW_WarningAndBrakeGainManager_BrakeGainRegulator_CalculateBrakeGain_HoldLogicForBrakeGainDecel_OffDelayBlock "autosar_swc_aeb/autosar_swc_aeb_Step_sys/Subsystem Reference/AEB Function/Run_CllsnFwdWarnCtrl_Step_Func/Run_CllsnFwdWarn_Step/FCW/WarningAndBrakeGainManager/BrakeGainRegulator/CalculateBrakeGain/HoldLogicForBrakeGainDecel/OffDelayBlock" /begin REF_MEASUREMENT autosar_swc_aeb_rtARID_DEF.UnitDelay_DSTATE_a /end REF_MEASUREMENT /end GROUP
/begin GROUP autosar_swc_aeb_autosar_swc_aeb_Step_sys_Subsystem_Reference_AEB_Function_Run_CllsnFwdWarnCtrl_Step_Func_Run_CllsnFwdWarn_Step_FCW_WarningAndBrakeGainManager_BrakeGainRegulator_CalculateBrakeGain_HoldLogicForBrakeGainDecel_OnDelayBlock1 "autosar_swc_aeb/autosar_swc_aeb_Step_sys/Subsystem Reference/AEB Function/Run_CllsnFwdWarnCtrl_Step_Func/Run_CllsnFwdWarn_Step/FCW/WarningAndBrakeGainManager/BrakeGainRegulator/CalculateBrakeGain/HoldLogicForBrakeGainDecel/OnDelayBlock1"
 /begin REF_MEASUREMENT autosar_swc_aeb_rtARID_DEF.UnitDelay_DSTATE_lq autosar_swc_aeb_rtARID_DEF.brakeGainEnabled /end REF_MEASUREMENT
/end GROUP
/begin GROUP autosar_swc_aeb_autosar_swc_aeb_Step_sys_Subsystem_Reference_AEB_Function_Run_CllsnFwdWarnCtrl_Step_Func_Run_CllsnFwdWarn_Step_FCW_WarningAndBrakeGainManager_BrakeGainRegulator_CalculateBrakeGain_SR_FF "autosar_swc_aeb/autosar_swc_aeb_Step_sys/Subsystem Reference/AEB Function/Run_CllsnFwdWarnCtrl_Step_Func/Run_CllsnFwdWarn_Step/FCW/WarningAndBrakeGainManager/BrakeGainRegulator/CalculateBrakeGain/SR_FF" /begin REF_MEASUREMENT autosar_swc_aeb_rtARID_DEF.UnitDelay1_DSTATE_ap /end REF_MEASUREMENT /end GROUP
/begin GROUP autosar_swc_aeb_autosar_swc_aeb_Step_sys_Subsystem_Reference_AEB_Function_Run_CllsnFwdWarnCtrl_Step_Func_Run_CllsnFwdWarn_Step_FCW_WarningAndBrakeGainManager_BrakeGainRegulator_DIAG_FCW_brakeGainState "autosar_swc_aeb/autosar_swc_aeb_Step_sys/Subsystem Reference/AEB Function/Run_CllsnFwdWarnCtrl_Step_Func/Run_CllsnFwdWarn_Step/FCW/WarningAndBrakeGainManager/BrakeGainRegulator/DIAG_FCW_brakeGainState"
 /begin SUB_GROUP autosar_swc_aeb_autosar_swc_aeb_Step_sys_Subsystem_Reference_AEB_Function_Run_CllsnFwdWarnCtrl_Step_Func_Run_CllsnFwdWarn_Step_FCW_WarningAndBrakeGainManager_BrakeGainRegulator_DIAG_FCW_brakeGainState_off /end SUB_GROUP
/end GROUP
/begin GROUP autosar_swc_aeb_autosar_swc_aeb_Step_sys_Subsystem_Reference_AEB_Function_Run_CllsnFwdWarnCtrl_Step_Func_Run_CllsnFwdWarn_Step_FCW_WarningAndBrakeGainManager_BrakeGainRegulator_DIAG_FCW_brakeGainState_off "autosar_swc_aeb/autosar_swc_aeb_Step_sys/Subsystem Reference/AEB Function/Run_CllsnFwdWarnCtrl_Step_Func/Run_CllsnFwdWarn_Step/FCW/WarningAndBrakeGainManager/BrakeGainRegulator/DIAG_FCW_brakeGainState/off"
 /begin SUB_GROUP autosar_swc_aeb_autosar_swc_aeb_Step_sys_Subsystem_Reference_AEB_Function_Run_CllsnFwdWarnCtrl_Step_Func_Run_CllsnFwdWarn_Step_FCW_WarningAndBrakeGainManager_BrakeGainRegulator_DIAG_FCW_brakeGainState_off_ALVTerm /end SUB_GROUP
/end GROUP
/begin GROUP autosar_swc_aeb_autosar_swc_aeb_Step_sys_Subsystem_Reference_AEB_Function_Run_CllsnFwdWarnCtrl_Step_Func_Run_CllsnFwdWarn_Step_FCW_WarningAndBrakeGainManager_BrakeGainRegulator_DIAG_FCW_brakeGainState_off_ALVTerm "autosar_swc_aeb/autosar_swc_aeb_Step_sys/Subsystem Reference/AEB Function/Run_CllsnFwdWarnCtrl_Step_Func/Run_CllsnFwdWarn_Step/FCW/WarningAndBrakeGainManager/BrakeGainRegulator/DIAG_FCW_brakeGainState/off/ALVTerm" /begin REF_MEASUREMENT autosar_swc_aeb_rtARID_DEF.brakeGainState /end REF_MEASUREMENT /end GROUP
/begin GROUP autosar_swc_aeb_autosar_swc_aeb_Step_sys_Subsystem_Reference_AEB_Function_Run_CllsnFwdWarnCtrl_Step_Func_Run_CllsnFwdWarn_Step_FCW_WarningAndBrakeGainManager_BrakePulseWarning "autosar_swc_aeb/autosar_swc_aeb_Step_sys/Subsystem Reference/AEB Function/Run_CllsnFwdWarnCtrl_Step_Func/Run_CllsnFwdWarn_Step/FCW/WarningAndBrakeGainManager/BrakePulseWarning"
 /begin SUB_GROUP autosar_swc_aeb_autosar_swc_aeb_Step_sys_Subsystem_Reference_AEB_Function_Run_CllsnFwdWarnCtrl_Step_Func_Run_CllsnFwdWarn_Step_FCW_WarningAndBrakeGainManager_BrakePulseWarning_BrakePulseCalclulation autosar_swc_aeb_autosar_swc_aeb_Step_sys_Subsystem_Reference_AEB_Function_Run_CllsnFwdWarnCtrl_Step_Func_Run_CllsnFwdWarn_Step_FCW_WarningAndBrakeGainManager_BrakePulseWarning_BrakePulseDelayCalculation autosar_swc_aeb_autosar_swc_aeb_Step_sys_Subsystem_Reference_AEB_Function_Run_CllsnFwdWarnCtrl_Step_Func_Run_CllsnFwdWarn_Step_FCW_WarningAndBrakeGainManager_BrakePulseWarning_InhibitBrakePulse /end SUB_GROUP
 /begin REF_CHARACTERISTIC FCW_MinWarnDplInCllsnFwdWarnCtrl_Ca /end REF_CHARACTERISTIC
 /begin REF_MEASUREMENT autosar_swc_aeb_rtARID_DEF.UnitDelay1_DSTATE_nn autosar_swc_aeb_rtARID_DEF.brakePulseFinished autosar_swc_aeb_rtARID_DEF.delay autosar_swc_aeb_rtARID_DEF.is_ACTIVE autosar_swc_aeb_rtARID_DEF.is_active_c378_autosar_swc_aeb autosar_swc_aeb_rtARID_DEF.is_c378_autosar_swc_aeb /end REF_MEASUREMENT
/end GROUP
/begin GROUP autosar_swc_aeb_autosar_swc_aeb_Step_sys_Subsystem_Reference_AEB_Function_Run_CllsnFwdWarnCtrl_Step_Func_Run_CllsnFwdWarn_Step_FCW_WarningAndBrakeGainManager_BrakePulseWarning_BrakePulseCalclulation "autosar_swc_aeb/autosar_swc_aeb_Step_sys/Subsystem Reference/AEB Function/Run_CllsnFwdWarnCtrl_Step_Func/Run_CllsnFwdWarn_Step/FCW/WarningAndBrakeGainManager/BrakePulseWarning/BrakePulseCalclulation"
 /begin SUB_GROUP autosar_swc_aeb_autosar_swc_aeb_Step_sys_Subsystem_Reference_AEB_Function_Run_CllsnFwdWarnCtrl_Step_Func_Run_CllsnFwdWarn_Step_FCW_WarningAndBrakeGainManager_BrakePulseWarning_BrakePulseCalclulation_CalculateBrakePulseAmplitude autosar_swc_aeb_autosar_swc_aeb_Step_sys_Subsystem_Reference_AEB_Function_Run_CllsnFwdWarnCtrl_Step_Func_Run_CllsnFwdWarn_Step_FCW_WarningAndBrakeGainManager_BrakePulseWarning_BrakePulseCalclulation_Calculate_Jerkup autosar_swc_aeb_autosar_swc_aeb_Step_sys_Subsystem_Reference_AEB_Function_Run_CllsnFwdWarnCtrl_Step_Func_Run_CllsnFwdWarn_Step_FCW_WarningAndBrakeGainManager_BrakePulseWarning_BrakePulseCalclulation_Calculate_holdtime autosar_swc_aeb_autosar_swc_aeb_Step_sys_Subsystem_Reference_AEB_Function_Run_CllsnFwdWarnCtrl_Step_Func_Run_CllsnFwdWarn_Step_FCW_WarningAndBrakeGainManager_BrakePulseWarning_BrakePulseCalclulation_TuningParameterSelection /end SUB_GROUP
 /begin REF_CHARACTERISTIC FCW_MaxAmpForBrkPlsInCllsnFwdWarnCtrl_Ca FCW_MinAmpForBrkPlsInCllsnFwdWarnCtrl_Ca /end REF_CHARACTERISTIC
 /begin REF_MEASUREMENT autosar_swc_aeb_rtARID_DEF.brakePulseAmplitude autosar_swc_aeb_rtARID_DEF.brakePulseFinished autosar_swc_aeb_rtARID_DEF.brakePulseHoldTime autosar_swc_aeb_rtARID_DEF.brakePulseJerkDown autosar_swc_aeb_rtARID_DEF.brakePulseJerkUp autosar_swc_aeb_rtARID_DEF.brakePulseRequest autosar_swc_aeb_rtARID_DEF.cyclesAtNoRequest autosar_swc_aeb_rtARID_DEF.delay_b autosar_swc_aeb_rtARID_DEF.is_active_c377_autosar_swc_aeb autosar_swc_aeb_rtARID_DEF.is_c377_autosar_swc_aeb /end REF_MEASUREMENT
/end GROUP
/begin GROUP autosar_swc_aeb_autosar_swc_aeb_Step_sys_Subsystem_Reference_AEB_Function_Run_CllsnFwdWarnCtrl_Step_Func_Run_CllsnFwdWarn_Step_FCW_WarningAndBrakeGainManager_BrakePulseWarning_BrakePulseCalclulation_CalculateBrakePulseAmplitude "autosar_swc_aeb/autosar_swc_aeb_Step_sys/Subsystem Reference/AEB Function/Run_CllsnFwdWarnCtrl_Step_Func/Run_CllsnFwdWarn_Step/FCW/WarningAndBrakeGainManager/BrakePulseWarning/BrakePulseCalclulation/CalculateBrakePulseAmplitude"
 /begin SUB_GROUP autosar_swc_aeb_autosar_swc_aeb_Step_sys_Subsystem_Reference_AEB_Function_Run_CllsnFwdWarnCtrl_Step_Func_Run_CllsnFwdWarn_Step_FCW_WarningAndBrakeGainManager_BrakePulseWarning_BrakePulseCalclulation_CalculateBrakePulseAmplitude_LowPassFilterALgt /end SUB_GROUP
 /begin REF_CHARACTERISTIC FCW_MaxAmpForBrkPlsInCllsnFwdWarnCtrl_Ca FCW_MinActvAmpForBrkPlsInCllsnFwdWarnCtrl_Ca /end REF_CHARACTERISTIC
/end GROUP
/begin GROUP autosar_swc_aeb_autosar_swc_aeb_Step_sys_Subsystem_Reference_AEB_Function_Run_CllsnFwdWarnCtrl_Step_Func_Run_CllsnFwdWarn_Step_FCW_WarningAndBrakeGainManager_BrakePulseWarning_BrakePulseCalclulation_CalculateBrakePulseAmplitude_LowPassFilterALgt "autosar_swc_aeb/autosar_swc_aeb_Step_sys/Subsystem Reference/AEB Function/Run_CllsnFwdWarnCtrl_Step_Func/Run_CllsnFwdWarn_Step/FCW/WarningAndBrakeGainManager/BrakePulseWarning/BrakePulseCalclulation/CalculateBrakePulseAmplitude/LowPassFilterALgt"
 /begin REF_CHARACTERISTIC FCW_ALgtFiltParam1InCllsnFwdWarnCtrl_Ca FCW_ALgtFiltParam2InCllsnFwdWarnCtrl_Ca FCW_ALgtFiltParam3InCllsnFwdWarnCtrl_Ca FCW_ALgtFiltParam4InCllsnFwdWarnCtrl_Ca FCW_ALgtFiltParam5InCllsnFwdWarnCtrl_Ca /end REF_CHARACTERISTIC
 /begin REF_MEASUREMENT autosar_swc_aeb_rtARID_DEF.Delay1_DSTATE_g autosar_swc_aeb_rtARID_DEF.Delay3_DSTATE_a autosar_swc_aeb_rtARID_DEF.Delay5_DSTATE_h autosar_swc_aeb_rtARID_DEF.Delay_DSTATE_fk /end REF_MEASUREMENT
/end GROUP
/begin GROUP autosar_swc_aeb_autosar_swc_aeb_Step_sys_Subsystem_Reference_AEB_Function_Run_CllsnFwdWarnCtrl_Step_Func_Run_CllsnFwdWarn_Step_FCW_WarningAndBrakeGainManager_BrakePulseWarning_BrakePulseCalclulation_Calculate_Jerkup "autosar_swc_aeb/autosar_swc_aeb_Step_sys/Subsystem Reference/AEB Function/Run_CllsnFwdWarnCtrl_Step_Func/Run_CllsnFwdWarn_Step/FCW/WarningAndBrakeGainManager/BrakePulseWarning/BrakePulseCalclulation/Calculate Jerkup"
 /begin REF_CHARACTERISTIC FCW_BrkPlsCmpFacMaxForJerkUpInCllsnFwdWarnCtrl_Ca FCW_BrkPlsCmpFacMinForJerkUpInCllsnFwdWarnCtrl_Ca /end REF_CHARACTERISTIC
/end GROUP
/begin GROUP autosar_swc_aeb_autosar_swc_aeb_Step_sys_Subsystem_Reference_AEB_Function_Run_CllsnFwdWarnCtrl_Step_Func_Run_CllsnFwdWarn_Step_FCW_WarningAndBrakeGainManager_BrakePulseWarning_BrakePulseCalclulation_Calculate_holdtime "autosar_swc_aeb/autosar_swc_aeb_Step_sys/Subsystem Reference/AEB Function/Run_CllsnFwdWarnCtrl_Step_Func/Run_CllsnFwdWarn_Step/FCW/WarningAndBrakeGainManager/BrakePulseWarning/BrakePulseCalclulation/Calculate holdtime"
 /begin REF_CHARACTERISTIC FCW_HldTiCmpByJerkThdInCllsnFwdWarnCtrl_Ca FCW_HldTiCmpByVehMtnThdInCllsnFwdWarnCtrl_Ca FCW_HldTiMaxForBrkPlsInCllsnFwdWarnCtrl_Ca FCW_NrOfCycCmpByVehMtnThdInCllsnFwdWarnCtrl_Ca /end REF_CHARACTERISTIC
/end GROUP
/begin GROUP autosar_swc_aeb_autosar_swc_aeb_Step_sys_Subsystem_Reference_AEB_Function_Run_CllsnFwdWarnCtrl_Step_Func_Run_CllsnFwdWarn_Step_FCW_WarningAndBrakeGainManager_BrakePulseWarning_BrakePulseCalclulation_TuningParameterSelection "autosar_swc_aeb/autosar_swc_aeb_Step_sys/Subsystem Reference/AEB Function/Run_CllsnFwdWarnCtrl_Step_Func/Run_CllsnFwdWarn_Step/FCW/WarningAndBrakeGainManager/BrakePulseWarning/BrakePulseCalclulation/TuningParameterSelection"
 /begin REF_CHARACTERISTIC FCW_AmpForBrkPlsVrnt0InCllsnFwdWarnCtrl_Ca FCW_AmpForBrkPlsVrnt1InCllsnFwdWarnCtrl_Ca FCW_AmpForBrkPlsVrnt2InCllsnFwdWarnCtrl_Ca FCW_AmpForBrkPlsVrnt3InCllsnFwdWarnCtrl_Ca FCW_AmpForBrkPlsVrnt4InCllsnFwdWarnCtrl_Ca FCW_AmpForBrkPlsVrnt5InCllsnFwdWarnCtrl_Ca FCW_AmpForBrkPlsVrnt6InCllsnFwdWarnCtrl_Ca FCW_AmpForBrkPlsVrnt7InCllsnFwdWarnCtrl_Ca FCW_HldTiChgRateFromVehAForBrkPlsVrnt0InCllsnFwdWarnCtrl_Ca FCW_HldTiChgRateFromVehAForBrkPlsVrnt1InCllsnFwdWarnCtrl_Ca FCW_HldTiChgRateFromVehAForBrkPlsVrnt2InCllsnFwdWarnCtrl_Ca FCW_HldTiChgRateFromVehAForBrkPlsVrnt3InCllsnFwdWarnCtrl_Ca FCW_HldTiChgRateFromVehAForBrkPlsVrnt4InCllsnFwdWarnCtrl_Ca FCW_HldTiChgRateFromVehAForBrkPlsVrnt5InCllsnFwdWarnCtrl_Ca FCW_HldTiChgRateFromVehAForBrkPlsVrnt6InCllsnFwdWarnCtrl_Ca FCW_HldTiChgRateFromVehAForBrkPlsVrnt7InCllsnFwdWarnCtrl_Ca FCW_HldTiChgRateFromVehSpdForBrkPlsVrnt0InCllsnFwdWarnCtrl_Ca FCW_HldTiChgRateFromVehSpdForBrkPlsVrnt1InCllsnFwdWarnCtrl_Ca FCW_HldTiChgRateFromVehSpdForBrkPlsVrnt2InCllsnFwdWarnCtrl_Ca FCW_HldTiChgRateFromVehSpdForBrkPlsVrnt3InCllsnFwdWarnCtrl_Ca FCW_HldTiChgRateFromVehSpdForBrkPlsVrnt4InCllsnFwdWarnCtrl_Ca FCW_HldTiChgRateFromVehSpdForBrkPlsVrnt5InCllsnFwdWarnCtrl_Ca FCW_HldTiChgRateFromVehSpdForBrkPlsVrnt6InCllsnFwdWarnCtrl_Ca FCW_HldTiChgRateFromVehSpdForBrkPlsVrnt7InCllsnFwdWarnCtrl_Ca FCW_HldTiMinForBrkPlsVrnt0InCllsnFwdWarnCtrl_Ca FCW_HldTiMinForBrkPlsVrnt1InCllsnFwdWarnCtrl_Ca FCW_HldTiMinForBrkPlsVrnt2InCllsnFwdWarnCtrl_Ca FCW_HldTiMinForBrkPlsVrnt3InCllsnFwdWarnCtrl_Ca FCW_HldTiMinForBrkPlsVrnt4InCllsnFwdWarnCtrl_Ca FCW_HldTiMinForBrkPlsVrnt5InCllsnFwdWarnCtrl_Ca FCW_HldTiMinForBrkPlsVrnt6InCllsnFwdWarnCtrl_Ca FCW_HldTiMinForBrkPlsVrnt7InCllsnFwdWarnCtrl_Ca FCW_JerkDwnForBrkPlsVrnt0InCllsnFwdWarnCtrl_Ca FCW_JerkDwnForBrkPlsVrnt1InCllsnFwdWarnCtrl_Ca FCW_JerkDwnForBrkPlsVrnt2InCllsnFwdWarnCtrl_Ca FCW_JerkDwnForBrkPlsVrnt3InCllsnFwdWarnCtrl_Ca FCW_JerkDwnForBrkPlsVrnt4InCllsnFwdWarnCtrl_Ca FCW_JerkDwnForBrkPlsVrnt5InCllsnFwdWarnCtrl_Ca FCW_JerkDwnForBrkPlsVrnt6InCllsnFwdWarnCtrl_Ca FCW_JerkDwnForBrkPlsVrnt7InCllsnFwdWarnCtrl_Ca FCW_JerkUpTiForBrkPlsVrnt0InCllsnFwdWarnCtrl_Ca FCW_JerkUpTiForBrkPlsVrnt1InCllsnFwdWarnCtrl_Ca FCW_JerkUpTiForBrkPlsVrnt2InCllsnFwdWarnCtrl_Ca FCW_JerkUpTiForBrkPlsVrnt3InCllsnFwdWarnCtrl_Ca FCW_JerkUpTiForBrkPlsVrnt4InCllsnFwdWarnCtrl_Ca FCW_JerkUpTiForBrkPlsVrnt5InCllsnFwdWarnCtrl_Ca FCW_JerkUpTiForBrkPlsVrnt6InCllsnFwdWarnCtrl_Ca FCW_JerkUpTiForBrkPlsVrnt7InCllsnFwdWarnCtrl_Ca FCW_NrOfCycAtNoReqAndAForBrkPlsVrnt0InCllsnFwdWarnCtrl_Ca FCW_NrOfCycAtNoReqAndAForBrkPlsVrnt1InCllsnFwdWarnCtrl_Ca FCW_NrOfCycAtNoReqAndAForBrkPlsVrnt2InCllsnFwdWarnCtrl_Ca FCW_NrOfCycAtNoReqAndAForBrkPlsVrnt3InCllsnFwdWarnCtrl_Ca FCW_NrOfCycAtNoReqAndAForBrkPlsVrnt4InCllsnFwdWarnCtrl_Ca FCW_NrOfCycAtNoReqAndAForBrkPlsVrnt5InCllsnFwdWarnCtrl_Ca FCW_NrOfCycAtNoReqAndAForBrkPlsVrnt6InCllsnFwdWarnCtrl_Ca FCW_NrOfCycAtNoReqAndAForBrkPlsVrnt7InCllsnFwdWarnCtrl_Ca FCW_NrOfCycAtNoReqForBrkPlsVrnt0InCllsnFwdWarnCtrl_Ca FCW_NrOfCycAtNoReqForBrkPlsVrnt1InCllsnFwdWarnCtrl_Ca FCW_NrOfCycAtNoReqForBrkPlsVrnt2InCllsnFwdWarnCtrl_Ca FCW_NrOfCycAtNoReqForBrkPlsVrnt3InCllsnFwdWarnCtrl_Ca FCW_NrOfCycAtNoReqForBrkPlsVrnt4InCllsnFwdWarnCtrl_Ca FCW_NrOfCycAtNoReqForBrkPlsVrnt5InCllsnFwdWarnCtrl_Ca FCW_NrOfCycAtNoReqForBrkPlsVrnt6InCllsnFwdWarnCtrl_Ca FCW_NrOfCycAtNoReqForBrkPlsVrnt7InCllsnFwdWarnCtrl_Ca FCW_SpdInpThdVectForBrkPlsInCllsnFwdWarnCtrl_Ca /end REF_CHARACTERISTIC
/end GROUP
/begin GROUP autosar_swc_aeb_autosar_swc_aeb_Step_sys_Subsystem_Reference_AEB_Function_Run_CllsnFwdWarnCtrl_Step_Func_Run_CllsnFwdWarn_Step_FCW_WarningAndBrakeGainManager_BrakePulseWarning_BrakePulseDelayCalculation "autosar_swc_aeb/autosar_swc_aeb_Step_sys/Subsystem Reference/AEB Function/Run_CllsnFwdWarnCtrl_Step_Func/Run_CllsnFwdWarn_Step/FCW/WarningAndBrakeGainManager/BrakePulseWarning/BrakePulseDelayCalculation"
 /begin REF_CHARACTERISTIC FCW_BrkPlsDlyFromSpdInCllsnFwdWarnCtrl_Ca FCW_BrkPlsDlySrcInCllsnFwdWarnCtrl_Ca FCW_DlyForBrkPlsForLvl1OfSnvtyInCllsnFwdWarnCtrl_Ca FCW_DlyForBrkPlsForLvl2OfSnvtyInCllsnFwdWarnCtrl_Ca FCW_DlyForBrkPlsForLvl3OfSnvtyInCllsnFwdWarnCtrl_Ca FCW_SpdInpThdVectForBrkPlsDlyInCllsnFwdWarnCtrl_Ca /end REF_CHARACTERISTIC
/end GROUP
/begin GROUP autosar_swc_aeb_autosar_swc_aeb_Step_sys_Subsystem_Reference_AEB_Function_Run_CllsnFwdWarnCtrl_Step_Func_Run_CllsnFwdWarn_Step_FCW_WarningAndBrakeGainManager_BrakePulseWarning_InhibitBrakePulse "autosar_swc_aeb/autosar_swc_aeb_Step_sys/Subsystem Reference/AEB Function/Run_CllsnFwdWarnCtrl_Step_Func/Run_CllsnFwdWarn_Step/FCW/WarningAndBrakeGainManager/BrakePulseWarning/InhibitBrakePulse"
 /begin SUB_GROUP autosar_swc_aeb_autosar_swc_aeb_Step_sys_Subsystem_Reference_AEB_Function_Run_CllsnFwdWarnCtrl_Step_Func_Run_CllsnFwdWarn_Step_FCW_WarningAndBrakeGainManager_BrakePulseWarning_InhibitBrakePulse_LowPassFilterALgt /end SUB_GROUP
 /begin REF_CHARACTERISTIC FCW_ALgtMaxForBrkPlsInCllsnFwdWarnCtrl_Ca FCW_BrkPlsActvdInCllsnFwdWarnCtrl_Ca /end REF_CHARACTERISTIC
/end GROUP
/begin GROUP autosar_swc_aeb_autosar_swc_aeb_Step_sys_Subsystem_Reference_AEB_Function_Run_CllsnFwdWarnCtrl_Step_Func_Run_CllsnFwdWarn_Step_FCW_WarningAndBrakeGainManager_BrakePulseWarning_InhibitBrakePulse_LowPassFilterALgt "autosar_swc_aeb/autosar_swc_aeb_Step_sys/Subsystem Reference/AEB Function/Run_CllsnFwdWarnCtrl_Step_Func/Run_CllsnFwdWarn_Step/FCW/WarningAndBrakeGainManager/BrakePulseWarning/InhibitBrakePulse/LowPassFilterALgt"
 /begin REF_CHARACTERISTIC FCW_ALgtFiltParam1InCllsnFwdWarnCtrl_Ca FCW_ALgtFiltParam2InCllsnFwdWarnCtrl_Ca FCW_ALgtFiltParam3InCllsnFwdWarnCtrl_Ca FCW_ALgtFiltParam4InCllsnFwdWarnCtrl_Ca FCW_ALgtFiltParam5InCllsnFwdWarnCtrl_Ca /end REF_CHARACTERISTIC
/end GROUP
/begin GROUP autosar_swc_aeb_autosar_swc_aeb_Step_sys_Subsystem_Reference_AEB_Function_Run_CllsnFwdWarnCtrl_Step_Func_Run_CllsnFwdWarn_Step_ReadableSignalsToAutoSar_FCW_BrakeGainOutputHandling "autosar_swc_aeb/autosar_swc_aeb_Step_sys/Subsystem Reference/AEB Function/Run_CllsnFwdWarnCtrl_Step_Func/Run_CllsnFwdWarn_Step/ReadableSignalsToAutoSar_FCW/BrakeGainOutputHandling" /begin REF_MEASUREMENT autosar_swc_aeb_rtARID_DEF.brakeGainEnabled /end REF_MEASUREMENT /end GROUP
/begin GROUP autosar_swc_aeb_autosar_swc_aeb_Step_sys_Subsystem_Reference_AEB_Function_Run_CllsnFwdWarnCtrl_Step_Func_Run_CllsnFwdWarn_Step_ReadableSignalsToAutoSar_FCW_Rename3 "autosar_swc_aeb/autosar_swc_aeb_Step_sys/Subsystem Reference/AEB Function/Run_CllsnFwdWarnCtrl_Step_Func/Run_CllsnFwdWarn_Step/ReadableSignalsToAutoSar_FCW/Rename3" /begin REF_MEASUREMENT autosar_swc_aeb_rtARID_DEF.selectedObjectId /end REF_MEASUREMENT /end GROUP
/begin GROUP autosar_swc_aeb_autosar_swc_aeb_Step_sys_Subsystem_Reference_AEB_Function_Run_DrvrStEstimr_Step_Func_Run_DrvrStEstimr_Step_Func_DrvrStEstimrStep_Func_ActnIntdByDrvr_ActionIntendedByDriver_PathEstimator "autosar_swc_aeb/autosar_swc_aeb_Step_sys/Subsystem Reference/AEB Function/Run_DrvrStEstimr_Step_Func/Run_DrvrStEstimr_Step_Func/DrvrStEstimrStep_Func/ActnIntdByDrvr/ActionIntendedByDriver/PathEstimator" /begin REF_CHARACTERISTIC P_AEB_UseCrvtFormVme /end REF_CHARACTERISTIC /end GROUP
/begin RECORD_LAYOUT Record_BOOLEAN FNC_VALUES 1 UBYTE COLUMN_DIR DIRECT /end RECORD_LAYOUT
/begin RECORD_LAYOUT Record_FLOAT32_IEEE FNC_VALUES 1 FLOAT32_IEEE COLUMN_DIR DIRECT /end RECORD_LAYOUT
/begin RECORD_LAYOUT Record_UBYTE FNC_VALUES 1 UBYTE COLUMN_DIR DIRECT /end RECORD_LAYOUT
/begin RECORD_LAYOUT Axis_FLOAT32_IEEE AXIS_PTS_X 1 FLOAT32_IEEE INDEX_INCR DIRECT /end RECORD_LAYOUT
/begin RECORD_LAYOUT Record_BOOLEAN FNC_VALUES 1 UBYTE COLUMN_DIR DIRECT /end RECORD_LAYOUT
/begin RECORD_LAYOUT Record_FLOAT32_IEEE FNC_VALUES 1 FLOAT32_IEEE COLUMN_DIR DIRECT /end RECORD_LAYOUT
/begin RECORD_LAYOUT Record_UBYTE FNC_VALUES 1 UBYTE COLUMN_DIR DIRECT /end RECORD_LAYOUT
/begin RECORD_LAYOUT Record_BOOLEAN FNC_VALUES 1 UBYTE COLUMN_DIR DIRECT /end RECORD_LAYOUT
/begin RECORD_LAYOUT Record_FLOAT32_IEEE FNC_VALUES 1 FLOAT32_IEEE COLUMN_DIR DIRECT /end RECORD_LAYOUT
/begin RECORD_LAYOUT Record_SBYTE FNC_VALUES 1 SBYTE COLUMN_DIR DIRECT /end RECORD_LAYOUT
/begin RECORD_LAYOUT Record_UBYTE FNC_VALUES 1 UBYTE COLUMN_DIR DIRECT /end RECORD_LAYOUT
/begin RECORD_LAYOUT Axis_FLOAT32_IEEE AXIS_PTS_X 1 FLOAT32_IEEE INDEX_INCR DIRECT /end RECORD_LAYOUT
/begin RECORD_LAYOUT Record_BOOLEAN FNC_VALUES 1 UBYTE COLUMN_DIR DIRECT /end RECORD_LAYOUT
/begin RECORD_LAYOUT Record_FLOAT32_IEEE FNC_VALUES 1 FLOAT32_IEEE COLUMN_DIR DIRECT /end RECORD_LAYOUT
/begin RECORD_LAYOUT Record_SBYTE FNC_VALUES 1 SBYTE COLUMN_DIR DIRECT /end RECORD_LAYOUT
/begin RECORD_LAYOUT Record_UBYTE FNC_VALUES 1 UBYTE COLUMN_DIR DIRECT /end RECORD_LAYOUT
/begin RECORD_LAYOUT Axis_FLOAT32_IEEE AXIS_PTS_X 1 FLOAT32_IEEE INDEX_INCR DIRECT /end RECORD_LAYOUT
/begin RECORD_LAYOUT Record_BOOLEAN FNC_VALUES 1 UBYTE COLUMN_DIR DIRECT /end RECORD_LAYOUT
/begin RECORD_LAYOUT Record_FLOAT32_IEEE FNC_VALUES 1 FLOAT32_IEEE COLUMN_DIR DIRECT /end RECORD_LAYOUT
/begin RECORD_LAYOUT Record_SBYTE FNC_VALUES 1 SBYTE COLUMN_DIR DIRECT /end RECORD_LAYOUT
/begin RECORD_LAYOUT Record_UBYTE FNC_VALUES 1 UBYTE COLUMN_DIR DIRECT /end RECORD_LAYOUT
/begin RECORD_LAYOUT Axis_FLOAT32_IEEE AXIS_PTS_X 1 FLOAT32_IEEE INDEX_INCR DIRECT /end RECORD_LAYOUT
/begin RECORD_LAYOUT Record_BOOLEAN FNC_VALUES 1 UBYTE COLUMN_DIR DIRECT /end RECORD_LAYOUT
/begin RECORD_LAYOUT Record_FLOAT32_IEEE FNC_VALUES 1 FLOAT32_IEEE COLUMN_DIR DIRECT /end RECORD_LAYOUT
/begin RECORD_LAYOUT Record_SBYTE FNC_VALUES 1 SBYTE COLUMN_DIR DIRECT /end RECORD_LAYOUT
/begin RECORD_LAYOUT Record_UBYTE FNC_VALUES 1 UBYTE COLUMN_DIR DIRECT /end RECORD_LAYOUT
/begin RECORD_LAYOUT Record_BOOLEAN FNC_VALUES 1 UBYTE COLUMN_DIR DIRECT /end RECORD_LAYOUT
/begin RECORD_LAYOUT Record_FLOAT32_IEEE FNC_VALUES 1 FLOAT32_IEEE COLUMN_DIR DIRECT /end RECORD_LAYOUT
/begin RECORD_LAYOUT Record_SBYTE FNC_VALUES 1 SBYTE COLUMN_DIR DIRECT /end RECORD_LAYOUT
/begin RECORD_LAYOUT Record_UBYTE FNC_VALUES 1 UBYTE COLUMN_DIR DIRECT /end RECORD_LAYOUT
/begin RECORD_LAYOUT Axis_FLOAT32_IEEE AXIS_PTS_X 1 FLOAT32_IEEE INDEX_INCR DIRECT /end RECORD_LAYOUT
/begin RECORD_LAYOUT Record_BOOLEAN FNC_VALUES 1 UBYTE COLUMN_DIR DIRECT /end RECORD_LAYOUT
/begin RECORD_LAYOUT Record_FLOAT32_IEEE FNC_VALUES 1 FLOAT32_IEEE COLUMN_DIR DIRECT /end RECORD_LAYOUT
/begin RECORD_LAYOUT Record_SBYTE FNC_VALUES 1 SBYTE COLUMN_DIR DIRECT /end RECORD_LAYOUT
/begin RECORD_LAYOUT Record_UBYTE FNC_VALUES 1 UBYTE COLUMN_DIR DIRECT /end RECORD_LAYOUT
/begin RECORD_LAYOUT Axis_FLOAT32_IEEE AXIS_PTS_X 1 FLOAT32_IEEE INDEX_INCR DIRECT /end RECORD_LAYOUT
/begin RECORD_LAYOUT Record_BOOLEAN FNC_VALUES 1 UBYTE COLUMN_DIR DIRECT /end RECORD_LAYOUT
/begin RECORD_LAYOUT Record_FLOAT32_IEEE FNC_VALUES 1 FLOAT32_IEEE COLUMN_DIR DIRECT /end RECORD_LAYOUT
/begin RECORD_LAYOUT Record_SBYTE FNC_VALUES 1 SBYTE COLUMN_DIR DIRECT /end RECORD_LAYOUT
/begin RECORD_LAYOUT Record_UBYTE FNC_VALUES 1 UBYTE COLUMN_DIR DIRECT /end RECORD_LAYOUT
/begin RECORD_LAYOUT Axis_FLOAT32_IEEE AXIS_PTS_X 1 FLOAT32_IEEE INDEX_INCR DIRECT /end RECORD_LAYOUT
/begin RECORD_LAYOUT Record_BOOLEAN FNC_VALUES 1 UBYTE COLUMN_DIR DIRECT /end RECORD_LAYOUT
/begin RECORD_LAYOUT Record_FLOAT32_IEEE FNC_VALUES 1 FLOAT32_IEEE COLUMN_DIR DIRECT /end RECORD_LAYOUT
/begin RECORD_LAYOUT Record_SBYTE FNC_VALUES 1 SBYTE COLUMN_DIR DIRECT /end RECORD_LAYOUT
/begin RECORD_LAYOUT Record_UBYTE FNC_VALUES 1 UBYTE COLUMN_DIR DIRECT /end RECORD_LAYOUT
/begin RECORD_LAYOUT Axis_FLOAT32_IEEE AXIS_PTS_X 1 FLOAT32_IEEE INDEX_INCR DIRECT /end RECORD_LAYOUT
/end MODULE
/end PROJECT
