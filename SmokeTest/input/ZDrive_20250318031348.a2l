ASAP2_VERSION 1 71
/begin PROJECT ProjectName ""
/begin MODULE ModuleName ""
/begin MOD_COMMON "" BYTE_ORDER MSB_LAST ALIGNMENT_BYTE 1 ALIGNMENT_WORD 1 ALIGNMENT_LONG 1 ALIGNMENT_INT64 1 ALIGNMENT_FLOAT16_IEEE 1 ALIGNMENT_FLOAT32_IEEE 1 ALIGNMENT_FLOAT64_IEEE 1 /end MOD_COMMON
/begin RECORD_LAYOUT __UBYTE_S FNC_VALUES 1 UBYTE COLUMN_DIR DIRECT /end RECORD_LAYOUT
/begin CHARACTERISTIC DSE_ALatCmftByDrvrInDrvrStEstimr_Ca "The lateral accelaration that can be achieved by the driver and still be comfortable." VALUE 0xfe503f54 /* @ECU_Address@DSE_ALatCmftByDrvrInDrvrStEstimr_Ca@ */ Record_FLOAT32_IEEE 0 autosar_swc_aeb_CM_single_m_per_s_ 0.000000 11.000000 /end CHARACTERISTIC
/begin CHARACTERISTIC DSE_ALatCritByDrvrInDrvrStEstimr_Ca "The maximum lateral accelaration that can be achieved by the driver in a critical situation." VALUE 0xfe503f58 /* @ECU_Address@DSE_ALatCritByDrvrInDrvrStEstimr_Ca@ */ Record_FLOAT32_IEEE 0 autosar_swc_aeb_CM_single_m_per_s_ 0.000000 10.000000 /end CHARACTERISTIC
/begin CHARACTERISTIC DSE_ALgtPosCmftDurgBrkgInDrvrStEstimr_Ca "" VALUE 0xfe503f5c /* @ECU_Address@DSE_ALgtPosCmftDurgBrkgInDrvrStEstimr_Ca@ */ Record_FLOAT32_IEEE 0 autosar_swc_aeb_CM_single_m_per_s_ 0.000000 5.000000 /end CHARACTERISTIC
/begin CHARACTERISTIC DSE_ALgtPosCmftDurgNotBrkgInDrvrStEstimr_Ca "" VALUE 0xfe503f60 /* @ECU_Address@DSE_ALgtPosCmftDurgNotBrkgInDrvrStEstimr_Ca@ */ Record_FLOAT32_IEEE 0 autosar_swc_aeb_CM_single_m_per_s_ 0.000000 5.000000 /end CHARACTERISTIC
/begin CHARACTERISTIC DSE_ALgtPosMaxDurgBrkgInDrvrStEstimr_Ca "" VALUE 0xfe503f64 /* @ECU_Address@DSE_ALgtPosMaxDurgBrkgInDrvrStEstimr_Ca@ */ Record_FLOAT32_IEEE 0 autosar_swc_aeb_CM_single_m_per_s_ 0.000000 5.000000 /end CHARACTERISTIC
/begin CHARACTERISTIC DSE_ALgtPosMaxDurgNotBrkgInDrvrStEstimr_Ca "" VALUE 0xfe503f68 /* @ECU_Address@DSE_ALgtPosMaxDurgNotBrkgInDrvrStEstimr_Ca@ */ Record_FLOAT32_IEEE 0 autosar_swc_aeb_CM_single_m_per_s_ 0.000000 5.000000 /end CHARACTERISTIC
/begin CHARACTERISTIC DSE_ANegMaxPlausInDrvrStEstimr_Ca "" VALUE 0xfe503f6c /* @ECU_Address@DSE_ANegMaxPlausInDrvrStEstimr_Ca@ */ Record_FLOAT32_IEEE 0 autosar_swc_aeb_CM_single_m_per_s_ -10.000000 0.000000 /end CHARACTERISTIC
/begin CHARACTERISTIC DSE_BypValForCllsnAidSnvtySeldStsInDrvrStEstimr_Ca "Bypass value of Driver Sensitivity Level, 0 = No Bypass, 1 = Force Late, 2 = Force Normal, 3 = Force Early." VALUE 0xfe5041c2 /* @ECU_Address@DSE_BypValForCllsnAidSnvtySeldStsInDrvrStEstimr_Ca@ */ Record_UBYTE 0 autosar_swc_aeb_CM_uint8 0.000000 3.000000 /end CHARACTERISTIC
/begin CHARACTERISTIC DSE_CmpMaxForPredDecelInDrvrStEstimr_Ca "The predicted driver deceleration can be increased if the vehicle is on a slope  (or possible by some other effect). This value sets the minimum factor that the predicted driver deceleration can be reduced by." VALUE 0xfe503f70 /* @ECU_Address@DSE_CmpMaxForPredDecelInDrvrStEstimr_Ca@ */ Record_FLOAT32_IEEE 0 autosar_swc_aeb_CM_single 1.000000 2.000000 /end CHARACTERISTIC
/begin CHARACTERISTIC DSE_CmpMinForPredDecelInDrvrStEstimr_Ca "The predicted driver deceleration can be reduced is there is poor road friction or the vehicle is on a slope. This value sets the minimum factor that the predicted driver deceleration can be reduced by." VALUE 0xfe503f74 /* @ECU_Address@DSE_CmpMinForPredDecelInDrvrStEstimr_Ca@ */ Record_FLOAT32_IEEE 0 autosar_swc_aeb_CM_single 0.100000 1.000000 /end CHARACTERISTIC
/begin CHARACTERISTIC DSE_CrvtAbsltCmftMaxInDrvrStEstimr_Ca "The maximum allowed value of curvature for comfort maneuvers. Controls the maximum value of output \"MtnLimn.CrvtAbsltCmft\"." VALUE 0xfe503f78 /* @ECU_Address@DSE_CrvtAbsltCmftMaxInDrvrStEstimr_Ca@ */ Record_FLOAT32_IEEE 0 autosar_swc_aeb_CM_single_1_per_m 0.000000 0.200000 /end CHARACTERISTIC
/begin CHARACTERISTIC DSE_CrvtAbsltMaxInDrvrStEstimr_Ca "The maximum allowed value of curvature for critical maneuvers. Controls the maximum value of output \"MtnLimn.CrvtAbsltMax\"." VALUE 0xfe503f7c /* @ECU_Address@DSE_CrvtAbsltMaxInDrvrStEstimr_Ca@ */ Record_FLOAT32_IEEE 0 autosar_swc_aeb_CM_single_1_per_m 0.000000 0.200000 /end CHARACTERISTIC
/begin CHARACTERISTIC DSE_CrvtRateAbsltCmftMaxInDrvrStEstimr_Ca "The maximum allowed value of curvature rate for comfort maneuvers. Controls the maximum value of output \"MtnLimn.CrvtRateAbsltCmft\"." VALUE 0xfe503f80 /* @ECU_Address@DSE_CrvtRateAbsltCmftMaxInDrvrStEstimr_Ca@ */ Record_FLOAT32_IEEE 0 autosar_swc_aeb_CM_single 0.000000 0.200000 /end CHARACTERISTIC
/begin CHARACTERISTIC DSE_CrvtRateAbsltMaxInDrvrStEstimr_Ca "The maximum allowed value of curvature rate for critical maneuvers. Controls the maximum value of output \"MtnLimn.CrvtRateAbsltMax\"." VALUE 0xfe503f84 /* @ECU_Address@DSE_CrvtRateAbsltMaxInDrvrStEstimr_Ca@ */ Record_FLOAT32_IEEE 0 autosar_swc_aeb_CM_single 0.000000 0.200000 /end CHARACTERISTIC
/begin CHARACTERISTIC DSE_JerkDecFacByTrlrInDrvrStEstimr_Ca "" VALUE 0xfe503f88 /* @ECU_Address@DSE_JerkDecFacByTrlrInDrvrStEstimr_Ca@ */ Record_FLOAT32_IEEE 0 autosar_swc_aeb_CM_single 0.100000 1.000000 /end CHARACTERISTIC
/begin CHARACTERISTIC DSE_JerkDecThdDurgFricDecInDrvrStEstimr_Ca "" VALUE 0xfe503f8c /* @ECU_Address@DSE_JerkDecThdDurgFricDecInDrvrStEstimr_Ca@ */ Record_FLOAT32_IEEE 0 autosar_swc_aeb_CM_single 0.000000 1.000000 /end CHARACTERISTIC
/begin CHARACTERISTIC DSE_JerkLatCmftByDrvrInDrvrStEstimr_Ca "The lateral jerk that can be achieved by the driver and still be comfortable." VALUE 0xfe503f90 /* @ECU_Address@DSE_JerkLatCmftByDrvrInDrvrStEstimr_Ca@ */ Record_FLOAT32_IEEE 0 autosar_swc_aeb_CM_single_m_per_s_ 0.000000 11.000000 /end CHARACTERISTIC
/begin CHARACTERISTIC DSE_JerkLatCritByDrvrInDrvrStEstimr_Ca "The maximum lateral jerk that can be achieved by the driver in a critical situation." VALUE 0xfe503f94 /* @ECU_Address@DSE_JerkLatCritByDrvrInDrvrStEstimr_Ca@ */ Record_FLOAT32_IEEE 0 autosar_swc_aeb_CM_single_m_per_s_ 0.000000 10.000000 /end CHARACTERISTIC
/begin CHARACTERISTIC DSE_JerkLgtNegMinByVehInDrvrStEstimr_Ca "Maximum negative jerk that the vehicle can achieve" VALUE 0xfe503f98 /* @ECU_Address@DSE_JerkLgtNegMinByVehInDrvrStEstimr_Ca@ */ Record_FLOAT32_IEEE 0 autosar_swc_aeb_CM_single_m_per_s_ -40.000000 0.000000 /end CHARACTERISTIC
/begin CHARACTERISTIC DSE_JerkLgtPosMinByVehInDrvrStEstimr_Ca "Maximum positive jerk that the vehicle can achieve" VALUE 0xfe503f9c /* @ECU_Address@DSE_JerkLgtPosMinByVehInDrvrStEstimr_Ca@ */ Record_FLOAT32_IEEE 0 autosar_swc_aeb_CM_single_m_per_s_ 0.000000 40.000000 /end CHARACTERISTIC
/begin CHARACTERISTIC DSE_JerkNegMaxPlausInDrvrStEstimr_Ca "" VALUE 0xfe503fa0 /* @ECU_Address@DSE_JerkNegMaxPlausInDrvrStEstimr_Ca@ */ Record_FLOAT32_IEEE 0 autosar_swc_aeb_CM_single_m_per_s_ -100.000000 -5.000000 /end CHARACTERISTIC
/begin CHARACTERISTIC DSE_LenMinOfPathInDrvrStEstimr_Ca "Minimum length of all RGF path segments. If below this value we do not trust RGF." VALUE 0xfe503fa4 /* @ECU_Address@DSE_LenMinOfPathInDrvrStEstimr_Ca@ */ Record_FLOAT32_IEEE 0 autosar_swc_aeb_CM_single_m 0.000000 1500.000000 /end CHARACTERISTIC
/begin CHARACTERISTIC DSE_LimOfPredDecelDftInDrvrStEstimr_Ca "" VALUE 0xfe503fa8 /* @ECU_Address@DSE_LimOfPredDecelDftInDrvrStEstimr_Ca@ */ Record_FLOAT32_IEEE 0 autosar_swc_aeb_CM_single_m_per_s_ -10.000000 0.000000 /end CHARACTERISTIC
/begin CHARACTERISTIC DSE_LimOfPredDecelHiInDrvrStEstimr_Ca "" VALUE 0xfe503fac /* @ECU_Address@DSE_LimOfPredDecelHiInDrvrStEstimr_Ca@ */ Record_FLOAT32_IEEE 0 autosar_swc_aeb_CM_single_m_per_s_ -10.000000 0.000000 /end CHARACTERISTIC
/begin CHARACTERISTIC DSE_LimOfPredDecelLoInDrvrStEstimr_Ca "The most active driver can brake significantly. The max deceleration is approximated by a piecewise linear function." VALUE 0xfe503fb0 /* @ECU_Address@DSE_LimOfPredDecelLoInDrvrStEstimr_Ca@ */ Record_FLOAT32_IEEE 0 autosar_swc_aeb_CM_single_m_per_s_ -10.000000 0.000000 /end CHARACTERISTIC
/begin CHARACTERISTIC DSE_OffsOfPredDecelDftInDrvrStEstimr_Ca "" VALUE 0xfe503fb4 /* @ECU_Address@DSE_OffsOfPredDecelDftInDrvrStEstimr_Ca@ */ Record_FLOAT32_IEEE 0 autosar_swc_aeb_CM_single_m_per_s_ 0.000000 1.000000 /end CHARACTERISTIC
/begin CHARACTERISTIC DSE_OffsOfPredDecelHiInDrvrStEstimr_Ca "" VALUE 0xfe503fb8 /* @ECU_Address@DSE_OffsOfPredDecelHiInDrvrStEstimr_Ca@ */ Record_FLOAT32_IEEE 0 autosar_swc_aeb_CM_single_m_per_s_ 0.000000 1.000000 /end CHARACTERISTIC
/begin CHARACTERISTIC DSE_OffsOfPredDecelLoInDrvrStEstimr_Ca "The most active driver can brake significantly. The max deceleration is approximated by a piecewise linear function." VALUE 0xfe503fbc /* @ECU_Address@DSE_OffsOfPredDecelLoInDrvrStEstimr_Ca@ */ Record_FLOAT32_IEEE 0 autosar_swc_aeb_CM_single_m_per_s_ 0.000000 1.000000 /end CHARACTERISTIC
/begin CHARACTERISTIC DSE_PinionAgRateFilConInDrvrStEstimr_Ca "Filter constant in low pass filter for pinion angle rate." VALUE 0xfe503fc0 /* @ECU_Address@DSE_PinionAgRateFilConInDrvrStEstimr_Ca@ */ Record_FLOAT32_IEEE 0 autosar_swc_aeb_CM_single 0.000000 1.000000 /end CHARACTERISTIC
/begin CHARACTERISTIC DSE_PredDecelDftInCtyDrvgInDrvrStEstimr_Ca "Predicted driver deceleration in a city driving scenario for driver selected sensitivity equal to Normal. " VALUE 0xfe503fc4 /* @ECU_Address@DSE_PredDecelDftInCtyDrvgInDrvrStEstimr_Ca@ */ Record_FLOAT32_IEEE 0 autosar_swc_aeb_CM_single_m_per_s_ -10.000000 0.000000 /end CHARACTERISTIC
/begin CHARACTERISTIC DSE_PredDecelHiInCtyDrvgInDrvrStEstimr_Ca "Predicted driver deceleration in a city driving scenario for driver selected sensitivity equal to High. " VALUE 0xfe503fc8 /* @ECU_Address@DSE_PredDecelHiInCtyDrvgInDrvrStEstimr_Ca@ */ Record_FLOAT32_IEEE 0 autosar_swc_aeb_CM_single_m_per_s_ -10.000000 0.000000 /end CHARACTERISTIC
/begin CHARACTERISTIC DSE_PredDecelLoInCtyDrvgInDrvrStEstimr_Ca "Predicted driver deceleration in a city driving scenario for driver selected sensitivity equal to Low. " VALUE 0xfe503fcc /* @ECU_Address@DSE_PredDecelLoInCtyDrvgInDrvrStEstimr_Ca@ */ Record_FLOAT32_IEEE 0 autosar_swc_aeb_CM_single_m_per_s_ -10.000000 0.000000 /end CHARACTERISTIC
/begin CHARACTERISTIC DSE_SlopOfPredDecelDftInDrvrStEstimr_Ca "" VALUE 0xfe503fe4 /* @ECU_Address@DSE_SlopOfPredDecelDftInDrvrStEstimr_Ca@ */ Record_FLOAT32_IEEE 0 autosar_swc_aeb_CM_single 0.005000 0.010000 /end CHARACTERISTIC
/begin CHARACTERISTIC DSE_SlopOfPredDecelHiInDrvrStEstimr_Ca "" VALUE 0xfe503fe8 /* @ECU_Address@DSE_SlopOfPredDecelHiInDrvrStEstimr_Ca@ */ Record_FLOAT32_IEEE 0 autosar_swc_aeb_CM_single 0.005000 0.010000 /end CHARACTERISTIC
/begin CHARACTERISTIC DSE_SlopOfPredDecelLoInDrvrStEstimr_Ca "The most active driver can brake significantly. The max deceleration is approximated by a piecewise linear function." VALUE 0xfe503fec /* @ECU_Address@DSE_SlopOfPredDecelLoInDrvrStEstimr_Ca@ */ Record_FLOAT32_IEEE 0 autosar_swc_aeb_CM_single 0.005000 0.010000 /end CHARACTERISTIC
/begin CHARACTERISTIC DSE_SteerWhlAgDftCmftByDrvrInDrvrStEstimr_Ca "The comfortable steering wheel angle that the driver can achieve with Sensitivity Level set to \"Normal\"." VALUE 0xfe503ff0 /* @ECU_Address@DSE_SteerWhlAgDftCmftByDrvrInDrvrStEstimr_Ca@ */ Record_FLOAT32_IEEE 0 autosar_swc_aeb_CM_single_rad 0.000000 11.000000 /end CHARACTERISTIC
/begin CHARACTERISTIC DSE_SteerWhlAgMaxByDrvrInDrvrStEstimr_Ca "The maximum steering wheel angle that the driver can achieve." VALUE 0xfe503ff4 /* @ECU_Address@DSE_SteerWhlAgMaxByDrvrInDrvrStEstimr_Ca@ */ Record_FLOAT32_IEEE 0 autosar_swc_aeb_CM_single_rad 0.000000 11.000000 /end CHARACTERISTIC
/begin CHARACTERISTIC DSE_SteerWhlAgRateDftCmftByDrvrInDrvrStEstimr_Ca "The comfortable steering wheel angle rate that the driver can achieve with Sensitivity Level set to \"Normal\"." VALUE 0xfe503ff8 /* @ECU_Address@DSE_SteerWhlAgRateDftCmftByDrvrInDrvrStEstimr_Ca@ */ Record_FLOAT32_IEEE 0 autosar_swc_aeb_CM_single_rad_per_s 0.000000 11.000000 /end CHARACTERISTIC
/begin CHARACTERISTIC DSE_SteerWhlAgRateMaxByDrvrInDrvrStEstimr_Ca "The maximum steering wheel angle rate that the driver can achieve." VALUE 0xfe503ffc /* @ECU_Address@DSE_SteerWhlAgRateMaxByDrvrInDrvrStEstimr_Ca@ */ Record_FLOAT32_IEEE 0 autosar_swc_aeb_CM_single_rad_per_s 0.000000 11.000000 /end CHARACTERISTIC
/begin CHARACTERISTIC DSE_SteerWhlAgSpdHiThdForDrvrActvInDrvrStEstimr_Ca "High threshold for driver active" VALUE 0xfe504000 /* @ECU_Address@DSE_SteerWhlAgSpdHiThdForDrvrActvInDrvrStEstimr_Ca@ */ Record_FLOAT32_IEEE 0 autosar_swc_aeb_CM_single_rad_per_s 0.000000 5.000000 /end CHARACTERISTIC
/begin CHARACTERISTIC DSE_SteerWhlAgSpdHldTiByDrvrInDrvrStEstimr_Ca "Time used in the prediction of the drivers steering wheel angle." VALUE 0xfe504004 /* @ECU_Address@DSE_SteerWhlAgSpdHldTiByDrvrInDrvrStEstimr_Ca@ */ Record_FLOAT32_IEEE 0 autosar_swc_aeb_CM_single_s 0.000000 0.500000 /end CHARACTERISTIC
/begin CHARACTERISTIC DSE_SteerWhlAgSpdLoThdForDrvrActvInDrvrStEstimr_Ca "Low threshold for driver active" VALUE 0xfe504008 /* @ECU_Address@DSE_SteerWhlAgSpdLoThdForDrvrActvInDrvrStEstimr_Ca@ */ Record_FLOAT32_IEEE 0 autosar_swc_aeb_CM_single_rad_per_s 0.000000 5.000000 /end CHARACTERISTIC
/begin CHARACTERISTIC DSE_SteerWhlCmpFacMaxForALimnInDrvrStEstimr_Ca "" VALUE 0xfe50400c /* @ECU_Address@DSE_SteerWhlCmpFacMaxForALimnInDrvrStEstimr_Ca@ */ Record_FLOAT32_IEEE 0 autosar_swc_aeb_CM_single 1.000000 1.500000 /end CHARACTERISTIC
/begin CHARACTERISTIC DSE_SteerWhlCmpFacMinForALimnInDrvrStEstimr_Ca "" VALUE 0xfe504010 /* @ECU_Address@DSE_SteerWhlCmpFacMinForALimnInDrvrStEstimr_Ca@ */ Record_FLOAT32_IEEE 0 autosar_swc_aeb_CM_single 0.600000 1.000000 /end CHARACTERISTIC
/begin CHARACTERISTIC DSE_SteerWhlFmpFacInALimnActvInDrvrStEstimr_Ca "" VALUE 0xfe504198 /* @ECU_Address@DSE_SteerWhlFmpFacInALimnActvInDrvrStEstimr_Ca@ */ Record_BOOLEAN 0 autosar_swc_aeb_CM_logical 0 1 /end CHARACTERISTIC
/begin CHARACTERISTIC DSE_TiDlyForDrvrActvInDrvrStEstimr_Ca "Time off delay for driver active" VALUE 0xfe504014 /* @ECU_Address@DSE_TiDlyForDrvrActvInDrvrStEstimr_Ca@ */ Record_FLOAT32_IEEE 0 autosar_swc_aeb_CM_single_s 0.000000 5.000000 /end CHARACTERISTIC
/begin CHARACTERISTIC DSE_TiDlyForSteerWhlAgSpdLoForDrvrActvInDrvrStEstimr_Ca "Time until low level threshold for steer wheel speed triggers driver active" VALUE 0xfe504018 /* @ECU_Address@DSE_TiDlyForSteerWhlAgSpdLoForDrvrActvInDrvrStEstimr_Ca@ */ Record_FLOAT32_IEEE 0 autosar_swc_aeb_CM_single_s 0.000000 5.000000 /end CHARACTERISTIC
/begin CHARACTERISTIC DSE_TiForHalfRednOfMeasInDrvrStEstimr_Ca "" VALUE 0xfe50401c /* @ECU_Address@DSE_TiForHalfRednOfMeasInDrvrStEstimr_Ca@ */ Record_FLOAT32_IEEE 0 autosar_swc_aeb_CM_single_s 1.000000 100.000000 /end CHARACTERISTIC
/begin CHARACTERISTIC P_AEB_C2CSCPVehVaildVLat "" VALUE 0xfe82000c /* @ECU_Address@P_AEB_C2CSCPVehVaildVLat@ */ Record_FLOAT32_IEEE 0 autosar_swc_aeb_CM_single -3.4E+38 3.4E+38 /end CHARACTERISTIC
/begin CHARACTERISTIC P_AEB_C2SCPVaildAge "" VALUE 0xfe820010 /* @ECU_Address@P_AEB_C2SCPVaildAge@ */ Record_FLOAT32_IEEE 0 autosar_swc_aeb_CM_single -3.4E+38 3.4E+38 /end CHARACTERISTIC
/begin CHARACTERISTIC P_AEB_C2SCPVaildSpeed "" VALUE 0xfe820014 /* @ECU_Address@P_AEB_C2SCPVaildSpeed@ */ Record_FLOAT32_IEEE 0 autosar_swc_aeb_CM_single -3.4E+38 3.4E+38 /end CHARACTERISTIC
/begin CHARACTERISTIC P_AEB_CBNAOBicycleVaildVLat "" VALUE 0xfe82001c /* @ECU_Address@P_AEB_CBNAOBicycleVaildVLat@ */ Record_FLOAT32_IEEE 0 autosar_swc_aeb_CM_single -3.4E+38 3.4E+38 /end CHARACTERISTIC
/begin CHARACTERISTIC P_AEB_CBNAVaildHeadingError "" VALUE 0xfe820020 /* @ECU_Address@P_AEB_CBNAVaildHeadingError@ */ Record_FLOAT32_IEEE 0 autosar_swc_aeb_CM_single -3.4E+38 3.4E+38 /end CHARACTERISTIC
/begin CHARACTERISTIC P_AEB_CBRsCompTime "" CURVE 0xfe820118 /* @ECU_Address@P_AEB_CBRsCompTime@ */ Record_FLOAT32_IEEE 0 autosar_swc_aeb_CM_single -3.4E+38 3.4E+38
 /begin AXIS_DESCR FIX_AXIS NO_INPUT_QUANTITY autosar_swc_aeb_CM_single 9 0.000000 22.222221 FIX_AXIS_PAR_DIST 0 2.7778 9 /end AXIS_DESCR
/end CHARACTERISTIC
/begin CHARACTERISTIC P_AEB_CBRsVaildCounter "" VALUE 0xfe820024 /* @ECU_Address@P_AEB_CBRsVaildCounter@ */ Record_FLOAT32_IEEE 0 autosar_swc_aeb_CM_single -3.4E+38 3.4E+38 /end CHARACTERISTIC
/begin CHARACTERISTIC P_AEB_CBRsVaildHeading "" VALUE 0xfe820028 /* @ECU_Address@P_AEB_CBRsVaildHeading@ */ Record_FLOAT32_IEEE 0 autosar_swc_aeb_CM_single -3.4E+38 3.4E+38 /end CHARACTERISTIC
/begin CHARACTERISTIC P_AEB_CCFT20VaildR "" VALUE 0xfe82002c /* @ECU_Address@P_AEB_CCFT20VaildR@ */ Record_FLOAT32_IEEE 0 autosar_swc_aeb_CM_single -3.4E+38 3.4E+38 /end CHARACTERISTIC
/begin CHARACTERISTIC P_AEB_CCFT30VaildR "" VALUE 0xfe820030 /* @ECU_Address@P_AEB_CCFT30VaildR@ */ Record_FLOAT32_IEEE 0 autosar_swc_aeb_CM_single -3.4E+38 3.4E+38 /end CHARACTERISTIC
/begin CHARACTERISTIC P_AEB_CCFTVaildTTC "" VALUE 0xfe820034 /* @ECU_Address@P_AEB_CCFTVaildTTC@ */ Record_FLOAT32_IEEE 0 autosar_swc_aeb_CM_single -3.4E+38 3.4E+38 /end CHARACTERISTIC
/begin CHARACTERISTIC P_AEB_CCFTVaildVLat "" VALUE 0xfe820038 /* @ECU_Address@P_AEB_CCFTVaildVLat@ */ Record_FLOAT32_IEEE 0 autosar_swc_aeb_CM_single -3.4E+38 3.4E+38 /end CHARACTERISTIC
/begin CHARACTERISTIC P_AEB_CCFTVehVaildHeadingAngle "" VALUE 0xfe82003c /* @ECU_Address@P_AEB_CCFTVehVaildHeadingAngle@ */ Record_FLOAT32_IEEE 0 autosar_swc_aeb_CM_single -3.4E+38 3.4E+38 /end CHARACTERISTIC
/begin CHARACTERISTIC P_AEB_CCFTVehVaildPosnLat "" VALUE 0xfe820040 /* @ECU_Address@P_AEB_CCFTVehVaildPosnLat@ */ Record_FLOAT32_IEEE 0 autosar_swc_aeb_CM_single -3.4E+38 3.4E+38 /end CHARACTERISTIC
/begin CHARACTERISTIC P_AEB_CCFTVehVaildSpd "" VALUE 0xfe820044 /* @ECU_Address@P_AEB_CCFTVehVaildSpd@ */ Record_FLOAT32_IEEE 0 autosar_swc_aeb_CM_single -3.4E+38 3.4E+38 /end CHARACTERISTIC
/begin CHARACTERISTIC P_AEB_CCRsCompTime "" CURVE 0xfe82013c /* @ECU_Address@P_AEB_CCRsCompTime@ */ Record_FLOAT32_IEEE 0 autosar_swc_aeb_CM_single -3.4E+38 3.4E+38
 /begin AXIS_DESCR FIX_AXIS NO_INPUT_QUANTITY autosar_swc_aeb_CM_single 9 0.000000 22.222221 FIX_AXIS_PAR_DIST 0 2.7778 9 /end AXIS_DESCR
/end CHARACTERISTIC
/begin CHARACTERISTIC P_AEB_CCRsVaildCounter "" VALUE 0xfe820054 /* @ECU_Address@P_AEB_CCRsVaildCounter@ */ Record_FLOAT32_IEEE 0 autosar_swc_aeb_CM_single -3.4E+38 3.4E+38 /end CHARACTERISTIC
/begin CHARACTERISTIC P_AEB_CCRsVaildHeading "" VALUE 0xfe820058 /* @ECU_Address@P_AEB_CCRsVaildHeading@ */ Record_FLOAT32_IEEE 0 autosar_swc_aeb_CM_single -3.4E+38 3.4E+38 /end CHARACTERISTIC
/begin CHARACTERISTIC P_AEB_CPNCOPedVaildVLat "" VALUE 0xfe82005c /* @ECU_Address@P_AEB_CPNCOPedVaildVLat@ */ Record_FLOAT32_IEEE 0 autosar_swc_aeb_CM_single -3.4E+38 3.4E+38 /end CHARACTERISTIC
/begin CHARACTERISTIC P_AEB_CPRsCompTime "" CURVE 0xfe820160 /* @ECU_Address@P_AEB_CPRsCompTime@ */ Record_FLOAT32_IEEE 0 autosar_swc_aeb_CM_single -3.4E+38 3.4E+38
 /begin AXIS_DESCR FIX_AXIS NO_INPUT_QUANTITY autosar_swc_aeb_CM_single 9 0.000000 22.222221 FIX_AXIS_PAR_DIST 0 2.7778 9 /end AXIS_DESCR
/end CHARACTERISTIC
/begin CHARACTERISTIC P_AEB_CPRsVaildCounter "" VALUE 0xfe820060 /* @ECU_Address@P_AEB_CPRsVaildCounter@ */ Record_FLOAT32_IEEE 0 autosar_swc_aeb_CM_single -3.4E+38 3.4E+38 /end CHARACTERISTIC
/begin CHARACTERISTIC P_AEB_CPTA20VaildR "" VALUE 0xfe820064 /* @ECU_Address@P_AEB_CPTA20VaildR@ */ Record_FLOAT32_IEEE 0 autosar_swc_aeb_CM_single -3.4E+38 3.4E+38 /end CHARACTERISTIC
/begin CHARACTERISTIC P_AEB_CPTA30VaildR "" VALUE 0xfe820068 /* @ECU_Address@P_AEB_CPTA30VaildR@ */ Record_FLOAT32_IEEE 0 autosar_swc_aeb_CM_single -3.4E+38 3.4E+38 /end CHARACTERISTIC
/begin CHARACTERISTIC P_AEB_CPTALFVaildYawAngle "" VALUE 0xfe82006c /* @ECU_Address@P_AEB_CPTALFVaildYawAngle@ */ Record_FLOAT32_IEEE 0 autosar_swc_aeb_CM_single -3.4E+38 3.4E+38 /end CHARACTERISTIC
/begin CHARACTERISTIC P_AEB_CPTALN20PedVaildPosnLat "" VALUE 0xfe820070 /* @ECU_Address@P_AEB_CPTALN20PedVaildPosnLat@ */ Record_FLOAT32_IEEE 0 autosar_swc_aeb_CM_single -3.4E+38 3.4E+38 /end CHARACTERISTIC
/begin CHARACTERISTIC P_AEB_CPTALN30MaxPedVaildPosnLat "" VALUE 0xfe820074 /* @ECU_Address@P_AEB_CPTALN30MaxPedVaildPosnLat@ */ Record_FLOAT32_IEEE 0 autosar_swc_aeb_CM_single -3.4E+38 3.4E+38 /end CHARACTERISTIC
/begin CHARACTERISTIC P_AEB_CPTALN30MinPedVaildPosnLat "" VALUE 0xfe820078 /* @ECU_Address@P_AEB_CPTALN30MinPedVaildPosnLat@ */ Record_FLOAT32_IEEE 0 autosar_swc_aeb_CM_single -3.4E+38 3.4E+38 /end CHARACTERISTIC
/begin CHARACTERISTIC P_AEB_CPTAVaildSPEED "" VALUE 0xfe82007c /* @ECU_Address@P_AEB_CPTAVaildSPEED@ */ Record_FLOAT32_IEEE 0 autosar_swc_aeb_CM_single -3.4E+38 3.4E+38 /end CHARACTERISTIC
/begin CHARACTERISTIC P_AEB_CPTAVaildTTC "" VALUE 0xfe820080 /* @ECU_Address@P_AEB_CPTAVaildTTC@ */ Record_FLOAT32_IEEE 0 autosar_swc_aeb_CM_single -3.4E+38 3.4E+38 /end CHARACTERISTIC
/begin CHARACTERISTIC P_AEB_CSTA20VaildR "" VALUE 0xfe820084 /* @ECU_Address@P_AEB_CSTA20VaildR@ */ Record_FLOAT32_IEEE 0 autosar_swc_aeb_CM_single -3.4E+38 3.4E+38 /end CHARACTERISTIC
/begin CHARACTERISTIC P_AEB_CSTA30VaildR "" VALUE 0xfe820088 /* @ECU_Address@P_AEB_CSTA30VaildR@ */ Record_FLOAT32_IEEE 0 autosar_swc_aeb_CM_single -3.4E+38 3.4E+38 /end CHARACTERISTIC
/begin CHARACTERISTIC P_AEB_CSTALNBicycleVaildHeadingAngle "" VALUE 0xfe82008c /* @ECU_Address@P_AEB_CSTALNBicycleVaildHeadingAngle@ */ Record_FLOAT32_IEEE 0 autosar_swc_aeb_CM_single -3.4E+38 3.4E+38 /end CHARACTERISTIC
/begin CHARACTERISTIC P_AEB_CSTALNBicycleVaildPosnLat "" VALUE 0xfe820090 /* @ECU_Address@P_AEB_CSTALNBicycleVaildPosnLat@ */ Record_FLOAT32_IEEE 0 autosar_swc_aeb_CM_single -3.4E+38 3.4E+38 /end CHARACTERISTIC
/begin CHARACTERISTIC P_AEB_CSTALNBicycleVaildSpd "" VALUE 0xfe820094 /* @ECU_Address@P_AEB_CSTALNBicycleVaildSpd@ */ Record_FLOAT32_IEEE 0 autosar_swc_aeb_CM_single -3.4E+38 3.4E+38 /end CHARACTERISTIC
/begin CHARACTERISTIC P_AEB_CSTARNBicycleVaildHeadingAngle "" VALUE 0xfe820098 /* @ECU_Address@P_AEB_CSTARNBicycleVaildHeadingAngle@ */ Record_FLOAT32_IEEE 0 autosar_swc_aeb_CM_single -3.4E+38 3.4E+38 /end CHARACTERISTIC
/begin CHARACTERISTIC P_AEB_CSTARNBicycleVaildPosnLat "" VALUE 0xfe82009c /* @ECU_Address@P_AEB_CSTARNBicycleVaildPosnLat@ */ Record_FLOAT32_IEEE 0 autosar_swc_aeb_CM_single -3.4E+38 3.4E+38 /end CHARACTERISTIC
/begin CHARACTERISTIC P_AEB_CSTARNBicycleVaildSpd "" VALUE 0xfe8200a0 /* @ECU_Address@P_AEB_CSTARNBicycleVaildSpd@ */ Record_FLOAT32_IEEE 0 autosar_swc_aeb_CM_single -3.4E+38 3.4E+38 /end CHARACTERISTIC
/begin CHARACTERISTIC P_AEB_CSTAVaildTTC "" VALUE 0xfe8200a4 /* @ECU_Address@P_AEB_CSTAVaildTTC@ */ Record_FLOAT32_IEEE 0 autosar_swc_aeb_CM_single -3.4E+38 3.4E+38 /end CHARACTERISTIC
/begin CHARACTERISTIC P_AEB_CSTAVaildVLat "" VALUE 0xfe8200a8 /* @ECU_Address@P_AEB_CSTAVaildVLat@ */ Record_FLOAT32_IEEE 0 autosar_swc_aeb_CM_single -3.4E+38 3.4E+38 /end CHARACTERISTIC
/begin CHARACTERISTIC P_AEB_CrossStopSpdCyclist "" VALUE 0xfe8200ac /* @ECU_Address@P_AEB_CrossStopSpdCyclist@ */ Record_FLOAT32_IEEE 0 autosar_swc_aeb_CM_single -3.4E+38 3.4E+38 /end CHARACTERISTIC
/begin CHARACTERISTIC P_AEB_CrossStopSpdPed "" VALUE 0xfe8200b0 /* @ECU_Address@P_AEB_CrossStopSpdPed@ */ Record_FLOAT32_IEEE 0 autosar_swc_aeb_CM_single -3.4E+38 3.4E+38 /end CHARACTERISTIC
/begin CHARACTERISTIC P_AEB_CrossStopSwitch "" VALUE 0xfe8200e4 /* @ECU_Address@P_AEB_CrossStopSwitch@ */ Record_BOOLEAN 0 autosar_swc_aeb_CM_boolean 0 1 /end CHARACTERISTIC
/begin CHARACTERISTIC P_AEB_CrvtChangeVaildValue "" VALUE 0xfe8200b4 /* @ECU_Address@P_AEB_CrvtChangeVaildValue@ */ Record_FLOAT32_IEEE 0 autosar_swc_aeb_CM_single -3.4E+38 3.4E+38 /end CHARACTERISTIC
/begin CHARACTERISTIC P_AEB_FenchAndFreesPaceSwitch "" VALUE 0xfe8200e6 /* @ECU_Address@P_AEB_FenchAndFreesPaceSwitch@ */ Record_BOOLEAN 0 autosar_swc_aeb_CM_boolean 0 1 /end CHARACTERISTIC
/begin CHARACTERISTIC P_AEB_HighSpeedCompTimeSwitch "" VALUE 0xfe8200bc /* @ECU_Address@P_AEB_HighSpeedCompTimeSwitch@ */ Record_FLOAT32_IEEE 0 autosar_swc_aeb_CM_single -3.4E+38 3.4E+38 /end CHARACTERISTIC
/begin CHARACTERISTIC P_AEB_HostCrvtStableSwitch "" VALUE 0xfe8200e8 /* @ECU_Address@P_AEB_HostCrvtStableSwitch@ */ Record_UBYTE 0 autosar_swc_aeb_CM_uint8 0 255 /end CHARACTERISTIC
/begin CHARACTERISTIC P_AEB_ModifyPedMovingStateSwitch "" VALUE 0xfe8200e9 /* @ECU_Address@P_AEB_ModifyPedMovingStateSwitch@ */ Record_BOOLEAN 0 autosar_swc_aeb_CM_boolean 0 1 /end CHARACTERISTIC
/begin CHARACTERISTIC P_AEB_NotStragihtRadius "" VALUE 0xfe8200c0 /* @ECU_Address@P_AEB_NotStragihtRadius@ */ Record_FLOAT32_IEEE 0 autosar_swc_aeb_CM_single -3.4E+38 3.4E+38 /end CHARACTERISTIC
/begin CHARACTERISTIC P_AEB_PedOutSideSwitch "" VALUE 0xfe8200eb /* @ECU_Address@P_AEB_PedOutSideSwitch@ */ Record_BOOLEAN 0 autosar_swc_aeb_CM_boolean 0 1 /end CHARACTERISTIC
/begin CHARACTERISTIC P_AEB_PosnLgtComp "" VALUE 0xfe8200c4 /* @ECU_Address@P_AEB_PosnLgtComp@ */ Record_FLOAT32_IEEE 0 autosar_swc_aeb_CM_single -20.000000 20.000000 /end CHARACTERISTIC
/begin CHARACTERISTIC P_AEB_SCPVaildHeadingError "" VALUE 0xfe8200cc /* @ECU_Address@P_AEB_SCPVaildHeadingError@ */ Record_FLOAT32_IEEE 0 autosar_swc_aeb_CM_single -3.4E+38 3.4E+38 /end CHARACTERISTIC
/begin CHARACTERISTIC P_AEB_StragihtRadius "" VALUE 0xfe8200d8 /* @ECU_Address@P_AEB_StragihtRadius@ */ Record_FLOAT32_IEEE 0 autosar_swc_aeb_CM_single -3.4E+38 3.4E+38 /end CHARACTERISTIC
/begin CHARACTERISTIC P_AEB_TAPHostVaildSpd "" VALUE 0xfe8200dc /* @ECU_Address@P_AEB_TAPHostVaildSpd@ */ Record_FLOAT32_IEEE 0 autosar_swc_aeb_CM_single -3.4E+38 3.4E+38 /end CHARACTERISTIC
/begin CHARACTERISTIC P_AEB_TAPVaildPosnLat "" VALUE 0xfe8200e0 /* @ECU_Address@P_AEB_TAPVaildPosnLat@ */ Record_FLOAT32_IEEE 0 autosar_swc_aeb_CM_single -3.4E+38 3.4E+38 /end CHARACTERISTIC
/begin MEASUREMENT AEB_SafetyFunctionUpdateCnt "" UBYTE autosar_swc_aeb_CM_uint8 0 0 0 255 ECU_ADDRESS 0xfe4a4d54 /* @ECU_Address@AEB_SafetyFunctionUpdateCnt@ */ /end MEASUREMENT
/begin MEASUREMENT AEB_SceniaroAnalysisVersion "" ULONG autosar_swc_aeb_CM_uint32 0 0 0 4294967295 ECU_ADDRESS 0xfe4a4b0c /* @ECU_Address@AEB_SceniaroAnalysisVersion@ */ /end MEASUREMENT
/begin MEASUREMENT autosar_swc_aeb_rtARID_DEF.Curvature_h "" FLOAT32_IEEE autosar_swc_aeb_CM_single 0 0 -3.4E+38 3.4E+38 LAYOUT COLUMN_DIR MATRIX_DIM 4 ECU_ADDRESS 0xfe4aa590 /* @ECU_Address@autosar_swc_aeb_rtARID_DEF.Curvature_h@ */ /end MEASUREMENT
/begin MEASUREMENT autosar_swc_aeb_rtARID_DEF.DstLatConCoeff "" FLOAT32_IEEE autosar_swc_aeb_CM_single 0 0 -3.4E+38 3.4E+38 ECU_ADDRESS 0xfe4ab5ec /* @ECU_Address@autosar_swc_aeb_rtARID_DEF.DstLatConCoeff@ */ /end MEASUREMENT
/begin MEASUREMENT autosar_swc_aeb_rtARID_DEF.DstLatConCoeff_p "" FLOAT32_IEEE autosar_swc_aeb_CM_single 0 0 -3.4E+38 3.4E+38 ECU_ADDRESS 0xfe4ab62c /* @ECU_Address@autosar_swc_aeb_rtARID_DEF.DstLatConCoeff_p@ */ /end MEASUREMENT
/begin MEASUREMENT autosar_swc_aeb_rtARID_DEF.DstLatFirstCoeff "" FLOAT32_IEEE autosar_swc_aeb_CM_single 0 0 -3.4E+38 3.4E+38 ECU_ADDRESS 0xfe4ab5e8 /* @ECU_Address@autosar_swc_aeb_rtARID_DEF.DstLatFirstCoeff@ */ /end MEASUREMENT
/begin MEASUREMENT autosar_swc_aeb_rtARID_DEF.DstLatFirstCoeff_h "" FLOAT32_IEEE autosar_swc_aeb_CM_single 0 0 -3.4E+38 3.4E+38 ECU_ADDRESS 0xfe4ab630 /* @ECU_Address@autosar_swc_aeb_rtARID_DEF.DstLatFirstCoeff_h@ */ /end MEASUREMENT
/begin MEASUREMENT autosar_swc_aeb_rtARID_DEF.DstLatSecCoeff "" FLOAT32_IEEE autosar_swc_aeb_CM_single 0 0 -3.4E+38 3.4E+38 ECU_ADDRESS 0xfe4ab5e0 /* @ECU_Address@autosar_swc_aeb_rtARID_DEF.DstLatSecCoeff@ */ /end MEASUREMENT
/begin MEASUREMENT autosar_swc_aeb_rtARID_DEF.DstLatSecCoeff_f "" FLOAT32_IEEE autosar_swc_aeb_CM_single 0 0 -3.4E+38 3.4E+38 ECU_ADDRESS 0xfe4ab634 /* @ECU_Address@autosar_swc_aeb_rtARID_DEF.DstLatSecCoeff_f@ */ /end MEASUREMENT
/begin MEASUREMENT autosar_swc_aeb_rtARID_DEF.DstLatThrdCoeff "" FLOAT32_IEEE autosar_swc_aeb_CM_single 0 0 -3.4E+38 3.4E+38 ECU_ADDRESS 0xfe4ab5e4 /* @ECU_Address@autosar_swc_aeb_rtARID_DEF.DstLatThrdCoeff@ */ /end MEASUREMENT
/begin MEASUREMENT autosar_swc_aeb_rtARID_DEF.DstLatThrdCoeff_c "" FLOAT32_IEEE autosar_swc_aeb_CM_single 0 0 -3.4E+38 3.4E+38 ECU_ADDRESS 0xfe4ab638 /* @ECU_Address@autosar_swc_aeb_rtARID_DEF.DstLatThrdCoeff_c@ */ /end MEASUREMENT
/begin MEASUREMENT autosar_swc_aeb_rtARID_DEF.HeadingAngle_h "" FLOAT32_IEEE autosar_swc_aeb_CM_single 0 0 -3.4E+38 3.4E+38 LAYOUT COLUMN_DIR MATRIX_DIM 4 ECU_ADDRESS 0xfe4aa580 /* @ECU_Address@autosar_swc_aeb_rtARID_DEF.HeadingAngle_h@ */ /end MEASUREMENT
/begin MEASUREMENT autosar_swc_aeb_rtARID_DEF.LockId "" ULONG autosar_swc_aeb_CM_uint32 0 0 0 4294967295 ECU_ADDRESS 0xfe4ab9f0 /* @ECU_Address@autosar_swc_aeb_rtARID_DEF.LockId@ */ /end MEASUREMENT
/begin MEASUREMENT autosar_swc_aeb_rtARID_DEF.LockId_g "" ULONG autosar_swc_aeb_CM_uint32 0 0 0 4294967295 ECU_ADDRESS 0xfe4ab9f4 /* @ECU_Address@autosar_swc_aeb_rtARID_DEF.LockId_g@ */ /end MEASUREMENT
/begin MEASUREMENT autosar_swc_aeb_rtARID_DEF.LoggingBus.AgDirRel "" FLOAT32_IEEE autosar_swc_aeb_CM_single 0 0 -3.4E+38 3.4E+38 ECU_ADDRESS 0xfe4aa2d0 /* @ECU_Address@autosar_swc_aeb_rtARID_DEF.LoggingBus.AgDirRel@ */ /end MEASUREMENT
/begin MEASUREMENT autosar_swc_aeb_rtARID_DEF.LoggingBus.CloseEdgeDistance "" FLOAT32_IEEE autosar_swc_aeb_CM_single 0 0 -3.4E+38 3.4E+38 ECU_ADDRESS 0xfe4aa2dc /* @ECU_Address@autosar_swc_aeb_rtARID_DEF.LoggingBus.CloseEdgeDistance@ */ /end MEASUREMENT
/begin MEASUREMENT autosar_swc_aeb_rtARID_DEF.LoggingBus.FarEdgeDistance "" FLOAT32_IEEE autosar_swc_aeb_CM_single 0 0 -3.4E+38 3.4E+38 ECU_ADDRESS 0xfe4aa2e0 /* @ECU_Address@autosar_swc_aeb_rtARID_DEF.LoggingBus.FarEdgeDistance@ */ /end MEASUREMENT
/begin MEASUREMENT autosar_swc_aeb_rtARID_DEF.LoggingBus.Idn "" ULONG autosar_swc_aeb_CM_uint32 0 0 0 4294967295 ECU_ADDRESS 0xfe4aa2ec /* @ECU_Address@autosar_swc_aeb_rtARID_DEF.LoggingBus.Idn@ */ /end MEASUREMENT
/begin MEASUREMENT autosar_swc_aeb_rtARID_DEF.LoggingBus.PosnLatRel "" FLOAT32_IEEE autosar_swc_aeb_CM_single 0 0 -3.4E+38 3.4E+38 ECU_ADDRESS 0xfe4aa2d8 /* @ECU_Address@autosar_swc_aeb_rtARID_DEF.LoggingBus.PosnLatRel@ */ /end MEASUREMENT
/begin MEASUREMENT autosar_swc_aeb_rtARID_DEF.LoggingBus.PosnLgtRel "" FLOAT32_IEEE autosar_swc_aeb_CM_single 0 0 -3.4E+38 3.4E+38 ECU_ADDRESS 0xfe4aa2d4 /* @ECU_Address@autosar_swc_aeb_rtARID_DEF.LoggingBus.PosnLgtRel@ */ /end MEASUREMENT
/begin MEASUREMENT autosar_swc_aeb_rtARID_DEF.LoggingBus.TTP "" FLOAT32_IEEE autosar_swc_aeb_CM_single 0 0 -3.4E+38 3.4E+38 ECU_ADDRESS 0xfe4aa2e8 /* @ECU_Address@autosar_swc_aeb_rtARID_DEF.LoggingBus.TTP@ */ /end MEASUREMENT
/begin MEASUREMENT autosar_swc_aeb_rtARID_DEF.LoggingBus.TTR "" FLOAT32_IEEE autosar_swc_aeb_CM_single 0 0 -3.4E+38 3.4E+38 ECU_ADDRESS 0xfe4aa2e4 /* @ECU_Address@autosar_swc_aeb_rtARID_DEF.LoggingBus.TTR@ */ /end MEASUREMENT
/begin MEASUREMENT autosar_swc_aeb_rtARID_DEF.LoggingBus.VLatRel "" FLOAT32_IEEE autosar_swc_aeb_CM_single 0 0 -3.4E+38 3.4E+38 ECU_ADDRESS 0xfe4aa2f0 /* @ECU_Address@autosar_swc_aeb_rtARID_DEF.LoggingBus.VLatRel@ */ /end MEASUREMENT
/begin MEASUREMENT autosar_swc_aeb_rtARID_DEF.ObjDataPrimaryTarget.BoundingBox.CosRotation "" FLOAT32_IEEE autosar_swc_aeb_CM_single 0 0 -3.4E+38 3.4E+38 ECU_ADDRESS 0xfe4a9e68 /* @ECU_Address@autosar_swc_aeb_rtARID_DEF.ObjDataPrimaryTarget.BoundingBox.CosRotation@ */ /end MEASUREMENT
/begin MEASUREMENT autosar_swc_aeb_rtARID_DEF.ObjDataPrimaryTarget.BoundingBox.LengthSideLat "" FLOAT32_IEEE autosar_swc_aeb_CM_single 0 0 -3.4E+38 3.4E+38 ECU_ADDRESS 0xfe4a9e5c /* @ECU_Address@autosar_swc_aeb_rtARID_DEF.ObjDataPrimaryTarget.BoundingBox.LengthSideLat@ */ /end MEASUREMENT
/begin MEASUREMENT autosar_swc_aeb_rtARID_DEF.ObjDataPrimaryTarget.BoundingBox.LengthSideLgt "" FLOAT32_IEEE autosar_swc_aeb_CM_single 0 0 -3.4E+38 3.4E+38 ECU_ADDRESS 0xfe4a9e60 /* @ECU_Address@autosar_swc_aeb_rtARID_DEF.ObjDataPrimaryTarget.BoundingBox.LengthSideLgt@ */ /end MEASUREMENT
/begin MEASUREMENT autosar_swc_aeb_rtARID_DEF.ObjDataPrimaryTarget.BoundingBox.RotationAngle "" FLOAT32_IEEE autosar_swc_aeb_CM_single 0 0 -3.4E+38 3.4E+38 ECU_ADDRESS 0xfe4a9e6c /* @ECU_Address@autosar_swc_aeb_rtARID_DEF.ObjDataPrimaryTarget.BoundingBox.RotationAngle@ */ /end MEASUREMENT
/begin MEASUREMENT autosar_swc_aeb_rtARID_DEF.ObjDataPrimaryTarget.BoundingBox.SinRotation "" FLOAT32_IEEE autosar_swc_aeb_CM_single 0 0 -3.4E+38 3.4E+38 ECU_ADDRESS 0xfe4a9e64 /* @ECU_Address@autosar_swc_aeb_rtARID_DEF.ObjDataPrimaryTarget.BoundingBox.SinRotation@ */ /end MEASUREMENT
/begin MEASUREMENT autosar_swc_aeb_rtARID_DEF.ObjDataPrimaryTarget.Idn "" ULONG autosar_swc_aeb_CM_uint32 0 0 0 4294967295 ECU_ADDRESS 0xfe4a9edc /* @ECU_Address@autosar_swc_aeb_rtARID_DEF.ObjDataPrimaryTarget.Idn@ */ /end MEASUREMENT
/begin MEASUREMENT autosar_swc_aeb_rtARID_DEF.ObjDataPrimaryTarget.InPathAtCurrentPosition "" UBYTE autosar_swc_aeb_CM_logical 0 0 0 1 ECU_ADDRESS 0xfe4a9e70 /* @ECU_Address@autosar_swc_aeb_rtARID_DEF.ObjDataPrimaryTarget.InPathAtCurrentPosition@ */ /end MEASUREMENT
/begin MEASUREMENT autosar_swc_aeb_rtARID_DEF.ObjDataPrimaryTarget.LongPredTime.A "" FLOAT32_IEEE autosar_swc_aeb_CM_single 0 0 -3.4E+38 3.4E+38 ECU_ADDRESS 0xfe4a9eb4 /* @ECU_Address@autosar_swc_aeb_rtARID_DEF.ObjDataPrimaryTarget.LongPredTime.A@ */ /end MEASUREMENT
/begin MEASUREMENT autosar_swc_aeb_rtARID_DEF.ObjDataPrimaryTarget.LongPredTime.ALat "" FLOAT32_IEEE autosar_swc_aeb_CM_single 0 0 -3.4E+38 3.4E+38 ECU_ADDRESS 0xfe4a9eb0 /* @ECU_Address@autosar_swc_aeb_rtARID_DEF.ObjDataPrimaryTarget.LongPredTime.ALat@ */ /end MEASUREMENT
/begin MEASUREMENT autosar_swc_aeb_rtARID_DEF.ObjDataPrimaryTarget.LongPredTime.ALgt "" FLOAT32_IEEE autosar_swc_aeb_CM_single 0 0 -3.4E+38 3.4E+38 ECU_ADDRESS 0xfe4a9eac /* @ECU_Address@autosar_swc_aeb_rtARID_DEF.ObjDataPrimaryTarget.LongPredTime.ALgt@ */ /end MEASUREMENT
/begin MEASUREMENT autosar_swc_aeb_rtARID_DEF.ObjDataPrimaryTarget.LongPredTime.Crvt "" FLOAT32_IEEE autosar_swc_aeb_CM_single 0 0 -3.4E+38 3.4E+38 ECU_ADDRESS 0xfe4a9eb8 /* @ECU_Address@autosar_swc_aeb_rtARID_DEF.ObjDataPrimaryTarget.LongPredTime.Crvt@ */ /end MEASUREMENT
/begin MEASUREMENT autosar_swc_aeb_rtARID_DEF.ObjDataPrimaryTarget.LongPredTime.InPath "" UBYTE autosar_swc_aeb_CM_logical 0 0 0 1 ECU_ADDRESS 0xfe4a9ea9 /* @ECU_Address@autosar_swc_aeb_rtARID_DEF.ObjDataPrimaryTarget.LongPredTime.InPath@ */ /end MEASUREMENT
/begin MEASUREMENT autosar_swc_aeb_rtARID_DEF.ObjDataPrimaryTarget.LongPredTime.ObjOnCmngAndBrkg "" UBYTE autosar_swc_aeb_CM_logical 0 0 0 1 ECU_ADDRESS 0xfe4a9eaa /* @ECU_Address@autosar_swc_aeb_rtARID_DEF.ObjDataPrimaryTarget.LongPredTime.ObjOnCmngAndBrkg@ */ /end MEASUREMENT
/begin MEASUREMENT autosar_swc_aeb_rtARID_DEF.ObjDataPrimaryTarget.LongPredTime.TTMSelected "" UBYTE autosar_swc_aeb_CM_logical 0 0 0 1 ECU_ADDRESS 0xfe4a9ea8 /* @ECU_Address@autosar_swc_aeb_rtARID_DEF.ObjDataPrimaryTarget.LongPredTime.TTMSelected@ */ /end MEASUREMENT
/begin MEASUREMENT autosar_swc_aeb_rtARID_DEF.ObjDataPrimaryTarget.LongPredTime.TimeToMiddleLgt "" FLOAT32_IEEE autosar_swc_aeb_CM_single 0 0 -3.4E+38 3.4E+38 ECU_ADDRESS 0xfe4a9ea0 /* @ECU_Address@autosar_swc_aeb_rtARID_DEF.ObjDataPrimaryTarget.LongPredTime.TimeToMiddleLgt@ */ /end MEASUREMENT
/begin MEASUREMENT autosar_swc_aeb_rtARID_DEF.ObjDataPrimaryTarget.LongPredTime.TimeToPassLgt "" FLOAT32_IEEE autosar_swc_aeb_CM_single 0 0 -3.4E+38 3.4E+38 ECU_ADDRESS 0xfe4a9ea4 /* @ECU_Address@autosar_swc_aeb_rtARID_DEF.ObjDataPrimaryTarget.LongPredTime.TimeToPassLgt@ */ /end MEASUREMENT
/begin MEASUREMENT autosar_swc_aeb_rtARID_DEF.ObjDataPrimaryTarget.LongPredTime.TimeToReachLgt "" FLOAT32_IEEE autosar_swc_aeb_CM_single 0 0 -3.4E+38 3.4E+38 ECU_ADDRESS 0xfe4a9e9c /* @ECU_Address@autosar_swc_aeb_rtARID_DEF.ObjDataPrimaryTarget.LongPredTime.TimeToReachLgt@ */ /end MEASUREMENT
/begin MEASUREMENT autosar_swc_aeb_rtARID_DEF.ObjDataPrimaryTarget.MotionType.AbsHeading "" FLOAT32_IEEE autosar_swc_aeb_CM_single 0 0 -3.4E+38 3.4E+38 ECU_ADDRESS 0xfe4a9e58 /* @ECU_Address@autosar_swc_aeb_rtARID_DEF.ObjDataPrimaryTarget.MotionType.AbsHeading@ */ /end MEASUREMENT
/begin MEASUREMENT autosar_swc_aeb_rtARID_DEF.ObjDataPrimaryTarget.MotionType.CurvedMotion "" UBYTE autosar_swc_aeb_CM_logical 0 0 0 1 ECU_ADDRESS 0xfe4a9e56 /* @ECU_Address@autosar_swc_aeb_rtARID_DEF.ObjDataPrimaryTarget.MotionType.CurvedMotion@ */ /end MEASUREMENT
/begin MEASUREMENT autosar_swc_aeb_rtARID_DEF.ObjDataPrimaryTarget.MotionType.MovingOncoming "" UBYTE autosar_swc_aeb_CM_logical 0 0 0 1 ECU_ADDRESS 0xfe4a9e51 /* @ECU_Address@autosar_swc_aeb_rtARID_DEF.ObjDataPrimaryTarget.MotionType.MovingOncoming@ */ /end MEASUREMENT
/begin MEASUREMENT autosar_swc_aeb_rtARID_DEF.ObjDataPrimaryTarget.MotionType.ObjectIsMotorVehicle "Object type is Car, Truck, Motorcycle or Vehicle Of Unkown Class." UBYTE autosar_swc_aeb_CM_logical 0 0 0 1 ECU_ADDRESS 0xfe4a9e55 /* @ECU_Address@autosar_swc_aeb_rtARID_DEF.ObjDataPrimaryTarget.MotionType.ObjectIsMotorVehicle@ */ /end MEASUREMENT
/begin MEASUREMENT autosar_swc_aeb_rtARID_DEF.ObjDataPrimaryTarget.MotionType.ObjectIsVehicle "" UBYTE autosar_swc_aeb_CM_logical 0 0 0 1 ECU_ADDRESS 0xfe4a9e54 /* @ECU_Address@autosar_swc_aeb_rtARID_DEF.ObjDataPrimaryTarget.MotionType.ObjectIsVehicle@ */ /end MEASUREMENT
/begin MEASUREMENT autosar_swc_aeb_rtARID_DEF.ObjDataPrimaryTarget.MotionType.ParallellVehicleLongPred "" UBYTE autosar_swc_aeb_CM_logical 0 0 0 1 ECU_ADDRESS 0xfe4a9e52 /* @ECU_Address@autosar_swc_aeb_rtARID_DEF.ObjDataPrimaryTarget.MotionType.ParallellVehicleLongPred@ */ /end MEASUREMENT
/begin MEASUREMENT autosar_swc_aeb_rtARID_DEF.ObjDataPrimaryTarget.MotionType.ParallellVehicleShortPred "" UBYTE autosar_swc_aeb_CM_logical 0 0 0 1 ECU_ADDRESS 0xfe4a9e53 /* @ECU_Address@autosar_swc_aeb_rtARID_DEF.ObjDataPrimaryTarget.MotionType.ParallellVehicleShortPred@ */ /end MEASUREMENT
/begin MEASUREMENT autosar_swc_aeb_rtARID_DEF.ObjDataPrimaryTarget.MotionType.SideIsClosest "" UBYTE autosar_swc_aeb_CM_logical 0 0 0 1 ECU_ADDRESS 0xfe4a9e57 /* @ECU_Address@autosar_swc_aeb_rtARID_DEF.ObjDataPrimaryTarget.MotionType.SideIsClosest@ */ /end MEASUREMENT
/begin MEASUREMENT autosar_swc_aeb_rtARID_DEF.ObjDataPrimaryTarget.MotionType.Stationary "" UBYTE autosar_swc_aeb_CM_logical 0 0 0 1 ECU_ADDRESS 0xfe4a9e50 /* @ECU_Address@autosar_swc_aeb_rtARID_DEF.ObjDataPrimaryTarget.MotionType.Stationary@ */ /end MEASUREMENT
/begin MEASUREMENT autosar_swc_aeb_rtARID_DEF.ObjDataPrimaryTarget.Offsets.OffsLatInPathCloseEdge "" FLOAT32_IEEE autosar_swc_aeb_CM_single 0 0 -3.4E+38 3.4E+38 ECU_ADDRESS 0xfe4a9e8c /* @ECU_Address@autosar_swc_aeb_rtARID_DEF.ObjDataPrimaryTarget.Offsets.OffsLatInPathCloseEdge@ */ /end MEASUREMENT
/begin MEASUREMENT autosar_swc_aeb_rtARID_DEF.ObjDataPrimaryTarget.Offsets.OffsLatInPathFarEdge "" FLOAT32_IEEE autosar_swc_aeb_CM_single 0 0 -3.4E+38 3.4E+38 ECU_ADDRESS 0xfe4a9e90 /* @ECU_Address@autosar_swc_aeb_rtARID_DEF.ObjDataPrimaryTarget.Offsets.OffsLatInPathFarEdge@ */ /end MEASUREMENT
/begin MEASUREMENT autosar_swc_aeb_rtARID_DEF.ObjDataPrimaryTarget.Offsets.OffsLatInPathPrimaryTarget "" FLOAT32_IEEE autosar_swc_aeb_CM_single 0 0 -3.4E+38 3.4E+38 ECU_ADDRESS 0xfe4a9e88 /* @ECU_Address@autosar_swc_aeb_rtARID_DEF.ObjDataPrimaryTarget.Offsets.OffsLatInPathPrimaryTarget@ */ /end MEASUREMENT
/begin MEASUREMENT autosar_swc_aeb_rtARID_DEF.ObjDataPrimaryTarget.Offsets.OffsLatIntersection "" FLOAT32_IEEE autosar_swc_aeb_CM_single 0 0 -3.4E+38 3.4E+38 ECU_ADDRESS 0xfe4a9e94 /* @ECU_Address@autosar_swc_aeb_rtARID_DEF.ObjDataPrimaryTarget.Offsets.OffsLatIntersection@ */ /end MEASUREMENT
/begin MEASUREMENT autosar_swc_aeb_rtARID_DEF.ObjDataPrimaryTarget.Offsets.OffsLatLongPred "" FLOAT32_IEEE autosar_swc_aeb_CM_single 0 0 -3.4E+38 3.4E+38 ECU_ADDRESS 0xfe4a9e78 /* @ECU_Address@autosar_swc_aeb_rtARID_DEF.ObjDataPrimaryTarget.Offsets.OffsLatLongPred@ */ /end MEASUREMENT
/begin MEASUREMENT autosar_swc_aeb_rtARID_DEF.ObjDataPrimaryTarget.Offsets.OffsLatManoeuvre "" FLOAT32_IEEE autosar_swc_aeb_CM_single 0 0 -3.4E+38 3.4E+38 ECU_ADDRESS 0xfe4a9e84 /* @ECU_Address@autosar_swc_aeb_rtARID_DEF.ObjDataPrimaryTarget.Offsets.OffsLatManoeuvre@ */ /end MEASUREMENT
/begin MEASUREMENT autosar_swc_aeb_rtARID_DEF.ObjDataPrimaryTarget.Offsets.OffsLatMplTar "" FLOAT32_IEEE autosar_swc_aeb_CM_single 0 0 -3.4E+38 3.4E+38 ECU_ADDRESS 0xfe4a9e98 /* @ECU_Address@autosar_swc_aeb_rtARID_DEF.ObjDataPrimaryTarget.Offsets.OffsLatMplTar@ */ /end MEASUREMENT
/begin MEASUREMENT autosar_swc_aeb_rtARID_DEF.ObjDataPrimaryTarget.Offsets.OffsLatShortPred "" FLOAT32_IEEE autosar_swc_aeb_CM_single 0 0 -3.4E+38 3.4E+38 ECU_ADDRESS 0xfe4a9e80 /* @ECU_Address@autosar_swc_aeb_rtARID_DEF.ObjDataPrimaryTarget.Offsets.OffsLatShortPred@ */ /end MEASUREMENT
/begin MEASUREMENT autosar_swc_aeb_rtARID_DEF.ObjDataPrimaryTarget.Offsets.OffsLgtLongPred "" FLOAT32_IEEE autosar_swc_aeb_CM_single 0 0 -3.4E+38 3.4E+38 ECU_ADDRESS 0xfe4a9e74 /* @ECU_Address@autosar_swc_aeb_rtARID_DEF.ObjDataPrimaryTarget.Offsets.OffsLgtLongPred@ */ /end MEASUREMENT
/begin MEASUREMENT autosar_swc_aeb_rtARID_DEF.ObjDataPrimaryTarget.Offsets.OffsLgtShortPred "" FLOAT32_IEEE autosar_swc_aeb_CM_single 0 0 -3.4E+38 3.4E+38 ECU_ADDRESS 0xfe4a9e7c /* @ECU_Address@autosar_swc_aeb_rtARID_DEF.ObjDataPrimaryTarget.Offsets.OffsLgtShortPred@ */ /end MEASUREMENT
/begin MEASUREMENT autosar_swc_aeb_rtARID_DEF.ObjDataPrimaryTarget.PredictionValid "" UBYTE autosar_swc_aeb_CM_logical 0 0 0 1 ECU_ADDRESS 0xfe4a9e71 /* @ECU_Address@autosar_swc_aeb_rtARID_DEF.ObjDataPrimaryTarget.PredictionValid@ */ /end MEASUREMENT
/begin MEASUREMENT autosar_swc_aeb_rtARID_DEF.ObjDataPrimaryTarget.ShortPredTime.A "" FLOAT32_IEEE autosar_swc_aeb_CM_single 0 0 -3.4E+38 3.4E+38 ECU_ADDRESS 0xfe4a9ed4 /* @ECU_Address@autosar_swc_aeb_rtARID_DEF.ObjDataPrimaryTarget.ShortPredTime.A@ */ /end MEASUREMENT
/begin MEASUREMENT autosar_swc_aeb_rtARID_DEF.ObjDataPrimaryTarget.ShortPredTime.ALat "" FLOAT32_IEEE autosar_swc_aeb_CM_single 0 0 -3.4E+38 3.4E+38 ECU_ADDRESS 0xfe4a9ed0 /* @ECU_Address@autosar_swc_aeb_rtARID_DEF.ObjDataPrimaryTarget.ShortPredTime.ALat@ */ /end MEASUREMENT
/begin MEASUREMENT autosar_swc_aeb_rtARID_DEF.ObjDataPrimaryTarget.ShortPredTime.ALgt "" FLOAT32_IEEE autosar_swc_aeb_CM_single 0 0 -3.4E+38 3.4E+38 ECU_ADDRESS 0xfe4a9ecc /* @ECU_Address@autosar_swc_aeb_rtARID_DEF.ObjDataPrimaryTarget.ShortPredTime.ALgt@ */ /end MEASUREMENT
/begin MEASUREMENT autosar_swc_aeb_rtARID_DEF.ObjDataPrimaryTarget.ShortPredTime.Crvt "" FLOAT32_IEEE autosar_swc_aeb_CM_single 0 0 -3.4E+38 3.4E+38 ECU_ADDRESS 0xfe4a9ed8 /* @ECU_Address@autosar_swc_aeb_rtARID_DEF.ObjDataPrimaryTarget.ShortPredTime.Crvt@ */ /end MEASUREMENT
/begin MEASUREMENT autosar_swc_aeb_rtARID_DEF.ObjDataPrimaryTarget.ShortPredTime.InPath "" UBYTE autosar_swc_aeb_CM_logical 0 0 0 1 ECU_ADDRESS 0xfe4a9ec9 /* @ECU_Address@autosar_swc_aeb_rtARID_DEF.ObjDataPrimaryTarget.ShortPredTime.InPath@ */ /end MEASUREMENT
/begin MEASUREMENT autosar_swc_aeb_rtARID_DEF.ObjDataPrimaryTarget.ShortPredTime.ObjOnCmngAndBrkg "" UBYTE autosar_swc_aeb_CM_logical 0 0 0 1 ECU_ADDRESS 0xfe4a9eca /* @ECU_Address@autosar_swc_aeb_rtARID_DEF.ObjDataPrimaryTarget.ShortPredTime.ObjOnCmngAndBrkg@ */ /end MEASUREMENT
/begin MEASUREMENT autosar_swc_aeb_rtARID_DEF.ObjDataPrimaryTarget.ShortPredTime.TTMSelected "" UBYTE autosar_swc_aeb_CM_logical 0 0 0 1 ECU_ADDRESS 0xfe4a9ec8 /* @ECU_Address@autosar_swc_aeb_rtARID_DEF.ObjDataPrimaryTarget.ShortPredTime.TTMSelected@ */ /end MEASUREMENT
/begin MEASUREMENT autosar_swc_aeb_rtARID_DEF.ObjDataPrimaryTarget.ShortPredTime.TimeToMiddleLgt "" FLOAT32_IEEE autosar_swc_aeb_CM_single 0 0 -3.4E+38 3.4E+38 ECU_ADDRESS 0xfe4a9ec0 /* @ECU_Address@autosar_swc_aeb_rtARID_DEF.ObjDataPrimaryTarget.ShortPredTime.TimeToMiddleLgt@ */ /end MEASUREMENT
/begin MEASUREMENT autosar_swc_aeb_rtARID_DEF.ObjDataPrimaryTarget.ShortPredTime.TimeToPassLgt "" FLOAT32_IEEE autosar_swc_aeb_CM_single 0 0 -3.4E+38 3.4E+38 ECU_ADDRESS 0xfe4a9ec4 /* @ECU_Address@autosar_swc_aeb_rtARID_DEF.ObjDataPrimaryTarget.ShortPredTime.TimeToPassLgt@ */ /end MEASUREMENT
/begin MEASUREMENT autosar_swc_aeb_rtARID_DEF.ObjDataPrimaryTarget.ShortPredTime.TimeToReachLgt "" FLOAT32_IEEE autosar_swc_aeb_CM_single 0 0 -3.4E+38 3.4E+38 ECU_ADDRESS 0xfe4a9ebc /* @ECU_Address@autosar_swc_aeb_rtARID_DEF.ObjDataPrimaryTarget.ShortPredTime.TimeToReachLgt@ */ /end MEASUREMENT
/begin MEASUREMENT autosar_swc_aeb_rtARID_DEF.ObjDataPrimaryTarget_a.BoundingBox.CosRotation "" FLOAT32_IEEE autosar_swc_aeb_CM_single 0 0 -3.4E+38 3.4E+38 ECU_ADDRESS 0xfe4a9ef8 /* @ECU_Address@autosar_swc_aeb_rtARID_DEF.ObjDataPrimaryTarget_a.BoundingBox.CosRotation@ */ /end MEASUREMENT
/begin MEASUREMENT autosar_swc_aeb_rtARID_DEF.ObjDataPrimaryTarget_a.BoundingBox.LengthSideLat "" FLOAT32_IEEE autosar_swc_aeb_CM_single 0 0 -3.4E+38 3.4E+38 ECU_ADDRESS 0xfe4a9eec /* @ECU_Address@autosar_swc_aeb_rtARID_DEF.ObjDataPrimaryTarget_a.BoundingBox.LengthSideLat@ */ /end MEASUREMENT
/begin MEASUREMENT autosar_swc_aeb_rtARID_DEF.ObjDataPrimaryTarget_a.BoundingBox.LengthSideLgt "" FLOAT32_IEEE autosar_swc_aeb_CM_single 0 0 -3.4E+38 3.4E+38 ECU_ADDRESS 0xfe4a9ef0 /* @ECU_Address@autosar_swc_aeb_rtARID_DEF.ObjDataPrimaryTarget_a.BoundingBox.LengthSideLgt@ */ /end MEASUREMENT
/begin MEASUREMENT autosar_swc_aeb_rtARID_DEF.ObjDataPrimaryTarget_a.BoundingBox.RotationAngle "" FLOAT32_IEEE autosar_swc_aeb_CM_single 0 0 -3.4E+38 3.4E+38 ECU_ADDRESS 0xfe4a9efc /* @ECU_Address@autosar_swc_aeb_rtARID_DEF.ObjDataPrimaryTarget_a.BoundingBox.RotationAngle@ */ /end MEASUREMENT
/begin MEASUREMENT autosar_swc_aeb_rtARID_DEF.ObjDataPrimaryTarget_a.BoundingBox.SinRotation "" FLOAT32_IEEE autosar_swc_aeb_CM_single 0 0 -3.4E+38 3.4E+38 ECU_ADDRESS 0xfe4a9ef4 /* @ECU_Address@autosar_swc_aeb_rtARID_DEF.ObjDataPrimaryTarget_a.BoundingBox.SinRotation@ */ /end MEASUREMENT
/begin MEASUREMENT autosar_swc_aeb_rtARID_DEF.ObjDataPrimaryTarget_a.Idn "" ULONG autosar_swc_aeb_CM_uint32 0 0 0 4294967295 ECU_ADDRESS 0xfe4a9f6c /* @ECU_Address@autosar_swc_aeb_rtARID_DEF.ObjDataPrimaryTarget_a.Idn@ */ /end MEASUREMENT
/begin MEASUREMENT autosar_swc_aeb_rtARID_DEF.ObjDataPrimaryTarget_a.InPathAtCurrentPosition "" UBYTE autosar_swc_aeb_CM_logical 0 0 0 1 ECU_ADDRESS 0xfe4a9f00 /* @ECU_Address@autosar_swc_aeb_rtARID_DEF.ObjDataPrimaryTarget_a.InPathAtCurrentPosition@ */ /end MEASUREMENT
/begin MEASUREMENT autosar_swc_aeb_rtARID_DEF.ObjDataPrimaryTarget_a.LongPredTime.A "" FLOAT32_IEEE autosar_swc_aeb_CM_single 0 0 -3.4E+38 3.4E+38 ECU_ADDRESS 0xfe4a9f44 /* @ECU_Address@autosar_swc_aeb_rtARID_DEF.ObjDataPrimaryTarget_a.LongPredTime.A@ */ /end MEASUREMENT
/begin MEASUREMENT autosar_swc_aeb_rtARID_DEF.ObjDataPrimaryTarget_a.LongPredTime.ALat "" FLOAT32_IEEE autosar_swc_aeb_CM_single 0 0 -3.4E+38 3.4E+38 ECU_ADDRESS 0xfe4a9f40 /* @ECU_Address@autosar_swc_aeb_rtARID_DEF.ObjDataPrimaryTarget_a.LongPredTime.ALat@ */ /end MEASUREMENT
/begin MEASUREMENT autosar_swc_aeb_rtARID_DEF.ObjDataPrimaryTarget_a.LongPredTime.ALgt "" FLOAT32_IEEE autosar_swc_aeb_CM_single 0 0 -3.4E+38 3.4E+38 ECU_ADDRESS 0xfe4a9f3c /* @ECU_Address@autosar_swc_aeb_rtARID_DEF.ObjDataPrimaryTarget_a.LongPredTime.ALgt@ */ /end MEASUREMENT
/begin MEASUREMENT autosar_swc_aeb_rtARID_DEF.ObjDataPrimaryTarget_a.LongPredTime.Crvt "" FLOAT32_IEEE autosar_swc_aeb_CM_single 0 0 -3.4E+38 3.4E+38 ECU_ADDRESS 0xfe4a9f48 /* @ECU_Address@autosar_swc_aeb_rtARID_DEF.ObjDataPrimaryTarget_a.LongPredTime.Crvt@ */ /end MEASUREMENT
/begin MEASUREMENT autosar_swc_aeb_rtARID_DEF.ObjDataPrimaryTarget_a.LongPredTime.InPath "" UBYTE autosar_swc_aeb_CM_logical 0 0 0 1 ECU_ADDRESS 0xfe4a9f39 /* @ECU_Address@autosar_swc_aeb_rtARID_DEF.ObjDataPrimaryTarget_a.LongPredTime.InPath@ */ /end MEASUREMENT
/begin MEASUREMENT autosar_swc_aeb_rtARID_DEF.ObjDataPrimaryTarget_a.LongPredTime.ObjOnCmngAndBrkg "" UBYTE autosar_swc_aeb_CM_logical 0 0 0 1 ECU_ADDRESS 0xfe4a9f3a /* @ECU_Address@autosar_swc_aeb_rtARID_DEF.ObjDataPrimaryTarget_a.LongPredTime.ObjOnCmngAndBrkg@ */ /end MEASUREMENT
/begin MEASUREMENT autosar_swc_aeb_rtARID_DEF.ObjDataPrimaryTarget_a.LongPredTime.TTMSelected "" UBYTE autosar_swc_aeb_CM_logical 0 0 0 1 ECU_ADDRESS 0xfe4a9f38 /* @ECU_Address@autosar_swc_aeb_rtARID_DEF.ObjDataPrimaryTarget_a.LongPredTime.TTMSelected@ */ /end MEASUREMENT
/begin MEASUREMENT autosar_swc_aeb_rtARID_DEF.ObjDataPrimaryTarget_a.LongPredTime.TimeToMiddleLgt "" FLOAT32_IEEE autosar_swc_aeb_CM_single 0 0 -3.4E+38 3.4E+38 ECU_ADDRESS 0xfe4a9f30 /* @ECU_Address@autosar_swc_aeb_rtARID_DEF.ObjDataPrimaryTarget_a.LongPredTime.TimeToMiddleLgt@ */ /end MEASUREMENT
/begin MEASUREMENT autosar_swc_aeb_rtARID_DEF.ObjDataPrimaryTarget_a.LongPredTime.TimeToPassLgt "" FLOAT32_IEEE autosar_swc_aeb_CM_single 0 0 -3.4E+38 3.4E+38 ECU_ADDRESS 0xfe4a9f34 /* @ECU_Address@autosar_swc_aeb_rtARID_DEF.ObjDataPrimaryTarget_a.LongPredTime.TimeToPassLgt@ */ /end MEASUREMENT
/begin MEASUREMENT autosar_swc_aeb_rtARID_DEF.ObjDataPrimaryTarget_a.LongPredTime.TimeToReachLgt "" FLOAT32_IEEE autosar_swc_aeb_CM_single 0 0 -3.4E+38 3.4E+38 ECU_ADDRESS 0xfe4a9f2c /* @ECU_Address@autosar_swc_aeb_rtARID_DEF.ObjDataPrimaryTarget_a.LongPredTime.TimeToReachLgt@ */ /end MEASUREMENT
/begin MEASUREMENT autosar_swc_aeb_rtARID_DEF.ObjDataPrimaryTarget_a.MotionType.AbsHeading "" FLOAT32_IEEE autosar_swc_aeb_CM_single 0 0 -3.4E+38 3.4E+38 ECU_ADDRESS 0xfe4a9ee8 /* @ECU_Address@autosar_swc_aeb_rtARID_DEF.ObjDataPrimaryTarget_a.MotionType.AbsHeading@ */ /end MEASUREMENT
/begin MEASUREMENT autosar_swc_aeb_rtARID_DEF.ObjDataPrimaryTarget_a.MotionType.CurvedMotion "" UBYTE autosar_swc_aeb_CM_logical 0 0 0 1 ECU_ADDRESS 0xfe4a9ee6 /* @ECU_Address@autosar_swc_aeb_rtARID_DEF.ObjDataPrimaryTarget_a.MotionType.CurvedMotion@ */ /end MEASUREMENT
/begin MEASUREMENT autosar_swc_aeb_rtARID_DEF.ObjDataPrimaryTarget_a.MotionType.MovingOncoming "" UBYTE autosar_swc_aeb_CM_logical 0 0 0 1 ECU_ADDRESS 0xfe4a9ee1 /* @ECU_Address@autosar_swc_aeb_rtARID_DEF.ObjDataPrimaryTarget_a.MotionType.MovingOncoming@ */ /end MEASUREMENT
/begin MEASUREMENT autosar_swc_aeb_rtARID_DEF.ObjDataPrimaryTarget_a.MotionType.ObjectIsMotorVehicle "Object type is Car, Truck, Motorcycle or Vehicle Of Unkown Class." UBYTE autosar_swc_aeb_CM_logical 0 0 0 1 ECU_ADDRESS 0xfe4a9ee5 /* @ECU_Address@autosar_swc_aeb_rtARID_DEF.ObjDataPrimaryTarget_a.MotionType.ObjectIsMotorVehicle@ */ /end MEASUREMENT
/begin MEASUREMENT autosar_swc_aeb_rtARID_DEF.ObjDataPrimaryTarget_a.MotionType.ObjectIsVehicle "" UBYTE autosar_swc_aeb_CM_logical 0 0 0 1 ECU_ADDRESS 0xfe4a9ee4 /* @ECU_Address@autosar_swc_aeb_rtARID_DEF.ObjDataPrimaryTarget_a.MotionType.ObjectIsVehicle@ */ /end MEASUREMENT
/begin MEASUREMENT autosar_swc_aeb_rtARID_DEF.ObjDataPrimaryTarget_a.MotionType.ParallellVehicleLongPred "" UBYTE autosar_swc_aeb_CM_logical 0 0 0 1 ECU_ADDRESS 0xfe4a9ee2 /* @ECU_Address@autosar_swc_aeb_rtARID_DEF.ObjDataPrimaryTarget_a.MotionType.ParallellVehicleLongPred@ */ /end MEASUREMENT
/begin MEASUREMENT autosar_swc_aeb_rtARID_DEF.ObjDataPrimaryTarget_a.MotionType.ParallellVehicleShortPred "" UBYTE autosar_swc_aeb_CM_logical 0 0 0 1 ECU_ADDRESS 0xfe4a9ee3 /* @ECU_Address@autosar_swc_aeb_rtARID_DEF.ObjDataPrimaryTarget_a.MotionType.ParallellVehicleShortPred@ */ /end MEASUREMENT
/begin MEASUREMENT autosar_swc_aeb_rtARID_DEF.ObjDataPrimaryTarget_a.MotionType.SideIsClosest "" UBYTE autosar_swc_aeb_CM_logical 0 0 0 1 ECU_ADDRESS 0xfe4a9ee7 /* @ECU_Address@autosar_swc_aeb_rtARID_DEF.ObjDataPrimaryTarget_a.MotionType.SideIsClosest@ */ /end MEASUREMENT
/begin MEASUREMENT autosar_swc_aeb_rtARID_DEF.ObjDataPrimaryTarget_a.MotionType.Stationary "" UBYTE autosar_swc_aeb_CM_logical 0 0 0 1 ECU_ADDRESS 0xfe4a9ee0 /* @ECU_Address@autosar_swc_aeb_rtARID_DEF.ObjDataPrimaryTarget_a.MotionType.Stationary@ */ /end MEASUREMENT
/begin MEASUREMENT autosar_swc_aeb_rtARID_DEF.ObjDataPrimaryTarget_a.Offsets.OffsLatInPathCloseEdge "" FLOAT32_IEEE autosar_swc_aeb_CM_single 0 0 -3.4E+38 3.4E+38 ECU_ADDRESS 0xfe4a9f1c /* @ECU_Address@autosar_swc_aeb_rtARID_DEF.ObjDataPrimaryTarget_a.Offsets.OffsLatInPathCloseEdge@ */ /end MEASUREMENT
/begin MEASUREMENT autosar_swc_aeb_rtARID_DEF.ObjDataPrimaryTarget_a.Offsets.OffsLatInPathFarEdge "" FLOAT32_IEEE autosar_swc_aeb_CM_single 0 0 -3.4E+38 3.4E+38 ECU_ADDRESS 0xfe4a9f20 /* @ECU_Address@autosar_swc_aeb_rtARID_DEF.ObjDataPrimaryTarget_a.Offsets.OffsLatInPathFarEdge@ */ /end MEASUREMENT
/begin MEASUREMENT autosar_swc_aeb_rtARID_DEF.ObjDataPrimaryTarget_a.Offsets.OffsLatInPathPrimaryTarget "" FLOAT32_IEEE autosar_swc_aeb_CM_single 0 0 -3.4E+38 3.4E+38 ECU_ADDRESS 0xfe4a9f18 /* @ECU_Address@autosar_swc_aeb_rtARID_DEF.ObjDataPrimaryTarget_a.Offsets.OffsLatInPathPrimaryTarget@ */ /end MEASUREMENT
/begin MEASUREMENT autosar_swc_aeb_rtARID_DEF.ObjDataPrimaryTarget_a.Offsets.OffsLatIntersection "" FLOAT32_IEEE autosar_swc_aeb_CM_single 0 0 -3.4E+38 3.4E+38 ECU_ADDRESS 0xfe4a9f24 /* @ECU_Address@autosar_swc_aeb_rtARID_DEF.ObjDataPrimaryTarget_a.Offsets.OffsLatIntersection@ */ /end MEASUREMENT
/begin MEASUREMENT autosar_swc_aeb_rtARID_DEF.ObjDataPrimaryTarget_a.Offsets.OffsLatLongPred "" FLOAT32_IEEE autosar_swc_aeb_CM_single 0 0 -3.4E+38 3.4E+38 ECU_ADDRESS 0xfe4a9f08 /* @ECU_Address@autosar_swc_aeb_rtARID_DEF.ObjDataPrimaryTarget_a.Offsets.OffsLatLongPred@ */ /end MEASUREMENT
/begin MEASUREMENT autosar_swc_aeb_rtARID_DEF.ObjDataPrimaryTarget_a.Offsets.OffsLatManoeuvre "" FLOAT32_IEEE autosar_swc_aeb_CM_single 0 0 -3.4E+38 3.4E+38 ECU_ADDRESS 0xfe4a9f14 /* @ECU_Address@autosar_swc_aeb_rtARID_DEF.ObjDataPrimaryTarget_a.Offsets.OffsLatManoeuvre@ */ /end MEASUREMENT
/begin MEASUREMENT autosar_swc_aeb_rtARID_DEF.ObjDataPrimaryTarget_a.Offsets.OffsLatMplTar "" FLOAT32_IEEE autosar_swc_aeb_CM_single 0 0 -3.4E+38 3.4E+38 ECU_ADDRESS 0xfe4a9f28 /* @ECU_Address@autosar_swc_aeb_rtARID_DEF.ObjDataPrimaryTarget_a.Offsets.OffsLatMplTar@ */ /end MEASUREMENT
/begin MEASUREMENT autosar_swc_aeb_rtARID_DEF.ObjDataPrimaryTarget_a.Offsets.OffsLatShortPred "" FLOAT32_IEEE autosar_swc_aeb_CM_single 0 0 -3.4E+38 3.4E+38 ECU_ADDRESS 0xfe4a9f10 /* @ECU_Address@autosar_swc_aeb_rtARID_DEF.ObjDataPrimaryTarget_a.Offsets.OffsLatShortPred@ */ /end MEASUREMENT
/begin MEASUREMENT autosar_swc_aeb_rtARID_DEF.ObjDataPrimaryTarget_a.Offsets.OffsLgtLongPred "" FLOAT32_IEEE autosar_swc_aeb_CM_single 0 0 -3.4E+38 3.4E+38 ECU_ADDRESS 0xfe4a9f04 /* @ECU_Address@autosar_swc_aeb_rtARID_DEF.ObjDataPrimaryTarget_a.Offsets.OffsLgtLongPred@ */ /end MEASUREMENT
/begin MEASUREMENT autosar_swc_aeb_rtARID_DEF.ObjDataPrimaryTarget_a.Offsets.OffsLgtShortPred "" FLOAT32_IEEE autosar_swc_aeb_CM_single 0 0 -3.4E+38 3.4E+38 ECU_ADDRESS 0xfe4a9f0c /* @ECU_Address@autosar_swc_aeb_rtARID_DEF.ObjDataPrimaryTarget_a.Offsets.OffsLgtShortPred@ */ /end MEASUREMENT
/begin MEASUREMENT autosar_swc_aeb_rtARID_DEF.ObjDataPrimaryTarget_a.PredictionValid "" UBYTE autosar_swc_aeb_CM_logical 0 0 0 1 ECU_ADDRESS 0xfe4a9f01 /* @ECU_Address@autosar_swc_aeb_rtARID_DEF.ObjDataPrimaryTarget_a.PredictionValid@ */ /end MEASUREMENT
/begin MEASUREMENT autosar_swc_aeb_rtARID_DEF.ObjDataPrimaryTarget_a.ShortPredTime.A "" FLOAT32_IEEE autosar_swc_aeb_CM_single 0 0 -3.4E+38 3.4E+38 ECU_ADDRESS 0xfe4a9f64 /* @ECU_Address@autosar_swc_aeb_rtARID_DEF.ObjDataPrimaryTarget_a.ShortPredTime.A@ */ /end MEASUREMENT
/begin MEASUREMENT autosar_swc_aeb_rtARID_DEF.ObjDataPrimaryTarget_a.ShortPredTime.ALat "" FLOAT32_IEEE autosar_swc_aeb_CM_single 0 0 -3.4E+38 3.4E+38 ECU_ADDRESS 0xfe4a9f60 /* @ECU_Address@autosar_swc_aeb_rtARID_DEF.ObjDataPrimaryTarget_a.ShortPredTime.ALat@ */ /end MEASUREMENT
/begin MEASUREMENT autosar_swc_aeb_rtARID_DEF.ObjDataPrimaryTarget_a.ShortPredTime.ALgt "" FLOAT32_IEEE autosar_swc_aeb_CM_single 0 0 -3.4E+38 3.4E+38 ECU_ADDRESS 0xfe4a9f5c /* @ECU_Address@autosar_swc_aeb_rtARID_DEF.ObjDataPrimaryTarget_a.ShortPredTime.ALgt@ */ /end MEASUREMENT
/begin MEASUREMENT autosar_swc_aeb_rtARID_DEF.ObjDataPrimaryTarget_a.ShortPredTime.Crvt "" FLOAT32_IEEE autosar_swc_aeb_CM_single 0 0 -3.4E+38 3.4E+38 ECU_ADDRESS 0xfe4a9f68 /* @ECU_Address@autosar_swc_aeb_rtARID_DEF.ObjDataPrimaryTarget_a.ShortPredTime.Crvt@ */ /end MEASUREMENT
/begin MEASUREMENT autosar_swc_aeb_rtARID_DEF.ObjDataPrimaryTarget_a.ShortPredTime.InPath "" UBYTE autosar_swc_aeb_CM_logical 0 0 0 1 ECU_ADDRESS 0xfe4a9f59 /* @ECU_Address@autosar_swc_aeb_rtARID_DEF.ObjDataPrimaryTarget_a.ShortPredTime.InPath@ */ /end MEASUREMENT
/begin MEASUREMENT autosar_swc_aeb_rtARID_DEF.ObjDataPrimaryTarget_a.ShortPredTime.ObjOnCmngAndBrkg "" UBYTE autosar_swc_aeb_CM_logical 0 0 0 1 ECU_ADDRESS 0xfe4a9f5a /* @ECU_Address@autosar_swc_aeb_rtARID_DEF.ObjDataPrimaryTarget_a.ShortPredTime.ObjOnCmngAndBrkg@ */ /end MEASUREMENT
/begin MEASUREMENT autosar_swc_aeb_rtARID_DEF.ObjDataPrimaryTarget_a.ShortPredTime.TTMSelected "" UBYTE autosar_swc_aeb_CM_logical 0 0 0 1 ECU_ADDRESS 0xfe4a9f58 /* @ECU_Address@autosar_swc_aeb_rtARID_DEF.ObjDataPrimaryTarget_a.ShortPredTime.TTMSelected@ */ /end MEASUREMENT
/begin MEASUREMENT autosar_swc_aeb_rtARID_DEF.ObjDataPrimaryTarget_a.ShortPredTime.TimeToMiddleLgt "" FLOAT32_IEEE autosar_swc_aeb_CM_single 0 0 -3.4E+38 3.4E+38 ECU_ADDRESS 0xfe4a9f50 /* @ECU_Address@autosar_swc_aeb_rtARID_DEF.ObjDataPrimaryTarget_a.ShortPredTime.TimeToMiddleLgt@ */ /end MEASUREMENT
/begin MEASUREMENT autosar_swc_aeb_rtARID_DEF.ObjDataPrimaryTarget_a.ShortPredTime.TimeToPassLgt "" FLOAT32_IEEE autosar_swc_aeb_CM_single 0 0 -3.4E+38 3.4E+38 ECU_ADDRESS 0xfe4a9f54 /* @ECU_Address@autosar_swc_aeb_rtARID_DEF.ObjDataPrimaryTarget_a.ShortPredTime.TimeToPassLgt@ */ /end MEASUREMENT
/begin MEASUREMENT autosar_swc_aeb_rtARID_DEF.ObjDataPrimaryTarget_a.ShortPredTime.TimeToReachLgt "" FLOAT32_IEEE autosar_swc_aeb_CM_single 0 0 -3.4E+38 3.4E+38 ECU_ADDRESS 0xfe4a9f4c /* @ECU_Address@autosar_swc_aeb_rtARID_DEF.ObjDataPrimaryTarget_a.ShortPredTime.TimeToReachLgt@ */ /end MEASUREMENT
/begin MEASUREMENT autosar_swc_aeb_rtARID_DEF.ObjData_i[0].BoundingBox.CosRotation "" FLOAT32_IEEE autosar_swc_aeb_CM_single 0 0 -3.4E+38 3.4E+38 ECU_ADDRESS 0xfe4a5078 /* @ECU_Address@autosar_swc_aeb_rtARID_DEF.ObjData_i[0].BoundingBox.CosRotation@ */ /end MEASUREMENT
/begin MEASUREMENT autosar_swc_aeb_rtARID_DEF.ObjData_i[0].BoundingBox.LengthSideLat "" FLOAT32_IEEE autosar_swc_aeb_CM_single 0 0 -3.4E+38 3.4E+38 ECU_ADDRESS 0xfe4a506c /* @ECU_Address@autosar_swc_aeb_rtARID_DEF.ObjData_i[0].BoundingBox.LengthSideLat@ */ /end MEASUREMENT
/begin MEASUREMENT autosar_swc_aeb_rtARID_DEF.ObjData_i[0].BoundingBox.LengthSideLgt "" FLOAT32_IEEE autosar_swc_aeb_CM_single 0 0 -3.4E+38 3.4E+38 ECU_ADDRESS 0xfe4a5070 /* @ECU_Address@autosar_swc_aeb_rtARID_DEF.ObjData_i[0].BoundingBox.LengthSideLgt@ */ /end MEASUREMENT
/begin MEASUREMENT autosar_swc_aeb_rtARID_DEF.ObjData_i[0].BoundingBox.RotationAngle "" FLOAT32_IEEE autosar_swc_aeb_CM_single 0 0 -3.4E+38 3.4E+38 ECU_ADDRESS 0xfe4a507c /* @ECU_Address@autosar_swc_aeb_rtARID_DEF.ObjData_i[0].BoundingBox.RotationAngle@ */ /end MEASUREMENT
/begin MEASUREMENT autosar_swc_aeb_rtARID_DEF.ObjData_i[0].BoundingBox.SinRotation "" FLOAT32_IEEE autosar_swc_aeb_CM_single 0 0 -3.4E+38 3.4E+38 ECU_ADDRESS 0xfe4a5074 /* @ECU_Address@autosar_swc_aeb_rtARID_DEF.ObjData_i[0].BoundingBox.SinRotation@ */ /end MEASUREMENT
/begin MEASUREMENT autosar_swc_aeb_rtARID_DEF.ObjData_i[0].Idn "" ULONG autosar_swc_aeb_CM_uint32 0 0 0 4294967295 ECU_ADDRESS 0xfe4a50ec /* @ECU_Address@autosar_swc_aeb_rtARID_DEF.ObjData_i[0].Idn@ */ /end MEASUREMENT
/begin MEASUREMENT autosar_swc_aeb_rtARID_DEF.ObjData_i[0].InPathAtCurrentPosition "" UBYTE autosar_swc_aeb_CM_logical 0 0 0 1 ECU_ADDRESS 0xfe4a5080 /* @ECU_Address@autosar_swc_aeb_rtARID_DEF.ObjData_i[0].InPathAtCurrentPosition@ */ /end MEASUREMENT
/begin MEASUREMENT autosar_swc_aeb_rtARID_DEF.ObjData_i[0].LongPredTime.A "" FLOAT32_IEEE autosar_swc_aeb_CM_single 0 0 -3.4E+38 3.4E+38 ECU_ADDRESS 0xfe4a50c4 /* @ECU_Address@autosar_swc_aeb_rtARID_DEF.ObjData_i[0].LongPredTime.A@ */ /end MEASUREMENT
/begin MEASUREMENT autosar_swc_aeb_rtARID_DEF.ObjData_i[0].LongPredTime.ALat "" FLOAT32_IEEE autosar_swc_aeb_CM_single 0 0 -3.4E+38 3.4E+38 ECU_ADDRESS 0xfe4a50c0 /* @ECU_Address@autosar_swc_aeb_rtARID_DEF.ObjData_i[0].LongPredTime.ALat@ */ /end MEASUREMENT
/begin MEASUREMENT autosar_swc_aeb_rtARID_DEF.ObjData_i[0].LongPredTime.ALgt "" FLOAT32_IEEE autosar_swc_aeb_CM_single 0 0 -3.4E+38 3.4E+38 ECU_ADDRESS 0xfe4a50bc /* @ECU_Address@autosar_swc_aeb_rtARID_DEF.ObjData_i[0].LongPredTime.ALgt@ */ /end MEASUREMENT
/begin MEASUREMENT autosar_swc_aeb_rtARID_DEF.ObjData_i[0].LongPredTime.Crvt "" FLOAT32_IEEE autosar_swc_aeb_CM_single 0 0 -3.4E+38 3.4E+38 ECU_ADDRESS 0xfe4a50c8 /* @ECU_Address@autosar_swc_aeb_rtARID_DEF.ObjData_i[0].LongPredTime.Crvt@ */ /end MEASUREMENT
/begin MEASUREMENT autosar_swc_aeb_rtARID_DEF.ObjData_i[0].LongPredTime.InPath "" UBYTE autosar_swc_aeb_CM_logical 0 0 0 1 ECU_ADDRESS 0xfe4a50b9 /* @ECU_Address@autosar_swc_aeb_rtARID_DEF.ObjData_i[0].LongPredTime.InPath@ */ /end MEASUREMENT
/begin MEASUREMENT autosar_swc_aeb_rtARID_DEF.ObjData_i[0].LongPredTime.ObjOnCmngAndBrkg "" UBYTE autosar_swc_aeb_CM_logical 0 0 0 1 ECU_ADDRESS 0xfe4a50ba /* @ECU_Address@autosar_swc_aeb_rtARID_DEF.ObjData_i[0].LongPredTime.ObjOnCmngAndBrkg@ */ /end MEASUREMENT
/begin MEASUREMENT autosar_swc_aeb_rtARID_DEF.ObjData_i[0].LongPredTime.TTMSelected "" UBYTE autosar_swc_aeb_CM_logical 0 0 0 1 ECU_ADDRESS 0xfe4a50b8 /* @ECU_Address@autosar_swc_aeb_rtARID_DEF.ObjData_i[0].LongPredTime.TTMSelected@ */ /end MEASUREMENT
/begin MEASUREMENT autosar_swc_aeb_rtARID_DEF.ObjData_i[0].LongPredTime.TimeToMiddleLgt "" FLOAT32_IEEE autosar_swc_aeb_CM_single 0 0 -3.4E+38 3.4E+38 ECU_ADDRESS 0xfe4a50b0 /* @ECU_Address@autosar_swc_aeb_rtARID_DEF.ObjData_i[0].LongPredTime.TimeToMiddleLgt@ */ /end MEASUREMENT
/begin MEASUREMENT autosar_swc_aeb_rtARID_DEF.ObjData_i[0].LongPredTime.TimeToPassLgt "" FLOAT32_IEEE autosar_swc_aeb_CM_single 0 0 -3.4E+38 3.4E+38 ECU_ADDRESS 0xfe4a50b4 /* @ECU_Address@autosar_swc_aeb_rtARID_DEF.ObjData_i[0].LongPredTime.TimeToPassLgt@ */ /end MEASUREMENT
/begin MEASUREMENT autosar_swc_aeb_rtARID_DEF.ObjData_i[0].LongPredTime.TimeToReachLgt "" FLOAT32_IEEE autosar_swc_aeb_CM_single 0 0 -3.4E+38 3.4E+38 ECU_ADDRESS 0xfe4a50ac /* @ECU_Address@autosar_swc_aeb_rtARID_DEF.ObjData_i[0].LongPredTime.TimeToReachLgt@ */ /end MEASUREMENT
/begin MEASUREMENT autosar_swc_aeb_rtARID_DEF.ObjData_i[0].MotionType.AbsHeading "" FLOAT32_IEEE autosar_swc_aeb_CM_single 0 0 -3.4E+38 3.4E+38 ECU_ADDRESS 0xfe4a5068 /* @ECU_Address@autosar_swc_aeb_rtARID_DEF.ObjData_i[0].MotionType.AbsHeading@ */ /end MEASUREMENT
/begin MEASUREMENT autosar_swc_aeb_rtARID_DEF.ObjData_i[0].MotionType.CurvedMotion "" UBYTE autosar_swc_aeb_CM_logical 0 0 0 1 ECU_ADDRESS 0xfe4a5066 /* @ECU_Address@autosar_swc_aeb_rtARID_DEF.ObjData_i[0].MotionType.CurvedMotion@ */ /end MEASUREMENT
/begin MEASUREMENT autosar_swc_aeb_rtARID_DEF.ObjData_i[0].MotionType.MovingOncoming "" UBYTE autosar_swc_aeb_CM_logical 0 0 0 1 ECU_ADDRESS 0xfe4a5061 /* @ECU_Address@autosar_swc_aeb_rtARID_DEF.ObjData_i[0].MotionType.MovingOncoming@ */ /end MEASUREMENT
/begin MEASUREMENT autosar_swc_aeb_rtARID_DEF.ObjData_i[0].MotionType.ObjectIsMotorVehicle "Object type is Car, Truck, Motorcycle or Vehicle Of Unkown Class." UBYTE autosar_swc_aeb_CM_logical 0 0 0 1 ECU_ADDRESS 0xfe4a5065 /* @ECU_Address@autosar_swc_aeb_rtARID_DEF.ObjData_i[0].MotionType.ObjectIsMotorVehicle@ */ /end MEASUREMENT
/begin MEASUREMENT autosar_swc_aeb_rtARID_DEF.ObjData_i[0].MotionType.ObjectIsVehicle "" UBYTE autosar_swc_aeb_CM_logical 0 0 0 1 ECU_ADDRESS 0xfe4a5064 /* @ECU_Address@autosar_swc_aeb_rtARID_DEF.ObjData_i[0].MotionType.ObjectIsVehicle@ */ /end MEASUREMENT
/begin MEASUREMENT autosar_swc_aeb_rtARID_DEF.ObjData_i[0].MotionType.ParallellVehicleLongPred "" UBYTE autosar_swc_aeb_CM_logical 0 0 0 1 ECU_ADDRESS 0xfe4a5062 /* @ECU_Address@autosar_swc_aeb_rtARID_DEF.ObjData_i[0].MotionType.ParallellVehicleLongPred@ */ /end MEASUREMENT
/begin MEASUREMENT autosar_swc_aeb_rtARID_DEF.ObjData_i[0].MotionType.ParallellVehicleShortPred "" UBYTE autosar_swc_aeb_CM_logical 0 0 0 1 ECU_ADDRESS 0xfe4a5063 /* @ECU_Address@autosar_swc_aeb_rtARID_DEF.ObjData_i[0].MotionType.ParallellVehicleShortPred@ */ /end MEASUREMENT
/begin MEASUREMENT autosar_swc_aeb_rtARID_DEF.ObjData_i[0].MotionType.SideIsClosest "" UBYTE autosar_swc_aeb_CM_logical 0 0 0 1 ECU_ADDRESS 0xfe4a5067 /* @ECU_Address@autosar_swc_aeb_rtARID_DEF.ObjData_i[0].MotionType.SideIsClosest@ */ /end MEASUREMENT
/begin MEASUREMENT autosar_swc_aeb_rtARID_DEF.ObjData_i[0].MotionType.Stationary "" UBYTE autosar_swc_aeb_CM_logical 0 0 0 1 ECU_ADDRESS 0xfe4a5060 /* @ECU_Address@autosar_swc_aeb_rtARID_DEF.ObjData_i[0].MotionType.Stationary@ */ /end MEASUREMENT
/begin MEASUREMENT autosar_swc_aeb_rtARID_DEF.ObjData_i[0].Offsets.OffsLatInPathCloseEdge "" FLOAT32_IEEE autosar_swc_aeb_CM_single 0 0 -3.4E+38 3.4E+38 ECU_ADDRESS 0xfe4a509c /* @ECU_Address@autosar_swc_aeb_rtARID_DEF.ObjData_i[0].Offsets.OffsLatInPathCloseEdge@ */ /end MEASUREMENT
/begin MEASUREMENT autosar_swc_aeb_rtARID_DEF.ObjData_i[0].Offsets.OffsLatInPathFarEdge "" FLOAT32_IEEE autosar_swc_aeb_CM_single 0 0 -3.4E+38 3.4E+38 ECU_ADDRESS 0xfe4a50a0 /* @ECU_Address@autosar_swc_aeb_rtARID_DEF.ObjData_i[0].Offsets.OffsLatInPathFarEdge@ */ /end MEASUREMENT
/begin MEASUREMENT autosar_swc_aeb_rtARID_DEF.ObjData_i[0].Offsets.OffsLatInPathPrimaryTarget "" FLOAT32_IEEE autosar_swc_aeb_CM_single 0 0 -3.4E+38 3.4E+38 ECU_ADDRESS 0xfe4a5098 /* @ECU_Address@autosar_swc_aeb_rtARID_DEF.ObjData_i[0].Offsets.OffsLatInPathPrimaryTarget@ */ /end MEASUREMENT
/begin MEASUREMENT autosar_swc_aeb_rtARID_DEF.ObjData_i[0].Offsets.OffsLatIntersection "" FLOAT32_IEEE autosar_swc_aeb_CM_single 0 0 -3.4E+38 3.4E+38 ECU_ADDRESS 0xfe4a50a4 /* @ECU_Address@autosar_swc_aeb_rtARID_DEF.ObjData_i[0].Offsets.OffsLatIntersection@ */ /end MEASUREMENT
/begin MEASUREMENT autosar_swc_aeb_rtARID_DEF.ObjData_i[0].Offsets.OffsLatLongPred "" FLOAT32_IEEE autosar_swc_aeb_CM_single 0 0 -3.4E+38 3.4E+38 ECU_ADDRESS 0xfe4a5088 /* @ECU_Address@autosar_swc_aeb_rtARID_DEF.ObjData_i[0].Offsets.OffsLatLongPred@ */ /end MEASUREMENT
/begin MEASUREMENT autosar_swc_aeb_rtARID_DEF.ObjData_i[0].Offsets.OffsLatManoeuvre "" FLOAT32_IEEE autosar_swc_aeb_CM_single 0 0 -3.4E+38 3.4E+38 ECU_ADDRESS 0xfe4a5094 /* @ECU_Address@autosar_swc_aeb_rtARID_DEF.ObjData_i[0].Offsets.OffsLatManoeuvre@ */ /end MEASUREMENT
/begin MEASUREMENT autosar_swc_aeb_rtARID_DEF.ObjData_i[0].Offsets.OffsLatMplTar "" FLOAT32_IEEE autosar_swc_aeb_CM_single 0 0 -3.4E+38 3.4E+38 ECU_ADDRESS 0xfe4a50a8 /* @ECU_Address@autosar_swc_aeb_rtARID_DEF.ObjData_i[0].Offsets.OffsLatMplTar@ */ /end MEASUREMENT
/begin MEASUREMENT autosar_swc_aeb_rtARID_DEF.ObjData_i[0].Offsets.OffsLatShortPred "" FLOAT32_IEEE autosar_swc_aeb_CM_single 0 0 -3.4E+38 3.4E+38 ECU_ADDRESS 0xfe4a5090 /* @ECU_Address@autosar_swc_aeb_rtARID_DEF.ObjData_i[0].Offsets.OffsLatShortPred@ */ /end MEASUREMENT
/begin MEASUREMENT autosar_swc_aeb_rtARID_DEF.ObjData_i[0].Offsets.OffsLgtLongPred "" FLOAT32_IEEE autosar_swc_aeb_CM_single 0 0 -3.4E+38 3.4E+38 ECU_ADDRESS 0xfe4a5084 /* @ECU_Address@autosar_swc_aeb_rtARID_DEF.ObjData_i[0].Offsets.OffsLgtLongPred@ */ /end MEASUREMENT
/begin MEASUREMENT autosar_swc_aeb_rtARID_DEF.ObjData_i[0].Offsets.OffsLgtShortPred "" FLOAT32_IEEE autosar_swc_aeb_CM_single 0 0 -3.4E+38 3.4E+38 ECU_ADDRESS 0xfe4a508c /* @ECU_Address@autosar_swc_aeb_rtARID_DEF.ObjData_i[0].Offsets.OffsLgtShortPred@ */ /end MEASUREMENT
/begin MEASUREMENT autosar_swc_aeb_rtARID_DEF.ObjData_i[0].PredictionValid "" UBYTE autosar_swc_aeb_CM_logical 0 0 0 1 ECU_ADDRESS 0xfe4a5081 /* @ECU_Address@autosar_swc_aeb_rtARID_DEF.ObjData_i[0].PredictionValid@ */ /end MEASUREMENT
/begin MEASUREMENT autosar_swc_aeb_rtARID_DEF.ObjData_i[0].ShortPredTime.A "" FLOAT32_IEEE autosar_swc_aeb_CM_single 0 0 -3.4E+38 3.4E+38 ECU_ADDRESS 0xfe4a50e4 /* @ECU_Address@autosar_swc_aeb_rtARID_DEF.ObjData_i[0].ShortPredTime.A@ */ /end MEASUREMENT
/begin MEASUREMENT autosar_swc_aeb_rtARID_DEF.ObjData_i[0].ShortPredTime.ALat "" FLOAT32_IEEE autosar_swc_aeb_CM_single 0 0 -3.4E+38 3.4E+38 ECU_ADDRESS 0xfe4a50e0 /* @ECU_Address@autosar_swc_aeb_rtARID_DEF.ObjData_i[0].ShortPredTime.ALat@ */ /end MEASUREMENT
/begin MEASUREMENT autosar_swc_aeb_rtARID_DEF.ObjData_i[0].ShortPredTime.ALgt "" FLOAT32_IEEE autosar_swc_aeb_CM_single 0 0 -3.4E+38 3.4E+38 ECU_ADDRESS 0xfe4a50dc /* @ECU_Address@autosar_swc_aeb_rtARID_DEF.ObjData_i[0].ShortPredTime.ALgt@ */ /end MEASUREMENT
/begin MEASUREMENT autosar_swc_aeb_rtARID_DEF.ObjData_i[0].ShortPredTime.Crvt "" FLOAT32_IEEE autosar_swc_aeb_CM_single 0 0 -3.4E+38 3.4E+38 ECU_ADDRESS 0xfe4a50e8 /* @ECU_Address@autosar_swc_aeb_rtARID_DEF.ObjData_i[0].ShortPredTime.Crvt@ */ /end MEASUREMENT
/begin MEASUREMENT autosar_swc_aeb_rtARID_DEF.ObjData_i[0].ShortPredTime.InPath "" UBYTE autosar_swc_aeb_CM_logical 0 0 0 1 ECU_ADDRESS 0xfe4a50d9 /* @ECU_Address@autosar_swc_aeb_rtARID_DEF.ObjData_i[0].ShortPredTime.InPath@ */ /end MEASUREMENT
/begin MEASUREMENT autosar_swc_aeb_rtARID_DEF.ObjData_i[0].ShortPredTime.ObjOnCmngAndBrkg "" UBYTE autosar_swc_aeb_CM_logical 0 0 0 1 ECU_ADDRESS 0xfe4a50da /* @ECU_Address@autosar_swc_aeb_rtARID_DEF.ObjData_i[0].ShortPredTime.ObjOnCmngAndBrkg@ */ /end MEASUREMENT
/begin MEASUREMENT autosar_swc_aeb_rtARID_DEF.ObjData_i[0].ShortPredTime.TTMSelected "" UBYTE autosar_swc_aeb_CM_logical 0 0 0 1 ECU_ADDRESS 0xfe4a50d8 /* @ECU_Address@autosar_swc_aeb_rtARID_DEF.ObjData_i[0].ShortPredTime.TTMSelected@ */ /end MEASUREMENT
/begin MEASUREMENT autosar_swc_aeb_rtARID_DEF.ObjData_i[0].ShortPredTime.TimeToMiddleLgt "" FLOAT32_IEEE autosar_swc_aeb_CM_single 0 0 -3.4E+38 3.4E+38 ECU_ADDRESS 0xfe4a50d0 /* @ECU_Address@autosar_swc_aeb_rtARID_DEF.ObjData_i[0].ShortPredTime.TimeToMiddleLgt@ */ /end MEASUREMENT
/begin MEASUREMENT autosar_swc_aeb_rtARID_DEF.ObjData_i[0].ShortPredTime.TimeToPassLgt "" FLOAT32_IEEE autosar_swc_aeb_CM_single 0 0 -3.4E+38 3.4E+38 ECU_ADDRESS 0xfe4a50d4 /* @ECU_Address@autosar_swc_aeb_rtARID_DEF.ObjData_i[0].ShortPredTime.TimeToPassLgt@ */ /end MEASUREMENT
/begin MEASUREMENT autosar_swc_aeb_rtARID_DEF.ObjData_i[0].ShortPredTime.TimeToReachLgt "" FLOAT32_IEEE autosar_swc_aeb_CM_single 0 0 -3.4E+38 3.4E+38 ECU_ADDRESS 0xfe4a50cc /* @ECU_Address@autosar_swc_aeb_rtARID_DEF.ObjData_i[0].ShortPredTime.TimeToReachLgt@ */ /end MEASUREMENT
/begin MEASUREMENT autosar_swc_aeb_rtARID_DEF.ObjData_i[10].BoundingBox.CosRotation "" FLOAT32_IEEE autosar_swc_aeb_CM_single 0 0 -3.4E+38 3.4E+38 ECU_ADDRESS 0xfe4a5618 /* @ECU_Address@autosar_swc_aeb_rtARID_DEF.ObjData_i[10].BoundingBox.CosRotation@ */ /end MEASUREMENT
/begin MEASUREMENT autosar_swc_aeb_rtARID_DEF.ObjData_i[10].BoundingBox.LengthSideLat "" FLOAT32_IEEE autosar_swc_aeb_CM_single 0 0 -3.4E+38 3.4E+38 ECU_ADDRESS 0xfe4a560c /* @ECU_Address@autosar_swc_aeb_rtARID_DEF.ObjData_i[10].BoundingBox.LengthSideLat@ */ /end MEASUREMENT
/begin MEASUREMENT autosar_swc_aeb_rtARID_DEF.ObjData_i[10].BoundingBox.LengthSideLgt "" FLOAT32_IEEE autosar_swc_aeb_CM_single 0 0 -3.4E+38 3.4E+38 ECU_ADDRESS 0xfe4a5610 /* @ECU_Address@autosar_swc_aeb_rtARID_DEF.ObjData_i[10].BoundingBox.LengthSideLgt@ */ /end MEASUREMENT
/begin MEASUREMENT autosar_swc_aeb_rtARID_DEF.ObjData_i[10].BoundingBox.RotationAngle "" FLOAT32_IEEE autosar_swc_aeb_CM_single 0 0 -3.4E+38 3.4E+38 ECU_ADDRESS 0xfe4a561c /* @ECU_Address@autosar_swc_aeb_rtARID_DEF.ObjData_i[10].BoundingBox.RotationAngle@ */ /end MEASUREMENT
/begin MEASUREMENT autosar_swc_aeb_rtARID_DEF.ObjData_i[10].BoundingBox.SinRotation "" FLOAT32_IEEE autosar_swc_aeb_CM_single 0 0 -3.4E+38 3.4E+38 ECU_ADDRESS 0xfe4a5614 /* @ECU_Address@autosar_swc_aeb_rtARID_DEF.ObjData_i[10].BoundingBox.SinRotation@ */ /end MEASUREMENT
/begin MEASUREMENT autosar_swc_aeb_rtARID_DEF.ObjData_i[10].Idn "" ULONG autosar_swc_aeb_CM_uint32 0 0 0 4294967295 ECU_ADDRESS 0xfe4a568c /* @ECU_Address@autosar_swc_aeb_rtARID_DEF.ObjData_i[10].Idn@ */ /end MEASUREMENT
/begin MEASUREMENT autosar_swc_aeb_rtARID_DEF.ObjData_i[10].InPathAtCurrentPosition "" UBYTE autosar_swc_aeb_CM_logical 0 0 0 1 ECU_ADDRESS 0xfe4a5620 /* @ECU_Address@autosar_swc_aeb_rtARID_DEF.ObjData_i[10].InPathAtCurrentPosition@ */ /end MEASUREMENT
/begin MEASUREMENT autosar_swc_aeb_rtARID_DEF.ObjData_i[10].LongPredTime.A "" FLOAT32_IEEE autosar_swc_aeb_CM_single 0 0 -3.4E+38 3.4E+38 ECU_ADDRESS 0xfe4a5664 /* @ECU_Address@autosar_swc_aeb_rtARID_DEF.ObjData_i[10].LongPredTime.A@ */ /end MEASUREMENT
/begin MEASUREMENT autosar_swc_aeb_rtARID_DEF.ObjData_i[10].LongPredTime.ALat "" FLOAT32_IEEE autosar_swc_aeb_CM_single 0 0 -3.4E+38 3.4E+38 ECU_ADDRESS 0xfe4a5660 /* @ECU_Address@autosar_swc_aeb_rtARID_DEF.ObjData_i[10].LongPredTime.ALat@ */ /end MEASUREMENT
/begin MEASUREMENT autosar_swc_aeb_rtARID_DEF.ObjData_i[10].LongPredTime.ALgt "" FLOAT32_IEEE autosar_swc_aeb_CM_single 0 0 -3.4E+38 3.4E+38 ECU_ADDRESS 0xfe4a565c /* @ECU_Address@autosar_swc_aeb_rtARID_DEF.ObjData_i[10].LongPredTime.ALgt@ */ /end MEASUREMENT
/begin MEASUREMENT autosar_swc_aeb_rtARID_DEF.ObjData_i[10].LongPredTime.Crvt "" FLOAT32_IEEE autosar_swc_aeb_CM_single 0 0 -3.4E+38 3.4E+38 ECU_ADDRESS 0xfe4a5668 /* @ECU_Address@autosar_swc_aeb_rtARID_DEF.ObjData_i[10].LongPredTime.Crvt@ */ /end MEASUREMENT
/begin MEASUREMENT autosar_swc_aeb_rtARID_DEF.ObjData_i[10].LongPredTime.InPath "" UBYTE autosar_swc_aeb_CM_logical 0 0 0 1 ECU_ADDRESS 0xfe4a5659 /* @ECU_Address@autosar_swc_aeb_rtARID_DEF.ObjData_i[10].LongPredTime.InPath@ */ /end MEASUREMENT
/begin MEASUREMENT autosar_swc_aeb_rtARID_DEF.ObjData_i[10].LongPredTime.ObjOnCmngAndBrkg "" UBYTE autosar_swc_aeb_CM_logical 0 0 0 1 ECU_ADDRESS 0xfe4a565a /* @ECU_Address@autosar_swc_aeb_rtARID_DEF.ObjData_i[10].LongPredTime.ObjOnCmngAndBrkg@ */ /end MEASUREMENT
/begin MEASUREMENT autosar_swc_aeb_rtARID_DEF.ObjData_i[10].LongPredTime.TTMSelected "" UBYTE autosar_swc_aeb_CM_logical 0 0 0 1 ECU_ADDRESS 0xfe4a5658 /* @ECU_Address@autosar_swc_aeb_rtARID_DEF.ObjData_i[10].LongPredTime.TTMSelected@ */ /end MEASUREMENT
/begin MEASUREMENT autosar_swc_aeb_rtARID_DEF.ObjData_i[10].LongPredTime.TimeToMiddleLgt "" FLOAT32_IEEE autosar_swc_aeb_CM_single 0 0 -3.4E+38 3.4E+38 ECU_ADDRESS 0xfe4a5650 /* @ECU_Address@autosar_swc_aeb_rtARID_DEF.ObjData_i[10].LongPredTime.TimeToMiddleLgt@ */ /end MEASUREMENT
/begin MEASUREMENT autosar_swc_aeb_rtARID_DEF.ObjData_i[10].LongPredTime.TimeToPassLgt "" FLOAT32_IEEE autosar_swc_aeb_CM_single 0 0 -3.4E+38 3.4E+38 ECU_ADDRESS 0xfe4a5654 /* @ECU_Address@autosar_swc_aeb_rtARID_DEF.ObjData_i[10].LongPredTime.TimeToPassLgt@ */ /end MEASUREMENT
/begin MEASUREMENT autosar_swc_aeb_rtARID_DEF.ObjData_i[10].LongPredTime.TimeToReachLgt "" FLOAT32_IEEE autosar_swc_aeb_CM_single 0 0 -3.4E+38 3.4E+38 ECU_ADDRESS 0xfe4a564c /* @ECU_Address@autosar_swc_aeb_rtARID_DEF.ObjData_i[10].LongPredTime.TimeToReachLgt@ */ /end MEASUREMENT
/begin MEASUREMENT autosar_swc_aeb_rtARID_DEF.ObjData_i[10].MotionType.AbsHeading "" FLOAT32_IEEE autosar_swc_aeb_CM_single 0 0 -3.4E+38 3.4E+38 ECU_ADDRESS 0xfe4a5608 /* @ECU_Address@autosar_swc_aeb_rtARID_DEF.ObjData_i[10].MotionType.AbsHeading@ */ /end MEASUREMENT
/begin MEASUREMENT autosar_swc_aeb_rtARID_DEF.ObjData_i[10].MotionType.CurvedMotion "" UBYTE autosar_swc_aeb_CM_logical 0 0 0 1 ECU_ADDRESS 0xfe4a5606 /* @ECU_Address@autosar_swc_aeb_rtARID_DEF.ObjData_i[10].MotionType.CurvedMotion@ */ /end MEASUREMENT
/begin MEASUREMENT autosar_swc_aeb_rtARID_DEF.ObjData_i[10].MotionType.MovingOncoming "" UBYTE autosar_swc_aeb_CM_logical 0 0 0 1 ECU_ADDRESS 0xfe4a5601 /* @ECU_Address@autosar_swc_aeb_rtARID_DEF.ObjData_i[10].MotionType.MovingOncoming@ */ /end MEASUREMENT
/begin MEASUREMENT autosar_swc_aeb_rtARID_DEF.ObjData_i[10].MotionType.ObjectIsMotorVehicle "Object type is Car, Truck, Motorcycle or Vehicle Of Unkown Class." UBYTE autosar_swc_aeb_CM_logical 0 0 0 1 ECU_ADDRESS 0xfe4a5605 /* @ECU_Address@autosar_swc_aeb_rtARID_DEF.ObjData_i[10].MotionType.ObjectIsMotorVehicle@ */ /end MEASUREMENT
/begin MEASUREMENT autosar_swc_aeb_rtARID_DEF.ObjData_i[10].MotionType.ObjectIsVehicle "" UBYTE autosar_swc_aeb_CM_logical 0 0 0 1 ECU_ADDRESS 0xfe4a5604 /* @ECU_Address@autosar_swc_aeb_rtARID_DEF.ObjData_i[10].MotionType.ObjectIsVehicle@ */ /end MEASUREMENT
/begin MEASUREMENT autosar_swc_aeb_rtARID_DEF.ObjData_i[10].MotionType.ParallellVehicleLongPred "" UBYTE autosar_swc_aeb_CM_logical 0 0 0 1 ECU_ADDRESS 0xfe4a5602 /* @ECU_Address@autosar_swc_aeb_rtARID_DEF.ObjData_i[10].MotionType.ParallellVehicleLongPred@ */ /end MEASUREMENT
/begin MEASUREMENT autosar_swc_aeb_rtARID_DEF.ObjData_i[10].MotionType.ParallellVehicleShortPred "" UBYTE autosar_swc_aeb_CM_logical 0 0 0 1 ECU_ADDRESS 0xfe4a5603 /* @ECU_Address@autosar_swc_aeb_rtARID_DEF.ObjData_i[10].MotionType.ParallellVehicleShortPred@ */ /end MEASUREMENT
/begin MEASUREMENT autosar_swc_aeb_rtARID_DEF.ObjData_i[10].MotionType.SideIsClosest "" UBYTE autosar_swc_aeb_CM_logical 0 0 0 1 ECU_ADDRESS 0xfe4a5607 /* @ECU_Address@autosar_swc_aeb_rtARID_DEF.ObjData_i[10].MotionType.SideIsClosest@ */ /end MEASUREMENT
/begin MEASUREMENT autosar_swc_aeb_rtARID_DEF.ObjData_i[10].MotionType.Stationary "" UBYTE autosar_swc_aeb_CM_logical 0 0 0 1 ECU_ADDRESS 0xfe4a5600 /* @ECU_Address@autosar_swc_aeb_rtARID_DEF.ObjData_i[10].MotionType.Stationary@ */ /end MEASUREMENT
/begin MEASUREMENT autosar_swc_aeb_rtARID_DEF.ObjData_i[10].Offsets.OffsLatInPathCloseEdge "" FLOAT32_IEEE autosar_swc_aeb_CM_single 0 0 -3.4E+38 3.4E+38 ECU_ADDRESS 0xfe4a563c /* @ECU_Address@autosar_swc_aeb_rtARID_DEF.ObjData_i[10].Offsets.OffsLatInPathCloseEdge@ */ /end MEASUREMENT
/begin MEASUREMENT autosar_swc_aeb_rtARID_DEF.ObjData_i[10].Offsets.OffsLatInPathFarEdge "" FLOAT32_IEEE autosar_swc_aeb_CM_single 0 0 -3.4E+38 3.4E+38 ECU_ADDRESS 0xfe4a5640 /* @ECU_Address@autosar_swc_aeb_rtARID_DEF.ObjData_i[10].Offsets.OffsLatInPathFarEdge@ */ /end MEASUREMENT
/begin MEASUREMENT autosar_swc_aeb_rtARID_DEF.ObjData_i[10].Offsets.OffsLatInPathPrimaryTarget "" FLOAT32_IEEE autosar_swc_aeb_CM_single 0 0 -3.4E+38 3.4E+38 ECU_ADDRESS 0xfe4a5638 /* @ECU_Address@autosar_swc_aeb_rtARID_DEF.ObjData_i[10].Offsets.OffsLatInPathPrimaryTarget@ */ /end MEASUREMENT
/begin MEASUREMENT autosar_swc_aeb_rtARID_DEF.ObjData_i[10].Offsets.OffsLatIntersection "" FLOAT32_IEEE autosar_swc_aeb_CM_single 0 0 -3.4E+38 3.4E+38 ECU_ADDRESS 0xfe4a5644 /* @ECU_Address@autosar_swc_aeb_rtARID_DEF.ObjData_i[10].Offsets.OffsLatIntersection@ */ /end MEASUREMENT
/begin MEASUREMENT autosar_swc_aeb_rtARID_DEF.ObjData_i[10].Offsets.OffsLatLongPred "" FLOAT32_IEEE autosar_swc_aeb_CM_single 0 0 -3.4E+38 3.4E+38 ECU_ADDRESS 0xfe4a5628 /* @ECU_Address@autosar_swc_aeb_rtARID_DEF.ObjData_i[10].Offsets.OffsLatLongPred@ */ /end MEASUREMENT
/begin MEASUREMENT autosar_swc_aeb_rtARID_DEF.ObjData_i[10].Offsets.OffsLatManoeuvre "" FLOAT32_IEEE autosar_swc_aeb_CM_single 0 0 -3.4E+38 3.4E+38 ECU_ADDRESS 0xfe4a5634 /* @ECU_Address@autosar_swc_aeb_rtARID_DEF.ObjData_i[10].Offsets.OffsLatManoeuvre@ */ /end MEASUREMENT
/begin MEASUREMENT autosar_swc_aeb_rtARID_DEF.ObjData_i[10].Offsets.OffsLatMplTar "" FLOAT32_IEEE autosar_swc_aeb_CM_single 0 0 -3.4E+38 3.4E+38 ECU_ADDRESS 0xfe4a5648 /* @ECU_Address@autosar_swc_aeb_rtARID_DEF.ObjData_i[10].Offsets.OffsLatMplTar@ */ /end MEASUREMENT
/begin MEASUREMENT autosar_swc_aeb_rtARID_DEF.ObjData_i[10].Offsets.OffsLatShortPred "" FLOAT32_IEEE autosar_swc_aeb_CM_single 0 0 -3.4E+38 3.4E+38 ECU_ADDRESS 0xfe4a5630 /* @ECU_Address@autosar_swc_aeb_rtARID_DEF.ObjData_i[10].Offsets.OffsLatShortPred@ */ /end MEASUREMENT
/begin MEASUREMENT autosar_swc_aeb_rtARID_DEF.ObjData_i[10].Offsets.OffsLgtLongPred "" FLOAT32_IEEE autosar_swc_aeb_CM_single 0 0 -3.4E+38 3.4E+38 ECU_ADDRESS 0xfe4a5624 /* @ECU_Address@autosar_swc_aeb_rtARID_DEF.ObjData_i[10].Offsets.OffsLgtLongPred@ */ /end MEASUREMENT
/begin MEASUREMENT autosar_swc_aeb_rtARID_DEF.ObjData_i[10].Offsets.OffsLgtShortPred "" FLOAT32_IEEE autosar_swc_aeb_CM_single 0 0 -3.4E+38 3.4E+38 ECU_ADDRESS 0xfe4a562c /* @ECU_Address@autosar_swc_aeb_rtARID_DEF.ObjData_i[10].Offsets.OffsLgtShortPred@ */ /end MEASUREMENT
/begin MEASUREMENT autosar_swc_aeb_rtARID_DEF.ObjData_i[10].PredictionValid "" UBYTE autosar_swc_aeb_CM_logical 0 0 0 1 ECU_ADDRESS 0xfe4a5621 /* @ECU_Address@autosar_swc_aeb_rtARID_DEF.ObjData_i[10].PredictionValid@ */ /end MEASUREMENT
/begin MEASUREMENT autosar_swc_aeb_rtARID_DEF.ObjData_i[10].ShortPredTime.A "" FLOAT32_IEEE autosar_swc_aeb_CM_single 0 0 -3.4E+38 3.4E+38 ECU_ADDRESS 0xfe4a5684 /* @ECU_Address@autosar_swc_aeb_rtARID_DEF.ObjData_i[10].ShortPredTime.A@ */ /end MEASUREMENT
/begin MEASUREMENT autosar_swc_aeb_rtARID_DEF.ObjData_i[10].ShortPredTime.ALat "" FLOAT32_IEEE autosar_swc_aeb_CM_single 0 0 -3.4E+38 3.4E+38 ECU_ADDRESS 0xfe4a5680 /* @ECU_Address@autosar_swc_aeb_rtARID_DEF.ObjData_i[10].ShortPredTime.ALat@ */ /end MEASUREMENT
/begin MEASUREMENT autosar_swc_aeb_rtARID_DEF.ObjData_i[10].ShortPredTime.ALgt "" FLOAT32_IEEE autosar_swc_aeb_CM_single 0 0 -3.4E+38 3.4E+38 ECU_ADDRESS 0xfe4a567c /* @ECU_Address@autosar_swc_aeb_rtARID_DEF.ObjData_i[10].ShortPredTime.ALgt@ */ /end MEASUREMENT
/begin MEASUREMENT autosar_swc_aeb_rtARID_DEF.ObjData_i[10].ShortPredTime.Crvt "" FLOAT32_IEEE autosar_swc_aeb_CM_single 0 0 -3.4E+38 3.4E+38 ECU_ADDRESS 0xfe4a5688 /* @ECU_Address@autosar_swc_aeb_rtARID_DEF.ObjData_i[10].ShortPredTime.Crvt@ */ /end MEASUREMENT
/begin MEASUREMENT autosar_swc_aeb_rtARID_DEF.ObjData_i[10].ShortPredTime.InPath "" UBYTE autosar_swc_aeb_CM_logical 0 0 0 1 ECU_ADDRESS 0xfe4a5679 /* @ECU_Address@autosar_swc_aeb_rtARID_DEF.ObjData_i[10].ShortPredTime.InPath@ */ /end MEASUREMENT
/begin MEASUREMENT autosar_swc_aeb_rtARID_DEF.ObjData_i[10].ShortPredTime.ObjOnCmngAndBrkg "" UBYTE autosar_swc_aeb_CM_logical 0 0 0 1 ECU_ADDRESS 0xfe4a567a /* @ECU_Address@autosar_swc_aeb_rtARID_DEF.ObjData_i[10].ShortPredTime.ObjOnCmngAndBrkg@ */ /end MEASUREMENT
/begin MEASUREMENT autosar_swc_aeb_rtARID_DEF.ObjData_i[10].ShortPredTime.TTMSelected "" UBYTE autosar_swc_aeb_CM_logical 0 0 0 1 ECU_ADDRESS 0xfe4a5678 /* @ECU_Address@autosar_swc_aeb_rtARID_DEF.ObjData_i[10].ShortPredTime.TTMSelected@ */ /end MEASUREMENT
/begin MEASUREMENT autosar_swc_aeb_rtARID_DEF.ObjData_i[10].ShortPredTime.TimeToMiddleLgt "" FLOAT32_IEEE autosar_swc_aeb_CM_single 0 0 -3.4E+38 3.4E+38 ECU_ADDRESS 0xfe4a5670 /* @ECU_Address@autosar_swc_aeb_rtARID_DEF.ObjData_i[10].ShortPredTime.TimeToMiddleLgt@ */ /end MEASUREMENT
/begin MEASUREMENT autosar_swc_aeb_rtARID_DEF.ObjData_i[10].ShortPredTime.TimeToPassLgt "" FLOAT32_IEEE autosar_swc_aeb_CM_single 0 0 -3.4E+38 3.4E+38 ECU_ADDRESS 0xfe4a5674 /* @ECU_Address@autosar_swc_aeb_rtARID_DEF.ObjData_i[10].ShortPredTime.TimeToPassLgt@ */ /end MEASUREMENT
/begin MEASUREMENT autosar_swc_aeb_rtARID_DEF.ObjData_i[10].ShortPredTime.TimeToReachLgt "" FLOAT32_IEEE autosar_swc_aeb_CM_single 0 0 -3.4E+38 3.4E+38 ECU_ADDRESS 0xfe4a566c /* @ECU_Address@autosar_swc_aeb_rtARID_DEF.ObjData_i[10].ShortPredTime.TimeToReachLgt@ */ /end MEASUREMENT
/begin MEASUREMENT autosar_swc_aeb_rtARID_DEF.ObjData_i[11].BoundingBox.CosRotation "" FLOAT32_IEEE autosar_swc_aeb_CM_single 0 0 -3.4E+38 3.4E+38 ECU_ADDRESS 0xfe4a56a8 /* @ECU_Address@autosar_swc_aeb_rtARID_DEF.ObjData_i[11].BoundingBox.CosRotation@ */ /end MEASUREMENT
/begin MEASUREMENT autosar_swc_aeb_rtARID_DEF.ObjData_i[11].BoundingBox.LengthSideLat "" FLOAT32_IEEE autosar_swc_aeb_CM_single 0 0 -3.4E+38 3.4E+38 ECU_ADDRESS 0xfe4a569c /* @ECU_Address@autosar_swc_aeb_rtARID_DEF.ObjData_i[11].BoundingBox.LengthSideLat@ */ /end MEASUREMENT
/begin MEASUREMENT autosar_swc_aeb_rtARID_DEF.ObjData_i[11].BoundingBox.LengthSideLgt "" FLOAT32_IEEE autosar_swc_aeb_CM_single 0 0 -3.4E+38 3.4E+38 ECU_ADDRESS 0xfe4a56a0 /* @ECU_Address@autosar_swc_aeb_rtARID_DEF.ObjData_i[11].BoundingBox.LengthSideLgt@ */ /end MEASUREMENT
/begin MEASUREMENT autosar_swc_aeb_rtARID_DEF.ObjData_i[11].BoundingBox.RotationAngle "" FLOAT32_IEEE autosar_swc_aeb_CM_single 0 0 -3.4E+38 3.4E+38 ECU_ADDRESS 0xfe4a56ac /* @ECU_Address@autosar_swc_aeb_rtARID_DEF.ObjData_i[11].BoundingBox.RotationAngle@ */ /end MEASUREMENT
/begin MEASUREMENT autosar_swc_aeb_rtARID_DEF.ObjData_i[11].BoundingBox.SinRotation "" FLOAT32_IEEE autosar_swc_aeb_CM_single 0 0 -3.4E+38 3.4E+38 ECU_ADDRESS 0xfe4a56a4 /* @ECU_Address@autosar_swc_aeb_rtARID_DEF.ObjData_i[11].BoundingBox.SinRotation@ */ /end MEASUREMENT
/begin MEASUREMENT autosar_swc_aeb_rtARID_DEF.ObjData_i[11].Idn "" ULONG autosar_swc_aeb_CM_uint32 0 0 0 4294967295 ECU_ADDRESS 0xfe4a571c /* @ECU_Address@autosar_swc_aeb_rtARID_DEF.ObjData_i[11].Idn@ */ /end MEASUREMENT
/begin MEASUREMENT autosar_swc_aeb_rtARID_DEF.ObjData_i[11].InPathAtCurrentPosition "" UBYTE autosar_swc_aeb_CM_logical 0 0 0 1 ECU_ADDRESS 0xfe4a56b0 /* @ECU_Address@autosar_swc_aeb_rtARID_DEF.ObjData_i[11].InPathAtCurrentPosition@ */ /end MEASUREMENT
/begin MEASUREMENT autosar_swc_aeb_rtARID_DEF.ObjData_i[11].LongPredTime.A "" FLOAT32_IEEE autosar_swc_aeb_CM_single 0 0 -3.4E+38 3.4E+38 ECU_ADDRESS 0xfe4a56f4 /* @ECU_Address@autosar_swc_aeb_rtARID_DEF.ObjData_i[11].LongPredTime.A@ */ /end MEASUREMENT
/begin MEASUREMENT autosar_swc_aeb_rtARID_DEF.ObjData_i[11].LongPredTime.ALat "" FLOAT32_IEEE autosar_swc_aeb_CM_single 0 0 -3.4E+38 3.4E+38 ECU_ADDRESS 0xfe4a56f0 /* @ECU_Address@autosar_swc_aeb_rtARID_DEF.ObjData_i[11].LongPredTime.ALat@ */ /end MEASUREMENT
/begin MEASUREMENT autosar_swc_aeb_rtARID_DEF.ObjData_i[11].LongPredTime.ALgt "" FLOAT32_IEEE autosar_swc_aeb_CM_single 0 0 -3.4E+38 3.4E+38 ECU_ADDRESS 0xfe4a56ec /* @ECU_Address@autosar_swc_aeb_rtARID_DEF.ObjData_i[11].LongPredTime.ALgt@ */ /end MEASUREMENT
/begin MEASUREMENT autosar_swc_aeb_rtARID_DEF.ObjData_i[11].LongPredTime.Crvt "" FLOAT32_IEEE autosar_swc_aeb_CM_single 0 0 -3.4E+38 3.4E+38 ECU_ADDRESS 0xfe4a56f8 /* @ECU_Address@autosar_swc_aeb_rtARID_DEF.ObjData_i[11].LongPredTime.Crvt@ */ /end MEASUREMENT
/begin MEASUREMENT autosar_swc_aeb_rtARID_DEF.ObjData_i[11].LongPredTime.InPath "" UBYTE autosar_swc_aeb_CM_logical 0 0 0 1 ECU_ADDRESS 0xfe4a56e9 /* @ECU_Address@autosar_swc_aeb_rtARID_DEF.ObjData_i[11].LongPredTime.InPath@ */ /end MEASUREMENT
/begin MEASUREMENT autosar_swc_aeb_rtARID_DEF.ObjData_i[11].LongPredTime.ObjOnCmngAndBrkg "" UBYTE autosar_swc_aeb_CM_logical 0 0 0 1 ECU_ADDRESS 0xfe4a56ea /* @ECU_Address@autosar_swc_aeb_rtARID_DEF.ObjData_i[11].LongPredTime.ObjOnCmngAndBrkg@ */ /end MEASUREMENT
/begin MEASUREMENT autosar_swc_aeb_rtARID_DEF.ObjData_i[11].LongPredTime.TTMSelected "" UBYTE autosar_swc_aeb_CM_logical 0 0 0 1 ECU_ADDRESS 0xfe4a56e8 /* @ECU_Address@autosar_swc_aeb_rtARID_DEF.ObjData_i[11].LongPredTime.TTMSelected@ */ /end MEASUREMENT
/begin MEASUREMENT autosar_swc_aeb_rtARID_DEF.ObjData_i[11].LongPredTime.TimeToMiddleLgt "" FLOAT32_IEEE autosar_swc_aeb_CM_single 0 0 -3.4E+38 3.4E+38 ECU_ADDRESS 0xfe4a56e0 /* @ECU_Address@autosar_swc_aeb_rtARID_DEF.ObjData_i[11].LongPredTime.TimeToMiddleLgt@ */ /end MEASUREMENT
/begin MEASUREMENT autosar_swc_aeb_rtARID_DEF.ObjData_i[11].LongPredTime.TimeToPassLgt "" FLOAT32_IEEE autosar_swc_aeb_CM_single 0 0 -3.4E+38 3.4E+38 ECU_ADDRESS 0xfe4a56e4 /* @ECU_Address@autosar_swc_aeb_rtARID_DEF.ObjData_i[11].LongPredTime.TimeToPassLgt@ */ /end MEASUREMENT
/begin MEASUREMENT autosar_swc_aeb_rtARID_DEF.ObjData_i[11].LongPredTime.TimeToReachLgt "" FLOAT32_IEEE autosar_swc_aeb_CM_single 0 0 -3.4E+38 3.4E+38 ECU_ADDRESS 0xfe4a56dc /* @ECU_Address@autosar_swc_aeb_rtARID_DEF.ObjData_i[11].LongPredTime.TimeToReachLgt@ */ /end MEASUREMENT
/begin MEASUREMENT autosar_swc_aeb_rtARID_DEF.ObjData_i[11].MotionType.AbsHeading "" FLOAT32_IEEE autosar_swc_aeb_CM_single 0 0 -3.4E+38 3.4E+38 ECU_ADDRESS 0xfe4a5698 /* @ECU_Address@autosar_swc_aeb_rtARID_DEF.ObjData_i[11].MotionType.AbsHeading@ */ /end MEASUREMENT
/begin MEASUREMENT autosar_swc_aeb_rtARID_DEF.ObjData_i[11].MotionType.CurvedMotion "" UBYTE autosar_swc_aeb_CM_logical 0 0 0 1 ECU_ADDRESS 0xfe4a5696 /* @ECU_Address@autosar_swc_aeb_rtARID_DEF.ObjData_i[11].MotionType.CurvedMotion@ */ /end MEASUREMENT
/begin MEASUREMENT autosar_swc_aeb_rtARID_DEF.ObjData_i[11].MotionType.MovingOncoming "" UBYTE autosar_swc_aeb_CM_logical 0 0 0 1 ECU_ADDRESS 0xfe4a5691 /* @ECU_Address@autosar_swc_aeb_rtARID_DEF.ObjData_i[11].MotionType.MovingOncoming@ */ /end MEASUREMENT
/begin MEASUREMENT autosar_swc_aeb_rtARID_DEF.ObjData_i[11].MotionType.ObjectIsMotorVehicle "Object type is Car, Truck, Motorcycle or Vehicle Of Unkown Class." UBYTE autosar_swc_aeb_CM_logical 0 0 0 1 ECU_ADDRESS 0xfe4a5695 /* @ECU_Address@autosar_swc_aeb_rtARID_DEF.ObjData_i[11].MotionType.ObjectIsMotorVehicle@ */ /end MEASUREMENT
/begin MEASUREMENT autosar_swc_aeb_rtARID_DEF.ObjData_i[11].MotionType.ObjectIsVehicle "" UBYTE autosar_swc_aeb_CM_logical 0 0 0 1 ECU_ADDRESS 0xfe4a5694 /* @ECU_Address@autosar_swc_aeb_rtARID_DEF.ObjData_i[11].MotionType.ObjectIsVehicle@ */ /end MEASUREMENT
/begin MEASUREMENT autosar_swc_aeb_rtARID_DEF.ObjData_i[11].MotionType.ParallellVehicleLongPred "" UBYTE autosar_swc_aeb_CM_logical 0 0 0 1 ECU_ADDRESS 0xfe4a5692 /* @ECU_Address@autosar_swc_aeb_rtARID_DEF.ObjData_i[11].MotionType.ParallellVehicleLongPred@ */ /end MEASUREMENT
/begin MEASUREMENT autosar_swc_aeb_rtARID_DEF.ObjData_i[11].MotionType.ParallellVehicleShortPred "" UBYTE autosar_swc_aeb_CM_logical 0 0 0 1 ECU_ADDRESS 0xfe4a5693 /* @ECU_Address@autosar_swc_aeb_rtARID_DEF.ObjData_i[11].MotionType.ParallellVehicleShortPred@ */ /end MEASUREMENT
/begin MEASUREMENT autosar_swc_aeb_rtARID_DEF.ObjData_i[11].MotionType.SideIsClosest "" UBYTE autosar_swc_aeb_CM_logical 0 0 0 1 ECU_ADDRESS 0xfe4a5697 /* @ECU_Address@autosar_swc_aeb_rtARID_DEF.ObjData_i[11].MotionType.SideIsClosest@ */ /end MEASUREMENT
/begin MEASUREMENT autosar_swc_aeb_rtARID_DEF.ObjData_i[11].MotionType.Stationary "" UBYTE autosar_swc_aeb_CM_logical 0 0 0 1 ECU_ADDRESS 0xfe4a5690 /* @ECU_Address@autosar_swc_aeb_rtARID_DEF.ObjData_i[11].MotionType.Stationary@ */ /end MEASUREMENT
/begin MEASUREMENT autosar_swc_aeb_rtARID_DEF.ObjData_i[11].Offsets.OffsLatInPathCloseEdge "" FLOAT32_IEEE autosar_swc_aeb_CM_single 0 0 -3.4E+38 3.4E+38 ECU_ADDRESS 0xfe4a56cc /* @ECU_Address@autosar_swc_aeb_rtARID_DEF.ObjData_i[11].Offsets.OffsLatInPathCloseEdge@ */ /end MEASUREMENT
/begin MEASUREMENT autosar_swc_aeb_rtARID_DEF.ObjData_i[11].Offsets.OffsLatInPathFarEdge "" FLOAT32_IEEE autosar_swc_aeb_CM_single 0 0 -3.4E+38 3.4E+38 ECU_ADDRESS 0xfe4a56d0 /* @ECU_Address@autosar_swc_aeb_rtARID_DEF.ObjData_i[11].Offsets.OffsLatInPathFarEdge@ */ /end MEASUREMENT
/begin MEASUREMENT autosar_swc_aeb_rtARID_DEF.ObjData_i[11].Offsets.OffsLatInPathPrimaryTarget "" FLOAT32_IEEE autosar_swc_aeb_CM_single 0 0 -3.4E+38 3.4E+38 ECU_ADDRESS 0xfe4a56c8 /* @ECU_Address@autosar_swc_aeb_rtARID_DEF.ObjData_i[11].Offsets.OffsLatInPathPrimaryTarget@ */ /end MEASUREMENT
/begin MEASUREMENT autosar_swc_aeb_rtARID_DEF.ObjData_i[11].Offsets.OffsLatIntersection "" FLOAT32_IEEE autosar_swc_aeb_CM_single 0 0 -3.4E+38 3.4E+38 ECU_ADDRESS 0xfe4a56d4 /* @ECU_Address@autosar_swc_aeb_rtARID_DEF.ObjData_i[11].Offsets.OffsLatIntersection@ */ /end MEASUREMENT
/begin MEASUREMENT autosar_swc_aeb_rtARID_DEF.ObjData_i[11].Offsets.OffsLatLongPred "" FLOAT32_IEEE autosar_swc_aeb_CM_single 0 0 -3.4E+38 3.4E+38 ECU_ADDRESS 0xfe4a56b8 /* @ECU_Address@autosar_swc_aeb_rtARID_DEF.ObjData_i[11].Offsets.OffsLatLongPred@ */ /end MEASUREMENT
/begin MEASUREMENT autosar_swc_aeb_rtARID_DEF.ObjData_i[11].Offsets.OffsLatManoeuvre "" FLOAT32_IEEE autosar_swc_aeb_CM_single 0 0 -3.4E+38 3.4E+38 ECU_ADDRESS 0xfe4a56c4 /* @ECU_Address@autosar_swc_aeb_rtARID_DEF.ObjData_i[11].Offsets.OffsLatManoeuvre@ */ /end MEASUREMENT
/begin MEASUREMENT autosar_swc_aeb_rtARID_DEF.ObjData_i[11].Offsets.OffsLatMplTar "" FLOAT32_IEEE autosar_swc_aeb_CM_single 0 0 -3.4E+38 3.4E+38 ECU_ADDRESS 0xfe4a56d8 /* @ECU_Address@autosar_swc_aeb_rtARID_DEF.ObjData_i[11].Offsets.OffsLatMplTar@ */ /end MEASUREMENT
/begin MEASUREMENT autosar_swc_aeb_rtARID_DEF.ObjData_i[11].Offsets.OffsLatShortPred "" FLOAT32_IEEE autosar_swc_aeb_CM_single 0 0 -3.4E+38 3.4E+38 ECU_ADDRESS 0xfe4a56c0 /* @ECU_Address@autosar_swc_aeb_rtARID_DEF.ObjData_i[11].Offsets.OffsLatShortPred@ */ /end MEASUREMENT
/begin MEASUREMENT autosar_swc_aeb_rtARID_DEF.ObjData_i[11].Offsets.OffsLgtLongPred "" FLOAT32_IEEE autosar_swc_aeb_CM_single 0 0 -3.4E+38 3.4E+38 ECU_ADDRESS 0xfe4a56b4 /* @ECU_Address@autosar_swc_aeb_rtARID_DEF.ObjData_i[11].Offsets.OffsLgtLongPred@ */ /end MEASUREMENT
/begin MEASUREMENT autosar_swc_aeb_rtARID_DEF.ObjData_i[11].Offsets.OffsLgtShortPred "" FLOAT32_IEEE autosar_swc_aeb_CM_single 0 0 -3.4E+38 3.4E+38 ECU_ADDRESS 0xfe4a56bc /* @ECU_Address@autosar_swc_aeb_rtARID_DEF.ObjData_i[11].Offsets.OffsLgtShortPred@ */ /end MEASUREMENT
/begin MEASUREMENT autosar_swc_aeb_rtARID_DEF.ObjData_i[11].PredictionValid "" UBYTE autosar_swc_aeb_CM_logical 0 0 0 1 ECU_ADDRESS 0xfe4a56b1 /* @ECU_Address@autosar_swc_aeb_rtARID_DEF.ObjData_i[11].PredictionValid@ */ /end MEASUREMENT
/begin MEASUREMENT autosar_swc_aeb_rtARID_DEF.ObjData_i[11].ShortPredTime.A "" FLOAT32_IEEE autosar_swc_aeb_CM_single 0 0 -3.4E+38 3.4E+38 ECU_ADDRESS 0xfe4a5714 /* @ECU_Address@autosar_swc_aeb_rtARID_DEF.ObjData_i[11].ShortPredTime.A@ */ /end MEASUREMENT
/begin MEASUREMENT autosar_swc_aeb_rtARID_DEF.ObjData_i[11].ShortPredTime.ALat "" FLOAT32_IEEE autosar_swc_aeb_CM_single 0 0 -3.4E+38 3.4E+38 ECU_ADDRESS 0xfe4a5710 /* @ECU_Address@autosar_swc_aeb_rtARID_DEF.ObjData_i[11].ShortPredTime.ALat@ */ /end MEASUREMENT
/begin MEASUREMENT autosar_swc_aeb_rtARID_DEF.ObjData_i[11].ShortPredTime.ALgt "" FLOAT32_IEEE autosar_swc_aeb_CM_single 0 0 -3.4E+38 3.4E+38 ECU_ADDRESS 0xfe4a570c /* @ECU_Address@autosar_swc_aeb_rtARID_DEF.ObjData_i[11].ShortPredTime.ALgt@ */ /end MEASUREMENT
/begin MEASUREMENT autosar_swc_aeb_rtARID_DEF.ObjData_i[11].ShortPredTime.Crvt "" FLOAT32_IEEE autosar_swc_aeb_CM_single 0 0 -3.4E+38 3.4E+38 ECU_ADDRESS 0xfe4a5718 /* @ECU_Address@autosar_swc_aeb_rtARID_DEF.ObjData_i[11].ShortPredTime.Crvt@ */ /end MEASUREMENT
/begin MEASUREMENT autosar_swc_aeb_rtARID_DEF.ObjData_i[11].ShortPredTime.InPath "" UBYTE autosar_swc_aeb_CM_logical 0 0 0 1 ECU_ADDRESS 0xfe4a5709 /* @ECU_Address@autosar_swc_aeb_rtARID_DEF.ObjData_i[11].ShortPredTime.InPath@ */ /end MEASUREMENT
/begin MEASUREMENT autosar_swc_aeb_rtARID_DEF.ObjData_i[11].ShortPredTime.ObjOnCmngAndBrkg "" UBYTE autosar_swc_aeb_CM_logical 0 0 0 1 ECU_ADDRESS 0xfe4a570a /* @ECU_Address@autosar_swc_aeb_rtARID_DEF.ObjData_i[11].ShortPredTime.ObjOnCmngAndBrkg@ */ /end MEASUREMENT
/begin MEASUREMENT autosar_swc_aeb_rtARID_DEF.ObjData_i[11].ShortPredTime.TTMSelected "" UBYTE autosar_swc_aeb_CM_logical 0 0 0 1 ECU_ADDRESS 0xfe4a5708 /* @ECU_Address@autosar_swc_aeb_rtARID_DEF.ObjData_i[11].ShortPredTime.TTMSelected@ */ /end MEASUREMENT
/begin MEASUREMENT autosar_swc_aeb_rtARID_DEF.ObjData_i[11].ShortPredTime.TimeToMiddleLgt "" FLOAT32_IEEE autosar_swc_aeb_CM_single 0 0 -3.4E+38 3.4E+38 ECU_ADDRESS 0xfe4a5700 /* @ECU_Address@autosar_swc_aeb_rtARID_DEF.ObjData_i[11].ShortPredTime.TimeToMiddleLgt@ */ /end MEASUREMENT
/begin MEASUREMENT autosar_swc_aeb_rtARID_DEF.ObjData_i[11].ShortPredTime.TimeToPassLgt "" FLOAT32_IEEE autosar_swc_aeb_CM_single 0 0 -3.4E+38 3.4E+38 ECU_ADDRESS 0xfe4a5704 /* @ECU_Address@autosar_swc_aeb_rtARID_DEF.ObjData_i[11].ShortPredTime.TimeToPassLgt@ */ /end MEASUREMENT
/begin MEASUREMENT autosar_swc_aeb_rtARID_DEF.ObjData_i[11].ShortPredTime.TimeToReachLgt "" FLOAT32_IEEE autosar_swc_aeb_CM_single 0 0 -3.4E+38 3.4E+38 ECU_ADDRESS 0xfe4a56fc /* @ECU_Address@autosar_swc_aeb_rtARID_DEF.ObjData_i[11].ShortPredTime.TimeToReachLgt@ */ /end MEASUREMENT
/begin MEASUREMENT autosar_swc_aeb_rtARID_DEF.ObjData_i[12].BoundingBox.CosRotation "" FLOAT32_IEEE autosar_swc_aeb_CM_single 0 0 -3.4E+38 3.4E+38 ECU_ADDRESS 0xfe4a5738 /* @ECU_Address@autosar_swc_aeb_rtARID_DEF.ObjData_i[12].BoundingBox.CosRotation@ */ /end MEASUREMENT
/begin MEASUREMENT autosar_swc_aeb_rtARID_DEF.ObjData_i[12].BoundingBox.LengthSideLat "" FLOAT32_IEEE autosar_swc_aeb_CM_single 0 0 -3.4E+38 3.4E+38 ECU_ADDRESS 0xfe4a572c /* @ECU_Address@autosar_swc_aeb_rtARID_DEF.ObjData_i[12].BoundingBox.LengthSideLat@ */ /end MEASUREMENT
/begin MEASUREMENT autosar_swc_aeb_rtARID_DEF.ObjData_i[12].BoundingBox.LengthSideLgt "" FLOAT32_IEEE autosar_swc_aeb_CM_single 0 0 -3.4E+38 3.4E+38 ECU_ADDRESS 0xfe4a5730 /* @ECU_Address@autosar_swc_aeb_rtARID_DEF.ObjData_i[12].BoundingBox.LengthSideLgt@ */ /end MEASUREMENT
/begin MEASUREMENT autosar_swc_aeb_rtARID_DEF.ObjData_i[12].BoundingBox.RotationAngle "" FLOAT32_IEEE autosar_swc_aeb_CM_single 0 0 -3.4E+38 3.4E+38 ECU_ADDRESS 0xfe4a573c /* @ECU_Address@autosar_swc_aeb_rtARID_DEF.ObjData_i[12].BoundingBox.RotationAngle@ */ /end MEASUREMENT
/begin MEASUREMENT autosar_swc_aeb_rtARID_DEF.ObjData_i[12].BoundingBox.SinRotation "" FLOAT32_IEEE autosar_swc_aeb_CM_single 0 0 -3.4E+38 3.4E+38 ECU_ADDRESS 0xfe4a5734 /* @ECU_Address@autosar_swc_aeb_rtARID_DEF.ObjData_i[12].BoundingBox.SinRotation@ */ /end MEASUREMENT
/begin MEASUREMENT autosar_swc_aeb_rtARID_DEF.ObjData_i[12].Idn "" ULONG autosar_swc_aeb_CM_uint32 0 0 0 4294967295 ECU_ADDRESS 0xfe4a57ac /* @ECU_Address@autosar_swc_aeb_rtARID_DEF.ObjData_i[12].Idn@ */ /end MEASUREMENT
/begin MEASUREMENT autosar_swc_aeb_rtARID_DEF.ObjData_i[12].InPathAtCurrentPosition "" UBYTE autosar_swc_aeb_CM_logical 0 0 0 1 ECU_ADDRESS 0xfe4a5740 /* @ECU_Address@autosar_swc_aeb_rtARID_DEF.ObjData_i[12].InPathAtCurrentPosition@ */ /end MEASUREMENT
/begin MEASUREMENT autosar_swc_aeb_rtARID_DEF.ObjData_i[12].PredictionValid "" UBYTE autosar_swc_aeb_CM_logical 0 0 0 1 ECU_ADDRESS 0xfe4a5741 /* @ECU_Address@autosar_swc_aeb_rtARID_DEF.ObjData_i[12].PredictionValid@ */ /end MEASUREMENT
/begin MEASUREMENT autosar_swc_aeb_rtARID_DEF.ObjInitCrvtHeadingAngle "" FLOAT32_IEEE autosar_swc_aeb_CM_single 0 0 -3.4E+38 3.4E+38 LAYOUT COLUMN_DIR MATRIX_DIM 20 ECU_ADDRESS 0xfe4aa4f0 /* @ECU_Address@autosar_swc_aeb_rtARID_DEF.ObjInitCrvtHeadingAngle@ */ /end MEASUREMENT
/begin MEASUREMENT autosar_swc_aeb_rtARID_DEF.ObjInitCrvtHostVLgt "" FLOAT32_IEEE autosar_swc_aeb_CM_single 0 0 -3.4E+38 3.4E+38 ECU_ADDRESS 0xfe4ab5fc /* @ECU_Address@autosar_swc_aeb_rtARID_DEF.ObjInitCrvtHostVLgt@ */ /end MEASUREMENT
/begin MEASUREMENT autosar_swc_aeb_rtARID_DEF.ObjInitCrvtObjIdn "" ULONG autosar_swc_aeb_CM_uint32 0 0 0 4294967295 LAYOUT COLUMN_DIR MATRIX_DIM 20 ECU_ADDRESS 0xfe4ab990 /* @ECU_Address@autosar_swc_aeb_rtARID_DEF.ObjInitCrvtObjIdn@ */ /end MEASUREMENT
/begin MEASUREMENT autosar_swc_aeb_rtARID_DEF.ObjInitCrvtPosnLgt "" FLOAT32_IEEE autosar_swc_aeb_CM_single 0 0 -3.4E+38 3.4E+38 LAYOUT COLUMN_DIR MATRIX_DIM 20 ECU_ADDRESS 0xfe4aa450 /* @ECU_Address@autosar_swc_aeb_rtARID_DEF.ObjInitCrvtPosnLgt@ */ /end MEASUREMENT
/begin MEASUREMENT autosar_swc_aeb_rtARID_DEF.ObjInitCrvtSpd "" FLOAT32_IEEE autosar_swc_aeb_CM_single 0 0 -3.4E+38 3.4E+38 LAYOUT COLUMN_DIR MATRIX_DIM 20 ECU_ADDRESS 0xfe4aa4a0 /* @ECU_Address@autosar_swc_aeb_rtARID_DEF.ObjInitCrvtSpd@ */ /end MEASUREMENT
/begin MEASUREMENT autosar_swc_aeb_rtARID_DEF.Output_DSTATE_e "" UBYTE autosar_swc_aeb_CM_uint8 0 0 0 255 ECU_ADDRESS 0xfe4aba66 /* @ECU_Address@autosar_swc_aeb_rtARID_DEF.Output_DSTATE_e@ */ /end MEASUREMENT
/begin MEASUREMENT autosar_swc_aeb_rtARID_DEF.PrimObjCount "" FLOAT64_IEEE autosar_swc_aeb_CM_double 0 0 -1.7E+308 1.7E+308 ECU_ADDRESS 0xfe4aa3d0 /* @ECU_Address@autosar_swc_aeb_rtARID_DEF.PrimObjCount@ */ /end MEASUREMENT
/begin MEASUREMENT autosar_swc_aeb_rtARID_DEF.PrimObjFirstPosnLgt "" FLOAT32_IEEE autosar_swc_aeb_CM_single 0 0 -3.4E+38 3.4E+38 ECU_ADDRESS 0xfe4ab5f8 /* @ECU_Address@autosar_swc_aeb_rtARID_DEF.PrimObjFirstPosnLgt@ */ /end MEASUREMENT
/begin MEASUREMENT autosar_swc_aeb_rtARID_DEF.SpeedAtIntervention "" FLOAT32_IEEE autosar_swc_aeb_CM_single 0 0 -3.4E+38 3.4E+38 ECU_ADDRESS 0xfe4ab914 /* @ECU_Address@autosar_swc_aeb_rtARID_DEF.SpeedAtIntervention@ */ /end MEASUREMENT
/begin MEASUREMENT autosar_swc_aeb_rtARID_DEF.SpeedAtIntervention_i "" FLOAT32_IEEE autosar_swc_aeb_CM_single 0 0 -3.4E+38 3.4E+38 ECU_ADDRESS 0xfe4ab920 /* @ECU_Address@autosar_swc_aeb_rtARID_DEF.SpeedAtIntervention_i@ */ /end MEASUREMENT
/begin MEASUREMENT autosar_swc_aeb_rtARID_DEF.SpeedRedPrevious "" FLOAT32_IEEE autosar_swc_aeb_CM_single 0 0 -3.4E+38 3.4E+38 ECU_ADDRESS 0xfe4ab918 /* @ECU_Address@autosar_swc_aeb_rtARID_DEF.SpeedRedPrevious@ */ /end MEASUREMENT
/begin MEASUREMENT autosar_swc_aeb_rtARID_DEF.SpeedRedPrevious_p "" FLOAT32_IEEE autosar_swc_aeb_CM_single 0 0 -3.4E+38 3.4E+38 ECU_ADDRESS 0xfe4ab924 /* @ECU_Address@autosar_swc_aeb_rtARID_DEF.SpeedRedPrevious_p@ */ /end MEASUREMENT
/begin MEASUREMENT autosar_swc_aeb_rtARID_DEF.SpeedReduction "" FLOAT32_IEEE autosar_swc_aeb_CM_single 0 0 -3.4E+38 3.4E+38 ECU_ADDRESS 0xfe4ab5f0 /* @ECU_Address@autosar_swc_aeb_rtARID_DEF.SpeedReduction@ */ /end MEASUREMENT
/begin MEASUREMENT autosar_swc_aeb_rtARID_DEF.SpeedReduction_l "" FLOAT32_IEEE autosar_swc_aeb_CM_single 0 0 -3.4E+38 3.4E+38 ECU_ADDRESS 0xfe4ab5f4 /* @ECU_Address@autosar_swc_aeb_rtARID_DEF.SpeedReduction_l@ */ /end MEASUREMENT
/begin MEASUREMENT autosar_swc_aeb_rtARID_DEF.Speed_m "" FLOAT32_IEEE autosar_swc_aeb_CM_single 0 0 -3.4E+38 3.4E+38 LAYOUT COLUMN_DIR MATRIX_DIM 4 ECU_ADDRESS 0xfe4aa570 /* @ECU_Address@autosar_swc_aeb_rtARID_DEF.Speed_m@ */ /end MEASUREMENT
/begin MEASUREMENT autosar_swc_aeb_rtARID_DEF.Time "" FLOAT32_IEEE autosar_swc_aeb_CM_single 0 0 -3.4E+38 3.4E+38 ECU_ADDRESS 0xfe4ab928 /* @ECU_Address@autosar_swc_aeb_rtARID_DEF.Time@ */ /end MEASUREMENT
/begin MEASUREMENT autosar_swc_aeb_rtARID_DEF.TimeNoIntervention "" FLOAT32_IEEE autosar_swc_aeb_CM_single 0 0 -3.4E+38 3.4E+38 ECU_ADDRESS 0xfe4ab910 /* @ECU_Address@autosar_swc_aeb_rtARID_DEF.TimeNoIntervention@ */ /end MEASUREMENT
/begin MEASUREMENT autosar_swc_aeb_rtARID_DEF.TimeNoIntervention_o "" FLOAT32_IEEE autosar_swc_aeb_CM_single 0 0 -3.4E+38 3.4E+38 ECU_ADDRESS 0xfe4ab91c /* @ECU_Address@autosar_swc_aeb_rtARID_DEF.TimeNoIntervention_o@ */ /end MEASUREMENT
/begin MEASUREMENT autosar_swc_aeb_rtARID_DEF.UD_1_DSTATE_g "" FLOAT32_IEEE autosar_swc_aeb_CM_single 0 0 -3.4E+38 3.4E+38 ECU_ADDRESS 0xfe4ab800 /* @ECU_Address@autosar_swc_aeb_rtARID_DEF.UD_1_DSTATE_g@ */ /end MEASUREMENT
/begin MEASUREMENT autosar_swc_aeb_rtARID_DEF.UnitDelay10_DSTATE "" FLOAT32_IEEE autosar_swc_aeb_CM_single 0 0 -3.4E+38 3.4E+38 ECU_ADDRESS 0xfe4ab8d4 /* @ECU_Address@autosar_swc_aeb_rtARID_DEF.UnitDelay10_DSTATE@ */ /end MEASUREMENT
/begin MEASUREMENT autosar_swc_aeb_rtARID_DEF.UnitDelay10_DSTATE_h "" FLOAT32_IEEE autosar_swc_aeb_CM_single 0 0 -3.4E+38 3.4E+38 ECU_ADDRESS 0xfe4ab900 /* @ECU_Address@autosar_swc_aeb_rtARID_DEF.UnitDelay10_DSTATE_h@ */ /end MEASUREMENT
/begin MEASUREMENT autosar_swc_aeb_rtARID_DEF.UnitDelay11_DSTATE "" FLOAT32_IEEE autosar_swc_aeb_CM_single 0 0 -3.4E+38 3.4E+38 ECU_ADDRESS 0xfe4ab8c4 /* @ECU_Address@autosar_swc_aeb_rtARID_DEF.UnitDelay11_DSTATE@ */ /end MEASUREMENT
/begin MEASUREMENT autosar_swc_aeb_rtARID_DEF.UnitDelay11_DSTATE_l "" FLOAT32_IEEE autosar_swc_aeb_CM_single 0 0 -3.4E+38 3.4E+38 ECU_ADDRESS 0xfe4ab8f0 /* @ECU_Address@autosar_swc_aeb_rtARID_DEF.UnitDelay11_DSTATE_l@ */ /end MEASUREMENT
/begin MEASUREMENT autosar_swc_aeb_rtARID_DEF.UnitDelay12_DSTATE "" FLOAT32_IEEE autosar_swc_aeb_CM_single 0 0 -3.4E+38 3.4E+38 ECU_ADDRESS 0xfe4ab8c8 /* @ECU_Address@autosar_swc_aeb_rtARID_DEF.UnitDelay12_DSTATE@ */ /end MEASUREMENT
/begin MEASUREMENT autosar_swc_aeb_rtARID_DEF.UnitDelay12_DSTATE_h "" FLOAT32_IEEE autosar_swc_aeb_CM_single 0 0 -3.4E+38 3.4E+38 ECU_ADDRESS 0xfe4ab8f4 /* @ECU_Address@autosar_swc_aeb_rtARID_DEF.UnitDelay12_DSTATE_h@ */ /end MEASUREMENT
/begin MEASUREMENT autosar_swc_aeb_rtARID_DEF.UnitDelay13_DSTATE "" FLOAT32_IEEE autosar_swc_aeb_CM_single 0 0 -3.4E+38 3.4E+38 ECU_ADDRESS 0xfe4ab8d0 /* @ECU_Address@autosar_swc_aeb_rtARID_DEF.UnitDelay13_DSTATE@ */ /end MEASUREMENT
/begin MEASUREMENT autosar_swc_aeb_rtARID_DEF.UnitDelay13_DSTATE_a "" FLOAT32_IEEE autosar_swc_aeb_CM_single 0 0 -3.4E+38 3.4E+38 ECU_ADDRESS 0xfe4ab8fc /* @ECU_Address@autosar_swc_aeb_rtARID_DEF.UnitDelay13_DSTATE_a@ */ /end MEASUREMENT
/begin MEASUREMENT autosar_swc_aeb_rtARID_DEF.UnitDelay14_DSTATE "" FLOAT32_IEEE autosar_swc_aeb_CM_single 0 0 -3.4E+38 3.4E+38 ECU_ADDRESS 0xfe4ab8b8 /* @ECU_Address@autosar_swc_aeb_rtARID_DEF.UnitDelay14_DSTATE@ */ /end MEASUREMENT
/begin MEASUREMENT autosar_swc_aeb_rtARID_DEF.UnitDelay14_DSTATE_c "" FLOAT32_IEEE autosar_swc_aeb_CM_single 0 0 -3.4E+38 3.4E+38 ECU_ADDRESS 0xfe4ab8e4 /* @ECU_Address@autosar_swc_aeb_rtARID_DEF.UnitDelay14_DSTATE_c@ */ /end MEASUREMENT
/begin MEASUREMENT autosar_swc_aeb_rtARID_DEF.UnitDelay15_DSTATE "" FLOAT32_IEEE autosar_swc_aeb_CM_single 0 0 -3.4E+38 3.4E+38 ECU_ADDRESS 0xfe4ab8c0 /* @ECU_Address@autosar_swc_aeb_rtARID_DEF.UnitDelay15_DSTATE@ */ /end MEASUREMENT
/begin MEASUREMENT autosar_swc_aeb_rtARID_DEF.UnitDelay15_DSTATE_a "" FLOAT32_IEEE autosar_swc_aeb_CM_single 0 0 -3.4E+38 3.4E+38 ECU_ADDRESS 0xfe4ab8ec /* @ECU_Address@autosar_swc_aeb_rtARID_DEF.UnitDelay15_DSTATE_a@ */ /end MEASUREMENT
/begin MEASUREMENT autosar_swc_aeb_rtARID_DEF.UnitDelay17_DSTATE "" FLOAT32_IEEE autosar_swc_aeb_CM_single 0 0 -3.4E+38 3.4E+38 ECU_ADDRESS 0xfe4ab8b4 /* @ECU_Address@autosar_swc_aeb_rtARID_DEF.UnitDelay17_DSTATE@ */ /end MEASUREMENT
/begin MEASUREMENT autosar_swc_aeb_rtARID_DEF.UnitDelay17_DSTATE_e "" FLOAT32_IEEE autosar_swc_aeb_CM_single 0 0 -3.4E+38 3.4E+38 ECU_ADDRESS 0xfe4ab8e0 /* @ECU_Address@autosar_swc_aeb_rtARID_DEF.UnitDelay17_DSTATE_e@ */ /end MEASUREMENT
/begin MEASUREMENT autosar_swc_aeb_rtARID_DEF.UnitDelay19_DSTATE "" FLOAT32_IEEE autosar_swc_aeb_CM_single 0 0 -3.4E+38 3.4E+38 ECU_ADDRESS 0xfe4ab8d8 /* @ECU_Address@autosar_swc_aeb_rtARID_DEF.UnitDelay19_DSTATE@ */ /end MEASUREMENT
/begin MEASUREMENT autosar_swc_aeb_rtARID_DEF.UnitDelay19_DSTATE_a "" FLOAT32_IEEE autosar_swc_aeb_CM_single 0 0 -3.4E+38 3.4E+38 ECU_ADDRESS 0xfe4ab904 /* @ECU_Address@autosar_swc_aeb_rtARID_DEF.UnitDelay19_DSTATE_a@ */ /end MEASUREMENT
/begin MEASUREMENT autosar_swc_aeb_rtARID_DEF.UnitDelay1_DSTATE_a "" FLOAT32_IEEE autosar_swc_aeb_CM_single 0 0 -3.4E+38 3.4E+38 ECU_ADDRESS 0xfe4ab828 /* @ECU_Address@autosar_swc_aeb_rtARID_DEF.UnitDelay1_DSTATE_a@ */ /end MEASUREMENT
/begin MEASUREMENT autosar_swc_aeb_rtARID_DEF.UnitDelay1_DSTATE_ik "" FLOAT32_IEEE autosar_swc_aeb_CM_single 0 0 -3.4E+38 3.4E+38 ECU_ADDRESS 0xfe4ab908 /* @ECU_Address@autosar_swc_aeb_rtARID_DEF.UnitDelay1_DSTATE_ik@ */ /end MEASUREMENT
/begin MEASUREMENT autosar_swc_aeb_rtARID_DEF.UnitDelay1_DSTATE_iy "" FLOAT32_IEEE autosar_swc_aeb_CM_single 0 0 -3.4E+38 3.4E+38 ECU_ADDRESS 0xfe4ab8bc /* @ECU_Address@autosar_swc_aeb_rtARID_DEF.UnitDelay1_DSTATE_iy@ */ /end MEASUREMENT
/begin MEASUREMENT autosar_swc_aeb_rtARID_DEF.UnitDelay1_DSTATE_kj "" FLOAT32_IEEE autosar_swc_aeb_CM_single 0 0 -3.4E+38 3.4E+38 ECU_ADDRESS 0xfe4ab8ac /* @ECU_Address@autosar_swc_aeb_rtARID_DEF.UnitDelay1_DSTATE_kj@ */ /end MEASUREMENT
/begin MEASUREMENT autosar_swc_aeb_rtARID_DEF.UnitDelay1_DSTATE_p "" FLOAT32_IEEE autosar_swc_aeb_CM_single 0 0 -3.4E+38 3.4E+38 ECU_ADDRESS 0xfe4ab8e8 /* @ECU_Address@autosar_swc_aeb_rtARID_DEF.UnitDelay1_DSTATE_p@ */ /end MEASUREMENT
/begin MEASUREMENT autosar_swc_aeb_rtARID_DEF.UnitDelay2_DSTATE_a "" FLOAT32_IEEE autosar_swc_aeb_CM_single 0 0 -3.4E+38 3.4E+38 ECU_ADDRESS 0xfe4ab8b0 /* @ECU_Address@autosar_swc_aeb_rtARID_DEF.UnitDelay2_DSTATE_a@ */ /end MEASUREMENT
/begin MEASUREMENT autosar_swc_aeb_rtARID_DEF.UnitDelay2_DSTATE_g "" ULONG autosar_swc_aeb_CM_uint32 0 0 0 4294967295 ECU_ADDRESS 0xfe4ab9e8 /* @ECU_Address@autosar_swc_aeb_rtARID_DEF.UnitDelay2_DSTATE_g@ */ /end MEASUREMENT
/begin MEASUREMENT autosar_swc_aeb_rtARID_DEF.UnitDelay2_DSTATE_jl "" FLOAT32_IEEE autosar_swc_aeb_CM_single 0 0 -3.4E+38 3.4E+38 ECU_ADDRESS 0xfe4ab8cc /* @ECU_Address@autosar_swc_aeb_rtARID_DEF.UnitDelay2_DSTATE_jl@ */ /end MEASUREMENT
/begin MEASUREMENT autosar_swc_aeb_rtARID_DEF.UnitDelay2_DSTATE_n "" FLOAT32_IEEE autosar_swc_aeb_CM_single 0 0 -3.4E+38 3.4E+38 ECU_ADDRESS 0xfe4ab8f8 /* @ECU_Address@autosar_swc_aeb_rtARID_DEF.UnitDelay2_DSTATE_n@ */ /end MEASUREMENT
/begin MEASUREMENT autosar_swc_aeb_rtARID_DEF.UnitDelay3_DSTATE_e "" FLOAT32_IEEE autosar_swc_aeb_CM_single 0 0 -3.4E+38 3.4E+38 ECU_ADDRESS 0xfe4ab89c /* @ECU_Address@autosar_swc_aeb_rtARID_DEF.UnitDelay3_DSTATE_e@ */ /end MEASUREMENT
/begin MEASUREMENT autosar_swc_aeb_rtARID_DEF.UnitDelay_DSTATE_bj "" FLOAT32_IEEE autosar_swc_aeb_CM_single 0 0 -3.4E+38 3.4E+38 ECU_ADDRESS 0xfe4ab8a8 /* @ECU_Address@autosar_swc_aeb_rtARID_DEF.UnitDelay_DSTATE_bj@ */ /end MEASUREMENT
/begin MEASUREMENT autosar_swc_aeb_rtARID_DEF.UnitDelay_DSTATE_d "" FLOAT32_IEEE autosar_swc_aeb_CM_single 0 0 -3.4E+38 3.4E+38 ECU_ADDRESS 0xfe4ab8a4 /* @ECU_Address@autosar_swc_aeb_rtARID_DEF.UnitDelay_DSTATE_d@ */ /end MEASUREMENT
/begin MEASUREMENT autosar_swc_aeb_rtARID_DEF.UnitDelay_DSTATE_f "" UBYTE autosar_swc_aeb_CM_logical 0 0 0 1 ECU_ADDRESS 0xfe4abadd /* @ECU_Address@autosar_swc_aeb_rtARID_DEF.UnitDelay_DSTATE_f@ */ /end MEASUREMENT
/begin MEASUREMENT autosar_swc_aeb_rtARID_DEF.UnitDelay_DSTATE_hq "" UBYTE autosar_swc_aeb_CM_logical 0 0 0 1 ECU_ADDRESS 0xfe4abad1 /* @ECU_Address@autosar_swc_aeb_rtARID_DEF.UnitDelay_DSTATE_hq@ */ /end MEASUREMENT
/begin MEASUREMENT autosar_swc_aeb_rtARID_DEF.UnitDelay_DSTATE_ig "" FLOAT32_IEEE autosar_swc_aeb_CM_single 0 0 -3.4E+38 3.4E+38 ECU_ADDRESS 0xfe4ab894 /* @ECU_Address@autosar_swc_aeb_rtARID_DEF.UnitDelay_DSTATE_ig@ */ /end MEASUREMENT
/begin MEASUREMENT autosar_swc_aeb_rtARID_DEF.UnitDelay_DSTATE_iu "" FLOAT32_IEEE autosar_swc_aeb_CM_single 0 0 -3.4E+38 3.4E+38 ECU_ADDRESS 0xfe4ab898 /* @ECU_Address@autosar_swc_aeb_rtARID_DEF.UnitDelay_DSTATE_iu@ */ /end MEASUREMENT
/begin MEASUREMENT autosar_swc_aeb_rtARID_DEF.UnitDelay_DSTATE_l4 "" FLOAT32_IEEE autosar_swc_aeb_CM_single 0 0 -3.4E+38 3.4E+38 ECU_ADDRESS 0xfe4ab8a0 /* @ECU_Address@autosar_swc_aeb_rtARID_DEF.UnitDelay_DSTATE_l4@ */ /end MEASUREMENT
/begin MEASUREMENT autosar_swc_aeb_rtARID_DEF.crvterror "" FLOAT32_IEEE autosar_swc_aeb_CM_single 0 0 -3.4E+38 3.4E+38 ECU_ADDRESS 0xfe4ab92c /* @ECU_Address@autosar_swc_aeb_rtARID_DEF.crvterror@ */ /end MEASUREMENT
/begin MEASUREMENT autosar_swc_aeb_rtARID_DEF.is_HostNotinStraightNoCrvt "" UBYTE autosar_swc_aeb_CM_uint8 0 0 0 255 ECU_ADDRESS 0xfe4aba76 /* @ECU_Address@autosar_swc_aeb_rtARID_DEF.is_HostNotinStraightNoCrvt@ */ /end MEASUREMENT
/begin MEASUREMENT autosar_swc_aeb_rtARID_DEF.is_SpeedReductionEval "" UBYTE autosar_swc_aeb_CM_uint8 0 0 0 255 ECU_ADDRESS 0xfe4aba6a /* @ECU_Address@autosar_swc_aeb_rtARID_DEF.is_SpeedReductionEval@ */ /end MEASUREMENT
/begin MEASUREMENT autosar_swc_aeb_rtARID_DEF.is_SpeedReductionEval_b "" UBYTE autosar_swc_aeb_CM_uint8 0 0 0 255 ECU_ADDRESS 0xfe4aba6d /* @ECU_Address@autosar_swc_aeb_rtARID_DEF.is_SpeedReductionEval_b@ */ /end MEASUREMENT
/begin MEASUREMENT autosar_swc_aeb_rtARID_DEF.is_active_c433_autosar_swc_aeb "" UBYTE autosar_swc_aeb_CM_uint8 0 0 0 255 ECU_ADDRESS 0xfe4aba6b /* @ECU_Address@autosar_swc_aeb_rtARID_DEF.is_active_c433_autosar_swc_aeb@ */ /end MEASUREMENT
/begin MEASUREMENT autosar_swc_aeb_rtARID_DEF.is_active_c461_autosar_swc_aeb "" UBYTE autosar_swc_aeb_CM_uint8 0 0 0 255 ECU_ADDRESS 0xfe4aba68 /* @ECU_Address@autosar_swc_aeb_rtARID_DEF.is_active_c461_autosar_swc_aeb@ */ /end MEASUREMENT
/begin MEASUREMENT autosar_swc_aeb_rtARID_DEF.is_active_c515_autosar_swc_aeb "" UBYTE autosar_swc_aeb_CM_uint8 0 0 0 255 ECU_ADDRESS 0xfe4aba70 /* @ECU_Address@autosar_swc_aeb_rtARID_DEF.is_active_c515_autosar_swc_aeb@ */ /end MEASUREMENT
/begin MEASUREMENT autosar_swc_aeb_rtARID_DEF.is_active_c516_autosar_swc_aeb "" UBYTE autosar_swc_aeb_CM_uint8 0 0 0 255 ECU_ADDRESS 0xfe4aba74 /* @ECU_Address@autosar_swc_aeb_rtARID_DEF.is_active_c516_autosar_swc_aeb@ */ /end MEASUREMENT
/begin MEASUREMENT autosar_swc_aeb_rtARID_DEF.is_active_c517_autosar_swc_aeb "" UBYTE autosar_swc_aeb_CM_uint8 0 0 0 255 ECU_ADDRESS 0xfe4aba72 /* @ECU_Address@autosar_swc_aeb_rtARID_DEF.is_active_c517_autosar_swc_aeb@ */ /end MEASUREMENT
/begin MEASUREMENT autosar_swc_aeb_rtARID_DEF.is_active_c518_autosar_swc_aeb "" UBYTE autosar_swc_aeb_CM_uint8 0 0 0 255 ECU_ADDRESS 0xfe4aba6e /* @ECU_Address@autosar_swc_aeb_rtARID_DEF.is_active_c518_autosar_swc_aeb@ */ /end MEASUREMENT
/begin MEASUREMENT autosar_swc_aeb_rtARID_DEF.is_c433_autosar_swc_aeb "" UBYTE autosar_swc_aeb_CM_uint8 0 0 0 255 ECU_ADDRESS 0xfe4aba6c /* @ECU_Address@autosar_swc_aeb_rtARID_DEF.is_c433_autosar_swc_aeb@ */ /end MEASUREMENT
/begin MEASUREMENT autosar_swc_aeb_rtARID_DEF.is_c461_autosar_swc_aeb "" UBYTE autosar_swc_aeb_CM_uint8 0 0 0 255 ECU_ADDRESS 0xfe4aba69 /* @ECU_Address@autosar_swc_aeb_rtARID_DEF.is_c461_autosar_swc_aeb@ */ /end MEASUREMENT
/begin MEASUREMENT autosar_swc_aeb_rtARID_DEF.is_c515_autosar_swc_aeb "" UBYTE autosar_swc_aeb_CM_uint8 0 0 0 255 ECU_ADDRESS 0xfe4aba71 /* @ECU_Address@autosar_swc_aeb_rtARID_DEF.is_c515_autosar_swc_aeb@ */ /end MEASUREMENT
/begin MEASUREMENT autosar_swc_aeb_rtARID_DEF.is_c516_autosar_swc_aeb "" UBYTE autosar_swc_aeb_CM_uint8 0 0 0 255 ECU_ADDRESS 0xfe4aba75 /* @ECU_Address@autosar_swc_aeb_rtARID_DEF.is_c516_autosar_swc_aeb@ */ /end MEASUREMENT
/begin MEASUREMENT autosar_swc_aeb_rtARID_DEF.is_c517_autosar_swc_aeb "" UBYTE autosar_swc_aeb_CM_uint8 0 0 0 255 ECU_ADDRESS 0xfe4aba73 /* @ECU_Address@autosar_swc_aeb_rtARID_DEF.is_c517_autosar_swc_aeb@ */ /end MEASUREMENT
/begin MEASUREMENT autosar_swc_aeb_rtARID_DEF.is_c518_autosar_swc_aeb "" UBYTE autosar_swc_aeb_CM_uint8 0 0 0 255 ECU_ADDRESS 0xfe4aba6f /* @ECU_Address@autosar_swc_aeb_rtARID_DEF.is_c518_autosar_swc_aeb@ */ /end MEASUREMENT
/begin MEASUREMENT autosar_swc_aeb_rtARID_DEF.posn_lat_ "" FLOAT64_IEEE autosar_swc_aeb_CM_double 0 0 -1.7E+308 1.7E+308 LAYOUT COLUMN_DIR MATRIX_DIM 8 ECU_ADDRESS 0xfe4aa350 /* @ECU_Address@autosar_swc_aeb_rtARID_DEF.posn_lat_@ */ /end MEASUREMENT
/begin MEASUREMENT autosar_swc_aeb_rtARID_DEF.time "" FLOAT64_IEEE autosar_swc_aeb_CM_double 0 0 -1.7E+308 1.7E+308 ECU_ADDRESS 0xfe4aa3e8 /* @ECU_Address@autosar_swc_aeb_rtARID_DEF.time@ */ /end MEASUREMENT
/begin MEASUREMENT autosar_swc_aeb_rtARID_DEF.v_lat_ "" FLOAT64_IEEE autosar_swc_aeb_CM_double 0 0 -1.7E+308 1.7E+308 LAYOUT COLUMN_DIR MATRIX_DIM 8 ECU_ADDRESS 0xfe4aa390 /* @ECU_Address@autosar_swc_aeb_rtARID_DEF.v_lat_@ */ /end MEASUREMENT
/begin COMPU_METHOD autosar_swc_aeb_CM_boolean "Q = V" IDENTICAL "%1.0" "" /end COMPU_METHOD
/begin COMPU_METHOD autosar_swc_aeb_CM_double "Q = V" IDENTICAL "%15.10" "" /end COMPU_METHOD
/begin COMPU_METHOD autosar_swc_aeb_CM_logical "Q = V" IDENTICAL "%1.0" "" /end COMPU_METHOD
/begin COMPU_METHOD autosar_swc_aeb_CM_single "Q = V" IDENTICAL "%8.6" "" /end COMPU_METHOD
/begin COMPU_METHOD autosar_swc_aeb_CM_single_1_per_m "Q = V" IDENTICAL "%8.6" "1/m" /end COMPU_METHOD
/begin COMPU_METHOD autosar_swc_aeb_CM_single_m "Q = V" IDENTICAL "%8.6" "m" /end COMPU_METHOD
/begin COMPU_METHOD autosar_swc_aeb_CM_single_m_per_s_ "Q = V" IDENTICAL "%8.6" "m/s?" /end COMPU_METHOD
/begin COMPU_METHOD autosar_swc_aeb_CM_single_rad "Q = V" IDENTICAL "%8.6" "rad" /end COMPU_METHOD
/begin COMPU_METHOD autosar_swc_aeb_CM_single_rad_per_s "Q = V" IDENTICAL "%8.6" "rad/s" /end COMPU_METHOD
/begin COMPU_METHOD autosar_swc_aeb_CM_single_s "Q = V" IDENTICAL "%8.6" "s" /end COMPU_METHOD
/begin COMPU_METHOD autosar_swc_aeb_CM_uint32 "Q = V" IDENTICAL "%10.0" "" /end COMPU_METHOD
/begin COMPU_METHOD autosar_swc_aeb_CM_uint8 "Q = V" IDENTICAL "%3.0" "" /end COMPU_METHOD
/begin RECORD_LAYOUT Record_BOOLEAN FNC_VALUES 1 UBYTE COLUMN_DIR DIRECT /end RECORD_LAYOUT
/begin RECORD_LAYOUT Record_FLOAT32_IEEE FNC_VALUES 1 FLOAT32_IEEE COLUMN_DIR DIRECT /end RECORD_LAYOUT
/begin RECORD_LAYOUT Record_UBYTE FNC_VALUES 1 UBYTE COLUMN_DIR DIRECT /end RECORD_LAYOUT
/begin GROUP autosar_swc_aeb_autosar_swc_aeb_Step_sys_Subsystem_Reference_AEB_Function_Run_DrvrStEstimr_Step_Func_Run_DrvrStEstimr_Step_Func_DrvrStEstimrStep_Func_ActnIntdByDrvr_ActionIntendedByDriver_PathEstimator_CurvatureBasedPath_PredictControlPointsCurvatureBased_SetVehicleStateAtT0 "autosar_swc_aeb/autosar_swc_aeb_Step_sys/Subsystem Reference/AEB Function/Run_DrvrStEstimr_Step_Func/Run_DrvrStEstimr_Step_Func/DrvrStEstimrStep_Func/ActnIntdByDrvr/ActionIntendedByDriver/PathEstimator/CurvatureBasedPath/PredictControlPointsCurvatureBased/SetVehicleStateAtT0"
 /begin SUB_GROUP autosar_swc_aeb_autosar_swc_aeb_Step_sys_Subsystem_Reference_AEB_Function_Run_DrvrStEstimr_Step_Func_Run_DrvrStEstimr_Step_Func_DrvrStEstimrStep_Func_ActnIntdByDrvr_ActionIntendedByDriver_PathEstimator_CurvatureBasedPath_PredictControlPointsCurvatureBased_SetVehicleStateAtT0_SetInitialMotion /end SUB_GROUP
/end GROUP
/begin GROUP autosar_swc_aeb_autosar_swc_aeb_Step_sys_Subsystem_Reference_AEB_Function_Run_DrvrStEstimr_Step_Func_Run_DrvrStEstimr_Step_Func_DrvrStEstimrStep_Func_ActnIntdByDrvr_ActionIntendedByDriver_PathEstimator_CurvatureBasedPath_PredictControlPointsCurvatureBased_SetVehicleStateAtT0_SetInitialMotion "autosar_swc_aeb/autosar_swc_aeb_Step_sys/Subsystem Reference/AEB Function/Run_DrvrStEstimr_Step_Func/Run_DrvrStEstimr_Step_Func/DrvrStEstimrStep_Func/ActnIntdByDrvr/ActionIntendedByDriver/PathEstimator/CurvatureBasedPath/PredictControlPointsCurvatureBased/SetVehicleStateAtT0/SetInitialMotion"
 /begin REF_MEASUREMENT autosar_swc_aeb_rtARID_DEF.UnitDelay10_DSTATE autosar_swc_aeb_rtARID_DEF.UnitDelay11_DSTATE autosar_swc_aeb_rtARID_DEF.UnitDelay12_DSTATE autosar_swc_aeb_rtARID_DEF.UnitDelay13_DSTATE autosar_swc_aeb_rtARID_DEF.UnitDelay14_DSTATE autosar_swc_aeb_rtARID_DEF.UnitDelay15_DSTATE autosar_swc_aeb_rtARID_DEF.UnitDelay17_DSTATE autosar_swc_aeb_rtARID_DEF.UnitDelay19_DSTATE autosar_swc_aeb_rtARID_DEF.UnitDelay1_DSTATE_iy autosar_swc_aeb_rtARID_DEF.UnitDelay2_DSTATE_jl /end REF_MEASUREMENT
/end GROUP
/begin GROUP autosar_swc_aeb_autosar_swc_aeb_Step_sys_Subsystem_Reference_AEB_Function_Run_DrvrStEstimr_Step_Func_Run_DrvrStEstimr_Step_Func_DrvrStEstimrStep_Func_ActnIntdByDrvr_ActionIntendedByDriver_PathEstimator_LowPassFilter "autosar_swc_aeb/autosar_swc_aeb_Step_sys/Subsystem Reference/AEB Function/Run_DrvrStEstimr_Step_Func/Run_DrvrStEstimr_Step_Func/DrvrStEstimrStep_Func/ActnIntdByDrvr/ActionIntendedByDriver/PathEstimator/LowPassFilter"
 /begin SUB_GROUP autosar_swc_aeb_autosar_swc_aeb_Step_sys_Subsystem_Reference_AEB_Function_Run_DrvrStEstimr_Step_Func_Run_DrvrStEstimr_Step_Func_DrvrStEstimrStep_Func_ActnIntdByDrvr_ActionIntendedByDriver_PathEstimator_LowPassFilter_LP1_1 /end SUB_GROUP
 /begin REF_CHARACTERISTIC DSE_PinionAgRateFilConInDrvrStEstimr_Ca /end REF_CHARACTERISTIC
/end GROUP
/begin GROUP autosar_swc_aeb_autosar_swc_aeb_Step_sys_Subsystem_Reference_AEB_Function_Run_DrvrStEstimr_Step_Func_Run_DrvrStEstimr_Step_Func_DrvrStEstimrStep_Func_ActnIntdByDrvr_ActionIntendedByDriver_PathEstimator_LowPassFilter_LP1_1 "autosar_swc_aeb/autosar_swc_aeb_Step_sys/Subsystem Reference/AEB Function/Run_DrvrStEstimr_Step_Func/Run_DrvrStEstimr_Step_Func/DrvrStEstimrStep_Func/ActnIntdByDrvr/ActionIntendedByDriver/PathEstimator/LowPassFilter/LP1_1" /begin REF_MEASUREMENT autosar_swc_aeb_rtARID_DEF.UD_1_DSTATE_g /end REF_MEASUREMENT /end GROUP
/begin GROUP autosar_swc_aeb_autosar_swc_aeb_Step_sys_Subsystem_Reference_AEB_Function_Run_DrvrStEstimr_Step_Func_Run_DrvrStEstimr_Step_Func_DrvrStEstimrStep_Func_ActnIntdByDrvr_ActionIntendedByDriver_PathEstimator_PathSelector "autosar_swc_aeb/autosar_swc_aeb_Step_sys/Subsystem Reference/AEB Function/Run_DrvrStEstimr_Step_Func/Run_DrvrStEstimr_Step_Func/DrvrStEstimrStep_Func/ActnIntdByDrvr/ActionIntendedByDriver/PathEstimator/PathSelector"
 /begin SUB_GROUP autosar_swc_aeb_autosar_swc_aeb_Step_sys_Subsystem_Reference_AEB_Function_Run_DrvrStEstimr_Step_Func_Run_DrvrStEstimr_Step_Func_DrvrStEstimrStep_Func_ActnIntdByDrvr_ActionIntendedByDriver_PathEstimator_PathSelector_CalculatePathUsingRoad /end SUB_GROUP
/end GROUP
/begin GROUP autosar_swc_aeb_autosar_swc_aeb_Step_sys_Subsystem_Reference_AEB_Function_Run_DrvrStEstimr_Step_Func_Run_DrvrStEstimr_Step_Func_DrvrStEstimrStep_Func_ActnIntdByDrvr_ActionIntendedByDriver_PathEstimator_PathSelector_CalculatePathUsingRoad "autosar_swc_aeb/autosar_swc_aeb_Step_sys/Subsystem Reference/AEB Function/Run_DrvrStEstimr_Step_Func/Run_DrvrStEstimr_Step_Func/DrvrStEstimrStep_Func/ActnIntdByDrvr/ActionIntendedByDriver/PathEstimator/PathSelector/CalculatePathUsingRoad"
 /begin SUB_GROUP autosar_swc_aeb_autosar_swc_aeb_Step_sys_Subsystem_Reference_AEB_Function_Run_DrvrStEstimr_Step_Func_Run_DrvrStEstimr_Step_Func_DrvrStEstimrStep_Func_ActnIntdByDrvr_ActionIntendedByDriver_PathEstimator_PathSelector_CalculatePathUsingRoad_DeterminePathCoefficients autosar_swc_aeb_autosar_swc_aeb_Step_sys_Subsystem_Reference_AEB_Function_Run_DrvrStEstimr_Step_Func_Run_DrvrStEstimr_Step_Func_DrvrStEstimrStep_Func_ActnIntdByDrvr_ActionIntendedByDriver_PathEstimator_PathSelector_CalculatePathUsingRoad_VehicleStateAtLookaheadDistance /end SUB_GROUP
/end GROUP
/begin GROUP autosar_swc_aeb_autosar_swc_aeb_Step_sys_Subsystem_Reference_AEB_Function_Run_DrvrStEstimr_Step_Func_Run_DrvrStEstimr_Step_Func_DrvrStEstimrStep_Func_ActnIntdByDrvr_ActionIntendedByDriver_PathEstimator_PathSelector_CalculatePathUsingRoad_DeterminePathCoefficients "autosar_swc_aeb/autosar_swc_aeb_Step_sys/Subsystem Reference/AEB Function/Run_DrvrStEstimr_Step_Func/Run_DrvrStEstimr_Step_Func/DrvrStEstimrStep_Func/ActnIntdByDrvr/ActionIntendedByDriver/PathEstimator/PathSelector/CalculatePathUsingRoad/DeterminePathCoefficients"
 /begin SUB_GROUP autosar_swc_aeb_autosar_swc_aeb_Step_sys_Subsystem_Reference_AEB_Function_Run_DrvrStEstimr_Step_Func_Run_DrvrStEstimr_Step_Func_DrvrStEstimrStep_Func_ActnIntdByDrvr_ActionIntendedByDriver_PathEstimator_PathSelector_CalculatePathUsingRoad_DeterminePathCoefficients_CheckValidity /end SUB_GROUP
/end GROUP
/begin GROUP autosar_swc_aeb_autosar_swc_aeb_Step_sys_Subsystem_Reference_AEB_Function_Run_DrvrStEstimr_Step_Func_Run_DrvrStEstimr_Step_Func_DrvrStEstimrStep_Func_ActnIntdByDrvr_ActionIntendedByDriver_PathEstimator_PathSelector_CalculatePathUsingRoad_DeterminePathCoefficients_CheckValidity "autosar_swc_aeb/autosar_swc_aeb_Step_sys/Subsystem Reference/AEB Function/Run_DrvrStEstimr_Step_Func/Run_DrvrStEstimr_Step_Func/DrvrStEstimrStep_Func/ActnIntdByDrvr/ActionIntendedByDriver/PathEstimator/PathSelector/CalculatePathUsingRoad/DeterminePathCoefficients/CheckValidity" /begin REF_CHARACTERISTIC DSE_LenMinOfPathInDrvrStEstimr_Ca /end REF_CHARACTERISTIC /end GROUP
/begin GROUP autosar_swc_aeb_autosar_swc_aeb_Step_sys_Subsystem_Reference_AEB_Function_Run_DrvrStEstimr_Step_Func_Run_DrvrStEstimr_Step_Func_DrvrStEstimrStep_Func_ActnIntdByDrvr_ActionIntendedByDriver_PathEstimator_PathSelector_CalculatePathUsingRoad_VehicleStateAtLookaheadDistance "autosar_swc_aeb/autosar_swc_aeb_Step_sys/Subsystem Reference/AEB Function/Run_DrvrStEstimr_Step_Func/Run_DrvrStEstimr_Step_Func/DrvrStEstimrStep_Func/ActnIntdByDrvr/ActionIntendedByDriver/PathEstimator/PathSelector/CalculatePathUsingRoad/VehicleStateAtLookaheadDistance"
 /begin SUB_GROUP autosar_swc_aeb_autosar_swc_aeb_Step_sys_Subsystem_Reference_AEB_Function_Run_DrvrStEstimr_Step_Func_Run_DrvrStEstimr_Step_Func_DrvrStEstimrStep_Func_ActnIntdByDrvr_ActionIntendedByDriver_PathEstimator_PathSelector_CalculatePathUsingRoad_VehicleStateAtLookaheadDistance_CalculateVehicleState /end SUB_GROUP
/end GROUP
/begin GROUP autosar_swc_aeb_autosar_swc_aeb_Step_sys_Subsystem_Reference_AEB_Function_Run_DrvrStEstimr_Step_Func_Run_DrvrStEstimr_Step_Func_DrvrStEstimrStep_Func_ActnIntdByDrvr_ActionIntendedByDriver_PathEstimator_PathSelector_CalculatePathUsingRoad_VehicleStateAtLookaheadDistance_CalculateVehicleState "autosar_swc_aeb/autosar_swc_aeb_Step_sys/Subsystem Reference/AEB Function/Run_DrvrStEstimr_Step_Func/Run_DrvrStEstimr_Step_Func/DrvrStEstimrStep_Func/ActnIntdByDrvr/ActionIntendedByDriver/PathEstimator/PathSelector/CalculatePathUsingRoad/VehicleStateAtLookaheadDistance/CalculateVehicleState"
 /begin REF_MEASUREMENT autosar_swc_aeb_rtARID_DEF.DstLatConCoeff autosar_swc_aeb_rtARID_DEF.DstLatFirstCoeff autosar_swc_aeb_rtARID_DEF.DstLatSecCoeff autosar_swc_aeb_rtARID_DEF.DstLatThrdCoeff /end REF_MEASUREMENT
/end GROUP
/begin GROUP autosar_swc_aeb_autosar_swc_aeb_Step_sys_Subsystem_Reference_AEB_Function_Run_DrvrStEstimr_Step_Func_Run_DrvrStEstimr_Step_Func_DrvrStEstimrStep_Func_ActnIntdByDrvr_ActionIntendedByDriver_PathEstimator_RoadBasedPath "autosar_swc_aeb/autosar_swc_aeb_Step_sys/Subsystem Reference/AEB Function/Run_DrvrStEstimr_Step_Func/Run_DrvrStEstimr_Step_Func/DrvrStEstimrStep_Func/ActnIntdByDrvr/ActionIntendedByDriver/PathEstimator/RoadBasedPath"
 /begin SUB_GROUP autosar_swc_aeb_autosar_swc_aeb_Step_sys_Subsystem_Reference_AEB_Function_Run_DrvrStEstimr_Step_Func_Run_DrvrStEstimr_Step_Func_DrvrStEstimrStep_Func_ActnIntdByDrvr_ActionIntendedByDriver_PathEstimator_RoadBasedPath_PredictControlPointsRoadBased /end SUB_GROUP
/end GROUP
/begin GROUP autosar_swc_aeb_autosar_swc_aeb_Step_sys_Subsystem_Reference_AEB_Function_Run_DrvrStEstimr_Step_Func_Run_DrvrStEstimr_Step_Func_DrvrStEstimrStep_Func_ActnIntdByDrvr_ActionIntendedByDriver_PathEstimator_RoadBasedPath_PredictControlPointsRoadBased "autosar_swc_aeb/autosar_swc_aeb_Step_sys/Subsystem Reference/AEB Function/Run_DrvrStEstimr_Step_Func/Run_DrvrStEstimr_Step_Func/DrvrStEstimrStep_Func/ActnIntdByDrvr/ActionIntendedByDriver/PathEstimator/RoadBasedPath/PredictControlPointsRoadBased"
 /begin SUB_GROUP autosar_swc_aeb_autosar_swc_aeb_Step_sys_Subsystem_Reference_AEB_Function_Run_DrvrStEstimr_Step_Func_Run_DrvrStEstimr_Step_Func_DrvrStEstimrStep_Func_ActnIntdByDrvr_ActionIntendedByDriver_PathEstimator_RoadBasedPath_PredictControlPointsRoadBased_CreateOutput autosar_swc_aeb_autosar_swc_aeb_Step_sys_Subsystem_Reference_AEB_Function_Run_DrvrStEstimr_Step_Func_Run_DrvrStEstimr_Step_Func_DrvrStEstimrStep_Func_ActnIntdByDrvr_ActionIntendedByDriver_PathEstimator_RoadBasedPath_PredictControlPointsRoadBased_CreateSplineSegment autosar_swc_aeb_autosar_swc_aeb_Step_sys_Subsystem_Reference_AEB_Function_Run_DrvrStEstimr_Step_Func_Run_DrvrStEstimr_Step_Func_DrvrStEstimrStep_Func_ActnIntdByDrvr_ActionIntendedByDriver_PathEstimator_RoadBasedPath_PredictControlPointsRoadBased_DiagSignals autosar_swc_aeb_autosar_swc_aeb_Step_sys_Subsystem_Reference_AEB_Function_Run_DrvrStEstimr_Step_Func_Run_DrvrStEstimr_Step_Func_DrvrStEstimrStep_Func_ActnIntdByDrvr_ActionIntendedByDriver_PathEstimator_RoadBasedPath_PredictControlPointsRoadBased_SetVehicleStateAtT0 /end SUB_GROUP
/end GROUP
/begin GROUP autosar_swc_aeb_autosar_swc_aeb_Step_sys_Subsystem_Reference_AEB_Function_Run_DrvrStEstimr_Step_Func_Run_DrvrStEstimr_Step_Func_DrvrStEstimrStep_Func_ActnIntdByDrvr_ActionIntendedByDriver_PathEstimator_RoadBasedPath_PredictControlPointsRoadBased_CreateOutput "autosar_swc_aeb/autosar_swc_aeb_Step_sys/Subsystem Reference/AEB Function/Run_DrvrStEstimr_Step_Func/Run_DrvrStEstimr_Step_Func/DrvrStEstimrStep_Func/ActnIntdByDrvr/ActionIntendedByDriver/PathEstimator/RoadBasedPath/PredictControlPointsRoadBased/CreateOutput" /begin REF_MEASUREMENT autosar_swc_aeb_rtARID_DEF.UnitDelay1_DSTATE_ik /end REF_MEASUREMENT /end GROUP
/begin GROUP autosar_swc_aeb_autosar_swc_aeb_Step_sys_Subsystem_Reference_AEB_Function_Run_DrvrStEstimr_Step_Func_Run_DrvrStEstimr_Step_Func_DrvrStEstimrStep_Func_ActnIntdByDrvr_ActionIntendedByDriver_PathEstimator_RoadBasedPath_PredictControlPointsRoadBased_CreateSplineSegment "autosar_swc_aeb/autosar_swc_aeb_Step_sys/Subsystem Reference/AEB Function/Run_DrvrStEstimr_Step_Func/Run_DrvrStEstimr_Step_Func/DrvrStEstimrStep_Func/ActnIntdByDrvr/ActionIntendedByDriver/PathEstimator/RoadBasedPath/PredictControlPointsRoadBased/CreateSplineSegment"
 /begin SUB_GROUP autosar_swc_aeb_autosar_swc_aeb_Step_sys_Subsystem_Reference_AEB_Function_Run_DrvrStEstimr_Step_Func_Run_DrvrStEstimr_Step_Func_DrvrStEstimrStep_Func_ActnIntdByDrvr_ActionIntendedByDriver_PathEstimator_RoadBasedPath_PredictControlPointsRoadBased_CreateSplineSegment_ComputeRoadBasedControlPointAtTime3s /end SUB_GROUP
/end GROUP
/begin GROUP autosar_swc_aeb_autosar_swc_aeb_Step_sys_Subsystem_Reference_AEB_Function_Run_DrvrStEstimr_Step_Func_Run_DrvrStEstimr_Step_Func_DrvrStEstimrStep_Func_ActnIntdByDrvr_ActionIntendedByDriver_PathEstimator_RoadBasedPath_PredictControlPointsRoadBased_CreateSplineSegment_ComputeRoadBasedControlPointAtTime3s "autosar_swc_aeb/autosar_swc_aeb_Step_sys/Subsystem Reference/AEB Function/Run_DrvrStEstimr_Step_Func/Run_DrvrStEstimr_Step_Func/DrvrStEstimrStep_Func/ActnIntdByDrvr/ActionIntendedByDriver/PathEstimator/RoadBasedPath/PredictControlPointsRoadBased/CreateSplineSegment/ComputeRoadBasedControlPointAtTime3s"
 /begin SUB_GROUP autosar_swc_aeb_autosar_swc_aeb_Step_sys_Subsystem_Reference_AEB_Function_Run_DrvrStEstimr_Step_Func_Run_DrvrStEstimr_Step_Func_DrvrStEstimrStep_Func_ActnIntdByDrvr_ActionIntendedByDriver_PathEstimator_RoadBasedPath_PredictControlPointsRoadBased_CreateSplineSegment_ComputeRoadBasedControlPointAtTime3s_VehicleStateAtLookaheadDistance /end SUB_GROUP
/end GROUP
/begin GROUP autosar_swc_aeb_autosar_swc_aeb_Step_sys_Subsystem_Reference_AEB_Function_Run_DrvrStEstimr_Step_Func_Run_DrvrStEstimr_Step_Func_DrvrStEstimrStep_Func_ActnIntdByDrvr_ActionIntendedByDriver_PathEstimator_RoadBasedPath_PredictControlPointsRoadBased_CreateSplineSegment_ComputeRoadBasedControlPointAtTime3s_VehicleStateAtLookaheadDistance "autosar_swc_aeb/autosar_swc_aeb_Step_sys/Subsystem Reference/AEB Function/Run_DrvrStEstimr_Step_Func/Run_DrvrStEstimr_Step_Func/DrvrStEstimrStep_Func/ActnIntdByDrvr/ActionIntendedByDriver/PathEstimator/RoadBasedPath/PredictControlPointsRoadBased/CreateSplineSegment/ComputeRoadBasedControlPointAtTime3s/VehicleStateAtLookaheadDistance"
 /begin SUB_GROUP autosar_swc_aeb_autosar_swc_aeb_Step_sys_Subsystem_Reference_AEB_Function_Run_DrvrStEstimr_Step_Func_Run_DrvrStEstimr_Step_Func_DrvrStEstimrStep_Func_ActnIntdByDrvr_ActionIntendedByDriver_PathEstimator_RoadBasedPath_PredictControlPointsRoadBased_CreateSplineSegment_ComputeRoadBasedControlPointAtTime3s_VehicleStateAtLookaheadDistance_CalculateVehicleState /end SUB_GROUP
/end GROUP
/begin GROUP autosar_swc_aeb_autosar_swc_aeb_Step_sys_Subsystem_Reference_AEB_Function_Run_DrvrStEstimr_Step_Func_Run_DrvrStEstimr_Step_Func_DrvrStEstimrStep_Func_ActnIntdByDrvr_ActionIntendedByDriver_PathEstimator_RoadBasedPath_PredictControlPointsRoadBased_CreateSplineSegment_ComputeRoadBasedControlPointAtTime3s_VehicleStateAtLookaheadDistance_CalculateVehicleState "autosar_swc_aeb/autosar_swc_aeb_Step_sys/Subsystem Reference/AEB Function/Run_DrvrStEstimr_Step_Func/Run_DrvrStEstimr_Step_Func/DrvrStEstimrStep_Func/ActnIntdByDrvr/ActionIntendedByDriver/PathEstimator/RoadBasedPath/PredictControlPointsRoadBased/CreateSplineSegment/ComputeRoadBasedControlPointAtTime3s/VehicleStateAtLookaheadDistance/CalculateVehicleState"
 /begin REF_MEASUREMENT autosar_swc_aeb_rtARID_DEF.DstLatConCoeff_p autosar_swc_aeb_rtARID_DEF.DstLatFirstCoeff_h autosar_swc_aeb_rtARID_DEF.DstLatSecCoeff_f autosar_swc_aeb_rtARID_DEF.DstLatThrdCoeff_c /end REF_MEASUREMENT
/end GROUP
/begin GROUP autosar_swc_aeb_autosar_swc_aeb_Step_sys_Subsystem_Reference_AEB_Function_Run_DrvrStEstimr_Step_Func_Run_DrvrStEstimr_Step_Func_DrvrStEstimrStep_Func_ActnIntdByDrvr_ActionIntendedByDriver_PathEstimator_RoadBasedPath_PredictControlPointsRoadBased_DiagSignals "autosar_swc_aeb/autosar_swc_aeb_Step_sys/Subsystem Reference/AEB Function/Run_DrvrStEstimr_Step_Func/Run_DrvrStEstimr_Step_Func/DrvrStEstimrStep_Func/ActnIntdByDrvr/ActionIntendedByDriver/PathEstimator/RoadBasedPath/PredictControlPointsRoadBased/DiagSignals"
 /begin REF_MEASUREMENT autosar_swc_aeb_rtARID_DEF.Curvature_h autosar_swc_aeb_rtARID_DEF.HeadingAngle_h autosar_swc_aeb_rtARID_DEF.Speed_m /end REF_MEASUREMENT
/end GROUP
/begin GROUP autosar_swc_aeb_autosar_swc_aeb_Step_sys_Subsystem_Reference_AEB_Function_Run_DrvrStEstimr_Step_Func_Run_DrvrStEstimr_Step_Func_DrvrStEstimrStep_Func_ActnIntdByDrvr_ActionIntendedByDriver_PathEstimator_RoadBasedPath_PredictControlPointsRoadBased_SetVehicleStateAtT0 "autosar_swc_aeb/autosar_swc_aeb_Step_sys/Subsystem Reference/AEB Function/Run_DrvrStEstimr_Step_Func/Run_DrvrStEstimr_Step_Func/DrvrStEstimrStep_Func/ActnIntdByDrvr/ActionIntendedByDriver/PathEstimator/RoadBasedPath/PredictControlPointsRoadBased/SetVehicleStateAtT0"
 /begin SUB_GROUP autosar_swc_aeb_autosar_swc_aeb_Step_sys_Subsystem_Reference_AEB_Function_Run_DrvrStEstimr_Step_Func_Run_DrvrStEstimr_Step_Func_DrvrStEstimrStep_Func_ActnIntdByDrvr_ActionIntendedByDriver_PathEstimator_RoadBasedPath_PredictControlPointsRoadBased_SetVehicleStateAtT0_SetInitialMotion /end SUB_GROUP
/end GROUP
/begin GROUP autosar_swc_aeb_autosar_swc_aeb_Step_sys_Subsystem_Reference_AEB_Function_Run_DrvrStEstimr_Step_Func_Run_DrvrStEstimr_Step_Func_DrvrStEstimrStep_Func_ActnIntdByDrvr_ActionIntendedByDriver_PathEstimator_RoadBasedPath_PredictControlPointsRoadBased_SetVehicleStateAtT0_SetInitialMotion "autosar_swc_aeb/autosar_swc_aeb_Step_sys/Subsystem Reference/AEB Function/Run_DrvrStEstimr_Step_Func/Run_DrvrStEstimr_Step_Func/DrvrStEstimrStep_Func/ActnIntdByDrvr/ActionIntendedByDriver/PathEstimator/RoadBasedPath/PredictControlPointsRoadBased/SetVehicleStateAtT0/SetInitialMotion"
 /begin REF_MEASUREMENT autosar_swc_aeb_rtARID_DEF.UnitDelay10_DSTATE_h autosar_swc_aeb_rtARID_DEF.UnitDelay11_DSTATE_l autosar_swc_aeb_rtARID_DEF.UnitDelay12_DSTATE_h autosar_swc_aeb_rtARID_DEF.UnitDelay13_DSTATE_a autosar_swc_aeb_rtARID_DEF.UnitDelay14_DSTATE_c autosar_swc_aeb_rtARID_DEF.UnitDelay15_DSTATE_a autosar_swc_aeb_rtARID_DEF.UnitDelay17_DSTATE_e autosar_swc_aeb_rtARID_DEF.UnitDelay19_DSTATE_a autosar_swc_aeb_rtARID_DEF.UnitDelay1_DSTATE_p autosar_swc_aeb_rtARID_DEF.UnitDelay2_DSTATE_n /end REF_MEASUREMENT
/end GROUP
/begin GROUP autosar_swc_aeb_autosar_swc_aeb_Step_sys_Subsystem_Reference_AEB_Function_Run_DrvrStEstimr_Step_Func_Run_DrvrStEstimr_Step_Func_DrvrStEstimrStep_Func_ForceSensitivityLevelForHostreSimPurposes "autosar_swc_aeb/autosar_swc_aeb_Step_sys/Subsystem Reference/AEB Function/Run_DrvrStEstimr_Step_Func/Run_DrvrStEstimr_Step_Func/DrvrStEstimrStep_Func/ForceSensitivityLevelForHostreSimPurposes" /begin REF_CHARACTERISTIC DSE_BypValForCllsnAidSnvtySeldStsInDrvrStEstimr_Ca /end REF_CHARACTERISTIC /end GROUP
/begin GROUP autosar_swc_aeb_autosar_swc_aeb_Step_sys_Subsystem_Reference_AEB_Function_Run_DrvrStEstimr_Step_Func_Run_DrvrStEstimr_Step_Func_DrvrStEstimrStep_Func_MtnLimnEstimr "autosar_swc_aeb/autosar_swc_aeb_Step_sys/Subsystem Reference/AEB Function/Run_DrvrStEstimr_Step_Func/Run_DrvrStEstimr_Step_Func/DrvrStEstimrStep_Func/MtnLimnEstimr"
 /begin SUB_GROUP autosar_swc_aeb_autosar_swc_aeb_Step_sys_Subsystem_Reference_AEB_Function_Run_DrvrStEstimr_Step_Func_Run_DrvrStEstimr_Step_Func_DrvrStEstimrStep_Func_MtnLimnEstimr_MtnLimnEstimr_Step /end SUB_GROUP
/end GROUP
/begin GROUP autosar_swc_aeb_autosar_swc_aeb_Step_sys_Subsystem_Reference_AEB_Function_Run_DrvrStEstimr_Step_Func_Run_DrvrStEstimr_Step_Func_DrvrStEstimrStep_Func_MtnLimnEstimr_MtnLimnEstimr_Step "autosar_swc_aeb/autosar_swc_aeb_Step_sys/Subsystem Reference/AEB Function/Run_DrvrStEstimr_Step_Func/Run_DrvrStEstimr_Step_Func/DrvrStEstimrStep_Func/MtnLimnEstimr/MtnLimnEstimr_Step"
 /begin SUB_GROUP autosar_swc_aeb_autosar_swc_aeb_Step_sys_Subsystem_Reference_AEB_Function_Run_DrvrStEstimr_Step_Func_Run_DrvrStEstimr_Step_Func_DrvrStEstimrStep_Func_MtnLimnEstimr_MtnLimnEstimr_Step_CheckDriverAggressive autosar_swc_aeb_autosar_swc_aeb_Step_sys_Subsystem_Reference_AEB_Function_Run_DrvrStEstimr_Step_Func_Run_DrvrStEstimr_Step_Func_DrvrStEstimrStep_Func_MtnLimnEstimr_MtnLimnEstimr_Step_MotionLimits_Step autosar_swc_aeb_autosar_swc_aeb_Step_sys_Subsystem_Reference_AEB_Function_Run_DrvrStEstimr_Step_Func_Run_DrvrStEstimr_Step_Func_DrvrStEstimrStep_Func_MtnLimnEstimr_MtnLimnEstimr_Step_SteeringWheelAnglePrediction /end SUB_GROUP
/end GROUP
/begin GROUP autosar_swc_aeb_autosar_swc_aeb_Step_sys_Subsystem_Reference_AEB_Function_Run_DrvrStEstimr_Step_Func_Run_DrvrStEstimr_Step_Func_DrvrStEstimrStep_Func_MtnLimnEstimr_MtnLimnEstimr_Step_CheckDriverAggressive "autosar_swc_aeb/autosar_swc_aeb_Step_sys/Subsystem Reference/AEB Function/Run_DrvrStEstimr_Step_Func/Run_DrvrStEstimr_Step_Func/DrvrStEstimrStep_Func/MtnLimnEstimr/MtnLimnEstimr_Step/CheckDriverAggressive"
 /begin SUB_GROUP autosar_swc_aeb_autosar_swc_aeb_Step_sys_Subsystem_Reference_AEB_Function_Run_DrvrStEstimr_Step_Func_Run_DrvrStEstimr_Step_Func_DrvrStEstimrStep_Func_MtnLimnEstimr_MtnLimnEstimr_Step_CheckDriverAggressive_OffDelayBlock autosar_swc_aeb_autosar_swc_aeb_Step_sys_Subsystem_Reference_AEB_Function_Run_DrvrStEstimr_Step_Func_Run_DrvrStEstimr_Step_Func_DrvrStEstimrStep_Func_MtnLimnEstimr_MtnLimnEstimr_Step_CheckDriverAggressive_OnDelayBlock /end SUB_GROUP
 /begin REF_CHARACTERISTIC DSE_SteerWhlAgSpdHiThdForDrvrActvInDrvrStEstimr_Ca DSE_SteerWhlAgSpdLoThdForDrvrActvInDrvrStEstimr_Ca DSE_TiDlyForDrvrActvInDrvrStEstimr_Ca DSE_TiDlyForSteerWhlAgSpdLoForDrvrActvInDrvrStEstimr_Ca /end REF_CHARACTERISTIC
/end GROUP
/begin GROUP autosar_swc_aeb_autosar_swc_aeb_Step_sys_Subsystem_Reference_AEB_Function_Run_DrvrStEstimr_Step_Func_Run_DrvrStEstimr_Step_Func_DrvrStEstimrStep_Func_MtnLimnEstimr_MtnLimnEstimr_Step_CheckDriverAggressive_OffDelayBlock "autosar_swc_aeb/autosar_swc_aeb_Step_sys/Subsystem Reference/AEB Function/Run_DrvrStEstimr_Step_Func/Run_DrvrStEstimr_Step_Func/DrvrStEstimrStep_Func/MtnLimnEstimr/MtnLimnEstimr_Step/CheckDriverAggressive/OffDelayBlock" /begin REF_MEASUREMENT autosar_swc_aeb_rtARID_DEF.UnitDelay_DSTATE_iu /end REF_MEASUREMENT /end GROUP
/begin GROUP autosar_swc_aeb_autosar_swc_aeb_Step_sys_Subsystem_Reference_AEB_Function_Run_DrvrStEstimr_Step_Func_Run_DrvrStEstimr_Step_Func_DrvrStEstimrStep_Func_MtnLimnEstimr_MtnLimnEstimr_Step_CheckDriverAggressive_OnDelayBlock "autosar_swc_aeb/autosar_swc_aeb_Step_sys/Subsystem Reference/AEB Function/Run_DrvrStEstimr_Step_Func/Run_DrvrStEstimr_Step_Func/DrvrStEstimrStep_Func/MtnLimnEstimr/MtnLimnEstimr_Step/CheckDriverAggressive/OnDelayBlock" /begin REF_MEASUREMENT autosar_swc_aeb_rtARID_DEF.UnitDelay_DSTATE_ig /end REF_MEASUREMENT /end GROUP
/begin GROUP autosar_swc_aeb_autosar_swc_aeb_Step_sys_Subsystem_Reference_AEB_Function_Run_DrvrStEstimr_Step_Func_Run_DrvrStEstimr_Step_Func_DrvrStEstimrStep_Func_MtnLimnEstimr_MtnLimnEstimr_Step_MotionLimits_Step "autosar_swc_aeb/autosar_swc_aeb_Step_sys/Subsystem Reference/AEB Function/Run_DrvrStEstimr_Step_Func/Run_DrvrStEstimr_Step_Func/DrvrStEstimrStep_Func/MtnLimnEstimr/MtnLimnEstimr_Step/MotionLimits_Step"
 /begin SUB_GROUP autosar_swc_aeb_autosar_swc_aeb_Step_sys_Subsystem_Reference_AEB_Function_Run_DrvrStEstimr_Step_Func_Run_DrvrStEstimr_Step_Func_DrvrStEstimrStep_Func_MtnLimnEstimr_MtnLimnEstimr_Step_MotionLimits_Step_MaximumLateralJerkAndAccelerationCalculationEstimation autosar_swc_aeb_autosar_swc_aeb_Step_sys_Subsystem_Reference_AEB_Function_Run_DrvrStEstimr_Step_Func_Run_DrvrStEstimr_Step_Func_DrvrStEstimrStep_Func_MtnLimnEstimr_MtnLimnEstimr_Step_MotionLimits_Step_MinimumLongitudinalAccelerationEstimation autosar_swc_aeb_autosar_swc_aeb_Step_sys_Subsystem_Reference_AEB_Function_Run_DrvrStEstimr_Step_Func_Run_DrvrStEstimr_Step_Func_DrvrStEstimrStep_Func_MtnLimnEstimr_MtnLimnEstimr_Step_MotionLimits_Step_longitudinalPositiveAccelerationEstimation /end SUB_GROUP
/end GROUP
/begin GROUP autosar_swc_aeb_autosar_swc_aeb_Step_sys_Subsystem_Reference_AEB_Function_Run_DrvrStEstimr_Step_Func_Run_DrvrStEstimr_Step_Func_DrvrStEstimrStep_Func_MtnLimnEstimr_MtnLimnEstimr_Step_MotionLimits_Step_MaximumLateralJerkAndAccelerationCalculationEstimation "autosar_swc_aeb/autosar_swc_aeb_Step_sys/Subsystem Reference/AEB Function/Run_DrvrStEstimr_Step_Func/Run_DrvrStEstimr_Step_Func/DrvrStEstimrStep_Func/MtnLimnEstimr/MtnLimnEstimr_Step/MotionLimits_Step/MaximumLateralJerkAndAccelerationCalculationEstimation"
 /begin SUB_GROUP autosar_swc_aeb_autosar_swc_aeb_Step_sys_Subsystem_Reference_AEB_Function_Run_DrvrStEstimr_Step_Func_Run_DrvrStEstimr_Step_Func_DrvrStEstimrStep_Func_MtnLimnEstimr_MtnLimnEstimr_Step_MotionLimits_Step_MaximumLateralJerkAndAccelerationCalculationEstimation_ConvertSteeringLimitsToAccelerationAndCurvatureLimitsComfort autosar_swc_aeb_autosar_swc_aeb_Step_sys_Subsystem_Reference_AEB_Function_Run_DrvrStEstimr_Step_Func_Run_DrvrStEstimr_Step_Func_DrvrStEstimrStep_Func_MtnLimnEstimr_MtnLimnEstimr_Step_MotionLimits_Step_MaximumLateralJerkAndAccelerationCalculationEstimation_ConvertSteeringLimitsToAccelerationAndCurvatureLimitsCritical /end SUB_GROUP
 /begin REF_CHARACTERISTIC DSE_SteerWhlAgDftCmftByDrvrInDrvrStEstimr_Ca DSE_SteerWhlAgMaxByDrvrInDrvrStEstimr_Ca DSE_SteerWhlAgRateDftCmftByDrvrInDrvrStEstimr_Ca DSE_SteerWhlAgRateMaxByDrvrInDrvrStEstimr_Ca /end REF_CHARACTERISTIC
/end GROUP
/begin GROUP autosar_swc_aeb_autosar_swc_aeb_Step_sys_Subsystem_Reference_AEB_Function_Run_DrvrStEstimr_Step_Func_Run_DrvrStEstimr_Step_Func_DrvrStEstimrStep_Func_MtnLimnEstimr_MtnLimnEstimr_Step_MotionLimits_Step_MaximumLateralJerkAndAccelerationCalculationEstimation_ConvertSteeringLimitsToAccelerationAndCurvatureLimitsComfort "autosar_swc_aeb/autosar_swc_aeb_Step_sys/Subsystem Reference/AEB Function/Run_DrvrStEstimr_Step_Func/Run_DrvrStEstimr_Step_Func/DrvrStEstimrStep_Func/MtnLimnEstimr/MtnLimnEstimr_Step/MotionLimits_Step/MaximumLateralJerkAndAccelerationCalculationEstimation/ConvertSteeringLimitsToAccelerationAndCurvatureLimitsComfort"
 /begin REF_CHARACTERISTIC DSE_ALatCmftByDrvrInDrvrStEstimr_Ca DSE_CrvtAbsltCmftMaxInDrvrStEstimr_Ca DSE_CrvtRateAbsltCmftMaxInDrvrStEstimr_Ca DSE_JerkLatCmftByDrvrInDrvrStEstimr_Ca /end REF_CHARACTERISTIC
/end GROUP
/begin GROUP autosar_swc_aeb_autosar_swc_aeb_Step_sys_Subsystem_Reference_AEB_Function_Run_DrvrStEstimr_Step_Func_Run_DrvrStEstimr_Step_Func_DrvrStEstimrStep_Func_MtnLimnEstimr_MtnLimnEstimr_Step_MotionLimits_Step_MaximumLateralJerkAndAccelerationCalculationEstimation_ConvertSteeringLimitsToAccelerationAndCurvatureLimitsCritical "autosar_swc_aeb/autosar_swc_aeb_Step_sys/Subsystem Reference/AEB Function/Run_DrvrStEstimr_Step_Func/Run_DrvrStEstimr_Step_Func/DrvrStEstimrStep_Func/MtnLimnEstimr/MtnLimnEstimr_Step/MotionLimits_Step/MaximumLateralJerkAndAccelerationCalculationEstimation/ConvertSteeringLimitsToAccelerationAndCurvatureLimitsCritical"
 /begin REF_CHARACTERISTIC DSE_ALatCritByDrvrInDrvrStEstimr_Ca DSE_CrvtAbsltMaxInDrvrStEstimr_Ca DSE_CrvtRateAbsltMaxInDrvrStEstimr_Ca DSE_JerkLatCritByDrvrInDrvrStEstimr_Ca /end REF_CHARACTERISTIC
/end GROUP
/begin GROUP autosar_swc_aeb_autosar_swc_aeb_Step_sys_Subsystem_Reference_AEB_Function_Run_DrvrStEstimr_Step_Func_Run_DrvrStEstimr_Step_Func_DrvrStEstimrStep_Func_MtnLimnEstimr_MtnLimnEstimr_Step_MotionLimits_Step_MinimumLongitudinalAccelerationEstimation "autosar_swc_aeb/autosar_swc_aeb_Step_sys/Subsystem Reference/AEB Function/Run_DrvrStEstimr_Step_Func/Run_DrvrStEstimr_Step_Func/DrvrStEstimrStep_Func/MtnLimnEstimr/MtnLimnEstimr_Step/MotionLimits_Step/MinimumLongitudinalAccelerationEstimation"
 /begin SUB_GROUP autosar_swc_aeb_autosar_swc_aeb_Step_sys_Subsystem_Reference_AEB_Function_Run_DrvrStEstimr_Step_Func_Run_DrvrStEstimr_Step_Func_DrvrStEstimrStep_Func_MtnLimnEstimr_MtnLimnEstimr_Step_MotionLimits_Step_MinimumLongitudinalAccelerationEstimation_AccelerationAndJerkLongitudinalNegativeMinimumEstimate autosar_swc_aeb_autosar_swc_aeb_Step_sys_Subsystem_Reference_AEB_Function_Run_DrvrStEstimr_Step_Func_Run_DrvrStEstimr_Step_Func_DrvrStEstimrStep_Func_MtnLimnEstimr_MtnLimnEstimr_Step_MotionLimits_Step_MinimumLongitudinalAccelerationEstimation_AccelerationLongitudinalComfort autosar_swc_aeb_autosar_swc_aeb_Step_sys_Subsystem_Reference_AEB_Function_Run_DrvrStEstimr_Step_Func_Run_DrvrStEstimr_Step_Func_DrvrStEstimrStep_Func_MtnLimnEstimr_MtnLimnEstimr_Step_MotionLimits_Step_MinimumLongitudinalAccelerationEstimation_AccelerationLongitudinalNegativeMeasuredEstimate autosar_swc_aeb_autosar_swc_aeb_Step_sys_Subsystem_Reference_AEB_Function_Run_DrvrStEstimr_Step_Func_Run_DrvrStEstimr_Step_Func_DrvrStEstimrStep_Func_MtnLimnEstimr_MtnLimnEstimr_Step_MotionLimits_Step_MinimumLongitudinalAccelerationEstimation_JerkLongitudinalNegativeMeasuredEstimate /end SUB_GROUP
 /begin REF_CHARACTERISTIC DSE_TiForHalfRednOfMeasInDrvrStEstimr_Ca /end REF_CHARACTERISTIC
/end GROUP
/begin GROUP autosar_swc_aeb_autosar_swc_aeb_Step_sys_Subsystem_Reference_AEB_Function_Run_DrvrStEstimr_Step_Func_Run_DrvrStEstimr_Step_Func_DrvrStEstimrStep_Func_MtnLimnEstimr_MtnLimnEstimr_Step_MotionLimits_Step_MinimumLongitudinalAccelerationEstimation_AccelerationAndJerkLongitudinalNegativeMinimumEstimate "autosar_swc_aeb/autosar_swc_aeb_Step_sys/Subsystem Reference/AEB Function/Run_DrvrStEstimr_Step_Func/Run_DrvrStEstimr_Step_Func/DrvrStEstimrStep_Func/MtnLimnEstimr/MtnLimnEstimr_Step/MotionLimits_Step/MinimumLongitudinalAccelerationEstimation/AccelerationAndJerkLongitudinalNegativeMinimumEstimate"
 /begin REF_CHARACTERISTIC DSE_ANegMaxPlausInDrvrStEstimr_Ca DSE_JerkDecFacByTrlrInDrvrStEstimr_Ca DSE_JerkDecThdDurgFricDecInDrvrStEstimr_Ca DSE_JerkLgtNegMinByVehInDrvrStEstimr_Ca /end REF_CHARACTERISTIC
/end GROUP
/begin GROUP autosar_swc_aeb_autosar_swc_aeb_Step_sys_Subsystem_Reference_AEB_Function_Run_DrvrStEstimr_Step_Func_Run_DrvrStEstimr_Step_Func_DrvrStEstimrStep_Func_MtnLimnEstimr_MtnLimnEstimr_Step_MotionLimits_Step_MinimumLongitudinalAccelerationEstimation_AccelerationLongitudinalComfort "autosar_swc_aeb/autosar_swc_aeb_Step_sys/Subsystem Reference/AEB Function/Run_DrvrStEstimr_Step_Func/Run_DrvrStEstimr_Step_Func/DrvrStEstimrStep_Func/MtnLimnEstimr/MtnLimnEstimr_Step/MotionLimits_Step/MinimumLongitudinalAccelerationEstimation/AccelerationLongitudinalComfort"
 /begin SUB_GROUP autosar_swc_aeb_autosar_swc_aeb_Step_sys_Subsystem_Reference_AEB_Function_Run_DrvrStEstimr_Step_Func_Run_DrvrStEstimr_Step_Func_DrvrStEstimrStep_Func_MtnLimnEstimr_MtnLimnEstimr_Step_MotionLimits_Step_MinimumLongitudinalAccelerationEstimation_AccelerationLongitudinalComfort_CalculatePredictedDriverDeceleration autosar_swc_aeb_autosar_swc_aeb_Step_sys_Subsystem_Reference_AEB_Function_Run_DrvrStEstimr_Step_Func_Run_DrvrStEstimr_Step_Func_DrvrStEstimrStep_Func_MtnLimnEstimr_MtnLimnEstimr_Step_MotionLimits_Step_MinimumLongitudinalAccelerationEstimation_AccelerationLongitudinalComfort_DriverSteeringCompensation /end SUB_GROUP
 /begin REF_CHARACTERISTIC DSE_CmpMaxForPredDecelInDrvrStEstimr_Ca DSE_CmpMinForPredDecelInDrvrStEstimr_Ca DSE_SteerWhlFmpFacInALimnActvInDrvrStEstimr_Ca /end REF_CHARACTERISTIC
/end GROUP
/begin GROUP autosar_swc_aeb_autosar_swc_aeb_Step_sys_Subsystem_Reference_AEB_Function_Run_DrvrStEstimr_Step_Func_Run_DrvrStEstimr_Step_Func_DrvrStEstimrStep_Func_MtnLimnEstimr_MtnLimnEstimr_Step_MotionLimits_Step_MinimumLongitudinalAccelerationEstimation_AccelerationLongitudinalComfort_CalculatePredictedDriverDeceleration "autosar_swc_aeb/autosar_swc_aeb_Step_sys/Subsystem Reference/AEB Function/Run_DrvrStEstimr_Step_Func/Run_DrvrStEstimr_Step_Func/DrvrStEstimrStep_Func/MtnLimnEstimr/MtnLimnEstimr_Step/MotionLimits_Step/MinimumLongitudinalAccelerationEstimation/AccelerationLongitudinalComfort/CalculatePredictedDriverDeceleration"
 /begin SUB_GROUP autosar_swc_aeb_autosar_swc_aeb_Step_sys_Subsystem_Reference_AEB_Function_Run_DrvrStEstimr_Step_Func_Run_DrvrStEstimr_Step_Func_DrvrStEstimrStep_Func_MtnLimnEstimr_MtnLimnEstimr_Step_MotionLimits_Step_MinimumLongitudinalAccelerationEstimation_AccelerationLongitudinalComfort_CalculatePredictedDriverDeceleration_HighSensitivityEstimate autosar_swc_aeb_autosar_swc_aeb_Step_sys_Subsystem_Reference_AEB_Function_Run_DrvrStEstimr_Step_Func_Run_DrvrStEstimr_Step_Func_DrvrStEstimrStep_Func_MtnLimnEstimr_MtnLimnEstimr_Step_MotionLimits_Step_MinimumLongitudinalAccelerationEstimation_AccelerationLongitudinalComfort_CalculatePredictedDriverDeceleration_LowSensitivityEstimate autosar_swc_aeb_autosar_swc_aeb_Step_sys_Subsystem_Reference_AEB_Function_Run_DrvrStEstimr_Step_Func_Run_DrvrStEstimr_Step_Func_DrvrStEstimrStep_Func_MtnLimnEstimr_MtnLimnEstimr_Step_MotionLimits_Step_MinimumLongitudinalAccelerationEstimation_AccelerationLongitudinalComfort_CalculatePredictedDriverDeceleration_NormalSensitivityEstimate /end SUB_GROUP
 /begin REF_CHARACTERISTIC DSE_PredDecelDftInCtyDrvgInDrvrStEstimr_Ca DSE_PredDecelHiInCtyDrvgInDrvrStEstimr_Ca DSE_PredDecelLoInCtyDrvgInDrvrStEstimr_Ca /end REF_CHARACTERISTIC
/end GROUP
/begin GROUP autosar_swc_aeb_autosar_swc_aeb_Step_sys_Subsystem_Reference_AEB_Function_Run_DrvrStEstimr_Step_Func_Run_DrvrStEstimr_Step_Func_DrvrStEstimrStep_Func_MtnLimnEstimr_MtnLimnEstimr_Step_MotionLimits_Step_MinimumLongitudinalAccelerationEstimation_AccelerationLongitudinalComfort_CalculatePredictedDriverDeceleration_HighSensitivityEstimate "autosar_swc_aeb/autosar_swc_aeb_Step_sys/Subsystem Reference/AEB Function/Run_DrvrStEstimr_Step_Func/Run_DrvrStEstimr_Step_Func/DrvrStEstimrStep_Func/MtnLimnEstimr/MtnLimnEstimr_Step/MotionLimits_Step/MinimumLongitudinalAccelerationEstimation/AccelerationLongitudinalComfort/CalculatePredictedDriverDeceleration/HighSensitivityEstimate"
 /begin REF_CHARACTERISTIC DSE_LimOfPredDecelHiInDrvrStEstimr_Ca DSE_OffsOfPredDecelHiInDrvrStEstimr_Ca DSE_SlopOfPredDecelHiInDrvrStEstimr_Ca /end REF_CHARACTERISTIC
/end GROUP
/begin GROUP autosar_swc_aeb_autosar_swc_aeb_Step_sys_Subsystem_Reference_AEB_Function_Run_DrvrStEstimr_Step_Func_Run_DrvrStEstimr_Step_Func_DrvrStEstimrStep_Func_MtnLimnEstimr_MtnLimnEstimr_Step_MotionLimits_Step_MinimumLongitudinalAccelerationEstimation_AccelerationLongitudinalComfort_CalculatePredictedDriverDeceleration_LowSensitivityEstimate "autosar_swc_aeb/autosar_swc_aeb_Step_sys/Subsystem Reference/AEB Function/Run_DrvrStEstimr_Step_Func/Run_DrvrStEstimr_Step_Func/DrvrStEstimrStep_Func/MtnLimnEstimr/MtnLimnEstimr_Step/MotionLimits_Step/MinimumLongitudinalAccelerationEstimation/AccelerationLongitudinalComfort/CalculatePredictedDriverDeceleration/LowSensitivityEstimate"
 /begin REF_CHARACTERISTIC DSE_LimOfPredDecelLoInDrvrStEstimr_Ca DSE_OffsOfPredDecelLoInDrvrStEstimr_Ca DSE_SlopOfPredDecelLoInDrvrStEstimr_Ca /end REF_CHARACTERISTIC
/end GROUP
/begin GROUP autosar_swc_aeb_autosar_swc_aeb_Step_sys_Subsystem_Reference_AEB_Function_Run_DrvrStEstimr_Step_Func_Run_DrvrStEstimr_Step_Func_DrvrStEstimrStep_Func_MtnLimnEstimr_MtnLimnEstimr_Step_MotionLimits_Step_MinimumLongitudinalAccelerationEstimation_AccelerationLongitudinalComfort_CalculatePredictedDriverDeceleration_NormalSensitivityEstimate "autosar_swc_aeb/autosar_swc_aeb_Step_sys/Subsystem Reference/AEB Function/Run_DrvrStEstimr_Step_Func/Run_DrvrStEstimr_Step_Func/DrvrStEstimrStep_Func/MtnLimnEstimr/MtnLimnEstimr_Step/MotionLimits_Step/MinimumLongitudinalAccelerationEstimation/AccelerationLongitudinalComfort/CalculatePredictedDriverDeceleration/NormalSensitivityEstimate"
 /begin REF_CHARACTERISTIC DSE_LimOfPredDecelDftInDrvrStEstimr_Ca DSE_OffsOfPredDecelDftInDrvrStEstimr_Ca DSE_SlopOfPredDecelDftInDrvrStEstimr_Ca /end REF_CHARACTERISTIC
/end GROUP
/begin GROUP autosar_swc_aeb_autosar_swc_aeb_Step_sys_Subsystem_Reference_AEB_Function_Run_DrvrStEstimr_Step_Func_Run_DrvrStEstimr_Step_Func_DrvrStEstimrStep_Func_MtnLimnEstimr_MtnLimnEstimr_Step_MotionLimits_Step_MinimumLongitudinalAccelerationEstimation_AccelerationLongitudinalComfort_DriverSteeringCompensation "autosar_swc_aeb/autosar_swc_aeb_Step_sys/Subsystem Reference/AEB Function/Run_DrvrStEstimr_Step_Func/Run_DrvrStEstimr_Step_Func/DrvrStEstimrStep_Func/MtnLimnEstimr/MtnLimnEstimr_Step/MotionLimits_Step/MinimumLongitudinalAccelerationEstimation/AccelerationLongitudinalComfort/DriverSteeringCompensation"
 /begin REF_CHARACTERISTIC DSE_SteerWhlCmpFacMaxForALimnInDrvrStEstimr_Ca DSE_SteerWhlCmpFacMinForALimnInDrvrStEstimr_Ca /end REF_CHARACTERISTIC
/end GROUP
/begin GROUP autosar_swc_aeb_autosar_swc_aeb_Step_sys_Subsystem_Reference_AEB_Function_Run_DrvrStEstimr_Step_Func_Run_DrvrStEstimr_Step_Func_DrvrStEstimrStep_Func_MtnLimnEstimr_MtnLimnEstimr_Step_MotionLimits_Step_MinimumLongitudinalAccelerationEstimation_AccelerationLongitudinalNegativeMeasuredEstimate "autosar_swc_aeb/autosar_swc_aeb_Step_sys/Subsystem Reference/AEB Function/Run_DrvrStEstimr_Step_Func/Run_DrvrStEstimr_Step_Func/DrvrStEstimrStep_Func/MtnLimnEstimr/MtnLimnEstimr_Step/MotionLimits_Step/MinimumLongitudinalAccelerationEstimation/AccelerationLongitudinalNegativeMeasuredEstimate" /begin REF_CHARACTERISTIC DSE_ANegMaxPlausInDrvrStEstimr_Ca /end REF_CHARACTERISTIC /begin REF_MEASUREMENT autosar_swc_aeb_rtARID_DEF.UnitDelay_DSTATE_d /end REF_MEASUREMENT /end GROUP
/begin GROUP autosar_swc_aeb_autosar_swc_aeb_Step_sys_Subsystem_Reference_AEB_Function_Run_DrvrStEstimr_Step_Func_Run_DrvrStEstimr_Step_Func_DrvrStEstimrStep_Func_MtnLimnEstimr_MtnLimnEstimr_Step_MotionLimits_Step_MinimumLongitudinalAccelerationEstimation_JerkLongitudinalNegativeMeasuredEstimate "autosar_swc_aeb/autosar_swc_aeb_Step_sys/Subsystem Reference/AEB Function/Run_DrvrStEstimr_Step_Func/Run_DrvrStEstimr_Step_Func/DrvrStEstimrStep_Func/MtnLimnEstimr/MtnLimnEstimr_Step/MotionLimits_Step/MinimumLongitudinalAccelerationEstimation/JerkLongitudinalNegativeMeasuredEstimate"
 /begin SUB_GROUP autosar_swc_aeb_autosar_swc_aeb_Step_sys_Subsystem_Reference_AEB_Function_Run_DrvrStEstimr_Step_Func_Run_DrvrStEstimr_Step_Func_DrvrStEstimrStep_Func_MtnLimnEstimr_MtnLimnEstimr_Step_MotionLimits_Step_MinimumLongitudinalAccelerationEstimation_JerkLongitudinalNegativeMeasuredEstimate_JerkEstimate /end SUB_GROUP
 /begin REF_CHARACTERISTIC DSE_JerkNegMaxPlausInDrvrStEstimr_Ca /end REF_CHARACTERISTIC
 /begin REF_MEASUREMENT autosar_swc_aeb_rtARID_DEF.UnitDelay_DSTATE_l4 /end REF_MEASUREMENT
/end GROUP
/begin GROUP autosar_swc_aeb_autosar_swc_aeb_Step_sys_Subsystem_Reference_AEB_Function_Run_DrvrStEstimr_Step_Func_Run_DrvrStEstimr_Step_Func_DrvrStEstimrStep_Func_MtnLimnEstimr_MtnLimnEstimr_Step_MotionLimits_Step_MinimumLongitudinalAccelerationEstimation_JerkLongitudinalNegativeMeasuredEstimate_JerkEstimate "autosar_swc_aeb/autosar_swc_aeb_Step_sys/Subsystem Reference/AEB Function/Run_DrvrStEstimr_Step_Func/Run_DrvrStEstimr_Step_Func/DrvrStEstimrStep_Func/MtnLimnEstimr/MtnLimnEstimr_Step/MotionLimits_Step/MinimumLongitudinalAccelerationEstimation/JerkLongitudinalNegativeMeasuredEstimate/JerkEstimate"
 /begin SUB_GROUP autosar_swc_aeb_autosar_swc_aeb_Step_sys_Subsystem_Reference_AEB_Function_Run_DrvrStEstimr_Step_Func_Run_DrvrStEstimr_Step_Func_DrvrStEstimrStep_Func_MtnLimnEstimr_MtnLimnEstimr_Step_MotionLimits_Step_MinimumLongitudinalAccelerationEstimation_JerkLongitudinalNegativeMeasuredEstimate_JerkEstimate_DelayAcceleration /end SUB_GROUP
/end GROUP
/begin GROUP autosar_swc_aeb_autosar_swc_aeb_Step_sys_Subsystem_Reference_AEB_Function_Run_DrvrStEstimr_Step_Func_Run_DrvrStEstimr_Step_Func_DrvrStEstimrStep_Func_MtnLimnEstimr_MtnLimnEstimr_Step_MotionLimits_Step_MinimumLongitudinalAccelerationEstimation_JerkLongitudinalNegativeMeasuredEstimate_JerkEstimate_DelayAcceleration "autosar_swc_aeb/autosar_swc_aeb_Step_sys/Subsystem Reference/AEB Function/Run_DrvrStEstimr_Step_Func/Run_DrvrStEstimr_Step_Func/DrvrStEstimrStep_Func/MtnLimnEstimr/MtnLimnEstimr_Step/MotionLimits_Step/MinimumLongitudinalAccelerationEstimation/JerkLongitudinalNegativeMeasuredEstimate/JerkEstimate/DelayAcceleration"
 /begin REF_MEASUREMENT autosar_swc_aeb_rtARID_DEF.UnitDelay1_DSTATE_kj autosar_swc_aeb_rtARID_DEF.UnitDelay2_DSTATE_a autosar_swc_aeb_rtARID_DEF.UnitDelay3_DSTATE_e autosar_swc_aeb_rtARID_DEF.UnitDelay_DSTATE_bj /end REF_MEASUREMENT
/end GROUP
/begin GROUP autosar_swc_aeb_autosar_swc_aeb_Step_sys_Subsystem_Reference_AEB_Function_Run_DrvrStEstimr_Step_Func_Run_DrvrStEstimr_Step_Func_DrvrStEstimrStep_Func_MtnLimnEstimr_MtnLimnEstimr_Step_MotionLimits_Step_longitudinalPositiveAccelerationEstimation "autosar_swc_aeb/autosar_swc_aeb_Step_sys/Subsystem Reference/AEB Function/Run_DrvrStEstimr_Step_Func/Run_DrvrStEstimr_Step_Func/DrvrStEstimrStep_Func/MtnLimnEstimr/MtnLimnEstimr_Step/MotionLimits_Step/longitudinalPositiveAccelerationEstimation"
 /begin REF_CHARACTERISTIC DSE_ALgtPosCmftDurgBrkgInDrvrStEstimr_Ca DSE_ALgtPosCmftDurgNotBrkgInDrvrStEstimr_Ca DSE_ALgtPosMaxDurgBrkgInDrvrStEstimr_Ca DSE_ALgtPosMaxDurgNotBrkgInDrvrStEstimr_Ca DSE_JerkLgtPosMinByVehInDrvrStEstimr_Ca /end REF_CHARACTERISTIC
/end GROUP
/begin GROUP autosar_swc_aeb_autosar_swc_aeb_Step_sys_Subsystem_Reference_AEB_Function_Run_DrvrStEstimr_Step_Func_Run_DrvrStEstimr_Step_Func_DrvrStEstimrStep_Func_MtnLimnEstimr_MtnLimnEstimr_Step_SteeringWheelAnglePrediction "autosar_swc_aeb/autosar_swc_aeb_Step_sys/Subsystem Reference/AEB Function/Run_DrvrStEstimr_Step_Func/Run_DrvrStEstimr_Step_Func/DrvrStEstimrStep_Func/MtnLimnEstimr/MtnLimnEstimr_Step/SteeringWheelAnglePrediction"
 /begin SUB_GROUP autosar_swc_aeb_autosar_swc_aeb_Step_sys_Subsystem_Reference_AEB_Function_Run_DrvrStEstimr_Step_Func_Run_DrvrStEstimr_Step_Func_DrvrStEstimrStep_Func_MtnLimnEstimr_MtnLimnEstimr_Step_SteeringWheelAnglePrediction_TimeForSteeringPrediction /end SUB_GROUP
/end GROUP
/begin GROUP autosar_swc_aeb_autosar_swc_aeb_Step_sys_Subsystem_Reference_AEB_Function_Run_DrvrStEstimr_Step_Func_Run_DrvrStEstimr_Step_Func_DrvrStEstimrStep_Func_MtnLimnEstimr_MtnLimnEstimr_Step_SteeringWheelAnglePrediction_TimeForSteeringPrediction "autosar_swc_aeb/autosar_swc_aeb_Step_sys/Subsystem Reference/AEB Function/Run_DrvrStEstimr_Step_Func/Run_DrvrStEstimr_Step_Func/DrvrStEstimrStep_Func/MtnLimnEstimr/MtnLimnEstimr_Step/SteeringWheelAnglePrediction/TimeForSteeringPrediction" /begin REF_CHARACTERISTIC DSE_SteerWhlAgSpdHldTiByDrvrInDrvrStEstimr_Ca /end REF_CHARACTERISTIC /end GROUP
/begin GROUP autosar_swc_aeb_autosar_swc_aeb_Step_sys_Subsystem_Reference_AEB_Function_Sceniaro_Analysis "autosar_swc_aeb/autosar_swc_aeb_Step_sys/Subsystem Reference/AEB Function/Sceniaro Analysis"
 /begin REF_CHARACTERISTIC P_AEB_C2CSCPVehVaildVLat P_AEB_C2SCPVaildAge P_AEB_C2SCPVaildSpeed P_AEB_CBNAOBicycleVaildVLat P_AEB_CBNAVaildHeadingError P_AEB_CBRsVaildCounter P_AEB_CBRsVaildHeading P_AEB_CCFT20VaildR P_AEB_CCFT30VaildR P_AEB_CCFTVaildTTC P_AEB_CCFTVaildVLat P_AEB_CCFTVehVaildHeadingAngle P_AEB_CCFTVehVaildPosnLat P_AEB_CCFTVehVaildSpd P_AEB_CCRsVaildCounter P_AEB_CCRsVaildHeading P_AEB_CPNCOPedVaildVLat P_AEB_CPRsVaildCounter P_AEB_CPTA20VaildR P_AEB_CPTA30VaildR P_AEB_CPTALFVaildYawAngle P_AEB_CPTALN20PedVaildPosnLat P_AEB_CPTALN30MaxPedVaildPosnLat P_AEB_CPTALN30MinPedVaildPosnLat P_AEB_CPTAVaildSPEED P_AEB_CPTAVaildTTC P_AEB_CSTA20VaildR P_AEB_CSTA30VaildR P_AEB_CSTALNBicycleVaildHeadingAngle P_AEB_CSTALNBicycleVaildPosnLat P_AEB_CSTALNBicycleVaildSpd P_AEB_CSTARNBicycleVaildHeadingAngle P_AEB_CSTARNBicycleVaildPosnLat P_AEB_CSTARNBicycleVaildSpd P_AEB_CSTAVaildTTC P_AEB_CSTAVaildVLat P_AEB_CrossStopSpdCyclist P_AEB_CrossStopSpdPed P_AEB_CrossStopSwitch P_AEB_CrvtChangeVaildValue P_AEB_FenchAndFreesPaceSwitch P_AEB_HostCrvtStableSwitch P_AEB_NotStragihtRadius P_AEB_PedOutSideSwitch P_AEB_SCPVaildHeadingError P_AEB_StragihtRadius P_AEB_TAPHostVaildSpd P_AEB_TAPVaildPosnLat /end REF_CHARACTERISTIC
 /begin REF_MEASUREMENT AEB_SceniaroAnalysisVersion autosar_swc_aeb_rtARID_DEF.LockId autosar_swc_aeb_rtARID_DEF.LockId_g autosar_swc_aeb_rtARID_DEF.ObjInitCrvtHeadingAngle autosar_swc_aeb_rtARID_DEF.ObjInitCrvtHostVLgt autosar_swc_aeb_rtARID_DEF.ObjInitCrvtObjIdn autosar_swc_aeb_rtARID_DEF.ObjInitCrvtPosnLgt autosar_swc_aeb_rtARID_DEF.ObjInitCrvtSpd autosar_swc_aeb_rtARID_DEF.PrimObjCount autosar_swc_aeb_rtARID_DEF.PrimObjFirstPosnLgt autosar_swc_aeb_rtARID_DEF.Time autosar_swc_aeb_rtARID_DEF.UnitDelay1_DSTATE_a autosar_swc_aeb_rtARID_DEF.UnitDelay2_DSTATE_g autosar_swc_aeb_rtARID_DEF.UnitDelay_DSTATE_hq autosar_swc_aeb_rtARID_DEF.crvterror autosar_swc_aeb_rtARID_DEF.is_HostNotinStraightNoCrvt autosar_swc_aeb_rtARID_DEF.is_active_c515_autosar_swc_aeb autosar_swc_aeb_rtARID_DEF.is_active_c516_autosar_swc_aeb autosar_swc_aeb_rtARID_DEF.is_active_c517_autosar_swc_aeb autosar_swc_aeb_rtARID_DEF.is_active_c518_autosar_swc_aeb autosar_swc_aeb_rtARID_DEF.is_c515_autosar_swc_aeb autosar_swc_aeb_rtARID_DEF.is_c516_autosar_swc_aeb autosar_swc_aeb_rtARID_DEF.is_c517_autosar_swc_aeb autosar_swc_aeb_rtARID_DEF.is_c518_autosar_swc_aeb autosar_swc_aeb_rtARID_DEF.posn_lat_ autosar_swc_aeb_rtARID_DEF.time autosar_swc_aeb_rtARID_DEF.v_lat_ /end REF_MEASUREMENT
/end GROUP
/begin GROUP autosar_swc_aeb_autosar_swc_aeb_Step_sys_Subsystem_Reference_AEB_SafetyFunctionUpdateCnt "autosar_swc_aeb/autosar_swc_aeb_Step_sys/Subsystem Reference/AEB_SafetyFunctionUpdateCnt"
 /begin SUB_GROUP autosar_swc_aeb_autosar_swc_aeb_Step_sys_Subsystem_Reference_AEB_SafetyFunctionUpdateCnt_Increment_Real_World /end SUB_GROUP
 /begin REF_MEASUREMENT AEB_SafetyFunctionUpdateCnt autosar_swc_aeb_rtARID_DEF.Output_DSTATE_e /end REF_MEASUREMENT
/end GROUP
/begin GROUP autosar_swc_aeb_autosar_swc_aeb_Step_sys_Subsystem_Reference_AEB_SafetyFunctionUpdateCnt_Increment_Real_World "autosar_swc_aeb/autosar_swc_aeb_Step_sys/Subsystem Reference/AEB_SafetyFunctionUpdateCnt/Increment\nReal World" /begin REF_MEASUREMENT AEB_SafetyFunctionUpdateCnt /end REF_MEASUREMENT /end GROUP
/begin GROUP autosar_swc_aeb_autosar_swc_aeb_Step_sys_Subsystem_Reference_AM "autosar_swc_aeb/autosar_swc_aeb_Step_sys/Subsystem Reference/AM"
 /begin SUB_GROUP autosar_swc_aeb_autosar_swc_aeb_Step_sys_Subsystem_Reference_AM_BrkArb /end SUB_GROUP
/end GROUP
/begin GROUP autosar_swc_aeb_autosar_swc_aeb_Step_sys_Subsystem_Reference_AM_BrkArb "autosar_swc_aeb/autosar_swc_aeb_Step_sys/Subsystem Reference/AM/BrkArb"
 /begin SUB_GROUP autosar_swc_aeb_autosar_swc_aeb_Step_sys_Subsystem_Reference_AM_BrkArb_AutnmsBrakingArb autosar_swc_aeb_autosar_swc_aeb_Step_sys_Subsystem_Reference_AM_BrkArb_SpeedLimitation /end SUB_GROUP
/end GROUP
/begin GROUP autosar_swc_aeb_autosar_swc_aeb_Step_sys_Subsystem_Reference_AM_BrkArb_AutnmsBrakingArb "autosar_swc_aeb/autosar_swc_aeb_Step_sys/Subsystem Reference/AM/BrkArb/AutnmsBrakingArb"
 /begin SUB_GROUP autosar_swc_aeb_autosar_swc_aeb_Step_sys_Subsystem_Reference_AM_BrkArb_AutnmsBrakingArb_SpeedLimitation /end SUB_GROUP
/end GROUP
/begin GROUP autosar_swc_aeb_autosar_swc_aeb_Step_sys_Subsystem_Reference_AM_BrkArb_AutnmsBrakingArb_SpeedLimitation "autosar_swc_aeb/autosar_swc_aeb_Step_sys/Subsystem Reference/AM/BrkArb/AutnmsBrakingArb/SpeedLimitation"
 /begin REF_MEASUREMENT autosar_swc_aeb_rtARID_DEF.SpeedAtIntervention_i autosar_swc_aeb_rtARID_DEF.SpeedRedPrevious_p autosar_swc_aeb_rtARID_DEF.SpeedReduction_l autosar_swc_aeb_rtARID_DEF.TimeNoIntervention_o autosar_swc_aeb_rtARID_DEF.is_SpeedReductionEval_b autosar_swc_aeb_rtARID_DEF.is_active_c433_autosar_swc_aeb autosar_swc_aeb_rtARID_DEF.is_c433_autosar_swc_aeb /end REF_MEASUREMENT
/end GROUP
/begin GROUP autosar_swc_aeb_autosar_swc_aeb_Step_sys_Subsystem_Reference_AM_BrkArb_SpeedLimitation "autosar_swc_aeb/autosar_swc_aeb_Step_sys/Subsystem Reference/AM/BrkArb/SpeedLimitation"
 /begin REF_MEASUREMENT autosar_swc_aeb_rtARID_DEF.SpeedAtIntervention autosar_swc_aeb_rtARID_DEF.SpeedRedPrevious autosar_swc_aeb_rtARID_DEF.SpeedReduction autosar_swc_aeb_rtARID_DEF.TimeNoIntervention autosar_swc_aeb_rtARID_DEF.UnitDelay_DSTATE_f autosar_swc_aeb_rtARID_DEF.is_SpeedReductionEval autosar_swc_aeb_rtARID_DEF.is_active_c461_autosar_swc_aeb autosar_swc_aeb_rtARID_DEF.is_c461_autosar_swc_aeb /end REF_MEASUREMENT
/end GROUP
/begin GROUP autosar_swc_aeb_autosar_swc_aeb_Step_sys_Subsystem_Reference_InputProcessor "autosar_swc_aeb/autosar_swc_aeb_Step_sys/Subsystem Reference/InputProcessor"
 /begin SUB_GROUP autosar_swc_aeb_autosar_swc_aeb_Step_sys_Subsystem_Reference_InputProcessor_ObjSignalProcess /end SUB_GROUP
/end GROUP
/begin GROUP autosar_swc_aeb_autosar_swc_aeb_Step_sys_Subsystem_Reference_InputProcessor_ObjSignalProcess "autosar_swc_aeb/autosar_swc_aeb_Step_sys/Subsystem Reference/InputProcessor/ObjSignalProcess"
 /begin SUB_GROUP autosar_swc_aeb_autosar_swc_aeb_Step_sys_Subsystem_Reference_InputProcessor_ObjSignalProcess_For_Each_Subsystem /end SUB_GROUP
/end GROUP
/begin GROUP autosar_swc_aeb_autosar_swc_aeb_Step_sys_Subsystem_Reference_InputProcessor_ObjSignalProcess_For_Each_Subsystem "autosar_swc_aeb/autosar_swc_aeb_Step_sys/Subsystem Reference/InputProcessor/ObjSignalProcess/For Each\nSubsystem"
 /begin REF_CHARACTERISTIC P_AEB_CBRsCompTime P_AEB_CCRsCompTime P_AEB_CPRsCompTime P_AEB_HighSpeedCompTimeSwitch P_AEB_ModifyPedMovingStateSwitch P_AEB_PosnLgtComp /end REF_CHARACTERISTIC
/end GROUP
/begin GROUP autosar_swc_aeb_rtARID_DEF.LoggingBus ""
 /begin REF_MEASUREMENT autosar_swc_aeb_rtARID_DEF.LoggingBus.AgDirRel autosar_swc_aeb_rtARID_DEF.LoggingBus.PosnLgtRel autosar_swc_aeb_rtARID_DEF.LoggingBus.PosnLatRel autosar_swc_aeb_rtARID_DEF.LoggingBus.CloseEdgeDistance autosar_swc_aeb_rtARID_DEF.LoggingBus.FarEdgeDistance autosar_swc_aeb_rtARID_DEF.LoggingBus.TTR autosar_swc_aeb_rtARID_DEF.LoggingBus.TTP autosar_swc_aeb_rtARID_DEF.LoggingBus.Idn autosar_swc_aeb_rtARID_DEF.LoggingBus.VLatRel /end REF_MEASUREMENT
/end GROUP
/begin GROUP autosar_swc_aeb_rtARID_DEF.ObjDataPrimaryTarget ""
 /begin SUB_GROUP autosar_swc_aeb_rtARID_DEF.ObjDataPrimaryTarget.MotionType autosar_swc_aeb_rtARID_DEF.ObjDataPrimaryTarget.BoundingBox autosar_swc_aeb_rtARID_DEF.ObjDataPrimaryTarget.Offsets autosar_swc_aeb_rtARID_DEF.ObjDataPrimaryTarget.LongPredTime autosar_swc_aeb_rtARID_DEF.ObjDataPrimaryTarget.ShortPredTime /end SUB_GROUP
 /begin REF_MEASUREMENT autosar_swc_aeb_rtARID_DEF.ObjDataPrimaryTarget.InPathAtCurrentPosition autosar_swc_aeb_rtARID_DEF.ObjDataPrimaryTarget.PredictionValid autosar_swc_aeb_rtARID_DEF.ObjDataPrimaryTarget.Idn /end REF_MEASUREMENT
/end GROUP
/begin GROUP autosar_swc_aeb_rtARID_DEF.ObjDataPrimaryTarget.BoundingBox ""
 /begin REF_MEASUREMENT autosar_swc_aeb_rtARID_DEF.ObjDataPrimaryTarget.BoundingBox.LengthSideLat autosar_swc_aeb_rtARID_DEF.ObjDataPrimaryTarget.BoundingBox.LengthSideLgt autosar_swc_aeb_rtARID_DEF.ObjDataPrimaryTarget.BoundingBox.SinRotation autosar_swc_aeb_rtARID_DEF.ObjDataPrimaryTarget.BoundingBox.CosRotation autosar_swc_aeb_rtARID_DEF.ObjDataPrimaryTarget.BoundingBox.RotationAngle /end REF_MEASUREMENT
/end GROUP
/begin GROUP autosar_swc_aeb_rtARID_DEF.ObjDataPrimaryTarget.LongPredTime ""
 /begin REF_MEASUREMENT autosar_swc_aeb_rtARID_DEF.ObjDataPrimaryTarget.LongPredTime.TimeToReachLgt autosar_swc_aeb_rtARID_DEF.ObjDataPrimaryTarget.LongPredTime.TimeToMiddleLgt autosar_swc_aeb_rtARID_DEF.ObjDataPrimaryTarget.LongPredTime.TimeToPassLgt autosar_swc_aeb_rtARID_DEF.ObjDataPrimaryTarget.LongPredTime.TTMSelected autosar_swc_aeb_rtARID_DEF.ObjDataPrimaryTarget.LongPredTime.InPath autosar_swc_aeb_rtARID_DEF.ObjDataPrimaryTarget.LongPredTime.ObjOnCmngAndBrkg autosar_swc_aeb_rtARID_DEF.ObjDataPrimaryTarget.LongPredTime.ALgt autosar_swc_aeb_rtARID_DEF.ObjDataPrimaryTarget.LongPredTime.ALat autosar_swc_aeb_rtARID_DEF.ObjDataPrimaryTarget.LongPredTime.A autosar_swc_aeb_rtARID_DEF.ObjDataPrimaryTarget.LongPredTime.Crvt /end REF_MEASUREMENT
/end GROUP
/begin GROUP autosar_swc_aeb_rtARID_DEF.ObjDataPrimaryTarget.MotionType ""
 /begin REF_MEASUREMENT autosar_swc_aeb_rtARID_DEF.ObjDataPrimaryTarget.MotionType.Stationary autosar_swc_aeb_rtARID_DEF.ObjDataPrimaryTarget.MotionType.MovingOncoming autosar_swc_aeb_rtARID_DEF.ObjDataPrimaryTarget.MotionType.ParallellVehicleLongPred autosar_swc_aeb_rtARID_DEF.ObjDataPrimaryTarget.MotionType.ParallellVehicleShortPred autosar_swc_aeb_rtARID_DEF.ObjDataPrimaryTarget.MotionType.ObjectIsVehicle autosar_swc_aeb_rtARID_DEF.ObjDataPrimaryTarget.MotionType.ObjectIsMotorVehicle autosar_swc_aeb_rtARID_DEF.ObjDataPrimaryTarget.MotionType.CurvedMotion autosar_swc_aeb_rtARID_DEF.ObjDataPrimaryTarget.MotionType.SideIsClosest autosar_swc_aeb_rtARID_DEF.ObjDataPrimaryTarget.MotionType.AbsHeading /end REF_MEASUREMENT
/end GROUP
/begin GROUP autosar_swc_aeb_rtARID_DEF.ObjDataPrimaryTarget.Offsets ""
 /begin REF_MEASUREMENT autosar_swc_aeb_rtARID_DEF.ObjDataPrimaryTarget.Offsets.OffsLgtLongPred autosar_swc_aeb_rtARID_DEF.ObjDataPrimaryTarget.Offsets.OffsLatLongPred autosar_swc_aeb_rtARID_DEF.ObjDataPrimaryTarget.Offsets.OffsLgtShortPred autosar_swc_aeb_rtARID_DEF.ObjDataPrimaryTarget.Offsets.OffsLatShortPred autosar_swc_aeb_rtARID_DEF.ObjDataPrimaryTarget.Offsets.OffsLatManoeuvre autosar_swc_aeb_rtARID_DEF.ObjDataPrimaryTarget.Offsets.OffsLatInPathPrimaryTarget autosar_swc_aeb_rtARID_DEF.ObjDataPrimaryTarget.Offsets.OffsLatInPathCloseEdge autosar_swc_aeb_rtARID_DEF.ObjDataPrimaryTarget.Offsets.OffsLatInPathFarEdge autosar_swc_aeb_rtARID_DEF.ObjDataPrimaryTarget.Offsets.OffsLatIntersection autosar_swc_aeb_rtARID_DEF.ObjDataPrimaryTarget.Offsets.OffsLatMplTar /end REF_MEASUREMENT
/end GROUP
/begin GROUP autosar_swc_aeb_rtARID_DEF.ObjDataPrimaryTarget.ShortPredTime ""
 /begin REF_MEASUREMENT autosar_swc_aeb_rtARID_DEF.ObjDataPrimaryTarget.ShortPredTime.TimeToReachLgt autosar_swc_aeb_rtARID_DEF.ObjDataPrimaryTarget.ShortPredTime.TimeToMiddleLgt autosar_swc_aeb_rtARID_DEF.ObjDataPrimaryTarget.ShortPredTime.TimeToPassLgt autosar_swc_aeb_rtARID_DEF.ObjDataPrimaryTarget.ShortPredTime.TTMSelected autosar_swc_aeb_rtARID_DEF.ObjDataPrimaryTarget.ShortPredTime.InPath autosar_swc_aeb_rtARID_DEF.ObjDataPrimaryTarget.ShortPredTime.ObjOnCmngAndBrkg autosar_swc_aeb_rtARID_DEF.ObjDataPrimaryTarget.ShortPredTime.ALgt autosar_swc_aeb_rtARID_DEF.ObjDataPrimaryTarget.ShortPredTime.ALat autosar_swc_aeb_rtARID_DEF.ObjDataPrimaryTarget.ShortPredTime.A autosar_swc_aeb_rtARID_DEF.ObjDataPrimaryTarget.ShortPredTime.Crvt /end REF_MEASUREMENT
/end GROUP
/begin GROUP autosar_swc_aeb_rtARID_DEF.ObjDataPrimaryTarget_a ""
 /begin SUB_GROUP autosar_swc_aeb_rtARID_DEF.ObjDataPrimaryTarget_a.MotionType autosar_swc_aeb_rtARID_DEF.ObjDataPrimaryTarget_a.BoundingBox autosar_swc_aeb_rtARID_DEF.ObjDataPrimaryTarget_a.Offsets autosar_swc_aeb_rtARID_DEF.ObjDataPrimaryTarget_a.LongPredTime autosar_swc_aeb_rtARID_DEF.ObjDataPrimaryTarget_a.ShortPredTime /end SUB_GROUP
 /begin REF_MEASUREMENT autosar_swc_aeb_rtARID_DEF.ObjDataPrimaryTarget_a.InPathAtCurrentPosition autosar_swc_aeb_rtARID_DEF.ObjDataPrimaryTarget_a.PredictionValid autosar_swc_aeb_rtARID_DEF.ObjDataPrimaryTarget_a.Idn /end REF_MEASUREMENT
/end GROUP
/begin GROUP autosar_swc_aeb_rtARID_DEF.ObjDataPrimaryTarget_a.BoundingBox ""
 /begin REF_MEASUREMENT autosar_swc_aeb_rtARID_DEF.ObjDataPrimaryTarget_a.BoundingBox.LengthSideLat autosar_swc_aeb_rtARID_DEF.ObjDataPrimaryTarget_a.BoundingBox.LengthSideLgt autosar_swc_aeb_rtARID_DEF.ObjDataPrimaryTarget_a.BoundingBox.SinRotation autosar_swc_aeb_rtARID_DEF.ObjDataPrimaryTarget_a.BoundingBox.CosRotation autosar_swc_aeb_rtARID_DEF.ObjDataPrimaryTarget_a.BoundingBox.RotationAngle /end REF_MEASUREMENT
/end GROUP
/begin GROUP autosar_swc_aeb_rtARID_DEF.ObjDataPrimaryTarget_a.LongPredTime ""
 /begin REF_MEASUREMENT autosar_swc_aeb_rtARID_DEF.ObjDataPrimaryTarget_a.LongPredTime.TimeToReachLgt autosar_swc_aeb_rtARID_DEF.ObjDataPrimaryTarget_a.LongPredTime.TimeToMiddleLgt autosar_swc_aeb_rtARID_DEF.ObjDataPrimaryTarget_a.LongPredTime.TimeToPassLgt autosar_swc_aeb_rtARID_DEF.ObjDataPrimaryTarget_a.LongPredTime.TTMSelected autosar_swc_aeb_rtARID_DEF.ObjDataPrimaryTarget_a.LongPredTime.InPath autosar_swc_aeb_rtARID_DEF.ObjDataPrimaryTarget_a.LongPredTime.ObjOnCmngAndBrkg autosar_swc_aeb_rtARID_DEF.ObjDataPrimaryTarget_a.LongPredTime.ALgt autosar_swc_aeb_rtARID_DEF.ObjDataPrimaryTarget_a.LongPredTime.ALat autosar_swc_aeb_rtARID_DEF.ObjDataPrimaryTarget_a.LongPredTime.A autosar_swc_aeb_rtARID_DEF.ObjDataPrimaryTarget_a.LongPredTime.Crvt /end REF_MEASUREMENT
/end GROUP
/begin GROUP autosar_swc_aeb_rtARID_DEF.ObjDataPrimaryTarget_a.MotionType ""
 /begin REF_MEASUREMENT autosar_swc_aeb_rtARID_DEF.ObjDataPrimaryTarget_a.MotionType.Stationary autosar_swc_aeb_rtARID_DEF.ObjDataPrimaryTarget_a.MotionType.MovingOncoming autosar_swc_aeb_rtARID_DEF.ObjDataPrimaryTarget_a.MotionType.ParallellVehicleLongPred autosar_swc_aeb_rtARID_DEF.ObjDataPrimaryTarget_a.MotionType.ParallellVehicleShortPred autosar_swc_aeb_rtARID_DEF.ObjDataPrimaryTarget_a.MotionType.ObjectIsVehicle autosar_swc_aeb_rtARID_DEF.ObjDataPrimaryTarget_a.MotionType.ObjectIsMotorVehicle autosar_swc_aeb_rtARID_DEF.ObjDataPrimaryTarget_a.MotionType.CurvedMotion autosar_swc_aeb_rtARID_DEF.ObjDataPrimaryTarget_a.MotionType.SideIsClosest autosar_swc_aeb_rtARID_DEF.ObjDataPrimaryTarget_a.MotionType.AbsHeading /end REF_MEASUREMENT
/end GROUP
/begin GROUP autosar_swc_aeb_rtARID_DEF.ObjDataPrimaryTarget_a.Offsets ""
 /begin REF_MEASUREMENT autosar_swc_aeb_rtARID_DEF.ObjDataPrimaryTarget_a.Offsets.OffsLgtLongPred autosar_swc_aeb_rtARID_DEF.ObjDataPrimaryTarget_a.Offsets.OffsLatLongPred autosar_swc_aeb_rtARID_DEF.ObjDataPrimaryTarget_a.Offsets.OffsLgtShortPred autosar_swc_aeb_rtARID_DEF.ObjDataPrimaryTarget_a.Offsets.OffsLatShortPred autosar_swc_aeb_rtARID_DEF.ObjDataPrimaryTarget_a.Offsets.OffsLatManoeuvre autosar_swc_aeb_rtARID_DEF.ObjDataPrimaryTarget_a.Offsets.OffsLatInPathPrimaryTarget autosar_swc_aeb_rtARID_DEF.ObjDataPrimaryTarget_a.Offsets.OffsLatInPathCloseEdge autosar_swc_aeb_rtARID_DEF.ObjDataPrimaryTarget_a.Offsets.OffsLatInPathFarEdge autosar_swc_aeb_rtARID_DEF.ObjDataPrimaryTarget_a.Offsets.OffsLatIntersection autosar_swc_aeb_rtARID_DEF.ObjDataPrimaryTarget_a.Offsets.OffsLatMplTar /end REF_MEASUREMENT
/end GROUP
/begin GROUP autosar_swc_aeb_rtARID_DEF.ObjDataPrimaryTarget_a.ShortPredTime ""
 /begin REF_MEASUREMENT autosar_swc_aeb_rtARID_DEF.ObjDataPrimaryTarget_a.ShortPredTime.TimeToReachLgt autosar_swc_aeb_rtARID_DEF.ObjDataPrimaryTarget_a.ShortPredTime.TimeToMiddleLgt autosar_swc_aeb_rtARID_DEF.ObjDataPrimaryTarget_a.ShortPredTime.TimeToPassLgt autosar_swc_aeb_rtARID_DEF.ObjDataPrimaryTarget_a.ShortPredTime.TTMSelected autosar_swc_aeb_rtARID_DEF.ObjDataPrimaryTarget_a.ShortPredTime.InPath autosar_swc_aeb_rtARID_DEF.ObjDataPrimaryTarget_a.ShortPredTime.ObjOnCmngAndBrkg autosar_swc_aeb_rtARID_DEF.ObjDataPrimaryTarget_a.ShortPredTime.ALgt autosar_swc_aeb_rtARID_DEF.ObjDataPrimaryTarget_a.ShortPredTime.ALat autosar_swc_aeb_rtARID_DEF.ObjDataPrimaryTarget_a.ShortPredTime.A autosar_swc_aeb_rtARID_DEF.ObjDataPrimaryTarget_a.ShortPredTime.Crvt /end REF_MEASUREMENT
/end GROUP
/begin GROUP autosar_swc_aeb_rtARID_DEF.ObjData_i[0] ""
 /begin SUB_GROUP autosar_swc_aeb_rtARID_DEF.ObjData_i[0].MotionType autosar_swc_aeb_rtARID_DEF.ObjData_i[0].BoundingBox autosar_swc_aeb_rtARID_DEF.ObjData_i[0].Offsets autosar_swc_aeb_rtARID_DEF.ObjData_i[0].LongPredTime autosar_swc_aeb_rtARID_DEF.ObjData_i[0].ShortPredTime /end SUB_GROUP
 /begin REF_MEASUREMENT autosar_swc_aeb_rtARID_DEF.ObjData_i[0].InPathAtCurrentPosition autosar_swc_aeb_rtARID_DEF.ObjData_i[0].PredictionValid autosar_swc_aeb_rtARID_DEF.ObjData_i[0].Idn /end REF_MEASUREMENT
/end GROUP
/begin GROUP autosar_swc_aeb_rtARID_DEF.ObjData_i[0].BoundingBox ""
 /begin REF_MEASUREMENT autosar_swc_aeb_rtARID_DEF.ObjData_i[0].BoundingBox.LengthSideLat autosar_swc_aeb_rtARID_DEF.ObjData_i[0].BoundingBox.LengthSideLgt autosar_swc_aeb_rtARID_DEF.ObjData_i[0].BoundingBox.SinRotation autosar_swc_aeb_rtARID_DEF.ObjData_i[0].BoundingBox.CosRotation autosar_swc_aeb_rtARID_DEF.ObjData_i[0].BoundingBox.RotationAngle /end REF_MEASUREMENT
/end GROUP
/begin GROUP autosar_swc_aeb_rtARID_DEF.ObjData_i[0].LongPredTime ""
 /begin REF_MEASUREMENT autosar_swc_aeb_rtARID_DEF.ObjData_i[0].LongPredTime.TimeToReachLgt autosar_swc_aeb_rtARID_DEF.ObjData_i[0].LongPredTime.TimeToMiddleLgt autosar_swc_aeb_rtARID_DEF.ObjData_i[0].LongPredTime.TimeToPassLgt autosar_swc_aeb_rtARID_DEF.ObjData_i[0].LongPredTime.TTMSelected autosar_swc_aeb_rtARID_DEF.ObjData_i[0].LongPredTime.InPath autosar_swc_aeb_rtARID_DEF.ObjData_i[0].LongPredTime.ObjOnCmngAndBrkg autosar_swc_aeb_rtARID_DEF.ObjData_i[0].LongPredTime.ALgt autosar_swc_aeb_rtARID_DEF.ObjData_i[0].LongPredTime.ALat autosar_swc_aeb_rtARID_DEF.ObjData_i[0].LongPredTime.A autosar_swc_aeb_rtARID_DEF.ObjData_i[0].LongPredTime.Crvt /end REF_MEASUREMENT
/end GROUP
/begin GROUP autosar_swc_aeb_rtARID_DEF.ObjData_i[0].MotionType ""
 /begin REF_MEASUREMENT autosar_swc_aeb_rtARID_DEF.ObjData_i[0].MotionType.Stationary autosar_swc_aeb_rtARID_DEF.ObjData_i[0].MotionType.MovingOncoming autosar_swc_aeb_rtARID_DEF.ObjData_i[0].MotionType.ParallellVehicleLongPred autosar_swc_aeb_rtARID_DEF.ObjData_i[0].MotionType.ParallellVehicleShortPred autosar_swc_aeb_rtARID_DEF.ObjData_i[0].MotionType.ObjectIsVehicle autosar_swc_aeb_rtARID_DEF.ObjData_i[0].MotionType.ObjectIsMotorVehicle autosar_swc_aeb_rtARID_DEF.ObjData_i[0].MotionType.CurvedMotion autosar_swc_aeb_rtARID_DEF.ObjData_i[0].MotionType.SideIsClosest autosar_swc_aeb_rtARID_DEF.ObjData_i[0].MotionType.AbsHeading /end REF_MEASUREMENT
/end GROUP
/begin GROUP autosar_swc_aeb_rtARID_DEF.ObjData_i[0].Offsets ""
 /begin REF_MEASUREMENT autosar_swc_aeb_rtARID_DEF.ObjData_i[0].Offsets.OffsLgtLongPred autosar_swc_aeb_rtARID_DEF.ObjData_i[0].Offsets.OffsLatLongPred autosar_swc_aeb_rtARID_DEF.ObjData_i[0].Offsets.OffsLgtShortPred autosar_swc_aeb_rtARID_DEF.ObjData_i[0].Offsets.OffsLatShortPred autosar_swc_aeb_rtARID_DEF.ObjData_i[0].Offsets.OffsLatManoeuvre autosar_swc_aeb_rtARID_DEF.ObjData_i[0].Offsets.OffsLatInPathPrimaryTarget autosar_swc_aeb_rtARID_DEF.ObjData_i[0].Offsets.OffsLatInPathCloseEdge autosar_swc_aeb_rtARID_DEF.ObjData_i[0].Offsets.OffsLatInPathFarEdge autosar_swc_aeb_rtARID_DEF.ObjData_i[0].Offsets.OffsLatIntersection autosar_swc_aeb_rtARID_DEF.ObjData_i[0].Offsets.OffsLatMplTar /end REF_MEASUREMENT
/end GROUP
/begin GROUP autosar_swc_aeb_rtARID_DEF.ObjData_i[0].ShortPredTime ""
 /begin REF_MEASUREMENT autosar_swc_aeb_rtARID_DEF.ObjData_i[0].ShortPredTime.TimeToReachLgt autosar_swc_aeb_rtARID_DEF.ObjData_i[0].ShortPredTime.TimeToMiddleLgt autosar_swc_aeb_rtARID_DEF.ObjData_i[0].ShortPredTime.TimeToPassLgt autosar_swc_aeb_rtARID_DEF.ObjData_i[0].ShortPredTime.TTMSelected autosar_swc_aeb_rtARID_DEF.ObjData_i[0].ShortPredTime.InPath autosar_swc_aeb_rtARID_DEF.ObjData_i[0].ShortPredTime.ObjOnCmngAndBrkg autosar_swc_aeb_rtARID_DEF.ObjData_i[0].ShortPredTime.ALgt autosar_swc_aeb_rtARID_DEF.ObjData_i[0].ShortPredTime.ALat autosar_swc_aeb_rtARID_DEF.ObjData_i[0].ShortPredTime.A autosar_swc_aeb_rtARID_DEF.ObjData_i[0].ShortPredTime.Crvt /end REF_MEASUREMENT
/end GROUP
/begin GROUP autosar_swc_aeb_rtARID_DEF.ObjData_i[10] ""
 /begin SUB_GROUP autosar_swc_aeb_rtARID_DEF.ObjData_i[10].MotionType autosar_swc_aeb_rtARID_DEF.ObjData_i[10].BoundingBox autosar_swc_aeb_rtARID_DEF.ObjData_i[10].Offsets autosar_swc_aeb_rtARID_DEF.ObjData_i[10].LongPredTime autosar_swc_aeb_rtARID_DEF.ObjData_i[10].ShortPredTime /end SUB_GROUP
 /begin REF_MEASUREMENT autosar_swc_aeb_rtARID_DEF.ObjData_i[10].InPathAtCurrentPosition autosar_swc_aeb_rtARID_DEF.ObjData_i[10].PredictionValid autosar_swc_aeb_rtARID_DEF.ObjData_i[10].Idn /end REF_MEASUREMENT
/end GROUP
/begin GROUP autosar_swc_aeb_rtARID_DEF.ObjData_i[10].BoundingBox ""
 /begin REF_MEASUREMENT autosar_swc_aeb_rtARID_DEF.ObjData_i[10].BoundingBox.LengthSideLat autosar_swc_aeb_rtARID_DEF.ObjData_i[10].BoundingBox.LengthSideLgt autosar_swc_aeb_rtARID_DEF.ObjData_i[10].BoundingBox.SinRotation autosar_swc_aeb_rtARID_DEF.ObjData_i[10].BoundingBox.CosRotation autosar_swc_aeb_rtARID_DEF.ObjData_i[10].BoundingBox.RotationAngle /end REF_MEASUREMENT
/end GROUP
/begin GROUP autosar_swc_aeb_rtARID_DEF.ObjData_i[10].LongPredTime ""
 /begin REF_MEASUREMENT autosar_swc_aeb_rtARID_DEF.ObjData_i[10].LongPredTime.TimeToReachLgt autosar_swc_aeb_rtARID_DEF.ObjData_i[10].LongPredTime.TimeToMiddleLgt autosar_swc_aeb_rtARID_DEF.ObjData_i[10].LongPredTime.TimeToPassLgt autosar_swc_aeb_rtARID_DEF.ObjData_i[10].LongPredTime.TTMSelected autosar_swc_aeb_rtARID_DEF.ObjData_i[10].LongPredTime.InPath autosar_swc_aeb_rtARID_DEF.ObjData_i[10].LongPredTime.ObjOnCmngAndBrkg autosar_swc_aeb_rtARID_DEF.ObjData_i[10].LongPredTime.ALgt autosar_swc_aeb_rtARID_DEF.ObjData_i[10].LongPredTime.ALat autosar_swc_aeb_rtARID_DEF.ObjData_i[10].LongPredTime.A autosar_swc_aeb_rtARID_DEF.ObjData_i[10].LongPredTime.Crvt /end REF_MEASUREMENT
/end GROUP
/begin GROUP autosar_swc_aeb_rtARID_DEF.ObjData_i[10].MotionType ""
 /begin REF_MEASUREMENT autosar_swc_aeb_rtARID_DEF.ObjData_i[10].MotionType.Stationary autosar_swc_aeb_rtARID_DEF.ObjData_i[10].MotionType.MovingOncoming autosar_swc_aeb_rtARID_DEF.ObjData_i[10].MotionType.ParallellVehicleLongPred autosar_swc_aeb_rtARID_DEF.ObjData_i[10].MotionType.ParallellVehicleShortPred autosar_swc_aeb_rtARID_DEF.ObjData_i[10].MotionType.ObjectIsVehicle autosar_swc_aeb_rtARID_DEF.ObjData_i[10].MotionType.ObjectIsMotorVehicle autosar_swc_aeb_rtARID_DEF.ObjData_i[10].MotionType.CurvedMotion autosar_swc_aeb_rtARID_DEF.ObjData_i[10].MotionType.SideIsClosest autosar_swc_aeb_rtARID_DEF.ObjData_i[10].MotionType.AbsHeading /end REF_MEASUREMENT
/end GROUP
/begin GROUP autosar_swc_aeb_rtARID_DEF.ObjData_i[10].Offsets ""
 /begin REF_MEASUREMENT autosar_swc_aeb_rtARID_DEF.ObjData_i[10].Offsets.OffsLgtLongPred autosar_swc_aeb_rtARID_DEF.ObjData_i[10].Offsets.OffsLatLongPred autosar_swc_aeb_rtARID_DEF.ObjData_i[10].Offsets.OffsLgtShortPred autosar_swc_aeb_rtARID_DEF.ObjData_i[10].Offsets.OffsLatShortPred autosar_swc_aeb_rtARID_DEF.ObjData_i[10].Offsets.OffsLatManoeuvre autosar_swc_aeb_rtARID_DEF.ObjData_i[10].Offsets.OffsLatInPathPrimaryTarget autosar_swc_aeb_rtARID_DEF.ObjData_i[10].Offsets.OffsLatInPathCloseEdge autosar_swc_aeb_rtARID_DEF.ObjData_i[10].Offsets.OffsLatInPathFarEdge autosar_swc_aeb_rtARID_DEF.ObjData_i[10].Offsets.OffsLatIntersection autosar_swc_aeb_rtARID_DEF.ObjData_i[10].Offsets.OffsLatMplTar /end REF_MEASUREMENT
/end GROUP
/begin GROUP autosar_swc_aeb_rtARID_DEF.ObjData_i[10].ShortPredTime ""
 /begin REF_MEASUREMENT autosar_swc_aeb_rtARID_DEF.ObjData_i[10].ShortPredTime.TimeToReachLgt autosar_swc_aeb_rtARID_DEF.ObjData_i[10].ShortPredTime.TimeToMiddleLgt autosar_swc_aeb_rtARID_DEF.ObjData_i[10].ShortPredTime.TimeToPassLgt autosar_swc_aeb_rtARID_DEF.ObjData_i[10].ShortPredTime.TTMSelected autosar_swc_aeb_rtARID_DEF.ObjData_i[10].ShortPredTime.InPath autosar_swc_aeb_rtARID_DEF.ObjData_i[10].ShortPredTime.ObjOnCmngAndBrkg autosar_swc_aeb_rtARID_DEF.ObjData_i[10].ShortPredTime.ALgt autosar_swc_aeb_rtARID_DEF.ObjData_i[10].ShortPredTime.ALat autosar_swc_aeb_rtARID_DEF.ObjData_i[10].ShortPredTime.A autosar_swc_aeb_rtARID_DEF.ObjData_i[10].ShortPredTime.Crvt /end REF_MEASUREMENT
/end GROUP
/begin GROUP autosar_swc_aeb_rtARID_DEF.ObjData_i[11] ""
 /begin SUB_GROUP autosar_swc_aeb_rtARID_DEF.ObjData_i[11].MotionType autosar_swc_aeb_rtARID_DEF.ObjData_i[11].BoundingBox autosar_swc_aeb_rtARID_DEF.ObjData_i[11].Offsets autosar_swc_aeb_rtARID_DEF.ObjData_i[11].LongPredTime autosar_swc_aeb_rtARID_DEF.ObjData_i[11].ShortPredTime /end SUB_GROUP
 /begin REF_MEASUREMENT autosar_swc_aeb_rtARID_DEF.ObjData_i[11].InPathAtCurrentPosition autosar_swc_aeb_rtARID_DEF.ObjData_i[11].PredictionValid autosar_swc_aeb_rtARID_DEF.ObjData_i[11].Idn /end REF_MEASUREMENT
/end GROUP
/begin GROUP autosar_swc_aeb_rtARID_DEF.ObjData_i[11].BoundingBox ""
 /begin REF_MEASUREMENT autosar_swc_aeb_rtARID_DEF.ObjData_i[11].BoundingBox.LengthSideLat autosar_swc_aeb_rtARID_DEF.ObjData_i[11].BoundingBox.LengthSideLgt autosar_swc_aeb_rtARID_DEF.ObjData_i[11].BoundingBox.SinRotation autosar_swc_aeb_rtARID_DEF.ObjData_i[11].BoundingBox.CosRotation autosar_swc_aeb_rtARID_DEF.ObjData_i[11].BoundingBox.RotationAngle /end REF_MEASUREMENT
/end GROUP
/begin GROUP autosar_swc_aeb_rtARID_DEF.ObjData_i[11].LongPredTime ""
 /begin REF_MEASUREMENT autosar_swc_aeb_rtARID_DEF.ObjData_i[11].LongPredTime.TimeToReachLgt autosar_swc_aeb_rtARID_DEF.ObjData_i[11].LongPredTime.TimeToMiddleLgt autosar_swc_aeb_rtARID_DEF.ObjData_i[11].LongPredTime.TimeToPassLgt autosar_swc_aeb_rtARID_DEF.ObjData_i[11].LongPredTime.TTMSelected autosar_swc_aeb_rtARID_DEF.ObjData_i[11].LongPredTime.InPath autosar_swc_aeb_rtARID_DEF.ObjData_i[11].LongPredTime.ObjOnCmngAndBrkg autosar_swc_aeb_rtARID_DEF.ObjData_i[11].LongPredTime.ALgt autosar_swc_aeb_rtARID_DEF.ObjData_i[11].LongPredTime.ALat autosar_swc_aeb_rtARID_DEF.ObjData_i[11].LongPredTime.A autosar_swc_aeb_rtARID_DEF.ObjData_i[11].LongPredTime.Crvt /end REF_MEASUREMENT
/end GROUP
/begin GROUP autosar_swc_aeb_rtARID_DEF.ObjData_i[11].MotionType ""
 /begin REF_MEASUREMENT autosar_swc_aeb_rtARID_DEF.ObjData_i[11].MotionType.Stationary autosar_swc_aeb_rtARID_DEF.ObjData_i[11].MotionType.MovingOncoming autosar_swc_aeb_rtARID_DEF.ObjData_i[11].MotionType.ParallellVehicleLongPred autosar_swc_aeb_rtARID_DEF.ObjData_i[11].MotionType.ParallellVehicleShortPred autosar_swc_aeb_rtARID_DEF.ObjData_i[11].MotionType.ObjectIsVehicle autosar_swc_aeb_rtARID_DEF.ObjData_i[11].MotionType.ObjectIsMotorVehicle autosar_swc_aeb_rtARID_DEF.ObjData_i[11].MotionType.CurvedMotion autosar_swc_aeb_rtARID_DEF.ObjData_i[11].MotionType.SideIsClosest autosar_swc_aeb_rtARID_DEF.ObjData_i[11].MotionType.AbsHeading /end REF_MEASUREMENT
/end GROUP
/begin GROUP autosar_swc_aeb_rtARID_DEF.ObjData_i[11].Offsets ""
 /begin REF_MEASUREMENT autosar_swc_aeb_rtARID_DEF.ObjData_i[11].Offsets.OffsLgtLongPred autosar_swc_aeb_rtARID_DEF.ObjData_i[11].Offsets.OffsLatLongPred autosar_swc_aeb_rtARID_DEF.ObjData_i[11].Offsets.OffsLgtShortPred autosar_swc_aeb_rtARID_DEF.ObjData_i[11].Offsets.OffsLatShortPred autosar_swc_aeb_rtARID_DEF.ObjData_i[11].Offsets.OffsLatManoeuvre autosar_swc_aeb_rtARID_DEF.ObjData_i[11].Offsets.OffsLatInPathPrimaryTarget autosar_swc_aeb_rtARID_DEF.ObjData_i[11].Offsets.OffsLatInPathCloseEdge autosar_swc_aeb_rtARID_DEF.ObjData_i[11].Offsets.OffsLatInPathFarEdge autosar_swc_aeb_rtARID_DEF.ObjData_i[11].Offsets.OffsLatIntersection autosar_swc_aeb_rtARID_DEF.ObjData_i[11].Offsets.OffsLatMplTar /end REF_MEASUREMENT
/end GROUP
/begin GROUP autosar_swc_aeb_rtARID_DEF.ObjData_i[11].ShortPredTime ""
 /begin REF_MEASUREMENT autosar_swc_aeb_rtARID_DEF.ObjData_i[11].ShortPredTime.TimeToReachLgt autosar_swc_aeb_rtARID_DEF.ObjData_i[11].ShortPredTime.TimeToMiddleLgt autosar_swc_aeb_rtARID_DEF.ObjData_i[11].ShortPredTime.TimeToPassLgt autosar_swc_aeb_rtARID_DEF.ObjData_i[11].ShortPredTime.TTMSelected autosar_swc_aeb_rtARID_DEF.ObjData_i[11].ShortPredTime.InPath autosar_swc_aeb_rtARID_DEF.ObjData_i[11].ShortPredTime.ObjOnCmngAndBrkg autosar_swc_aeb_rtARID_DEF.ObjData_i[11].ShortPredTime.ALgt autosar_swc_aeb_rtARID_DEF.ObjData_i[11].ShortPredTime.ALat autosar_swc_aeb_rtARID_DEF.ObjData_i[11].ShortPredTime.A autosar_swc_aeb_rtARID_DEF.ObjData_i[11].ShortPredTime.Crvt /end REF_MEASUREMENT
/end GROUP
/begin GROUP autosar_swc_aeb_rtARID_DEF.ObjData_i[12] ""
 /begin SUB_GROUP autosar_swc_aeb_rtARID_DEF.ObjData_i[12].MotionType autosar_swc_aeb_rtARID_DEF.ObjData_i[12].BoundingBox autosar_swc_aeb_rtARID_DEF.ObjData_i[12].Offsets autosar_swc_aeb_rtARID_DEF.ObjData_i[12].LongPredTime autosar_swc_aeb_rtARID_DEF.ObjData_i[12].ShortPredTime /end SUB_GROUP
 /begin REF_MEASUREMENT autosar_swc_aeb_rtARID_DEF.ObjData_i[12].InPathAtCurrentPosition autosar_swc_aeb_rtARID_DEF.ObjData_i[12].PredictionValid autosar_swc_aeb_rtARID_DEF.ObjData_i[12].Idn /end REF_MEASUREMENT
/end GROUP
/begin GROUP autosar_swc_aeb_rtARID_DEF.ObjData_i[12].BoundingBox ""
 /begin REF_MEASUREMENT autosar_swc_aeb_rtARID_DEF.ObjData_i[12].BoundingBox.LengthSideLat autosar_swc_aeb_rtARID_DEF.ObjData_i[12].BoundingBox.LengthSideLgt autosar_swc_aeb_rtARID_DEF.ObjData_i[12].BoundingBox.SinRotation autosar_swc_aeb_rtARID_DEF.ObjData_i[12].BoundingBox.CosRotation autosar_swc_aeb_rtARID_DEF.ObjData_i[12].BoundingBox.RotationAngle /end REF_MEASUREMENT
/end GROUP
/begin RECORD_LAYOUT Record_BOOLEAN FNC_VALUES 1 UBYTE COLUMN_DIR DIRECT /end RECORD_LAYOUT
/begin RECORD_LAYOUT Record_FLOAT32_IEEE FNC_VALUES 1 FLOAT32_IEEE COLUMN_DIR DIRECT /end RECORD_LAYOUT
/begin RECORD_LAYOUT Record_UBYTE FNC_VALUES 1 UBYTE COLUMN_DIR DIRECT /end RECORD_LAYOUT
/begin RECORD_LAYOUT Record_BOOLEAN FNC_VALUES 1 UBYTE COLUMN_DIR DIRECT /end RECORD_LAYOUT
/begin RECORD_LAYOUT Record_FLOAT32_IEEE FNC_VALUES 1 FLOAT32_IEEE COLUMN_DIR DIRECT /end RECORD_LAYOUT
/begin RECORD_LAYOUT Record_UBYTE FNC_VALUES 1 UBYTE COLUMN_DIR DIRECT /end RECORD_LAYOUT
/begin RECORD_LAYOUT Record_BOOLEAN FNC_VALUES 1 UBYTE COLUMN_DIR DIRECT /end RECORD_LAYOUT
/begin RECORD_LAYOUT Record_FLOAT32_IEEE FNC_VALUES 1 FLOAT32_IEEE COLUMN_DIR DIRECT /end RECORD_LAYOUT
/begin RECORD_LAYOUT Record_UBYTE FNC_VALUES 1 UBYTE COLUMN_DIR DIRECT /end RECORD_LAYOUT
/begin RECORD_LAYOUT Record_BOOLEAN FNC_VALUES 1 UBYTE COLUMN_DIR DIRECT /end RECORD_LAYOUT
/begin RECORD_LAYOUT Record_FLOAT32_IEEE FNC_VALUES 1 FLOAT32_IEEE COLUMN_DIR DIRECT /end RECORD_LAYOUT
/begin RECORD_LAYOUT Record_UBYTE FNC_VALUES 1 UBYTE COLUMN_DIR DIRECT /end RECORD_LAYOUT
/begin RECORD_LAYOUT Record_BOOLEAN FNC_VALUES 1 UBYTE COLUMN_DIR DIRECT /end RECORD_LAYOUT
/begin RECORD_LAYOUT Record_FLOAT32_IEEE FNC_VALUES 1 FLOAT32_IEEE COLUMN_DIR DIRECT /end RECORD_LAYOUT
/begin RECORD_LAYOUT Record_UBYTE FNC_VALUES 1 UBYTE COLUMN_DIR DIRECT /end RECORD_LAYOUT
/begin RECORD_LAYOUT Record_BOOLEAN FNC_VALUES 1 UBYTE COLUMN_DIR DIRECT /end RECORD_LAYOUT
/begin RECORD_LAYOUT Record_FLOAT32_IEEE FNC_VALUES 1 FLOAT32_IEEE COLUMN_DIR DIRECT /end RECORD_LAYOUT
/begin RECORD_LAYOUT Record_UBYTE FNC_VALUES 1 UBYTE COLUMN_DIR DIRECT /end RECORD_LAYOUT
/begin RECORD_LAYOUT Record_BOOLEAN FNC_VALUES 1 UBYTE COLUMN_DIR DIRECT /end RECORD_LAYOUT
/begin RECORD_LAYOUT Record_FLOAT32_IEEE FNC_VALUES 1 FLOAT32_IEEE COLUMN_DIR DIRECT /end RECORD_LAYOUT
/begin RECORD_LAYOUT Record_UBYTE FNC_VALUES 1 UBYTE COLUMN_DIR DIRECT /end RECORD_LAYOUT
/begin RECORD_LAYOUT Record_BOOLEAN FNC_VALUES 1 UBYTE COLUMN_DIR DIRECT /end RECORD_LAYOUT
/begin RECORD_LAYOUT Record_FLOAT32_IEEE FNC_VALUES 1 FLOAT32_IEEE COLUMN_DIR DIRECT /end RECORD_LAYOUT
/begin RECORD_LAYOUT Record_UBYTE FNC_VALUES 1 UBYTE COLUMN_DIR DIRECT /end RECORD_LAYOUT
/begin RECORD_LAYOUT Record_BOOLEAN FNC_VALUES 1 UBYTE COLUMN_DIR DIRECT /end RECORD_LAYOUT
/begin RECORD_LAYOUT Record_FLOAT32_IEEE FNC_VALUES 1 FLOAT32_IEEE COLUMN_DIR DIRECT /end RECORD_LAYOUT
/begin RECORD_LAYOUT Record_UBYTE FNC_VALUES 1 UBYTE COLUMN_DIR DIRECT /end RECORD_LAYOUT
/begin RECORD_LAYOUT Record_BOOLEAN FNC_VALUES 1 UBYTE COLUMN_DIR DIRECT /end RECORD_LAYOUT
/begin RECORD_LAYOUT Record_FLOAT32_IEEE FNC_VALUES 1 FLOAT32_IEEE COLUMN_DIR DIRECT /end RECORD_LAYOUT
/begin RECORD_LAYOUT Record_UBYTE FNC_VALUES 1 UBYTE COLUMN_DIR DIRECT /end RECORD_LAYOUT
/end MODULE
/end PROJECT
