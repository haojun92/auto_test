ASAP2_VERSION 1 71
/begin PROJECT ProjectName ""
/begin MODULE ModuleName ""
/begin MOD_COMMON "" BYTE_ORDER MSB_LAST ALIGNMENT_BYTE 1 ALIGNMENT_WORD 1 ALIGNMENT_LONG 1 ALIGNMENT_INT64 1 ALIGNMENT_FLOAT16_IEEE 1 ALIGNMENT_FLOAT32_IEEE 1 ALIGNMENT_FLOAT64_IEEE 1 /end MOD_COMMON
/begin RECORD_LAYOUT Record_FLOAT32_IEEE FNC_VALUES 1 FLOAT32_IEEE COLUMN_DIR DIRECT /end RECORD_LAYOUT
/begin RECORD_LAYOUT Record_SBYTE FNC_VALUES 1 SBYTE COLUMN_DIR DIRECT /end RECORD_LAYOUT
/begin RECORD_LAYOUT Record_SWORD FNC_VALUES 1 SWORD COLUMN_DIR DIRECT /end RECORD_LAYOUT
/begin RECORD_LAYOUT Record_UBYTE FNC_VALUES 1 UBYTE COLUMN_DIR DIRECT /end RECORD_LAYOUT
/begin RECORD_LAYOUT Record_ULONG FNC_VALUES 1 ULONG COLUMN_DIR DIRECT /end RECORD_LAYOUT
/begin RECORD_LAYOUT Record_UWORD FNC_VALUES 1 UWORD COLUMN_DIR DIRECT /end RECORD_LAYOUT
/begin RECORD_LAYOUT Record_FLOAT32_IEEE FNC_VALUES 1 FLOAT32_IEEE COLUMN_DIR DIRECT /end RECORD_LAYOUT
/begin RECORD_LAYOUT Record_UBYTE FNC_VALUES 1 UBYTE COLUMN_DIR DIRECT /end RECORD_LAYOUT
/begin RECORD_LAYOUT Record_ULONG FNC_VALUES 1 ULONG COLUMN_DIR DIRECT /end RECORD_LAYOUT
/begin RECORD_LAYOUT Record_UWORD FNC_VALUES 1 UWORD COLUMN_DIR DIRECT /end RECORD_LAYOUT
/begin RECORD_LAYOUT Record_FLOAT32_IEEE FNC_VALUES 1 FLOAT32_IEEE COLUMN_DIR DIRECT /end RECORD_LAYOUT
/begin RECORD_LAYOUT Record_SWORD FNC_VALUES 1 SWORD COLUMN_DIR DIRECT /end RECORD_LAYOUT
/begin RECORD_LAYOUT Record_UBYTE FNC_VALUES 1 UBYTE COLUMN_DIR DIRECT /end RECORD_LAYOUT
/begin RECORD_LAYOUT Record_ULONG FNC_VALUES 1 ULONG COLUMN_DIR DIRECT /end RECORD_LAYOUT
/begin RECORD_LAYOUT Record_FLOAT32_IEEE FNC_VALUES 1 FLOAT32_IEEE COLUMN_DIR DIRECT /end RECORD_LAYOUT
/begin RECORD_LAYOUT Record_SBYTE FNC_VALUES 1 SBYTE COLUMN_DIR DIRECT /end RECORD_LAYOUT
/begin RECORD_LAYOUT Record_UBYTE FNC_VALUES 1 UBYTE COLUMN_DIR DIRECT /end RECORD_LAYOUT
/begin RECORD_LAYOUT Record_ULONG FNC_VALUES 1 ULONG COLUMN_DIR DIRECT /end RECORD_LAYOUT
/begin RECORD_LAYOUT Record_UWORD FNC_VALUES 1 UWORD COLUMN_DIR DIRECT /end RECORD_LAYOUT
/begin CHARACTERISTIC ZDrive_BSW_Cal_Cal.ZDrive_BSW_Cal_VehicleInfomationTable.ASU_Type "" VALUE 0x3d8081 Record_UBYTE 0 autosar_swc_las_CM_uint8 0 255 /end CHARACTERISTIC
/begin CHARACTERISTIC ZDrive_BSW_Cal_Cal.ZDrive_BSW_Cal_VehicleInfomationTable.AccSens_LatAccSigDirect "" VALUE 0x3d8078 Record_UBYTE 0 autosar_swc_las_CM_uint8 0 255 /end CHARACTERISTIC
/begin CHARACTERISTIC ZDrive_BSW_Cal_Cal.ZDrive_BSW_Cal_VehicleInfomationTable.AccSens_LonAccSigDirect "" VALUE 0x3d8079 Record_UBYTE 0 autosar_swc_las_CM_uint8 0 255 /end CHARACTERISTIC
/begin CHARACTERISTIC ZDrive_BSW_Cal_Cal.ZDrive_BSW_Cal_VehicleInfomationTable.AutoHold_Type "" VALUE 0x3d8077 Record_UBYTE 0 autosar_swc_las_CM_uint8 0 255 /end CHARACTERISTIC
/begin CHARACTERISTIC ZDrive_BSW_Cal_Cal.ZDrive_BSW_Cal_VehicleInfomationTable.CURB_kg "" VALUE 0x3d810c Record_FLOAT32_IEEE 0 autosar_swc_las_CM_single -3.4E+38 3.4E+38 /end CHARACTERISTIC
/begin CHARACTERISTIC ZDrive_BSW_Cal_Cal.ZDrive_BSW_Cal_VehicleInfomationTable.CamDistToRearAxleCenter_DZ "" VALUE 0x3d8174 Record_FLOAT32_IEEE 0 autosar_swc_las_CM_single -3.4E+38 3.4E+38 /end CHARACTERISTIC
/begin CHARACTERISTIC ZDrive_BSW_Cal_Cal.ZDrive_BSW_Cal_VehicleInfomationTable.CharSpd_mps "" VALUE 0x3d8138 Record_FLOAT32_IEEE 0 autosar_swc_las_CM_single -3.4E+38 3.4E+38 /end CHARACTERISTIC
/begin CHARACTERISTIC ZDrive_BSW_Cal_Cal.ZDrive_BSW_Cal_VehicleInfomationTable.DriHandTorqueDirect "" VALUE 0x3d807b Record_UBYTE 0 autosar_swc_las_CM_uint8 0 255 /end CHARACTERISTIC
/begin CHARACTERISTIC ZDrive_BSW_Cal_Cal.ZDrive_BSW_Cal_VehicleInfomationTable.Driving_Type "" VALUE 0x3d8075 Record_UBYTE 0 autosar_swc_las_CM_uint8 0 255 /end CHARACTERISTIC
/begin CHARACTERISTIC ZDrive_BSW_Cal_Cal.ZDrive_BSW_Cal_VehicleInfomationTable.DxvFrontBumper_m "" VALUE 0x3d80cc Record_FLOAT32_IEEE 0 autosar_swc_las_CM_single -3.4E+38 3.4E+38 /end CHARACTERISTIC
/begin CHARACTERISTIC ZDrive_BSW_Cal_Cal.ZDrive_BSW_Cal_VehicleInfomationTable.DxvRearBumper_m "" VALUE 0x3d80c8 Record_FLOAT32_IEEE 0 autosar_swc_las_CM_single -3.4E+38 3.4E+38 /end CHARACTERISTIC
/begin CHARACTERISTIC ZDrive_BSW_Cal_Cal.ZDrive_BSW_Cal_VehicleInfomationTable.Empty_mass_kg "" VALUE 0x3d8118 Record_FLOAT32_IEEE 0 autosar_swc_las_CM_single -3.4E+38 3.4E+38 /end CHARACTERISTIC
/begin CHARACTERISTIC ZDrive_BSW_Cal_Cal.ZDrive_BSW_Cal_VehicleInfomationTable.EngineMaxiTorque_N "" VALUE 0x3d80a0 Record_FLOAT32_IEEE 0 autosar_swc_las_CM_single -3.4E+38 3.4E+38 /end CHARACTERISTIC
/begin CHARACTERISTIC ZDrive_BSW_Cal_Cal.ZDrive_BSW_Cal_VehicleInfomationTable.FC2LeftWheel_m "" VALUE 0x3d8188 Record_FLOAT32_IEEE 0 autosar_swc_las_CM_single -3.4E+38 3.4E+38 /end CHARACTERISTIC
/begin CHARACTERISTIC ZDrive_BSW_Cal_Cal.ZDrive_BSW_Cal_VehicleInfomationTable.FC2RearAxisX_m "" VALUE 0x3d816c Record_FLOAT32_IEEE 0 autosar_swc_las_CM_single -3.4E+38 3.4E+38 /end CHARACTERISTIC
/begin CHARACTERISTIC ZDrive_BSW_Cal_Cal.ZDrive_BSW_Cal_VehicleInfomationTable.FC2RearAxisY_m "" VALUE 0x3d8170 Record_FLOAT32_IEEE 0 autosar_swc_las_CM_single -3.4E+38 3.4E+38 /end CHARACTERISTIC
/begin CHARACTERISTIC ZDrive_BSW_Cal_Cal.ZDrive_BSW_Cal_VehicleInfomationTable.FC2RightWheel_m "" VALUE 0x3d818c Record_FLOAT32_IEEE 0 autosar_swc_las_CM_single -3.4E+38 3.4E+38 /end CHARACTERISTIC
/begin CHARACTERISTIC ZDrive_BSW_Cal_Cal.ZDrive_BSW_Cal_VehicleInfomationTable.FCFirstViewPointDist_m "" VALUE 0x3d8178 Record_FLOAT32_IEEE 0 autosar_swc_las_CM_single -3.4E+38 3.4E+38 /end CHARACTERISTIC
/begin CHARACTERISTIC ZDrive_BSW_Cal_Cal.ZDrive_BSW_Cal_VehicleInfomationTable.FCFocus2FrAxleDist_Y_m "" VALUE 0x3d8164 Record_FLOAT32_IEEE 0 autosar_swc_las_CM_single -3.4E+38 3.4E+38 /end CHARACTERISTIC
/begin CHARACTERISTIC ZDrive_BSW_Cal_Cal.ZDrive_BSW_Cal_VehicleInfomationTable.FCFocus2FrAxleDist_Z_m "" VALUE 0x3d8168 Record_FLOAT32_IEEE 0 autosar_swc_las_CM_single -3.4E+38 3.4E+38 /end CHARACTERISTIC
/begin CHARACTERISTIC ZDrive_BSW_Cal_Cal.ZDrive_BSW_Cal_VehicleInfomationTable.FRollingRadius_m "" VALUE 0x3d8150 Record_FLOAT32_IEEE 0 autosar_swc_las_CM_single -3.4E+38 3.4E+38 /end CHARACTERISTIC
/begin CHARACTERISTIC ZDrive_BSW_Cal_Cal.ZDrive_BSW_Cal_VehicleInfomationTable.FrSCBlindSpotLength_m "" VALUE 0x3d81d0 Record_FLOAT32_IEEE 0 autosar_swc_las_CM_single -3.4E+38 3.4E+38 /end CHARACTERISTIC
/begin CHARACTERISTIC ZDrive_BSW_Cal_Cal.ZDrive_BSW_Cal_VehicleInfomationTable.FrSCDist2OuterMostSide_m "" VALUE 0x3d81d4 Record_FLOAT32_IEEE 0 autosar_swc_las_CM_single -3.4E+38 3.4E+38 /end CHARACTERISTIC
/begin CHARACTERISTIC ZDrive_BSW_Cal_Cal.ZDrive_BSW_Cal_VehicleInfomationTable.FrWhlHousingHeight_m "" VALUE 0x3d80c0 Record_FLOAT32_IEEE 0 autosar_swc_las_CM_single -3.4E+38 3.4E+38 /end CHARACTERISTIC
/begin CHARACTERISTIC ZDrive_BSW_Cal_Cal.ZDrive_BSW_Cal_VehicleInfomationTable.FrWhlTrack_m "" VALUE 0x3d80b0 Record_FLOAT32_IEEE 0 autosar_swc_las_CM_single -3.4E+38 3.4E+38 /end CHARACTERISTIC
/begin CHARACTERISTIC ZDrive_BSW_Cal_Cal.ZDrive_BSW_Cal_VehicleInfomationTable.FrntLeCrnrUss_Dx "" VALUE 0x3d8260 Record_FLOAT32_IEEE 0 autosar_swc_las_CM_single -3.4E+38 3.4E+38 /end CHARACTERISTIC
/begin CHARACTERISTIC ZDrive_BSW_Cal_Cal.ZDrive_BSW_Cal_VehicleInfomationTable.FrntLeCrnrUss_Dy "" VALUE 0x3d8264 Record_FLOAT32_IEEE 0 autosar_swc_las_CM_single -3.4E+38 3.4E+38 /end CHARACTERISTIC
/begin CHARACTERISTIC ZDrive_BSW_Cal_Cal.ZDrive_BSW_Cal_VehicleInfomationTable.FrntLeCrnrUss_Dz "" VALUE 0x3d8268 Record_FLOAT32_IEEE 0 autosar_swc_las_CM_single -3.4E+38 3.4E+38 /end CHARACTERISTIC
/begin CHARACTERISTIC ZDrive_BSW_Cal_Cal.ZDrive_BSW_Cal_VehicleInfomationTable.FrntLeCrnrUss_Pitch "" VALUE 0x3d8274 Record_FLOAT32_IEEE 0 autosar_swc_las_CM_single -3.4E+38 3.4E+38 /end CHARACTERISTIC
/begin CHARACTERISTIC ZDrive_BSW_Cal_Cal.ZDrive_BSW_Cal_VehicleInfomationTable.FrntLeCrnrUss_Roll "" VALUE 0x3d8270 Record_FLOAT32_IEEE 0 autosar_swc_las_CM_single -3.4E+38 3.4E+38 /end CHARACTERISTIC
/begin CHARACTERISTIC ZDrive_BSW_Cal_Cal.ZDrive_BSW_Cal_VehicleInfomationTable.FrntLeCrnrUss_Yaw "" VALUE 0x3d8278 Record_FLOAT32_IEEE 0 autosar_swc_las_CM_single -3.4E+38 3.4E+38 /end CHARACTERISTIC
/begin CHARACTERISTIC ZDrive_BSW_Cal_Cal.ZDrive_BSW_Cal_VehicleInfomationTable.FrntLeMidUss_Dx "" VALUE 0x3d827c Record_FLOAT32_IEEE 0 autosar_swc_las_CM_single -3.4E+38 3.4E+38 /end CHARACTERISTIC
/begin CHARACTERISTIC ZDrive_BSW_Cal_Cal.ZDrive_BSW_Cal_VehicleInfomationTable.FrntLeMidUss_Dy "" VALUE 0x3d8280 Record_FLOAT32_IEEE 0 autosar_swc_las_CM_single -3.4E+38 3.4E+38 /end CHARACTERISTIC
/begin CHARACTERISTIC ZDrive_BSW_Cal_Cal.ZDrive_BSW_Cal_VehicleInfomationTable.FrntLeMidUss_Dz "" VALUE 0x3d8284 Record_FLOAT32_IEEE 0 autosar_swc_las_CM_single -3.4E+38 3.4E+38 /end CHARACTERISTIC
/begin CHARACTERISTIC ZDrive_BSW_Cal_Cal.ZDrive_BSW_Cal_VehicleInfomationTable.FrntLeMidUss_Pitch "" VALUE 0x3d8290 Record_FLOAT32_IEEE 0 autosar_swc_las_CM_single -3.4E+38 3.4E+38 /end CHARACTERISTIC
/begin CHARACTERISTIC ZDrive_BSW_Cal_Cal.ZDrive_BSW_Cal_VehicleInfomationTable.FrntLeMidUss_Roll "" VALUE 0x3d828c Record_FLOAT32_IEEE 0 autosar_swc_las_CM_single -3.4E+38 3.4E+38 /end CHARACTERISTIC
/begin CHARACTERISTIC ZDrive_BSW_Cal_Cal.ZDrive_BSW_Cal_VehicleInfomationTable.FrntLeMidUss_Yaw "" VALUE 0x3d8294 Record_FLOAT32_IEEE 0 autosar_swc_las_CM_single -3.4E+38 3.4E+38 /end CHARACTERISTIC
/begin CHARACTERISTIC ZDrive_BSW_Cal_Cal.ZDrive_BSW_Cal_VehicleInfomationTable.FrntLeSideUss_Dx "" VALUE 0x3d8244 Record_FLOAT32_IEEE 0 autosar_swc_las_CM_single -3.4E+38 3.4E+38 /end CHARACTERISTIC
/begin CHARACTERISTIC ZDrive_BSW_Cal_Cal.ZDrive_BSW_Cal_VehicleInfomationTable.FrntLeSideUss_Dy "" VALUE 0x3d8248 Record_FLOAT32_IEEE 0 autosar_swc_las_CM_single -3.4E+38 3.4E+38 /end CHARACTERISTIC
/begin CHARACTERISTIC ZDrive_BSW_Cal_Cal.ZDrive_BSW_Cal_VehicleInfomationTable.FrntLeSideUss_Dz "" VALUE 0x3d824c Record_FLOAT32_IEEE 0 autosar_swc_las_CM_single -3.4E+38 3.4E+38 /end CHARACTERISTIC
/begin CHARACTERISTIC ZDrive_BSW_Cal_Cal.ZDrive_BSW_Cal_VehicleInfomationTable.FrntLeSideUss_Pitch "" VALUE 0x3d8258 Record_FLOAT32_IEEE 0 autosar_swc_las_CM_single -3.4E+38 3.4E+38 /end CHARACTERISTIC
/begin CHARACTERISTIC ZDrive_BSW_Cal_Cal.ZDrive_BSW_Cal_VehicleInfomationTable.FrntLeSideUss_Roll "" VALUE 0x3d8254 Record_FLOAT32_IEEE 0 autosar_swc_las_CM_single -3.4E+38 3.4E+38 /end CHARACTERISTIC
/begin CHARACTERISTIC ZDrive_BSW_Cal_Cal.ZDrive_BSW_Cal_VehicleInfomationTable.FrntLeSideUss_Yaw "" VALUE 0x3d825c Record_FLOAT32_IEEE 0 autosar_swc_las_CM_single -3.4E+38 3.4E+38 /end CHARACTERISTIC
/begin CHARACTERISTIC ZDrive_BSW_Cal_Cal.ZDrive_BSW_Cal_VehicleInfomationTable.FrntRiCrnrUss_Dx "" VALUE 0x3d82b4 Record_FLOAT32_IEEE 0 autosar_swc_las_CM_single -3.4E+38 3.4E+38 /end CHARACTERISTIC
/begin CHARACTERISTIC ZDrive_BSW_Cal_Cal.ZDrive_BSW_Cal_VehicleInfomationTable.FrntRiCrnrUss_Dy "" VALUE 0x3d82b8 Record_FLOAT32_IEEE 0 autosar_swc_las_CM_single -3.4E+38 3.4E+38 /end CHARACTERISTIC
/begin CHARACTERISTIC ZDrive_BSW_Cal_Cal.ZDrive_BSW_Cal_VehicleInfomationTable.FrntRiCrnrUss_Dz "" VALUE 0x3d82bc Record_FLOAT32_IEEE 0 autosar_swc_las_CM_single -3.4E+38 3.4E+38 /end CHARACTERISTIC
/begin CHARACTERISTIC ZDrive_BSW_Cal_Cal.ZDrive_BSW_Cal_VehicleInfomationTable.FrntRiCrnrUss_Pitch "" VALUE 0x3d82c8 Record_FLOAT32_IEEE 0 autosar_swc_las_CM_single -3.4E+38 3.4E+38 /end CHARACTERISTIC
/begin CHARACTERISTIC ZDrive_BSW_Cal_Cal.ZDrive_BSW_Cal_VehicleInfomationTable.FrntRiCrnrUss_Roll "" VALUE 0x3d82c4 Record_FLOAT32_IEEE 0 autosar_swc_las_CM_single -3.4E+38 3.4E+38 /end CHARACTERISTIC
/begin CHARACTERISTIC ZDrive_BSW_Cal_Cal.ZDrive_BSW_Cal_VehicleInfomationTable.FrntRiCrnrUss_Yaw "" VALUE 0x3d82cc Record_FLOAT32_IEEE 0 autosar_swc_las_CM_single -3.4E+38 3.4E+38 /end CHARACTERISTIC
/begin CHARACTERISTIC ZDrive_BSW_Cal_Cal.ZDrive_BSW_Cal_VehicleInfomationTable.FrntRiMidUss_Dx "" VALUE 0x3d8298 Record_FLOAT32_IEEE 0 autosar_swc_las_CM_single -3.4E+38 3.4E+38 /end CHARACTERISTIC
/begin CHARACTERISTIC ZDrive_BSW_Cal_Cal.ZDrive_BSW_Cal_VehicleInfomationTable.FrntRiMidUss_Dy "" VALUE 0x3d829c Record_FLOAT32_IEEE 0 autosar_swc_las_CM_single -3.4E+38 3.4E+38 /end CHARACTERISTIC
/begin CHARACTERISTIC ZDrive_BSW_Cal_Cal.ZDrive_BSW_Cal_VehicleInfomationTable.FrntRiMidUss_Dz "" VALUE 0x3d82a0 Record_FLOAT32_IEEE 0 autosar_swc_las_CM_single -3.4E+38 3.4E+38 /end CHARACTERISTIC
/begin CHARACTERISTIC ZDrive_BSW_Cal_Cal.ZDrive_BSW_Cal_VehicleInfomationTable.FrntRiMidUss_Pitch "" VALUE 0x3d82ac Record_FLOAT32_IEEE 0 autosar_swc_las_CM_single -3.4E+38 3.4E+38 /end CHARACTERISTIC
/begin CHARACTERISTIC ZDrive_BSW_Cal_Cal.ZDrive_BSW_Cal_VehicleInfomationTable.FrntRiMidUss_Roll "" VALUE 0x3d82a8 Record_FLOAT32_IEEE 0 autosar_swc_las_CM_single -3.4E+38 3.4E+38 /end CHARACTERISTIC
/begin CHARACTERISTIC ZDrive_BSW_Cal_Cal.ZDrive_BSW_Cal_VehicleInfomationTable.FrntRiMidUss_Yaw "" VALUE 0x3d82b0 Record_FLOAT32_IEEE 0 autosar_swc_las_CM_single -3.4E+38 3.4E+38 /end CHARACTERISTIC
/begin CHARACTERISTIC ZDrive_BSW_Cal_Cal.ZDrive_BSW_Cal_VehicleInfomationTable.FrntRiSideUss_Dx "" VALUE 0x3d82d0 Record_FLOAT32_IEEE 0 autosar_swc_las_CM_single -3.4E+38 3.4E+38 /end CHARACTERISTIC
/begin CHARACTERISTIC ZDrive_BSW_Cal_Cal.ZDrive_BSW_Cal_VehicleInfomationTable.FrntRiSideUss_Dy "" VALUE 0x3d82d4 Record_FLOAT32_IEEE 0 autosar_swc_las_CM_single -3.4E+38 3.4E+38 /end CHARACTERISTIC
/begin CHARACTERISTIC ZDrive_BSW_Cal_Cal.ZDrive_BSW_Cal_VehicleInfomationTable.FrntRiSideUss_Dz "" VALUE 0x3d82d8 Record_FLOAT32_IEEE 0 autosar_swc_las_CM_single -3.4E+38 3.4E+38 /end CHARACTERISTIC
/begin CHARACTERISTIC ZDrive_BSW_Cal_Cal.ZDrive_BSW_Cal_VehicleInfomationTable.FrntRiSideUss_Pitch "" VALUE 0x3d82e4 Record_FLOAT32_IEEE 0 autosar_swc_las_CM_single -3.4E+38 3.4E+38 /end CHARACTERISTIC
/begin CHARACTERISTIC ZDrive_BSW_Cal_Cal.ZDrive_BSW_Cal_VehicleInfomationTable.FrntRiSideUss_Roll "" VALUE 0x3d82e0 Record_FLOAT32_IEEE 0 autosar_swc_las_CM_single -3.4E+38 3.4E+38 /end CHARACTERISTIC
/begin CHARACTERISTIC ZDrive_BSW_Cal_Cal.ZDrive_BSW_Cal_VehicleInfomationTable.FrntRiSideUss_Yaw "" VALUE 0x3d82e8 Record_FLOAT32_IEEE 0 autosar_swc_las_CM_single -3.4E+38 3.4E+38 /end CHARACTERISTIC
/begin CHARACTERISTIC ZDrive_BSW_Cal_Cal.ZDrive_BSW_Cal_VehicleInfomationTable.FrontAxleToCenter_m "" VALUE 0x3d80d0 Record_FLOAT32_IEEE 0 autosar_swc_las_CM_single -3.4E+38 3.4E+38 /end CHARACTERISTIC
/begin CHARACTERISTIC ZDrive_BSW_Cal_Cal.ZDrive_BSW_Cal_VehicleInfomationTable.FrontAxleToRearAxLeCenterX_m "" VALUE 0x3d80a8 Record_FLOAT32_IEEE 0 autosar_swc_las_CM_single -3.4E+38 3.4E+38 /end CHARACTERISTIC
/begin CHARACTERISTIC ZDrive_BSW_Cal_Cal.ZDrive_BSW_Cal_VehicleInfomationTable.FrontLeftFrontPointToCenterLine_Distance_m "" VALUE 0x3d80f0 Record_FLOAT32_IEEE 0 autosar_swc_las_CM_single -3.4E+38 3.4E+38 /end CHARACTERISTIC
/begin CHARACTERISTIC ZDrive_BSW_Cal_Cal.ZDrive_BSW_Cal_VehicleInfomationTable.FrontLeftFrontPointToRearAxleCenter_Distance_m "" VALUE 0x3d80ec Record_FLOAT32_IEEE 0 autosar_swc_las_CM_single -3.4E+38 3.4E+38 /end CHARACTERISTIC
/begin CHARACTERISTIC ZDrive_BSW_Cal_Cal.ZDrive_BSW_Cal_VehicleInfomationTable.FrontLeftOutsidePointToCenterLine_Distance_m "" VALUE 0x3d80f8 Record_FLOAT32_IEEE 0 autosar_swc_las_CM_single -3.4E+38 3.4E+38 /end CHARACTERISTIC
/begin CHARACTERISTIC ZDrive_BSW_Cal_Cal.ZDrive_BSW_Cal_VehicleInfomationTable.FrontLeftOutsidePointToRearAxleCenter_Distance_m "" VALUE 0x3d80f4 Record_FLOAT32_IEEE 0 autosar_swc_las_CM_single -3.4E+38 3.4E+38 /end CHARACTERISTIC
/begin CHARACTERISTIC ZDrive_BSW_Cal_Cal.ZDrive_BSW_Cal_VehicleInfomationTable.FrontOverhang_Length_m "" VALUE 0x3d80b8 Record_FLOAT32_IEEE 0 autosar_swc_las_CM_single -3.4E+38 3.4E+38 /end CHARACTERISTIC
/begin CHARACTERISTIC ZDrive_BSW_Cal_Cal.ZDrive_BSW_Cal_VehicleInfomationTable.FrontShortCamera_Dx "" VALUE 0x3d81b4 Record_FLOAT32_IEEE 0 autosar_swc_las_CM_single -3.4E+38 3.4E+38 /end CHARACTERISTIC
/begin CHARACTERISTIC ZDrive_BSW_Cal_Cal.ZDrive_BSW_Cal_VehicleInfomationTable.FrontShortCamera_Dy "" VALUE 0x3d81b8 Record_FLOAT32_IEEE 0 autosar_swc_las_CM_single -3.4E+38 3.4E+38 /end CHARACTERISTIC
/begin CHARACTERISTIC ZDrive_BSW_Cal_Cal.ZDrive_BSW_Cal_VehicleInfomationTable.FrontShortCamera_Dz "" VALUE 0x3d81bc Record_FLOAT32_IEEE 0 autosar_swc_las_CM_single -3.4E+38 3.4E+38 /end CHARACTERISTIC
/begin CHARACTERISTIC ZDrive_BSW_Cal_Cal.ZDrive_BSW_Cal_VehicleInfomationTable.FrontShortCamera_Pitch "" VALUE 0x3d81c8 Record_FLOAT32_IEEE 0 autosar_swc_las_CM_single -3.4E+38 3.4E+38 /end CHARACTERISTIC
/begin CHARACTERISTIC ZDrive_BSW_Cal_Cal.ZDrive_BSW_Cal_VehicleInfomationTable.FrontShortCamera_Roll "" VALUE 0x3d81c4 Record_FLOAT32_IEEE 0 autosar_swc_las_CM_single -3.4E+38 3.4E+38 /end CHARACTERISTIC
/begin CHARACTERISTIC ZDrive_BSW_Cal_Cal.ZDrive_BSW_Cal_VehicleInfomationTable.FrontShortCamera_Yaw "" VALUE 0x3d81cc Record_FLOAT32_IEEE 0 autosar_swc_las_CM_single -3.4E+38 3.4E+38 /end CHARACTERISTIC
/begin CHARACTERISTIC ZDrive_BSW_Cal_Cal.ZDrive_BSW_Cal_VehicleInfomationTable.GVW_kg "" VALUE 0x3d8114 Record_FLOAT32_IEEE 0 autosar_swc_las_CM_single -3.4E+38 3.4E+38 /end CHARACTERISTIC
/begin CHARACTERISTIC ZDrive_BSW_Cal_Cal.ZDrive_BSW_Cal_VehicleInfomationTable.Height_m "" VALUE 0x3d809c Record_FLOAT32_IEEE 0 autosar_swc_las_CM_single -3.4E+38 3.4E+38 /end CHARACTERISTIC
/begin CHARACTERISTIC ZDrive_BSW_Cal_Cal.ZDrive_BSW_Cal_VehicleInfomationTable.IEnviroment_Bottom_Crop "" VALUE 0x3d8184 Record_SWORD 0 autosar_swc_las_CM_int16 -32768 32767 /end CHARACTERISTIC
/begin CHARACTERISTIC ZDrive_BSW_Cal_Cal.ZDrive_BSW_Cal_VehicleInfomationTable.IEnviroment_Top_Crop "" VALUE 0x3d8182 Record_UWORD 0 autosar_swc_las_CM_uint16 0 65535 /end CHARACTERISTIC
/begin CHARACTERISTIC ZDrive_BSW_Cal_Cal.ZDrive_BSW_Cal_VehicleInfomationTable.IEnvironment_CamToFrontAxle "" VALUE 0x3d8160 Record_FLOAT32_IEEE 0 autosar_swc_las_CM_single -3.4E+38 3.4E+38 /end CHARACTERISTIC
/begin CHARACTERISTIC ZDrive_BSW_Cal_Cal.ZDrive_BSW_Cal_VehicleInfomationTable.IEnvironment_RefPX_Front_Bumper "" VALUE 0x3d817c Record_FLOAT32_IEEE 0 autosar_swc_las_CM_single -3.4E+38 3.4E+38 /end CHARACTERISTIC
/begin CHARACTERISTIC ZDrive_BSW_Cal_Cal.ZDrive_BSW_Cal_VehicleInfomationTable.IEnvironment_WheelWidth "" VALUE 0x3d8120 Record_FLOAT32_IEEE 0 autosar_swc_las_CM_single -3.4E+38 3.4E+38 /end CHARACTERISTIC
/begin CHARACTERISTIC ZDrive_BSW_Cal_Cal.ZDrive_BSW_Cal_VehicleInfomationTable.LeSCBlindSpotLength_m "" VALUE 0x3d81f4 Record_FLOAT32_IEEE 0 autosar_swc_las_CM_single -3.4E+38 3.4E+38 /end CHARACTERISTIC
/begin CHARACTERISTIC ZDrive_BSW_Cal_Cal.ZDrive_BSW_Cal_VehicleInfomationTable.LeSCVerticalDist2Body_m "" VALUE 0x3d81f8 Record_FLOAT32_IEEE 0 autosar_swc_las_CM_single -3.4E+38 3.4E+38 /end CHARACTERISTIC
/begin CHARACTERISTIC ZDrive_BSW_Cal_Cal.ZDrive_BSW_Cal_VehicleInfomationTable.LeftShortCamera_Dx "" VALUE 0x3d81d8 Record_FLOAT32_IEEE 0 autosar_swc_las_CM_single -3.4E+38 3.4E+38 /end CHARACTERISTIC
/begin CHARACTERISTIC ZDrive_BSW_Cal_Cal.ZDrive_BSW_Cal_VehicleInfomationTable.LeftShortCamera_Dy "" VALUE 0x3d81dc Record_FLOAT32_IEEE 0 autosar_swc_las_CM_single -3.4E+38 3.4E+38 /end CHARACTERISTIC
/begin CHARACTERISTIC ZDrive_BSW_Cal_Cal.ZDrive_BSW_Cal_VehicleInfomationTable.LeftShortCamera_Dz "" VALUE 0x3d81e0 Record_FLOAT32_IEEE 0 autosar_swc_las_CM_single -3.4E+38 3.4E+38 /end CHARACTERISTIC
/begin CHARACTERISTIC ZDrive_BSW_Cal_Cal.ZDrive_BSW_Cal_VehicleInfomationTable.LeftShortCamera_Pitch "" VALUE 0x3d81ec Record_FLOAT32_IEEE 0 autosar_swc_las_CM_single -3.4E+38 3.4E+38 /end CHARACTERISTIC
/begin CHARACTERISTIC ZDrive_BSW_Cal_Cal.ZDrive_BSW_Cal_VehicleInfomationTable.LeftShortCamera_Roll "" VALUE 0x3d81e8 Record_FLOAT32_IEEE 0 autosar_swc_las_CM_single -3.4E+38 3.4E+38 /end CHARACTERISTIC
/begin CHARACTERISTIC ZDrive_BSW_Cal_Cal.ZDrive_BSW_Cal_VehicleInfomationTable.LeftShortCamera_Yaw "" VALUE 0x3d81f0 Record_FLOAT32_IEEE 0 autosar_swc_las_CM_single -3.4E+38 3.4E+38 /end CHARACTERISTIC
/begin CHARACTERISTIC ZDrive_BSW_Cal_Cal.ZDrive_BSW_Cal_VehicleInfomationTable.Left_Right_handType "" VALUE 0x3d8076 Record_UBYTE 0 autosar_swc_las_CM_uint8 0 255 /end CHARACTERISTIC
/begin CHARACTERISTIC ZDrive_BSW_Cal_Cal.ZDrive_BSW_Cal_VehicleInfomationTable.MaxSteeringAngle "" VALUE 0x3d8140 Record_FLOAT32_IEEE 0 autosar_swc_las_CM_single -3.4E+38 3.4E+38 /end CHARACTERISTIC
/begin CHARACTERISTIC ZDrive_BSW_Cal_Cal.ZDrive_BSW_Cal_VehicleInfomationTable.ParkingBrakeType "" VALUE 0x3d8072 Record_UBYTE 0 autosar_swc_las_CM_uint8 0 255 /end CHARACTERISTIC
/begin CHARACTERISTIC ZDrive_BSW_Cal_Cal.ZDrive_BSW_Cal_VehicleInfomationTable.ParkingLongControlInterForm "" VALUE 0x3d8074 Record_UBYTE 0 autosar_swc_las_CM_uint8 0 255 /end CHARACTERISTIC
/begin CHARACTERISTIC ZDrive_BSW_Cal_Cal.ZDrive_BSW_Cal_VehicleInfomationTable.PitchAngOfCAD "" VALUE 0x3d81ac Record_FLOAT32_IEEE 0 autosar_swc_las_CM_single -3.4E+38 3.4E+38 /end CHARACTERISTIC
/begin CHARACTERISTIC ZDrive_BSW_Cal_Cal.ZDrive_BSW_Cal_VehicleInfomationTable.PowerTransRatio "" VALUE 0x3d8158 Record_FLOAT32_IEEE 0 autosar_swc_las_CM_single -3.4E+38 3.4E+38 /end CHARACTERISTIC
/begin CHARACTERISTIC ZDrive_BSW_Cal_Cal.ZDrive_BSW_Cal_VehicleInfomationTable.RRollingRadius_m "" VALUE 0x3d8154 Record_FLOAT32_IEEE 0 autosar_swc_las_CM_single -3.4E+38 3.4E+38 /end CHARACTERISTIC
/begin CHARACTERISTIC ZDrive_BSW_Cal_Cal.ZDrive_BSW_Cal_VehicleInfomationTable.ReLeCrnrUss_Dx "" VALUE 0x3d835c Record_FLOAT32_IEEE 0 autosar_swc_las_CM_single -3.4E+38 3.4E+38 /end CHARACTERISTIC
/begin CHARACTERISTIC ZDrive_BSW_Cal_Cal.ZDrive_BSW_Cal_VehicleInfomationTable.ReLeCrnrUss_Dy "" VALUE 0x3d8360 Record_FLOAT32_IEEE 0 autosar_swc_las_CM_single -3.4E+38 3.4E+38 /end CHARACTERISTIC
/begin CHARACTERISTIC ZDrive_BSW_Cal_Cal.ZDrive_BSW_Cal_VehicleInfomationTable.ReLeCrnrUss_Dz "" VALUE 0x3d8364 Record_FLOAT32_IEEE 0 autosar_swc_las_CM_single -3.4E+38 3.4E+38 /end CHARACTERISTIC
/begin CHARACTERISTIC ZDrive_BSW_Cal_Cal.ZDrive_BSW_Cal_VehicleInfomationTable.ReLeCrnrUss_Pitch "" VALUE 0x3d8370 Record_FLOAT32_IEEE 0 autosar_swc_las_CM_single -3.4E+38 3.4E+38 /end CHARACTERISTIC
/begin CHARACTERISTIC ZDrive_BSW_Cal_Cal.ZDrive_BSW_Cal_VehicleInfomationTable.ReLeCrnrUss_Roll "" VALUE 0x3d836c Record_FLOAT32_IEEE 0 autosar_swc_las_CM_single -3.4E+38 3.4E+38 /end CHARACTERISTIC
/begin CHARACTERISTIC ZDrive_BSW_Cal_Cal.ZDrive_BSW_Cal_VehicleInfomationTable.ReLeCrnrUss_Yaw "" VALUE 0x3d8374 Record_FLOAT32_IEEE 0 autosar_swc_las_CM_single -3.4E+38 3.4E+38 /end CHARACTERISTIC
/begin CHARACTERISTIC ZDrive_BSW_Cal_Cal.ZDrive_BSW_Cal_VehicleInfomationTable.ReLeMidUss_Dx "" VALUE 0x3d8340 Record_FLOAT32_IEEE 0 autosar_swc_las_CM_single -3.4E+38 3.4E+38 /end CHARACTERISTIC
/begin CHARACTERISTIC ZDrive_BSW_Cal_Cal.ZDrive_BSW_Cal_VehicleInfomationTable.ReLeMidUss_Dy "" VALUE 0x3d8344 Record_FLOAT32_IEEE 0 autosar_swc_las_CM_single -3.4E+38 3.4E+38 /end CHARACTERISTIC
/begin CHARACTERISTIC ZDrive_BSW_Cal_Cal.ZDrive_BSW_Cal_VehicleInfomationTable.ReLeMidUss_Dz "" VALUE 0x3d8348 Record_FLOAT32_IEEE 0 autosar_swc_las_CM_single -3.4E+38 3.4E+38 /end CHARACTERISTIC
/begin CHARACTERISTIC ZDrive_BSW_Cal_Cal.ZDrive_BSW_Cal_VehicleInfomationTable.ReLeMidUss_Pitch "" VALUE 0x3d8354 Record_FLOAT32_IEEE 0 autosar_swc_las_CM_single -3.4E+38 3.4E+38 /end CHARACTERISTIC
/begin CHARACTERISTIC ZDrive_BSW_Cal_Cal.ZDrive_BSW_Cal_VehicleInfomationTable.ReLeMidUss_Roll "" VALUE 0x3d8350 Record_FLOAT32_IEEE 0 autosar_swc_las_CM_single -3.4E+38 3.4E+38 /end CHARACTERISTIC
/begin CHARACTERISTIC ZDrive_BSW_Cal_Cal.ZDrive_BSW_Cal_VehicleInfomationTable.ReLeMidUss_Yaw "" VALUE 0x3d8358 Record_FLOAT32_IEEE 0 autosar_swc_las_CM_single -3.4E+38 3.4E+38 /end CHARACTERISTIC
/begin CHARACTERISTIC ZDrive_BSW_Cal_Cal.ZDrive_BSW_Cal_VehicleInfomationTable.ReLeSideUss_Dx "" VALUE 0x3d8378 Record_FLOAT32_IEEE 0 autosar_swc_las_CM_single -3.4E+38 3.4E+38 /end CHARACTERISTIC
/begin CHARACTERISTIC ZDrive_BSW_Cal_Cal.ZDrive_BSW_Cal_VehicleInfomationTable.ReLeSideUss_Dy "" VALUE 0x3d837c Record_FLOAT32_IEEE 0 autosar_swc_las_CM_single -3.4E+38 3.4E+38 /end CHARACTERISTIC
/begin CHARACTERISTIC ZDrive_BSW_Cal_Cal.ZDrive_BSW_Cal_VehicleInfomationTable.ReLeSideUss_Dz "" VALUE 0x3d8380 Record_FLOAT32_IEEE 0 autosar_swc_las_CM_single -3.4E+38 3.4E+38 /end CHARACTERISTIC
/begin CHARACTERISTIC ZDrive_BSW_Cal_Cal.ZDrive_BSW_Cal_VehicleInfomationTable.ReLeSideUss_Pitch "" VALUE 0x3d838c Record_FLOAT32_IEEE 0 autosar_swc_las_CM_single -3.4E+38 3.4E+38 /end CHARACTERISTIC
/begin CHARACTERISTIC ZDrive_BSW_Cal_Cal.ZDrive_BSW_Cal_VehicleInfomationTable.ReLeSideUss_Roll "" VALUE 0x3d8388 Record_FLOAT32_IEEE 0 autosar_swc_las_CM_single -3.4E+38 3.4E+38 /end CHARACTERISTIC
/begin CHARACTERISTIC ZDrive_BSW_Cal_Cal.ZDrive_BSW_Cal_VehicleInfomationTable.ReLeSideUss_Yaw "" VALUE 0x3d8390 Record_FLOAT32_IEEE 0 autosar_swc_las_CM_single -3.4E+38 3.4E+38 /end CHARACTERISTIC
/begin CHARACTERISTIC ZDrive_BSW_Cal_Cal.ZDrive_BSW_Cal_VehicleInfomationTable.ReRiCrnrUss_Dx "" VALUE 0x3d8308 Record_FLOAT32_IEEE 0 autosar_swc_las_CM_single -3.4E+38 3.4E+38 /end CHARACTERISTIC
/begin CHARACTERISTIC ZDrive_BSW_Cal_Cal.ZDrive_BSW_Cal_VehicleInfomationTable.ReRiCrnrUss_Dy "" VALUE 0x3d830c Record_FLOAT32_IEEE 0 autosar_swc_las_CM_single -3.4E+38 3.4E+38 /end CHARACTERISTIC
/begin CHARACTERISTIC ZDrive_BSW_Cal_Cal.ZDrive_BSW_Cal_VehicleInfomationTable.ReRiCrnrUss_Dz "" VALUE 0x3d8310 Record_FLOAT32_IEEE 0 autosar_swc_las_CM_single -3.4E+38 3.4E+38 /end CHARACTERISTIC
/begin CHARACTERISTIC ZDrive_BSW_Cal_Cal.ZDrive_BSW_Cal_VehicleInfomationTable.ReRiCrnrUss_Pitch "" VALUE 0x3d831c Record_FLOAT32_IEEE 0 autosar_swc_las_CM_single -3.4E+38 3.4E+38 /end CHARACTERISTIC
/begin CHARACTERISTIC ZDrive_BSW_Cal_Cal.ZDrive_BSW_Cal_VehicleInfomationTable.ReRiCrnrUss_Roll "" VALUE 0x3d8318 Record_FLOAT32_IEEE 0 autosar_swc_las_CM_single -3.4E+38 3.4E+38 /end CHARACTERISTIC
/begin CHARACTERISTIC ZDrive_BSW_Cal_Cal.ZDrive_BSW_Cal_VehicleInfomationTable.ReRiCrnrUss_Yaw "" VALUE 0x3d8320 Record_FLOAT32_IEEE 0 autosar_swc_las_CM_single -3.4E+38 3.4E+38 /end CHARACTERISTIC
/begin CHARACTERISTIC ZDrive_BSW_Cal_Cal.ZDrive_BSW_Cal_VehicleInfomationTable.ReRiMidUss_Dx "" VALUE 0x3d8324 Record_FLOAT32_IEEE 0 autosar_swc_las_CM_single -3.4E+38 3.4E+38 /end CHARACTERISTIC
/begin CHARACTERISTIC ZDrive_BSW_Cal_Cal.ZDrive_BSW_Cal_VehicleInfomationTable.ReRiMidUss_Dy "" VALUE 0x3d8328 Record_FLOAT32_IEEE 0 autosar_swc_las_CM_single -3.4E+38 3.4E+38 /end CHARACTERISTIC
/begin CHARACTERISTIC ZDrive_BSW_Cal_Cal.ZDrive_BSW_Cal_VehicleInfomationTable.ReRiMidUss_Dz "" VALUE 0x3d832c Record_FLOAT32_IEEE 0 autosar_swc_las_CM_single -3.4E+38 3.4E+38 /end CHARACTERISTIC
/begin CHARACTERISTIC ZDrive_BSW_Cal_Cal.ZDrive_BSW_Cal_VehicleInfomationTable.ReRiMidUss_Pitch "" VALUE 0x3d8338 Record_FLOAT32_IEEE 0 autosar_swc_las_CM_single -3.4E+38 3.4E+38 /end CHARACTERISTIC
/begin CHARACTERISTIC ZDrive_BSW_Cal_Cal.ZDrive_BSW_Cal_VehicleInfomationTable.ReRiMidUss_Roll "" VALUE 0x3d8334 Record_FLOAT32_IEEE 0 autosar_swc_las_CM_single -3.4E+38 3.4E+38 /end CHARACTERISTIC
/begin CHARACTERISTIC ZDrive_BSW_Cal_Cal.ZDrive_BSW_Cal_VehicleInfomationTable.ReRiMidUss_Yaw "" VALUE 0x3d833c Record_FLOAT32_IEEE 0 autosar_swc_las_CM_single -3.4E+38 3.4E+38 /end CHARACTERISTIC
/begin CHARACTERISTIC ZDrive_BSW_Cal_Cal.ZDrive_BSW_Cal_VehicleInfomationTable.ReRiSideUss_Dx "" VALUE 0x3d82ec Record_FLOAT32_IEEE 0 autosar_swc_las_CM_single -3.4E+38 3.4E+38 /end CHARACTERISTIC
/begin CHARACTERISTIC ZDrive_BSW_Cal_Cal.ZDrive_BSW_Cal_VehicleInfomationTable.ReRiSideUss_Dy "" VALUE 0x3d82f0 Record_FLOAT32_IEEE 0 autosar_swc_las_CM_single -3.4E+38 3.4E+38 /end CHARACTERISTIC
/begin CHARACTERISTIC ZDrive_BSW_Cal_Cal.ZDrive_BSW_Cal_VehicleInfomationTable.ReRiSideUss_Dz "" VALUE 0x3d82f4 Record_FLOAT32_IEEE 0 autosar_swc_las_CM_single -3.4E+38 3.4E+38 /end CHARACTERISTIC
/begin CHARACTERISTIC ZDrive_BSW_Cal_Cal.ZDrive_BSW_Cal_VehicleInfomationTable.ReRiSideUss_Pitch "" VALUE 0x3d8300 Record_FLOAT32_IEEE 0 autosar_swc_las_CM_single -3.4E+38 3.4E+38 /end CHARACTERISTIC
/begin CHARACTERISTIC ZDrive_BSW_Cal_Cal.ZDrive_BSW_Cal_VehicleInfomationTable.ReRiSideUss_Roll "" VALUE 0x3d82fc Record_FLOAT32_IEEE 0 autosar_swc_las_CM_single -3.4E+38 3.4E+38 /end CHARACTERISTIC
/begin CHARACTERISTIC ZDrive_BSW_Cal_Cal.ZDrive_BSW_Cal_VehicleInfomationTable.ReRiSideUss_Yaw "" VALUE 0x3d8304 Record_FLOAT32_IEEE 0 autosar_swc_las_CM_single -3.4E+38 3.4E+38 /end CHARACTERISTIC
/begin CHARACTERISTIC ZDrive_BSW_Cal_Cal.ZDrive_BSW_Cal_VehicleInfomationTable.ReSCBlindSpotLength_m "" VALUE 0x3d8218 Record_FLOAT32_IEEE 0 autosar_swc_las_CM_single -3.4E+38 3.4E+38 /end CHARACTERISTIC
/begin CHARACTERISTIC ZDrive_BSW_Cal_Cal.ZDrive_BSW_Cal_VehicleInfomationTable.ReSCDist2OuterMostSide_m "" VALUE 0x3d821c Record_FLOAT32_IEEE 0 autosar_swc_las_CM_single -3.4E+38 3.4E+38 /end CHARACTERISTIC
/begin CHARACTERISTIC ZDrive_BSW_Cal_Cal.ZDrive_BSW_Cal_VehicleInfomationTable.ReWhlHousingHeight_m "" VALUE 0x3d80c4 Record_FLOAT32_IEEE 0 autosar_swc_las_CM_single -3.4E+38 3.4E+38 /end CHARACTERISTIC
/begin CHARACTERISTIC ZDrive_BSW_Cal_Cal.ZDrive_BSW_Cal_VehicleInfomationTable.ReWhlTrack_m "" VALUE 0x3d80b4 Record_FLOAT32_IEEE 0 autosar_swc_las_CM_single -3.4E+38 3.4E+38 /end CHARACTERISTIC
/begin CHARACTERISTIC ZDrive_BSW_Cal_Cal.ZDrive_BSW_Cal_VehicleInfomationTable.RearAxleToCenter_m "" VALUE 0x3d80d4 Record_FLOAT32_IEEE 0 autosar_swc_las_CM_single -3.4E+38 3.4E+38 /end CHARACTERISTIC
/begin CHARACTERISTIC ZDrive_BSW_Cal_Cal.ZDrive_BSW_Cal_VehicleInfomationTable.RearAxlecCenterTurningCircle "" VALUE 0x3d8148 Record_FLOAT32_IEEE 0 autosar_swc_las_CM_single -3.4E+38 3.4E+38 /end CHARACTERISTIC
/begin CHARACTERISTIC ZDrive_BSW_Cal_Cal.ZDrive_BSW_Cal_VehicleInfomationTable.RearLeftOutsidePointToCenterLine_Distance_m "" VALUE 0x3d8100 Record_FLOAT32_IEEE 0 autosar_swc_las_CM_single -3.4E+38 3.4E+38 /end CHARACTERISTIC
/begin CHARACTERISTIC ZDrive_BSW_Cal_Cal.ZDrive_BSW_Cal_VehicleInfomationTable.RearLeftOutsidePointToRearAxleCenter_Distance_m "" VALUE 0x3d80fc Record_FLOAT32_IEEE 0 autosar_swc_las_CM_single -3.4E+38 3.4E+38 /end CHARACTERISTIC
/begin CHARACTERISTIC ZDrive_BSW_Cal_Cal.ZDrive_BSW_Cal_VehicleInfomationTable.RearLeftRearPointToCenterLine_Distance_m "" VALUE 0x3d8108 Record_FLOAT32_IEEE 0 autosar_swc_las_CM_single -3.4E+38 3.4E+38 /end CHARACTERISTIC
/begin CHARACTERISTIC ZDrive_BSW_Cal_Cal.ZDrive_BSW_Cal_VehicleInfomationTable.RearLeftRearPointToRearAxleCenter_Distance_m "" VALUE 0x3d8104 Record_FLOAT32_IEEE 0 autosar_swc_las_CM_single -3.4E+38 3.4E+38 /end CHARACTERISTIC
/begin CHARACTERISTIC ZDrive_BSW_Cal_Cal.ZDrive_BSW_Cal_VehicleInfomationTable.RearOverhang_Length_m "" VALUE 0x3d80bc Record_FLOAT32_IEEE 0 autosar_swc_las_CM_single -3.4E+38 3.4E+38 /end CHARACTERISTIC
/begin CHARACTERISTIC ZDrive_BSW_Cal_Cal.ZDrive_BSW_Cal_VehicleInfomationTable.RearShortCamera_Dx "" VALUE 0x3d81fc Record_FLOAT32_IEEE 0 autosar_swc_las_CM_single -3.4E+38 3.4E+38 /end CHARACTERISTIC
/begin CHARACTERISTIC ZDrive_BSW_Cal_Cal.ZDrive_BSW_Cal_VehicleInfomationTable.RearShortCamera_Dy "" VALUE 0x3d8200 Record_FLOAT32_IEEE 0 autosar_swc_las_CM_single -3.4E+38 3.4E+38 /end CHARACTERISTIC
/begin CHARACTERISTIC ZDrive_BSW_Cal_Cal.ZDrive_BSW_Cal_VehicleInfomationTable.RearShortCamera_Dz "" VALUE 0x3d8204 Record_FLOAT32_IEEE 0 autosar_swc_las_CM_single -3.4E+38 3.4E+38 /end CHARACTERISTIC
/begin CHARACTERISTIC ZDrive_BSW_Cal_Cal.ZDrive_BSW_Cal_VehicleInfomationTable.RearShortCamera_Pitch "" VALUE 0x3d8210 Record_FLOAT32_IEEE 0 autosar_swc_las_CM_single -3.4E+38 3.4E+38 /end CHARACTERISTIC
/begin CHARACTERISTIC ZDrive_BSW_Cal_Cal.ZDrive_BSW_Cal_VehicleInfomationTable.RearShortCamera_Roll "" VALUE 0x3d820c Record_FLOAT32_IEEE 0 autosar_swc_las_CM_single -3.4E+38 3.4E+38 /end CHARACTERISTIC
/begin CHARACTERISTIC ZDrive_BSW_Cal_Cal.ZDrive_BSW_Cal_VehicleInfomationTable.RearShortCamera_Yaw "" VALUE 0x3d8214 Record_FLOAT32_IEEE 0 autosar_swc_las_CM_single -3.4E+38 3.4E+38 /end CHARACTERISTIC
/begin CHARACTERISTIC ZDrive_BSW_Cal_Cal.ZDrive_BSW_Cal_VehicleInfomationTable.RearViewMirrorBottomSide_Height "" VALUE 0x3d80e4 Record_FLOAT32_IEEE 0 autosar_swc_las_CM_single -3.4E+38 3.4E+38 /end CHARACTERISTIC
/begin CHARACTERISTIC ZDrive_BSW_Cal_Cal.ZDrive_BSW_Cal_VehicleInfomationTable.RearViewMirrorLength_On_X "" VALUE 0x3d80dc Record_FLOAT32_IEEE 0 autosar_swc_las_CM_single -3.4E+38 3.4E+38 /end CHARACTERISTIC
/begin CHARACTERISTIC ZDrive_BSW_Cal_Cal.ZDrive_BSW_Cal_VehicleInfomationTable.RearViewMirrorLength_On_Y "" VALUE 0x3d80d8 Record_FLOAT32_IEEE 0 autosar_swc_las_CM_single -3.4E+38 3.4E+38 /end CHARACTERISTIC
/begin CHARACTERISTIC ZDrive_BSW_Cal_Cal.ZDrive_BSW_Cal_VehicleInfomationTable.RearViewMirrorOutsidePointToRearAxle_Diatance_m "" VALUE 0x3d80e8 Record_FLOAT32_IEEE 0 autosar_swc_las_CM_single -3.4E+38 3.4E+38 /end CHARACTERISTIC
/begin CHARACTERISTIC ZDrive_BSW_Cal_Cal.ZDrive_BSW_Cal_VehicleInfomationTable.RearViewMirrorTopSide_Height "" VALUE 0x3d80e0 Record_FLOAT32_IEEE 0 autosar_swc_las_CM_single -3.4E+38 3.4E+38 /end CHARACTERISTIC
/begin CHARACTERISTIC ZDrive_BSW_Cal_Cal.ZDrive_BSW_Cal_VehicleInfomationTable.RiSCBlindSpotLength_m "" VALUE 0x3d823c Record_FLOAT32_IEEE 0 autosar_swc_las_CM_single -3.4E+38 3.4E+38 /end CHARACTERISTIC
/begin CHARACTERISTIC ZDrive_BSW_Cal_Cal.ZDrive_BSW_Cal_VehicleInfomationTable.RiSCVerticalDist2Body_m "" VALUE 0x3d8240 Record_FLOAT32_IEEE 0 autosar_swc_las_CM_single -3.4E+38 3.4E+38 /end CHARACTERISTIC
/begin CHARACTERISTIC ZDrive_BSW_Cal_Cal.ZDrive_BSW_Cal_VehicleInfomationTable.RightShortCamera_Dx "" VALUE 0x3d8220 Record_FLOAT32_IEEE 0 autosar_swc_las_CM_single -3.4E+38 3.4E+38 /end CHARACTERISTIC
/begin CHARACTERISTIC ZDrive_BSW_Cal_Cal.ZDrive_BSW_Cal_VehicleInfomationTable.RightShortCamera_Dy "" VALUE 0x3d8224 Record_FLOAT32_IEEE 0 autosar_swc_las_CM_single -3.4E+38 3.4E+38 /end CHARACTERISTIC
/begin CHARACTERISTIC ZDrive_BSW_Cal_Cal.ZDrive_BSW_Cal_VehicleInfomationTable.RightShortCamera_Dz "" VALUE 0x3d8228 Record_FLOAT32_IEEE 0 autosar_swc_las_CM_single -3.4E+38 3.4E+38 /end CHARACTERISTIC
/begin CHARACTERISTIC ZDrive_BSW_Cal_Cal.ZDrive_BSW_Cal_VehicleInfomationTable.RightShortCamera_Pitch "" VALUE 0x3d8234 Record_FLOAT32_IEEE 0 autosar_swc_las_CM_single -3.4E+38 3.4E+38 /end CHARACTERISTIC
/begin CHARACTERISTIC ZDrive_BSW_Cal_Cal.ZDrive_BSW_Cal_VehicleInfomationTable.RightShortCamera_Roll "" VALUE 0x3d8230 Record_FLOAT32_IEEE 0 autosar_swc_las_CM_single -3.4E+38 3.4E+38 /end CHARACTERISTIC
/begin CHARACTERISTIC ZDrive_BSW_Cal_Cal.ZDrive_BSW_Cal_VehicleInfomationTable.RightShortCamera_Yaw "" VALUE 0x3d8238 Record_FLOAT32_IEEE 0 autosar_swc_las_CM_single -3.4E+38 3.4E+38 /end CHARACTERISTIC
/begin CHARACTERISTIC ZDrive_BSW_Cal_Cal.ZDrive_BSW_Cal_VehicleInfomationTable.RollingAngOfCAD "" VALUE 0x3d81a8 Record_FLOAT32_IEEE 0 autosar_swc_las_CM_single -3.4E+38 3.4E+38 /end CHARACTERISTIC
/begin CHARACTERISTIC ZDrive_BSW_Cal_Cal.ZDrive_BSW_Cal_VehicleInfomationTable.SideSlipAnglefactor "" VALUE 0x3d813c Record_FLOAT32_IEEE 0 autosar_swc_las_CM_single -3.4E+38 3.4E+38 /end CHARACTERISTIC
/begin CHARACTERISTIC ZDrive_BSW_Cal_Cal.ZDrive_BSW_Cal_VehicleInfomationTable.SteeringAngleRatio "" VALUE 0x3d8144 Record_FLOAT32_IEEE 0 autosar_swc_las_CM_single -3.4E+38 3.4E+38 /end CHARACTERISTIC
/begin CHARACTERISTIC ZDrive_BSW_Cal_Cal.ZDrive_BSW_Cal_VehicleInfomationTable.StrWhlAngSigDirect "" VALUE 0x3d807a Record_UBYTE 0 autosar_swc_las_CM_uint8 0 255 /end CHARACTERISTIC
/begin CHARACTERISTIC ZDrive_BSW_Cal_Cal.ZDrive_BSW_Cal_VehicleInfomationTable.StrWhlConfig "" VALUE 0x3d8073 Record_UBYTE 0 autosar_swc_las_CM_uint8 0 255 /end CHARACTERISTIC
/begin CHARACTERISTIC ZDrive_BSW_Cal_Cal.ZDrive_BSW_Cal_VehicleInfomationTable.StrWhlMappingTable "" VALUE 0x3d814c Record_FLOAT32_IEEE 0 autosar_swc_las_CM_single -3.4E+38 3.4E+38 /end CHARACTERISTIC
/begin CHARACTERISTIC ZDrive_BSW_Cal_Cal.ZDrive_BSW_Cal_VehicleInfomationTable.Suspension "" VALUE 0x3d8082 Record_UBYTE 0 autosar_swc_las_CM_uint8 0 255 /end CHARACTERISTIC
/begin CHARACTERISTIC ZDrive_BSW_Cal_Cal.ZDrive_BSW_Cal_VehicleInfomationTable.TAC_Bottom "" VALUE 0x3d8180 Record_SBYTE 0 autosar_swc_las_CM_int8 -128 127 /end CHARACTERISTIC
/begin CHARACTERISTIC ZDrive_BSW_Cal_Cal.ZDrive_BSW_Cal_VehicleInfomationTable.TAC_Camera_Height "" VALUE 0x3d815c Record_FLOAT32_IEEE 0 autosar_swc_las_CM_single -3.4E+38 3.4E+38 /end CHARACTERISTIC
/begin CHARACTERISTIC ZDrive_BSW_Cal_Cal.ZDrive_BSW_Cal_VehicleInfomationTable.TAC_Targets_Num "" VALUE 0x3d8190 Record_UBYTE 0 autosar_swc_las_CM_uint8 0 255 /end CHARACTERISTIC
/begin CHARACTERISTIC ZDrive_BSW_Cal_Cal.ZDrive_BSW_Cal_VehicleInfomationTable.TireRadius_m "" VALUE 0x3d811c Record_FLOAT32_IEEE 0 autosar_swc_las_CM_single -3.4E+38 3.4E+38 /end CHARACTERISTIC
/begin CHARACTERISTIC ZDrive_BSW_Cal_Cal.ZDrive_BSW_Cal_VehicleInfomationTable.UltraInstallAng_FA "" VALUE 0x3d8398 Record_FLOAT32_IEEE 0 autosar_swc_las_CM_single -3.4E+38 3.4E+38 /end CHARACTERISTIC
/begin CHARACTERISTIC ZDrive_BSW_Cal_Cal.ZDrive_BSW_Cal_VehicleInfomationTable.UltraInstallAng_FM "" VALUE 0x3d8394 Record_FLOAT32_IEEE 0 autosar_swc_las_CM_single -3.4E+38 3.4E+38 /end CHARACTERISTIC
/begin CHARACTERISTIC ZDrive_BSW_Cal_Cal.ZDrive_BSW_Cal_VehicleInfomationTable.UltraInstallAng_FS "" VALUE 0x3d839c Record_FLOAT32_IEEE 0 autosar_swc_las_CM_single -3.4E+38 3.4E+38 /end CHARACTERISTIC
/begin CHARACTERISTIC ZDrive_BSW_Cal_Cal.ZDrive_BSW_Cal_VehicleInfomationTable.UltraInstallAng_RA "" VALUE 0x3d83b4 Record_FLOAT32_IEEE 0 autosar_swc_las_CM_single -3.4E+38 3.4E+38 /end CHARACTERISTIC
/begin CHARACTERISTIC ZDrive_BSW_Cal_Cal.ZDrive_BSW_Cal_VehicleInfomationTable.UltraInstallAng_RM "" VALUE 0x3d83b0 Record_FLOAT32_IEEE 0 autosar_swc_las_CM_single -3.4E+38 3.4E+38 /end CHARACTERISTIC
/begin CHARACTERISTIC ZDrive_BSW_Cal_Cal.ZDrive_BSW_Cal_VehicleInfomationTable.UltraInstallAng_RS "" VALUE 0x3d83b8 Record_FLOAT32_IEEE 0 autosar_swc_las_CM_single -3.4E+38 3.4E+38 /end CHARACTERISTIC
/begin CHARACTERISTIC ZDrive_BSW_Cal_Cal.ZDrive_BSW_Cal_VehicleInfomationTable.UltraInstallHeight_FA_m "" VALUE 0x3d83cc Record_FLOAT32_IEEE 0 autosar_swc_las_CM_single -3.4E+38 3.4E+38 /end CHARACTERISTIC
/begin CHARACTERISTIC ZDrive_BSW_Cal_Cal.ZDrive_BSW_Cal_VehicleInfomationTable.UltraInstallHeight_FM_m "" VALUE 0x3d83c8 Record_FLOAT32_IEEE 0 autosar_swc_las_CM_single -3.4E+38 3.4E+38 /end CHARACTERISTIC
/begin CHARACTERISTIC ZDrive_BSW_Cal_Cal.ZDrive_BSW_Cal_VehicleInfomationTable.UltraInstallHeight_FS_m "" VALUE 0x3d83d0 Record_FLOAT32_IEEE 0 autosar_swc_las_CM_single -3.4E+38 3.4E+38 /end CHARACTERISTIC
/begin CHARACTERISTIC ZDrive_BSW_Cal_Cal.ZDrive_BSW_Cal_VehicleInfomationTable.UltraInstallHeight_RA_m "" VALUE 0x3d83d8 Record_FLOAT32_IEEE 0 autosar_swc_las_CM_single -3.4E+38 3.4E+38 /end CHARACTERISTIC
/begin CHARACTERISTIC ZDrive_BSW_Cal_Cal.ZDrive_BSW_Cal_VehicleInfomationTable.UltraInstallHeight_RM_m "" VALUE 0x3d83d4 Record_FLOAT32_IEEE 0 autosar_swc_las_CM_single -3.4E+38 3.4E+38 /end CHARACTERISTIC
/begin CHARACTERISTIC ZDrive_BSW_Cal_Cal.ZDrive_BSW_Cal_VehicleInfomationTable.UltraInstallHeight_RS_m "" VALUE 0x3d83dc Record_FLOAT32_IEEE 0 autosar_swc_las_CM_single -3.4E+38 3.4E+38 /end CHARACTERISTIC
/begin CHARACTERISTIC ZDrive_BSW_Cal_Cal.ZDrive_BSW_Cal_VehicleInfomationTable.UltraInstallLatOffset_FA_m "" VALUE 0x3d83a4 Record_FLOAT32_IEEE 0 autosar_swc_las_CM_single -3.4E+38 3.4E+38 /end CHARACTERISTIC
/begin CHARACTERISTIC ZDrive_BSW_Cal_Cal.ZDrive_BSW_Cal_VehicleInfomationTable.UltraInstallLatOffset_FM_m "" VALUE 0x3d83a0 Record_FLOAT32_IEEE 0 autosar_swc_las_CM_single -3.4E+38 3.4E+38 /end CHARACTERISTIC
/begin CHARACTERISTIC ZDrive_BSW_Cal_Cal.ZDrive_BSW_Cal_VehicleInfomationTable.UltraInstallLatOffset_FS_m "" VALUE 0x3d83a8 Record_FLOAT32_IEEE 0 autosar_swc_las_CM_single -3.4E+38 3.4E+38 /end CHARACTERISTIC
/begin CHARACTERISTIC ZDrive_BSW_Cal_Cal.ZDrive_BSW_Cal_VehicleInfomationTable.UltraInstallLatOffset_RA_m "" VALUE 0x3d83c0 Record_FLOAT32_IEEE 0 autosar_swc_las_CM_single -3.4E+38 3.4E+38 /end CHARACTERISTIC
/begin CHARACTERISTIC ZDrive_BSW_Cal_Cal.ZDrive_BSW_Cal_VehicleInfomationTable.UltraInstallLatOffset_RM_m "" VALUE 0x3d83bc Record_FLOAT32_IEEE 0 autosar_swc_las_CM_single -3.4E+38 3.4E+38 /end CHARACTERISTIC
/begin CHARACTERISTIC ZDrive_BSW_Cal_Cal.ZDrive_BSW_Cal_VehicleInfomationTable.UltraInstallLatOffset_RS_m "" VALUE 0x3d83c4 Record_FLOAT32_IEEE 0 autosar_swc_las_CM_single -3.4E+38 3.4E+38 /end CHARACTERISTIC
/begin CHARACTERISTIC ZDrive_BSW_Cal_Cal.ZDrive_BSW_Cal_VehicleInfomationTable.VISION_MOUNT_PARAM_FRONT_X_POSITION "" VALUE 0x3d83e4 Record_FLOAT32_IEEE 0 autosar_swc_las_CM_single -3.4E+38 3.4E+38 /end CHARACTERISTIC
/begin CHARACTERISTIC ZDrive_BSW_Cal_Cal.ZDrive_BSW_Cal_VehicleInfomationTable.VISION_MOUNT_PARAM_FRONT_YAW_ANGLE "" VALUE 0x3d83ec Record_FLOAT32_IEEE 0 autosar_swc_las_CM_single -3.4E+38 3.4E+38 /end CHARACTERISTIC
/begin CHARACTERISTIC ZDrive_BSW_Cal_Cal.ZDrive_BSW_Cal_VehicleInfomationTable.VISION_MOUNT_PARAM_FRONT_Y_POSITION "" VALUE 0x3d83e8 Record_FLOAT32_IEEE 0 autosar_swc_las_CM_single -3.4E+38 3.4E+38 /end CHARACTERISTIC
/begin CHARACTERISTIC ZDrive_BSW_Cal_Cal.ZDrive_BSW_Cal_VehicleInfomationTable.ValFunc_Reserve1 "" VALUE 0x3d807f Record_UBYTE 0 autosar_swc_las_CM_uint8 0 255 /end CHARACTERISTIC
/begin CHARACTERISTIC ZDrive_BSW_Cal_Cal.ZDrive_BSW_Cal_VehicleInfomationTable.ValFunc_Reserve2 "" VALUE 0x3d8080 Record_UBYTE 0 autosar_swc_las_CM_uint8 0 255 /end CHARACTERISTIC
/begin CHARACTERISTIC ZDrive_BSW_Cal_Cal.ZDrive_BSW_Cal_VehicleInfomationTable.VehicleWidthMax_m "" VALUE 0x3d8094 Record_FLOAT32_IEEE 0 autosar_swc_las_CM_single -3.4E+38 3.4E+38 /end CHARACTERISTIC
/begin CHARACTERISTIC ZDrive_BSW_Cal_Cal.ZDrive_BSW_Cal_VehicleInfomationTable.VehicleWidthMin_m "" VALUE 0x3d8098 Record_FLOAT32_IEEE 0 autosar_swc_las_CM_single -3.4E+38 3.4E+38 /end CHARACTERISTIC
/begin CHARACTERISTIC ZDrive_BSW_Cal_Cal.ZDrive_BSW_Cal_VehicleInfomationTable.Vehicle_Information_Reserved_Line102 "" VALUE 0x3d8181 Record_UBYTE 0 autosar_swc_las_CM_uint8 0 255 /end CHARACTERISTIC
/begin CHARACTERISTIC ZDrive_BSW_Cal_Cal.ZDrive_BSW_Cal_VehicleInfomationTable.Vehicle_Information_Reserved_Line105 "" VALUE 0x3d8186 Record_UWORD 0 autosar_swc_las_CM_uint16 0 65535 /end CHARACTERISTIC
/begin CHARACTERISTIC ZDrive_BSW_Cal_Cal.ZDrive_BSW_Cal_VehicleInfomationTable.Vehicle_Information_Reserved_Line109 "" VALUE 0x3d8191 Record_UBYTE 0 autosar_swc_las_CM_uint8 0 255 /end CHARACTERISTIC
/begin CHARACTERISTIC ZDrive_BSW_Cal_Cal.ZDrive_BSW_Cal_VehicleInfomationTable.Vehicle_Information_Reserved_Line110 "" VALUE 0x3d8192 Record_UWORD 0 autosar_swc_las_CM_uint16 0 65535 /end CHARACTERISTIC
/begin CHARACTERISTIC ZDrive_BSW_Cal_Cal.ZDrive_BSW_Cal_VehicleInfomationTable.Vehicle_Information_Reserved_Line115 "" VALUE 0x3d81a4 Record_ULONG 0 autosar_swc_las_CM_uint32 0 4294967295 /end CHARACTERISTIC
/begin CHARACTERISTIC ZDrive_BSW_Cal_Cal.ZDrive_BSW_Cal_VehicleInfomationTable.Vehicle_Information_Reserved_Line122 "" VALUE 0x3d81c0 Record_ULONG 0 autosar_swc_las_CM_uint32 0 4294967295 /end CHARACTERISTIC
/begin CHARACTERISTIC ZDrive_BSW_Cal_Cal.ZDrive_BSW_Cal_VehicleInfomationTable.Vehicle_Information_Reserved_Line131 "" VALUE 0x3d81e4 Record_ULONG 0 autosar_swc_las_CM_uint32 0 4294967295 /end CHARACTERISTIC
/begin CHARACTERISTIC ZDrive_BSW_Cal_Cal.ZDrive_BSW_Cal_VehicleInfomationTable.Vehicle_Information_Reserved_Line140 "" VALUE 0x3d8208 Record_ULONG 0 autosar_swc_las_CM_uint32 0 4294967295 /end CHARACTERISTIC
/begin CHARACTERISTIC ZDrive_BSW_Cal_Cal.ZDrive_BSW_Cal_VehicleInfomationTable.Vehicle_Information_Reserved_Line149 "" VALUE 0x3d822c Record_ULONG 0 autosar_swc_las_CM_uint32 0 4294967295 /end CHARACTERISTIC
/begin CHARACTERISTIC ZDrive_BSW_Cal_Cal.ZDrive_BSW_Cal_VehicleInfomationTable.Vehicle_Information_Reserved_Line158 "" VALUE 0x3d8250 Record_ULONG 0 autosar_swc_las_CM_uint32 0 4294967295 /end CHARACTERISTIC
/begin CHARACTERISTIC ZDrive_BSW_Cal_Cal.ZDrive_BSW_Cal_VehicleInfomationTable.Vehicle_Information_Reserved_Line165 "" VALUE 0x3d826c Record_ULONG 0 autosar_swc_las_CM_uint32 0 4294967295 /end CHARACTERISTIC
/begin CHARACTERISTIC ZDrive_BSW_Cal_Cal.ZDrive_BSW_Cal_VehicleInfomationTable.Vehicle_Information_Reserved_Line172 "" VALUE 0x3d8288 Record_ULONG 0 autosar_swc_las_CM_uint32 0 4294967295 /end CHARACTERISTIC
/begin CHARACTERISTIC ZDrive_BSW_Cal_Cal.ZDrive_BSW_Cal_VehicleInfomationTable.Vehicle_Information_Reserved_Line179 "" VALUE 0x3d82a4 Record_ULONG 0 autosar_swc_las_CM_uint32 0 4294967295 /end CHARACTERISTIC
/begin CHARACTERISTIC ZDrive_BSW_Cal_Cal.ZDrive_BSW_Cal_VehicleInfomationTable.Vehicle_Information_Reserved_Line186 "" VALUE 0x3d82c0 Record_ULONG 0 autosar_swc_las_CM_uint32 0 4294967295 /end CHARACTERISTIC
/begin CHARACTERISTIC ZDrive_BSW_Cal_Cal.ZDrive_BSW_Cal_VehicleInfomationTable.Vehicle_Information_Reserved_Line193 "" VALUE 0x3d82dc Record_ULONG 0 autosar_swc_las_CM_uint32 0 4294967295 /end CHARACTERISTIC
/begin CHARACTERISTIC ZDrive_BSW_Cal_Cal.ZDrive_BSW_Cal_VehicleInfomationTable.Vehicle_Information_Reserved_Line200 "" VALUE 0x3d82f8 Record_ULONG 0 autosar_swc_las_CM_uint32 0 4294967295 /end CHARACTERISTIC
/begin CHARACTERISTIC ZDrive_BSW_Cal_Cal.ZDrive_BSW_Cal_VehicleInfomationTable.Vehicle_Information_Reserved_Line207 "" VALUE 0x3d8314 Record_ULONG 0 autosar_swc_las_CM_uint32 0 4294967295 /end CHARACTERISTIC
/begin CHARACTERISTIC ZDrive_BSW_Cal_Cal.ZDrive_BSW_Cal_VehicleInfomationTable.Vehicle_Information_Reserved_Line214 "" VALUE 0x3d8330 Record_ULONG 0 autosar_swc_las_CM_uint32 0 4294967295 /end CHARACTERISTIC
/begin CHARACTERISTIC ZDrive_BSW_Cal_Cal.ZDrive_BSW_Cal_VehicleInfomationTable.Vehicle_Information_Reserved_Line221 "" VALUE 0x3d834c Record_ULONG 0 autosar_swc_las_CM_uint32 0 4294967295 /end CHARACTERISTIC
/begin CHARACTERISTIC ZDrive_BSW_Cal_Cal.ZDrive_BSW_Cal_VehicleInfomationTable.Vehicle_Information_Reserved_Line228 "" VALUE 0x3d8368 Record_ULONG 0 autosar_swc_las_CM_uint32 0 4294967295 /end CHARACTERISTIC
/begin CHARACTERISTIC ZDrive_BSW_Cal_Cal.ZDrive_BSW_Cal_VehicleInfomationTable.Vehicle_Information_Reserved_Line235 "" VALUE 0x3d8384 Record_ULONG 0 autosar_swc_las_CM_uint32 0 4294967295 /end CHARACTERISTIC
/begin CHARACTERISTIC ZDrive_BSW_Cal_Cal.ZDrive_BSW_Cal_VehicleInfomationTable.Vehicle_Information_Reserved_Line24 "" VALUE 0x0 Record_UBYTE 0 autosar_swc_las_CM_uint8 0 255 /end CHARACTERISTIC
/begin CHARACTERISTIC ZDrive_BSW_Cal_Cal.ZDrive_BSW_Cal_VehicleInfomationTable.Vehicle_Information_Reserved_Line245 "" VALUE 0x3d83ac Record_ULONG 0 autosar_swc_las_CM_uint32 0 4294967295 /end CHARACTERISTIC
/begin CHARACTERISTIC ZDrive_BSW_Cal_Cal.ZDrive_BSW_Cal_VehicleInfomationTable.Vehicle_Information_Reserved_Line25 "" VALUE 0x0 Record_UBYTE 0 autosar_swc_las_CM_uint8 0 255 /end CHARACTERISTIC
/begin CHARACTERISTIC ZDrive_BSW_Cal_Cal.ZDrive_BSW_Cal_VehicleInfomationTable.Vehicle_Information_Reserved_Line258 "" VALUE 0x3d83e0 Record_ULONG 0 autosar_swc_las_CM_uint32 0 4294967295 /end CHARACTERISTIC
/begin CHARACTERISTIC ZDrive_BSW_Cal_Cal.ZDrive_BSW_Cal_VehicleInfomationTable.Vehicle_Information_Reserved_Line26 "" VALUE 0x3d807e Record_UBYTE 0 autosar_swc_las_CM_uint8 0 255 /end CHARACTERISTIC
/begin CHARACTERISTIC ZDrive_BSW_Cal_Cal.ZDrive_BSW_Cal_VehicleInfomationTable.Vehicle_Information_Reserved_Line31 "" VALUE 0x3d8083 Record_UBYTE 0 autosar_swc_las_CM_uint8 0 255 /end CHARACTERISTIC
/begin CHARACTERISTIC ZDrive_BSW_Cal_Cal.ZDrive_BSW_Cal_VehicleInfomationTable.Vehicle_Information_Reserved_Line32 "" VALUE 0x3d8084 Record_UWORD 0 autosar_swc_las_CM_uint16 0 65535 /end CHARACTERISTIC
/begin CHARACTERISTIC ZDrive_BSW_Cal_Cal.ZDrive_BSW_Cal_VehicleInfomationTable.Vehicle_Information_Reserved_Line33 "" VALUE 0x3d8086 Record_UWORD 0 autosar_swc_las_CM_uint16 0 65535 /end CHARACTERISTIC
/begin CHARACTERISTIC ZDrive_BSW_Cal_Cal.ZDrive_BSW_Cal_VehicleInfomationTable.Vehicle_Information_Reserved_Line34 "" VALUE 0x3d8088 Record_UWORD 0 autosar_swc_las_CM_uint16 0 65535 /end CHARACTERISTIC
/begin CHARACTERISTIC ZDrive_BSW_Cal_Cal.ZDrive_BSW_Cal_VehicleInfomationTable.Vehicle_Information_Reserved_Line35 "" VALUE 0x3d808a Record_UWORD 0 autosar_swc_las_CM_uint16 0 65535 /end CHARACTERISTIC
/begin CHARACTERISTIC ZDrive_BSW_Cal_Cal.ZDrive_BSW_Cal_VehicleInfomationTable.Vehicle_Information_Reserved_Line36 "" VALUE 0x3d808c Record_UWORD 0 autosar_swc_las_CM_uint16 0 65535 /end CHARACTERISTIC
/begin CHARACTERISTIC ZDrive_BSW_Cal_Cal.ZDrive_BSW_Cal_VehicleInfomationTable.Vehicle_Information_Reserved_Line37 "" VALUE 0x3d808e Record_UWORD 0 autosar_swc_las_CM_uint16 0 65535 /end CHARACTERISTIC
/begin CHARACTERISTIC ZDrive_BSW_Cal_Cal.ZDrive_BSW_Cal_VehicleInfomationTable.Vehicle_Information_Reserved_Line81 "" VALUE 0x3d8134 Record_UWORD 0 autosar_swc_las_CM_uint16 0 65535 /end CHARACTERISTIC
/begin CHARACTERISTIC ZDrive_BSW_Cal_Cal.ZDrive_BSW_Cal_VehicleInfomationTable.Vehicle_Information_Reserved_Line82 "" VALUE 0x3d8136 Record_UWORD 0 autosar_swc_las_CM_uint16 0 65535 /end CHARACTERISTIC
/begin CHARACTERISTIC ZDrive_BSW_Cal_Cal.ZDrive_BSW_Cal_VehicleInfomationTable.Vehicle_Length_m "" VALUE 0x3d8090 Record_FLOAT32_IEEE 0 autosar_swc_las_CM_single -3.4E+38 3.4E+38 /end CHARACTERISTIC
/begin CHARACTERISTIC ZDrive_BSW_Cal_Cal.ZDrive_BSW_Cal_VehicleInfomationTable.Weight_N "" VALUE 0x3d8110 Record_FLOAT32_IEEE 0 autosar_swc_las_CM_single -3.4E+38 3.4E+38 /end CHARACTERISTIC
/begin CHARACTERISTIC ZDrive_BSW_Cal_Cal.ZDrive_BSW_Cal_VehicleInfomationTable.WheelBase_m "" VALUE 0x3d80a4 Record_FLOAT32_IEEE 0 autosar_swc_las_CM_single -3.4E+38 3.4E+38 /end CHARACTERISTIC
/begin CHARACTERISTIC ZDrive_BSW_Cal_Cal.ZDrive_BSW_Cal_VehicleInfomationTable.WheelDiameter "" VALUE 0x3d8124 Record_FLOAT32_IEEE 0 autosar_swc_las_CM_single -3.4E+38 3.4E+38 /end CHARACTERISTIC
/begin CHARACTERISTIC ZDrive_BSW_Cal_Cal.ZDrive_BSW_Cal_VehicleInfomationTable.WheelSpeedCounterIsUnsigned "" VALUE 0x3d8130 Record_UWORD 0 autosar_swc_las_CM_uint16 0 65535 /end CHARACTERISTIC
/begin CHARACTERISTIC ZDrive_BSW_Cal_Cal.ZDrive_BSW_Cal_VehicleInfomationTable.WheelSpeedCounterMax "" VALUE 0x3d812c Record_UWORD 0 autosar_swc_las_CM_uint16 0 65535 /end CHARACTERISTIC
/begin CHARACTERISTIC ZDrive_BSW_Cal_Cal.ZDrive_BSW_Cal_VehicleInfomationTable.WheelSpeedCounterMin "" VALUE 0x3d8132 Record_UWORD 0 autosar_swc_las_CM_uint16 0 65535 /end CHARACTERISTIC
/begin CHARACTERISTIC ZDrive_BSW_Cal_Cal.ZDrive_BSW_Cal_VehicleInfomationTable.WheelSpeedCounterPulse "" VALUE 0x3d812e Record_UWORD 0 autosar_swc_las_CM_uint16 0 65535 /end CHARACTERISTIC
/begin CHARACTERISTIC ZDrive_BSW_Cal_Cal.ZDrive_BSW_Cal_VehicleInfomationTable.WheelTrack_m "" VALUE 0x3d80ac Record_FLOAT32_IEEE 0 autosar_swc_las_CM_single -3.4E+38 3.4E+38 /end CHARACTERISTIC
/begin CHARACTERISTIC ZDrive_BSW_Cal_Cal.ZDrive_BSW_Cal_VehicleInfomationTable.WhlSpdSensUnitPulseDist "" VALUE 0x3d8128 Record_FLOAT32_IEEE 0 autosar_swc_las_CM_single -3.4E+38 3.4E+38 /end CHARACTERISTIC
/begin CHARACTERISTIC ZDrive_BSW_Cal_Cal.ZDrive_BSW_Cal_VehicleInfomationTable.YawAngOfCAD "" VALUE 0x3d81b0 Record_FLOAT32_IEEE 0 autosar_swc_las_CM_single -3.4E+38 3.4E+38 /end CHARACTERISTIC
/begin CHARACTERISTIC ZDrive_BSW_Cal_Cal.ZDrive_BSW_Cal_VehicleInfomationTable.camera_x_m "" VALUE 0x3d8194 Record_FLOAT32_IEEE 0 autosar_swc_las_CM_single -3.4E+38 3.4E+38 /end CHARACTERISTIC
/begin CHARACTERISTIC ZDrive_BSW_Cal_Cal.ZDrive_BSW_Cal_VehicleInfomationTable.camera_y_m "" VALUE 0x3d8198 Record_FLOAT32_IEEE 0 autosar_swc_las_CM_single -3.4E+38 3.4E+38 /end CHARACTERISTIC
/begin CHARACTERISTIC ZDrive_BSW_Cal_Cal.ZDrive_BSW_Cal_VehicleInfomationTable.camera_z_m "" VALUE 0x3d819c Record_FLOAT32_IEEE 0 autosar_swc_las_CM_single -3.4E+38 3.4E+38 /end CHARACTERISTIC
/begin CHARACTERISTIC ZDrive_BSW_Cal_Cal.ZDrive_BSW_Cal_VehicleInfomationTable.translation_x_m "" VALUE 0x3d81a0 Record_FLOAT32_IEEE 0 autosar_swc_las_CM_single -3.4E+38 3.4E+38 /end CHARACTERISTIC
/begin COMPU_METHOD autosar_swc_las_CM_int16 "Q = V" IDENTICAL "%5.0" "" /end COMPU_METHOD
/begin COMPU_METHOD autosar_swc_las_CM_int8 "Q = V" IDENTICAL "%3.0" "" /end COMPU_METHOD
/begin COMPU_METHOD autosar_swc_las_CM_single "Q = V" IDENTICAL "%8.6" "" /end COMPU_METHOD
/begin COMPU_METHOD autosar_swc_las_CM_uint16 "Q = V" IDENTICAL "%5.0" "" /end COMPU_METHOD
/begin COMPU_METHOD autosar_swc_las_CM_uint32 "Q = V" IDENTICAL "%10.0" "" /end COMPU_METHOD
/begin COMPU_METHOD autosar_swc_las_CM_uint8 "Q = V" IDENTICAL "%3.0" "" /end COMPU_METHOD
/begin RECORD_LAYOUT Record_FLOAT32_IEEE FNC_VALUES 1 FLOAT32_IEEE COLUMN_DIR DIRECT /end RECORD_LAYOUT
/begin RECORD_LAYOUT Record_SBYTE FNC_VALUES 1 SBYTE COLUMN_DIR DIRECT /end RECORD_LAYOUT
/begin RECORD_LAYOUT Record_SWORD FNC_VALUES 1 SWORD COLUMN_DIR DIRECT /end RECORD_LAYOUT
/begin RECORD_LAYOUT Record_UBYTE FNC_VALUES 1 UBYTE COLUMN_DIR DIRECT /end RECORD_LAYOUT
/begin RECORD_LAYOUT Record_ULONG FNC_VALUES 1 ULONG COLUMN_DIR DIRECT /end RECORD_LAYOUT
/begin RECORD_LAYOUT Record_UWORD FNC_VALUES 1 UWORD COLUMN_DIR DIRECT /end RECORD_LAYOUT
/begin GROUP ZDrive_BSW_Cal_Cal.ZDrive_BSW_Cal_VehicleInfomationTable ""
 /begin REF_CHARACTERISTIC ZDrive_BSW_Cal_Cal.ZDrive_BSW_Cal_VehicleInfomationTable.ParkingBrakeType ZDrive_BSW_Cal_Cal.ZDrive_BSW_Cal_VehicleInfomationTable.StrWhlConfig ZDrive_BSW_Cal_Cal.ZDrive_BSW_Cal_VehicleInfomationTable.ParkingLongControlInterForm ZDrive_BSW_Cal_Cal.ZDrive_BSW_Cal_VehicleInfomationTable.Driving_Type ZDrive_BSW_Cal_Cal.ZDrive_BSW_Cal_VehicleInfomationTable.Left_Right_handType ZDrive_BSW_Cal_Cal.ZDrive_BSW_Cal_VehicleInfomationTable.AutoHold_Type ZDrive_BSW_Cal_Cal.ZDrive_BSW_Cal_VehicleInfomationTable.AccSens_LatAccSigDirect ZDrive_BSW_Cal_Cal.ZDrive_BSW_Cal_VehicleInfomationTable.AccSens_LonAccSigDirect ZDrive_BSW_Cal_Cal.ZDrive_BSW_Cal_VehicleInfomationTable.StrWhlAngSigDirect ZDrive_BSW_Cal_Cal.ZDrive_BSW_Cal_VehicleInfomationTable.DriHandTorqueDirect ZDrive_BSW_Cal_Cal.ZDrive_BSW_Cal_VehicleInfomationTable.Vehicle_Information_Reserved_Line24 ZDrive_BSW_Cal_Cal.ZDrive_BSW_Cal_VehicleInfomationTable.Vehicle_Information_Reserved_Line25 ZDrive_BSW_Cal_Cal.ZDrive_BSW_Cal_VehicleInfomationTable.Vehicle_Information_Reserved_Line26 ZDrive_BSW_Cal_Cal.ZDrive_BSW_Cal_VehicleInfomationTable.ValFunc_Reserve1 ZDrive_BSW_Cal_Cal.ZDrive_BSW_Cal_VehicleInfomationTable.ValFunc_Reserve2 ZDrive_BSW_Cal_Cal.ZDrive_BSW_Cal_VehicleInfomationTable.ASU_Type ZDrive_BSW_Cal_Cal.ZDrive_BSW_Cal_VehicleInfomationTable.Suspension ZDrive_BSW_Cal_Cal.ZDrive_BSW_Cal_VehicleInfomationTable.Vehicle_Information_Reserved_Line31 ZDrive_BSW_Cal_Cal.ZDrive_BSW_Cal_VehicleInfomationTable.Vehicle_Information_Reserved_Line32 ZDrive_BSW_Cal_Cal.ZDrive_BSW_Cal_VehicleInfomationTable.Vehicle_Information_Reserved_Line33 ZDrive_BSW_Cal_Cal.ZDrive_BSW_Cal_VehicleInfomationTable.Vehicle_Information_Reserved_Line34 ZDrive_BSW_Cal_Cal.ZDrive_BSW_Cal_VehicleInfomationTable.Vehicle_Information_Reserved_Line35 ZDrive_BSW_Cal_Cal.ZDrive_BSW_Cal_VehicleInfomationTable.Vehicle_Information_Reserved_Line36 ZDrive_BSW_Cal_Cal.ZDrive_BSW_Cal_VehicleInfomationTable.Vehicle_Information_Reserved_Line37 ZDrive_BSW_Cal_Cal.ZDrive_BSW_Cal_VehicleInfomationTable.Vehicle_Length_m ZDrive_BSW_Cal_Cal.ZDrive_BSW_Cal_VehicleInfomationTable.VehicleWidthMax_m ZDrive_BSW_Cal_Cal.ZDrive_BSW_Cal_VehicleInfomationTable.VehicleWidthMin_m ZDrive_BSW_Cal_Cal.ZDrive_BSW_Cal_VehicleInfomationTable.Height_m ZDrive_BSW_Cal_Cal.ZDrive_BSW_Cal_VehicleInfomationTable.EngineMaxiTorque_N ZDrive_BSW_Cal_Cal.ZDrive_BSW_Cal_VehicleInfomationTable.WheelBase_m ZDrive_BSW_Cal_Cal.ZDrive_BSW_Cal_VehicleInfomationTable.FrontAxleToRearAxLeCenterX_m ZDrive_BSW_Cal_Cal.ZDrive_BSW_Cal_VehicleInfomationTable.WheelTrack_m ZDrive_BSW_Cal_Cal.ZDrive_BSW_Cal_VehicleInfomationTable.FrWhlTrack_m ZDrive_BSW_Cal_Cal.ZDrive_BSW_Cal_VehicleInfomationTable.ReWhlTrack_m ZDrive_BSW_Cal_Cal.ZDrive_BSW_Cal_VehicleInfomationTable.FrontOverhang_Length_m ZDrive_BSW_Cal_Cal.ZDrive_BSW_Cal_VehicleInfomationTable.RearOverhang_Length_m ZDrive_BSW_Cal_Cal.ZDrive_BSW_Cal_VehicleInfomationTable.FrWhlHousingHeight_m ZDrive_BSW_Cal_Cal.ZDrive_BSW_Cal_VehicleInfomationTable.ReWhlHousingHeight_m ZDrive_BSW_Cal_Cal.ZDrive_BSW_Cal_VehicleInfomationTable.DxvRearBumper_m ZDrive_BSW_Cal_Cal.ZDrive_BSW_Cal_VehicleInfomationTable.DxvFrontBumper_m ZDrive_BSW_Cal_Cal.ZDrive_BSW_Cal_VehicleInfomationTable.FrontAxleToCenter_m ZDrive_BSW_Cal_Cal.ZDrive_BSW_Cal_VehicleInfomationTable.RearAxleToCenter_m ZDrive_BSW_Cal_Cal.ZDrive_BSW_Cal_VehicleInfomationTable.RearViewMirrorLength_On_Y ZDrive_BSW_Cal_Cal.ZDrive_BSW_Cal_VehicleInfomationTable.RearViewMirrorLength_On_X ZDrive_BSW_Cal_Cal.ZDrive_BSW_Cal_VehicleInfomationTable.RearViewMirrorTopSide_Height ZDrive_BSW_Cal_Cal.ZDrive_BSW_Cal_VehicleInfomationTable.RearViewMirrorBottomSide_Height ZDrive_BSW_Cal_Cal.ZDrive_BSW_Cal_VehicleInfomationTable.RearViewMirrorOutsidePointToRearAxle_Diatance_m ZDrive_BSW_Cal_Cal.ZDrive_BSW_Cal_VehicleInfomationTable.FrontLeftFrontPointToRearAxleCenter_Distance_m ZDrive_BSW_Cal_Cal.ZDrive_BSW_Cal_VehicleInfomationTable.FrontLeftFrontPointToCenterLine_Distance_m ZDrive_BSW_Cal_Cal.ZDrive_BSW_Cal_VehicleInfomationTable.FrontLeftOutsidePointToRearAxleCenter_Distance_m ZDrive_BSW_Cal_Cal.ZDrive_BSW_Cal_VehicleInfomationTable.FrontLeftOutsidePointToCenterLine_Distance_m ZDrive_BSW_Cal_Cal.ZDrive_BSW_Cal_VehicleInfomationTable.RearLeftOutsidePointToRearAxleCenter_Distance_m ZDrive_BSW_Cal_Cal.ZDrive_BSW_Cal_VehicleInfomationTable.RearLeftOutsidePointToCenterLine_Distance_m ZDrive_BSW_Cal_Cal.ZDrive_BSW_Cal_VehicleInfomationTable.RearLeftRearPointToRearAxleCenter_Distance_m ZDrive_BSW_Cal_Cal.ZDrive_BSW_Cal_VehicleInfomationTable.RearLeftRearPointToCenterLine_Distance_m ZDrive_BSW_Cal_Cal.ZDrive_BSW_Cal_VehicleInfomationTable.CURB_kg ZDrive_BSW_Cal_Cal.ZDrive_BSW_Cal_VehicleInfomationTable.Weight_N ZDrive_BSW_Cal_Cal.ZDrive_BSW_Cal_VehicleInfomationTable.GVW_kg ZDrive_BSW_Cal_Cal.ZDrive_BSW_Cal_VehicleInfomationTable.Empty_mass_kg ZDrive_BSW_Cal_Cal.ZDrive_BSW_Cal_VehicleInfomationTable.TireRadius_m ZDrive_BSW_Cal_Cal.ZDrive_BSW_Cal_VehicleInfomationTable.IEnvironment_WheelWidth ZDrive_BSW_Cal_Cal.ZDrive_BSW_Cal_VehicleInfomationTable.WheelDiameter ZDrive_BSW_Cal_Cal.ZDrive_BSW_Cal_VehicleInfomationTable.WhlSpdSensUnitPulseDist ZDrive_BSW_Cal_Cal.ZDrive_BSW_Cal_VehicleInfomationTable.WheelSpeedCounterMax ZDrive_BSW_Cal_Cal.ZDrive_BSW_Cal_VehicleInfomationTable.WheelSpeedCounterPulse ZDrive_BSW_Cal_Cal.ZDrive_BSW_Cal_VehicleInfomationTable.WheelSpeedCounterIsUnsigned ZDrive_BSW_Cal_Cal.ZDrive_BSW_Cal_VehicleInfomationTable.WheelSpeedCounterMin ZDrive_BSW_Cal_Cal.ZDrive_BSW_Cal_VehicleInfomationTable.Vehicle_Information_Reserved_Line81 ZDrive_BSW_Cal_Cal.ZDrive_BSW_Cal_VehicleInfomationTable.Vehicle_Information_Reserved_Line82 ZDrive_BSW_Cal_Cal.ZDrive_BSW_Cal_VehicleInfomationTable.CharSpd_mps ZDrive_BSW_Cal_Cal.ZDrive_BSW_Cal_VehicleInfomationTable.SideSlipAnglefactor ZDrive_BSW_Cal_Cal.ZDrive_BSW_Cal_VehicleInfomationTable.MaxSteeringAngle ZDrive_BSW_Cal_Cal.ZDrive_BSW_Cal_VehicleInfomationTable.SteeringAngleRatio ZDrive_BSW_Cal_Cal.ZDrive_BSW_Cal_VehicleInfomationTable.RearAxlecCenterTurningCircle ZDrive_BSW_Cal_Cal.ZDrive_BSW_Cal_VehicleInfomationTable.StrWhlMappingTable ZDrive_BSW_Cal_Cal.ZDrive_BSW_Cal_VehicleInfomationTable.FRollingRadius_m ZDrive_BSW_Cal_Cal.ZDrive_BSW_Cal_VehicleInfomationTable.RRollingRadius_m ZDrive_BSW_Cal_Cal.ZDrive_BSW_Cal_VehicleInfomationTable.PowerTransRatio ZDrive_BSW_Cal_Cal.ZDrive_BSW_Cal_VehicleInfomationTable.TAC_Camera_Height ZDrive_BSW_Cal_Cal.ZDrive_BSW_Cal_VehicleInfomationTable.IEnvironment_CamToFrontAxle ZDrive_BSW_Cal_Cal.ZDrive_BSW_Cal_VehicleInfomationTable.FCFocus2FrAxleDist_Y_m ZDrive_BSW_Cal_Cal.ZDrive_BSW_Cal_VehicleInfomationTable.FCFocus2FrAxleDist_Z_m ZDrive_BSW_Cal_Cal.ZDrive_BSW_Cal_VehicleInfomationTable.FC2RearAxisX_m ZDrive_BSW_Cal_Cal.ZDrive_BSW_Cal_VehicleInfomationTable.FC2RearAxisY_m ZDrive_BSW_Cal_Cal.ZDrive_BSW_Cal_VehicleInfomationTable.CamDistToRearAxleCenter_DZ ZDrive_BSW_Cal_Cal.ZDrive_BSW_Cal_VehicleInfomationTable.FCFirstViewPointDist_m ZDrive_BSW_Cal_Cal.ZDrive_BSW_Cal_VehicleInfomationTable.IEnvironment_RefPX_Front_Bumper ZDrive_BSW_Cal_Cal.ZDrive_BSW_Cal_VehicleInfomationTable.TAC_Bottom ZDrive_BSW_Cal_Cal.ZDrive_BSW_Cal_VehicleInfomationTable.Vehicle_Information_Reserved_Line102 ZDrive_BSW_Cal_Cal.ZDrive_BSW_Cal_VehicleInfomationTable.IEnviroment_Top_Crop ZDrive_BSW_Cal_Cal.ZDrive_BSW_Cal_VehicleInfomationTable.IEnviroment_Bottom_Crop ZDrive_BSW_Cal_Cal.ZDrive_BSW_Cal_VehicleInfomationTable.Vehicle_Information_Reserved_Line105 ZDrive_BSW_Cal_Cal.ZDrive_BSW_Cal_VehicleInfomationTable.FC2LeftWheel_m ZDrive_BSW_Cal_Cal.ZDrive_BSW_Cal_VehicleInfomationTable.FC2RightWheel_m ZDrive_BSW_Cal_Cal.ZDrive_BSW_Cal_VehicleInfomationTable.TAC_Targets_Num ZDrive_BSW_Cal_Cal.ZDrive_BSW_Cal_VehicleInfomationTable.Vehicle_Information_Reserved_Line109 ZDrive_BSW_Cal_Cal.ZDrive_BSW_Cal_VehicleInfomationTable.Vehicle_Information_Reserved_Line110 ZDrive_BSW_Cal_Cal.ZDrive_BSW_Cal_VehicleInfomationTable.camera_x_m ZDrive_BSW_Cal_Cal.ZDrive_BSW_Cal_VehicleInfomationTable.camera_y_m ZDrive_BSW_Cal_Cal.ZDrive_BSW_Cal_VehicleInfomationTable.camera_z_m ZDrive_BSW_Cal_Cal.ZDrive_BSW_Cal_VehicleInfomationTable.translation_x_m ZDrive_BSW_Cal_Cal.ZDrive_BSW_Cal_VehicleInfomationTable.Vehicle_Information_Reserved_Line115 ZDrive_BSW_Cal_Cal.ZDrive_BSW_Cal_VehicleInfomationTable.RollingAngOfCAD ZDrive_BSW_Cal_Cal.ZDrive_BSW_Cal_VehicleInfomationTable.PitchAngOfCAD ZDrive_BSW_Cal_Cal.ZDrive_BSW_Cal_VehicleInfomationTable.YawAngOfCAD ZDrive_BSW_Cal_Cal.ZDrive_BSW_Cal_VehicleInfomationTable.FrontShortCamera_Dx ZDrive_BSW_Cal_Cal.ZDrive_BSW_Cal_VehicleInfomationTable.FrontShortCamera_Dy ZDrive_BSW_Cal_Cal.ZDrive_BSW_Cal_VehicleInfomationTable.FrontShortCamera_Dz ZDrive_BSW_Cal_Cal.ZDrive_BSW_Cal_VehicleInfomationTable.Vehicle_Information_Reserved_Line122 ZDrive_BSW_Cal_Cal.ZDrive_BSW_Cal_VehicleInfomationTable.FrontShortCamera_Roll ZDrive_BSW_Cal_Cal.ZDrive_BSW_Cal_VehicleInfomationTable.FrontShortCamera_Pitch ZDrive_BSW_Cal_Cal.ZDrive_BSW_Cal_VehicleInfomationTable.FrontShortCamera_Yaw ZDrive_BSW_Cal_Cal.ZDrive_BSW_Cal_VehicleInfomationTable.FrSCBlindSpotLength_m ZDrive_BSW_Cal_Cal.ZDrive_BSW_Cal_VehicleInfomationTable.FrSCDist2OuterMostSide_m ZDrive_BSW_Cal_Cal.ZDrive_BSW_Cal_VehicleInfomationTable.LeftShortCamera_Dx ZDrive_BSW_Cal_Cal.ZDrive_BSW_Cal_VehicleInfomationTable.LeftShortCamera_Dy ZDrive_BSW_Cal_Cal.ZDrive_BSW_Cal_VehicleInfomationTable.LeftShortCamera_Dz ZDrive_BSW_Cal_Cal.ZDrive_BSW_Cal_VehicleInfomationTable.Vehicle_Information_Reserved_Line131 ZDrive_BSW_Cal_Cal.ZDrive_BSW_Cal_VehicleInfomationTable.LeftShortCamera_Roll ZDrive_BSW_Cal_Cal.ZDrive_BSW_Cal_VehicleInfomationTable.LeftShortCamera_Pitch ZDrive_BSW_Cal_Cal.ZDrive_BSW_Cal_VehicleInfomationTable.LeftShortCamera_Yaw ZDrive_BSW_Cal_Cal.ZDrive_BSW_Cal_VehicleInfomationTable.LeSCBlindSpotLength_m ZDrive_BSW_Cal_Cal.ZDrive_BSW_Cal_VehicleInfomationTable.LeSCVerticalDist2Body_m ZDrive_BSW_Cal_Cal.ZDrive_BSW_Cal_VehicleInfomationTable.RearShortCamera_Dx ZDrive_BSW_Cal_Cal.ZDrive_BSW_Cal_VehicleInfomationTable.RearShortCamera_Dy ZDrive_BSW_Cal_Cal.ZDrive_BSW_Cal_VehicleInfomationTable.RearShortCamera_Dz ZDrive_BSW_Cal_Cal.ZDrive_BSW_Cal_VehicleInfomationTable.Vehicle_Information_Reserved_Line140 ZDrive_BSW_Cal_Cal.ZDrive_BSW_Cal_VehicleInfomationTable.RearShortCamera_Roll ZDrive_BSW_Cal_Cal.ZDrive_BSW_Cal_VehicleInfomationTable.RearShortCamera_Pitch ZDrive_BSW_Cal_Cal.ZDrive_BSW_Cal_VehicleInfomationTable.RearShortCamera_Yaw ZDrive_BSW_Cal_Cal.ZDrive_BSW_Cal_VehicleInfomationTable.ReSCBlindSpotLength_m ZDrive_BSW_Cal_Cal.ZDrive_BSW_Cal_VehicleInfomationTable.ReSCDist2OuterMostSide_m ZDrive_BSW_Cal_Cal.ZDrive_BSW_Cal_VehicleInfomationTable.RightShortCamera_Dx ZDrive_BSW_Cal_Cal.ZDrive_BSW_Cal_VehicleInfomationTable.RightShortCamera_Dy ZDrive_BSW_Cal_Cal.ZDrive_BSW_Cal_VehicleInfomationTable.RightShortCamera_Dz ZDrive_BSW_Cal_Cal.ZDrive_BSW_Cal_VehicleInfomationTable.Vehicle_Information_Reserved_Line149 ZDrive_BSW_Cal_Cal.ZDrive_BSW_Cal_VehicleInfomationTable.RightShortCamera_Roll ZDrive_BSW_Cal_Cal.ZDrive_BSW_Cal_VehicleInfomationTable.RightShortCamera_Pitch ZDrive_BSW_Cal_Cal.ZDrive_BSW_Cal_VehicleInfomationTable.RightShortCamera_Yaw ZDrive_BSW_Cal_Cal.ZDrive_BSW_Cal_VehicleInfomationTable.RiSCBlindSpotLength_m ZDrive_BSW_Cal_Cal.ZDrive_BSW_Cal_VehicleInfomationTable.RiSCVerticalDist2Body_m ZDrive_BSW_Cal_Cal.ZDrive_BSW_Cal_VehicleInfomationTable.FrntLeSideUss_Dx ZDrive_BSW_Cal_Cal.ZDrive_BSW_Cal_VehicleInfomationTable.FrntLeSideUss_Dy ZDrive_BSW_Cal_Cal.ZDrive_BSW_Cal_VehicleInfomationTable.FrntLeSideUss_Dz ZDrive_BSW_Cal_Cal.ZDrive_BSW_Cal_VehicleInfomationTable.Vehicle_Information_Reserved_Line158 ZDrive_BSW_Cal_Cal.ZDrive_BSW_Cal_VehicleInfomationTable.FrntLeSideUss_Roll ZDrive_BSW_Cal_Cal.ZDrive_BSW_Cal_VehicleInfomationTable.FrntLeSideUss_Pitch ZDrive_BSW_Cal_Cal.ZDrive_BSW_Cal_VehicleInfomationTable.FrntLeSideUss_Yaw ZDrive_BSW_Cal_Cal.ZDrive_BSW_Cal_VehicleInfomationTable.FrntLeCrnrUss_Dx ZDrive_BSW_Cal_Cal.ZDrive_BSW_Cal_VehicleInfomationTable.FrntLeCrnrUss_Dy ZDrive_BSW_Cal_Cal.ZDrive_BSW_Cal_VehicleInfomationTable.FrntLeCrnrUss_Dz ZDrive_BSW_Cal_Cal.ZDrive_BSW_Cal_VehicleInfomationTable.Vehicle_Information_Reserved_Line165 ZDrive_BSW_Cal_Cal.ZDrive_BSW_Cal_VehicleInfomationTable.FrntLeCrnrUss_Roll ZDrive_BSW_Cal_Cal.ZDrive_BSW_Cal_VehicleInfomationTable.FrntLeCrnrUss_Pitch ZDrive_BSW_Cal_Cal.ZDrive_BSW_Cal_VehicleInfomationTable.FrntLeCrnrUss_Yaw ZDrive_BSW_Cal_Cal.ZDrive_BSW_Cal_VehicleInfomationTable.FrntLeMidUss_Dx ZDrive_BSW_Cal_Cal.ZDrive_BSW_Cal_VehicleInfomationTable.FrntLeMidUss_Dy ZDrive_BSW_Cal_Cal.ZDrive_BSW_Cal_VehicleInfomationTable.FrntLeMidUss_Dz ZDrive_BSW_Cal_Cal.ZDrive_BSW_Cal_VehicleInfomationTable.Vehicle_Information_Reserved_Line172 ZDrive_BSW_Cal_Cal.ZDrive_BSW_Cal_VehicleInfomationTable.FrntLeMidUss_Roll ZDrive_BSW_Cal_Cal.ZDrive_BSW_Cal_VehicleInfomationTable.FrntLeMidUss_Pitch ZDrive_BSW_Cal_Cal.ZDrive_BSW_Cal_VehicleInfomationTable.FrntLeMidUss_Yaw ZDrive_BSW_Cal_Cal.ZDrive_BSW_Cal_VehicleInfomationTable.FrntRiMidUss_Dx ZDrive_BSW_Cal_Cal.ZDrive_BSW_Cal_VehicleInfomationTable.FrntRiMidUss_Dy ZDrive_BSW_Cal_Cal.ZDrive_BSW_Cal_VehicleInfomationTable.FrntRiMidUss_Dz ZDrive_BSW_Cal_Cal.ZDrive_BSW_Cal_VehicleInfomationTable.Vehicle_Information_Reserved_Line179 ZDrive_BSW_Cal_Cal.ZDrive_BSW_Cal_VehicleInfomationTable.FrntRiMidUss_Roll ZDrive_BSW_Cal_Cal.ZDrive_BSW_Cal_VehicleInfomationTable.FrntRiMidUss_Pitch ZDrive_BSW_Cal_Cal.ZDrive_BSW_Cal_VehicleInfomationTable.FrntRiMidUss_Yaw ZDrive_BSW_Cal_Cal.ZDrive_BSW_Cal_VehicleInfomationTable.FrntRiCrnrUss_Dx ZDrive_BSW_Cal_Cal.ZDrive_BSW_Cal_VehicleInfomationTable.FrntRiCrnrUss_Dy ZDrive_BSW_Cal_Cal.ZDrive_BSW_Cal_VehicleInfomationTable.FrntRiCrnrUss_Dz ZDrive_BSW_Cal_Cal.ZDrive_BSW_Cal_VehicleInfomationTable.Vehicle_Information_Reserved_Line186 ZDrive_BSW_Cal_Cal.ZDrive_BSW_Cal_VehicleInfomationTable.FrntRiCrnrUss_Roll ZDrive_BSW_Cal_Cal.ZDrive_BSW_Cal_VehicleInfomationTable.FrntRiCrnrUss_Pitch ZDrive_BSW_Cal_Cal.ZDrive_BSW_Cal_VehicleInfomationTable.FrntRiCrnrUss_Yaw ZDrive_BSW_Cal_Cal.ZDrive_BSW_Cal_VehicleInfomationTable.FrntRiSideUss_Dx ZDrive_BSW_Cal_Cal.ZDrive_BSW_Cal_VehicleInfomationTable.FrntRiSideUss_Dy ZDrive_BSW_Cal_Cal.ZDrive_BSW_Cal_VehicleInfomationTable.FrntRiSideUss_Dz ZDrive_BSW_Cal_Cal.ZDrive_BSW_Cal_VehicleInfomationTable.Vehicle_Information_Reserved_Line193 ZDrive_BSW_Cal_Cal.ZDrive_BSW_Cal_VehicleInfomationTable.FrntRiSideUss_Roll ZDrive_BSW_Cal_Cal.ZDrive_BSW_Cal_VehicleInfomationTable.FrntRiSideUss_Pitch ZDrive_BSW_Cal_Cal.ZDrive_BSW_Cal_VehicleInfomationTable.FrntRiSideUss_Yaw ZDrive_BSW_Cal_Cal.ZDrive_BSW_Cal_VehicleInfomationTable.ReRiSideUss_Dx ZDrive_BSW_Cal_Cal.ZDrive_BSW_Cal_VehicleInfomationTable.ReRiSideUss_Dy ZDrive_BSW_Cal_Cal.ZDrive_BSW_Cal_VehicleInfomationTable.ReRiSideUss_Dz ZDrive_BSW_Cal_Cal.ZDrive_BSW_Cal_VehicleInfomationTable.Vehicle_Information_Reserved_Line200 ZDrive_BSW_Cal_Cal.ZDrive_BSW_Cal_VehicleInfomationTable.ReRiSideUss_Roll ZDrive_BSW_Cal_Cal.ZDrive_BSW_Cal_VehicleInfomationTable.ReRiSideUss_Pitch ZDrive_BSW_Cal_Cal.ZDrive_BSW_Cal_VehicleInfomationTable.ReRiSideUss_Yaw ZDrive_BSW_Cal_Cal.ZDrive_BSW_Cal_VehicleInfomationTable.ReRiCrnrUss_Dx ZDrive_BSW_Cal_Cal.ZDrive_BSW_Cal_VehicleInfomationTable.ReRiCrnrUss_Dy ZDrive_BSW_Cal_Cal.ZDrive_BSW_Cal_VehicleInfomationTable.ReRiCrnrUss_Dz ZDrive_BSW_Cal_Cal.ZDrive_BSW_Cal_VehicleInfomationTable.Vehicle_Information_Reserved_Line207 ZDrive_BSW_Cal_Cal.ZDrive_BSW_Cal_VehicleInfomationTable.ReRiCrnrUss_Roll ZDrive_BSW_Cal_Cal.ZDrive_BSW_Cal_VehicleInfomationTable.ReRiCrnrUss_Pitch ZDrive_BSW_Cal_Cal.ZDrive_BSW_Cal_VehicleInfomationTable.ReRiCrnrUss_Yaw ZDrive_BSW_Cal_Cal.ZDrive_BSW_Cal_VehicleInfomationTable.ReRiMidUss_Dx ZDrive_BSW_Cal_Cal.ZDrive_BSW_Cal_VehicleInfomationTable.ReRiMidUss_Dy ZDrive_BSW_Cal_Cal.ZDrive_BSW_Cal_VehicleInfomationTable.ReRiMidUss_Dz ZDrive_BSW_Cal_Cal.ZDrive_BSW_Cal_VehicleInfomationTable.Vehicle_Information_Reserved_Line214 ZDrive_BSW_Cal_Cal.ZDrive_BSW_Cal_VehicleInfomationTable.ReRiMidUss_Roll ZDrive_BSW_Cal_Cal.ZDrive_BSW_Cal_VehicleInfomationTable.ReRiMidUss_Pitch ZDrive_BSW_Cal_Cal.ZDrive_BSW_Cal_VehicleInfomationTable.ReRiMidUss_Yaw ZDrive_BSW_Cal_Cal.ZDrive_BSW_Cal_VehicleInfomationTable.ReLeMidUss_Dx ZDrive_BSW_Cal_Cal.ZDrive_BSW_Cal_VehicleInfomationTable.ReLeMidUss_Dy ZDrive_BSW_Cal_Cal.ZDrive_BSW_Cal_VehicleInfomationTable.ReLeMidUss_Dz ZDrive_BSW_Cal_Cal.ZDrive_BSW_Cal_VehicleInfomationTable.Vehicle_Information_Reserved_Line221 ZDrive_BSW_Cal_Cal.ZDrive_BSW_Cal_VehicleInfomationTable.ReLeMidUss_Roll ZDrive_BSW_Cal_Cal.ZDrive_BSW_Cal_VehicleInfomationTable.ReLeMidUss_Pitch ZDrive_BSW_Cal_Cal.ZDrive_BSW_Cal_VehicleInfomationTable.ReLeMidUss_Yaw ZDrive_BSW_Cal_Cal.ZDrive_BSW_Cal_VehicleInfomationTable.ReLeCrnrUss_Dx ZDrive_BSW_Cal_Cal.ZDrive_BSW_Cal_VehicleInfomationTable.ReLeCrnrUss_Dy ZDrive_BSW_Cal_Cal.ZDrive_BSW_Cal_VehicleInfomationTable.ReLeCrnrUss_Dz ZDrive_BSW_Cal_Cal.ZDrive_BSW_Cal_VehicleInfomationTable.Vehicle_Information_Reserved_Line228 ZDrive_BSW_Cal_Cal.ZDrive_BSW_Cal_VehicleInfomationTable.ReLeCrnrUss_Roll ZDrive_BSW_Cal_Cal.ZDrive_BSW_Cal_VehicleInfomationTable.ReLeCrnrUss_Pitch ZDrive_BSW_Cal_Cal.ZDrive_BSW_Cal_VehicleInfomationTable.ReLeCrnrUss_Yaw ZDrive_BSW_Cal_Cal.ZDrive_BSW_Cal_VehicleInfomationTable.ReLeSideUss_Dx ZDrive_BSW_Cal_Cal.ZDrive_BSW_Cal_VehicleInfomationTable.ReLeSideUss_Dy ZDrive_BSW_Cal_Cal.ZDrive_BSW_Cal_VehicleInfomationTable.ReLeSideUss_Dz ZDrive_BSW_Cal_Cal.ZDrive_BSW_Cal_VehicleInfomationTable.Vehicle_Information_Reserved_Line235 ZDrive_BSW_Cal_Cal.ZDrive_BSW_Cal_VehicleInfomationTable.ReLeSideUss_Roll ZDrive_BSW_Cal_Cal.ZDrive_BSW_Cal_VehicleInfomationTable.ReLeSideUss_Pitch ZDrive_BSW_Cal_Cal.ZDrive_BSW_Cal_VehicleInfomationTable.ReLeSideUss_Yaw ZDrive_BSW_Cal_Cal.ZDrive_BSW_Cal_VehicleInfomationTable.UltraInstallAng_FM ZDrive_BSW_Cal_Cal.ZDrive_BSW_Cal_VehicleInfomationTable.UltraInstallAng_FA ZDrive_BSW_Cal_Cal.ZDrive_BSW_Cal_VehicleInfomationTable.UltraInstallAng_FS ZDrive_BSW_Cal_Cal.ZDrive_BSW_Cal_VehicleInfomationTable.UltraInstallLatOffset_FM_m ZDrive_BSW_Cal_Cal.ZDrive_BSW_Cal_VehicleInfomationTable.UltraInstallLatOffset_FA_m ZDrive_BSW_Cal_Cal.ZDrive_BSW_Cal_VehicleInfomationTable.UltraInstallLatOffset_FS_m ZDrive_BSW_Cal_Cal.ZDrive_BSW_Cal_VehicleInfomationTable.Vehicle_Information_Reserved_Line245 ZDrive_BSW_Cal_Cal.ZDrive_BSW_Cal_VehicleInfomationTable.UltraInstallAng_RM ZDrive_BSW_Cal_Cal.ZDrive_BSW_Cal_VehicleInfomationTable.UltraInstallAng_RA ZDrive_BSW_Cal_Cal.ZDrive_BSW_Cal_VehicleInfomationTable.UltraInstallAng_RS ZDrive_BSW_Cal_Cal.ZDrive_BSW_Cal_VehicleInfomationTable.UltraInstallLatOffset_RM_m ZDrive_BSW_Cal_Cal.ZDrive_BSW_Cal_VehicleInfomationTable.UltraInstallLatOffset_RA_m ZDrive_BSW_Cal_Cal.ZDrive_BSW_Cal_VehicleInfomationTable.UltraInstallLatOffset_RS_m ZDrive_BSW_Cal_Cal.ZDrive_BSW_Cal_VehicleInfomationTable.UltraInstallHeight_FM_m ZDrive_BSW_Cal_Cal.ZDrive_BSW_Cal_VehicleInfomationTable.UltraInstallHeight_FA_m ZDrive_BSW_Cal_Cal.ZDrive_BSW_Cal_VehicleInfomationTable.UltraInstallHeight_FS_m ZDrive_BSW_Cal_Cal.ZDrive_BSW_Cal_VehicleInfomationTable.UltraInstallHeight_RM_m ZDrive_BSW_Cal_Cal.ZDrive_BSW_Cal_VehicleInfomationTable.UltraInstallHeight_RA_m ZDrive_BSW_Cal_Cal.ZDrive_BSW_Cal_VehicleInfomationTable.UltraInstallHeight_RS_m ZDrive_BSW_Cal_Cal.ZDrive_BSW_Cal_VehicleInfomationTable.Vehicle_Information_Reserved_Line258 ZDrive_BSW_Cal_Cal.ZDrive_BSW_Cal_VehicleInfomationTable.VISION_MOUNT_PARAM_FRONT_X_POSITION ZDrive_BSW_Cal_Cal.ZDrive_BSW_Cal_VehicleInfomationTable.VISION_MOUNT_PARAM_FRONT_Y_POSITION ZDrive_BSW_Cal_Cal.ZDrive_BSW_Cal_VehicleInfomationTable.VISION_MOUNT_PARAM_FRONT_YAW_ANGLE /end REF_CHARACTERISTIC
/end GROUP
/begin RECORD_LAYOUT Record_FLOAT32_IEEE FNC_VALUES 1 FLOAT32_IEEE COLUMN_DIR DIRECT /end RECORD_LAYOUT
/begin RECORD_LAYOUT Record_SBYTE FNC_VALUES 1 SBYTE COLUMN_DIR DIRECT /end RECORD_LAYOUT
/begin RECORD_LAYOUT Record_SWORD FNC_VALUES 1 SWORD COLUMN_DIR DIRECT /end RECORD_LAYOUT
/begin RECORD_LAYOUT Record_UBYTE FNC_VALUES 1 UBYTE COLUMN_DIR DIRECT /end RECORD_LAYOUT
/begin RECORD_LAYOUT Record_ULONG FNC_VALUES 1 ULONG COLUMN_DIR DIRECT /end RECORD_LAYOUT
/begin RECORD_LAYOUT Record_UWORD FNC_VALUES 1 UWORD COLUMN_DIR DIRECT /end RECORD_LAYOUT
/begin GROUP ZDrive_BSW_Cal_Cal.ZDrive_BSW_Cal_VehicleInfomationTable ""
 /begin REF_CHARACTERISTIC ZDrive_BSW_Cal_Cal.ZDrive_BSW_Cal_VehicleInfomationTable.ParkingBrakeType ZDrive_BSW_Cal_Cal.ZDrive_BSW_Cal_VehicleInfomationTable.StrWhlConfig ZDrive_BSW_Cal_Cal.ZDrive_BSW_Cal_VehicleInfomationTable.ParkingLongControlInterForm ZDrive_BSW_Cal_Cal.ZDrive_BSW_Cal_VehicleInfomationTable.Driving_Type ZDrive_BSW_Cal_Cal.ZDrive_BSW_Cal_VehicleInfomationTable.Left_Right_handType ZDrive_BSW_Cal_Cal.ZDrive_BSW_Cal_VehicleInfomationTable.AutoHold_Type ZDrive_BSW_Cal_Cal.ZDrive_BSW_Cal_VehicleInfomationTable.AccSens_LatAccSigDirect ZDrive_BSW_Cal_Cal.ZDrive_BSW_Cal_VehicleInfomationTable.AccSens_LonAccSigDirect ZDrive_BSW_Cal_Cal.ZDrive_BSW_Cal_VehicleInfomationTable.StrWhlAngSigDirect ZDrive_BSW_Cal_Cal.ZDrive_BSW_Cal_VehicleInfomationTable.DriHandTorqueDirect ZDrive_BSW_Cal_Cal.ZDrive_BSW_Cal_VehicleInfomationTable.Vehicle_Information_Reserved_Line24 ZDrive_BSW_Cal_Cal.ZDrive_BSW_Cal_VehicleInfomationTable.Vehicle_Information_Reserved_Line25 ZDrive_BSW_Cal_Cal.ZDrive_BSW_Cal_VehicleInfomationTable.Vehicle_Information_Reserved_Line26 ZDrive_BSW_Cal_Cal.ZDrive_BSW_Cal_VehicleInfomationTable.ValFunc_Reserve1 ZDrive_BSW_Cal_Cal.ZDrive_BSW_Cal_VehicleInfomationTable.ValFunc_Reserve2 ZDrive_BSW_Cal_Cal.ZDrive_BSW_Cal_VehicleInfomationTable.ASU_Type ZDrive_BSW_Cal_Cal.ZDrive_BSW_Cal_VehicleInfomationTable.Suspension ZDrive_BSW_Cal_Cal.ZDrive_BSW_Cal_VehicleInfomationTable.Vehicle_Information_Reserved_Line31 ZDrive_BSW_Cal_Cal.ZDrive_BSW_Cal_VehicleInfomationTable.Vehicle_Information_Reserved_Line32 ZDrive_BSW_Cal_Cal.ZDrive_BSW_Cal_VehicleInfomationTable.Vehicle_Information_Reserved_Line33 ZDrive_BSW_Cal_Cal.ZDrive_BSW_Cal_VehicleInfomationTable.Vehicle_Information_Reserved_Line34 ZDrive_BSW_Cal_Cal.ZDrive_BSW_Cal_VehicleInfomationTable.Vehicle_Information_Reserved_Line35 ZDrive_BSW_Cal_Cal.ZDrive_BSW_Cal_VehicleInfomationTable.Vehicle_Information_Reserved_Line36 ZDrive_BSW_Cal_Cal.ZDrive_BSW_Cal_VehicleInfomationTable.Vehicle_Information_Reserved_Line37 ZDrive_BSW_Cal_Cal.ZDrive_BSW_Cal_VehicleInfomationTable.Vehicle_Length_m ZDrive_BSW_Cal_Cal.ZDrive_BSW_Cal_VehicleInfomationTable.VehicleWidthMax_m ZDrive_BSW_Cal_Cal.ZDrive_BSW_Cal_VehicleInfomationTable.VehicleWidthMin_m ZDrive_BSW_Cal_Cal.ZDrive_BSW_Cal_VehicleInfomationTable.Height_m ZDrive_BSW_Cal_Cal.ZDrive_BSW_Cal_VehicleInfomationTable.EngineMaxiTorque_N ZDrive_BSW_Cal_Cal.ZDrive_BSW_Cal_VehicleInfomationTable.WheelBase_m ZDrive_BSW_Cal_Cal.ZDrive_BSW_Cal_VehicleInfomationTable.FrontAxleToRearAxLeCenterX_m ZDrive_BSW_Cal_Cal.ZDrive_BSW_Cal_VehicleInfomationTable.WheelTrack_m ZDrive_BSW_Cal_Cal.ZDrive_BSW_Cal_VehicleInfomationTable.FrWhlTrack_m ZDrive_BSW_Cal_Cal.ZDrive_BSW_Cal_VehicleInfomationTable.ReWhlTrack_m ZDrive_BSW_Cal_Cal.ZDrive_BSW_Cal_VehicleInfomationTable.FrontOverhang_Length_m ZDrive_BSW_Cal_Cal.ZDrive_BSW_Cal_VehicleInfomationTable.RearOverhang_Length_m ZDrive_BSW_Cal_Cal.ZDrive_BSW_Cal_VehicleInfomationTable.FrWhlHousingHeight_m ZDrive_BSW_Cal_Cal.ZDrive_BSW_Cal_VehicleInfomationTable.ReWhlHousingHeight_m ZDrive_BSW_Cal_Cal.ZDrive_BSW_Cal_VehicleInfomationTable.DxvRearBumper_m ZDrive_BSW_Cal_Cal.ZDrive_BSW_Cal_VehicleInfomationTable.DxvFrontBumper_m ZDrive_BSW_Cal_Cal.ZDrive_BSW_Cal_VehicleInfomationTable.FrontAxleToCenter_m ZDrive_BSW_Cal_Cal.ZDrive_BSW_Cal_VehicleInfomationTable.RearAxleToCenter_m ZDrive_BSW_Cal_Cal.ZDrive_BSW_Cal_VehicleInfomationTable.RearViewMirrorLength_On_Y ZDrive_BSW_Cal_Cal.ZDrive_BSW_Cal_VehicleInfomationTable.RearViewMirrorLength_On_X ZDrive_BSW_Cal_Cal.ZDrive_BSW_Cal_VehicleInfomationTable.RearViewMirrorTopSide_Height ZDrive_BSW_Cal_Cal.ZDrive_BSW_Cal_VehicleInfomationTable.RearViewMirrorBottomSide_Height ZDrive_BSW_Cal_Cal.ZDrive_BSW_Cal_VehicleInfomationTable.RearViewMirrorOutsidePointToRearAxle_Diatance_m ZDrive_BSW_Cal_Cal.ZDrive_BSW_Cal_VehicleInfomationTable.FrontLeftFrontPointToRearAxleCenter_Distance_m ZDrive_BSW_Cal_Cal.ZDrive_BSW_Cal_VehicleInfomationTable.FrontLeftFrontPointToCenterLine_Distance_m ZDrive_BSW_Cal_Cal.ZDrive_BSW_Cal_VehicleInfomationTable.FrontLeftOutsidePointToRearAxleCenter_Distance_m ZDrive_BSW_Cal_Cal.ZDrive_BSW_Cal_VehicleInfomationTable.FrontLeftOutsidePointToCenterLine_Distance_m ZDrive_BSW_Cal_Cal.ZDrive_BSW_Cal_VehicleInfomationTable.RearLeftOutsidePointToRearAxleCenter_Distance_m ZDrive_BSW_Cal_Cal.ZDrive_BSW_Cal_VehicleInfomationTable.RearLeftOutsidePointToCenterLine_Distance_m ZDrive_BSW_Cal_Cal.ZDrive_BSW_Cal_VehicleInfomationTable.RearLeftRearPointToRearAxleCenter_Distance_m ZDrive_BSW_Cal_Cal.ZDrive_BSW_Cal_VehicleInfomationTable.RearLeftRearPointToCenterLine_Distance_m ZDrive_BSW_Cal_Cal.ZDrive_BSW_Cal_VehicleInfomationTable.CURB_kg ZDrive_BSW_Cal_Cal.ZDrive_BSW_Cal_VehicleInfomationTable.Weight_N ZDrive_BSW_Cal_Cal.ZDrive_BSW_Cal_VehicleInfomationTable.GVW_kg ZDrive_BSW_Cal_Cal.ZDrive_BSW_Cal_VehicleInfomationTable.Empty_mass_kg ZDrive_BSW_Cal_Cal.ZDrive_BSW_Cal_VehicleInfomationTable.TireRadius_m ZDrive_BSW_Cal_Cal.ZDrive_BSW_Cal_VehicleInfomationTable.IEnvironment_WheelWidth ZDrive_BSW_Cal_Cal.ZDrive_BSW_Cal_VehicleInfomationTable.WheelDiameter ZDrive_BSW_Cal_Cal.ZDrive_BSW_Cal_VehicleInfomationTable.WhlSpdSensUnitPulseDist ZDrive_BSW_Cal_Cal.ZDrive_BSW_Cal_VehicleInfomationTable.WheelSpeedCounterMax ZDrive_BSW_Cal_Cal.ZDrive_BSW_Cal_VehicleInfomationTable.WheelSpeedCounterPulse ZDrive_BSW_Cal_Cal.ZDrive_BSW_Cal_VehicleInfomationTable.WheelSpeedCounterIsUnsigned ZDrive_BSW_Cal_Cal.ZDrive_BSW_Cal_VehicleInfomationTable.WheelSpeedCounterMin ZDrive_BSW_Cal_Cal.ZDrive_BSW_Cal_VehicleInfomationTable.Vehicle_Information_Reserved_Line81 ZDrive_BSW_Cal_Cal.ZDrive_BSW_Cal_VehicleInfomationTable.Vehicle_Information_Reserved_Line82 ZDrive_BSW_Cal_Cal.ZDrive_BSW_Cal_VehicleInfomationTable.CharSpd_mps ZDrive_BSW_Cal_Cal.ZDrive_BSW_Cal_VehicleInfomationTable.SideSlipAnglefactor ZDrive_BSW_Cal_Cal.ZDrive_BSW_Cal_VehicleInfomationTable.MaxSteeringAngle ZDrive_BSW_Cal_Cal.ZDrive_BSW_Cal_VehicleInfomationTable.SteeringAngleRatio ZDrive_BSW_Cal_Cal.ZDrive_BSW_Cal_VehicleInfomationTable.RearAxlecCenterTurningCircle ZDrive_BSW_Cal_Cal.ZDrive_BSW_Cal_VehicleInfomationTable.StrWhlMappingTable ZDrive_BSW_Cal_Cal.ZDrive_BSW_Cal_VehicleInfomationTable.FRollingRadius_m ZDrive_BSW_Cal_Cal.ZDrive_BSW_Cal_VehicleInfomationTable.RRollingRadius_m ZDrive_BSW_Cal_Cal.ZDrive_BSW_Cal_VehicleInfomationTable.PowerTransRatio ZDrive_BSW_Cal_Cal.ZDrive_BSW_Cal_VehicleInfomationTable.TAC_Camera_Height ZDrive_BSW_Cal_Cal.ZDrive_BSW_Cal_VehicleInfomationTable.IEnvironment_CamToFrontAxle ZDrive_BSW_Cal_Cal.ZDrive_BSW_Cal_VehicleInfomationTable.FCFocus2FrAxleDist_Y_m ZDrive_BSW_Cal_Cal.ZDrive_BSW_Cal_VehicleInfomationTable.FCFocus2FrAxleDist_Z_m ZDrive_BSW_Cal_Cal.ZDrive_BSW_Cal_VehicleInfomationTable.FC2RearAxisX_m ZDrive_BSW_Cal_Cal.ZDrive_BSW_Cal_VehicleInfomationTable.FC2RearAxisY_m ZDrive_BSW_Cal_Cal.ZDrive_BSW_Cal_VehicleInfomationTable.CamDistToRearAxleCenter_DZ ZDrive_BSW_Cal_Cal.ZDrive_BSW_Cal_VehicleInfomationTable.FCFirstViewPointDist_m ZDrive_BSW_Cal_Cal.ZDrive_BSW_Cal_VehicleInfomationTable.IEnvironment_RefPX_Front_Bumper ZDrive_BSW_Cal_Cal.ZDrive_BSW_Cal_VehicleInfomationTable.TAC_Bottom ZDrive_BSW_Cal_Cal.ZDrive_BSW_Cal_VehicleInfomationTable.Vehicle_Information_Reserved_Line102 ZDrive_BSW_Cal_Cal.ZDrive_BSW_Cal_VehicleInfomationTable.IEnviroment_Top_Crop ZDrive_BSW_Cal_Cal.ZDrive_BSW_Cal_VehicleInfomationTable.IEnviroment_Bottom_Crop ZDrive_BSW_Cal_Cal.ZDrive_BSW_Cal_VehicleInfomationTable.Vehicle_Information_Reserved_Line105 ZDrive_BSW_Cal_Cal.ZDrive_BSW_Cal_VehicleInfomationTable.FC2LeftWheel_m ZDrive_BSW_Cal_Cal.ZDrive_BSW_Cal_VehicleInfomationTable.FC2RightWheel_m ZDrive_BSW_Cal_Cal.ZDrive_BSW_Cal_VehicleInfomationTable.TAC_Targets_Num ZDrive_BSW_Cal_Cal.ZDrive_BSW_Cal_VehicleInfomationTable.Vehicle_Information_Reserved_Line109 ZDrive_BSW_Cal_Cal.ZDrive_BSW_Cal_VehicleInfomationTable.Vehicle_Information_Reserved_Line110 ZDrive_BSW_Cal_Cal.ZDrive_BSW_Cal_VehicleInfomationTable.camera_x_m ZDrive_BSW_Cal_Cal.ZDrive_BSW_Cal_VehicleInfomationTable.camera_y_m ZDrive_BSW_Cal_Cal.ZDrive_BSW_Cal_VehicleInfomationTable.camera_z_m ZDrive_BSW_Cal_Cal.ZDrive_BSW_Cal_VehicleInfomationTable.translation_x_m ZDrive_BSW_Cal_Cal.ZDrive_BSW_Cal_VehicleInfomationTable.Vehicle_Information_Reserved_Line115 ZDrive_BSW_Cal_Cal.ZDrive_BSW_Cal_VehicleInfomationTable.RollingAngOfCAD ZDrive_BSW_Cal_Cal.ZDrive_BSW_Cal_VehicleInfomationTable.PitchAngOfCAD ZDrive_BSW_Cal_Cal.ZDrive_BSW_Cal_VehicleInfomationTable.YawAngOfCAD ZDrive_BSW_Cal_Cal.ZDrive_BSW_Cal_VehicleInfomationTable.FrontShortCamera_Dx ZDrive_BSW_Cal_Cal.ZDrive_BSW_Cal_VehicleInfomationTable.FrontShortCamera_Dy ZDrive_BSW_Cal_Cal.ZDrive_BSW_Cal_VehicleInfomationTable.FrontShortCamera_Dz ZDrive_BSW_Cal_Cal.ZDrive_BSW_Cal_VehicleInfomationTable.Vehicle_Information_Reserved_Line122 ZDrive_BSW_Cal_Cal.ZDrive_BSW_Cal_VehicleInfomationTable.FrontShortCamera_Roll ZDrive_BSW_Cal_Cal.ZDrive_BSW_Cal_VehicleInfomationTable.FrontShortCamera_Pitch ZDrive_BSW_Cal_Cal.ZDrive_BSW_Cal_VehicleInfomationTable.FrontShortCamera_Yaw ZDrive_BSW_Cal_Cal.ZDrive_BSW_Cal_VehicleInfomationTable.FrSCBlindSpotLength_m ZDrive_BSW_Cal_Cal.ZDrive_BSW_Cal_VehicleInfomationTable.FrSCDist2OuterMostSide_m ZDrive_BSW_Cal_Cal.ZDrive_BSW_Cal_VehicleInfomationTable.LeftShortCamera_Dx ZDrive_BSW_Cal_Cal.ZDrive_BSW_Cal_VehicleInfomationTable.LeftShortCamera_Dy ZDrive_BSW_Cal_Cal.ZDrive_BSW_Cal_VehicleInfomationTable.LeftShortCamera_Dz ZDrive_BSW_Cal_Cal.ZDrive_BSW_Cal_VehicleInfomationTable.Vehicle_Information_Reserved_Line131 ZDrive_BSW_Cal_Cal.ZDrive_BSW_Cal_VehicleInfomationTable.LeftShortCamera_Roll ZDrive_BSW_Cal_Cal.ZDrive_BSW_Cal_VehicleInfomationTable.LeftShortCamera_Pitch ZDrive_BSW_Cal_Cal.ZDrive_BSW_Cal_VehicleInfomationTable.LeftShortCamera_Yaw ZDrive_BSW_Cal_Cal.ZDrive_BSW_Cal_VehicleInfomationTable.LeSCBlindSpotLength_m ZDrive_BSW_Cal_Cal.ZDrive_BSW_Cal_VehicleInfomationTable.LeSCVerticalDist2Body_m ZDrive_BSW_Cal_Cal.ZDrive_BSW_Cal_VehicleInfomationTable.RearShortCamera_Dx ZDrive_BSW_Cal_Cal.ZDrive_BSW_Cal_VehicleInfomationTable.RearShortCamera_Dy ZDrive_BSW_Cal_Cal.ZDrive_BSW_Cal_VehicleInfomationTable.RearShortCamera_Dz ZDrive_BSW_Cal_Cal.ZDrive_BSW_Cal_VehicleInfomationTable.Vehicle_Information_Reserved_Line140 ZDrive_BSW_Cal_Cal.ZDrive_BSW_Cal_VehicleInfomationTable.RearShortCamera_Roll ZDrive_BSW_Cal_Cal.ZDrive_BSW_Cal_VehicleInfomationTable.RearShortCamera_Pitch ZDrive_BSW_Cal_Cal.ZDrive_BSW_Cal_VehicleInfomationTable.RearShortCamera_Yaw ZDrive_BSW_Cal_Cal.ZDrive_BSW_Cal_VehicleInfomationTable.ReSCBlindSpotLength_m ZDrive_BSW_Cal_Cal.ZDrive_BSW_Cal_VehicleInfomationTable.ReSCDist2OuterMostSide_m ZDrive_BSW_Cal_Cal.ZDrive_BSW_Cal_VehicleInfomationTable.RightShortCamera_Dx ZDrive_BSW_Cal_Cal.ZDrive_BSW_Cal_VehicleInfomationTable.RightShortCamera_Dy ZDrive_BSW_Cal_Cal.ZDrive_BSW_Cal_VehicleInfomationTable.RightShortCamera_Dz ZDrive_BSW_Cal_Cal.ZDrive_BSW_Cal_VehicleInfomationTable.Vehicle_Information_Reserved_Line149 ZDrive_BSW_Cal_Cal.ZDrive_BSW_Cal_VehicleInfomationTable.RightShortCamera_Roll ZDrive_BSW_Cal_Cal.ZDrive_BSW_Cal_VehicleInfomationTable.RightShortCamera_Pitch ZDrive_BSW_Cal_Cal.ZDrive_BSW_Cal_VehicleInfomationTable.RightShortCamera_Yaw ZDrive_BSW_Cal_Cal.ZDrive_BSW_Cal_VehicleInfomationTable.RiSCBlindSpotLength_m ZDrive_BSW_Cal_Cal.ZDrive_BSW_Cal_VehicleInfomationTable.RiSCVerticalDist2Body_m ZDrive_BSW_Cal_Cal.ZDrive_BSW_Cal_VehicleInfomationTable.FrntLeSideUss_Dx ZDrive_BSW_Cal_Cal.ZDrive_BSW_Cal_VehicleInfomationTable.FrntLeSideUss_Dy ZDrive_BSW_Cal_Cal.ZDrive_BSW_Cal_VehicleInfomationTable.FrntLeSideUss_Dz ZDrive_BSW_Cal_Cal.ZDrive_BSW_Cal_VehicleInfomationTable.Vehicle_Information_Reserved_Line158 ZDrive_BSW_Cal_Cal.ZDrive_BSW_Cal_VehicleInfomationTable.FrntLeSideUss_Roll ZDrive_BSW_Cal_Cal.ZDrive_BSW_Cal_VehicleInfomationTable.FrntLeSideUss_Pitch ZDrive_BSW_Cal_Cal.ZDrive_BSW_Cal_VehicleInfomationTable.FrntLeSideUss_Yaw ZDrive_BSW_Cal_Cal.ZDrive_BSW_Cal_VehicleInfomationTable.FrntLeCrnrUss_Dx ZDrive_BSW_Cal_Cal.ZDrive_BSW_Cal_VehicleInfomationTable.FrntLeCrnrUss_Dy ZDrive_BSW_Cal_Cal.ZDrive_BSW_Cal_VehicleInfomationTable.FrntLeCrnrUss_Dz ZDrive_BSW_Cal_Cal.ZDrive_BSW_Cal_VehicleInfomationTable.Vehicle_Information_Reserved_Line165 ZDrive_BSW_Cal_Cal.ZDrive_BSW_Cal_VehicleInfomationTable.FrntLeCrnrUss_Roll ZDrive_BSW_Cal_Cal.ZDrive_BSW_Cal_VehicleInfomationTable.FrntLeCrnrUss_Pitch ZDrive_BSW_Cal_Cal.ZDrive_BSW_Cal_VehicleInfomationTable.FrntLeCrnrUss_Yaw ZDrive_BSW_Cal_Cal.ZDrive_BSW_Cal_VehicleInfomationTable.FrntLeMidUss_Dx ZDrive_BSW_Cal_Cal.ZDrive_BSW_Cal_VehicleInfomationTable.FrntLeMidUss_Dy ZDrive_BSW_Cal_Cal.ZDrive_BSW_Cal_VehicleInfomationTable.FrntLeMidUss_Dz ZDrive_BSW_Cal_Cal.ZDrive_BSW_Cal_VehicleInfomationTable.Vehicle_Information_Reserved_Line172 ZDrive_BSW_Cal_Cal.ZDrive_BSW_Cal_VehicleInfomationTable.FrntLeMidUss_Roll ZDrive_BSW_Cal_Cal.ZDrive_BSW_Cal_VehicleInfomationTable.FrntLeMidUss_Pitch ZDrive_BSW_Cal_Cal.ZDrive_BSW_Cal_VehicleInfomationTable.FrntLeMidUss_Yaw ZDrive_BSW_Cal_Cal.ZDrive_BSW_Cal_VehicleInfomationTable.FrntRiMidUss_Dx ZDrive_BSW_Cal_Cal.ZDrive_BSW_Cal_VehicleInfomationTable.FrntRiMidUss_Dy ZDrive_BSW_Cal_Cal.ZDrive_BSW_Cal_VehicleInfomationTable.FrntRiMidUss_Dz ZDrive_BSW_Cal_Cal.ZDrive_BSW_Cal_VehicleInfomationTable.Vehicle_Information_Reserved_Line179 ZDrive_BSW_Cal_Cal.ZDrive_BSW_Cal_VehicleInfomationTable.FrntRiMidUss_Roll ZDrive_BSW_Cal_Cal.ZDrive_BSW_Cal_VehicleInfomationTable.FrntRiMidUss_Pitch ZDrive_BSW_Cal_Cal.ZDrive_BSW_Cal_VehicleInfomationTable.FrntRiMidUss_Yaw ZDrive_BSW_Cal_Cal.ZDrive_BSW_Cal_VehicleInfomationTable.FrntRiCrnrUss_Dx ZDrive_BSW_Cal_Cal.ZDrive_BSW_Cal_VehicleInfomationTable.FrntRiCrnrUss_Dy ZDrive_BSW_Cal_Cal.ZDrive_BSW_Cal_VehicleInfomationTable.FrntRiCrnrUss_Dz ZDrive_BSW_Cal_Cal.ZDrive_BSW_Cal_VehicleInfomationTable.Vehicle_Information_Reserved_Line186 ZDrive_BSW_Cal_Cal.ZDrive_BSW_Cal_VehicleInfomationTable.FrntRiCrnrUss_Roll ZDrive_BSW_Cal_Cal.ZDrive_BSW_Cal_VehicleInfomationTable.FrntRiCrnrUss_Pitch ZDrive_BSW_Cal_Cal.ZDrive_BSW_Cal_VehicleInfomationTable.FrntRiCrnrUss_Yaw ZDrive_BSW_Cal_Cal.ZDrive_BSW_Cal_VehicleInfomationTable.FrntRiSideUss_Dx ZDrive_BSW_Cal_Cal.ZDrive_BSW_Cal_VehicleInfomationTable.FrntRiSideUss_Dy ZDrive_BSW_Cal_Cal.ZDrive_BSW_Cal_VehicleInfomationTable.FrntRiSideUss_Dz ZDrive_BSW_Cal_Cal.ZDrive_BSW_Cal_VehicleInfomationTable.Vehicle_Information_Reserved_Line193 ZDrive_BSW_Cal_Cal.ZDrive_BSW_Cal_VehicleInfomationTable.FrntRiSideUss_Roll ZDrive_BSW_Cal_Cal.ZDrive_BSW_Cal_VehicleInfomationTable.FrntRiSideUss_Pitch ZDrive_BSW_Cal_Cal.ZDrive_BSW_Cal_VehicleInfomationTable.FrntRiSideUss_Yaw ZDrive_BSW_Cal_Cal.ZDrive_BSW_Cal_VehicleInfomationTable.ReRiSideUss_Dx ZDrive_BSW_Cal_Cal.ZDrive_BSW_Cal_VehicleInfomationTable.ReRiSideUss_Dy ZDrive_BSW_Cal_Cal.ZDrive_BSW_Cal_VehicleInfomationTable.ReRiSideUss_Dz ZDrive_BSW_Cal_Cal.ZDrive_BSW_Cal_VehicleInfomationTable.Vehicle_Information_Reserved_Line200 ZDrive_BSW_Cal_Cal.ZDrive_BSW_Cal_VehicleInfomationTable.ReRiSideUss_Roll ZDrive_BSW_Cal_Cal.ZDrive_BSW_Cal_VehicleInfomationTable.ReRiSideUss_Pitch ZDrive_BSW_Cal_Cal.ZDrive_BSW_Cal_VehicleInfomationTable.ReRiSideUss_Yaw ZDrive_BSW_Cal_Cal.ZDrive_BSW_Cal_VehicleInfomationTable.ReRiCrnrUss_Dx ZDrive_BSW_Cal_Cal.ZDrive_BSW_Cal_VehicleInfomationTable.ReRiCrnrUss_Dy ZDrive_BSW_Cal_Cal.ZDrive_BSW_Cal_VehicleInfomationTable.ReRiCrnrUss_Dz ZDrive_BSW_Cal_Cal.ZDrive_BSW_Cal_VehicleInfomationTable.Vehicle_Information_Reserved_Line207 ZDrive_BSW_Cal_Cal.ZDrive_BSW_Cal_VehicleInfomationTable.ReRiCrnrUss_Roll ZDrive_BSW_Cal_Cal.ZDrive_BSW_Cal_VehicleInfomationTable.ReRiCrnrUss_Pitch ZDrive_BSW_Cal_Cal.ZDrive_BSW_Cal_VehicleInfomationTable.ReRiCrnrUss_Yaw ZDrive_BSW_Cal_Cal.ZDrive_BSW_Cal_VehicleInfomationTable.ReRiMidUss_Dx ZDrive_BSW_Cal_Cal.ZDrive_BSW_Cal_VehicleInfomationTable.ReRiMidUss_Dy ZDrive_BSW_Cal_Cal.ZDrive_BSW_Cal_VehicleInfomationTable.ReRiMidUss_Dz ZDrive_BSW_Cal_Cal.ZDrive_BSW_Cal_VehicleInfomationTable.Vehicle_Information_Reserved_Line214 ZDrive_BSW_Cal_Cal.ZDrive_BSW_Cal_VehicleInfomationTable.ReRiMidUss_Roll ZDrive_BSW_Cal_Cal.ZDrive_BSW_Cal_VehicleInfomationTable.ReRiMidUss_Pitch ZDrive_BSW_Cal_Cal.ZDrive_BSW_Cal_VehicleInfomationTable.ReRiMidUss_Yaw ZDrive_BSW_Cal_Cal.ZDrive_BSW_Cal_VehicleInfomationTable.ReLeMidUss_Dx ZDrive_BSW_Cal_Cal.ZDrive_BSW_Cal_VehicleInfomationTable.ReLeMidUss_Dy ZDrive_BSW_Cal_Cal.ZDrive_BSW_Cal_VehicleInfomationTable.ReLeMidUss_Dz ZDrive_BSW_Cal_Cal.ZDrive_BSW_Cal_VehicleInfomationTable.Vehicle_Information_Reserved_Line221 ZDrive_BSW_Cal_Cal.ZDrive_BSW_Cal_VehicleInfomationTable.ReLeMidUss_Roll ZDrive_BSW_Cal_Cal.ZDrive_BSW_Cal_VehicleInfomationTable.ReLeMidUss_Pitch ZDrive_BSW_Cal_Cal.ZDrive_BSW_Cal_VehicleInfomationTable.ReLeMidUss_Yaw ZDrive_BSW_Cal_Cal.ZDrive_BSW_Cal_VehicleInfomationTable.ReLeCrnrUss_Dx ZDrive_BSW_Cal_Cal.ZDrive_BSW_Cal_VehicleInfomationTable.ReLeCrnrUss_Dy ZDrive_BSW_Cal_Cal.ZDrive_BSW_Cal_VehicleInfomationTable.ReLeCrnrUss_Dz ZDrive_BSW_Cal_Cal.ZDrive_BSW_Cal_VehicleInfomationTable.Vehicle_Information_Reserved_Line228 ZDrive_BSW_Cal_Cal.ZDrive_BSW_Cal_VehicleInfomationTable.ReLeCrnrUss_Roll ZDrive_BSW_Cal_Cal.ZDrive_BSW_Cal_VehicleInfomationTable.ReLeCrnrUss_Pitch ZDrive_BSW_Cal_Cal.ZDrive_BSW_Cal_VehicleInfomationTable.ReLeCrnrUss_Yaw ZDrive_BSW_Cal_Cal.ZDrive_BSW_Cal_VehicleInfomationTable.ReLeSideUss_Dx ZDrive_BSW_Cal_Cal.ZDrive_BSW_Cal_VehicleInfomationTable.ReLeSideUss_Dy ZDrive_BSW_Cal_Cal.ZDrive_BSW_Cal_VehicleInfomationTable.ReLeSideUss_Dz ZDrive_BSW_Cal_Cal.ZDrive_BSW_Cal_VehicleInfomationTable.Vehicle_Information_Reserved_Line235 ZDrive_BSW_Cal_Cal.ZDrive_BSW_Cal_VehicleInfomationTable.ReLeSideUss_Roll ZDrive_BSW_Cal_Cal.ZDrive_BSW_Cal_VehicleInfomationTable.ReLeSideUss_Pitch ZDrive_BSW_Cal_Cal.ZDrive_BSW_Cal_VehicleInfomationTable.ReLeSideUss_Yaw ZDrive_BSW_Cal_Cal.ZDrive_BSW_Cal_VehicleInfomationTable.UltraInstallAng_FM ZDrive_BSW_Cal_Cal.ZDrive_BSW_Cal_VehicleInfomationTable.UltraInstallAng_FA ZDrive_BSW_Cal_Cal.ZDrive_BSW_Cal_VehicleInfomationTable.UltraInstallAng_FS ZDrive_BSW_Cal_Cal.ZDrive_BSW_Cal_VehicleInfomationTable.UltraInstallLatOffset_FM_m ZDrive_BSW_Cal_Cal.ZDrive_BSW_Cal_VehicleInfomationTable.UltraInstallLatOffset_FA_m ZDrive_BSW_Cal_Cal.ZDrive_BSW_Cal_VehicleInfomationTable.UltraInstallLatOffset_FS_m ZDrive_BSW_Cal_Cal.ZDrive_BSW_Cal_VehicleInfomationTable.Vehicle_Information_Reserved_Line245 ZDrive_BSW_Cal_Cal.ZDrive_BSW_Cal_VehicleInfomationTable.UltraInstallAng_RM ZDrive_BSW_Cal_Cal.ZDrive_BSW_Cal_VehicleInfomationTable.UltraInstallAng_RA ZDrive_BSW_Cal_Cal.ZDrive_BSW_Cal_VehicleInfomationTable.UltraInstallAng_RS ZDrive_BSW_Cal_Cal.ZDrive_BSW_Cal_VehicleInfomationTable.UltraInstallLatOffset_RM_m ZDrive_BSW_Cal_Cal.ZDrive_BSW_Cal_VehicleInfomationTable.UltraInstallLatOffset_RA_m ZDrive_BSW_Cal_Cal.ZDrive_BSW_Cal_VehicleInfomationTable.UltraInstallLatOffset_RS_m ZDrive_BSW_Cal_Cal.ZDrive_BSW_Cal_VehicleInfomationTable.UltraInstallHeight_FM_m ZDrive_BSW_Cal_Cal.ZDrive_BSW_Cal_VehicleInfomationTable.UltraInstallHeight_FA_m ZDrive_BSW_Cal_Cal.ZDrive_BSW_Cal_VehicleInfomationTable.UltraInstallHeight_FS_m ZDrive_BSW_Cal_Cal.ZDrive_BSW_Cal_VehicleInfomationTable.UltraInstallHeight_RM_m ZDrive_BSW_Cal_Cal.ZDrive_BSW_Cal_VehicleInfomationTable.UltraInstallHeight_RA_m ZDrive_BSW_Cal_Cal.ZDrive_BSW_Cal_VehicleInfomationTable.UltraInstallHeight_RS_m ZDrive_BSW_Cal_Cal.ZDrive_BSW_Cal_VehicleInfomationTable.Vehicle_Information_Reserved_Line258 ZDrive_BSW_Cal_Cal.ZDrive_BSW_Cal_VehicleInfomationTable.VISION_MOUNT_PARAM_FRONT_X_POSITION ZDrive_BSW_Cal_Cal.ZDrive_BSW_Cal_VehicleInfomationTable.VISION_MOUNT_PARAM_FRONT_Y_POSITION ZDrive_BSW_Cal_Cal.ZDrive_BSW_Cal_VehicleInfomationTable.VISION_MOUNT_PARAM_FRONT_YAW_ANGLE /end REF_CHARACTERISTIC
/end GROUP
/begin RECORD_LAYOUT Record_FLOAT32_IEEE FNC_VALUES 1 FLOAT32_IEEE COLUMN_DIR DIRECT /end RECORD_LAYOUT
/begin RECORD_LAYOUT Record_SBYTE FNC_VALUES 1 SBYTE COLUMN_DIR DIRECT /end RECORD_LAYOUT
/begin RECORD_LAYOUT Record_SWORD FNC_VALUES 1 SWORD COLUMN_DIR DIRECT /end RECORD_LAYOUT
/begin RECORD_LAYOUT Record_UBYTE FNC_VALUES 1 UBYTE COLUMN_DIR DIRECT /end RECORD_LAYOUT
/begin RECORD_LAYOUT Record_ULONG FNC_VALUES 1 ULONG COLUMN_DIR DIRECT /end RECORD_LAYOUT
/begin RECORD_LAYOUT Record_UWORD FNC_VALUES 1 UWORD COLUMN_DIR DIRECT /end RECORD_LAYOUT
/begin GROUP ZDrive_BSW_Cal_Cal.ZDrive_BSW_Cal_VehicleInfomationTable ""
 /begin REF_CHARACTERISTIC ZDrive_BSW_Cal_Cal.ZDrive_BSW_Cal_VehicleInfomationTable.ParkingBrakeType ZDrive_BSW_Cal_Cal.ZDrive_BSW_Cal_VehicleInfomationTable.StrWhlConfig ZDrive_BSW_Cal_Cal.ZDrive_BSW_Cal_VehicleInfomationTable.ParkingLongControlInterForm ZDrive_BSW_Cal_Cal.ZDrive_BSW_Cal_VehicleInfomationTable.Driving_Type ZDrive_BSW_Cal_Cal.ZDrive_BSW_Cal_VehicleInfomationTable.Left_Right_handType ZDrive_BSW_Cal_Cal.ZDrive_BSW_Cal_VehicleInfomationTable.AutoHold_Type ZDrive_BSW_Cal_Cal.ZDrive_BSW_Cal_VehicleInfomationTable.AccSens_LatAccSigDirect ZDrive_BSW_Cal_Cal.ZDrive_BSW_Cal_VehicleInfomationTable.AccSens_LonAccSigDirect ZDrive_BSW_Cal_Cal.ZDrive_BSW_Cal_VehicleInfomationTable.StrWhlAngSigDirect ZDrive_BSW_Cal_Cal.ZDrive_BSW_Cal_VehicleInfomationTable.DriHandTorqueDirect ZDrive_BSW_Cal_Cal.ZDrive_BSW_Cal_VehicleInfomationTable.Vehicle_Information_Reserved_Line24 ZDrive_BSW_Cal_Cal.ZDrive_BSW_Cal_VehicleInfomationTable.Vehicle_Information_Reserved_Line25 ZDrive_BSW_Cal_Cal.ZDrive_BSW_Cal_VehicleInfomationTable.Vehicle_Information_Reserved_Line26 ZDrive_BSW_Cal_Cal.ZDrive_BSW_Cal_VehicleInfomationTable.ValFunc_Reserve1 ZDrive_BSW_Cal_Cal.ZDrive_BSW_Cal_VehicleInfomationTable.ValFunc_Reserve2 ZDrive_BSW_Cal_Cal.ZDrive_BSW_Cal_VehicleInfomationTable.ASU_Type ZDrive_BSW_Cal_Cal.ZDrive_BSW_Cal_VehicleInfomationTable.Suspension ZDrive_BSW_Cal_Cal.ZDrive_BSW_Cal_VehicleInfomationTable.Vehicle_Information_Reserved_Line31 ZDrive_BSW_Cal_Cal.ZDrive_BSW_Cal_VehicleInfomationTable.Vehicle_Information_Reserved_Line32 ZDrive_BSW_Cal_Cal.ZDrive_BSW_Cal_VehicleInfomationTable.Vehicle_Information_Reserved_Line33 ZDrive_BSW_Cal_Cal.ZDrive_BSW_Cal_VehicleInfomationTable.Vehicle_Information_Reserved_Line34 ZDrive_BSW_Cal_Cal.ZDrive_BSW_Cal_VehicleInfomationTable.Vehicle_Information_Reserved_Line35 ZDrive_BSW_Cal_Cal.ZDrive_BSW_Cal_VehicleInfomationTable.Vehicle_Information_Reserved_Line36 ZDrive_BSW_Cal_Cal.ZDrive_BSW_Cal_VehicleInfomationTable.Vehicle_Information_Reserved_Line37 ZDrive_BSW_Cal_Cal.ZDrive_BSW_Cal_VehicleInfomationTable.Vehicle_Length_m ZDrive_BSW_Cal_Cal.ZDrive_BSW_Cal_VehicleInfomationTable.VehicleWidthMax_m ZDrive_BSW_Cal_Cal.ZDrive_BSW_Cal_VehicleInfomationTable.VehicleWidthMin_m ZDrive_BSW_Cal_Cal.ZDrive_BSW_Cal_VehicleInfomationTable.Height_m ZDrive_BSW_Cal_Cal.ZDrive_BSW_Cal_VehicleInfomationTable.EngineMaxiTorque_N ZDrive_BSW_Cal_Cal.ZDrive_BSW_Cal_VehicleInfomationTable.WheelBase_m ZDrive_BSW_Cal_Cal.ZDrive_BSW_Cal_VehicleInfomationTable.FrontAxleToRearAxLeCenterX_m ZDrive_BSW_Cal_Cal.ZDrive_BSW_Cal_VehicleInfomationTable.WheelTrack_m ZDrive_BSW_Cal_Cal.ZDrive_BSW_Cal_VehicleInfomationTable.FrWhlTrack_m ZDrive_BSW_Cal_Cal.ZDrive_BSW_Cal_VehicleInfomationTable.ReWhlTrack_m ZDrive_BSW_Cal_Cal.ZDrive_BSW_Cal_VehicleInfomationTable.FrontOverhang_Length_m ZDrive_BSW_Cal_Cal.ZDrive_BSW_Cal_VehicleInfomationTable.RearOverhang_Length_m ZDrive_BSW_Cal_Cal.ZDrive_BSW_Cal_VehicleInfomationTable.FrWhlHousingHeight_m ZDrive_BSW_Cal_Cal.ZDrive_BSW_Cal_VehicleInfomationTable.ReWhlHousingHeight_m ZDrive_BSW_Cal_Cal.ZDrive_BSW_Cal_VehicleInfomationTable.DxvRearBumper_m ZDrive_BSW_Cal_Cal.ZDrive_BSW_Cal_VehicleInfomationTable.DxvFrontBumper_m ZDrive_BSW_Cal_Cal.ZDrive_BSW_Cal_VehicleInfomationTable.FrontAxleToCenter_m ZDrive_BSW_Cal_Cal.ZDrive_BSW_Cal_VehicleInfomationTable.RearAxleToCenter_m ZDrive_BSW_Cal_Cal.ZDrive_BSW_Cal_VehicleInfomationTable.RearViewMirrorLength_On_Y ZDrive_BSW_Cal_Cal.ZDrive_BSW_Cal_VehicleInfomationTable.RearViewMirrorLength_On_X ZDrive_BSW_Cal_Cal.ZDrive_BSW_Cal_VehicleInfomationTable.RearViewMirrorTopSide_Height ZDrive_BSW_Cal_Cal.ZDrive_BSW_Cal_VehicleInfomationTable.RearViewMirrorBottomSide_Height ZDrive_BSW_Cal_Cal.ZDrive_BSW_Cal_VehicleInfomationTable.RearViewMirrorOutsidePointToRearAxle_Diatance_m ZDrive_BSW_Cal_Cal.ZDrive_BSW_Cal_VehicleInfomationTable.FrontLeftFrontPointToRearAxleCenter_Distance_m ZDrive_BSW_Cal_Cal.ZDrive_BSW_Cal_VehicleInfomationTable.FrontLeftFrontPointToCenterLine_Distance_m ZDrive_BSW_Cal_Cal.ZDrive_BSW_Cal_VehicleInfomationTable.FrontLeftOutsidePointToRearAxleCenter_Distance_m ZDrive_BSW_Cal_Cal.ZDrive_BSW_Cal_VehicleInfomationTable.FrontLeftOutsidePointToCenterLine_Distance_m ZDrive_BSW_Cal_Cal.ZDrive_BSW_Cal_VehicleInfomationTable.RearLeftOutsidePointToRearAxleCenter_Distance_m ZDrive_BSW_Cal_Cal.ZDrive_BSW_Cal_VehicleInfomationTable.RearLeftOutsidePointToCenterLine_Distance_m ZDrive_BSW_Cal_Cal.ZDrive_BSW_Cal_VehicleInfomationTable.RearLeftRearPointToRearAxleCenter_Distance_m ZDrive_BSW_Cal_Cal.ZDrive_BSW_Cal_VehicleInfomationTable.RearLeftRearPointToCenterLine_Distance_m ZDrive_BSW_Cal_Cal.ZDrive_BSW_Cal_VehicleInfomationTable.CURB_kg ZDrive_BSW_Cal_Cal.ZDrive_BSW_Cal_VehicleInfomationTable.Weight_N ZDrive_BSW_Cal_Cal.ZDrive_BSW_Cal_VehicleInfomationTable.GVW_kg ZDrive_BSW_Cal_Cal.ZDrive_BSW_Cal_VehicleInfomationTable.Empty_mass_kg ZDrive_BSW_Cal_Cal.ZDrive_BSW_Cal_VehicleInfomationTable.TireRadius_m ZDrive_BSW_Cal_Cal.ZDrive_BSW_Cal_VehicleInfomationTable.IEnvironment_WheelWidth ZDrive_BSW_Cal_Cal.ZDrive_BSW_Cal_VehicleInfomationTable.WheelDiameter ZDrive_BSW_Cal_Cal.ZDrive_BSW_Cal_VehicleInfomationTable.WhlSpdSensUnitPulseDist ZDrive_BSW_Cal_Cal.ZDrive_BSW_Cal_VehicleInfomationTable.WheelSpeedCounterMax ZDrive_BSW_Cal_Cal.ZDrive_BSW_Cal_VehicleInfomationTable.WheelSpeedCounterPulse ZDrive_BSW_Cal_Cal.ZDrive_BSW_Cal_VehicleInfomationTable.WheelSpeedCounterIsUnsigned ZDrive_BSW_Cal_Cal.ZDrive_BSW_Cal_VehicleInfomationTable.WheelSpeedCounterMin ZDrive_BSW_Cal_Cal.ZDrive_BSW_Cal_VehicleInfomationTable.Vehicle_Information_Reserved_Line81 ZDrive_BSW_Cal_Cal.ZDrive_BSW_Cal_VehicleInfomationTable.Vehicle_Information_Reserved_Line82 ZDrive_BSW_Cal_Cal.ZDrive_BSW_Cal_VehicleInfomationTable.CharSpd_mps ZDrive_BSW_Cal_Cal.ZDrive_BSW_Cal_VehicleInfomationTable.SideSlipAnglefactor ZDrive_BSW_Cal_Cal.ZDrive_BSW_Cal_VehicleInfomationTable.MaxSteeringAngle ZDrive_BSW_Cal_Cal.ZDrive_BSW_Cal_VehicleInfomationTable.SteeringAngleRatio ZDrive_BSW_Cal_Cal.ZDrive_BSW_Cal_VehicleInfomationTable.RearAxlecCenterTurningCircle ZDrive_BSW_Cal_Cal.ZDrive_BSW_Cal_VehicleInfomationTable.StrWhlMappingTable ZDrive_BSW_Cal_Cal.ZDrive_BSW_Cal_VehicleInfomationTable.FRollingRadius_m ZDrive_BSW_Cal_Cal.ZDrive_BSW_Cal_VehicleInfomationTable.RRollingRadius_m ZDrive_BSW_Cal_Cal.ZDrive_BSW_Cal_VehicleInfomationTable.PowerTransRatio ZDrive_BSW_Cal_Cal.ZDrive_BSW_Cal_VehicleInfomationTable.TAC_Camera_Height ZDrive_BSW_Cal_Cal.ZDrive_BSW_Cal_VehicleInfomationTable.IEnvironment_CamToFrontAxle ZDrive_BSW_Cal_Cal.ZDrive_BSW_Cal_VehicleInfomationTable.FCFocus2FrAxleDist_Y_m ZDrive_BSW_Cal_Cal.ZDrive_BSW_Cal_VehicleInfomationTable.FCFocus2FrAxleDist_Z_m ZDrive_BSW_Cal_Cal.ZDrive_BSW_Cal_VehicleInfomationTable.FC2RearAxisX_m ZDrive_BSW_Cal_Cal.ZDrive_BSW_Cal_VehicleInfomationTable.FC2RearAxisY_m ZDrive_BSW_Cal_Cal.ZDrive_BSW_Cal_VehicleInfomationTable.CamDistToRearAxleCenter_DZ ZDrive_BSW_Cal_Cal.ZDrive_BSW_Cal_VehicleInfomationTable.FCFirstViewPointDist_m ZDrive_BSW_Cal_Cal.ZDrive_BSW_Cal_VehicleInfomationTable.IEnvironment_RefPX_Front_Bumper ZDrive_BSW_Cal_Cal.ZDrive_BSW_Cal_VehicleInfomationTable.TAC_Bottom ZDrive_BSW_Cal_Cal.ZDrive_BSW_Cal_VehicleInfomationTable.Vehicle_Information_Reserved_Line102 ZDrive_BSW_Cal_Cal.ZDrive_BSW_Cal_VehicleInfomationTable.IEnviroment_Top_Crop ZDrive_BSW_Cal_Cal.ZDrive_BSW_Cal_VehicleInfomationTable.IEnviroment_Bottom_Crop ZDrive_BSW_Cal_Cal.ZDrive_BSW_Cal_VehicleInfomationTable.Vehicle_Information_Reserved_Line105 ZDrive_BSW_Cal_Cal.ZDrive_BSW_Cal_VehicleInfomationTable.FC2LeftWheel_m ZDrive_BSW_Cal_Cal.ZDrive_BSW_Cal_VehicleInfomationTable.FC2RightWheel_m ZDrive_BSW_Cal_Cal.ZDrive_BSW_Cal_VehicleInfomationTable.TAC_Targets_Num ZDrive_BSW_Cal_Cal.ZDrive_BSW_Cal_VehicleInfomationTable.Vehicle_Information_Reserved_Line109 ZDrive_BSW_Cal_Cal.ZDrive_BSW_Cal_VehicleInfomationTable.Vehicle_Information_Reserved_Line110 ZDrive_BSW_Cal_Cal.ZDrive_BSW_Cal_VehicleInfomationTable.camera_x_m ZDrive_BSW_Cal_Cal.ZDrive_BSW_Cal_VehicleInfomationTable.camera_y_m ZDrive_BSW_Cal_Cal.ZDrive_BSW_Cal_VehicleInfomationTable.camera_z_m ZDrive_BSW_Cal_Cal.ZDrive_BSW_Cal_VehicleInfomationTable.translation_x_m ZDrive_BSW_Cal_Cal.ZDrive_BSW_Cal_VehicleInfomationTable.Vehicle_Information_Reserved_Line115 ZDrive_BSW_Cal_Cal.ZDrive_BSW_Cal_VehicleInfomationTable.RollingAngOfCAD ZDrive_BSW_Cal_Cal.ZDrive_BSW_Cal_VehicleInfomationTable.PitchAngOfCAD ZDrive_BSW_Cal_Cal.ZDrive_BSW_Cal_VehicleInfomationTable.YawAngOfCAD ZDrive_BSW_Cal_Cal.ZDrive_BSW_Cal_VehicleInfomationTable.FrontShortCamera_Dx ZDrive_BSW_Cal_Cal.ZDrive_BSW_Cal_VehicleInfomationTable.FrontShortCamera_Dy ZDrive_BSW_Cal_Cal.ZDrive_BSW_Cal_VehicleInfomationTable.FrontShortCamera_Dz ZDrive_BSW_Cal_Cal.ZDrive_BSW_Cal_VehicleInfomationTable.Vehicle_Information_Reserved_Line122 ZDrive_BSW_Cal_Cal.ZDrive_BSW_Cal_VehicleInfomationTable.FrontShortCamera_Roll ZDrive_BSW_Cal_Cal.ZDrive_BSW_Cal_VehicleInfomationTable.FrontShortCamera_Pitch ZDrive_BSW_Cal_Cal.ZDrive_BSW_Cal_VehicleInfomationTable.FrontShortCamera_Yaw ZDrive_BSW_Cal_Cal.ZDrive_BSW_Cal_VehicleInfomationTable.FrSCBlindSpotLength_m ZDrive_BSW_Cal_Cal.ZDrive_BSW_Cal_VehicleInfomationTable.FrSCDist2OuterMostSide_m ZDrive_BSW_Cal_Cal.ZDrive_BSW_Cal_VehicleInfomationTable.LeftShortCamera_Dx ZDrive_BSW_Cal_Cal.ZDrive_BSW_Cal_VehicleInfomationTable.LeftShortCamera_Dy ZDrive_BSW_Cal_Cal.ZDrive_BSW_Cal_VehicleInfomationTable.LeftShortCamera_Dz ZDrive_BSW_Cal_Cal.ZDrive_BSW_Cal_VehicleInfomationTable.Vehicle_Information_Reserved_Line131 ZDrive_BSW_Cal_Cal.ZDrive_BSW_Cal_VehicleInfomationTable.LeftShortCamera_Roll ZDrive_BSW_Cal_Cal.ZDrive_BSW_Cal_VehicleInfomationTable.LeftShortCamera_Pitch ZDrive_BSW_Cal_Cal.ZDrive_BSW_Cal_VehicleInfomationTable.LeftShortCamera_Yaw ZDrive_BSW_Cal_Cal.ZDrive_BSW_Cal_VehicleInfomationTable.LeSCBlindSpotLength_m ZDrive_BSW_Cal_Cal.ZDrive_BSW_Cal_VehicleInfomationTable.LeSCVerticalDist2Body_m ZDrive_BSW_Cal_Cal.ZDrive_BSW_Cal_VehicleInfomationTable.RearShortCamera_Dx ZDrive_BSW_Cal_Cal.ZDrive_BSW_Cal_VehicleInfomationTable.RearShortCamera_Dy ZDrive_BSW_Cal_Cal.ZDrive_BSW_Cal_VehicleInfomationTable.RearShortCamera_Dz ZDrive_BSW_Cal_Cal.ZDrive_BSW_Cal_VehicleInfomationTable.Vehicle_Information_Reserved_Line140 ZDrive_BSW_Cal_Cal.ZDrive_BSW_Cal_VehicleInfomationTable.RearShortCamera_Roll ZDrive_BSW_Cal_Cal.ZDrive_BSW_Cal_VehicleInfomationTable.RearShortCamera_Pitch ZDrive_BSW_Cal_Cal.ZDrive_BSW_Cal_VehicleInfomationTable.RearShortCamera_Yaw ZDrive_BSW_Cal_Cal.ZDrive_BSW_Cal_VehicleInfomationTable.ReSCBlindSpotLength_m ZDrive_BSW_Cal_Cal.ZDrive_BSW_Cal_VehicleInfomationTable.ReSCDist2OuterMostSide_m ZDrive_BSW_Cal_Cal.ZDrive_BSW_Cal_VehicleInfomationTable.RightShortCamera_Dx ZDrive_BSW_Cal_Cal.ZDrive_BSW_Cal_VehicleInfomationTable.RightShortCamera_Dy ZDrive_BSW_Cal_Cal.ZDrive_BSW_Cal_VehicleInfomationTable.RightShortCamera_Dz ZDrive_BSW_Cal_Cal.ZDrive_BSW_Cal_VehicleInfomationTable.Vehicle_Information_Reserved_Line149 ZDrive_BSW_Cal_Cal.ZDrive_BSW_Cal_VehicleInfomationTable.RightShortCamera_Roll ZDrive_BSW_Cal_Cal.ZDrive_BSW_Cal_VehicleInfomationTable.RightShortCamera_Pitch ZDrive_BSW_Cal_Cal.ZDrive_BSW_Cal_VehicleInfomationTable.RightShortCamera_Yaw ZDrive_BSW_Cal_Cal.ZDrive_BSW_Cal_VehicleInfomationTable.RiSCBlindSpotLength_m ZDrive_BSW_Cal_Cal.ZDrive_BSW_Cal_VehicleInfomationTable.RiSCVerticalDist2Body_m ZDrive_BSW_Cal_Cal.ZDrive_BSW_Cal_VehicleInfomationTable.FrntLeSideUss_Dx ZDrive_BSW_Cal_Cal.ZDrive_BSW_Cal_VehicleInfomationTable.FrntLeSideUss_Dy ZDrive_BSW_Cal_Cal.ZDrive_BSW_Cal_VehicleInfomationTable.FrntLeSideUss_Dz ZDrive_BSW_Cal_Cal.ZDrive_BSW_Cal_VehicleInfomationTable.Vehicle_Information_Reserved_Line158 ZDrive_BSW_Cal_Cal.ZDrive_BSW_Cal_VehicleInfomationTable.FrntLeSideUss_Roll ZDrive_BSW_Cal_Cal.ZDrive_BSW_Cal_VehicleInfomationTable.FrntLeSideUss_Pitch ZDrive_BSW_Cal_Cal.ZDrive_BSW_Cal_VehicleInfomationTable.FrntLeSideUss_Yaw ZDrive_BSW_Cal_Cal.ZDrive_BSW_Cal_VehicleInfomationTable.FrntLeCrnrUss_Dx ZDrive_BSW_Cal_Cal.ZDrive_BSW_Cal_VehicleInfomationTable.FrntLeCrnrUss_Dy ZDrive_BSW_Cal_Cal.ZDrive_BSW_Cal_VehicleInfomationTable.FrntLeCrnrUss_Dz ZDrive_BSW_Cal_Cal.ZDrive_BSW_Cal_VehicleInfomationTable.Vehicle_Information_Reserved_Line165 ZDrive_BSW_Cal_Cal.ZDrive_BSW_Cal_VehicleInfomationTable.FrntLeCrnrUss_Roll ZDrive_BSW_Cal_Cal.ZDrive_BSW_Cal_VehicleInfomationTable.FrntLeCrnrUss_Pitch ZDrive_BSW_Cal_Cal.ZDrive_BSW_Cal_VehicleInfomationTable.FrntLeCrnrUss_Yaw ZDrive_BSW_Cal_Cal.ZDrive_BSW_Cal_VehicleInfomationTable.FrntLeMidUss_Dx ZDrive_BSW_Cal_Cal.ZDrive_BSW_Cal_VehicleInfomationTable.FrntLeMidUss_Dy ZDrive_BSW_Cal_Cal.ZDrive_BSW_Cal_VehicleInfomationTable.FrntLeMidUss_Dz ZDrive_BSW_Cal_Cal.ZDrive_BSW_Cal_VehicleInfomationTable.Vehicle_Information_Reserved_Line172 ZDrive_BSW_Cal_Cal.ZDrive_BSW_Cal_VehicleInfomationTable.FrntLeMidUss_Roll ZDrive_BSW_Cal_Cal.ZDrive_BSW_Cal_VehicleInfomationTable.FrntLeMidUss_Pitch ZDrive_BSW_Cal_Cal.ZDrive_BSW_Cal_VehicleInfomationTable.FrntLeMidUss_Yaw ZDrive_BSW_Cal_Cal.ZDrive_BSW_Cal_VehicleInfomationTable.FrntRiMidUss_Dx ZDrive_BSW_Cal_Cal.ZDrive_BSW_Cal_VehicleInfomationTable.FrntRiMidUss_Dy ZDrive_BSW_Cal_Cal.ZDrive_BSW_Cal_VehicleInfomationTable.FrntRiMidUss_Dz ZDrive_BSW_Cal_Cal.ZDrive_BSW_Cal_VehicleInfomationTable.Vehicle_Information_Reserved_Line179 ZDrive_BSW_Cal_Cal.ZDrive_BSW_Cal_VehicleInfomationTable.FrntRiMidUss_Roll ZDrive_BSW_Cal_Cal.ZDrive_BSW_Cal_VehicleInfomationTable.FrntRiMidUss_Pitch ZDrive_BSW_Cal_Cal.ZDrive_BSW_Cal_VehicleInfomationTable.FrntRiMidUss_Yaw ZDrive_BSW_Cal_Cal.ZDrive_BSW_Cal_VehicleInfomationTable.FrntRiCrnrUss_Dx ZDrive_BSW_Cal_Cal.ZDrive_BSW_Cal_VehicleInfomationTable.FrntRiCrnrUss_Dy ZDrive_BSW_Cal_Cal.ZDrive_BSW_Cal_VehicleInfomationTable.FrntRiCrnrUss_Dz ZDrive_BSW_Cal_Cal.ZDrive_BSW_Cal_VehicleInfomationTable.Vehicle_Information_Reserved_Line186 ZDrive_BSW_Cal_Cal.ZDrive_BSW_Cal_VehicleInfomationTable.FrntRiCrnrUss_Roll ZDrive_BSW_Cal_Cal.ZDrive_BSW_Cal_VehicleInfomationTable.FrntRiCrnrUss_Pitch ZDrive_BSW_Cal_Cal.ZDrive_BSW_Cal_VehicleInfomationTable.FrntRiCrnrUss_Yaw ZDrive_BSW_Cal_Cal.ZDrive_BSW_Cal_VehicleInfomationTable.FrntRiSideUss_Dx ZDrive_BSW_Cal_Cal.ZDrive_BSW_Cal_VehicleInfomationTable.FrntRiSideUss_Dy ZDrive_BSW_Cal_Cal.ZDrive_BSW_Cal_VehicleInfomationTable.FrntRiSideUss_Dz ZDrive_BSW_Cal_Cal.ZDrive_BSW_Cal_VehicleInfomationTable.Vehicle_Information_Reserved_Line193 ZDrive_BSW_Cal_Cal.ZDrive_BSW_Cal_VehicleInfomationTable.FrntRiSideUss_Roll ZDrive_BSW_Cal_Cal.ZDrive_BSW_Cal_VehicleInfomationTable.FrntRiSideUss_Pitch ZDrive_BSW_Cal_Cal.ZDrive_BSW_Cal_VehicleInfomationTable.FrntRiSideUss_Yaw ZDrive_BSW_Cal_Cal.ZDrive_BSW_Cal_VehicleInfomationTable.ReRiSideUss_Dx ZDrive_BSW_Cal_Cal.ZDrive_BSW_Cal_VehicleInfomationTable.ReRiSideUss_Dy ZDrive_BSW_Cal_Cal.ZDrive_BSW_Cal_VehicleInfomationTable.ReRiSideUss_Dz ZDrive_BSW_Cal_Cal.ZDrive_BSW_Cal_VehicleInfomationTable.Vehicle_Information_Reserved_Line200 ZDrive_BSW_Cal_Cal.ZDrive_BSW_Cal_VehicleInfomationTable.ReRiSideUss_Roll ZDrive_BSW_Cal_Cal.ZDrive_BSW_Cal_VehicleInfomationTable.ReRiSideUss_Pitch ZDrive_BSW_Cal_Cal.ZDrive_BSW_Cal_VehicleInfomationTable.ReRiSideUss_Yaw ZDrive_BSW_Cal_Cal.ZDrive_BSW_Cal_VehicleInfomationTable.ReRiCrnrUss_Dx ZDrive_BSW_Cal_Cal.ZDrive_BSW_Cal_VehicleInfomationTable.ReRiCrnrUss_Dy ZDrive_BSW_Cal_Cal.ZDrive_BSW_Cal_VehicleInfomationTable.ReRiCrnrUss_Dz ZDrive_BSW_Cal_Cal.ZDrive_BSW_Cal_VehicleInfomationTable.Vehicle_Information_Reserved_Line207 ZDrive_BSW_Cal_Cal.ZDrive_BSW_Cal_VehicleInfomationTable.ReRiCrnrUss_Roll ZDrive_BSW_Cal_Cal.ZDrive_BSW_Cal_VehicleInfomationTable.ReRiCrnrUss_Pitch ZDrive_BSW_Cal_Cal.ZDrive_BSW_Cal_VehicleInfomationTable.ReRiCrnrUss_Yaw ZDrive_BSW_Cal_Cal.ZDrive_BSW_Cal_VehicleInfomationTable.ReRiMidUss_Dx ZDrive_BSW_Cal_Cal.ZDrive_BSW_Cal_VehicleInfomationTable.ReRiMidUss_Dy ZDrive_BSW_Cal_Cal.ZDrive_BSW_Cal_VehicleInfomationTable.ReRiMidUss_Dz ZDrive_BSW_Cal_Cal.ZDrive_BSW_Cal_VehicleInfomationTable.Vehicle_Information_Reserved_Line214 ZDrive_BSW_Cal_Cal.ZDrive_BSW_Cal_VehicleInfomationTable.ReRiMidUss_Roll ZDrive_BSW_Cal_Cal.ZDrive_BSW_Cal_VehicleInfomationTable.ReRiMidUss_Pitch ZDrive_BSW_Cal_Cal.ZDrive_BSW_Cal_VehicleInfomationTable.ReRiMidUss_Yaw ZDrive_BSW_Cal_Cal.ZDrive_BSW_Cal_VehicleInfomationTable.ReLeMidUss_Dx ZDrive_BSW_Cal_Cal.ZDrive_BSW_Cal_VehicleInfomationTable.ReLeMidUss_Dy ZDrive_BSW_Cal_Cal.ZDrive_BSW_Cal_VehicleInfomationTable.ReLeMidUss_Dz ZDrive_BSW_Cal_Cal.ZDrive_BSW_Cal_VehicleInfomationTable.Vehicle_Information_Reserved_Line221 ZDrive_BSW_Cal_Cal.ZDrive_BSW_Cal_VehicleInfomationTable.ReLeMidUss_Roll ZDrive_BSW_Cal_Cal.ZDrive_BSW_Cal_VehicleInfomationTable.ReLeMidUss_Pitch ZDrive_BSW_Cal_Cal.ZDrive_BSW_Cal_VehicleInfomationTable.ReLeMidUss_Yaw ZDrive_BSW_Cal_Cal.ZDrive_BSW_Cal_VehicleInfomationTable.ReLeCrnrUss_Dx ZDrive_BSW_Cal_Cal.ZDrive_BSW_Cal_VehicleInfomationTable.ReLeCrnrUss_Dy ZDrive_BSW_Cal_Cal.ZDrive_BSW_Cal_VehicleInfomationTable.ReLeCrnrUss_Dz ZDrive_BSW_Cal_Cal.ZDrive_BSW_Cal_VehicleInfomationTable.Vehicle_Information_Reserved_Line228 ZDrive_BSW_Cal_Cal.ZDrive_BSW_Cal_VehicleInfomationTable.ReLeCrnrUss_Roll ZDrive_BSW_Cal_Cal.ZDrive_BSW_Cal_VehicleInfomationTable.ReLeCrnrUss_Pitch ZDrive_BSW_Cal_Cal.ZDrive_BSW_Cal_VehicleInfomationTable.ReLeCrnrUss_Yaw ZDrive_BSW_Cal_Cal.ZDrive_BSW_Cal_VehicleInfomationTable.ReLeSideUss_Dx ZDrive_BSW_Cal_Cal.ZDrive_BSW_Cal_VehicleInfomationTable.ReLeSideUss_Dy ZDrive_BSW_Cal_Cal.ZDrive_BSW_Cal_VehicleInfomationTable.ReLeSideUss_Dz ZDrive_BSW_Cal_Cal.ZDrive_BSW_Cal_VehicleInfomationTable.Vehicle_Information_Reserved_Line235 ZDrive_BSW_Cal_Cal.ZDrive_BSW_Cal_VehicleInfomationTable.ReLeSideUss_Roll ZDrive_BSW_Cal_Cal.ZDrive_BSW_Cal_VehicleInfomationTable.ReLeSideUss_Pitch ZDrive_BSW_Cal_Cal.ZDrive_BSW_Cal_VehicleInfomationTable.ReLeSideUss_Yaw ZDrive_BSW_Cal_Cal.ZDrive_BSW_Cal_VehicleInfomationTable.UltraInstallAng_FM ZDrive_BSW_Cal_Cal.ZDrive_BSW_Cal_VehicleInfomationTable.UltraInstallAng_FA ZDrive_BSW_Cal_Cal.ZDrive_BSW_Cal_VehicleInfomationTable.UltraInstallAng_FS ZDrive_BSW_Cal_Cal.ZDrive_BSW_Cal_VehicleInfomationTable.UltraInstallLatOffset_FM_m ZDrive_BSW_Cal_Cal.ZDrive_BSW_Cal_VehicleInfomationTable.UltraInstallLatOffset_FA_m ZDrive_BSW_Cal_Cal.ZDrive_BSW_Cal_VehicleInfomationTable.UltraInstallLatOffset_FS_m ZDrive_BSW_Cal_Cal.ZDrive_BSW_Cal_VehicleInfomationTable.Vehicle_Information_Reserved_Line245 ZDrive_BSW_Cal_Cal.ZDrive_BSW_Cal_VehicleInfomationTable.UltraInstallAng_RM ZDrive_BSW_Cal_Cal.ZDrive_BSW_Cal_VehicleInfomationTable.UltraInstallAng_RA ZDrive_BSW_Cal_Cal.ZDrive_BSW_Cal_VehicleInfomationTable.UltraInstallAng_RS ZDrive_BSW_Cal_Cal.ZDrive_BSW_Cal_VehicleInfomationTable.UltraInstallLatOffset_RM_m ZDrive_BSW_Cal_Cal.ZDrive_BSW_Cal_VehicleInfomationTable.UltraInstallLatOffset_RA_m ZDrive_BSW_Cal_Cal.ZDrive_BSW_Cal_VehicleInfomationTable.UltraInstallLatOffset_RS_m ZDrive_BSW_Cal_Cal.ZDrive_BSW_Cal_VehicleInfomationTable.UltraInstallHeight_FM_m ZDrive_BSW_Cal_Cal.ZDrive_BSW_Cal_VehicleInfomationTable.UltraInstallHeight_FA_m ZDrive_BSW_Cal_Cal.ZDrive_BSW_Cal_VehicleInfomationTable.UltraInstallHeight_FS_m ZDrive_BSW_Cal_Cal.ZDrive_BSW_Cal_VehicleInfomationTable.UltraInstallHeight_RM_m ZDrive_BSW_Cal_Cal.ZDrive_BSW_Cal_VehicleInfomationTable.UltraInstallHeight_RA_m ZDrive_BSW_Cal_Cal.ZDrive_BSW_Cal_VehicleInfomationTable.UltraInstallHeight_RS_m ZDrive_BSW_Cal_Cal.ZDrive_BSW_Cal_VehicleInfomationTable.Vehicle_Information_Reserved_Line258 ZDrive_BSW_Cal_Cal.ZDrive_BSW_Cal_VehicleInfomationTable.VISION_MOUNT_PARAM_FRONT_X_POSITION ZDrive_BSW_Cal_Cal.ZDrive_BSW_Cal_VehicleInfomationTable.VISION_MOUNT_PARAM_FRONT_Y_POSITION ZDrive_BSW_Cal_Cal.ZDrive_BSW_Cal_VehicleInfomationTable.VISION_MOUNT_PARAM_FRONT_YAW_ANGLE /end REF_CHARACTERISTIC
/end GROUP
/begin RECORD_LAYOUT Record_FLOAT32_IEEE FNC_VALUES 1 FLOAT32_IEEE COLUMN_DIR DIRECT /end RECORD_LAYOUT
/begin RECORD_LAYOUT Record_SBYTE FNC_VALUES 1 SBYTE COLUMN_DIR DIRECT /end RECORD_LAYOUT
/begin RECORD_LAYOUT Record_SWORD FNC_VALUES 1 SWORD COLUMN_DIR DIRECT /end RECORD_LAYOUT
/begin RECORD_LAYOUT Record_UBYTE FNC_VALUES 1 UBYTE COLUMN_DIR DIRECT /end RECORD_LAYOUT
/begin RECORD_LAYOUT Record_ULONG FNC_VALUES 1 ULONG COLUMN_DIR DIRECT /end RECORD_LAYOUT
/begin RECORD_LAYOUT Record_UWORD FNC_VALUES 1 UWORD COLUMN_DIR DIRECT /end RECORD_LAYOUT
/begin GROUP ZDrive_BSW_Cal_Cal.ZDrive_BSW_Cal_VehicleInfomationTable ""
 /begin REF_CHARACTERISTIC ZDrive_BSW_Cal_Cal.ZDrive_BSW_Cal_VehicleInfomationTable.ParkingBrakeType ZDrive_BSW_Cal_Cal.ZDrive_BSW_Cal_VehicleInfomationTable.StrWhlConfig ZDrive_BSW_Cal_Cal.ZDrive_BSW_Cal_VehicleInfomationTable.ParkingLongControlInterForm ZDrive_BSW_Cal_Cal.ZDrive_BSW_Cal_VehicleInfomationTable.Driving_Type ZDrive_BSW_Cal_Cal.ZDrive_BSW_Cal_VehicleInfomationTable.Left_Right_handType ZDrive_BSW_Cal_Cal.ZDrive_BSW_Cal_VehicleInfomationTable.AutoHold_Type ZDrive_BSW_Cal_Cal.ZDrive_BSW_Cal_VehicleInfomationTable.AccSens_LatAccSigDirect ZDrive_BSW_Cal_Cal.ZDrive_BSW_Cal_VehicleInfomationTable.AccSens_LonAccSigDirect ZDrive_BSW_Cal_Cal.ZDrive_BSW_Cal_VehicleInfomationTable.StrWhlAngSigDirect ZDrive_BSW_Cal_Cal.ZDrive_BSW_Cal_VehicleInfomationTable.DriHandTorqueDirect ZDrive_BSW_Cal_Cal.ZDrive_BSW_Cal_VehicleInfomationTable.Vehicle_Information_Reserved_Line24 ZDrive_BSW_Cal_Cal.ZDrive_BSW_Cal_VehicleInfomationTable.Vehicle_Information_Reserved_Line25 ZDrive_BSW_Cal_Cal.ZDrive_BSW_Cal_VehicleInfomationTable.Vehicle_Information_Reserved_Line26 ZDrive_BSW_Cal_Cal.ZDrive_BSW_Cal_VehicleInfomationTable.ValFunc_Reserve1 ZDrive_BSW_Cal_Cal.ZDrive_BSW_Cal_VehicleInfomationTable.ValFunc_Reserve2 ZDrive_BSW_Cal_Cal.ZDrive_BSW_Cal_VehicleInfomationTable.ASU_Type ZDrive_BSW_Cal_Cal.ZDrive_BSW_Cal_VehicleInfomationTable.Suspension ZDrive_BSW_Cal_Cal.ZDrive_BSW_Cal_VehicleInfomationTable.Vehicle_Information_Reserved_Line31 ZDrive_BSW_Cal_Cal.ZDrive_BSW_Cal_VehicleInfomationTable.Vehicle_Information_Reserved_Line32 ZDrive_BSW_Cal_Cal.ZDrive_BSW_Cal_VehicleInfomationTable.Vehicle_Information_Reserved_Line33 ZDrive_BSW_Cal_Cal.ZDrive_BSW_Cal_VehicleInfomationTable.Vehicle_Information_Reserved_Line34 ZDrive_BSW_Cal_Cal.ZDrive_BSW_Cal_VehicleInfomationTable.Vehicle_Information_Reserved_Line35 ZDrive_BSW_Cal_Cal.ZDrive_BSW_Cal_VehicleInfomationTable.Vehicle_Information_Reserved_Line36 ZDrive_BSW_Cal_Cal.ZDrive_BSW_Cal_VehicleInfomationTable.Vehicle_Information_Reserved_Line37 ZDrive_BSW_Cal_Cal.ZDrive_BSW_Cal_VehicleInfomationTable.Vehicle_Length_m ZDrive_BSW_Cal_Cal.ZDrive_BSW_Cal_VehicleInfomationTable.VehicleWidthMax_m ZDrive_BSW_Cal_Cal.ZDrive_BSW_Cal_VehicleInfomationTable.VehicleWidthMin_m ZDrive_BSW_Cal_Cal.ZDrive_BSW_Cal_VehicleInfomationTable.Height_m ZDrive_BSW_Cal_Cal.ZDrive_BSW_Cal_VehicleInfomationTable.EngineMaxiTorque_N ZDrive_BSW_Cal_Cal.ZDrive_BSW_Cal_VehicleInfomationTable.WheelBase_m ZDrive_BSW_Cal_Cal.ZDrive_BSW_Cal_VehicleInfomationTable.FrontAxleToRearAxLeCenterX_m ZDrive_BSW_Cal_Cal.ZDrive_BSW_Cal_VehicleInfomationTable.WheelTrack_m ZDrive_BSW_Cal_Cal.ZDrive_BSW_Cal_VehicleInfomationTable.FrWhlTrack_m ZDrive_BSW_Cal_Cal.ZDrive_BSW_Cal_VehicleInfomationTable.ReWhlTrack_m ZDrive_BSW_Cal_Cal.ZDrive_BSW_Cal_VehicleInfomationTable.FrontOverhang_Length_m ZDrive_BSW_Cal_Cal.ZDrive_BSW_Cal_VehicleInfomationTable.RearOverhang_Length_m ZDrive_BSW_Cal_Cal.ZDrive_BSW_Cal_VehicleInfomationTable.FrWhlHousingHeight_m ZDrive_BSW_Cal_Cal.ZDrive_BSW_Cal_VehicleInfomationTable.ReWhlHousingHeight_m ZDrive_BSW_Cal_Cal.ZDrive_BSW_Cal_VehicleInfomationTable.DxvRearBumper_m ZDrive_BSW_Cal_Cal.ZDrive_BSW_Cal_VehicleInfomationTable.DxvFrontBumper_m ZDrive_BSW_Cal_Cal.ZDrive_BSW_Cal_VehicleInfomationTable.FrontAxleToCenter_m ZDrive_BSW_Cal_Cal.ZDrive_BSW_Cal_VehicleInfomationTable.RearAxleToCenter_m ZDrive_BSW_Cal_Cal.ZDrive_BSW_Cal_VehicleInfomationTable.RearViewMirrorLength_On_Y ZDrive_BSW_Cal_Cal.ZDrive_BSW_Cal_VehicleInfomationTable.RearViewMirrorLength_On_X ZDrive_BSW_Cal_Cal.ZDrive_BSW_Cal_VehicleInfomationTable.RearViewMirrorTopSide_Height ZDrive_BSW_Cal_Cal.ZDrive_BSW_Cal_VehicleInfomationTable.RearViewMirrorBottomSide_Height ZDrive_BSW_Cal_Cal.ZDrive_BSW_Cal_VehicleInfomationTable.RearViewMirrorOutsidePointToRearAxle_Diatance_m ZDrive_BSW_Cal_Cal.ZDrive_BSW_Cal_VehicleInfomationTable.FrontLeftFrontPointToRearAxleCenter_Distance_m ZDrive_BSW_Cal_Cal.ZDrive_BSW_Cal_VehicleInfomationTable.FrontLeftFrontPointToCenterLine_Distance_m ZDrive_BSW_Cal_Cal.ZDrive_BSW_Cal_VehicleInfomationTable.FrontLeftOutsidePointToRearAxleCenter_Distance_m ZDrive_BSW_Cal_Cal.ZDrive_BSW_Cal_VehicleInfomationTable.FrontLeftOutsidePointToCenterLine_Distance_m ZDrive_BSW_Cal_Cal.ZDrive_BSW_Cal_VehicleInfomationTable.RearLeftOutsidePointToRearAxleCenter_Distance_m ZDrive_BSW_Cal_Cal.ZDrive_BSW_Cal_VehicleInfomationTable.RearLeftOutsidePointToCenterLine_Distance_m ZDrive_BSW_Cal_Cal.ZDrive_BSW_Cal_VehicleInfomationTable.RearLeftRearPointToRearAxleCenter_Distance_m ZDrive_BSW_Cal_Cal.ZDrive_BSW_Cal_VehicleInfomationTable.RearLeftRearPointToCenterLine_Distance_m ZDrive_BSW_Cal_Cal.ZDrive_BSW_Cal_VehicleInfomationTable.CURB_kg ZDrive_BSW_Cal_Cal.ZDrive_BSW_Cal_VehicleInfomationTable.Weight_N ZDrive_BSW_Cal_Cal.ZDrive_BSW_Cal_VehicleInfomationTable.GVW_kg ZDrive_BSW_Cal_Cal.ZDrive_BSW_Cal_VehicleInfomationTable.Empty_mass_kg ZDrive_BSW_Cal_Cal.ZDrive_BSW_Cal_VehicleInfomationTable.TireRadius_m ZDrive_BSW_Cal_Cal.ZDrive_BSW_Cal_VehicleInfomationTable.IEnvironment_WheelWidth ZDrive_BSW_Cal_Cal.ZDrive_BSW_Cal_VehicleInfomationTable.WheelDiameter ZDrive_BSW_Cal_Cal.ZDrive_BSW_Cal_VehicleInfomationTable.WhlSpdSensUnitPulseDist ZDrive_BSW_Cal_Cal.ZDrive_BSW_Cal_VehicleInfomationTable.WheelSpeedCounterMax ZDrive_BSW_Cal_Cal.ZDrive_BSW_Cal_VehicleInfomationTable.WheelSpeedCounterPulse ZDrive_BSW_Cal_Cal.ZDrive_BSW_Cal_VehicleInfomationTable.WheelSpeedCounterIsUnsigned ZDrive_BSW_Cal_Cal.ZDrive_BSW_Cal_VehicleInfomationTable.WheelSpeedCounterMin ZDrive_BSW_Cal_Cal.ZDrive_BSW_Cal_VehicleInfomationTable.Vehicle_Information_Reserved_Line81 ZDrive_BSW_Cal_Cal.ZDrive_BSW_Cal_VehicleInfomationTable.Vehicle_Information_Reserved_Line82 ZDrive_BSW_Cal_Cal.ZDrive_BSW_Cal_VehicleInfomationTable.CharSpd_mps ZDrive_BSW_Cal_Cal.ZDrive_BSW_Cal_VehicleInfomationTable.SideSlipAnglefactor ZDrive_BSW_Cal_Cal.ZDrive_BSW_Cal_VehicleInfomationTable.MaxSteeringAngle ZDrive_BSW_Cal_Cal.ZDrive_BSW_Cal_VehicleInfomationTable.SteeringAngleRatio ZDrive_BSW_Cal_Cal.ZDrive_BSW_Cal_VehicleInfomationTable.RearAxlecCenterTurningCircle ZDrive_BSW_Cal_Cal.ZDrive_BSW_Cal_VehicleInfomationTable.StrWhlMappingTable ZDrive_BSW_Cal_Cal.ZDrive_BSW_Cal_VehicleInfomationTable.FRollingRadius_m ZDrive_BSW_Cal_Cal.ZDrive_BSW_Cal_VehicleInfomationTable.RRollingRadius_m ZDrive_BSW_Cal_Cal.ZDrive_BSW_Cal_VehicleInfomationTable.PowerTransRatio ZDrive_BSW_Cal_Cal.ZDrive_BSW_Cal_VehicleInfomationTable.TAC_Camera_Height ZDrive_BSW_Cal_Cal.ZDrive_BSW_Cal_VehicleInfomationTable.IEnvironment_CamToFrontAxle ZDrive_BSW_Cal_Cal.ZDrive_BSW_Cal_VehicleInfomationTable.FCFocus2FrAxleDist_Y_m ZDrive_BSW_Cal_Cal.ZDrive_BSW_Cal_VehicleInfomationTable.FCFocus2FrAxleDist_Z_m ZDrive_BSW_Cal_Cal.ZDrive_BSW_Cal_VehicleInfomationTable.FC2RearAxisX_m ZDrive_BSW_Cal_Cal.ZDrive_BSW_Cal_VehicleInfomationTable.FC2RearAxisY_m ZDrive_BSW_Cal_Cal.ZDrive_BSW_Cal_VehicleInfomationTable.CamDistToRearAxleCenter_DZ ZDrive_BSW_Cal_Cal.ZDrive_BSW_Cal_VehicleInfomationTable.FCFirstViewPointDist_m ZDrive_BSW_Cal_Cal.ZDrive_BSW_Cal_VehicleInfomationTable.IEnvironment_RefPX_Front_Bumper ZDrive_BSW_Cal_Cal.ZDrive_BSW_Cal_VehicleInfomationTable.TAC_Bottom ZDrive_BSW_Cal_Cal.ZDrive_BSW_Cal_VehicleInfomationTable.Vehicle_Information_Reserved_Line102 ZDrive_BSW_Cal_Cal.ZDrive_BSW_Cal_VehicleInfomationTable.IEnviroment_Top_Crop ZDrive_BSW_Cal_Cal.ZDrive_BSW_Cal_VehicleInfomationTable.IEnviroment_Bottom_Crop ZDrive_BSW_Cal_Cal.ZDrive_BSW_Cal_VehicleInfomationTable.Vehicle_Information_Reserved_Line105 ZDrive_BSW_Cal_Cal.ZDrive_BSW_Cal_VehicleInfomationTable.FC2LeftWheel_m ZDrive_BSW_Cal_Cal.ZDrive_BSW_Cal_VehicleInfomationTable.FC2RightWheel_m ZDrive_BSW_Cal_Cal.ZDrive_BSW_Cal_VehicleInfomationTable.TAC_Targets_Num ZDrive_BSW_Cal_Cal.ZDrive_BSW_Cal_VehicleInfomationTable.Vehicle_Information_Reserved_Line109 ZDrive_BSW_Cal_Cal.ZDrive_BSW_Cal_VehicleInfomationTable.Vehicle_Information_Reserved_Line110 ZDrive_BSW_Cal_Cal.ZDrive_BSW_Cal_VehicleInfomationTable.camera_x_m ZDrive_BSW_Cal_Cal.ZDrive_BSW_Cal_VehicleInfomationTable.camera_y_m ZDrive_BSW_Cal_Cal.ZDrive_BSW_Cal_VehicleInfomationTable.camera_z_m ZDrive_BSW_Cal_Cal.ZDrive_BSW_Cal_VehicleInfomationTable.translation_x_m ZDrive_BSW_Cal_Cal.ZDrive_BSW_Cal_VehicleInfomationTable.Vehicle_Information_Reserved_Line115 ZDrive_BSW_Cal_Cal.ZDrive_BSW_Cal_VehicleInfomationTable.RollingAngOfCAD ZDrive_BSW_Cal_Cal.ZDrive_BSW_Cal_VehicleInfomationTable.PitchAngOfCAD ZDrive_BSW_Cal_Cal.ZDrive_BSW_Cal_VehicleInfomationTable.YawAngOfCAD ZDrive_BSW_Cal_Cal.ZDrive_BSW_Cal_VehicleInfomationTable.FrontShortCamera_Dx ZDrive_BSW_Cal_Cal.ZDrive_BSW_Cal_VehicleInfomationTable.FrontShortCamera_Dy ZDrive_BSW_Cal_Cal.ZDrive_BSW_Cal_VehicleInfomationTable.FrontShortCamera_Dz ZDrive_BSW_Cal_Cal.ZDrive_BSW_Cal_VehicleInfomationTable.Vehicle_Information_Reserved_Line122 ZDrive_BSW_Cal_Cal.ZDrive_BSW_Cal_VehicleInfomationTable.FrontShortCamera_Roll ZDrive_BSW_Cal_Cal.ZDrive_BSW_Cal_VehicleInfomationTable.FrontShortCamera_Pitch ZDrive_BSW_Cal_Cal.ZDrive_BSW_Cal_VehicleInfomationTable.FrontShortCamera_Yaw ZDrive_BSW_Cal_Cal.ZDrive_BSW_Cal_VehicleInfomationTable.FrSCBlindSpotLength_m ZDrive_BSW_Cal_Cal.ZDrive_BSW_Cal_VehicleInfomationTable.FrSCDist2OuterMostSide_m ZDrive_BSW_Cal_Cal.ZDrive_BSW_Cal_VehicleInfomationTable.LeftShortCamera_Dx ZDrive_BSW_Cal_Cal.ZDrive_BSW_Cal_VehicleInfomationTable.LeftShortCamera_Dy ZDrive_BSW_Cal_Cal.ZDrive_BSW_Cal_VehicleInfomationTable.LeftShortCamera_Dz ZDrive_BSW_Cal_Cal.ZDrive_BSW_Cal_VehicleInfomationTable.Vehicle_Information_Reserved_Line131 ZDrive_BSW_Cal_Cal.ZDrive_BSW_Cal_VehicleInfomationTable.LeftShortCamera_Roll ZDrive_BSW_Cal_Cal.ZDrive_BSW_Cal_VehicleInfomationTable.LeftShortCamera_Pitch ZDrive_BSW_Cal_Cal.ZDrive_BSW_Cal_VehicleInfomationTable.LeftShortCamera_Yaw ZDrive_BSW_Cal_Cal.ZDrive_BSW_Cal_VehicleInfomationTable.LeSCBlindSpotLength_m ZDrive_BSW_Cal_Cal.ZDrive_BSW_Cal_VehicleInfomationTable.LeSCVerticalDist2Body_m ZDrive_BSW_Cal_Cal.ZDrive_BSW_Cal_VehicleInfomationTable.RearShortCamera_Dx ZDrive_BSW_Cal_Cal.ZDrive_BSW_Cal_VehicleInfomationTable.RearShortCamera_Dy ZDrive_BSW_Cal_Cal.ZDrive_BSW_Cal_VehicleInfomationTable.RearShortCamera_Dz ZDrive_BSW_Cal_Cal.ZDrive_BSW_Cal_VehicleInfomationTable.Vehicle_Information_Reserved_Line140 ZDrive_BSW_Cal_Cal.ZDrive_BSW_Cal_VehicleInfomationTable.RearShortCamera_Roll ZDrive_BSW_Cal_Cal.ZDrive_BSW_Cal_VehicleInfomationTable.RearShortCamera_Pitch ZDrive_BSW_Cal_Cal.ZDrive_BSW_Cal_VehicleInfomationTable.RearShortCamera_Yaw ZDrive_BSW_Cal_Cal.ZDrive_BSW_Cal_VehicleInfomationTable.ReSCBlindSpotLength_m ZDrive_BSW_Cal_Cal.ZDrive_BSW_Cal_VehicleInfomationTable.ReSCDist2OuterMostSide_m ZDrive_BSW_Cal_Cal.ZDrive_BSW_Cal_VehicleInfomationTable.RightShortCamera_Dx ZDrive_BSW_Cal_Cal.ZDrive_BSW_Cal_VehicleInfomationTable.RightShortCamera_Dy ZDrive_BSW_Cal_Cal.ZDrive_BSW_Cal_VehicleInfomationTable.RightShortCamera_Dz ZDrive_BSW_Cal_Cal.ZDrive_BSW_Cal_VehicleInfomationTable.Vehicle_Information_Reserved_Line149 ZDrive_BSW_Cal_Cal.ZDrive_BSW_Cal_VehicleInfomationTable.RightShortCamera_Roll ZDrive_BSW_Cal_Cal.ZDrive_BSW_Cal_VehicleInfomationTable.RightShortCamera_Pitch ZDrive_BSW_Cal_Cal.ZDrive_BSW_Cal_VehicleInfomationTable.RightShortCamera_Yaw ZDrive_BSW_Cal_Cal.ZDrive_BSW_Cal_VehicleInfomationTable.RiSCBlindSpotLength_m ZDrive_BSW_Cal_Cal.ZDrive_BSW_Cal_VehicleInfomationTable.RiSCVerticalDist2Body_m ZDrive_BSW_Cal_Cal.ZDrive_BSW_Cal_VehicleInfomationTable.FrntLeSideUss_Dx ZDrive_BSW_Cal_Cal.ZDrive_BSW_Cal_VehicleInfomationTable.FrntLeSideUss_Dy ZDrive_BSW_Cal_Cal.ZDrive_BSW_Cal_VehicleInfomationTable.FrntLeSideUss_Dz ZDrive_BSW_Cal_Cal.ZDrive_BSW_Cal_VehicleInfomationTable.Vehicle_Information_Reserved_Line158 ZDrive_BSW_Cal_Cal.ZDrive_BSW_Cal_VehicleInfomationTable.FrntLeSideUss_Roll ZDrive_BSW_Cal_Cal.ZDrive_BSW_Cal_VehicleInfomationTable.FrntLeSideUss_Pitch ZDrive_BSW_Cal_Cal.ZDrive_BSW_Cal_VehicleInfomationTable.FrntLeSideUss_Yaw ZDrive_BSW_Cal_Cal.ZDrive_BSW_Cal_VehicleInfomationTable.FrntLeCrnrUss_Dx ZDrive_BSW_Cal_Cal.ZDrive_BSW_Cal_VehicleInfomationTable.FrntLeCrnrUss_Dy ZDrive_BSW_Cal_Cal.ZDrive_BSW_Cal_VehicleInfomationTable.FrntLeCrnrUss_Dz ZDrive_BSW_Cal_Cal.ZDrive_BSW_Cal_VehicleInfomationTable.Vehicle_Information_Reserved_Line165 ZDrive_BSW_Cal_Cal.ZDrive_BSW_Cal_VehicleInfomationTable.FrntLeCrnrUss_Roll ZDrive_BSW_Cal_Cal.ZDrive_BSW_Cal_VehicleInfomationTable.FrntLeCrnrUss_Pitch ZDrive_BSW_Cal_Cal.ZDrive_BSW_Cal_VehicleInfomationTable.FrntLeCrnrUss_Yaw ZDrive_BSW_Cal_Cal.ZDrive_BSW_Cal_VehicleInfomationTable.FrntLeMidUss_Dx ZDrive_BSW_Cal_Cal.ZDrive_BSW_Cal_VehicleInfomationTable.FrntLeMidUss_Dy ZDrive_BSW_Cal_Cal.ZDrive_BSW_Cal_VehicleInfomationTable.FrntLeMidUss_Dz ZDrive_BSW_Cal_Cal.ZDrive_BSW_Cal_VehicleInfomationTable.Vehicle_Information_Reserved_Line172 ZDrive_BSW_Cal_Cal.ZDrive_BSW_Cal_VehicleInfomationTable.FrntLeMidUss_Roll ZDrive_BSW_Cal_Cal.ZDrive_BSW_Cal_VehicleInfomationTable.FrntLeMidUss_Pitch ZDrive_BSW_Cal_Cal.ZDrive_BSW_Cal_VehicleInfomationTable.FrntLeMidUss_Yaw ZDrive_BSW_Cal_Cal.ZDrive_BSW_Cal_VehicleInfomationTable.FrntRiMidUss_Dx ZDrive_BSW_Cal_Cal.ZDrive_BSW_Cal_VehicleInfomationTable.FrntRiMidUss_Dy ZDrive_BSW_Cal_Cal.ZDrive_BSW_Cal_VehicleInfomationTable.FrntRiMidUss_Dz ZDrive_BSW_Cal_Cal.ZDrive_BSW_Cal_VehicleInfomationTable.Vehicle_Information_Reserved_Line179 ZDrive_BSW_Cal_Cal.ZDrive_BSW_Cal_VehicleInfomationTable.FrntRiMidUss_Roll ZDrive_BSW_Cal_Cal.ZDrive_BSW_Cal_VehicleInfomationTable.FrntRiMidUss_Pitch ZDrive_BSW_Cal_Cal.ZDrive_BSW_Cal_VehicleInfomationTable.FrntRiMidUss_Yaw ZDrive_BSW_Cal_Cal.ZDrive_BSW_Cal_VehicleInfomationTable.FrntRiCrnrUss_Dx ZDrive_BSW_Cal_Cal.ZDrive_BSW_Cal_VehicleInfomationTable.FrntRiCrnrUss_Dy ZDrive_BSW_Cal_Cal.ZDrive_BSW_Cal_VehicleInfomationTable.FrntRiCrnrUss_Dz ZDrive_BSW_Cal_Cal.ZDrive_BSW_Cal_VehicleInfomationTable.Vehicle_Information_Reserved_Line186 ZDrive_BSW_Cal_Cal.ZDrive_BSW_Cal_VehicleInfomationTable.FrntRiCrnrUss_Roll ZDrive_BSW_Cal_Cal.ZDrive_BSW_Cal_VehicleInfomationTable.FrntRiCrnrUss_Pitch ZDrive_BSW_Cal_Cal.ZDrive_BSW_Cal_VehicleInfomationTable.FrntRiCrnrUss_Yaw ZDrive_BSW_Cal_Cal.ZDrive_BSW_Cal_VehicleInfomationTable.FrntRiSideUss_Dx ZDrive_BSW_Cal_Cal.ZDrive_BSW_Cal_VehicleInfomationTable.FrntRiSideUss_Dy ZDrive_BSW_Cal_Cal.ZDrive_BSW_Cal_VehicleInfomationTable.FrntRiSideUss_Dz ZDrive_BSW_Cal_Cal.ZDrive_BSW_Cal_VehicleInfomationTable.Vehicle_Information_Reserved_Line193 ZDrive_BSW_Cal_Cal.ZDrive_BSW_Cal_VehicleInfomationTable.FrntRiSideUss_Roll ZDrive_BSW_Cal_Cal.ZDrive_BSW_Cal_VehicleInfomationTable.FrntRiSideUss_Pitch ZDrive_BSW_Cal_Cal.ZDrive_BSW_Cal_VehicleInfomationTable.FrntRiSideUss_Yaw ZDrive_BSW_Cal_Cal.ZDrive_BSW_Cal_VehicleInfomationTable.ReRiSideUss_Dx ZDrive_BSW_Cal_Cal.ZDrive_BSW_Cal_VehicleInfomationTable.ReRiSideUss_Dy ZDrive_BSW_Cal_Cal.ZDrive_BSW_Cal_VehicleInfomationTable.ReRiSideUss_Dz ZDrive_BSW_Cal_Cal.ZDrive_BSW_Cal_VehicleInfomationTable.Vehicle_Information_Reserved_Line200 ZDrive_BSW_Cal_Cal.ZDrive_BSW_Cal_VehicleInfomationTable.ReRiSideUss_Roll ZDrive_BSW_Cal_Cal.ZDrive_BSW_Cal_VehicleInfomationTable.ReRiSideUss_Pitch ZDrive_BSW_Cal_Cal.ZDrive_BSW_Cal_VehicleInfomationTable.ReRiSideUss_Yaw ZDrive_BSW_Cal_Cal.ZDrive_BSW_Cal_VehicleInfomationTable.ReRiCrnrUss_Dx ZDrive_BSW_Cal_Cal.ZDrive_BSW_Cal_VehicleInfomationTable.ReRiCrnrUss_Dy ZDrive_BSW_Cal_Cal.ZDrive_BSW_Cal_VehicleInfomationTable.ReRiCrnrUss_Dz ZDrive_BSW_Cal_Cal.ZDrive_BSW_Cal_VehicleInfomationTable.Vehicle_Information_Reserved_Line207 ZDrive_BSW_Cal_Cal.ZDrive_BSW_Cal_VehicleInfomationTable.ReRiCrnrUss_Roll ZDrive_BSW_Cal_Cal.ZDrive_BSW_Cal_VehicleInfomationTable.ReRiCrnrUss_Pitch ZDrive_BSW_Cal_Cal.ZDrive_BSW_Cal_VehicleInfomationTable.ReRiCrnrUss_Yaw ZDrive_BSW_Cal_Cal.ZDrive_BSW_Cal_VehicleInfomationTable.ReRiMidUss_Dx ZDrive_BSW_Cal_Cal.ZDrive_BSW_Cal_VehicleInfomationTable.ReRiMidUss_Dy ZDrive_BSW_Cal_Cal.ZDrive_BSW_Cal_VehicleInfomationTable.ReRiMidUss_Dz ZDrive_BSW_Cal_Cal.ZDrive_BSW_Cal_VehicleInfomationTable.Vehicle_Information_Reserved_Line214 ZDrive_BSW_Cal_Cal.ZDrive_BSW_Cal_VehicleInfomationTable.ReRiMidUss_Roll ZDrive_BSW_Cal_Cal.ZDrive_BSW_Cal_VehicleInfomationTable.ReRiMidUss_Pitch ZDrive_BSW_Cal_Cal.ZDrive_BSW_Cal_VehicleInfomationTable.ReRiMidUss_Yaw ZDrive_BSW_Cal_Cal.ZDrive_BSW_Cal_VehicleInfomationTable.ReLeMidUss_Dx ZDrive_BSW_Cal_Cal.ZDrive_BSW_Cal_VehicleInfomationTable.ReLeMidUss_Dy ZDrive_BSW_Cal_Cal.ZDrive_BSW_Cal_VehicleInfomationTable.ReLeMidUss_Dz ZDrive_BSW_Cal_Cal.ZDrive_BSW_Cal_VehicleInfomationTable.Vehicle_Information_Reserved_Line221 ZDrive_BSW_Cal_Cal.ZDrive_BSW_Cal_VehicleInfomationTable.ReLeMidUss_Roll ZDrive_BSW_Cal_Cal.ZDrive_BSW_Cal_VehicleInfomationTable.ReLeMidUss_Pitch ZDrive_BSW_Cal_Cal.ZDrive_BSW_Cal_VehicleInfomationTable.ReLeMidUss_Yaw ZDrive_BSW_Cal_Cal.ZDrive_BSW_Cal_VehicleInfomationTable.ReLeCrnrUss_Dx ZDrive_BSW_Cal_Cal.ZDrive_BSW_Cal_VehicleInfomationTable.ReLeCrnrUss_Dy ZDrive_BSW_Cal_Cal.ZDrive_BSW_Cal_VehicleInfomationTable.ReLeCrnrUss_Dz ZDrive_BSW_Cal_Cal.ZDrive_BSW_Cal_VehicleInfomationTable.Vehicle_Information_Reserved_Line228 ZDrive_BSW_Cal_Cal.ZDrive_BSW_Cal_VehicleInfomationTable.ReLeCrnrUss_Roll ZDrive_BSW_Cal_Cal.ZDrive_BSW_Cal_VehicleInfomationTable.ReLeCrnrUss_Pitch ZDrive_BSW_Cal_Cal.ZDrive_BSW_Cal_VehicleInfomationTable.ReLeCrnrUss_Yaw ZDrive_BSW_Cal_Cal.ZDrive_BSW_Cal_VehicleInfomationTable.ReLeSideUss_Dx ZDrive_BSW_Cal_Cal.ZDrive_BSW_Cal_VehicleInfomationTable.ReLeSideUss_Dy ZDrive_BSW_Cal_Cal.ZDrive_BSW_Cal_VehicleInfomationTable.ReLeSideUss_Dz ZDrive_BSW_Cal_Cal.ZDrive_BSW_Cal_VehicleInfomationTable.Vehicle_Information_Reserved_Line235 ZDrive_BSW_Cal_Cal.ZDrive_BSW_Cal_VehicleInfomationTable.ReLeSideUss_Roll ZDrive_BSW_Cal_Cal.ZDrive_BSW_Cal_VehicleInfomationTable.ReLeSideUss_Pitch ZDrive_BSW_Cal_Cal.ZDrive_BSW_Cal_VehicleInfomationTable.ReLeSideUss_Yaw ZDrive_BSW_Cal_Cal.ZDrive_BSW_Cal_VehicleInfomationTable.UltraInstallAng_FM ZDrive_BSW_Cal_Cal.ZDrive_BSW_Cal_VehicleInfomationTable.UltraInstallAng_FA ZDrive_BSW_Cal_Cal.ZDrive_BSW_Cal_VehicleInfomationTable.UltraInstallAng_FS ZDrive_BSW_Cal_Cal.ZDrive_BSW_Cal_VehicleInfomationTable.UltraInstallLatOffset_FM_m ZDrive_BSW_Cal_Cal.ZDrive_BSW_Cal_VehicleInfomationTable.UltraInstallLatOffset_FA_m ZDrive_BSW_Cal_Cal.ZDrive_BSW_Cal_VehicleInfomationTable.UltraInstallLatOffset_FS_m ZDrive_BSW_Cal_Cal.ZDrive_BSW_Cal_VehicleInfomationTable.Vehicle_Information_Reserved_Line245 ZDrive_BSW_Cal_Cal.ZDrive_BSW_Cal_VehicleInfomationTable.UltraInstallAng_RM ZDrive_BSW_Cal_Cal.ZDrive_BSW_Cal_VehicleInfomationTable.UltraInstallAng_RA ZDrive_BSW_Cal_Cal.ZDrive_BSW_Cal_VehicleInfomationTable.UltraInstallAng_RS ZDrive_BSW_Cal_Cal.ZDrive_BSW_Cal_VehicleInfomationTable.UltraInstallLatOffset_RM_m ZDrive_BSW_Cal_Cal.ZDrive_BSW_Cal_VehicleInfomationTable.UltraInstallLatOffset_RA_m ZDrive_BSW_Cal_Cal.ZDrive_BSW_Cal_VehicleInfomationTable.UltraInstallLatOffset_RS_m ZDrive_BSW_Cal_Cal.ZDrive_BSW_Cal_VehicleInfomationTable.UltraInstallHeight_FM_m ZDrive_BSW_Cal_Cal.ZDrive_BSW_Cal_VehicleInfomationTable.UltraInstallHeight_FA_m ZDrive_BSW_Cal_Cal.ZDrive_BSW_Cal_VehicleInfomationTable.UltraInstallHeight_FS_m ZDrive_BSW_Cal_Cal.ZDrive_BSW_Cal_VehicleInfomationTable.UltraInstallHeight_RM_m ZDrive_BSW_Cal_Cal.ZDrive_BSW_Cal_VehicleInfomationTable.UltraInstallHeight_RA_m ZDrive_BSW_Cal_Cal.ZDrive_BSW_Cal_VehicleInfomationTable.UltraInstallHeight_RS_m ZDrive_BSW_Cal_Cal.ZDrive_BSW_Cal_VehicleInfomationTable.Vehicle_Information_Reserved_Line258 ZDrive_BSW_Cal_Cal.ZDrive_BSW_Cal_VehicleInfomationTable.VISION_MOUNT_PARAM_FRONT_X_POSITION ZDrive_BSW_Cal_Cal.ZDrive_BSW_Cal_VehicleInfomationTable.VISION_MOUNT_PARAM_FRONT_Y_POSITION ZDrive_BSW_Cal_Cal.ZDrive_BSW_Cal_VehicleInfomationTable.VISION_MOUNT_PARAM_FRONT_YAW_ANGLE /end REF_CHARACTERISTIC
/end GROUP
/begin RECORD_LAYOUT Record_FLOAT32_IEEE FNC_VALUES 1 FLOAT32_IEEE COLUMN_DIR DIRECT /end RECORD_LAYOUT
/begin RECORD_LAYOUT Record_SBYTE FNC_VALUES 1 SBYTE COLUMN_DIR DIRECT /end RECORD_LAYOUT
/begin RECORD_LAYOUT Record_SWORD FNC_VALUES 1 SWORD COLUMN_DIR DIRECT /end RECORD_LAYOUT
/begin RECORD_LAYOUT Record_UBYTE FNC_VALUES 1 UBYTE COLUMN_DIR DIRECT /end RECORD_LAYOUT
/begin RECORD_LAYOUT Record_ULONG FNC_VALUES 1 ULONG COLUMN_DIR DIRECT /end RECORD_LAYOUT
/begin RECORD_LAYOUT Record_UWORD FNC_VALUES 1 UWORD COLUMN_DIR DIRECT /end RECORD_LAYOUT
/begin GROUP ZDrive_BSW_Cal_Cal.ZDrive_BSW_Cal_VehicleInfomationTable ""
 /begin REF_CHARACTERISTIC ZDrive_BSW_Cal_Cal.ZDrive_BSW_Cal_VehicleInfomationTable.ParkingBrakeType ZDrive_BSW_Cal_Cal.ZDrive_BSW_Cal_VehicleInfomationTable.StrWhlConfig ZDrive_BSW_Cal_Cal.ZDrive_BSW_Cal_VehicleInfomationTable.ParkingLongControlInterForm ZDrive_BSW_Cal_Cal.ZDrive_BSW_Cal_VehicleInfomationTable.Driving_Type ZDrive_BSW_Cal_Cal.ZDrive_BSW_Cal_VehicleInfomationTable.Left_Right_handType ZDrive_BSW_Cal_Cal.ZDrive_BSW_Cal_VehicleInfomationTable.AutoHold_Type ZDrive_BSW_Cal_Cal.ZDrive_BSW_Cal_VehicleInfomationTable.AccSens_LatAccSigDirect ZDrive_BSW_Cal_Cal.ZDrive_BSW_Cal_VehicleInfomationTable.AccSens_LonAccSigDirect ZDrive_BSW_Cal_Cal.ZDrive_BSW_Cal_VehicleInfomationTable.StrWhlAngSigDirect ZDrive_BSW_Cal_Cal.ZDrive_BSW_Cal_VehicleInfomationTable.DriHandTorqueDirect ZDrive_BSW_Cal_Cal.ZDrive_BSW_Cal_VehicleInfomationTable.Vehicle_Information_Reserved_Line24 ZDrive_BSW_Cal_Cal.ZDrive_BSW_Cal_VehicleInfomationTable.Vehicle_Information_Reserved_Line25 ZDrive_BSW_Cal_Cal.ZDrive_BSW_Cal_VehicleInfomationTable.Vehicle_Information_Reserved_Line26 ZDrive_BSW_Cal_Cal.ZDrive_BSW_Cal_VehicleInfomationTable.ValFunc_Reserve1 ZDrive_BSW_Cal_Cal.ZDrive_BSW_Cal_VehicleInfomationTable.ValFunc_Reserve2 ZDrive_BSW_Cal_Cal.ZDrive_BSW_Cal_VehicleInfomationTable.ASU_Type ZDrive_BSW_Cal_Cal.ZDrive_BSW_Cal_VehicleInfomationTable.Suspension ZDrive_BSW_Cal_Cal.ZDrive_BSW_Cal_VehicleInfomationTable.Vehicle_Information_Reserved_Line31 ZDrive_BSW_Cal_Cal.ZDrive_BSW_Cal_VehicleInfomationTable.Vehicle_Information_Reserved_Line32 ZDrive_BSW_Cal_Cal.ZDrive_BSW_Cal_VehicleInfomationTable.Vehicle_Information_Reserved_Line33 ZDrive_BSW_Cal_Cal.ZDrive_BSW_Cal_VehicleInfomationTable.Vehicle_Information_Reserved_Line34 ZDrive_BSW_Cal_Cal.ZDrive_BSW_Cal_VehicleInfomationTable.Vehicle_Information_Reserved_Line35 ZDrive_BSW_Cal_Cal.ZDrive_BSW_Cal_VehicleInfomationTable.Vehicle_Information_Reserved_Line36 ZDrive_BSW_Cal_Cal.ZDrive_BSW_Cal_VehicleInfomationTable.Vehicle_Information_Reserved_Line37 ZDrive_BSW_Cal_Cal.ZDrive_BSW_Cal_VehicleInfomationTable.Vehicle_Length_m ZDrive_BSW_Cal_Cal.ZDrive_BSW_Cal_VehicleInfomationTable.VehicleWidthMax_m ZDrive_BSW_Cal_Cal.ZDrive_BSW_Cal_VehicleInfomationTable.VehicleWidthMin_m ZDrive_BSW_Cal_Cal.ZDrive_BSW_Cal_VehicleInfomationTable.Height_m ZDrive_BSW_Cal_Cal.ZDrive_BSW_Cal_VehicleInfomationTable.EngineMaxiTorque_N ZDrive_BSW_Cal_Cal.ZDrive_BSW_Cal_VehicleInfomationTable.WheelBase_m ZDrive_BSW_Cal_Cal.ZDrive_BSW_Cal_VehicleInfomationTable.FrontAxleToRearAxLeCenterX_m ZDrive_BSW_Cal_Cal.ZDrive_BSW_Cal_VehicleInfomationTable.WheelTrack_m ZDrive_BSW_Cal_Cal.ZDrive_BSW_Cal_VehicleInfomationTable.FrWhlTrack_m ZDrive_BSW_Cal_Cal.ZDrive_BSW_Cal_VehicleInfomationTable.ReWhlTrack_m ZDrive_BSW_Cal_Cal.ZDrive_BSW_Cal_VehicleInfomationTable.FrontOverhang_Length_m ZDrive_BSW_Cal_Cal.ZDrive_BSW_Cal_VehicleInfomationTable.RearOverhang_Length_m ZDrive_BSW_Cal_Cal.ZDrive_BSW_Cal_VehicleInfomationTable.FrWhlHousingHeight_m ZDrive_BSW_Cal_Cal.ZDrive_BSW_Cal_VehicleInfomationTable.ReWhlHousingHeight_m ZDrive_BSW_Cal_Cal.ZDrive_BSW_Cal_VehicleInfomationTable.DxvRearBumper_m ZDrive_BSW_Cal_Cal.ZDrive_BSW_Cal_VehicleInfomationTable.DxvFrontBumper_m ZDrive_BSW_Cal_Cal.ZDrive_BSW_Cal_VehicleInfomationTable.FrontAxleToCenter_m ZDrive_BSW_Cal_Cal.ZDrive_BSW_Cal_VehicleInfomationTable.RearAxleToCenter_m ZDrive_BSW_Cal_Cal.ZDrive_BSW_Cal_VehicleInfomationTable.RearViewMirrorLength_On_Y ZDrive_BSW_Cal_Cal.ZDrive_BSW_Cal_VehicleInfomationTable.RearViewMirrorLength_On_X ZDrive_BSW_Cal_Cal.ZDrive_BSW_Cal_VehicleInfomationTable.RearViewMirrorTopSide_Height ZDrive_BSW_Cal_Cal.ZDrive_BSW_Cal_VehicleInfomationTable.RearViewMirrorBottomSide_Height ZDrive_BSW_Cal_Cal.ZDrive_BSW_Cal_VehicleInfomationTable.RearViewMirrorOutsidePointToRearAxle_Diatance_m ZDrive_BSW_Cal_Cal.ZDrive_BSW_Cal_VehicleInfomationTable.FrontLeftFrontPointToRearAxleCenter_Distance_m ZDrive_BSW_Cal_Cal.ZDrive_BSW_Cal_VehicleInfomationTable.FrontLeftFrontPointToCenterLine_Distance_m ZDrive_BSW_Cal_Cal.ZDrive_BSW_Cal_VehicleInfomationTable.FrontLeftOutsidePointToRearAxleCenter_Distance_m ZDrive_BSW_Cal_Cal.ZDrive_BSW_Cal_VehicleInfomationTable.FrontLeftOutsidePointToCenterLine_Distance_m ZDrive_BSW_Cal_Cal.ZDrive_BSW_Cal_VehicleInfomationTable.RearLeftOutsidePointToRearAxleCenter_Distance_m ZDrive_BSW_Cal_Cal.ZDrive_BSW_Cal_VehicleInfomationTable.RearLeftOutsidePointToCenterLine_Distance_m ZDrive_BSW_Cal_Cal.ZDrive_BSW_Cal_VehicleInfomationTable.RearLeftRearPointToRearAxleCenter_Distance_m ZDrive_BSW_Cal_Cal.ZDrive_BSW_Cal_VehicleInfomationTable.RearLeftRearPointToCenterLine_Distance_m ZDrive_BSW_Cal_Cal.ZDrive_BSW_Cal_VehicleInfomationTable.CURB_kg ZDrive_BSW_Cal_Cal.ZDrive_BSW_Cal_VehicleInfomationTable.Weight_N ZDrive_BSW_Cal_Cal.ZDrive_BSW_Cal_VehicleInfomationTable.GVW_kg ZDrive_BSW_Cal_Cal.ZDrive_BSW_Cal_VehicleInfomationTable.Empty_mass_kg ZDrive_BSW_Cal_Cal.ZDrive_BSW_Cal_VehicleInfomationTable.TireRadius_m ZDrive_BSW_Cal_Cal.ZDrive_BSW_Cal_VehicleInfomationTable.IEnvironment_WheelWidth ZDrive_BSW_Cal_Cal.ZDrive_BSW_Cal_VehicleInfomationTable.WheelDiameter ZDrive_BSW_Cal_Cal.ZDrive_BSW_Cal_VehicleInfomationTable.WhlSpdSensUnitPulseDist ZDrive_BSW_Cal_Cal.ZDrive_BSW_Cal_VehicleInfomationTable.WheelSpeedCounterMax ZDrive_BSW_Cal_Cal.ZDrive_BSW_Cal_VehicleInfomationTable.WheelSpeedCounterPulse ZDrive_BSW_Cal_Cal.ZDrive_BSW_Cal_VehicleInfomationTable.WheelSpeedCounterIsUnsigned ZDrive_BSW_Cal_Cal.ZDrive_BSW_Cal_VehicleInfomationTable.WheelSpeedCounterMin ZDrive_BSW_Cal_Cal.ZDrive_BSW_Cal_VehicleInfomationTable.Vehicle_Information_Reserved_Line81 ZDrive_BSW_Cal_Cal.ZDrive_BSW_Cal_VehicleInfomationTable.Vehicle_Information_Reserved_Line82 ZDrive_BSW_Cal_Cal.ZDrive_BSW_Cal_VehicleInfomationTable.CharSpd_mps ZDrive_BSW_Cal_Cal.ZDrive_BSW_Cal_VehicleInfomationTable.SideSlipAnglefactor ZDrive_BSW_Cal_Cal.ZDrive_BSW_Cal_VehicleInfomationTable.MaxSteeringAngle ZDrive_BSW_Cal_Cal.ZDrive_BSW_Cal_VehicleInfomationTable.SteeringAngleRatio ZDrive_BSW_Cal_Cal.ZDrive_BSW_Cal_VehicleInfomationTable.RearAxlecCenterTurningCircle ZDrive_BSW_Cal_Cal.ZDrive_BSW_Cal_VehicleInfomationTable.StrWhlMappingTable ZDrive_BSW_Cal_Cal.ZDrive_BSW_Cal_VehicleInfomationTable.FRollingRadius_m ZDrive_BSW_Cal_Cal.ZDrive_BSW_Cal_VehicleInfomationTable.RRollingRadius_m ZDrive_BSW_Cal_Cal.ZDrive_BSW_Cal_VehicleInfomationTable.PowerTransRatio ZDrive_BSW_Cal_Cal.ZDrive_BSW_Cal_VehicleInfomationTable.TAC_Camera_Height ZDrive_BSW_Cal_Cal.ZDrive_BSW_Cal_VehicleInfomationTable.IEnvironment_CamToFrontAxle ZDrive_BSW_Cal_Cal.ZDrive_BSW_Cal_VehicleInfomationTable.FCFocus2FrAxleDist_Y_m ZDrive_BSW_Cal_Cal.ZDrive_BSW_Cal_VehicleInfomationTable.FCFocus2FrAxleDist_Z_m ZDrive_BSW_Cal_Cal.ZDrive_BSW_Cal_VehicleInfomationTable.FC2RearAxisX_m ZDrive_BSW_Cal_Cal.ZDrive_BSW_Cal_VehicleInfomationTable.FC2RearAxisY_m ZDrive_BSW_Cal_Cal.ZDrive_BSW_Cal_VehicleInfomationTable.CamDistToRearAxleCenter_DZ ZDrive_BSW_Cal_Cal.ZDrive_BSW_Cal_VehicleInfomationTable.FCFirstViewPointDist_m ZDrive_BSW_Cal_Cal.ZDrive_BSW_Cal_VehicleInfomationTable.IEnvironment_RefPX_Front_Bumper ZDrive_BSW_Cal_Cal.ZDrive_BSW_Cal_VehicleInfomationTable.TAC_Bottom ZDrive_BSW_Cal_Cal.ZDrive_BSW_Cal_VehicleInfomationTable.Vehicle_Information_Reserved_Line102 ZDrive_BSW_Cal_Cal.ZDrive_BSW_Cal_VehicleInfomationTable.IEnviroment_Top_Crop ZDrive_BSW_Cal_Cal.ZDrive_BSW_Cal_VehicleInfomationTable.IEnviroment_Bottom_Crop ZDrive_BSW_Cal_Cal.ZDrive_BSW_Cal_VehicleInfomationTable.Vehicle_Information_Reserved_Line105 ZDrive_BSW_Cal_Cal.ZDrive_BSW_Cal_VehicleInfomationTable.FC2LeftWheel_m ZDrive_BSW_Cal_Cal.ZDrive_BSW_Cal_VehicleInfomationTable.FC2RightWheel_m ZDrive_BSW_Cal_Cal.ZDrive_BSW_Cal_VehicleInfomationTable.TAC_Targets_Num ZDrive_BSW_Cal_Cal.ZDrive_BSW_Cal_VehicleInfomationTable.Vehicle_Information_Reserved_Line109 ZDrive_BSW_Cal_Cal.ZDrive_BSW_Cal_VehicleInfomationTable.Vehicle_Information_Reserved_Line110 ZDrive_BSW_Cal_Cal.ZDrive_BSW_Cal_VehicleInfomationTable.camera_x_m ZDrive_BSW_Cal_Cal.ZDrive_BSW_Cal_VehicleInfomationTable.camera_y_m ZDrive_BSW_Cal_Cal.ZDrive_BSW_Cal_VehicleInfomationTable.camera_z_m ZDrive_BSW_Cal_Cal.ZDrive_BSW_Cal_VehicleInfomationTable.translation_x_m ZDrive_BSW_Cal_Cal.ZDrive_BSW_Cal_VehicleInfomationTable.Vehicle_Information_Reserved_Line115 ZDrive_BSW_Cal_Cal.ZDrive_BSW_Cal_VehicleInfomationTable.RollingAngOfCAD ZDrive_BSW_Cal_Cal.ZDrive_BSW_Cal_VehicleInfomationTable.PitchAngOfCAD ZDrive_BSW_Cal_Cal.ZDrive_BSW_Cal_VehicleInfomationTable.YawAngOfCAD ZDrive_BSW_Cal_Cal.ZDrive_BSW_Cal_VehicleInfomationTable.FrontShortCamera_Dx ZDrive_BSW_Cal_Cal.ZDrive_BSW_Cal_VehicleInfomationTable.FrontShortCamera_Dy ZDrive_BSW_Cal_Cal.ZDrive_BSW_Cal_VehicleInfomationTable.FrontShortCamera_Dz ZDrive_BSW_Cal_Cal.ZDrive_BSW_Cal_VehicleInfomationTable.Vehicle_Information_Reserved_Line122 ZDrive_BSW_Cal_Cal.ZDrive_BSW_Cal_VehicleInfomationTable.FrontShortCamera_Roll ZDrive_BSW_Cal_Cal.ZDrive_BSW_Cal_VehicleInfomationTable.FrontShortCamera_Pitch ZDrive_BSW_Cal_Cal.ZDrive_BSW_Cal_VehicleInfomationTable.FrontShortCamera_Yaw ZDrive_BSW_Cal_Cal.ZDrive_BSW_Cal_VehicleInfomationTable.FrSCBlindSpotLength_m ZDrive_BSW_Cal_Cal.ZDrive_BSW_Cal_VehicleInfomationTable.FrSCDist2OuterMostSide_m ZDrive_BSW_Cal_Cal.ZDrive_BSW_Cal_VehicleInfomationTable.LeftShortCamera_Dx ZDrive_BSW_Cal_Cal.ZDrive_BSW_Cal_VehicleInfomationTable.LeftShortCamera_Dy ZDrive_BSW_Cal_Cal.ZDrive_BSW_Cal_VehicleInfomationTable.LeftShortCamera_Dz ZDrive_BSW_Cal_Cal.ZDrive_BSW_Cal_VehicleInfomationTable.Vehicle_Information_Reserved_Line131 ZDrive_BSW_Cal_Cal.ZDrive_BSW_Cal_VehicleInfomationTable.LeftShortCamera_Roll ZDrive_BSW_Cal_Cal.ZDrive_BSW_Cal_VehicleInfomationTable.LeftShortCamera_Pitch ZDrive_BSW_Cal_Cal.ZDrive_BSW_Cal_VehicleInfomationTable.LeftShortCamera_Yaw ZDrive_BSW_Cal_Cal.ZDrive_BSW_Cal_VehicleInfomationTable.LeSCBlindSpotLength_m ZDrive_BSW_Cal_Cal.ZDrive_BSW_Cal_VehicleInfomationTable.LeSCVerticalDist2Body_m ZDrive_BSW_Cal_Cal.ZDrive_BSW_Cal_VehicleInfomationTable.RearShortCamera_Dx ZDrive_BSW_Cal_Cal.ZDrive_BSW_Cal_VehicleInfomationTable.RearShortCamera_Dy ZDrive_BSW_Cal_Cal.ZDrive_BSW_Cal_VehicleInfomationTable.RearShortCamera_Dz ZDrive_BSW_Cal_Cal.ZDrive_BSW_Cal_VehicleInfomationTable.Vehicle_Information_Reserved_Line140 ZDrive_BSW_Cal_Cal.ZDrive_BSW_Cal_VehicleInfomationTable.RearShortCamera_Roll ZDrive_BSW_Cal_Cal.ZDrive_BSW_Cal_VehicleInfomationTable.RearShortCamera_Pitch ZDrive_BSW_Cal_Cal.ZDrive_BSW_Cal_VehicleInfomationTable.RearShortCamera_Yaw ZDrive_BSW_Cal_Cal.ZDrive_BSW_Cal_VehicleInfomationTable.ReSCBlindSpotLength_m ZDrive_BSW_Cal_Cal.ZDrive_BSW_Cal_VehicleInfomationTable.ReSCDist2OuterMostSide_m ZDrive_BSW_Cal_Cal.ZDrive_BSW_Cal_VehicleInfomationTable.RightShortCamera_Dx ZDrive_BSW_Cal_Cal.ZDrive_BSW_Cal_VehicleInfomationTable.RightShortCamera_Dy ZDrive_BSW_Cal_Cal.ZDrive_BSW_Cal_VehicleInfomationTable.RightShortCamera_Dz ZDrive_BSW_Cal_Cal.ZDrive_BSW_Cal_VehicleInfomationTable.Vehicle_Information_Reserved_Line149 ZDrive_BSW_Cal_Cal.ZDrive_BSW_Cal_VehicleInfomationTable.RightShortCamera_Roll ZDrive_BSW_Cal_Cal.ZDrive_BSW_Cal_VehicleInfomationTable.RightShortCamera_Pitch ZDrive_BSW_Cal_Cal.ZDrive_BSW_Cal_VehicleInfomationTable.RightShortCamera_Yaw ZDrive_BSW_Cal_Cal.ZDrive_BSW_Cal_VehicleInfomationTable.RiSCBlindSpotLength_m ZDrive_BSW_Cal_Cal.ZDrive_BSW_Cal_VehicleInfomationTable.RiSCVerticalDist2Body_m ZDrive_BSW_Cal_Cal.ZDrive_BSW_Cal_VehicleInfomationTable.FrntLeSideUss_Dx ZDrive_BSW_Cal_Cal.ZDrive_BSW_Cal_VehicleInfomationTable.FrntLeSideUss_Dy ZDrive_BSW_Cal_Cal.ZDrive_BSW_Cal_VehicleInfomationTable.FrntLeSideUss_Dz ZDrive_BSW_Cal_Cal.ZDrive_BSW_Cal_VehicleInfomationTable.Vehicle_Information_Reserved_Line158 ZDrive_BSW_Cal_Cal.ZDrive_BSW_Cal_VehicleInfomationTable.FrntLeSideUss_Roll ZDrive_BSW_Cal_Cal.ZDrive_BSW_Cal_VehicleInfomationTable.FrntLeSideUss_Pitch ZDrive_BSW_Cal_Cal.ZDrive_BSW_Cal_VehicleInfomationTable.FrntLeSideUss_Yaw ZDrive_BSW_Cal_Cal.ZDrive_BSW_Cal_VehicleInfomationTable.FrntLeCrnrUss_Dx ZDrive_BSW_Cal_Cal.ZDrive_BSW_Cal_VehicleInfomationTable.FrntLeCrnrUss_Dy ZDrive_BSW_Cal_Cal.ZDrive_BSW_Cal_VehicleInfomationTable.FrntLeCrnrUss_Dz ZDrive_BSW_Cal_Cal.ZDrive_BSW_Cal_VehicleInfomationTable.Vehicle_Information_Reserved_Line165 ZDrive_BSW_Cal_Cal.ZDrive_BSW_Cal_VehicleInfomationTable.FrntLeCrnrUss_Roll ZDrive_BSW_Cal_Cal.ZDrive_BSW_Cal_VehicleInfomationTable.FrntLeCrnrUss_Pitch ZDrive_BSW_Cal_Cal.ZDrive_BSW_Cal_VehicleInfomationTable.FrntLeCrnrUss_Yaw ZDrive_BSW_Cal_Cal.ZDrive_BSW_Cal_VehicleInfomationTable.FrntLeMidUss_Dx ZDrive_BSW_Cal_Cal.ZDrive_BSW_Cal_VehicleInfomationTable.FrntLeMidUss_Dy ZDrive_BSW_Cal_Cal.ZDrive_BSW_Cal_VehicleInfomationTable.FrntLeMidUss_Dz ZDrive_BSW_Cal_Cal.ZDrive_BSW_Cal_VehicleInfomationTable.Vehicle_Information_Reserved_Line172 ZDrive_BSW_Cal_Cal.ZDrive_BSW_Cal_VehicleInfomationTable.FrntLeMidUss_Roll ZDrive_BSW_Cal_Cal.ZDrive_BSW_Cal_VehicleInfomationTable.FrntLeMidUss_Pitch ZDrive_BSW_Cal_Cal.ZDrive_BSW_Cal_VehicleInfomationTable.FrntLeMidUss_Yaw ZDrive_BSW_Cal_Cal.ZDrive_BSW_Cal_VehicleInfomationTable.FrntRiMidUss_Dx ZDrive_BSW_Cal_Cal.ZDrive_BSW_Cal_VehicleInfomationTable.FrntRiMidUss_Dy ZDrive_BSW_Cal_Cal.ZDrive_BSW_Cal_VehicleInfomationTable.FrntRiMidUss_Dz ZDrive_BSW_Cal_Cal.ZDrive_BSW_Cal_VehicleInfomationTable.Vehicle_Information_Reserved_Line179 ZDrive_BSW_Cal_Cal.ZDrive_BSW_Cal_VehicleInfomationTable.FrntRiMidUss_Roll ZDrive_BSW_Cal_Cal.ZDrive_BSW_Cal_VehicleInfomationTable.FrntRiMidUss_Pitch ZDrive_BSW_Cal_Cal.ZDrive_BSW_Cal_VehicleInfomationTable.FrntRiMidUss_Yaw ZDrive_BSW_Cal_Cal.ZDrive_BSW_Cal_VehicleInfomationTable.FrntRiCrnrUss_Dx ZDrive_BSW_Cal_Cal.ZDrive_BSW_Cal_VehicleInfomationTable.FrntRiCrnrUss_Dy ZDrive_BSW_Cal_Cal.ZDrive_BSW_Cal_VehicleInfomationTable.FrntRiCrnrUss_Dz ZDrive_BSW_Cal_Cal.ZDrive_BSW_Cal_VehicleInfomationTable.Vehicle_Information_Reserved_Line186 ZDrive_BSW_Cal_Cal.ZDrive_BSW_Cal_VehicleInfomationTable.FrntRiCrnrUss_Roll ZDrive_BSW_Cal_Cal.ZDrive_BSW_Cal_VehicleInfomationTable.FrntRiCrnrUss_Pitch ZDrive_BSW_Cal_Cal.ZDrive_BSW_Cal_VehicleInfomationTable.FrntRiCrnrUss_Yaw ZDrive_BSW_Cal_Cal.ZDrive_BSW_Cal_VehicleInfomationTable.FrntRiSideUss_Dx ZDrive_BSW_Cal_Cal.ZDrive_BSW_Cal_VehicleInfomationTable.FrntRiSideUss_Dy ZDrive_BSW_Cal_Cal.ZDrive_BSW_Cal_VehicleInfomationTable.FrntRiSideUss_Dz ZDrive_BSW_Cal_Cal.ZDrive_BSW_Cal_VehicleInfomationTable.Vehicle_Information_Reserved_Line193 ZDrive_BSW_Cal_Cal.ZDrive_BSW_Cal_VehicleInfomationTable.FrntRiSideUss_Roll ZDrive_BSW_Cal_Cal.ZDrive_BSW_Cal_VehicleInfomationTable.FrntRiSideUss_Pitch ZDrive_BSW_Cal_Cal.ZDrive_BSW_Cal_VehicleInfomationTable.FrntRiSideUss_Yaw ZDrive_BSW_Cal_Cal.ZDrive_BSW_Cal_VehicleInfomationTable.ReRiSideUss_Dx ZDrive_BSW_Cal_Cal.ZDrive_BSW_Cal_VehicleInfomationTable.ReRiSideUss_Dy ZDrive_BSW_Cal_Cal.ZDrive_BSW_Cal_VehicleInfomationTable.ReRiSideUss_Dz ZDrive_BSW_Cal_Cal.ZDrive_BSW_Cal_VehicleInfomationTable.Vehicle_Information_Reserved_Line200 ZDrive_BSW_Cal_Cal.ZDrive_BSW_Cal_VehicleInfomationTable.ReRiSideUss_Roll ZDrive_BSW_Cal_Cal.ZDrive_BSW_Cal_VehicleInfomationTable.ReRiSideUss_Pitch ZDrive_BSW_Cal_Cal.ZDrive_BSW_Cal_VehicleInfomationTable.ReRiSideUss_Yaw ZDrive_BSW_Cal_Cal.ZDrive_BSW_Cal_VehicleInfomationTable.ReRiCrnrUss_Dx ZDrive_BSW_Cal_Cal.ZDrive_BSW_Cal_VehicleInfomationTable.ReRiCrnrUss_Dy ZDrive_BSW_Cal_Cal.ZDrive_BSW_Cal_VehicleInfomationTable.ReRiCrnrUss_Dz ZDrive_BSW_Cal_Cal.ZDrive_BSW_Cal_VehicleInfomationTable.Vehicle_Information_Reserved_Line207 ZDrive_BSW_Cal_Cal.ZDrive_BSW_Cal_VehicleInfomationTable.ReRiCrnrUss_Roll ZDrive_BSW_Cal_Cal.ZDrive_BSW_Cal_VehicleInfomationTable.ReRiCrnrUss_Pitch ZDrive_BSW_Cal_Cal.ZDrive_BSW_Cal_VehicleInfomationTable.ReRiCrnrUss_Yaw ZDrive_BSW_Cal_Cal.ZDrive_BSW_Cal_VehicleInfomationTable.ReRiMidUss_Dx ZDrive_BSW_Cal_Cal.ZDrive_BSW_Cal_VehicleInfomationTable.ReRiMidUss_Dy ZDrive_BSW_Cal_Cal.ZDrive_BSW_Cal_VehicleInfomationTable.ReRiMidUss_Dz ZDrive_BSW_Cal_Cal.ZDrive_BSW_Cal_VehicleInfomationTable.Vehicle_Information_Reserved_Line214 ZDrive_BSW_Cal_Cal.ZDrive_BSW_Cal_VehicleInfomationTable.ReRiMidUss_Roll ZDrive_BSW_Cal_Cal.ZDrive_BSW_Cal_VehicleInfomationTable.ReRiMidUss_Pitch ZDrive_BSW_Cal_Cal.ZDrive_BSW_Cal_VehicleInfomationTable.ReRiMidUss_Yaw ZDrive_BSW_Cal_Cal.ZDrive_BSW_Cal_VehicleInfomationTable.ReLeMidUss_Dx ZDrive_BSW_Cal_Cal.ZDrive_BSW_Cal_VehicleInfomationTable.ReLeMidUss_Dy ZDrive_BSW_Cal_Cal.ZDrive_BSW_Cal_VehicleInfomationTable.ReLeMidUss_Dz ZDrive_BSW_Cal_Cal.ZDrive_BSW_Cal_VehicleInfomationTable.Vehicle_Information_Reserved_Line221 ZDrive_BSW_Cal_Cal.ZDrive_BSW_Cal_VehicleInfomationTable.ReLeMidUss_Roll ZDrive_BSW_Cal_Cal.ZDrive_BSW_Cal_VehicleInfomationTable.ReLeMidUss_Pitch ZDrive_BSW_Cal_Cal.ZDrive_BSW_Cal_VehicleInfomationTable.ReLeMidUss_Yaw ZDrive_BSW_Cal_Cal.ZDrive_BSW_Cal_VehicleInfomationTable.ReLeCrnrUss_Dx ZDrive_BSW_Cal_Cal.ZDrive_BSW_Cal_VehicleInfomationTable.ReLeCrnrUss_Dy ZDrive_BSW_Cal_Cal.ZDrive_BSW_Cal_VehicleInfomationTable.ReLeCrnrUss_Dz ZDrive_BSW_Cal_Cal.ZDrive_BSW_Cal_VehicleInfomationTable.Vehicle_Information_Reserved_Line228 ZDrive_BSW_Cal_Cal.ZDrive_BSW_Cal_VehicleInfomationTable.ReLeCrnrUss_Roll ZDrive_BSW_Cal_Cal.ZDrive_BSW_Cal_VehicleInfomationTable.ReLeCrnrUss_Pitch ZDrive_BSW_Cal_Cal.ZDrive_BSW_Cal_VehicleInfomationTable.ReLeCrnrUss_Yaw ZDrive_BSW_Cal_Cal.ZDrive_BSW_Cal_VehicleInfomationTable.ReLeSideUss_Dx ZDrive_BSW_Cal_Cal.ZDrive_BSW_Cal_VehicleInfomationTable.ReLeSideUss_Dy ZDrive_BSW_Cal_Cal.ZDrive_BSW_Cal_VehicleInfomationTable.ReLeSideUss_Dz ZDrive_BSW_Cal_Cal.ZDrive_BSW_Cal_VehicleInfomationTable.Vehicle_Information_Reserved_Line235 ZDrive_BSW_Cal_Cal.ZDrive_BSW_Cal_VehicleInfomationTable.ReLeSideUss_Roll ZDrive_BSW_Cal_Cal.ZDrive_BSW_Cal_VehicleInfomationTable.ReLeSideUss_Pitch ZDrive_BSW_Cal_Cal.ZDrive_BSW_Cal_VehicleInfomationTable.ReLeSideUss_Yaw ZDrive_BSW_Cal_Cal.ZDrive_BSW_Cal_VehicleInfomationTable.UltraInstallAng_FM ZDrive_BSW_Cal_Cal.ZDrive_BSW_Cal_VehicleInfomationTable.UltraInstallAng_FA ZDrive_BSW_Cal_Cal.ZDrive_BSW_Cal_VehicleInfomationTable.UltraInstallAng_FS ZDrive_BSW_Cal_Cal.ZDrive_BSW_Cal_VehicleInfomationTable.UltraInstallLatOffset_FM_m ZDrive_BSW_Cal_Cal.ZDrive_BSW_Cal_VehicleInfomationTable.UltraInstallLatOffset_FA_m ZDrive_BSW_Cal_Cal.ZDrive_BSW_Cal_VehicleInfomationTable.UltraInstallLatOffset_FS_m ZDrive_BSW_Cal_Cal.ZDrive_BSW_Cal_VehicleInfomationTable.Vehicle_Information_Reserved_Line245 ZDrive_BSW_Cal_Cal.ZDrive_BSW_Cal_VehicleInfomationTable.UltraInstallAng_RM ZDrive_BSW_Cal_Cal.ZDrive_BSW_Cal_VehicleInfomationTable.UltraInstallAng_RA ZDrive_BSW_Cal_Cal.ZDrive_BSW_Cal_VehicleInfomationTable.UltraInstallAng_RS ZDrive_BSW_Cal_Cal.ZDrive_BSW_Cal_VehicleInfomationTable.UltraInstallLatOffset_RM_m ZDrive_BSW_Cal_Cal.ZDrive_BSW_Cal_VehicleInfomationTable.UltraInstallLatOffset_RA_m ZDrive_BSW_Cal_Cal.ZDrive_BSW_Cal_VehicleInfomationTable.UltraInstallLatOffset_RS_m ZDrive_BSW_Cal_Cal.ZDrive_BSW_Cal_VehicleInfomationTable.UltraInstallHeight_FM_m ZDrive_BSW_Cal_Cal.ZDrive_BSW_Cal_VehicleInfomationTable.UltraInstallHeight_FA_m ZDrive_BSW_Cal_Cal.ZDrive_BSW_Cal_VehicleInfomationTable.UltraInstallHeight_FS_m ZDrive_BSW_Cal_Cal.ZDrive_BSW_Cal_VehicleInfomationTable.UltraInstallHeight_RM_m ZDrive_BSW_Cal_Cal.ZDrive_BSW_Cal_VehicleInfomationTable.UltraInstallHeight_RA_m ZDrive_BSW_Cal_Cal.ZDrive_BSW_Cal_VehicleInfomationTable.UltraInstallHeight_RS_m ZDrive_BSW_Cal_Cal.ZDrive_BSW_Cal_VehicleInfomationTable.Vehicle_Information_Reserved_Line258 ZDrive_BSW_Cal_Cal.ZDrive_BSW_Cal_VehicleInfomationTable.VISION_MOUNT_PARAM_FRONT_X_POSITION ZDrive_BSW_Cal_Cal.ZDrive_BSW_Cal_VehicleInfomationTable.VISION_MOUNT_PARAM_FRONT_Y_POSITION ZDrive_BSW_Cal_Cal.ZDrive_BSW_Cal_VehicleInfomationTable.VISION_MOUNT_PARAM_FRONT_YAW_ANGLE /end REF_CHARACTERISTIC
/end GROUP
/begin RECORD_LAYOUT Record_FLOAT32_IEEE FNC_VALUES 1 FLOAT32_IEEE COLUMN_DIR DIRECT /end RECORD_LAYOUT
/begin RECORD_LAYOUT Record_SBYTE FNC_VALUES 1 SBYTE COLUMN_DIR DIRECT /end RECORD_LAYOUT
/begin RECORD_LAYOUT Record_SWORD FNC_VALUES 1 SWORD COLUMN_DIR DIRECT /end RECORD_LAYOUT
/begin RECORD_LAYOUT Record_UBYTE FNC_VALUES 1 UBYTE COLUMN_DIR DIRECT /end RECORD_LAYOUT
/begin RECORD_LAYOUT Record_ULONG FNC_VALUES 1 ULONG COLUMN_DIR DIRECT /end RECORD_LAYOUT
/begin RECORD_LAYOUT Record_UWORD FNC_VALUES 1 UWORD COLUMN_DIR DIRECT /end RECORD_LAYOUT
/begin GROUP ZDrive_BSW_Cal_Cal.ZDrive_BSW_Cal_VehicleInfomationTable ""
 /begin REF_CHARACTERISTIC ZDrive_BSW_Cal_Cal.ZDrive_BSW_Cal_VehicleInfomationTable.ParkingBrakeType ZDrive_BSW_Cal_Cal.ZDrive_BSW_Cal_VehicleInfomationTable.StrWhlConfig ZDrive_BSW_Cal_Cal.ZDrive_BSW_Cal_VehicleInfomationTable.ParkingLongControlInterForm ZDrive_BSW_Cal_Cal.ZDrive_BSW_Cal_VehicleInfomationTable.Driving_Type ZDrive_BSW_Cal_Cal.ZDrive_BSW_Cal_VehicleInfomationTable.Left_Right_handType ZDrive_BSW_Cal_Cal.ZDrive_BSW_Cal_VehicleInfomationTable.AutoHold_Type ZDrive_BSW_Cal_Cal.ZDrive_BSW_Cal_VehicleInfomationTable.AccSens_LatAccSigDirect ZDrive_BSW_Cal_Cal.ZDrive_BSW_Cal_VehicleInfomationTable.AccSens_LonAccSigDirect ZDrive_BSW_Cal_Cal.ZDrive_BSW_Cal_VehicleInfomationTable.StrWhlAngSigDirect ZDrive_BSW_Cal_Cal.ZDrive_BSW_Cal_VehicleInfomationTable.DriHandTorqueDirect ZDrive_BSW_Cal_Cal.ZDrive_BSW_Cal_VehicleInfomationTable.Vehicle_Information_Reserved_Line24 ZDrive_BSW_Cal_Cal.ZDrive_BSW_Cal_VehicleInfomationTable.Vehicle_Information_Reserved_Line25 ZDrive_BSW_Cal_Cal.ZDrive_BSW_Cal_VehicleInfomationTable.Vehicle_Information_Reserved_Line26 ZDrive_BSW_Cal_Cal.ZDrive_BSW_Cal_VehicleInfomationTable.ValFunc_Reserve1 ZDrive_BSW_Cal_Cal.ZDrive_BSW_Cal_VehicleInfomationTable.ValFunc_Reserve2 ZDrive_BSW_Cal_Cal.ZDrive_BSW_Cal_VehicleInfomationTable.ASU_Type ZDrive_BSW_Cal_Cal.ZDrive_BSW_Cal_VehicleInfomationTable.Suspension ZDrive_BSW_Cal_Cal.ZDrive_BSW_Cal_VehicleInfomationTable.Vehicle_Information_Reserved_Line31 ZDrive_BSW_Cal_Cal.ZDrive_BSW_Cal_VehicleInfomationTable.Vehicle_Information_Reserved_Line32 ZDrive_BSW_Cal_Cal.ZDrive_BSW_Cal_VehicleInfomationTable.Vehicle_Information_Reserved_Line33 ZDrive_BSW_Cal_Cal.ZDrive_BSW_Cal_VehicleInfomationTable.Vehicle_Information_Reserved_Line34 ZDrive_BSW_Cal_Cal.ZDrive_BSW_Cal_VehicleInfomationTable.Vehicle_Information_Reserved_Line35 ZDrive_BSW_Cal_Cal.ZDrive_BSW_Cal_VehicleInfomationTable.Vehicle_Information_Reserved_Line36 ZDrive_BSW_Cal_Cal.ZDrive_BSW_Cal_VehicleInfomationTable.Vehicle_Information_Reserved_Line37 ZDrive_BSW_Cal_Cal.ZDrive_BSW_Cal_VehicleInfomationTable.Vehicle_Length_m ZDrive_BSW_Cal_Cal.ZDrive_BSW_Cal_VehicleInfomationTable.VehicleWidthMax_m ZDrive_BSW_Cal_Cal.ZDrive_BSW_Cal_VehicleInfomationTable.VehicleWidthMin_m ZDrive_BSW_Cal_Cal.ZDrive_BSW_Cal_VehicleInfomationTable.Height_m ZDrive_BSW_Cal_Cal.ZDrive_BSW_Cal_VehicleInfomationTable.EngineMaxiTorque_N ZDrive_BSW_Cal_Cal.ZDrive_BSW_Cal_VehicleInfomationTable.WheelBase_m ZDrive_BSW_Cal_Cal.ZDrive_BSW_Cal_VehicleInfomationTable.FrontAxleToRearAxLeCenterX_m ZDrive_BSW_Cal_Cal.ZDrive_BSW_Cal_VehicleInfomationTable.WheelTrack_m ZDrive_BSW_Cal_Cal.ZDrive_BSW_Cal_VehicleInfomationTable.FrWhlTrack_m ZDrive_BSW_Cal_Cal.ZDrive_BSW_Cal_VehicleInfomationTable.ReWhlTrack_m ZDrive_BSW_Cal_Cal.ZDrive_BSW_Cal_VehicleInfomationTable.FrontOverhang_Length_m ZDrive_BSW_Cal_Cal.ZDrive_BSW_Cal_VehicleInfomationTable.RearOverhang_Length_m ZDrive_BSW_Cal_Cal.ZDrive_BSW_Cal_VehicleInfomationTable.FrWhlHousingHeight_m ZDrive_BSW_Cal_Cal.ZDrive_BSW_Cal_VehicleInfomationTable.ReWhlHousingHeight_m ZDrive_BSW_Cal_Cal.ZDrive_BSW_Cal_VehicleInfomationTable.DxvRearBumper_m ZDrive_BSW_Cal_Cal.ZDrive_BSW_Cal_VehicleInfomationTable.DxvFrontBumper_m ZDrive_BSW_Cal_Cal.ZDrive_BSW_Cal_VehicleInfomationTable.FrontAxleToCenter_m ZDrive_BSW_Cal_Cal.ZDrive_BSW_Cal_VehicleInfomationTable.RearAxleToCenter_m ZDrive_BSW_Cal_Cal.ZDrive_BSW_Cal_VehicleInfomationTable.RearViewMirrorLength_On_Y ZDrive_BSW_Cal_Cal.ZDrive_BSW_Cal_VehicleInfomationTable.RearViewMirrorLength_On_X ZDrive_BSW_Cal_Cal.ZDrive_BSW_Cal_VehicleInfomationTable.RearViewMirrorTopSide_Height ZDrive_BSW_Cal_Cal.ZDrive_BSW_Cal_VehicleInfomationTable.RearViewMirrorBottomSide_Height ZDrive_BSW_Cal_Cal.ZDrive_BSW_Cal_VehicleInfomationTable.RearViewMirrorOutsidePointToRearAxle_Diatance_m ZDrive_BSW_Cal_Cal.ZDrive_BSW_Cal_VehicleInfomationTable.FrontLeftFrontPointToRearAxleCenter_Distance_m ZDrive_BSW_Cal_Cal.ZDrive_BSW_Cal_VehicleInfomationTable.FrontLeftFrontPointToCenterLine_Distance_m ZDrive_BSW_Cal_Cal.ZDrive_BSW_Cal_VehicleInfomationTable.FrontLeftOutsidePointToRearAxleCenter_Distance_m ZDrive_BSW_Cal_Cal.ZDrive_BSW_Cal_VehicleInfomationTable.FrontLeftOutsidePointToCenterLine_Distance_m ZDrive_BSW_Cal_Cal.ZDrive_BSW_Cal_VehicleInfomationTable.RearLeftOutsidePointToRearAxleCenter_Distance_m ZDrive_BSW_Cal_Cal.ZDrive_BSW_Cal_VehicleInfomationTable.RearLeftOutsidePointToCenterLine_Distance_m ZDrive_BSW_Cal_Cal.ZDrive_BSW_Cal_VehicleInfomationTable.RearLeftRearPointToRearAxleCenter_Distance_m ZDrive_BSW_Cal_Cal.ZDrive_BSW_Cal_VehicleInfomationTable.RearLeftRearPointToCenterLine_Distance_m ZDrive_BSW_Cal_Cal.ZDrive_BSW_Cal_VehicleInfomationTable.CURB_kg ZDrive_BSW_Cal_Cal.ZDrive_BSW_Cal_VehicleInfomationTable.Weight_N ZDrive_BSW_Cal_Cal.ZDrive_BSW_Cal_VehicleInfomationTable.GVW_kg ZDrive_BSW_Cal_Cal.ZDrive_BSW_Cal_VehicleInfomationTable.Empty_mass_kg ZDrive_BSW_Cal_Cal.ZDrive_BSW_Cal_VehicleInfomationTable.TireRadius_m ZDrive_BSW_Cal_Cal.ZDrive_BSW_Cal_VehicleInfomationTable.IEnvironment_WheelWidth ZDrive_BSW_Cal_Cal.ZDrive_BSW_Cal_VehicleInfomationTable.WheelDiameter ZDrive_BSW_Cal_Cal.ZDrive_BSW_Cal_VehicleInfomationTable.WhlSpdSensUnitPulseDist ZDrive_BSW_Cal_Cal.ZDrive_BSW_Cal_VehicleInfomationTable.WheelSpeedCounterMax ZDrive_BSW_Cal_Cal.ZDrive_BSW_Cal_VehicleInfomationTable.WheelSpeedCounterPulse ZDrive_BSW_Cal_Cal.ZDrive_BSW_Cal_VehicleInfomationTable.WheelSpeedCounterIsUnsigned ZDrive_BSW_Cal_Cal.ZDrive_BSW_Cal_VehicleInfomationTable.WheelSpeedCounterMin ZDrive_BSW_Cal_Cal.ZDrive_BSW_Cal_VehicleInfomationTable.Vehicle_Information_Reserved_Line81 ZDrive_BSW_Cal_Cal.ZDrive_BSW_Cal_VehicleInfomationTable.Vehicle_Information_Reserved_Line82 ZDrive_BSW_Cal_Cal.ZDrive_BSW_Cal_VehicleInfomationTable.CharSpd_mps ZDrive_BSW_Cal_Cal.ZDrive_BSW_Cal_VehicleInfomationTable.SideSlipAnglefactor ZDrive_BSW_Cal_Cal.ZDrive_BSW_Cal_VehicleInfomationTable.MaxSteeringAngle ZDrive_BSW_Cal_Cal.ZDrive_BSW_Cal_VehicleInfomationTable.SteeringAngleRatio ZDrive_BSW_Cal_Cal.ZDrive_BSW_Cal_VehicleInfomationTable.RearAxlecCenterTurningCircle ZDrive_BSW_Cal_Cal.ZDrive_BSW_Cal_VehicleInfomationTable.StrWhlMappingTable ZDrive_BSW_Cal_Cal.ZDrive_BSW_Cal_VehicleInfomationTable.FRollingRadius_m ZDrive_BSW_Cal_Cal.ZDrive_BSW_Cal_VehicleInfomationTable.RRollingRadius_m ZDrive_BSW_Cal_Cal.ZDrive_BSW_Cal_VehicleInfomationTable.PowerTransRatio ZDrive_BSW_Cal_Cal.ZDrive_BSW_Cal_VehicleInfomationTable.TAC_Camera_Height ZDrive_BSW_Cal_Cal.ZDrive_BSW_Cal_VehicleInfomationTable.IEnvironment_CamToFrontAxle ZDrive_BSW_Cal_Cal.ZDrive_BSW_Cal_VehicleInfomationTable.FCFocus2FrAxleDist_Y_m ZDrive_BSW_Cal_Cal.ZDrive_BSW_Cal_VehicleInfomationTable.FCFocus2FrAxleDist_Z_m ZDrive_BSW_Cal_Cal.ZDrive_BSW_Cal_VehicleInfomationTable.FC2RearAxisX_m ZDrive_BSW_Cal_Cal.ZDrive_BSW_Cal_VehicleInfomationTable.FC2RearAxisY_m ZDrive_BSW_Cal_Cal.ZDrive_BSW_Cal_VehicleInfomationTable.CamDistToRearAxleCenter_DZ ZDrive_BSW_Cal_Cal.ZDrive_BSW_Cal_VehicleInfomationTable.FCFirstViewPointDist_m ZDrive_BSW_Cal_Cal.ZDrive_BSW_Cal_VehicleInfomationTable.IEnvironment_RefPX_Front_Bumper ZDrive_BSW_Cal_Cal.ZDrive_BSW_Cal_VehicleInfomationTable.TAC_Bottom ZDrive_BSW_Cal_Cal.ZDrive_BSW_Cal_VehicleInfomationTable.Vehicle_Information_Reserved_Line102 ZDrive_BSW_Cal_Cal.ZDrive_BSW_Cal_VehicleInfomationTable.IEnviroment_Top_Crop ZDrive_BSW_Cal_Cal.ZDrive_BSW_Cal_VehicleInfomationTable.IEnviroment_Bottom_Crop ZDrive_BSW_Cal_Cal.ZDrive_BSW_Cal_VehicleInfomationTable.Vehicle_Information_Reserved_Line105 ZDrive_BSW_Cal_Cal.ZDrive_BSW_Cal_VehicleInfomationTable.FC2LeftWheel_m ZDrive_BSW_Cal_Cal.ZDrive_BSW_Cal_VehicleInfomationTable.FC2RightWheel_m ZDrive_BSW_Cal_Cal.ZDrive_BSW_Cal_VehicleInfomationTable.TAC_Targets_Num ZDrive_BSW_Cal_Cal.ZDrive_BSW_Cal_VehicleInfomationTable.Vehicle_Information_Reserved_Line109 ZDrive_BSW_Cal_Cal.ZDrive_BSW_Cal_VehicleInfomationTable.Vehicle_Information_Reserved_Line110 ZDrive_BSW_Cal_Cal.ZDrive_BSW_Cal_VehicleInfomationTable.camera_x_m ZDrive_BSW_Cal_Cal.ZDrive_BSW_Cal_VehicleInfomationTable.camera_y_m ZDrive_BSW_Cal_Cal.ZDrive_BSW_Cal_VehicleInfomationTable.camera_z_m ZDrive_BSW_Cal_Cal.ZDrive_BSW_Cal_VehicleInfomationTable.translation_x_m ZDrive_BSW_Cal_Cal.ZDrive_BSW_Cal_VehicleInfomationTable.Vehicle_Information_Reserved_Line115 ZDrive_BSW_Cal_Cal.ZDrive_BSW_Cal_VehicleInfomationTable.RollingAngOfCAD ZDrive_BSW_Cal_Cal.ZDrive_BSW_Cal_VehicleInfomationTable.PitchAngOfCAD ZDrive_BSW_Cal_Cal.ZDrive_BSW_Cal_VehicleInfomationTable.YawAngOfCAD ZDrive_BSW_Cal_Cal.ZDrive_BSW_Cal_VehicleInfomationTable.FrontShortCamera_Dx ZDrive_BSW_Cal_Cal.ZDrive_BSW_Cal_VehicleInfomationTable.FrontShortCamera_Dy ZDrive_BSW_Cal_Cal.ZDrive_BSW_Cal_VehicleInfomationTable.FrontShortCamera_Dz ZDrive_BSW_Cal_Cal.ZDrive_BSW_Cal_VehicleInfomationTable.Vehicle_Information_Reserved_Line122 ZDrive_BSW_Cal_Cal.ZDrive_BSW_Cal_VehicleInfomationTable.FrontShortCamera_Roll ZDrive_BSW_Cal_Cal.ZDrive_BSW_Cal_VehicleInfomationTable.FrontShortCamera_Pitch ZDrive_BSW_Cal_Cal.ZDrive_BSW_Cal_VehicleInfomationTable.FrontShortCamera_Yaw ZDrive_BSW_Cal_Cal.ZDrive_BSW_Cal_VehicleInfomationTable.FrSCBlindSpotLength_m ZDrive_BSW_Cal_Cal.ZDrive_BSW_Cal_VehicleInfomationTable.FrSCDist2OuterMostSide_m ZDrive_BSW_Cal_Cal.ZDrive_BSW_Cal_VehicleInfomationTable.LeftShortCamera_Dx ZDrive_BSW_Cal_Cal.ZDrive_BSW_Cal_VehicleInfomationTable.LeftShortCamera_Dy ZDrive_BSW_Cal_Cal.ZDrive_BSW_Cal_VehicleInfomationTable.LeftShortCamera_Dz ZDrive_BSW_Cal_Cal.ZDrive_BSW_Cal_VehicleInfomationTable.Vehicle_Information_Reserved_Line131 ZDrive_BSW_Cal_Cal.ZDrive_BSW_Cal_VehicleInfomationTable.LeftShortCamera_Roll ZDrive_BSW_Cal_Cal.ZDrive_BSW_Cal_VehicleInfomationTable.LeftShortCamera_Pitch ZDrive_BSW_Cal_Cal.ZDrive_BSW_Cal_VehicleInfomationTable.LeftShortCamera_Yaw ZDrive_BSW_Cal_Cal.ZDrive_BSW_Cal_VehicleInfomationTable.LeSCBlindSpotLength_m ZDrive_BSW_Cal_Cal.ZDrive_BSW_Cal_VehicleInfomationTable.LeSCVerticalDist2Body_m ZDrive_BSW_Cal_Cal.ZDrive_BSW_Cal_VehicleInfomationTable.RearShortCamera_Dx ZDrive_BSW_Cal_Cal.ZDrive_BSW_Cal_VehicleInfomationTable.RearShortCamera_Dy ZDrive_BSW_Cal_Cal.ZDrive_BSW_Cal_VehicleInfomationTable.RearShortCamera_Dz ZDrive_BSW_Cal_Cal.ZDrive_BSW_Cal_VehicleInfomationTable.Vehicle_Information_Reserved_Line140 ZDrive_BSW_Cal_Cal.ZDrive_BSW_Cal_VehicleInfomationTable.RearShortCamera_Roll ZDrive_BSW_Cal_Cal.ZDrive_BSW_Cal_VehicleInfomationTable.RearShortCamera_Pitch ZDrive_BSW_Cal_Cal.ZDrive_BSW_Cal_VehicleInfomationTable.RearShortCamera_Yaw ZDrive_BSW_Cal_Cal.ZDrive_BSW_Cal_VehicleInfomationTable.ReSCBlindSpotLength_m ZDrive_BSW_Cal_Cal.ZDrive_BSW_Cal_VehicleInfomationTable.ReSCDist2OuterMostSide_m ZDrive_BSW_Cal_Cal.ZDrive_BSW_Cal_VehicleInfomationTable.RightShortCamera_Dx ZDrive_BSW_Cal_Cal.ZDrive_BSW_Cal_VehicleInfomationTable.RightShortCamera_Dy ZDrive_BSW_Cal_Cal.ZDrive_BSW_Cal_VehicleInfomationTable.RightShortCamera_Dz ZDrive_BSW_Cal_Cal.ZDrive_BSW_Cal_VehicleInfomationTable.Vehicle_Information_Reserved_Line149 ZDrive_BSW_Cal_Cal.ZDrive_BSW_Cal_VehicleInfomationTable.RightShortCamera_Roll ZDrive_BSW_Cal_Cal.ZDrive_BSW_Cal_VehicleInfomationTable.RightShortCamera_Pitch ZDrive_BSW_Cal_Cal.ZDrive_BSW_Cal_VehicleInfomationTable.RightShortCamera_Yaw ZDrive_BSW_Cal_Cal.ZDrive_BSW_Cal_VehicleInfomationTable.RiSCBlindSpotLength_m ZDrive_BSW_Cal_Cal.ZDrive_BSW_Cal_VehicleInfomationTable.RiSCVerticalDist2Body_m ZDrive_BSW_Cal_Cal.ZDrive_BSW_Cal_VehicleInfomationTable.FrntLeSideUss_Dx ZDrive_BSW_Cal_Cal.ZDrive_BSW_Cal_VehicleInfomationTable.FrntLeSideUss_Dy ZDrive_BSW_Cal_Cal.ZDrive_BSW_Cal_VehicleInfomationTable.FrntLeSideUss_Dz ZDrive_BSW_Cal_Cal.ZDrive_BSW_Cal_VehicleInfomationTable.Vehicle_Information_Reserved_Line158 ZDrive_BSW_Cal_Cal.ZDrive_BSW_Cal_VehicleInfomationTable.FrntLeSideUss_Roll ZDrive_BSW_Cal_Cal.ZDrive_BSW_Cal_VehicleInfomationTable.FrntLeSideUss_Pitch ZDrive_BSW_Cal_Cal.ZDrive_BSW_Cal_VehicleInfomationTable.FrntLeSideUss_Yaw ZDrive_BSW_Cal_Cal.ZDrive_BSW_Cal_VehicleInfomationTable.FrntLeCrnrUss_Dx ZDrive_BSW_Cal_Cal.ZDrive_BSW_Cal_VehicleInfomationTable.FrntLeCrnrUss_Dy ZDrive_BSW_Cal_Cal.ZDrive_BSW_Cal_VehicleInfomationTable.FrntLeCrnrUss_Dz ZDrive_BSW_Cal_Cal.ZDrive_BSW_Cal_VehicleInfomationTable.Vehicle_Information_Reserved_Line165 ZDrive_BSW_Cal_Cal.ZDrive_BSW_Cal_VehicleInfomationTable.FrntLeCrnrUss_Roll ZDrive_BSW_Cal_Cal.ZDrive_BSW_Cal_VehicleInfomationTable.FrntLeCrnrUss_Pitch ZDrive_BSW_Cal_Cal.ZDrive_BSW_Cal_VehicleInfomationTable.FrntLeCrnrUss_Yaw ZDrive_BSW_Cal_Cal.ZDrive_BSW_Cal_VehicleInfomationTable.FrntLeMidUss_Dx ZDrive_BSW_Cal_Cal.ZDrive_BSW_Cal_VehicleInfomationTable.FrntLeMidUss_Dy ZDrive_BSW_Cal_Cal.ZDrive_BSW_Cal_VehicleInfomationTable.FrntLeMidUss_Dz ZDrive_BSW_Cal_Cal.ZDrive_BSW_Cal_VehicleInfomationTable.Vehicle_Information_Reserved_Line172 ZDrive_BSW_Cal_Cal.ZDrive_BSW_Cal_VehicleInfomationTable.FrntLeMidUss_Roll ZDrive_BSW_Cal_Cal.ZDrive_BSW_Cal_VehicleInfomationTable.FrntLeMidUss_Pitch ZDrive_BSW_Cal_Cal.ZDrive_BSW_Cal_VehicleInfomationTable.FrntLeMidUss_Yaw ZDrive_BSW_Cal_Cal.ZDrive_BSW_Cal_VehicleInfomationTable.FrntRiMidUss_Dx ZDrive_BSW_Cal_Cal.ZDrive_BSW_Cal_VehicleInfomationTable.FrntRiMidUss_Dy ZDrive_BSW_Cal_Cal.ZDrive_BSW_Cal_VehicleInfomationTable.FrntRiMidUss_Dz ZDrive_BSW_Cal_Cal.ZDrive_BSW_Cal_VehicleInfomationTable.Vehicle_Information_Reserved_Line179 ZDrive_BSW_Cal_Cal.ZDrive_BSW_Cal_VehicleInfomationTable.FrntRiMidUss_Roll ZDrive_BSW_Cal_Cal.ZDrive_BSW_Cal_VehicleInfomationTable.FrntRiMidUss_Pitch ZDrive_BSW_Cal_Cal.ZDrive_BSW_Cal_VehicleInfomationTable.FrntRiMidUss_Yaw ZDrive_BSW_Cal_Cal.ZDrive_BSW_Cal_VehicleInfomationTable.FrntRiCrnrUss_Dx ZDrive_BSW_Cal_Cal.ZDrive_BSW_Cal_VehicleInfomationTable.FrntRiCrnrUss_Dy ZDrive_BSW_Cal_Cal.ZDrive_BSW_Cal_VehicleInfomationTable.FrntRiCrnrUss_Dz ZDrive_BSW_Cal_Cal.ZDrive_BSW_Cal_VehicleInfomationTable.Vehicle_Information_Reserved_Line186 ZDrive_BSW_Cal_Cal.ZDrive_BSW_Cal_VehicleInfomationTable.FrntRiCrnrUss_Roll ZDrive_BSW_Cal_Cal.ZDrive_BSW_Cal_VehicleInfomationTable.FrntRiCrnrUss_Pitch ZDrive_BSW_Cal_Cal.ZDrive_BSW_Cal_VehicleInfomationTable.FrntRiCrnrUss_Yaw ZDrive_BSW_Cal_Cal.ZDrive_BSW_Cal_VehicleInfomationTable.FrntRiSideUss_Dx ZDrive_BSW_Cal_Cal.ZDrive_BSW_Cal_VehicleInfomationTable.FrntRiSideUss_Dy ZDrive_BSW_Cal_Cal.ZDrive_BSW_Cal_VehicleInfomationTable.FrntRiSideUss_Dz ZDrive_BSW_Cal_Cal.ZDrive_BSW_Cal_VehicleInfomationTable.Vehicle_Information_Reserved_Line193 ZDrive_BSW_Cal_Cal.ZDrive_BSW_Cal_VehicleInfomationTable.FrntRiSideUss_Roll ZDrive_BSW_Cal_Cal.ZDrive_BSW_Cal_VehicleInfomationTable.FrntRiSideUss_Pitch ZDrive_BSW_Cal_Cal.ZDrive_BSW_Cal_VehicleInfomationTable.FrntRiSideUss_Yaw ZDrive_BSW_Cal_Cal.ZDrive_BSW_Cal_VehicleInfomationTable.ReRiSideUss_Dx ZDrive_BSW_Cal_Cal.ZDrive_BSW_Cal_VehicleInfomationTable.ReRiSideUss_Dy ZDrive_BSW_Cal_Cal.ZDrive_BSW_Cal_VehicleInfomationTable.ReRiSideUss_Dz ZDrive_BSW_Cal_Cal.ZDrive_BSW_Cal_VehicleInfomationTable.Vehicle_Information_Reserved_Line200 ZDrive_BSW_Cal_Cal.ZDrive_BSW_Cal_VehicleInfomationTable.ReRiSideUss_Roll ZDrive_BSW_Cal_Cal.ZDrive_BSW_Cal_VehicleInfomationTable.ReRiSideUss_Pitch ZDrive_BSW_Cal_Cal.ZDrive_BSW_Cal_VehicleInfomationTable.ReRiSideUss_Yaw ZDrive_BSW_Cal_Cal.ZDrive_BSW_Cal_VehicleInfomationTable.ReRiCrnrUss_Dx ZDrive_BSW_Cal_Cal.ZDrive_BSW_Cal_VehicleInfomationTable.ReRiCrnrUss_Dy ZDrive_BSW_Cal_Cal.ZDrive_BSW_Cal_VehicleInfomationTable.ReRiCrnrUss_Dz ZDrive_BSW_Cal_Cal.ZDrive_BSW_Cal_VehicleInfomationTable.Vehicle_Information_Reserved_Line207 ZDrive_BSW_Cal_Cal.ZDrive_BSW_Cal_VehicleInfomationTable.ReRiCrnrUss_Roll ZDrive_BSW_Cal_Cal.ZDrive_BSW_Cal_VehicleInfomationTable.ReRiCrnrUss_Pitch ZDrive_BSW_Cal_Cal.ZDrive_BSW_Cal_VehicleInfomationTable.ReRiCrnrUss_Yaw ZDrive_BSW_Cal_Cal.ZDrive_BSW_Cal_VehicleInfomationTable.ReRiMidUss_Dx ZDrive_BSW_Cal_Cal.ZDrive_BSW_Cal_VehicleInfomationTable.ReRiMidUss_Dy ZDrive_BSW_Cal_Cal.ZDrive_BSW_Cal_VehicleInfomationTable.ReRiMidUss_Dz ZDrive_BSW_Cal_Cal.ZDrive_BSW_Cal_VehicleInfomationTable.Vehicle_Information_Reserved_Line214 ZDrive_BSW_Cal_Cal.ZDrive_BSW_Cal_VehicleInfomationTable.ReRiMidUss_Roll ZDrive_BSW_Cal_Cal.ZDrive_BSW_Cal_VehicleInfomationTable.ReRiMidUss_Pitch ZDrive_BSW_Cal_Cal.ZDrive_BSW_Cal_VehicleInfomationTable.ReRiMidUss_Yaw ZDrive_BSW_Cal_Cal.ZDrive_BSW_Cal_VehicleInfomationTable.ReLeMidUss_Dx ZDrive_BSW_Cal_Cal.ZDrive_BSW_Cal_VehicleInfomationTable.ReLeMidUss_Dy ZDrive_BSW_Cal_Cal.ZDrive_BSW_Cal_VehicleInfomationTable.ReLeMidUss_Dz ZDrive_BSW_Cal_Cal.ZDrive_BSW_Cal_VehicleInfomationTable.Vehicle_Information_Reserved_Line221 ZDrive_BSW_Cal_Cal.ZDrive_BSW_Cal_VehicleInfomationTable.ReLeMidUss_Roll ZDrive_BSW_Cal_Cal.ZDrive_BSW_Cal_VehicleInfomationTable.ReLeMidUss_Pitch ZDrive_BSW_Cal_Cal.ZDrive_BSW_Cal_VehicleInfomationTable.ReLeMidUss_Yaw ZDrive_BSW_Cal_Cal.ZDrive_BSW_Cal_VehicleInfomationTable.ReLeCrnrUss_Dx ZDrive_BSW_Cal_Cal.ZDrive_BSW_Cal_VehicleInfomationTable.ReLeCrnrUss_Dy ZDrive_BSW_Cal_Cal.ZDrive_BSW_Cal_VehicleInfomationTable.ReLeCrnrUss_Dz ZDrive_BSW_Cal_Cal.ZDrive_BSW_Cal_VehicleInfomationTable.Vehicle_Information_Reserved_Line228 ZDrive_BSW_Cal_Cal.ZDrive_BSW_Cal_VehicleInfomationTable.ReLeCrnrUss_Roll ZDrive_BSW_Cal_Cal.ZDrive_BSW_Cal_VehicleInfomationTable.ReLeCrnrUss_Pitch ZDrive_BSW_Cal_Cal.ZDrive_BSW_Cal_VehicleInfomationTable.ReLeCrnrUss_Yaw ZDrive_BSW_Cal_Cal.ZDrive_BSW_Cal_VehicleInfomationTable.ReLeSideUss_Dx ZDrive_BSW_Cal_Cal.ZDrive_BSW_Cal_VehicleInfomationTable.ReLeSideUss_Dy ZDrive_BSW_Cal_Cal.ZDrive_BSW_Cal_VehicleInfomationTable.ReLeSideUss_Dz ZDrive_BSW_Cal_Cal.ZDrive_BSW_Cal_VehicleInfomationTable.Vehicle_Information_Reserved_Line235 ZDrive_BSW_Cal_Cal.ZDrive_BSW_Cal_VehicleInfomationTable.ReLeSideUss_Roll ZDrive_BSW_Cal_Cal.ZDrive_BSW_Cal_VehicleInfomationTable.ReLeSideUss_Pitch ZDrive_BSW_Cal_Cal.ZDrive_BSW_Cal_VehicleInfomationTable.ReLeSideUss_Yaw ZDrive_BSW_Cal_Cal.ZDrive_BSW_Cal_VehicleInfomationTable.UltraInstallAng_FM ZDrive_BSW_Cal_Cal.ZDrive_BSW_Cal_VehicleInfomationTable.UltraInstallAng_FA ZDrive_BSW_Cal_Cal.ZDrive_BSW_Cal_VehicleInfomationTable.UltraInstallAng_FS ZDrive_BSW_Cal_Cal.ZDrive_BSW_Cal_VehicleInfomationTable.UltraInstallLatOffset_FM_m ZDrive_BSW_Cal_Cal.ZDrive_BSW_Cal_VehicleInfomationTable.UltraInstallLatOffset_FA_m ZDrive_BSW_Cal_Cal.ZDrive_BSW_Cal_VehicleInfomationTable.UltraInstallLatOffset_FS_m ZDrive_BSW_Cal_Cal.ZDrive_BSW_Cal_VehicleInfomationTable.Vehicle_Information_Reserved_Line245 ZDrive_BSW_Cal_Cal.ZDrive_BSW_Cal_VehicleInfomationTable.UltraInstallAng_RM ZDrive_BSW_Cal_Cal.ZDrive_BSW_Cal_VehicleInfomationTable.UltraInstallAng_RA ZDrive_BSW_Cal_Cal.ZDrive_BSW_Cal_VehicleInfomationTable.UltraInstallAng_RS ZDrive_BSW_Cal_Cal.ZDrive_BSW_Cal_VehicleInfomationTable.UltraInstallLatOffset_RM_m ZDrive_BSW_Cal_Cal.ZDrive_BSW_Cal_VehicleInfomationTable.UltraInstallLatOffset_RA_m ZDrive_BSW_Cal_Cal.ZDrive_BSW_Cal_VehicleInfomationTable.UltraInstallLatOffset_RS_m ZDrive_BSW_Cal_Cal.ZDrive_BSW_Cal_VehicleInfomationTable.UltraInstallHeight_FM_m ZDrive_BSW_Cal_Cal.ZDrive_BSW_Cal_VehicleInfomationTable.UltraInstallHeight_FA_m ZDrive_BSW_Cal_Cal.ZDrive_BSW_Cal_VehicleInfomationTable.UltraInstallHeight_FS_m ZDrive_BSW_Cal_Cal.ZDrive_BSW_Cal_VehicleInfomationTable.UltraInstallHeight_RM_m ZDrive_BSW_Cal_Cal.ZDrive_BSW_Cal_VehicleInfomationTable.UltraInstallHeight_RA_m ZDrive_BSW_Cal_Cal.ZDrive_BSW_Cal_VehicleInfomationTable.UltraInstallHeight_RS_m ZDrive_BSW_Cal_Cal.ZDrive_BSW_Cal_VehicleInfomationTable.Vehicle_Information_Reserved_Line258 ZDrive_BSW_Cal_Cal.ZDrive_BSW_Cal_VehicleInfomationTable.VISION_MOUNT_PARAM_FRONT_X_POSITION ZDrive_BSW_Cal_Cal.ZDrive_BSW_Cal_VehicleInfomationTable.VISION_MOUNT_PARAM_FRONT_Y_POSITION ZDrive_BSW_Cal_Cal.ZDrive_BSW_Cal_VehicleInfomationTable.VISION_MOUNT_PARAM_FRONT_YAW_ANGLE /end REF_CHARACTERISTIC
/end GROUP
/begin RECORD_LAYOUT Record_FLOAT32_IEEE FNC_VALUES 1 FLOAT32_IEEE COLUMN_DIR DIRECT /end RECORD_LAYOUT
/begin RECORD_LAYOUT Record_SBYTE FNC_VALUES 1 SBYTE COLUMN_DIR DIRECT /end RECORD_LAYOUT
/begin RECORD_LAYOUT Record_SWORD FNC_VALUES 1 SWORD COLUMN_DIR DIRECT /end RECORD_LAYOUT
/begin RECORD_LAYOUT Record_UBYTE FNC_VALUES 1 UBYTE COLUMN_DIR DIRECT /end RECORD_LAYOUT
/begin RECORD_LAYOUT Record_ULONG FNC_VALUES 1 ULONG COLUMN_DIR DIRECT /end RECORD_LAYOUT
/begin RECORD_LAYOUT Record_UWORD FNC_VALUES 1 UWORD COLUMN_DIR DIRECT /end RECORD_LAYOUT
/begin GROUP ZDrive_BSW_Cal_Cal.ZDrive_BSW_Cal_VehicleInfomationTable ""
 /begin REF_CHARACTERISTIC ZDrive_BSW_Cal_Cal.ZDrive_BSW_Cal_VehicleInfomationTable.ParkingBrakeType ZDrive_BSW_Cal_Cal.ZDrive_BSW_Cal_VehicleInfomationTable.StrWhlConfig ZDrive_BSW_Cal_Cal.ZDrive_BSW_Cal_VehicleInfomationTable.ParkingLongControlInterForm ZDrive_BSW_Cal_Cal.ZDrive_BSW_Cal_VehicleInfomationTable.Driving_Type ZDrive_BSW_Cal_Cal.ZDrive_BSW_Cal_VehicleInfomationTable.Left_Right_handType ZDrive_BSW_Cal_Cal.ZDrive_BSW_Cal_VehicleInfomationTable.AutoHold_Type ZDrive_BSW_Cal_Cal.ZDrive_BSW_Cal_VehicleInfomationTable.AccSens_LatAccSigDirect ZDrive_BSW_Cal_Cal.ZDrive_BSW_Cal_VehicleInfomationTable.AccSens_LonAccSigDirect ZDrive_BSW_Cal_Cal.ZDrive_BSW_Cal_VehicleInfomationTable.StrWhlAngSigDirect ZDrive_BSW_Cal_Cal.ZDrive_BSW_Cal_VehicleInfomationTable.DriHandTorqueDirect ZDrive_BSW_Cal_Cal.ZDrive_BSW_Cal_VehicleInfomationTable.Vehicle_Information_Reserved_Line26 ZDrive_BSW_Cal_Cal.ZDrive_BSW_Cal_VehicleInfomationTable.ValFunc_Reserve1 ZDrive_BSW_Cal_Cal.ZDrive_BSW_Cal_VehicleInfomationTable.ValFunc_Reserve2 ZDrive_BSW_Cal_Cal.ZDrive_BSW_Cal_VehicleInfomationTable.ASU_Type ZDrive_BSW_Cal_Cal.ZDrive_BSW_Cal_VehicleInfomationTable.Suspension ZDrive_BSW_Cal_Cal.ZDrive_BSW_Cal_VehicleInfomationTable.Vehicle_Information_Reserved_Line31 ZDrive_BSW_Cal_Cal.ZDrive_BSW_Cal_VehicleInfomationTable.Vehicle_Information_Reserved_Line32 ZDrive_BSW_Cal_Cal.ZDrive_BSW_Cal_VehicleInfomationTable.Vehicle_Information_Reserved_Line33 ZDrive_BSW_Cal_Cal.ZDrive_BSW_Cal_VehicleInfomationTable.Vehicle_Information_Reserved_Line34 ZDrive_BSW_Cal_Cal.ZDrive_BSW_Cal_VehicleInfomationTable.Vehicle_Information_Reserved_Line35 ZDrive_BSW_Cal_Cal.ZDrive_BSW_Cal_VehicleInfomationTable.Vehicle_Information_Reserved_Line36 ZDrive_BSW_Cal_Cal.ZDrive_BSW_Cal_VehicleInfomationTable.Vehicle_Information_Reserved_Line37 ZDrive_BSW_Cal_Cal.ZDrive_BSW_Cal_VehicleInfomationTable.Vehicle_Length_m ZDrive_BSW_Cal_Cal.ZDrive_BSW_Cal_VehicleInfomationTable.VehicleWidthMax_m ZDrive_BSW_Cal_Cal.ZDrive_BSW_Cal_VehicleInfomationTable.VehicleWidthMin_m ZDrive_BSW_Cal_Cal.ZDrive_BSW_Cal_VehicleInfomationTable.Height_m ZDrive_BSW_Cal_Cal.ZDrive_BSW_Cal_VehicleInfomationTable.EngineMaxiTorque_N ZDrive_BSW_Cal_Cal.ZDrive_BSW_Cal_VehicleInfomationTable.WheelBase_m ZDrive_BSW_Cal_Cal.ZDrive_BSW_Cal_VehicleInfomationTable.FrontAxleToRearAxLeCenterX_m ZDrive_BSW_Cal_Cal.ZDrive_BSW_Cal_VehicleInfomationTable.WheelTrack_m ZDrive_BSW_Cal_Cal.ZDrive_BSW_Cal_VehicleInfomationTable.FrWhlTrack_m ZDrive_BSW_Cal_Cal.ZDrive_BSW_Cal_VehicleInfomationTable.ReWhlTrack_m ZDrive_BSW_Cal_Cal.ZDrive_BSW_Cal_VehicleInfomationTable.FrontOverhang_Length_m ZDrive_BSW_Cal_Cal.ZDrive_BSW_Cal_VehicleInfomationTable.RearOverhang_Length_m ZDrive_BSW_Cal_Cal.ZDrive_BSW_Cal_VehicleInfomationTable.FrWhlHousingHeight_m ZDrive_BSW_Cal_Cal.ZDrive_BSW_Cal_VehicleInfomationTable.ReWhlHousingHeight_m ZDrive_BSW_Cal_Cal.ZDrive_BSW_Cal_VehicleInfomationTable.DxvRearBumper_m ZDrive_BSW_Cal_Cal.ZDrive_BSW_Cal_VehicleInfomationTable.DxvFrontBumper_m ZDrive_BSW_Cal_Cal.ZDrive_BSW_Cal_VehicleInfomationTable.FrontAxleToCenter_m ZDrive_BSW_Cal_Cal.ZDrive_BSW_Cal_VehicleInfomationTable.RearAxleToCenter_m ZDrive_BSW_Cal_Cal.ZDrive_BSW_Cal_VehicleInfomationTable.RearViewMirrorLength_On_Y ZDrive_BSW_Cal_Cal.ZDrive_BSW_Cal_VehicleInfomationTable.RearViewMirrorLength_On_X ZDrive_BSW_Cal_Cal.ZDrive_BSW_Cal_VehicleInfomationTable.RearViewMirrorTopSide_Height ZDrive_BSW_Cal_Cal.ZDrive_BSW_Cal_VehicleInfomationTable.RearViewMirrorBottomSide_Height ZDrive_BSW_Cal_Cal.ZDrive_BSW_Cal_VehicleInfomationTable.RearViewMirrorOutsidePointToRearAxle_Diatance_m ZDrive_BSW_Cal_Cal.ZDrive_BSW_Cal_VehicleInfomationTable.FrontLeftFrontPointToRearAxleCenter_Distance_m ZDrive_BSW_Cal_Cal.ZDrive_BSW_Cal_VehicleInfomationTable.FrontLeftFrontPointToCenterLine_Distance_m ZDrive_BSW_Cal_Cal.ZDrive_BSW_Cal_VehicleInfomationTable.FrontLeftOutsidePointToRearAxleCenter_Distance_m ZDrive_BSW_Cal_Cal.ZDrive_BSW_Cal_VehicleInfomationTable.FrontLeftOutsidePointToCenterLine_Distance_m ZDrive_BSW_Cal_Cal.ZDrive_BSW_Cal_VehicleInfomationTable.RearLeftOutsidePointToRearAxleCenter_Distance_m ZDrive_BSW_Cal_Cal.ZDrive_BSW_Cal_VehicleInfomationTable.RearLeftOutsidePointToCenterLine_Distance_m ZDrive_BSW_Cal_Cal.ZDrive_BSW_Cal_VehicleInfomationTable.RearLeftRearPointToRearAxleCenter_Distance_m ZDrive_BSW_Cal_Cal.ZDrive_BSW_Cal_VehicleInfomationTable.RearLeftRearPointToCenterLine_Distance_m ZDrive_BSW_Cal_Cal.ZDrive_BSW_Cal_VehicleInfomationTable.CURB_kg ZDrive_BSW_Cal_Cal.ZDrive_BSW_Cal_VehicleInfomationTable.Weight_N ZDrive_BSW_Cal_Cal.ZDrive_BSW_Cal_VehicleInfomationTable.GVW_kg ZDrive_BSW_Cal_Cal.ZDrive_BSW_Cal_VehicleInfomationTable.Empty_mass_kg ZDrive_BSW_Cal_Cal.ZDrive_BSW_Cal_VehicleInfomationTable.TireRadius_m ZDrive_BSW_Cal_Cal.ZDrive_BSW_Cal_VehicleInfomationTable.IEnvironment_WheelWidth ZDrive_BSW_Cal_Cal.ZDrive_BSW_Cal_VehicleInfomationTable.WheelDiameter ZDrive_BSW_Cal_Cal.ZDrive_BSW_Cal_VehicleInfomationTable.WhlSpdSensUnitPulseDist ZDrive_BSW_Cal_Cal.ZDrive_BSW_Cal_VehicleInfomationTable.WheelSpeedCounterMax ZDrive_BSW_Cal_Cal.ZDrive_BSW_Cal_VehicleInfomationTable.WheelSpeedCounterPulse ZDrive_BSW_Cal_Cal.ZDrive_BSW_Cal_VehicleInfomationTable.WheelSpeedCounterIsUnsigned ZDrive_BSW_Cal_Cal.ZDrive_BSW_Cal_VehicleInfomationTable.WheelSpeedCounterMin ZDrive_BSW_Cal_Cal.ZDrive_BSW_Cal_VehicleInfomationTable.Vehicle_Information_Reserved_Line81 ZDrive_BSW_Cal_Cal.ZDrive_BSW_Cal_VehicleInfomationTable.Vehicle_Information_Reserved_Line82 ZDrive_BSW_Cal_Cal.ZDrive_BSW_Cal_VehicleInfomationTable.CharSpd_mps ZDrive_BSW_Cal_Cal.ZDrive_BSW_Cal_VehicleInfomationTable.SideSlipAnglefactor ZDrive_BSW_Cal_Cal.ZDrive_BSW_Cal_VehicleInfomationTable.MaxSteeringAngle ZDrive_BSW_Cal_Cal.ZDrive_BSW_Cal_VehicleInfomationTable.SteeringAngleRatio ZDrive_BSW_Cal_Cal.ZDrive_BSW_Cal_VehicleInfomationTable.RearAxlecCenterTurningCircle ZDrive_BSW_Cal_Cal.ZDrive_BSW_Cal_VehicleInfomationTable.StrWhlMappingTable ZDrive_BSW_Cal_Cal.ZDrive_BSW_Cal_VehicleInfomationTable.FRollingRadius_m ZDrive_BSW_Cal_Cal.ZDrive_BSW_Cal_VehicleInfomationTable.RRollingRadius_m ZDrive_BSW_Cal_Cal.ZDrive_BSW_Cal_VehicleInfomationTable.PowerTransRatio ZDrive_BSW_Cal_Cal.ZDrive_BSW_Cal_VehicleInfomationTable.TAC_Camera_Height ZDrive_BSW_Cal_Cal.ZDrive_BSW_Cal_VehicleInfomationTable.IEnvironment_CamToFrontAxle ZDrive_BSW_Cal_Cal.ZDrive_BSW_Cal_VehicleInfomationTable.FCFocus2FrAxleDist_Y_m ZDrive_BSW_Cal_Cal.ZDrive_BSW_Cal_VehicleInfomationTable.FCFocus2FrAxleDist_Z_m ZDrive_BSW_Cal_Cal.ZDrive_BSW_Cal_VehicleInfomationTable.FC2RearAxisX_m ZDrive_BSW_Cal_Cal.ZDrive_BSW_Cal_VehicleInfomationTable.FC2RearAxisY_m ZDrive_BSW_Cal_Cal.ZDrive_BSW_Cal_VehicleInfomationTable.CamDistToRearAxleCenter_DZ ZDrive_BSW_Cal_Cal.ZDrive_BSW_Cal_VehicleInfomationTable.FCFirstViewPointDist_m ZDrive_BSW_Cal_Cal.ZDrive_BSW_Cal_VehicleInfomationTable.IEnvironment_RefPX_Front_Bumper ZDrive_BSW_Cal_Cal.ZDrive_BSW_Cal_VehicleInfomationTable.TAC_Bottom ZDrive_BSW_Cal_Cal.ZDrive_BSW_Cal_VehicleInfomationTable.Vehicle_Information_Reserved_Line102 ZDrive_BSW_Cal_Cal.ZDrive_BSW_Cal_VehicleInfomationTable.IEnviroment_Top_Crop ZDrive_BSW_Cal_Cal.ZDrive_BSW_Cal_VehicleInfomationTable.IEnviroment_Bottom_Crop ZDrive_BSW_Cal_Cal.ZDrive_BSW_Cal_VehicleInfomationTable.Vehicle_Information_Reserved_Line105 ZDrive_BSW_Cal_Cal.ZDrive_BSW_Cal_VehicleInfomationTable.FC2LeftWheel_m ZDrive_BSW_Cal_Cal.ZDrive_BSW_Cal_VehicleInfomationTable.FC2RightWheel_m ZDrive_BSW_Cal_Cal.ZDrive_BSW_Cal_VehicleInfomationTable.TAC_Targets_Num ZDrive_BSW_Cal_Cal.ZDrive_BSW_Cal_VehicleInfomationTable.Vehicle_Information_Reserved_Line109 ZDrive_BSW_Cal_Cal.ZDrive_BSW_Cal_VehicleInfomationTable.Vehicle_Information_Reserved_Line110 ZDrive_BSW_Cal_Cal.ZDrive_BSW_Cal_VehicleInfomationTable.camera_x_m ZDrive_BSW_Cal_Cal.ZDrive_BSW_Cal_VehicleInfomationTable.camera_y_m ZDrive_BSW_Cal_Cal.ZDrive_BSW_Cal_VehicleInfomationTable.camera_z_m ZDrive_BSW_Cal_Cal.ZDrive_BSW_Cal_VehicleInfomationTable.translation_x_m ZDrive_BSW_Cal_Cal.ZDrive_BSW_Cal_VehicleInfomationTable.Vehicle_Information_Reserved_Line115 ZDrive_BSW_Cal_Cal.ZDrive_BSW_Cal_VehicleInfomationTable.RollingAngOfCAD ZDrive_BSW_Cal_Cal.ZDrive_BSW_Cal_VehicleInfomationTable.PitchAngOfCAD ZDrive_BSW_Cal_Cal.ZDrive_BSW_Cal_VehicleInfomationTable.YawAngOfCAD ZDrive_BSW_Cal_Cal.ZDrive_BSW_Cal_VehicleInfomationTable.FrontShortCamera_Dx ZDrive_BSW_Cal_Cal.ZDrive_BSW_Cal_VehicleInfomationTable.FrontShortCamera_Dy ZDrive_BSW_Cal_Cal.ZDrive_BSW_Cal_VehicleInfomationTable.FrontShortCamera_Dz ZDrive_BSW_Cal_Cal.ZDrive_BSW_Cal_VehicleInfomationTable.Vehicle_Information_Reserved_Line122 ZDrive_BSW_Cal_Cal.ZDrive_BSW_Cal_VehicleInfomationTable.FrontShortCamera_Roll ZDrive_BSW_Cal_Cal.ZDrive_BSW_Cal_VehicleInfomationTable.FrontShortCamera_Pitch ZDrive_BSW_Cal_Cal.ZDrive_BSW_Cal_VehicleInfomationTable.FrontShortCamera_Yaw ZDrive_BSW_Cal_Cal.ZDrive_BSW_Cal_VehicleInfomationTable.FrSCBlindSpotLength_m ZDrive_BSW_Cal_Cal.ZDrive_BSW_Cal_VehicleInfomationTable.FrSCDist2OuterMostSide_m ZDrive_BSW_Cal_Cal.ZDrive_BSW_Cal_VehicleInfomationTable.LeftShortCamera_Dx ZDrive_BSW_Cal_Cal.ZDrive_BSW_Cal_VehicleInfomationTable.LeftShortCamera_Dy ZDrive_BSW_Cal_Cal.ZDrive_BSW_Cal_VehicleInfomationTable.LeftShortCamera_Dz ZDrive_BSW_Cal_Cal.ZDrive_BSW_Cal_VehicleInfomationTable.Vehicle_Information_Reserved_Line131 ZDrive_BSW_Cal_Cal.ZDrive_BSW_Cal_VehicleInfomationTable.LeftShortCamera_Roll ZDrive_BSW_Cal_Cal.ZDrive_BSW_Cal_VehicleInfomationTable.LeftShortCamera_Pitch ZDrive_BSW_Cal_Cal.ZDrive_BSW_Cal_VehicleInfomationTable.LeftShortCamera_Yaw ZDrive_BSW_Cal_Cal.ZDrive_BSW_Cal_VehicleInfomationTable.LeSCBlindSpotLength_m ZDrive_BSW_Cal_Cal.ZDrive_BSW_Cal_VehicleInfomationTable.LeSCVerticalDist2Body_m ZDrive_BSW_Cal_Cal.ZDrive_BSW_Cal_VehicleInfomationTable.RearShortCamera_Dx ZDrive_BSW_Cal_Cal.ZDrive_BSW_Cal_VehicleInfomationTable.RearShortCamera_Dy ZDrive_BSW_Cal_Cal.ZDrive_BSW_Cal_VehicleInfomationTable.RearShortCamera_Dz ZDrive_BSW_Cal_Cal.ZDrive_BSW_Cal_VehicleInfomationTable.Vehicle_Information_Reserved_Line140 ZDrive_BSW_Cal_Cal.ZDrive_BSW_Cal_VehicleInfomationTable.RearShortCamera_Roll ZDrive_BSW_Cal_Cal.ZDrive_BSW_Cal_VehicleInfomationTable.RearShortCamera_Pitch ZDrive_BSW_Cal_Cal.ZDrive_BSW_Cal_VehicleInfomationTable.RearShortCamera_Yaw ZDrive_BSW_Cal_Cal.ZDrive_BSW_Cal_VehicleInfomationTable.ReSCBlindSpotLength_m ZDrive_BSW_Cal_Cal.ZDrive_BSW_Cal_VehicleInfomationTable.ReSCDist2OuterMostSide_m ZDrive_BSW_Cal_Cal.ZDrive_BSW_Cal_VehicleInfomationTable.RightShortCamera_Dx ZDrive_BSW_Cal_Cal.ZDrive_BSW_Cal_VehicleInfomationTable.RightShortCamera_Dy ZDrive_BSW_Cal_Cal.ZDrive_BSW_Cal_VehicleInfomationTable.RightShortCamera_Dz ZDrive_BSW_Cal_Cal.ZDrive_BSW_Cal_VehicleInfomationTable.Vehicle_Information_Reserved_Line149 ZDrive_BSW_Cal_Cal.ZDrive_BSW_Cal_VehicleInfomationTable.RightShortCamera_Roll ZDrive_BSW_Cal_Cal.ZDrive_BSW_Cal_VehicleInfomationTable.RightShortCamera_Pitch ZDrive_BSW_Cal_Cal.ZDrive_BSW_Cal_VehicleInfomationTable.RightShortCamera_Yaw ZDrive_BSW_Cal_Cal.ZDrive_BSW_Cal_VehicleInfomationTable.RiSCBlindSpotLength_m ZDrive_BSW_Cal_Cal.ZDrive_BSW_Cal_VehicleInfomationTable.RiSCVerticalDist2Body_m ZDrive_BSW_Cal_Cal.ZDrive_BSW_Cal_VehicleInfomationTable.FrntLeSideUss_Dx ZDrive_BSW_Cal_Cal.ZDrive_BSW_Cal_VehicleInfomationTable.FrntLeSideUss_Dy ZDrive_BSW_Cal_Cal.ZDrive_BSW_Cal_VehicleInfomationTable.FrntLeSideUss_Dz ZDrive_BSW_Cal_Cal.ZDrive_BSW_Cal_VehicleInfomationTable.Vehicle_Information_Reserved_Line158 ZDrive_BSW_Cal_Cal.ZDrive_BSW_Cal_VehicleInfomationTable.FrntLeSideUss_Roll ZDrive_BSW_Cal_Cal.ZDrive_BSW_Cal_VehicleInfomationTable.FrntLeSideUss_Pitch ZDrive_BSW_Cal_Cal.ZDrive_BSW_Cal_VehicleInfomationTable.FrntLeSideUss_Yaw ZDrive_BSW_Cal_Cal.ZDrive_BSW_Cal_VehicleInfomationTable.FrntLeCrnrUss_Dx ZDrive_BSW_Cal_Cal.ZDrive_BSW_Cal_VehicleInfomationTable.FrntLeCrnrUss_Dy ZDrive_BSW_Cal_Cal.ZDrive_BSW_Cal_VehicleInfomationTable.FrntLeCrnrUss_Dz ZDrive_BSW_Cal_Cal.ZDrive_BSW_Cal_VehicleInfomationTable.Vehicle_Information_Reserved_Line165 ZDrive_BSW_Cal_Cal.ZDrive_BSW_Cal_VehicleInfomationTable.FrntLeCrnrUss_Roll ZDrive_BSW_Cal_Cal.ZDrive_BSW_Cal_VehicleInfomationTable.FrntLeCrnrUss_Pitch ZDrive_BSW_Cal_Cal.ZDrive_BSW_Cal_VehicleInfomationTable.FrntLeCrnrUss_Yaw ZDrive_BSW_Cal_Cal.ZDrive_BSW_Cal_VehicleInfomationTable.FrntLeMidUss_Dx ZDrive_BSW_Cal_Cal.ZDrive_BSW_Cal_VehicleInfomationTable.FrntLeMidUss_Dy ZDrive_BSW_Cal_Cal.ZDrive_BSW_Cal_VehicleInfomationTable.FrntLeMidUss_Dz ZDrive_BSW_Cal_Cal.ZDrive_BSW_Cal_VehicleInfomationTable.Vehicle_Information_Reserved_Line172 ZDrive_BSW_Cal_Cal.ZDrive_BSW_Cal_VehicleInfomationTable.FrntLeMidUss_Roll ZDrive_BSW_Cal_Cal.ZDrive_BSW_Cal_VehicleInfomationTable.FrntLeMidUss_Pitch ZDrive_BSW_Cal_Cal.ZDrive_BSW_Cal_VehicleInfomationTable.FrntLeMidUss_Yaw ZDrive_BSW_Cal_Cal.ZDrive_BSW_Cal_VehicleInfomationTable.FrntRiMidUss_Dx ZDrive_BSW_Cal_Cal.ZDrive_BSW_Cal_VehicleInfomationTable.FrntRiMidUss_Dy ZDrive_BSW_Cal_Cal.ZDrive_BSW_Cal_VehicleInfomationTable.FrntRiMidUss_Dz ZDrive_BSW_Cal_Cal.ZDrive_BSW_Cal_VehicleInfomationTable.Vehicle_Information_Reserved_Line179 ZDrive_BSW_Cal_Cal.ZDrive_BSW_Cal_VehicleInfomationTable.FrntRiMidUss_Roll ZDrive_BSW_Cal_Cal.ZDrive_BSW_Cal_VehicleInfomationTable.FrntRiMidUss_Pitch ZDrive_BSW_Cal_Cal.ZDrive_BSW_Cal_VehicleInfomationTable.FrntRiMidUss_Yaw ZDrive_BSW_Cal_Cal.ZDrive_BSW_Cal_VehicleInfomationTable.FrntRiCrnrUss_Dx ZDrive_BSW_Cal_Cal.ZDrive_BSW_Cal_VehicleInfomationTable.FrntRiCrnrUss_Dy ZDrive_BSW_Cal_Cal.ZDrive_BSW_Cal_VehicleInfomationTable.FrntRiCrnrUss_Dz ZDrive_BSW_Cal_Cal.ZDrive_BSW_Cal_VehicleInfomationTable.Vehicle_Information_Reserved_Line186 ZDrive_BSW_Cal_Cal.ZDrive_BSW_Cal_VehicleInfomationTable.FrntRiCrnrUss_Roll ZDrive_BSW_Cal_Cal.ZDrive_BSW_Cal_VehicleInfomationTable.FrntRiCrnrUss_Pitch ZDrive_BSW_Cal_Cal.ZDrive_BSW_Cal_VehicleInfomationTable.FrntRiCrnrUss_Yaw ZDrive_BSW_Cal_Cal.ZDrive_BSW_Cal_VehicleInfomationTable.FrntRiSideUss_Dx ZDrive_BSW_Cal_Cal.ZDrive_BSW_Cal_VehicleInfomationTable.FrntRiSideUss_Dy ZDrive_BSW_Cal_Cal.ZDrive_BSW_Cal_VehicleInfomationTable.FrntRiSideUss_Dz ZDrive_BSW_Cal_Cal.ZDrive_BSW_Cal_VehicleInfomationTable.Vehicle_Information_Reserved_Line193 ZDrive_BSW_Cal_Cal.ZDrive_BSW_Cal_VehicleInfomationTable.FrntRiSideUss_Roll ZDrive_BSW_Cal_Cal.ZDrive_BSW_Cal_VehicleInfomationTable.FrntRiSideUss_Pitch ZDrive_BSW_Cal_Cal.ZDrive_BSW_Cal_VehicleInfomationTable.FrntRiSideUss_Yaw ZDrive_BSW_Cal_Cal.ZDrive_BSW_Cal_VehicleInfomationTable.ReRiSideUss_Dx ZDrive_BSW_Cal_Cal.ZDrive_BSW_Cal_VehicleInfomationTable.ReRiSideUss_Dy ZDrive_BSW_Cal_Cal.ZDrive_BSW_Cal_VehicleInfomationTable.ReRiSideUss_Dz ZDrive_BSW_Cal_Cal.ZDrive_BSW_Cal_VehicleInfomationTable.Vehicle_Information_Reserved_Line200 ZDrive_BSW_Cal_Cal.ZDrive_BSW_Cal_VehicleInfomationTable.ReRiSideUss_Roll ZDrive_BSW_Cal_Cal.ZDrive_BSW_Cal_VehicleInfomationTable.ReRiSideUss_Pitch ZDrive_BSW_Cal_Cal.ZDrive_BSW_Cal_VehicleInfomationTable.ReRiSideUss_Yaw ZDrive_BSW_Cal_Cal.ZDrive_BSW_Cal_VehicleInfomationTable.ReRiCrnrUss_Dx ZDrive_BSW_Cal_Cal.ZDrive_BSW_Cal_VehicleInfomationTable.ReRiCrnrUss_Dy ZDrive_BSW_Cal_Cal.ZDrive_BSW_Cal_VehicleInfomationTable.ReRiCrnrUss_Dz ZDrive_BSW_Cal_Cal.ZDrive_BSW_Cal_VehicleInfomationTable.Vehicle_Information_Reserved_Line207 ZDrive_BSW_Cal_Cal.ZDrive_BSW_Cal_VehicleInfomationTable.ReRiCrnrUss_Roll ZDrive_BSW_Cal_Cal.ZDrive_BSW_Cal_VehicleInfomationTable.ReRiCrnrUss_Pitch ZDrive_BSW_Cal_Cal.ZDrive_BSW_Cal_VehicleInfomationTable.ReRiCrnrUss_Yaw ZDrive_BSW_Cal_Cal.ZDrive_BSW_Cal_VehicleInfomationTable.ReRiMidUss_Dx ZDrive_BSW_Cal_Cal.ZDrive_BSW_Cal_VehicleInfomationTable.ReRiMidUss_Dy ZDrive_BSW_Cal_Cal.ZDrive_BSW_Cal_VehicleInfomationTable.ReRiMidUss_Dz ZDrive_BSW_Cal_Cal.ZDrive_BSW_Cal_VehicleInfomationTable.Vehicle_Information_Reserved_Line214 ZDrive_BSW_Cal_Cal.ZDrive_BSW_Cal_VehicleInfomationTable.ReRiMidUss_Roll ZDrive_BSW_Cal_Cal.ZDrive_BSW_Cal_VehicleInfomationTable.ReRiMidUss_Pitch ZDrive_BSW_Cal_Cal.ZDrive_BSW_Cal_VehicleInfomationTable.ReRiMidUss_Yaw ZDrive_BSW_Cal_Cal.ZDrive_BSW_Cal_VehicleInfomationTable.ReLeMidUss_Dx ZDrive_BSW_Cal_Cal.ZDrive_BSW_Cal_VehicleInfomationTable.ReLeMidUss_Dy ZDrive_BSW_Cal_Cal.ZDrive_BSW_Cal_VehicleInfomationTable.ReLeMidUss_Dz ZDrive_BSW_Cal_Cal.ZDrive_BSW_Cal_VehicleInfomationTable.Vehicle_Information_Reserved_Line221 ZDrive_BSW_Cal_Cal.ZDrive_BSW_Cal_VehicleInfomationTable.ReLeMidUss_Roll ZDrive_BSW_Cal_Cal.ZDrive_BSW_Cal_VehicleInfomationTable.ReLeMidUss_Pitch ZDrive_BSW_Cal_Cal.ZDrive_BSW_Cal_VehicleInfomationTable.ReLeMidUss_Yaw ZDrive_BSW_Cal_Cal.ZDrive_BSW_Cal_VehicleInfomationTable.ReLeCrnrUss_Dx ZDrive_BSW_Cal_Cal.ZDrive_BSW_Cal_VehicleInfomationTable.ReLeCrnrUss_Dy ZDrive_BSW_Cal_Cal.ZDrive_BSW_Cal_VehicleInfomationTable.ReLeCrnrUss_Dz ZDrive_BSW_Cal_Cal.ZDrive_BSW_Cal_VehicleInfomationTable.Vehicle_Information_Reserved_Line228 ZDrive_BSW_Cal_Cal.ZDrive_BSW_Cal_VehicleInfomationTable.ReLeCrnrUss_Roll ZDrive_BSW_Cal_Cal.ZDrive_BSW_Cal_VehicleInfomationTable.ReLeCrnrUss_Pitch ZDrive_BSW_Cal_Cal.ZDrive_BSW_Cal_VehicleInfomationTable.ReLeCrnrUss_Yaw ZDrive_BSW_Cal_Cal.ZDrive_BSW_Cal_VehicleInfomationTable.ReLeSideUss_Dx ZDrive_BSW_Cal_Cal.ZDrive_BSW_Cal_VehicleInfomationTable.ReLeSideUss_Dy ZDrive_BSW_Cal_Cal.ZDrive_BSW_Cal_VehicleInfomationTable.ReLeSideUss_Dz ZDrive_BSW_Cal_Cal.ZDrive_BSW_Cal_VehicleInfomationTable.Vehicle_Information_Reserved_Line235 ZDrive_BSW_Cal_Cal.ZDrive_BSW_Cal_VehicleInfomationTable.ReLeSideUss_Roll ZDrive_BSW_Cal_Cal.ZDrive_BSW_Cal_VehicleInfomationTable.ReLeSideUss_Pitch ZDrive_BSW_Cal_Cal.ZDrive_BSW_Cal_VehicleInfomationTable.ReLeSideUss_Yaw ZDrive_BSW_Cal_Cal.ZDrive_BSW_Cal_VehicleInfomationTable.UltraInstallAng_FM ZDrive_BSW_Cal_Cal.ZDrive_BSW_Cal_VehicleInfomationTable.UltraInstallAng_FA ZDrive_BSW_Cal_Cal.ZDrive_BSW_Cal_VehicleInfomationTable.UltraInstallAng_FS ZDrive_BSW_Cal_Cal.ZDrive_BSW_Cal_VehicleInfomationTable.UltraInstallLatOffset_FM_m ZDrive_BSW_Cal_Cal.ZDrive_BSW_Cal_VehicleInfomationTable.UltraInstallLatOffset_FA_m ZDrive_BSW_Cal_Cal.ZDrive_BSW_Cal_VehicleInfomationTable.UltraInstallLatOffset_FS_m ZDrive_BSW_Cal_Cal.ZDrive_BSW_Cal_VehicleInfomationTable.Vehicle_Information_Reserved_Line245 ZDrive_BSW_Cal_Cal.ZDrive_BSW_Cal_VehicleInfomationTable.UltraInstallAng_RM ZDrive_BSW_Cal_Cal.ZDrive_BSW_Cal_VehicleInfomationTable.UltraInstallAng_RA ZDrive_BSW_Cal_Cal.ZDrive_BSW_Cal_VehicleInfomationTable.UltraInstallAng_RS ZDrive_BSW_Cal_Cal.ZDrive_BSW_Cal_VehicleInfomationTable.UltraInstallLatOffset_RM_m ZDrive_BSW_Cal_Cal.ZDrive_BSW_Cal_VehicleInfomationTable.UltraInstallLatOffset_RA_m ZDrive_BSW_Cal_Cal.ZDrive_BSW_Cal_VehicleInfomationTable.UltraInstallLatOffset_RS_m ZDrive_BSW_Cal_Cal.ZDrive_BSW_Cal_VehicleInfomationTable.UltraInstallHeight_FM_m ZDrive_BSW_Cal_Cal.ZDrive_BSW_Cal_VehicleInfomationTable.UltraInstallHeight_FA_m ZDrive_BSW_Cal_Cal.ZDrive_BSW_Cal_VehicleInfomationTable.UltraInstallHeight_FS_m ZDrive_BSW_Cal_Cal.ZDrive_BSW_Cal_VehicleInfomationTable.UltraInstallHeight_RM_m ZDrive_BSW_Cal_Cal.ZDrive_BSW_Cal_VehicleInfomationTable.UltraInstallHeight_RA_m ZDrive_BSW_Cal_Cal.ZDrive_BSW_Cal_VehicleInfomationTable.UltraInstallHeight_RS_m ZDrive_BSW_Cal_Cal.ZDrive_BSW_Cal_VehicleInfomationTable.Vehicle_Information_Reserved_Line258 ZDrive_BSW_Cal_Cal.ZDrive_BSW_Cal_VehicleInfomationTable.VISION_MOUNT_PARAM_FRONT_X_POSITION ZDrive_BSW_Cal_Cal.ZDrive_BSW_Cal_VehicleInfomationTable.VISION_MOUNT_PARAM_FRONT_Y_POSITION ZDrive_BSW_Cal_Cal.ZDrive_BSW_Cal_VehicleInfomationTable.VISION_MOUNT_PARAM_FRONT_YAW_ANGLE /end REF_CHARACTERISTIC
/end GROUP
/end MODULE
/end PROJECT
