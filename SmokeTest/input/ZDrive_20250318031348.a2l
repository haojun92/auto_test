ASAP2_VERSION 1 71
/begin PROJECT ProjectName ""
/begin MODULE ModuleName ""
/begin MOD_COMMON "" BYTE_ORDER MSB_LAST ALIGNMENT_BYTE 1 ALIGNMENT_WORD 1 ALIGNMENT_LONG 1 ALIGNMENT_INT64 1 ALIGNMENT_FLOAT16_IEEE 1 ALIGNMENT_FLOAT32_IEEE 1 ALIGNMENT_FLOAT64_IEEE 1 /end MOD_COMMON
/begin RECORD_LAYOUT Scalar_ULONG FNC_VALUES 1 ULONG COLUMN_DIR DIRECT /end RECORD_LAYOUT
/begin MEASUREMENT SwcIn_SysIn_HMI_ADASSetting.ADASSettingInfo.AEBSettingSt "" UBYTE autosar_swc_val_CM_uint8 0 0 0 255 ECU_ADDRESS 0xfe4ccce6 /* @ECU_Address@SwcIn_SysIn_HMI_ADASSetting.ADASSettingInfo.AEBSettingSt@ */ /end MEASUREMENT
/begin MEASUREMENT SwcIn_SysIn_HMI_ADASSetting.ADASSettingInfo.AMAPSettingSt "" UBYTE autosar_swc_val_CM_uint8 0 0 0 255 ECU_ADDRESS 0xfe4cccf0 /* @ECU_Address@SwcIn_SysIn_HMI_ADASSetting.ADASSettingInfo.AMAPSettingSt@ */ /end MEASUREMENT
/begin MEASUREMENT SwcIn_SysIn_HMI_ADASSetting.ADASSettingInfo.APASettingSt "" UBYTE autosar_swc_val_CM_uint8 0 0 0 255 ECU_ADDRESS 0xfe4cccf9 /* @ECU_Address@SwcIn_SysIn_HMI_ADASSetting.ADASSettingInfo.APASettingSt@ */ /end MEASUREMENT
/begin MEASUREMENT SwcIn_SysIn_HMI_ADASSetting.ADASSettingInfo.BSDSettingSt "" UBYTE autosar_swc_val_CM_uint8 0 0 0 255 ECU_ADDRESS 0xfe4cccea /* @ECU_Address@SwcIn_SysIn_HMI_ADASSetting.ADASSettingInfo.BSDSettingSt@ */ /end MEASUREMENT
/begin MEASUREMENT SwcIn_SysIn_HMI_ADASSetting.ADASSettingInfo.DOWSettingSt "" UBYTE autosar_swc_val_CM_uint8 0 0 0 255 ECU_ADDRESS 0xfe4ccceb /* @ECU_Address@SwcIn_SysIn_HMI_ADASSetting.ADASSettingInfo.DOWSettingSt@ */ /end MEASUREMENT
/begin MEASUREMENT SwcIn_SysIn_HMI_ADASSetting.ADASSettingInfo.DrivingVoiceRemindSettingSt "" UBYTE autosar_swc_val_CM_uint8 0 0 0 255 ECU_ADDRESS 0xfe4cccfb /* @ECU_Address@SwcIn_SysIn_HMI_ADASSetting.ADASSettingInfo.DrivingVoiceRemindSettingSt@ */ /end MEASUREMENT
/begin MEASUREMENT SwcIn_SysIn_HMI_ADASSetting.ADASSettingInfo.ELKSettingSt "" UBYTE autosar_swc_val_CM_uint8 0 0 0 255 ECU_ADDRESS 0xfe4ccce9 /* @ECU_Address@SwcIn_SysIn_HMI_ADASSetting.ADASSettingInfo.ELKSettingSt@ */ /end MEASUREMENT
/begin MEASUREMENT SwcIn_SysIn_HMI_ADASSetting.ADASSettingInfo.ESASettingSt "" UBYTE autosar_swc_val_CM_uint8 0 0 0 255 ECU_ADDRESS 0xfe4cccef /* @ECU_Address@SwcIn_SysIn_HMI_ADASSetting.ADASSettingInfo.ESASettingSt@ */ /end MEASUREMENT
/begin MEASUREMENT SwcIn_SysIn_HMI_ADASSetting.ADASSettingInfo.FCTAWarnType "" UBYTE autosar_swc_val_CM_uint8 0 0 0 255 ECU_ADDRESS 0xfe4ccced /* @ECU_Address@SwcIn_SysIn_HMI_ADASSetting.ADASSettingInfo.FCTAWarnType@ */ /end MEASUREMENT
/begin MEASUREMENT SwcIn_SysIn_HMI_ADASSetting.ADASSettingInfo.FCWSettingSt "" UBYTE autosar_swc_val_CM_uint8 0 0 0 255 ECU_ADDRESS 0xfe4ccce5 /* @ECU_Address@SwcIn_SysIn_HMI_ADASSetting.ADASSettingInfo.FCWSettingSt@ */ /end MEASUREMENT
/begin MEASUREMENT SwcIn_SysIn_HMI_ADASSetting.ADASSettingInfo.FCWWarnDistance "" UBYTE autosar_swc_val_CM_uint8 0 0 0 255 ECU_ADDRESS 0xfe4ccce4 /* @ECU_Address@SwcIn_SysIn_HMI_ADASSetting.ADASSettingInfo.FCWWarnDistance@ */ /end MEASUREMENT
/begin MEASUREMENT SwcIn_SysIn_HMI_ADASSetting.ADASSettingInfo.FSRACruiseSpdMod "" UBYTE autosar_swc_val_CM_uint8 0 0 0 255 ECU_ADDRESS 0xfe4cccdc /* @ECU_Address@SwcIn_SysIn_HMI_ADASSetting.ADASSettingInfo.FSRACruiseSpdMod@ */ /end MEASUREMENT
/begin MEASUREMENT SwcIn_SysIn_HMI_ADASSetting.ADASSettingInfo.FSRACruiseSpdOffsetMod "" UBYTE autosar_swc_val_CM_uint8 0 0 0 255 ECU_ADDRESS 0xfe4cccdd /* @ECU_Address@SwcIn_SysIn_HMI_ADASSetting.ADASSettingInfo.FSRACruiseSpdOffsetMod@ */ /end MEASUREMENT
/begin MEASUREMENT SwcIn_SysIn_HMI_ADASSetting.ADASSettingInfo.FSRACruiseSpdOffsetPercent "" SBYTE autosar_swc_val_CM_int8 0 0 -128 127 ECU_ADDRESS 0xfe4cccdf /* @ECU_Address@SwcIn_SysIn_HMI_ADASSetting.ADASSettingInfo.FSRACruiseSpdOffsetPercent@ */ /end MEASUREMENT
/begin MEASUREMENT SwcIn_SysIn_HMI_ADASSetting.ADASSettingInfo.FSRACruiseSpdOffsetSpd "" SBYTE autosar_swc_val_CM_int8 0 0 -128 127 ECU_ADDRESS 0xfe4cccde /* @ECU_Address@SwcIn_SysIn_HMI_ADASSetting.ADASSettingInfo.FSRACruiseSpdOffsetSpd@ */ /end MEASUREMENT
/begin MEASUREMENT SwcIn_SysIn_HMI_ADASSetting.ADASSettingInfo.FSRASpdSetMod "" UBYTE autosar_swc_val_CM_uint8 0 0 0 255 ECU_ADDRESS 0xfe4cccdb /* @ECU_Address@SwcIn_SysIn_HMI_ADASSetting.ADASSettingInfo.FSRASpdSetMod@ */ /end MEASUREMENT
/begin MEASUREMENT SwcIn_SysIn_HMI_ADASSetting.ADASSettingInfo.HODWarnSettingSt "" UBYTE autosar_swc_val_CM_uint8 0 0 0 255 ECU_ADDRESS 0xfe4cccec /* @ECU_Address@SwcIn_SysIn_HMI_ADASSetting.ADASSettingInfo.HODWarnSettingSt@ */ /end MEASUREMENT
/begin MEASUREMENT SwcIn_SysIn_HMI_ADASSetting.ADASSettingInfo.HPASettingSt "" UBYTE autosar_swc_val_CM_uint8 0 0 0 255 ECU_ADDRESS 0xfe4cccf7 /* @ECU_Address@SwcIn_SysIn_HMI_ADASSetting.ADASSettingInfo.HPASettingSt@ */ /end MEASUREMENT
/begin MEASUREMENT SwcIn_SysIn_HMI_ADASSetting.ADASSettingInfo.ICAEnableBtnSts "" UBYTE autosar_swc_val_CM_uint8 0 0 0 255 ECU_ADDRESS 0xfe4cccda /* @ECU_Address@SwcIn_SysIn_HMI_ADASSetting.ADASSettingInfo.ICAEnableBtnSts@ */ /end MEASUREMENT
/begin MEASUREMENT SwcIn_SysIn_HMI_ADASSetting.ADASSettingInfo.ISLICruiseSpdAbdOffset "" UBYTE autosar_swc_val_CM_uint8 0 0 0 255 ECU_ADDRESS 0xfe4ccce3 /* @ECU_Address@SwcIn_SysIn_HMI_ADASSetting.ADASSettingInfo.ISLICruiseSpdAbdOffset@ */ /end MEASUREMENT
/begin MEASUREMENT SwcIn_SysIn_HMI_ADASSetting.ADASSettingInfo.ISLICruiseSpdRelOffset "" SBYTE autosar_swc_val_CM_int8 0 0 -128 127 ECU_ADDRESS 0xfe4ccce2 /* @ECU_Address@SwcIn_SysIn_HMI_ADASSetting.ADASSettingInfo.ISLICruiseSpdRelOffset@ */ /end MEASUREMENT
/begin MEASUREMENT SwcIn_SysIn_HMI_ADASSetting.ADASSettingInfo.ISLISpdOffsetMod "" UBYTE autosar_swc_val_CM_uint8 0 0 0 255 ECU_ADDRESS 0xfe4ccce1 /* @ECU_Address@SwcIn_SysIn_HMI_ADASSetting.ADASSettingInfo.ISLISpdOffsetMod@ */ /end MEASUREMENT
/begin MEASUREMENT SwcIn_SysIn_HMI_ADASSetting.ADASSettingInfo.ISLIWarnMod "" UBYTE autosar_swc_val_CM_uint8 0 0 0 255 ECU_ADDRESS 0xfe4ccce0 /* @ECU_Address@SwcIn_SysIn_HMI_ADASSetting.ADASSettingInfo.ISLIWarnMod@ */ /end MEASUREMENT
/begin MEASUREMENT SwcIn_SysIn_HMI_ADASSetting.ADASSettingInfo.LDWWarnType "" UBYTE autosar_swc_val_CM_uint8 0 0 0 255 ECU_ADDRESS 0xfe4ccce8 /* @ECU_Address@SwcIn_SysIn_HMI_ADASSetting.ADASSettingInfo.LDWWarnType@ */ /end MEASUREMENT
/begin MEASUREMENT SwcIn_SysIn_HMI_ADASSetting.ADASSettingInfo.LKSSettingSt "" UBYTE autosar_swc_val_CM_uint8 0 0 0 255 ECU_ADDRESS 0xfe4ccce7 /* @ECU_Address@SwcIn_SysIn_HMI_ADASSetting.ADASSettingInfo.LKSSettingSt@ */ /end MEASUREMENT
/begin MEASUREMENT SwcIn_SysIn_HMI_ADASSetting.ADASSettingInfo.NOPEnableBtnSts "" UBYTE autosar_swc_val_CM_uint8 0 0 0 255 ECU_ADDRESS 0xfe4cccf1 /* @ECU_Address@SwcIn_SysIn_HMI_ADASSetting.ADASSettingInfo.NOPEnableBtnSts@ */ /end MEASUREMENT
/begin MEASUREMENT SwcIn_SysIn_HMI_ADASSetting.ADASSettingInfo.NOPLaneChangeMod "" UBYTE autosar_swc_val_CM_uint8 0 0 0 255 ECU_ADDRESS 0xfe4cccf4 /* @ECU_Address@SwcIn_SysIn_HMI_ADASSetting.ADASSettingInfo.NOPLaneChangeMod@ */ /end MEASUREMENT
/begin MEASUREMENT SwcIn_SysIn_HMI_ADASSetting.ADASSettingInfo.NOPLaneChangeStyle "" UBYTE autosar_swc_val_CM_uint8 0 0 0 255 ECU_ADDRESS 0xfe4cccf3 /* @ECU_Address@SwcIn_SysIn_HMI_ADASSetting.ADASSettingInfo.NOPLaneChangeStyle@ */ /end MEASUREMENT
/begin MEASUREMENT SwcIn_SysIn_HMI_ADASSetting.ADASSettingInfo.NOPLaneChangeWarnType "" UBYTE autosar_swc_val_CM_uint8 0 0 0 255 ECU_ADDRESS 0xfe4cccf5 /* @ECU_Address@SwcIn_SysIn_HMI_ADASSetting.ADASSettingInfo.NOPLaneChangeWarnType@ */ /end MEASUREMENT
/begin MEASUREMENT SwcIn_SysIn_HMI_ADASSetting.ADASSettingInfo.NRASettingSt "" UBYTE autosar_swc_val_CM_uint8 0 0 0 255 ECU_ADDRESS 0xfe4cccfc /* @ECU_Address@SwcIn_SysIn_HMI_ADASSetting.ADASSettingInfo.NRASettingSt@ */ /end MEASUREMENT
/begin MEASUREMENT SwcIn_SysIn_HMI_ADASSetting.ADASSettingInfo.RCTAWarnType "" UBYTE autosar_swc_val_CM_uint8 0 0 0 255 ECU_ADDRESS 0xfe4cccee /* @ECU_Address@SwcIn_SysIn_HMI_ADASSetting.ADASSettingInfo.RCTAWarnType@ */ /end MEASUREMENT
/begin MEASUREMENT SwcIn_SysIn_HMI_ADASSetting.ADASSettingInfo.U_NOPEnableBtnSts "" UBYTE autosar_swc_val_CM_uint8 0 0 0 255 ECU_ADDRESS 0xfe4cccf6 /* @ECU_Address@SwcIn_SysIn_HMI_ADASSetting.ADASSettingInfo.U_NOPEnableBtnSts@ */ /end MEASUREMENT
/begin MEASUREMENT SwcIn_SysIn_HMI_ADASSetting.ADASSettingInfo.VPASettingSt "" UBYTE autosar_swc_val_CM_uint8 0 0 0 255 ECU_ADDRESS 0xfe4cccf8 /* @ECU_Address@SwcIn_SysIn_HMI_ADASSetting.ADASSettingInfo.VPASettingSt@ */ /end MEASUREMENT
/begin MEASUREMENT SwcIn_SysIn_HMI_ADASSetting.ADASSettingInfo.VoiceRemindSettingMode "" UBYTE autosar_swc_val_CM_uint8 0 0 0 255 ECU_ADDRESS 0xfe4cccf2 /* @ECU_Address@SwcIn_SysIn_HMI_ADASSetting.ADASSettingInfo.VoiceRemindSettingMode@ */ /end MEASUREMENT
/begin MEASUREMENT SwcIn_SysIn_HMI_ADASSetting.ADASSettingInfo.VoiceRemindSettingSt "" UBYTE autosar_swc_val_CM_uint8 0 0 0 255 ECU_ADDRESS 0xfe4cccfa /* @ECU_Address@SwcIn_SysIn_HMI_ADASSetting.ADASSettingInfo.VoiceRemindSettingSt@ */ /end MEASUREMENT
/begin MEASUREMENT SwcIn_SysIn_HMI_ADASSetting.ADASSettingInfo_2.ADASSettingInfoReserved "" UBYTE autosar_swc_val_CM_uint8 0 0 0 255 LAYOUT COLUMN_DIR MATRIX_DIM 50 ECU_ADDRESS 0xfe4ccd32 /* @ECU_Address@SwcIn_SysIn_HMI_ADASSetting.ADASSettingInfo_2.ADASSettingInfoReserved@ */ /end MEASUREMENT
/begin MEASUREMENT SwcIn_SysIn_HMI_ADASSetting.ADASSettingInfo_2.AEBSettingSt "" UBYTE autosar_swc_val_CM_uint8 0 0 0 255 ECU_ADDRESS 0xfe4ccd09 /* @ECU_Address@SwcIn_SysIn_HMI_ADASSetting.ADASSettingInfo_2.AEBSettingSt@ */ /end MEASUREMENT
/begin MEASUREMENT SwcIn_SysIn_HMI_ADASSetting.ADASSettingInfo_2.AMAPSettingSt "" UBYTE autosar_swc_val_CM_uint8 0 0 0 255 ECU_ADDRESS 0xfe4ccd13 /* @ECU_Address@SwcIn_SysIn_HMI_ADASSetting.ADASSettingInfo_2.AMAPSettingSt@ */ /end MEASUREMENT
/begin MEASUREMENT SwcIn_SysIn_HMI_ADASSetting.ADASSettingInfo_2.AMAPSwtSet "" UBYTE autosar_swc_val_CM_uint8 0 0 0 255 ECU_ADDRESS 0xfe4ccd24 /* @ECU_Address@SwcIn_SysIn_HMI_ADASSetting.ADASSettingInfo_2.AMAPSwtSet@ */ /end MEASUREMENT
/begin MEASUREMENT SwcIn_SysIn_HMI_ADASSetting.ADASSettingInfo_2.APASettingSt "" UBYTE autosar_swc_val_CM_uint8 0 0 0 255 ECU_ADDRESS 0xfe4ccd1c /* @ECU_Address@SwcIn_SysIn_HMI_ADASSetting.ADASSettingInfo_2.APASettingSt@ */ /end MEASUREMENT
/begin MEASUREMENT SwcIn_SysIn_HMI_ADASSetting.ADASSettingInfo_2.BSDSettingSt "" UBYTE autosar_swc_val_CM_uint8 0 0 0 255 ECU_ADDRESS 0xfe4ccd0d /* @ECU_Address@SwcIn_SysIn_HMI_ADASSetting.ADASSettingInfo_2.BSDSettingSt@ */ /end MEASUREMENT
/begin MEASUREMENT SwcIn_SysIn_HMI_ADASSetting.ADASSettingInfo_2.DAIEnableBtnSt "" UBYTE autosar_swc_val_CM_uint8 0 0 0 255 ECU_ADDRESS 0xfe4ccd28 /* @ECU_Address@SwcIn_SysIn_HMI_ADASSetting.ADASSettingInfo_2.DAIEnableBtnSt@ */ /end MEASUREMENT
/begin MEASUREMENT SwcIn_SysIn_HMI_ADASSetting.ADASSettingInfo_2.DOWSettingSt "" UBYTE autosar_swc_val_CM_uint8 0 0 0 255 ECU_ADDRESS 0xfe4ccd0e /* @ECU_Address@SwcIn_SysIn_HMI_ADASSetting.ADASSettingInfo_2.DOWSettingSt@ */ /end MEASUREMENT
/begin MEASUREMENT SwcIn_SysIn_HMI_ADASSetting.ADASSettingInfo_2.DrivingVoiceRemindSettingSt "" UBYTE autosar_swc_val_CM_uint8 0 0 0 255 ECU_ADDRESS 0xfe4ccd1e /* @ECU_Address@SwcIn_SysIn_HMI_ADASSetting.ADASSettingInfo_2.DrivingVoiceRemindSettingSt@ */ /end MEASUREMENT
/begin MEASUREMENT SwcIn_SysIn_HMI_ADASSetting.ADASSettingInfo_2.ELKSettingSt "" UBYTE autosar_swc_val_CM_uint8 0 0 0 255 ECU_ADDRESS 0xfe4ccd0c /* @ECU_Address@SwcIn_SysIn_HMI_ADASSetting.ADASSettingInfo_2.ELKSettingSt@ */ /end MEASUREMENT
/begin MEASUREMENT SwcIn_SysIn_HMI_ADASSetting.ADASSettingInfo_2.ESASettingSt "" UBYTE autosar_swc_val_CM_uint8 0 0 0 255 ECU_ADDRESS 0xfe4ccd12 /* @ECU_Address@SwcIn_SysIn_HMI_ADASSetting.ADASSettingInfo_2.ESASettingSt@ */ /end MEASUREMENT
/begin MEASUREMENT SwcIn_SysIn_HMI_ADASSetting.ADASSettingInfo_2.FCTAWarnType "" UBYTE autosar_swc_val_CM_uint8 0 0 0 255 ECU_ADDRESS 0xfe4ccd10 /* @ECU_Address@SwcIn_SysIn_HMI_ADASSetting.ADASSettingInfo_2.FCTAWarnType@ */ /end MEASUREMENT
/begin MEASUREMENT SwcIn_SysIn_HMI_ADASSetting.ADASSettingInfo_2.FCWSettingSt "" UBYTE autosar_swc_val_CM_uint8 0 0 0 255 ECU_ADDRESS 0xfe4ccd08 /* @ECU_Address@SwcIn_SysIn_HMI_ADASSetting.ADASSettingInfo_2.FCWSettingSt@ */ /end MEASUREMENT
/begin MEASUREMENT SwcIn_SysIn_HMI_ADASSetting.ADASSettingInfo_2.FCWWarnDistance "" UBYTE autosar_swc_val_CM_uint8 0 0 0 255 ECU_ADDRESS 0xfe4ccd07 /* @ECU_Address@SwcIn_SysIn_HMI_ADASSetting.ADASSettingInfo_2.FCWWarnDistance@ */ /end MEASUREMENT
/begin MEASUREMENT SwcIn_SysIn_HMI_ADASSetting.ADASSettingInfo_2.FSRACruiseSpdMod "" UBYTE autosar_swc_val_CM_uint8 0 0 0 255 ECU_ADDRESS 0xfe4cccff /* @ECU_Address@SwcIn_SysIn_HMI_ADASSetting.ADASSettingInfo_2.FSRACruiseSpdMod@ */ /end MEASUREMENT
/begin MEASUREMENT SwcIn_SysIn_HMI_ADASSetting.ADASSettingInfo_2.FSRACruiseSpdOffsetMod "" UBYTE autosar_swc_val_CM_uint8 0 0 0 255 ECU_ADDRESS 0xfe4ccd00 /* @ECU_Address@SwcIn_SysIn_HMI_ADASSetting.ADASSettingInfo_2.FSRACruiseSpdOffsetMod@ */ /end MEASUREMENT
/begin MEASUREMENT SwcIn_SysIn_HMI_ADASSetting.ADASSettingInfo_2.FSRACruiseSpdOffsetPercent "" SBYTE autosar_swc_val_CM_int8 0 0 -128 127 ECU_ADDRESS 0xfe4ccd02 /* @ECU_Address@SwcIn_SysIn_HMI_ADASSetting.ADASSettingInfo_2.FSRACruiseSpdOffsetPercent@ */ /end MEASUREMENT
/begin MEASUREMENT SwcIn_SysIn_HMI_ADASSetting.ADASSettingInfo_2.FSRACruiseSpdOffsetSpd "" SBYTE autosar_swc_val_CM_int8 0 0 -128 127 ECU_ADDRESS 0xfe4ccd01 /* @ECU_Address@SwcIn_SysIn_HMI_ADASSetting.ADASSettingInfo_2.FSRACruiseSpdOffsetSpd@ */ /end MEASUREMENT
/begin MEASUREMENT SwcIn_SysIn_HMI_ADASSetting.ADASSettingInfo_2.FSRASpdSetMod "" UBYTE autosar_swc_val_CM_uint8 0 0 0 255 ECU_ADDRESS 0xfe4cccfe /* @ECU_Address@SwcIn_SysIn_HMI_ADASSetting.ADASSettingInfo_2.FSRASpdSetMod@ */ /end MEASUREMENT
/begin MEASUREMENT SwcIn_SysIn_HMI_ADASSetting.ADASSettingInfo_2.HPACrusingSpeedSettingSt "" UBYTE autosar_swc_val_CM_uint8 0 0 0 255 ECU_ADDRESS 0xfe4ccd22 /* @ECU_Address@SwcIn_SysIn_HMI_ADASSetting.ADASSettingInfo_2.HPACrusingSpeedSettingSt@ */ /end MEASUREMENT
/begin MEASUREMENT SwcIn_SysIn_HMI_ADASSetting.ADASSettingInfo_2.HPASettingSt "" UBYTE autosar_swc_val_CM_uint8 0 0 0 255 ECU_ADDRESS 0xfe4ccd1a /* @ECU_Address@SwcIn_SysIn_HMI_ADASSetting.ADASSettingInfo_2.HPASettingSt@ */ /end MEASUREMENT
/begin MEASUREMENT SwcIn_SysIn_HMI_ADASSetting.ADASSettingInfo_2.ICAEnableBtnSts "" UBYTE autosar_swc_val_CM_uint8 0 0 0 255 ECU_ADDRESS 0xfe4cccfd /* @ECU_Address@SwcIn_SysIn_HMI_ADASSetting.ADASSettingInfo_2.ICAEnableBtnSts@ */ /end MEASUREMENT
/begin MEASUREMENT SwcIn_SysIn_HMI_ADASSetting.ADASSettingInfo_2.ICAplusSettingSt "" UBYTE autosar_swc_val_CM_uint8 0 0 0 255 ECU_ADDRESS 0xfe4ccd0f /* @ECU_Address@SwcIn_SysIn_HMI_ADASSetting.ADASSettingInfo_2.ICAplusSettingSt@ */ /end MEASUREMENT
/begin MEASUREMENT SwcIn_SysIn_HMI_ADASSetting.ADASSettingInfo_2.IHCEnableBtnSt "" UBYTE autosar_swc_val_CM_uint8 0 0 0 255 ECU_ADDRESS 0xfe4ccd29 /* @ECU_Address@SwcIn_SysIn_HMI_ADASSetting.ADASSettingInfo_2.IHCEnableBtnSt@ */ /end MEASUREMENT
/begin MEASUREMENT SwcIn_SysIn_HMI_ADASSetting.ADASSettingInfo_2.ISLICruiseSpdAbdOffset "" UBYTE autosar_swc_val_CM_uint8 0 0 0 255 ECU_ADDRESS 0xfe4ccd06 /* @ECU_Address@SwcIn_SysIn_HMI_ADASSetting.ADASSettingInfo_2.ISLICruiseSpdAbdOffset@ */ /end MEASUREMENT
/begin MEASUREMENT SwcIn_SysIn_HMI_ADASSetting.ADASSettingInfo_2.ISLICruiseSpdOffsetAbd "" SBYTE autosar_swc_val_CM_int8 0 0 -128 127 ECU_ADDRESS 0xfe4ccd2a /* @ECU_Address@SwcIn_SysIn_HMI_ADASSetting.ADASSettingInfo_2.ISLICruiseSpdOffsetAbd@ */ /end MEASUREMENT
/begin MEASUREMENT SwcIn_SysIn_HMI_ADASSetting.ADASSettingInfo_2.ISLICruiseSpdRelOffset "" SBYTE autosar_swc_val_CM_int8 0 0 -128 127 ECU_ADDRESS 0xfe4ccd05 /* @ECU_Address@SwcIn_SysIn_HMI_ADASSetting.ADASSettingInfo_2.ISLICruiseSpdRelOffset@ */ /end MEASUREMENT
/begin MEASUREMENT SwcIn_SysIn_HMI_ADASSetting.ADASSettingInfo_2.ISLISpdOffsetMod "" UBYTE autosar_swc_val_CM_uint8 0 0 0 255 ECU_ADDRESS 0xfe4ccd04 /* @ECU_Address@SwcIn_SysIn_HMI_ADASSetting.ADASSettingInfo_2.ISLISpdOffsetMod@ */ /end MEASUREMENT
/begin MEASUREMENT SwcIn_SysIn_HMI_ADASSetting.ADASSettingInfo_2.ISLIWarnMod "" UBYTE autosar_swc_val_CM_uint8 0 0 0 255 ECU_ADDRESS 0xfe4ccd03 /* @ECU_Address@SwcIn_SysIn_HMI_ADASSetting.ADASSettingInfo_2.ISLIWarnMod@ */ /end MEASUREMENT
/begin MEASUREMENT SwcIn_SysIn_HMI_ADASSetting.ADASSettingInfo_2.LDWWarnType "" UBYTE autosar_swc_val_CM_uint8 0 0 0 255 ECU_ADDRESS 0xfe4ccd0b /* @ECU_Address@SwcIn_SysIn_HMI_ADASSetting.ADASSettingInfo_2.LDWWarnType@ */ /end MEASUREMENT
/begin MEASUREMENT SwcIn_SysIn_HMI_ADASSetting.ADASSettingInfo_2.LKSSettingSt "" UBYTE autosar_swc_val_CM_uint8 0 0 0 255 ECU_ADDRESS 0xfe4ccd0a /* @ECU_Address@SwcIn_SysIn_HMI_ADASSetting.ADASSettingInfo_2.LKSSettingSt@ */ /end MEASUREMENT
/begin MEASUREMENT SwcIn_SysIn_HMI_ADASSetting.ADASSettingInfo_2.LKSWarnSensitivity "" UBYTE autosar_swc_val_CM_uint8 0 0 0 255 ECU_ADDRESS 0xfe4ccd27 /* @ECU_Address@SwcIn_SysIn_HMI_ADASSetting.ADASSettingInfo_2.LKSWarnSensitivity@ */ /end MEASUREMENT
/begin MEASUREMENT SwcIn_SysIn_HMI_ADASSetting.ADASSettingInfo_2.LccPlusEnableBtnSt "" UBYTE autosar_swc_val_CM_uint8 0 0 0 255 ECU_ADDRESS 0xfe4ccd26 /* @ECU_Address@SwcIn_SysIn_HMI_ADASSetting.ADASSettingInfo_2.LccPlusEnableBtnSt@ */ /end MEASUREMENT
/begin MEASUREMENT SwcIn_SysIn_HMI_ADASSetting.ADASSettingInfo_2.MEBSwtSet "" UBYTE autosar_swc_val_CM_uint8 0 0 0 255 ECU_ADDRESS 0xfe4ccd23 /* @ECU_Address@SwcIn_SysIn_HMI_ADASSetting.ADASSettingInfo_2.MEBSwtSet@ */ /end MEASUREMENT
/begin MEASUREMENT SwcIn_SysIn_HMI_ADASSetting.ADASSettingInfo_2.MNPDelRouteIDBtnSt "" UBYTE autosar_swc_val_CM_uint8 0 0 0 255 ECU_ADDRESS 0xfe4ccd30 /* @ECU_Address@SwcIn_SysIn_HMI_ADASSetting.ADASSettingInfo_2.MNPDelRouteIDBtnSt@ */ /end MEASUREMENT
/begin MEASUREMENT SwcIn_SysIn_HMI_ADASSetting.ADASSettingInfo_2.MNPEnableBtnSt "" UBYTE autosar_swc_val_CM_uint8 0 0 0 255 ECU_ADDRESS 0xfe4ccd25 /* @ECU_Address@SwcIn_SysIn_HMI_ADASSetting.ADASSettingInfo_2.MNPEnableBtnSt@ */ /end MEASUREMENT
/begin MEASUREMENT SwcIn_SysIn_HMI_ADASSetting.ADASSettingInfo_2.MNPMemRouteCompleteBtnSt "" UBYTE autosar_swc_val_CM_uint8 0 0 0 255 ECU_ADDRESS 0xfe4ccd2e /* @ECU_Address@SwcIn_SysIn_HMI_ADASSetting.ADASSettingInfo_2.MNPMemRouteCompleteBtnSt@ */ /end MEASUREMENT
/begin MEASUREMENT SwcIn_SysIn_HMI_ADASSetting.ADASSettingInfo_2.MNPMemRouteNewName "" UBYTE autosar_swc_val_CM_uint8 0 0 0 255 ECU_ADDRESS 0xfe4ccd2f /* @ECU_Address@SwcIn_SysIn_HMI_ADASSetting.ADASSettingInfo_2.MNPMemRouteNewName@ */ /end MEASUREMENT
/begin MEASUREMENT SwcIn_SysIn_HMI_ADASSetting.ADASSettingInfo_2.MNPMemRouteQuitBtnSt "" UBYTE autosar_swc_val_CM_uint8 0 0 0 255 ECU_ADDRESS 0xfe4ccd2c /* @ECU_Address@SwcIn_SysIn_HMI_ADASSetting.ADASSettingInfo_2.MNPMemRouteQuitBtnSt@ */ /end MEASUREMENT
/begin MEASUREMENT SwcIn_SysIn_HMI_ADASSetting.ADASSettingInfo_2.MNPNewBtnSt "" UBYTE autosar_swc_val_CM_uint8 0 0 0 255 ECU_ADDRESS 0xfe4ccd2b /* @ECU_Address@SwcIn_SysIn_HMI_ADASSetting.ADASSettingInfo_2.MNPNewBtnSt@ */ /end MEASUREMENT
/begin MEASUREMENT SwcIn_SysIn_HMI_ADASSetting.ADASSettingInfo_2.MNPUseRouteIDBtnSt "" UBYTE autosar_swc_val_CM_uint8 0 0 0 255 ECU_ADDRESS 0xfe4ccd31 /* @ECU_Address@SwcIn_SysIn_HMI_ADASSetting.ADASSettingInfo_2.MNPUseRouteIDBtnSt@ */ /end MEASUREMENT
/begin MEASUREMENT SwcIn_SysIn_HMI_ADASSetting.ADASSettingInfo_2.MNPUseRouteQuitBtnSt "" UBYTE autosar_swc_val_CM_uint8 0 0 0 255 ECU_ADDRESS 0xfe4ccd2d /* @ECU_Address@SwcIn_SysIn_HMI_ADASSetting.ADASSettingInfo_2.MNPUseRouteQuitBtnSt@ */ /end MEASUREMENT
/begin MEASUREMENT SwcIn_SysIn_HMI_ADASSetting.ADASSettingInfo_2.NOPEnableBtnSts "" UBYTE autosar_swc_val_CM_uint8 0 0 0 255 ECU_ADDRESS 0xfe4ccd14 /* @ECU_Address@SwcIn_SysIn_HMI_ADASSetting.ADASSettingInfo_2.NOPEnableBtnSts@ */ /end MEASUREMENT
/begin MEASUREMENT SwcIn_SysIn_HMI_ADASSetting.ADASSettingInfo_2.NOPLaneChangeMod "" UBYTE autosar_swc_val_CM_uint8 0 0 0 255 ECU_ADDRESS 0xfe4ccd17 /* @ECU_Address@SwcIn_SysIn_HMI_ADASSetting.ADASSettingInfo_2.NOPLaneChangeMod@ */ /end MEASUREMENT
/begin MEASUREMENT SwcIn_SysIn_HMI_ADASSetting.ADASSettingInfo_2.NOPLaneChangeStyle "" UBYTE autosar_swc_val_CM_uint8 0 0 0 255 ECU_ADDRESS 0xfe4ccd16 /* @ECU_Address@SwcIn_SysIn_HMI_ADASSetting.ADASSettingInfo_2.NOPLaneChangeStyle@ */ /end MEASUREMENT
/begin MEASUREMENT SwcIn_SysIn_HMI_ADASSetting.ADASSettingInfo_2.NOPLaneChangeWarnType "" UBYTE autosar_swc_val_CM_uint8 0 0 0 255 ECU_ADDRESS 0xfe4ccd18 /* @ECU_Address@SwcIn_SysIn_HMI_ADASSetting.ADASSettingInfo_2.NOPLaneChangeWarnType@ */ /end MEASUREMENT
/begin MEASUREMENT SwcIn_SysIn_HMI_ADASSetting.ADASSettingInfo_2.NRASettingSt "" UBYTE autosar_swc_val_CM_uint8 0 0 0 255 ECU_ADDRESS 0xfe4ccd1f /* @ECU_Address@SwcIn_SysIn_HMI_ADASSetting.ADASSettingInfo_2.NRASettingSt@ */ /end MEASUREMENT
/begin MEASUREMENT SwcIn_SysIn_HMI_ADASSetting.ADASSettingInfo_2.ParkingSpeedSettingSt "" UBYTE autosar_swc_val_CM_uint8 0 0 0 255 ECU_ADDRESS 0xfe4ccd21 /* @ECU_Address@SwcIn_SysIn_HMI_ADASSetting.ADASSettingInfo_2.ParkingSpeedSettingSt@ */ /end MEASUREMENT
/begin MEASUREMENT SwcIn_SysIn_HMI_ADASSetting.ADASSettingInfo_2.RCTAWarnType "" UBYTE autosar_swc_val_CM_uint8 0 0 0 255 ECU_ADDRESS 0xfe4ccd11 /* @ECU_Address@SwcIn_SysIn_HMI_ADASSetting.ADASSettingInfo_2.RCTAWarnType@ */ /end MEASUREMENT
/begin MEASUREMENT SwcIn_SysIn_HMI_ADASSetting.ADASSettingInfo_2.RPASetSettingSt "" UBYTE autosar_swc_val_CM_uint8 0 0 0 255 ECU_ADDRESS 0xfe4ccd20 /* @ECU_Address@SwcIn_SysIn_HMI_ADASSetting.ADASSettingInfo_2.RPASetSettingSt@ */ /end MEASUREMENT
/begin MEASUREMENT SwcIn_SysIn_HMI_ADASSetting.ADASSettingInfo_2.U_NOPEnableBtnSts "" UBYTE autosar_swc_val_CM_uint8 0 0 0 255 ECU_ADDRESS 0xfe4ccd19 /* @ECU_Address@SwcIn_SysIn_HMI_ADASSetting.ADASSettingInfo_2.U_NOPEnableBtnSts@ */ /end MEASUREMENT
/begin MEASUREMENT SwcIn_SysIn_HMI_ADASSetting.ADASSettingInfo_2.VPASettingSt "" UBYTE autosar_swc_val_CM_uint8 0 0 0 255 ECU_ADDRESS 0xfe4ccd1b /* @ECU_Address@SwcIn_SysIn_HMI_ADASSetting.ADASSettingInfo_2.VPASettingSt@ */ /end MEASUREMENT
/begin MEASUREMENT SwcIn_SysIn_HMI_ADASSetting.ADASSettingInfo_2.VoiceRemindSettingMode "" UBYTE autosar_swc_val_CM_uint8 0 0 0 255 ECU_ADDRESS 0xfe4ccd15 /* @ECU_Address@SwcIn_SysIn_HMI_ADASSetting.ADASSettingInfo_2.VoiceRemindSettingMode@ */ /end MEASUREMENT
/begin MEASUREMENT SwcIn_SysIn_HMI_ADASSetting.ADASSettingInfo_2.VoiceRemindSettingSt "" UBYTE autosar_swc_val_CM_uint8 0 0 0 255 ECU_ADDRESS 0xfe4ccd1d /* @ECU_Address@SwcIn_SysIn_HMI_ADASSetting.ADASSettingInfo_2.VoiceRemindSettingSt@ */ /end MEASUREMENT
/begin MEASUREMENT SwcIn_SysIn_ICC_SDmapInfo.NtfSDmapNaviRoadInfo.NaviFormWay "" SLONG autosar_swc_val_CM_int32 0 0 -2147483648 2147483647 ECU_ADDRESS 0xfe4ccb54 /* @ECU_Address@SwcIn_SysIn_ICC_SDmapInfo.NtfSDmapNaviRoadInfo.NaviFormWay@ */ /end MEASUREMENT
/begin MEASUREMENT SwcIn_SysIn_ICC_SDmapInfo.NtfSDmapNaviRoadInfo.NaviRoadClass "" SLONG autosar_swc_val_CM_int32 0 0 -2147483648 2147483647 ECU_ADDRESS 0xfe4ccb4c /* @ECU_Address@SwcIn_SysIn_ICC_SDmapInfo.NtfSDmapNaviRoadInfo.NaviRoadClass@ */ /end MEASUREMENT
/begin MEASUREMENT SwcIn_SysIn_ICC_SDmapInfo.NtfSDmapNaviRoadInfo.Navicurrentroadspd "" SLONG autosar_swc_val_CM_int32 0 0 -2147483648 2147483647 ECU_ADDRESS 0xfe4ccb50 /* @ECU_Address@SwcIn_SysIn_ICC_SDmapInfo.NtfSDmapNaviRoadInfo.Navicurrentroadspd@ */ /end MEASUREMENT
/begin MEASUREMENT SwcIn_SysIn_ICC_SDmapInfo.NtfSDmapNaviStatusInfo.NaviMode "" SLONG autosar_swc_val_CM_int32 0 0 -2147483648 2147483647 ECU_ADDRESS 0xfe4ccb44 /* @ECU_Address@SwcIn_SysIn_ICC_SDmapInfo.NtfSDmapNaviStatusInfo.NaviMode@ */ /end MEASUREMENT
/begin MEASUREMENT SwcIn_SysIn_ICC_SDmapInfo.NtfSDmapNaviStatusInfo.NaviStatus "" SLONG autosar_swc_val_CM_int32 0 0 -2147483648 2147483647 ECU_ADDRESS 0xfe4ccb48 /* @ECU_Address@SwcIn_SysIn_ICC_SDmapInfo.NtfSDmapNaviStatusInfo.NaviStatus@ */ /end MEASUREMENT
/begin MEASUREMENT SwcIn_SysIn_NvM_Read.AEBOnOff "" UBYTE autosar_swc_val_CM_boolean 0 0 0 1 ECU_ADDRESS 0xfe4cb1d3 /* @ECU_Address@SwcIn_SysIn_NvM_Read.AEBOnOff@ */ /end MEASUREMENT
/begin MEASUREMENT SwcIn_SysIn_NvM_Read.AESOnOff "" UBYTE autosar_swc_val_CM_boolean 0 0 0 1 ECU_ADDRESS 0xfe4cb1ce /* @ECU_Address@SwcIn_SysIn_NvM_Read.AESOnOff@ */ /end MEASUREMENT
/begin MEASUREMENT SwcIn_SysIn_NvM_Read.ALCSet "" UBYTE autosar_swc_val_CM_uint8 0 0 0 255 ECU_ADDRESS 0xfe4cb1e0 /* @ECU_Address@SwcIn_SysIn_NvM_Read.ALCSet@ */ /end MEASUREMENT
/begin MEASUREMENT SwcIn_SysIn_NvM_Read.ALCSnvtySet "" UBYTE autosar_swc_val_CM_uint8 0 0 0 255 ECU_ADDRESS 0xfe4cb1e2 /* @ECU_Address@SwcIn_SysIn_NvM_Read.ALCSnvtySet@ */ /end MEASUREMENT
/begin MEASUREMENT SwcIn_SysIn_NvM_Read.DAIOnOff "" UBYTE autosar_swc_val_CM_boolean 0 0 0 1 ECU_ADDRESS 0xfe4cb1d4 /* @ECU_Address@SwcIn_SysIn_NvM_Read.DAIOnOff@ */ /end MEASUREMENT
/begin MEASUREMENT SwcIn_SysIn_NvM_Read.DCLCSet "" UBYTE autosar_swc_val_CM_uint8 0 0 0 255 ECU_ADDRESS 0xfe4cb1e1 /* @ECU_Address@SwcIn_SysIn_NvM_Read.DCLCSet@ */ /end MEASUREMENT
/begin MEASUREMENT SwcIn_SysIn_NvM_Read.ELKOnOff "" UBYTE autosar_swc_val_CM_boolean 0 0 0 1 ECU_ADDRESS 0xfe4cb1cc /* @ECU_Address@SwcIn_SysIn_NvM_Read.ELKOnOff@ */ /end MEASUREMENT
/begin MEASUREMENT SwcIn_SysIn_NvM_Read.ESSOnOff "" UBYTE autosar_swc_val_CM_boolean 0 0 0 1 ECU_ADDRESS 0xfe4cb1cd /* @ECU_Address@SwcIn_SysIn_NvM_Read.ESSOnOff@ */ /end MEASUREMENT
/begin MEASUREMENT SwcIn_SysIn_NvM_Read.FCWOnOff "" UBYTE autosar_swc_val_CM_boolean 0 0 0 1 ECU_ADDRESS 0xfe4cb1d2 /* @ECU_Address@SwcIn_SysIn_NvM_Read.FCWOnOff@ */ /end MEASUREMENT
/begin MEASUREMENT SwcIn_SysIn_NvM_Read.FCWSnvty "" UBYTE autosar_swc_val_CM_uint8 0 0 0 255 ECU_ADDRESS 0xfe4cb1e3 /* @ECU_Address@SwcIn_SysIn_NvM_Read.FCWSnvty@ */ /end MEASUREMENT
/begin MEASUREMENT SwcIn_SysIn_NvM_Read.ICAOnOff "" UBYTE autosar_swc_val_CM_uint8 0 0 0 255 ECU_ADDRESS 0xfe4cb1d9 /* @ECU_Address@SwcIn_SysIn_NvM_Read.ICAOnOff@ */ /end MEASUREMENT
/begin MEASUREMENT SwcIn_SysIn_NvM_Read.IHCOnOff "" UBYTE autosar_swc_val_CM_uint8 0 0 0 255 ECU_ADDRESS 0xfe4cb1d8 /* @ECU_Address@SwcIn_SysIn_NvM_Read.IHCOnOff@ */ /end MEASUREMENT
/begin MEASUREMENT SwcIn_SysIn_NvM_Read.ISLOnOff "" UBYTE autosar_swc_val_CM_boolean 0 0 0 1 ECU_ADDRESS 0xfe4cb1d0 /* @ECU_Address@SwcIn_SysIn_NvM_Read.ISLOnOff@ */ /end MEASUREMENT
/begin MEASUREMENT SwcIn_SysIn_NvM_Read.IntellgntCurveOnOff "" UBYTE autosar_swc_val_CM_boolean 0 0 0 1 ECU_ADDRESS 0xfe4cb1d1 /* @ECU_Address@SwcIn_SysIn_NvM_Read.IntellgntCurveOnOff@ */ /end MEASUREMENT
/begin MEASUREMENT SwcIn_SysIn_NvM_Read.LASSnvtySet "" UBYTE autosar_swc_val_CM_uint8 0 0 0 255 ECU_ADDRESS 0xfe4cb1dc /* @ECU_Address@SwcIn_SysIn_NvM_Read.LASSnvtySet@ */ /end MEASUREMENT
/begin MEASUREMENT SwcIn_SysIn_NvM_Read.LASWarnFormSwtReq "" UBYTE autosar_swc_val_CM_uint8 0 0 0 255 ECU_ADDRESS 0xfe4cb1dd /* @ECU_Address@SwcIn_SysIn_NvM_Read.LASWarnFormSwtReq@ */ /end MEASUREMENT
/begin MEASUREMENT SwcIn_SysIn_NvM_Read.LCKIEOnOff "" UBYTE autosar_swc_val_CM_boolean 0 0 0 1 ECU_ADDRESS 0xfe4cb1cf /* @ECU_Address@SwcIn_SysIn_NvM_Read.LCKIEOnOff@ */ /end MEASUREMENT
/begin MEASUREMENT SwcIn_SysIn_NvM_Read.LDWOnOff "" UBYTE autosar_swc_val_CM_boolean 0 0 0 1 ECU_ADDRESS 0xfe4cb1ca /* @ECU_Address@SwcIn_SysIn_NvM_Read.LDWOnOff@ */ /end MEASUREMENT
/begin MEASUREMENT SwcIn_SysIn_NvM_Read.LKAOnOff "" UBYTE autosar_swc_val_CM_boolean 0 0 0 1 ECU_ADDRESS 0xfe4cb1cb /* @ECU_Address@SwcIn_SysIn_NvM_Read.LKAOnOff@ */ /end MEASUREMENT
/begin MEASUREMENT SwcIn_SysIn_NvM_Read.NOHActReq "" UBYTE autosar_swc_val_CM_boolean 0 0 0 1 ECU_ADDRESS 0xfe4cb1c9 /* @ECU_Address@SwcIn_SysIn_NvM_Read.NOHActReq@ */ /end MEASUREMENT
/begin MEASUREMENT SwcIn_SysIn_NvM_Read.NOHOnOff "" UBYTE autosar_swc_val_CM_boolean 0 0 0 1 ECU_ADDRESS 0xfe4cb1c8 /* @ECU_Address@SwcIn_SysIn_NvM_Read.NOHOnOff@ */ /end MEASUREMENT
/begin MEASUREMENT SwcIn_SysIn_NvM_Read.Reserve "" UBYTE autosar_swc_val_CM_uint8 0 0 0 255 LAYOUT COLUMN_DIR MATRIX_DIM 72 ECU_ADDRESS 0xfe4cb200 /* @ECU_Address@SwcIn_SysIn_NvM_Read.Reserve@ */ /end MEASUREMENT
/begin MEASUREMENT SwcIn_SysIn_NvM_Read.SLAOnOff "" UBYTE autosar_swc_val_CM_uint8 0 0 0 255 ECU_ADDRESS 0xfe4cb1da /* @ECU_Address@SwcIn_SysIn_NvM_Read.SLAOnOff@ */ /end MEASUREMENT
/begin MEASUREMENT SwcIn_SysIn_NvM_Read.SLAWarnMod "" UBYTE autosar_swc_val_CM_uint8 0 0 0 255 ECU_ADDRESS 0xfe4cb1db /* @ECU_Address@SwcIn_SysIn_NvM_Read.SLAWarnMod@ */ /end MEASUREMENT
/begin MEASUREMENT SwcIn_SysIn_NvM_Read.SPL_SuppName_Value_Init "" UBYTE autosar_swc_val_CM_uint8 0 0 0 255 ECU_ADDRESS 0xfe4cb1ea /* @ECU_Address@SwcIn_SysIn_NvM_Read.SPL_SuppName_Value_Init@ */ /end MEASUREMENT
/begin MEASUREMENT SwcIn_SysIn_NvM_Read.SPL_noSupp_Dist_Init "" FLOAT32_IEEE autosar_swc_val_CM_single 0 0 -3.4E+38 3.4E+38 ECU_ADDRESS 0xfe4cb1f4 /* @ECU_Address@SwcIn_SysIn_NvM_Read.SPL_noSupp_Dist_Init@ */ /end MEASUREMENT
/begin MEASUREMENT SwcIn_SysIn_NvM_Read.SPL_noSupp_Value_Init "" UBYTE autosar_swc_val_CM_uint8 0 0 0 255 ECU_ADDRESS 0xfe4cb1e7 /* @ECU_Address@SwcIn_SysIn_NvM_Read.SPL_noSupp_Value_Init@ */ /end MEASUREMENT
/begin MEASUREMENT SwcIn_SysIn_NvM_Read.SPL_whSupp_Dist_Init "" FLOAT32_IEEE autosar_swc_val_CM_single 0 0 -3.4E+38 3.4E+38 ECU_ADDRESS 0xfe4cb1f8 /* @ECU_Address@SwcIn_SysIn_NvM_Read.SPL_whSupp_Dist_Init@ */ /end MEASUREMENT
/begin MEASUREMENT SwcIn_SysIn_NvM_Read.SPL_whSupp_Value_Init "" UBYTE autosar_swc_val_CM_uint8 0 0 0 255 ECU_ADDRESS 0xfe4cb1e8 /* @ECU_Address@SwcIn_SysIn_NvM_Read.SPL_whSupp_Value_Init@ */ /end MEASUREMENT
/begin MEASUREMENT SwcIn_SysIn_NvM_Read.SpeedLimitOnOff "" UBYTE autosar_swc_val_CM_uint8 0 0 0 255 ECU_ADDRESS 0xfe4cb1e6 /* @ECU_Address@SwcIn_SysIn_NvM_Read.SpeedLimitOnOff@ */ /end MEASUREMENT
/begin MEASUREMENT SwcIn_SysIn_NvM_Read.SpeedLmtNumberAbs "" SBYTE autosar_swc_val_CM_int8 0 0 -128 127 ECU_ADDRESS 0xfe4cb1d5 /* @ECU_Address@SwcIn_SysIn_NvM_Read.SpeedLmtNumberAbs@ */ /end MEASUREMENT
/begin MEASUREMENT SwcIn_SysIn_NvM_Read.SpeedLmtNumberPerct "" SBYTE autosar_swc_val_CM_int8 0 0 -128 127 ECU_ADDRESS 0xfe4cb1d6 /* @ECU_Address@SwcIn_SysIn_NvM_Read.SpeedLmtNumberPerct@ */ /end MEASUREMENT
/begin MEASUREMENT SwcIn_SysIn_NvM_Read.SpeedLmtSnvtyMod "" UBYTE autosar_swc_val_CM_uint8 0 0 0 255 ECU_ADDRESS 0xfe4cb1d7 /* @ECU_Address@SwcIn_SysIn_NvM_Read.SpeedLmtSnvtyMod@ */ /end MEASUREMENT
/begin MEASUREMENT SwcIn_SysIn_NvM_Read.SysOut_ACCStsInit "" UBYTE autosar_swc_val_CM_uint8 0 0 0 255 ECU_ADDRESS 0xfe4cb1ec /* @ECU_Address@SwcIn_SysIn_NvM_Read.SysOut_ACCStsInit@ */ /end MEASUREMENT
/begin MEASUREMENT SwcIn_SysIn_NvM_Read.SysOut_ICASStsInit "" UBYTE autosar_swc_val_CM_uint8 0 0 0 255 ECU_ADDRESS 0xfe4cb1ed /* @ECU_Address@SwcIn_SysIn_NvM_Read.SysOut_ICASStsInit@ */ /end MEASUREMENT
/begin MEASUREMENT SwcIn_SysIn_NvM_Read.SysOut_SteerAngOffsetInit "" FLOAT32_IEEE autosar_swc_val_CM_single 0 0 -3.4E+38 3.4E+38 ECU_ADDRESS 0xfe4cb1f0 /* @ECU_Address@SwcIn_SysIn_NvM_Read.SysOut_SteerAngOffsetInit@ */ /end MEASUREMENT
/begin MEASUREMENT SwcIn_SysIn_NvM_Read.SysOut_TimeGapInit "" UBYTE autosar_swc_val_CM_uint8 0 0 0 255 ECU_ADDRESS 0xfe4cb1eb /* @ECU_Address@SwcIn_SysIn_NvM_Read.SysOut_TimeGapInit@ */ /end MEASUREMENT
/begin MEASUREMENT SwcIn_SysIn_NvM_Read.TJAICAExitTextInfoONOFF "" UBYTE autosar_swc_val_CM_uint8 0 0 0 255 ECU_ADDRESS 0xfe4cb1e5 /* @ECU_Address@SwcIn_SysIn_NvM_Read.TJAICAExitTextInfoONOFF@ */ /end MEASUREMENT
/begin MEASUREMENT SwcIn_SysIn_NvM_Read.TLIOnOff "" UBYTE autosar_swc_val_CM_uint8 0 0 0 255 ECU_ADDRESS 0xfe4cb1df /* @ECU_Address@SwcIn_SysIn_NvM_Read.TLIOnOff@ */ /end MEASUREMENT
/begin MEASUREMENT SwcIn_SysIn_NvM_Read.TSROnOff "" UBYTE autosar_swc_val_CM_uint8 0 0 0 255 ECU_ADDRESS 0xfe4cb1de /* @ECU_Address@SwcIn_SysIn_NvM_Read.TSROnOff@ */ /end MEASUREMENT
/begin MEASUREMENT SwcIn_SysIn_NvM_Read.TS_SignName_Dist_Init "" FLOAT32_IEEE autosar_swc_val_CM_single 0 0 -3.4E+38 3.4E+38 ECU_ADDRESS 0xfe4cb1fc /* @ECU_Address@SwcIn_SysIn_NvM_Read.TS_SignName_Dist_Init@ */ /end MEASUREMENT
/begin MEASUREMENT SwcIn_SysIn_NvM_Read.TS_SignName_Value_Init "" UBYTE autosar_swc_val_CM_uint8 0 0 0 255 ECU_ADDRESS 0xfe4cb1e9 /* @ECU_Address@SwcIn_SysIn_NvM_Read.TS_SignName_Value_Init@ */ /end MEASUREMENT
/begin MEASUREMENT SwcIn_SysIn_NvM_Read.Uint8_Reserve "" UBYTE autosar_swc_val_CM_uint8 0 0 0 255 LAYOUT COLUMN_DIR MATRIX_DIM 2 ECU_ADDRESS 0xfe4cb1ee /* @ECU_Address@SwcIn_SysIn_NvM_Read.Uint8_Reserve@ */ /end MEASUREMENT
/begin MEASUREMENT SwcIn_SysIn_NvM_Read.VoiceRemindType "" UBYTE autosar_swc_val_CM_uint8 0 0 0 255 ECU_ADDRESS 0xfe4cb1e4 /* @ECU_Address@SwcIn_SysIn_NvM_Read.VoiceRemindType@ */ /end MEASUREMENT
/begin MEASUREMENT SwcIn_TCM_1.TCM_1_TrailerSts "" UBYTE autosar_swc_val_CM_TCM_1_TrailerSts_1199_dt 0 0 0 255 ECU_ADDRESS 0xfe4cce81 /* @ECU_Address@SwcIn_TCM_1.TCM_1_TrailerSts@ */ /end MEASUREMENT
/begin MEASUREMENT SwcIn_TMS_1.ExternalTemperatureFailSts "" UBYTE autosar_swc_val_CM_ExternalTemperatureFailSts_1172_dt 0 0 0 255 ECU_ADDRESS 0xfe4cb24c /* @ECU_Address@SwcIn_TMS_1.ExternalTemperatureFailSts@ */ /end MEASUREMENT
/begin MEASUREMENT SwcIn_TMS_1.ExternalTemperature_C "" FLOAT32_IEEE autosar_swc_val_CM_ExternalTemperature_C_1172_dt 0 0 -3.4E+38 3.4E+38 ECU_ADDRESS 0xfe4cb248 /* @ECU_Address@SwcIn_TMS_1.ExternalTemperature_C@ */ /end MEASUREMENT
/begin MEASUREMENT SwcIn_VAL_MemSet_TSRInit.SPL_SuppName_Value_Init "" UBYTE autosar_swc_val_CM_uint8 0 0 0 255 ECU_ADDRESS 0xfe4cb253 /* @ECU_Address@SwcIn_VAL_MemSet_TSRInit.SPL_SuppName_Value_Init@ */ /end MEASUREMENT
/begin MEASUREMENT SwcIn_VAL_MemSet_TSRInit.SPL_noSupp_Dist_Init "" FLOAT32_IEEE autosar_swc_val_CM_single 0 0 -3.4E+38 3.4E+38 ECU_ADDRESS 0xfe4cb254 /* @ECU_Address@SwcIn_VAL_MemSet_TSRInit.SPL_noSupp_Dist_Init@ */ /end MEASUREMENT
/begin MEASUREMENT SwcIn_VAL_MemSet_TSRInit.SPL_noSupp_Value_Init "" UBYTE autosar_swc_val_CM_uint8 0 0 0 255 ECU_ADDRESS 0xfe4cb250 /* @ECU_Address@SwcIn_VAL_MemSet_TSRInit.SPL_noSupp_Value_Init@ */ /end MEASUREMENT
/begin MEASUREMENT SwcIn_VAL_MemSet_TSRInit.SPL_whSupp_Dist_Init "" FLOAT32_IEEE autosar_swc_val_CM_single 0 0 -3.4E+38 3.4E+38 ECU_ADDRESS 0xfe4cb258 /* @ECU_Address@SwcIn_VAL_MemSet_TSRInit.SPL_whSupp_Dist_Init@ */ /end MEASUREMENT
/begin MEASUREMENT SwcIn_VAL_MemSet_TSRInit.SPL_whSupp_Value_Init "" UBYTE autosar_swc_val_CM_uint8 0 0 0 255 ECU_ADDRESS 0xfe4cb251 /* @ECU_Address@SwcIn_VAL_MemSet_TSRInit.SPL_whSupp_Value_Init@ */ /end MEASUREMENT
/begin MEASUREMENT SwcIn_VAL_MemSet_TSRInit.TS_SignName_Dist_Init "" FLOAT32_IEEE autosar_swc_val_CM_single 0 0 -3.4E+38 3.4E+38 ECU_ADDRESS 0xfe4cb25c /* @ECU_Address@SwcIn_VAL_MemSet_TSRInit.TS_SignName_Dist_Init@ */ /end MEASUREMENT
/begin MEASUREMENT SwcIn_VAL_MemSet_TSRInit.TS_SignName_Value_Init "" UBYTE autosar_swc_val_CM_uint8 0 0 0 255 ECU_ADDRESS 0xfe4cb252 /* @ECU_Address@SwcIn_VAL_MemSet_TSRInit.TS_SignName_Value_Init@ */ /end MEASUREMENT
/begin MEASUREMENT SwcIn_VCC_1.VCC_1_CarMode "" UBYTE autosar_swc_val_CM_VCC_1_CarMode_1035_dt 0 0 0 255 ECU_ADDRESS 0xfe4ccd64 /* @ECU_Address@SwcIn_VCC_1.VCC_1_CarMode@ */ /end MEASUREMENT
/begin MEASUREMENT SwcIn_VCC_1.VCC_1_DriveMode "" UBYTE autosar_swc_val_CM_VCC_1_DriveMode_1035_dt 0 0 0 255 ECU_ADDRESS 0xfe4ccd65 /* @ECU_Address@SwcIn_VCC_1.VCC_1_DriveMode@ */ /end MEASUREMENT
/begin MEASUREMENT SwcIn_VCC_2.VCC_2_ConfigurationMessageTrg "" UBYTE autosar_swc_val_CM_VCC_2_ConfigurationMessageTrg_1075_dt 0 0 0 255 ECU_ADDRESS 0xfe4cce86 /* @ECU_Address@SwcIn_VCC_2.VCC_2_ConfigurationMessageTrg@ */ /end MEASUREMENT
/begin MEASUREMENT SwcIn_VCC_3.VCC_3_CRC "" UBYTE autosar_swc_val_CM_VCC_3_CRC_1136_dt 0 0 0 255 ECU_ADDRESS 0xfe4cce87 /* @ECU_Address@SwcIn_VCC_3.VCC_3_CRC@ */ /end MEASUREMENT
/begin MEASUREMENT SwcIn_VCC_3.VCC_3_RollgCntr "" UBYTE autosar_swc_val_CM_VCC_3_RollgCntr_1136_dt 0 0 0 255 ECU_ADDRESS 0xfe4cce88 /* @ECU_Address@SwcIn_VCC_3.VCC_3_RollgCntr@ */ /end MEASUREMENT
/begin MEASUREMENT SwcIn_VCC_3.VCC_3_SN "" UBYTE autosar_swc_val_CM_VCC_3_SN_1136_dt 0 0 0 255 ECU_ADDRESS 0xfe4cce89 /* @ECU_Address@SwcIn_VCC_3.VCC_3_SN@ */ /end MEASUREMENT
/begin MEASUREMENT SwcIn_VCU_1_G.VCU_1_G_CRC "" UBYTE autosar_swc_val_CM_VCU_1_G_CRC_1204_dt 0 0 0 255 ECU_ADDRESS 0xfe4cb260 /* @ECU_Address@SwcIn_VCU_1_G.VCU_1_G_CRC@ */ /end MEASUREMENT
/begin MEASUREMENT SwcIn_VCU_1_G.VCU_1_G_Resd "" UBYTE autosar_swc_val_CM_VCU_1_G_Resd_1204_dt 0 0 0 255 ECU_ADDRESS 0xfe4cb262 /* @ECU_Address@SwcIn_VCU_1_G.VCU_1_G_Resd@ */ /end MEASUREMENT
/begin MEASUREMENT SwcIn_VCU_1_G.VCU_1_G_RollgCntr "" UBYTE autosar_swc_val_CM_VCU_1_G_RollgCntr_1204_dt 0 0 0 255 ECU_ADDRESS 0xfe4cb261 /* @ECU_Address@SwcIn_VCU_1_G.VCU_1_G_RollgCntr@ */ /end MEASUREMENT
/begin MEASUREMENT SwcIn_VCU_1_G.VCU_AcceleratorPosRaw "" FLOAT32_IEEE autosar_swc_val_CM_VCU_AcceleratorPosRaw_1204_dt 0 0 -3.4E+38 3.4E+38 ECU_ADDRESS 0xfe4cb264 /* @ECU_Address@SwcIn_VCU_1_G.VCU_AcceleratorPosRaw@ */ /end MEASUREMENT
/begin MEASUREMENT SwcIn_VCU_1_G.VCU_DriveMode "" UBYTE autosar_swc_val_CM_VCU_DriveMode_1204_dt 0 0 0 255 ECU_ADDRESS 0xfe4cb263 /* @ECU_Address@SwcIn_VCU_1_G.VCU_DriveMode@ */ /end MEASUREMENT
/begin MEASUREMENT SwcIn_VCU_2_G.VCU_2_G_CRC "" UBYTE autosar_swc_val_CM_VCU_2_G_CRC_1209_dt 0 0 0 255 ECU_ADDRESS 0xfe4ccb5c /* @ECU_Address@SwcIn_VCU_2_G.VCU_2_G_CRC@ */ /end MEASUREMENT
/begin MEASUREMENT SwcIn_VCU_2_G.VCU_2_G_Resd "" UBYTE autosar_swc_val_CM_VCU_2_G_Resd_1209_dt 0 0 0 255 ECU_ADDRESS 0xfe4ccb5e /* @ECU_Address@SwcIn_VCU_2_G.VCU_2_G_Resd@ */ /end MEASUREMENT
/begin MEASUREMENT SwcIn_VCU_2_G.VCU_2_G_RollgCntr "" UBYTE autosar_swc_val_CM_VCU_2_G_RollgCntr_1209_dt 0 0 0 255 ECU_ADDRESS 0xfe4ccb5d /* @ECU_Address@SwcIn_VCU_2_G.VCU_2_G_RollgCntr@ */ /end MEASUREMENT
/begin MEASUREMENT SwcIn_VCU_2_G.VCU_GasPedalPosition "" FLOAT32_IEEE autosar_swc_val_CM_VCU_GasPedalPosition_1209_dt 0 0 -3.4E+38 3.4E+38 ECU_ADDRESS 0xfe4ccb60 /* @ECU_Address@SwcIn_VCU_2_G.VCU_GasPedalPosition@ */ /end MEASUREMENT
/begin MEASUREMENT SwcIn_VCU_2_G.VCU_GasPedalPositionInvalidData "" UBYTE autosar_swc_val_CM_VCU_GasPedalPositionInvalidData_1209_dt 0 0 0 255 ECU_ADDRESS 0xfe4ccb64 /* @ECU_Address@SwcIn_VCU_2_G.VCU_GasPedalPositionInvalidData@ */ /end MEASUREMENT
/begin MEASUREMENT SwcIn_VCU_2_G.VCU_HVReady "" UBYTE autosar_swc_val_CM_VCU_HVReady_1209_dt 0 0 0 255 ECU_ADDRESS 0xfe4ccb65 /* @ECU_Address@SwcIn_VCU_2_G.VCU_HVReady@ */ /end MEASUREMENT
/begin MEASUREMENT SwcIn_VCU_3_G.VCU_ActWheelTorqueFA "" SWORD autosar_swc_val_CM_VCU_ActWheelTorqueFA_1212_dt 0 0 -32768 32767 ECU_ADDRESS 0xfe4ccb68 /* @ECU_Address@SwcIn_VCU_3_G.VCU_ActWheelTorqueFA@ */ /end MEASUREMENT
/begin MEASUREMENT SwcIn_VCU_3_G.VCU_ActWheelTorqueRA "" SWORD autosar_swc_val_CM_VCU_ActWheelTorqueRA_1212_dt 0 0 -32768 32767 ECU_ADDRESS 0xfe4ccb6a /* @ECU_Address@SwcIn_VCU_3_G.VCU_ActWheelTorqueRA@ */ /end MEASUREMENT
/begin MEASUREMENT SwcIn_VCU_4_G.VCU_DynamicRangeAval "" UWORD autosar_swc_val_CM_VCU_DynamicRangeAval_1229_dt 0 0 0 65535 ECU_ADDRESS 0xfe4ccd66 /* @ECU_Address@SwcIn_VCU_4_G.VCU_DynamicRangeAval@ */ /end MEASUREMENT
/begin MEASUREMENT SwcIn_VCU_ADCC_12.VCU_12_CRC1 "" UBYTE autosar_swc_val_CM_VCU_12_CRC1_75_dt 0 0 0 255 ECU_ADDRESS 0xfe4ccb6c /* @ECU_Address@SwcIn_VCU_ADCC_12.VCU_12_CRC1@ */ /end MEASUREMENT
/begin MEASUREMENT SwcIn_VCU_ADCC_12.VCU_12_CRC2 "" UBYTE autosar_swc_val_CM_VCU_12_CRC2_75_dt 0 0 0 255 ECU_ADDRESS 0xfe4ccb79 /* @ECU_Address@SwcIn_VCU_ADCC_12.VCU_12_CRC2@ */ /end MEASUREMENT
/begin MEASUREMENT SwcIn_VCU_ADCC_12.VCU_12_CRC3 "" UBYTE autosar_swc_val_CM_VCU_12_CRC3_75_dt 0 0 0 255 ECU_ADDRESS 0xfe4ccb80 /* @ECU_Address@SwcIn_VCU_ADCC_12.VCU_12_CRC3@ */ /end MEASUREMENT
/begin MEASUREMENT SwcIn_VCU_ADCC_12.VCU_12_DriverTorqueDesired "" SWORD autosar_swc_val_CM_VCU_12_DriverTorqueDesired_75_dt 0 0 -32768 32767 ECU_ADDRESS 0xfe4ccb72 /* @ECU_Address@SwcIn_VCU_ADCC_12.VCU_12_DriverTorqueDesired@ */ /end MEASUREMENT
/begin MEASUREMENT SwcIn_VCU_ADCC_12.VCU_12_DrvrAccrPedlOvrd "" UBYTE autosar_swc_val_CM_VCU_12_DrvrAccrPedlOvrd_75_dt 0 0 0 255 ECU_ADDRESS 0xfe4ccb74 /* @ECU_Address@SwcIn_VCU_ADCC_12.VCU_12_DrvrAccrPedlOvrd@ */ /end MEASUREMENT
/begin MEASUREMENT SwcIn_VCU_ADCC_12.VCU_12_DrvrGearIntervention "" UBYTE autosar_swc_val_CM_VCU_12_DrvrGearIntervention_75_dt 0 0 0 255 ECU_ADDRESS 0xfe4ccb6f /* @ECU_Address@SwcIn_VCU_ADCC_12.VCU_12_DrvrGearIntervention@ */ /end MEASUREMENT
/begin MEASUREMENT SwcIn_VCU_ADCC_12.VCU_12_GasPedalInhabition "" UBYTE autosar_swc_val_CM_VCU_12_GasPedalInhabition_75_dt 0 0 0 255 ECU_ADDRESS 0xfe4ccb7f /* @ECU_Address@SwcIn_VCU_ADCC_12.VCU_12_GasPedalInhabition@ */ /end MEASUREMENT
/begin MEASUREMENT SwcIn_VCU_ADCC_12.VCU_12_PtTqActvSts "" UBYTE autosar_swc_val_CM_VCU_12_PtTqActvSts_75_dt 0 0 0 255 ECU_ADDRESS 0xfe4ccb70 /* @ECU_Address@SwcIn_VCU_ADCC_12.VCU_12_PtTqActvSts@ */ /end MEASUREMENT
/begin MEASUREMENT SwcIn_VCU_ADCC_12.VCU_12_PtTqAvl "" UBYTE autosar_swc_val_CM_VCU_12_PtTqAvl_75_dt 0 0 0 255 ECU_ADDRESS 0xfe4ccb71 /* @ECU_Address@SwcIn_VCU_ADCC_12.VCU_12_PtTqAvl@ */ /end MEASUREMENT
/begin MEASUREMENT SwcIn_VCU_ADCC_12.VCU_12_PtTqMax "" SWORD autosar_swc_val_CM_VCU_12_PtTqMax_75_dt 0 0 -32768 32767 ECU_ADDRESS 0xfe4ccb7c /* @ECU_Address@SwcIn_VCU_ADCC_12.VCU_12_PtTqMax@ */ /end MEASUREMENT
/begin MEASUREMENT SwcIn_VCU_ADCC_12.VCU_12_PtTqMaxVld "" UBYTE autosar_swc_val_CM_VCU_12_PtTqMaxVld_75_dt 0 0 0 255 ECU_ADDRESS 0xfe4ccb7e /* @ECU_Address@SwcIn_VCU_ADCC_12.VCU_12_PtTqMaxVld@ */ /end MEASUREMENT
/begin MEASUREMENT SwcIn_VCU_ADCC_12.VCU_12_Resd1 "" UBYTE autosar_swc_val_CM_VCU_12_Resd1_75_dt 0 0 0 255 ECU_ADDRESS 0xfe4ccb6e /* @ECU_Address@SwcIn_VCU_ADCC_12.VCU_12_Resd1@ */ /end MEASUREMENT
/begin MEASUREMENT SwcIn_VCU_ADCC_12.VCU_12_Resd2 "" UBYTE autosar_swc_val_CM_VCU_12_Resd2_75_dt 0 0 0 255 ECU_ADDRESS 0xfe4ccb7b /* @ECU_Address@SwcIn_VCU_ADCC_12.VCU_12_Resd2@ */ /end MEASUREMENT
/begin MEASUREMENT SwcIn_VCU_ADCC_12.VCU_12_Resd3 "" UBYTE autosar_swc_val_CM_VCU_12_Resd3_75_dt 0 0 0 255 ECU_ADDRESS 0xfe4ccb82 /* @ECU_Address@SwcIn_VCU_ADCC_12.VCU_12_Resd3@ */ /end MEASUREMENT
/begin MEASUREMENT SwcIn_VCU_ADCC_12.VCU_12_RollgCntr1 "" UBYTE autosar_swc_val_CM_VCU_12_RollgCntr1_75_dt 0 0 0 255 ECU_ADDRESS 0xfe4ccb6d /* @ECU_Address@SwcIn_VCU_ADCC_12.VCU_12_RollgCntr1@ */ /end MEASUREMENT
/begin MEASUREMENT SwcIn_VCU_ADCC_12.VCU_12_RollgCntr2 "" UBYTE autosar_swc_val_CM_VCU_12_RollgCntr2_75_dt 0 0 0 255 ECU_ADDRESS 0xfe4ccb7a /* @ECU_Address@SwcIn_VCU_ADCC_12.VCU_12_RollgCntr2@ */ /end MEASUREMENT
/begin MEASUREMENT SwcIn_VCU_ADCC_12.VCU_12_RollgCntr3 "" UBYTE autosar_swc_val_CM_VCU_12_RollgCntr3_75_dt 0 0 0 255 ECU_ADDRESS 0xfe4ccb81 /* @ECU_Address@SwcIn_VCU_ADCC_12.VCU_12_RollgCntr3@ */ /end MEASUREMENT
/begin MEASUREMENT SwcIn_VCU_ADCC_12.VCU_12_VehWhlActTq "" SWORD autosar_swc_val_CM_VCU_12_VehWhlActTq_75_dt 0 0 -32768 32767 ECU_ADDRESS 0xfe4ccb76 /* @ECU_Address@SwcIn_VCU_ADCC_12.VCU_12_VehWhlActTq@ */ /end MEASUREMENT
/begin MEASUREMENT SwcIn_VCU_ADCC_12.VCU_12_VehWhlActTqADS "" UWORD autosar_swc_val_CM_VCU_12_VehWhlActTqADS_75_dt 0 0 0 65535 ECU_ADDRESS 0xfe4ccb84 /* @ECU_Address@SwcIn_VCU_ADCC_12.VCU_12_VehWhlActTqADS@ */ /end MEASUREMENT
/begin MEASUREMENT SwcIn_VCU_ADCC_12.VCU_12_VehWhlActTqADSVld "" UBYTE autosar_swc_val_CM_VCU_12_VehWhlActTqADSVld_75_dt 0 0 0 255 ECU_ADDRESS 0xfe4ccb86 /* @ECU_Address@SwcIn_VCU_ADCC_12.VCU_12_VehWhlActTqADSVld@ */ /end MEASUREMENT
/begin MEASUREMENT SwcIn_VCU_ADCC_12.VCU_12_VehWhlActTqVld "" UBYTE autosar_swc_val_CM_VCU_12_VehWhlActTqVld_75_dt 0 0 0 255 ECU_ADDRESS 0xfe4ccb78 /* @ECU_Address@SwcIn_VCU_ADCC_12.VCU_12_VehWhlActTqVld@ */ /end MEASUREMENT
/begin MEASUREMENT SwcIn_VCU_COM_10.VCU_10_CRC "" UBYTE autosar_swc_val_CM_VCU_10_CRC_56_dt 0 0 0 255 ECU_ADDRESS 0xfe4cce8a /* @ECU_Address@SwcIn_VCU_COM_10.VCU_10_CRC@ */ /end MEASUREMENT
/begin MEASUREMENT SwcIn_VCU_COM_10.VCU_10_Resd "" UBYTE autosar_swc_val_CM_VCU_10_Resd_56_dt 0 0 0 255 ECU_ADDRESS 0xfe4cce8c /* @ECU_Address@SwcIn_VCU_COM_10.VCU_10_Resd@ */ /end MEASUREMENT
/begin MEASUREMENT SwcIn_VCU_COM_10.VCU_10_RollgCntr "" UBYTE autosar_swc_val_CM_VCU_10_RollgCntr_56_dt 0 0 0 255 ECU_ADDRESS 0xfe4cce8b /* @ECU_Address@SwcIn_VCU_COM_10.VCU_10_RollgCntr@ */ /end MEASUREMENT
/begin MEASUREMENT SwcIn_VCU_COM_10.VCU_ActualGear "" UBYTE autosar_swc_val_CM_VCU_ActualGear_56_dt 0 0 0 255 ECU_ADDRESS 0xfe4cce8e /* @ECU_Address@SwcIn_VCU_COM_10.VCU_ActualGear@ */ /end MEASUREMENT
/begin MEASUREMENT SwcIn_VCU_COM_10.VCU_ActualGearValidData "" UBYTE autosar_swc_val_CM_VCU_ActualGearValidData_56_dt 0 0 0 255 ECU_ADDRESS 0xfe4cce90 /* @ECU_Address@SwcIn_VCU_COM_10.VCU_ActualGearValidData@ */ /end MEASUREMENT
/begin MEASUREMENT SwcIn_VCU_COM_10.VCU_BrakePedalSts "" UBYTE autosar_swc_val_CM_VCU_BrakePedalSts_56_dt 0 0 0 255 ECU_ADDRESS 0xfe4cce92 /* @ECU_Address@SwcIn_VCU_COM_10.VCU_BrakePedalSts@ */ /end MEASUREMENT
/begin MEASUREMENT SwcIn_VCU_COM_10.VCU_BrakePedalStsValidData "" UBYTE autosar_swc_val_CM_VCU_BrakePedalStsValidData_56_dt 0 0 0 255 ECU_ADDRESS 0xfe4cce91 /* @ECU_Address@SwcIn_VCU_COM_10.VCU_BrakePedalStsValidData@ */ /end MEASUREMENT
/begin MEASUREMENT SwcIn_VCU_COM_10.VCU_TargetGear "" UBYTE autosar_swc_val_CM_VCU_TargetGear_56_dt 0 0 0 255 ECU_ADDRESS 0xfe4cce8d /* @ECU_Address@SwcIn_VCU_COM_10.VCU_TargetGear@ */ /end MEASUREMENT
/begin MEASUREMENT SwcIn_VCU_COM_10.VCU_TargetGearValidData "" UBYTE autosar_swc_val_CM_VCU_TargetGearValidData_56_dt 0 0 0 255 ECU_ADDRESS 0xfe4cce8f /* @ECU_Address@SwcIn_VCU_COM_10.VCU_TargetGearValidData@ */ /end MEASUREMENT
/begin MEASUREMENT SwcIn_VCU_ONEBOX_11.VCU_11_CRC1 "" UBYTE autosar_swc_val_CM_VCU_11_CRC1_59_dt 0 0 0 255 ECU_ADDRESS 0xfe4ccb88 /* @ECU_Address@SwcIn_VCU_ONEBOX_11.VCU_11_CRC1@ */ /end MEASUREMENT
/begin MEASUREMENT SwcIn_VCU_ONEBOX_11.VCU_11_CRC2 "" UBYTE autosar_swc_val_CM_VCU_11_CRC2_59_dt 0 0 0 255 ECU_ADDRESS 0xfe4ccb94 /* @ECU_Address@SwcIn_VCU_ONEBOX_11.VCU_11_CRC2@ */ /end MEASUREMENT
/begin MEASUREMENT SwcIn_VCU_ONEBOX_11.VCU_11_CRC3 "" UBYTE autosar_swc_val_CM_VCU_11_CRC3_59_dt 0 0 0 255 ECU_ADDRESS 0xfe4ccb9c /* @ECU_Address@SwcIn_VCU_ONEBOX_11.VCU_11_CRC3@ */ /end MEASUREMENT
/begin MEASUREMENT SwcIn_VCU_ONEBOX_11.VCU_11_CRC4 "" UBYTE autosar_swc_val_CM_VCU_11_CRC4_59_dt 0 0 0 255 ECU_ADDRESS 0xfe4ccba7 /* @ECU_Address@SwcIn_VCU_ONEBOX_11.VCU_11_CRC4@ */ /end MEASUREMENT
/begin MEASUREMENT SwcIn_VCU_ONEBOX_11.VCU_11_Resd1 "" UBYTE autosar_swc_val_CM_VCU_11_Resd1_59_dt 0 0 0 255 ECU_ADDRESS 0xfe4ccb8a /* @ECU_Address@SwcIn_VCU_ONEBOX_11.VCU_11_Resd1@ */ /end MEASUREMENT
/begin MEASUREMENT SwcIn_VCU_ONEBOX_11.VCU_11_Resd2 "" UBYTE autosar_swc_val_CM_VCU_11_Resd2_59_dt 0 0 0 255 ECU_ADDRESS 0xfe4ccb96 /* @ECU_Address@SwcIn_VCU_ONEBOX_11.VCU_11_Resd2@ */ /end MEASUREMENT
/begin MEASUREMENT SwcIn_VCU_ONEBOX_11.VCU_11_Resd3 "" UBYTE autosar_swc_val_CM_VCU_11_Resd3_59_dt 0 0 0 255 ECU_ADDRESS 0xfe4ccb9e /* @ECU_Address@SwcIn_VCU_ONEBOX_11.VCU_11_Resd3@ */ /end MEASUREMENT
/begin MEASUREMENT SwcIn_VCU_ONEBOX_11.VCU_11_Resd4 "" UBYTE autosar_swc_val_CM_VCU_11_Resd4_59_dt 0 0 0 255 ECU_ADDRESS 0xfe4ccba9 /* @ECU_Address@SwcIn_VCU_ONEBOX_11.VCU_11_Resd4@ */ /end MEASUREMENT
/begin MEASUREMENT SwcIn_VCU_ONEBOX_11.VCU_11_RollgCntr1 "" UBYTE autosar_swc_val_CM_VCU_11_RollgCntr1_59_dt 0 0 0 255 ECU_ADDRESS 0xfe4ccb89 /* @ECU_Address@SwcIn_VCU_ONEBOX_11.VCU_11_RollgCntr1@ */ /end MEASUREMENT
/begin MEASUREMENT SwcIn_VCU_ONEBOX_11.VCU_11_RollgCntr2 "" UBYTE autosar_swc_val_CM_VCU_11_RollgCntr2_59_dt 0 0 0 255 ECU_ADDRESS 0xfe4ccb95 /* @ECU_Address@SwcIn_VCU_ONEBOX_11.VCU_11_RollgCntr2@ */ /end MEASUREMENT
/begin MEASUREMENT SwcIn_VCU_ONEBOX_11.VCU_11_RollgCntr3 "" UBYTE autosar_swc_val_CM_VCU_11_RollgCntr3_59_dt 0 0 0 255 ECU_ADDRESS 0xfe4ccb9d /* @ECU_Address@SwcIn_VCU_ONEBOX_11.VCU_11_RollgCntr3@ */ /end MEASUREMENT
/begin MEASUREMENT SwcIn_VCU_ONEBOX_11.VCU_11_RollgCntr4 "" UBYTE autosar_swc_val_CM_VCU_11_RollgCntr4_59_dt 0 0 0 255 ECU_ADDRESS 0xfe4ccba8 /* @ECU_Address@SwcIn_VCU_ONEBOX_11.VCU_11_RollgCntr4@ */ /end MEASUREMENT
/begin MEASUREMENT SwcIn_VCU_ONEBOX_11.VCU_AcceleratorPosRaw "" FLOAT32_IEEE autosar_swc_val_CM_VCU_AcceleratorPosRaw_59_dt 0 0 -3.4E+38 3.4E+38 ECU_ADDRESS 0xfe4ccbb0 /* @ECU_Address@SwcIn_VCU_ONEBOX_11.VCU_AcceleratorPosRaw@ */ /end MEASUREMENT
/begin MEASUREMENT SwcIn_VCU_ONEBOX_11.VCU_AcceleratorPosRawIVD "" UBYTE autosar_swc_val_CM_VCU_AcceleratorPosRawIVD_59_dt 0 0 0 255 ECU_ADDRESS 0xfe4ccbab /* @ECU_Address@SwcIn_VCU_ONEBOX_11.VCU_AcceleratorPosRawIVD@ */ /end MEASUREMENT
/begin MEASUREMENT SwcIn_VCU_ONEBOX_11.VCU_ActWheelSpdFA "" SLONG autosar_swc_val_CM_VCU_ActWheelSpdFA_59_dt 0 0 -2147483648 2147483647 ECU_ADDRESS 0xfe4ccb90 /* @ECU_Address@SwcIn_VCU_ONEBOX_11.VCU_ActWheelSpdFA@ */ /end MEASUREMENT
/begin MEASUREMENT SwcIn_VCU_ONEBOX_11.VCU_ActWheelSpdRA "" SLONG autosar_swc_val_CM_VCU_ActWheelSpdRA_59_dt 0 0 -2147483648 2147483647 ECU_ADDRESS 0xfe4ccba0 /* @ECU_Address@SwcIn_VCU_ONEBOX_11.VCU_ActWheelSpdRA@ */ /end MEASUREMENT
/begin MEASUREMENT SwcIn_VCU_ONEBOX_11.VCU_ActWheelSpdStsFA "" UBYTE autosar_swc_val_CM_VCU_ActWheelSpdStsFA_59_dt 0 0 0 255 ECU_ADDRESS 0xfe4ccb99 /* @ECU_Address@SwcIn_VCU_ONEBOX_11.VCU_ActWheelSpdStsFA@ */ /end MEASUREMENT
/begin MEASUREMENT SwcIn_VCU_ONEBOX_11.VCU_ActWheelSpdStsRA "" UBYTE autosar_swc_val_CM_VCU_ActWheelSpdStsRA_59_dt 0 0 0 255 ECU_ADDRESS 0xfe4ccba6 /* @ECU_Address@SwcIn_VCU_ONEBOX_11.VCU_ActWheelSpdStsRA@ */ /end MEASUREMENT
/begin MEASUREMENT SwcIn_VCU_ONEBOX_11.VCU_ActWheelTorqueStsFA "" UBYTE autosar_swc_val_CM_VCU_ActWheelTorqueStsFA_59_dt 0 0 0 255 ECU_ADDRESS 0xfe4ccb98 /* @ECU_Address@SwcIn_VCU_ONEBOX_11.VCU_ActWheelTorqueStsFA@ */ /end MEASUREMENT
/begin MEASUREMENT SwcIn_VCU_ONEBOX_11.VCU_ActWheelTorqueStsRA "" UBYTE autosar_swc_val_CM_VCU_ActWheelTorqueStsRA_59_dt 0 0 0 255 ECU_ADDRESS 0xfe4ccba5 /* @ECU_Address@SwcIn_VCU_ONEBOX_11.VCU_ActWheelTorqueStsRA@ */ /end MEASUREMENT
/begin MEASUREMENT SwcIn_VCU_ONEBOX_11.VCU_GasPedalPosition "" FLOAT32_IEEE autosar_swc_val_CM_VCU_GasPedalPosition_59_dt 0 0 -3.4E+38 3.4E+38 ECU_ADDRESS 0xfe4ccbac /* @ECU_Address@SwcIn_VCU_ONEBOX_11.VCU_GasPedalPosition@ */ /end MEASUREMENT
/begin MEASUREMENT SwcIn_VCU_ONEBOX_11.VCU_GasPedalPositionInvalidData "" UBYTE autosar_swc_val_CM_VCU_GasPedalPositionInvalidData_59_dt 0 0 0 255 ECU_ADDRESS 0xfe4ccbaa /* @ECU_Address@SwcIn_VCU_ONEBOX_11.VCU_GasPedalPositionInvalidData@ */ /end MEASUREMENT
/begin MEASUREMENT SwcIn_VCU_ONEBOX_11.VCU_IndcdDriverReqWhlTqStsFA "" UBYTE autosar_swc_val_CM_VCU_IndcdDriverReqWhlTqStsFA_59_dt 0 0 0 255 ECU_ADDRESS 0xfe4ccb97 /* @ECU_Address@SwcIn_VCU_ONEBOX_11.VCU_IndcdDriverReqWhlTqStsFA@ */ /end MEASUREMENT
/begin MEASUREMENT SwcIn_VCU_ONEBOX_11.VCU_IndcdDriverReqWhlTqStsRA "" UBYTE autosar_swc_val_CM_VCU_IndcdDriverReqWhlTqStsRA_59_dt 0 0 0 255 ECU_ADDRESS 0xfe4ccba4 /* @ECU_Address@SwcIn_VCU_ONEBOX_11.VCU_IndcdDriverReqWhlTqStsRA@ */ /end MEASUREMENT
/begin MEASUREMENT SwcIn_VCU_ONEBOX_11.VCU_IndicatedDriverReqWhlTqFA "" SWORD autosar_swc_val_CM_VCU_IndicatedDriverReqWhlTqFA_59_dt 0 0 -32768 32767 ECU_ADDRESS 0xfe4ccb8c /* @ECU_Address@SwcIn_VCU_ONEBOX_11.VCU_IndicatedDriverReqWhlTqFA@ */ /end MEASUREMENT
/begin MEASUREMENT SwcIn_VCU_ONEBOX_11.VCU_IndicatedDriverReqWhlTqRA "" SWORD autosar_swc_val_CM_VCU_IndicatedDriverReqWhlTqRA_59_dt 0 0 -32768 32767 ECU_ADDRESS 0xfe4ccb9a /* @ECU_Address@SwcIn_VCU_ONEBOX_11.VCU_IndicatedDriverReqWhlTqRA@ */ /end MEASUREMENT
/begin MEASUREMENT SwcOut_ADS_COM_2.ADS_2_AEBStatus "" UBYTE autosar_swc_val_CM_ADS_2_AEBStatus_788_dt 0 0 0 255 ECU_ADDRESS 0xfe4ccbba /* @ECU_Address@SwcOut_ADS_COM_2.ADS_2_AEBStatus@ */ /end MEASUREMENT
/begin MEASUREMENT SwcOut_ADS_COM_2.ADS_2_CRC1 "" UBYTE autosar_swc_val_CM_ADS_2_CRC1_788_dt 0 0 0 255 ECU_ADDRESS 0xfe4ccbb4 /* @ECU_Address@SwcOut_ADS_COM_2.ADS_2_CRC1@ */ /end MEASUREMENT
/begin MEASUREMENT SwcOut_ADS_COM_2.ADS_2_ClosingSpeed "" UBYTE autosar_swc_val_CM_ADS_2_ClosingSpeed_788_dt 0 0 0 255 ECU_ADDRESS 0xfe4ccbbb /* @ECU_Address@SwcOut_ADS_COM_2.ADS_2_ClosingSpeed@ */ /end MEASUREMENT
/begin MEASUREMENT SwcOut_ADS_COM_2.ADS_2_FCWStatus "" UBYTE autosar_swc_val_CM_ADS_2_FCWStatus_788_dt 0 0 0 255 ECU_ADDRESS 0xfe4ccbc2 /* @ECU_Address@SwcOut_ADS_COM_2.ADS_2_FCWStatus@ */ /end MEASUREMENT
/begin MEASUREMENT SwcOut_ADS_COM_2.ADS_2_FunctionSuppressReq "" UBYTE autosar_swc_val_CM_ADS_2_FunctionSuppressReq_788_dt 0 0 0 255 ECU_ADDRESS 0xfe4ccbb7 /* @ECU_Address@SwcOut_ADS_COM_2.ADS_2_FunctionSuppressReq@ */ /end MEASUREMENT
/begin MEASUREMENT SwcOut_ADS_COM_2.ADS_2_HWRequest "" UBYTE autosar_swc_val_CM_ADS_2_HWRequest_788_dt 0 0 0 255 ECU_ADDRESS 0xfe4ccbb8 /* @ECU_Address@SwcOut_ADS_COM_2.ADS_2_HWRequest@ */ /end MEASUREMENT
/begin MEASUREMENT SwcOut_ADS_COM_2.ADS_2_Object "" UBYTE autosar_swc_val_CM_ADS_2_Object_788_dt 0 0 0 255 ECU_ADDRESS 0xfe4ccbc0 /* @ECU_Address@SwcOut_ADS_COM_2.ADS_2_Object@ */ /end MEASUREMENT
/begin MEASUREMENT SwcOut_ADS_COM_2.ADS_2_Object_Status "" UBYTE autosar_swc_val_CM_ADS_2_Object_Status_788_dt 0 0 0 255 ECU_ADDRESS 0xfe4ccbc1 /* @ECU_Address@SwcOut_ADS_COM_2.ADS_2_Object_Status@ */ /end MEASUREMENT
/begin MEASUREMENT SwcOut_ADS_COM_2.ADS_2_PP_M_Request "" UBYTE autosar_swc_val_CM_ADS_2_PP_M_Request_788_dt 0 0 0 255 ECU_ADDRESS 0xfe4ccbb9 /* @ECU_Address@SwcOut_ADS_COM_2.ADS_2_PP_M_Request@ */ /end MEASUREMENT
/begin MEASUREMENT SwcOut_ADS_COM_2.ADS_2_Resd1 "" UBYTE autosar_swc_val_CM_ADS_2_Resd1_788_dt 0 0 0 255 ECU_ADDRESS 0xfe4ccbb6 /* @ECU_Address@SwcOut_ADS_COM_2.ADS_2_Resd1@ */ /end MEASUREMENT
/begin MEASUREMENT SwcOut_ADS_COM_2.ADS_2_RollgCntr1 "" UBYTE autosar_swc_val_CM_ADS_2_RollgCntr1_788_dt 0 0 0 255 ECU_ADDRESS 0xfe4ccbb5 /* @ECU_Address@SwcOut_ADS_COM_2.ADS_2_RollgCntr1@ */ /end MEASUREMENT
/begin MEASUREMENT SwcOut_ADS_COM_2.ADS_2_TTC "" FLOAT32_IEEE autosar_swc_val_CM_ADS_2_TTC_788_dt 0 0 -3.4E+38 3.4E+38 ECU_ADDRESS 0xfe4ccbbc /* @ECU_Address@SwcOut_ADS_COM_2.ADS_2_TTC@ */ /end MEASUREMENT
/begin MEASUREMENT SwcOut_ADS_COM_2.FCM_2_HazardLightReq "" UBYTE autosar_swc_val_CM_FCM_2_HazardLightReq_788_dt 0 0 0 255 ECU_ADDRESS 0xfe4ccbc5 /* @ECU_Address@SwcOut_ADS_COM_2.FCM_2_HazardLightReq@ */ /end MEASUREMENT
/begin MEASUREMENT SwcOut_ADS_COM_2.FCM_2_HighBeamReq_Cmd "" UBYTE autosar_swc_val_CM_FCM_2_HighBeamReq_Cmd_788_dt 0 0 0 255 ECU_ADDRESS 0xfe4ccbc6 /* @ECU_Address@SwcOut_ADS_COM_2.FCM_2_HighBeamReq_Cmd@ */ /end MEASUREMENT
/begin MEASUREMENT SwcOut_ADS_COM_2.FCM_2_IHCfunctionSts "" UBYTE autosar_swc_val_CM_FCM_2_IHCfunctionSts_788_dt 0 0 0 255 ECU_ADDRESS 0xfe4ccbc4 /* @ECU_Address@SwcOut_ADS_COM_2.FCM_2_IHCfunctionSts@ */ /end MEASUREMENT
/begin MEASUREMENT SwcOut_ADS_COM_2.FCM_2_SysStatus "" UBYTE autosar_swc_val_CM_FCM_2_SysStatus_788_dt 0 0 0 255 ECU_ADDRESS 0xfe4ccbc3 /* @ECU_Address@SwcOut_ADS_COM_2.FCM_2_SysStatus@ */ /end MEASUREMENT
/begin MEASUREMENT SwcOut_ADS_COM_3.ADAS_ParkingActiveSubFuncSt "" UBYTE autosar_swc_val_CM_ADAS_ParkingActiveSubFuncSt_794_dt 0 0 0 255 ECU_ADDRESS 0xfe4ccea9 /* @ECU_Address@SwcOut_ADS_COM_3.ADAS_ParkingActiveSubFuncSt@ */ /end MEASUREMENT
/begin MEASUREMENT SwcOut_ADS_COM_3.ADS_3_ACCSts "" UBYTE autosar_swc_val_CM_ADS_3_ACCSts_794_dt 0 0 0 255 ECU_ADDRESS 0xfe4cce98 /* @ECU_Address@SwcOut_ADS_COM_3.ADS_3_ACCSts@ */ /end MEASUREMENT
/begin MEASUREMENT SwcOut_ADS_COM_3.ADS_3_AESStatus "" UBYTE autosar_swc_val_CM_ADS_3_AESStatus_794_dt 0 0 0 255 ECU_ADDRESS 0xfe4cce9a /* @ECU_Address@SwcOut_ADS_COM_3.ADS_3_AESStatus@ */ /end MEASUREMENT
/begin MEASUREMENT SwcOut_ADS_COM_3.ADS_3_CRC1 "" UBYTE autosar_swc_val_CM_ADS_3_CRC1_794_dt 0 0 0 255 ECU_ADDRESS 0xfe4cce93 /* @ECU_Address@SwcOut_ADS_COM_3.ADS_3_CRC1@ */ /end MEASUREMENT
/begin MEASUREMENT SwcOut_ADS_COM_3.ADS_3_CRC2 "" UBYTE autosar_swc_val_CM_ADS_3_CRC2_794_dt 0 0 0 255 ECU_ADDRESS 0xfe4ccea3 /* @ECU_Address@SwcOut_ADS_COM_3.ADS_3_CRC2@ */ /end MEASUREMENT
/begin MEASUREMENT SwcOut_ADS_COM_3.ADS_3_DriverHandsoffWarning "" UBYTE autosar_swc_val_CM_ADS_3_DriverHandsoffWarning_794_dt 0 0 0 255 ECU_ADDRESS 0xfe4cce99 /* @ECU_Address@SwcOut_ADS_COM_3.ADS_3_DriverHandsoffWarning@ */ /end MEASUREMENT
/begin MEASUREMENT SwcOut_ADS_COM_3.ADS_3_ELKLeftActiveSt "" UBYTE autosar_swc_val_CM_ADS_3_ELKLeftActiveSt_794_dt 0 0 0 255 ECU_ADDRESS 0xfe4ccea0 /* @ECU_Address@SwcOut_ADS_COM_3.ADS_3_ELKLeftActiveSt@ */ /end MEASUREMENT
/begin MEASUREMENT SwcOut_ADS_COM_3.ADS_3_ELKRightActiveSt "" UBYTE autosar_swc_val_CM_ADS_3_ELKRightActiveSt_794_dt 0 0 0 255 ECU_ADDRESS 0xfe4ccea1 /* @ECU_Address@SwcOut_ADS_COM_3.ADS_3_ELKRightActiveSt@ */ /end MEASUREMENT
/begin MEASUREMENT SwcOut_ADS_COM_3.ADS_3_ELKSts "" UBYTE autosar_swc_val_CM_ADS_3_ELKSts_794_dt 0 0 0 255 ECU_ADDRESS 0xfe4cce9d /* @ECU_Address@SwcOut_ADS_COM_3.ADS_3_ELKSts@ */ /end MEASUREMENT
/begin MEASUREMENT SwcOut_ADS_COM_3.ADS_3_ICAStatus "" UBYTE autosar_swc_val_CM_ADS_3_ICAStatus_794_dt 0 0 0 255 ECU_ADDRESS 0xfe4cce96 /* @ECU_Address@SwcOut_ADS_COM_3.ADS_3_ICAStatus@ */ /end MEASUREMENT
/begin MEASUREMENT SwcOut_ADS_COM_3.ADS_3_ICATextinfo "" UBYTE autosar_swc_val_CM_ADS_3_ICATextinfo_794_dt 0 0 0 255 ECU_ADDRESS 0xfe4cce97 /* @ECU_Address@SwcOut_ADS_COM_3.ADS_3_ICATextinfo@ */ /end MEASUREMENT
/begin MEASUREMENT SwcOut_ADS_COM_3.ADS_3_LKSLeftTrackingSt "" UBYTE autosar_swc_val_CM_ADS_3_LKSLeftTrackingSt_794_dt 0 0 0 255 ECU_ADDRESS 0xfe4cce9e /* @ECU_Address@SwcOut_ADS_COM_3.ADS_3_LKSLeftTrackingSt@ */ /end MEASUREMENT
/begin MEASUREMENT SwcOut_ADS_COM_3.ADS_3_LKSMod "" UBYTE autosar_swc_val_CM_ADS_3_LKSMod_794_dt 0 0 0 255 ECU_ADDRESS 0xfe4cce9b /* @ECU_Address@SwcOut_ADS_COM_3.ADS_3_LKSMod@ */ /end MEASUREMENT
/begin MEASUREMENT SwcOut_ADS_COM_3.ADS_3_LKSRightTrackingSt "" UBYTE autosar_swc_val_CM_ADS_3_LKSRightTrackingSt_794_dt 0 0 0 255 ECU_ADDRESS 0xfe4cce9f /* @ECU_Address@SwcOut_ADS_COM_3.ADS_3_LKSRightTrackingSt@ */ /end MEASUREMENT
/begin MEASUREMENT SwcOut_ADS_COM_3.ADS_3_LKSSts "" UBYTE autosar_swc_val_CM_ADS_3_LKSSts_794_dt 0 0 0 255 ECU_ADDRESS 0xfe4cce9c /* @ECU_Address@SwcOut_ADS_COM_3.ADS_3_LKSSts@ */ /end MEASUREMENT
/begin MEASUREMENT SwcOut_ADS_COM_3.ADS_3_RearViewFoldReq "" UBYTE autosar_swc_val_CM_ADS_3_RearViewFoldReq_794_dt 0 0 0 255 ECU_ADDRESS 0xfe4ccea2 /* @ECU_Address@SwcOut_ADS_COM_3.ADS_3_RearViewFoldReq@ */ /end MEASUREMENT
/begin MEASUREMENT SwcOut_ADS_COM_3.ADS_3_Resd1 "" UBYTE autosar_swc_val_CM_ADS_3_Resd1_794_dt 0 0 0 255 ECU_ADDRESS 0xfe4cce95 /* @ECU_Address@SwcOut_ADS_COM_3.ADS_3_Resd1@ */ /end MEASUREMENT
/begin MEASUREMENT SwcOut_ADS_COM_3.ADS_3_Resd2 "" UBYTE autosar_swc_val_CM_ADS_3_Resd2_794_dt 0 0 0 255 ECU_ADDRESS 0xfe4ccea5 /* @ECU_Address@SwcOut_ADS_COM_3.ADS_3_Resd2@ */ /end MEASUREMENT
/begin MEASUREMENT SwcOut_ADS_COM_3.ADS_3_RollgCntr1 "" UBYTE autosar_swc_val_CM_ADS_3_RollgCntr1_794_dt 0 0 0 255 ECU_ADDRESS 0xfe4cce94 /* @ECU_Address@SwcOut_ADS_COM_3.ADS_3_RollgCntr1@ */ /end MEASUREMENT
/begin MEASUREMENT SwcOut_ADS_COM_3.ADS_3_RollgCntr2 "" UBYTE autosar_swc_val_CM_ADS_3_RollgCntr2_794_dt 0 0 0 255 ECU_ADDRESS 0xfe4ccea4 /* @ECU_Address@SwcOut_ADS_COM_3.ADS_3_RollgCntr2@ */ /end MEASUREMENT
/begin MEASUREMENT SwcOut_ADS_COM_3.ADS_ALCSts "" UBYTE autosar_swc_val_CM_ADS_ALCSts_794_dt 0 0 0 255 ECU_ADDRESS 0xfe4ccea6 /* @ECU_Address@SwcOut_ADS_COM_3.ADS_ALCSts@ */ /end MEASUREMENT
/begin MEASUREMENT SwcOut_ADS_COM_3.ADS_HNOPSts "" UBYTE autosar_swc_val_CM_ADS_HNOPSts_794_dt 0 0 0 255 ECU_ADDRESS 0xfe4ccea7 /* @ECU_Address@SwcOut_ADS_COM_3.ADS_HNOPSts@ */ /end MEASUREMENT
/begin MEASUREMENT SwcOut_ADS_COM_3.ADS_UNOPSts "" UBYTE autosar_swc_val_CM_ADS_UNOPSts_794_dt 0 0 0 255 ECU_ADDRESS 0xfe4ccea8 /* @ECU_Address@SwcOut_ADS_COM_3.ADS_UNOPSts@ */ /end MEASUREMENT
/begin MEASUREMENT SwcOut_ADS_EPS_1.ADS_1_ADSHealthSts "" UBYTE autosar_swc_val_CM_ADS_1_ADSHealthSts_405_dt 0 0 0 255 ECU_ADDRESS 0xfe4cb280 /* @ECU_Address@SwcOut_ADS_EPS_1.ADS_1_ADSHealthSts@ */ /end MEASUREMENT
/begin MEASUREMENT SwcOut_ADS_EPS_1.ADS_1_CRC1 "" UBYTE autosar_swc_val_CM_ADS_1_CRC1_405_dt 0 0 0 255 ECU_ADDRESS 0xfe4cb268 /* @ECU_Address@SwcOut_ADS_EPS_1.ADS_1_CRC1@ */ /end MEASUREMENT
/begin MEASUREMENT SwcOut_ADS_EPS_1.ADS_1_CRC2 "" UBYTE autosar_swc_val_CM_ADS_1_CRC2_405_dt 0 0 0 255 ECU_ADDRESS 0xfe4cb272 /* @ECU_Address@SwcOut_ADS_EPS_1.ADS_1_CRC2@ */ /end MEASUREMENT
/begin MEASUREMENT SwcOut_ADS_EPS_1.ADS_1_LdwWarningCmd "" UBYTE autosar_swc_val_CM_ADS_1_LdwWarningCmd_405_dt 0 0 0 255 ECU_ADDRESS 0xfe4cb276 /* @ECU_Address@SwcOut_ADS_EPS_1.ADS_1_LdwWarningCmd@ */ /end MEASUREMENT
/begin MEASUREMENT SwcOut_ADS_EPS_1.ADS_1_LdwWarningCmdVld "" UBYTE autosar_swc_val_CM_ADS_1_LdwWarningCmdVld_405_dt 0 0 0 255 ECU_ADDRESS 0xfe4cb277 /* @ECU_Address@SwcOut_ADS_EPS_1.ADS_1_LdwWarningCmdVld@ */ /end MEASUREMENT
/begin MEASUREMENT SwcOut_ADS_EPS_1.ADS_1_Resd1 "" UBYTE autosar_swc_val_CM_ADS_1_Resd1_405_dt 0 0 0 255 ECU_ADDRESS 0xfe4cb26a /* @ECU_Address@SwcOut_ADS_EPS_1.ADS_1_Resd1@ */ /end MEASUREMENT
/begin MEASUREMENT SwcOut_ADS_EPS_1.ADS_1_Resd2 "" UBYTE autosar_swc_val_CM_ADS_1_Resd2_405_dt 0 0 0 255 ECU_ADDRESS 0xfe4cb274 /* @ECU_Address@SwcOut_ADS_EPS_1.ADS_1_Resd2@ */ /end MEASUREMENT
/begin MEASUREMENT SwcOut_ADS_EPS_1.ADS_1_RollgCntr1 "" UBYTE autosar_swc_val_CM_ADS_1_RollgCntr1_405_dt 0 0 0 255 ECU_ADDRESS 0xfe4cb269 /* @ECU_Address@SwcOut_ADS_EPS_1.ADS_1_RollgCntr1@ */ /end MEASUREMENT
/begin MEASUREMENT SwcOut_ADS_EPS_1.ADS_1_RollgCntr2 "" UBYTE autosar_swc_val_CM_ADS_1_RollgCntr2_405_dt 0 0 0 255 ECU_ADDRESS 0xfe4cb273 /* @ECU_Address@SwcOut_ADS_EPS_1.ADS_1_RollgCntr2@ */ /end MEASUREMENT
/begin MEASUREMENT SwcOut_ADS_EPS_1.ADS_1_SteerAgReq "" FLOAT32_IEEE autosar_swc_val_CM_ADS_1_SteerAgReq_405_dt 0 0 -3.4E+38 3.4E+38 ECU_ADDRESS 0xfe4cb26c /* @ECU_Address@SwcOut_ADS_EPS_1.ADS_1_SteerAgReq@ */ /end MEASUREMENT
/begin MEASUREMENT SwcOut_ADS_EPS_1.ADS_1_SteerAgVld "" UBYTE autosar_swc_val_CM_ADS_1_SteerAgVld_405_dt 0 0 0 255 ECU_ADDRESS 0xfe4cb270 /* @ECU_Address@SwcOut_ADS_EPS_1.ADS_1_SteerAgVld@ */ /end MEASUREMENT
/begin MEASUREMENT SwcOut_ADS_EPS_1.ADS_1_SteerMaxTqReq "" FLOAT32_IEEE autosar_swc_val_CM_ADS_1_SteerMaxTqReq_405_dt 0 0 -3.4E+38 3.4E+38 ECU_ADDRESS 0xfe4cb278 /* @ECU_Address@SwcOut_ADS_EPS_1.ADS_1_SteerMaxTqReq@ */ /end MEASUREMENT
/begin MEASUREMENT SwcOut_ADS_EPS_1.ADS_1_SteerMinTqReq "" FLOAT32_IEEE autosar_swc_val_CM_ADS_1_SteerMinTqReq_405_dt 0 0 -3.4E+38 3.4E+38 ECU_ADDRESS 0xfe4cb27c /* @ECU_Address@SwcOut_ADS_EPS_1.ADS_1_SteerMinTqReq@ */ /end MEASUREMENT
/begin MEASUREMENT SwcOut_ADS_EPS_1.ADS_1_SteerPilotAgEna "" UBYTE autosar_swc_val_CM_ADS_1_SteerPilotAgEna_405_dt 0 0 0 255 ECU_ADDRESS 0xfe4cb271 /* @ECU_Address@SwcOut_ADS_EPS_1.ADS_1_SteerPilotAgEna@ */ /end MEASUREMENT
/begin MEASUREMENT SwcOut_ADS_EPS_1.ADS_1_SteerTqEna "" UBYTE autosar_swc_val_CM_ADS_1_SteerTqEna_405_dt 0 0 0 255 ECU_ADDRESS 0xfe4cb275 /* @ECU_Address@SwcOut_ADS_EPS_1.ADS_1_SteerTqEna@ */ /end MEASUREMENT
/begin MEASUREMENT SwcOut_ADS_EPS_1.CutOutFreshvalues_2CB_S "" UWORD autosar_swc_val_CM_CutOutFreshvalues_2CB_S_405_dt 0 0 0 65535 ECU_ADDRESS 0xfe4cb282 /* @ECU_Address@SwcOut_ADS_EPS_1.CutOutFreshvalues_2CB_S@ */ /end MEASUREMENT
/begin MEASUREMENT SwcOut_ADS_EPS_1.CutOutMAC_2CB_S "" A_UINT64 autosar_swc_val_CM_CutOutMAC_2CB_S_405_dt 0 0 0.0 1.844674407370955e+19 ECU_ADDRESS 0xfe4cb288 /* @ECU_Address@SwcOut_ADS_EPS_1.CutOutMAC_2CB_S@ */ /end MEASUREMENT
/begin MEASUREMENT SwcOut_ADS_ONEBOX_2.FCM_2_AbaLvl "" UBYTE autosar_swc_val_CM_FCM_2_AbaLvl_325_dt 0 0 0 255 ECU_ADDRESS 0xfe4cb29d /* @ECU_Address@SwcOut_ADS_ONEBOX_2.FCM_2_AbaLvl@ */ /end MEASUREMENT
/begin MEASUREMENT SwcOut_ADS_ONEBOX_2.FCM_2_AbaReq "" UBYTE autosar_swc_val_CM_FCM_2_AbaReq_325_dt 0 0 0 255 ECU_ADDRESS 0xfe4cb29c /* @ECU_Address@SwcOut_ADS_ONEBOX_2.FCM_2_AbaReq@ */ /end MEASUREMENT
/begin MEASUREMENT SwcOut_ADS_ONEBOX_2.FCM_2_AebReqTyp "" UBYTE autosar_swc_val_CM_FCM_2_AebReqTyp_325_dt 0 0 0 255 ECU_ADDRESS 0xfe4cb293 /* @ECU_Address@SwcOut_ADS_ONEBOX_2.FCM_2_AebReqTyp@ */ /end MEASUREMENT
/begin MEASUREMENT SwcOut_ADS_ONEBOX_2.FCM_2_AebTarDec "" FLOAT32_IEEE autosar_swc_val_CM_FCM_2_AebTarDec_325_dt 0 0 -3.4E+38 3.4E+38 ECU_ADDRESS 0xfe4cb294 /* @ECU_Address@SwcOut_ADS_ONEBOX_2.FCM_2_AebTarDec@ */ /end MEASUREMENT
/begin MEASUREMENT SwcOut_ADS_ONEBOX_2.FCM_2_AebTarDecVld "" UBYTE autosar_swc_val_CM_FCM_2_AebTarDecVld_325_dt 0 0 0 255 ECU_ADDRESS 0xfe4cb298 /* @ECU_Address@SwcOut_ADS_ONEBOX_2.FCM_2_AebTarDecVld@ */ /end MEASUREMENT
/begin MEASUREMENT SwcOut_ADS_ONEBOX_2.FCM_2_Avl "" UBYTE autosar_swc_val_CM_FCM_2_Avl_325_dt 0 0 0 255 ECU_ADDRESS 0xfe4cb29e /* @ECU_Address@SwcOut_ADS_ONEBOX_2.FCM_2_Avl@ */ /end MEASUREMENT
/begin MEASUREMENT SwcOut_ADS_ONEBOX_2.FCM_2_AwbLvl "" UBYTE autosar_swc_val_CM_FCM_2_AwbLvl_325_dt 0 0 0 255 ECU_ADDRESS 0xfe4cb29a /* @ECU_Address@SwcOut_ADS_ONEBOX_2.FCM_2_AwbLvl@ */ /end MEASUREMENT
/begin MEASUREMENT SwcOut_ADS_ONEBOX_2.FCM_2_AwbReq "" UBYTE autosar_swc_val_CM_FCM_2_AwbReq_325_dt 0 0 0 255 ECU_ADDRESS 0xfe4cb299 /* @ECU_Address@SwcOut_ADS_ONEBOX_2.FCM_2_AwbReq@ */ /end MEASUREMENT
/begin MEASUREMENT SwcOut_ADS_ONEBOX_2.FCM_2_BrkPreFillReq "" UBYTE autosar_swc_val_CM_FCM_2_BrkPreFillReq_325_dt 0 0 0 255 ECU_ADDRESS 0xfe4cb29b /* @ECU_Address@SwcOut_ADS_ONEBOX_2.FCM_2_BrkPreFillReq@ */ /end MEASUREMENT
/begin MEASUREMENT SwcOut_ADS_ONEBOX_2.FCM_2_CRC1 "" UBYTE autosar_swc_val_CM_FCM_2_CRC1_325_dt 0 0 0 255 ECU_ADDRESS 0xfe4cb290 /* @ECU_Address@SwcOut_ADS_ONEBOX_2.FCM_2_CRC1@ */ /end MEASUREMENT
/begin MEASUREMENT SwcOut_ADS_ONEBOX_2.FCM_2_Resd1 "" UBYTE autosar_swc_val_CM_FCM_2_Resd1_325_dt 0 0 0 255 ECU_ADDRESS 0xfe4cb292 /* @ECU_Address@SwcOut_ADS_ONEBOX_2.FCM_2_Resd1@ */ /end MEASUREMENT
/begin MEASUREMENT SwcOut_ADS_ONEBOX_2.FCM_2_RollgCntr1 "" UBYTE autosar_swc_val_CM_FCM_2_RollgCntr1_325_dt 0 0 0 255 ECU_ADDRESS 0xfe4cb291 /* @ECU_Address@SwcOut_ADS_ONEBOX_2.FCM_2_RollgCntr1@ */ /end MEASUREMENT
/begin MEASUREMENT SwcOut_ADS_ONEBOX_3.CutOutFreshvalues_2CB_S "" UWORD autosar_swc_val_CM_CutOutFreshvalues_2CB_S_330_dt 0 0 0 65535 ECU_ADDRESS 0xfe4cb2b0 /* @ECU_Address@SwcOut_ADS_ONEBOX_3.CutOutFreshvalues_2CB_S@ */ /end MEASUREMENT
/begin MEASUREMENT SwcOut_ADS_ONEBOX_3.CutOutMAC_2CB_S "" A_UINT64 autosar_swc_val_CM_CutOutMAC_2CB_S_330_dt 0 0 0.0 1.844674407370955e+19 ECU_ADDRESS 0xfe4cb2b8 /* @ECU_Address@SwcOut_ADS_ONEBOX_3.CutOutMAC_2CB_S@ */ /end MEASUREMENT
/begin MEASUREMENT SwcOut_ADS_ONEBOX_3.FCM_3_CRC1 "" UBYTE autosar_swc_val_CM_FCM_3_CRC1_330_dt 0 0 0 255 ECU_ADDRESS 0xfe4cb2a0 /* @ECU_Address@SwcOut_ADS_ONEBOX_3.FCM_3_CRC1@ */ /end MEASUREMENT
/begin MEASUREMENT SwcOut_ADS_ONEBOX_3.FCM_3_PilotBrkDecTarReq "" UBYTE autosar_swc_val_CM_FCM_3_PilotBrkDecTarReq_330_dt 0 0 0 255 ECU_ADDRESS 0xfe4cb2ad /* @ECU_Address@SwcOut_ADS_ONEBOX_3.FCM_3_PilotBrkDecTarReq@ */ /end MEASUREMENT
/begin MEASUREMENT SwcOut_ADS_ONEBOX_3.FCM_3_PilotBrkDecTarVld "" UBYTE autosar_swc_val_CM_FCM_3_PilotBrkDecTarVld_330_dt 0 0 0 255 ECU_ADDRESS 0xfe4cb2ac /* @ECU_Address@SwcOut_ADS_ONEBOX_3.FCM_3_PilotBrkDecTarVld@ */ /end MEASUREMENT
/begin MEASUREMENT SwcOut_ADS_ONEBOX_3.FCM_3_PilotCtrlType "" UBYTE autosar_swc_val_CM_FCM_3_PilotCtrlType_330_dt 0 0 0 255 ECU_ADDRESS 0xfe4cb2a4 /* @ECU_Address@SwcOut_ADS_ONEBOX_3.FCM_3_PilotCtrlType@ */ /end MEASUREMENT
/begin MEASUREMENT SwcOut_ADS_ONEBOX_3.FCM_3_PilotDec2StpReq "" UBYTE autosar_swc_val_CM_FCM_3_PilotDec2StpReq_330_dt 0 0 0 255 ECU_ADDRESS 0xfe4cb2ae /* @ECU_Address@SwcOut_ADS_ONEBOX_3.FCM_3_PilotDec2StpReq@ */ /end MEASUREMENT
/begin MEASUREMENT SwcOut_ADS_ONEBOX_3.FCM_3_PilotDriOffReq "" UBYTE autosar_swc_val_CM_FCM_3_PilotDriOffReq_330_dt 0 0 0 255 ECU_ADDRESS 0xfe4cb2af /* @ECU_Address@SwcOut_ADS_ONEBOX_3.FCM_3_PilotDriOffReq@ */ /end MEASUREMENT
/begin MEASUREMENT SwcOut_ADS_ONEBOX_3.FCM_3_PilotParkCtrlRepSta "" UBYTE autosar_swc_val_CM_FCM_3_PilotParkCtrlRepSta_330_dt 0 0 0 255 ECU_ADDRESS 0xfe4cb2a3 /* @ECU_Address@SwcOut_ADS_ONEBOX_3.FCM_3_PilotParkCtrlRepSta@ */ /end MEASUREMENT
/begin MEASUREMENT SwcOut_ADS_ONEBOX_3.FCM_3_PilotkBrkDecTar "" FLOAT32_IEEE autosar_swc_val_CM_FCM_3_PilotkBrkDecTar_330_dt 0 0 -3.4E+38 3.4E+38 ECU_ADDRESS 0xfe4cb2a8 /* @ECU_Address@SwcOut_ADS_ONEBOX_3.FCM_3_PilotkBrkDecTar@ */ /end MEASUREMENT
/begin MEASUREMENT SwcOut_ADS_ONEBOX_3.FCM_3_Resd1 "" UBYTE autosar_swc_val_CM_FCM_3_Resd1_330_dt 0 0 0 255 ECU_ADDRESS 0xfe4cb2a2 /* @ECU_Address@SwcOut_ADS_ONEBOX_3.FCM_3_Resd1@ */ /end MEASUREMENT
/begin MEASUREMENT SwcOut_ADS_ONEBOX_3.FCM_3_RollgCntr1 "" UBYTE autosar_swc_val_CM_FCM_3_RollgCntr1_330_dt 0 0 0 255 ECU_ADDRESS 0xfe4cb2a1 /* @ECU_Address@SwcOut_ADS_ONEBOX_3.FCM_3_RollgCntr1@ */ /end MEASUREMENT
/begin MEASUREMENT SwcOut_ADS_VCU_1.ADS_1_ADCCAvl "" UBYTE autosar_swc_val_CM_ADS_1_ADCCAvl_359_dt 0 0 0 255 ECU_ADDRESS 0xfe4cb2cc /* @ECU_Address@SwcOut_ADS_VCU_1.ADS_1_ADCCAvl@ */ /end MEASUREMENT
/begin MEASUREMENT SwcOut_ADS_VCU_1.ADS_1_AMAPRequest "" UBYTE autosar_swc_val_CM_ADS_1_AMAPRequest_359_dt 0 0 0 255 ECU_ADDRESS 0xfe4cb2ca /* @ECU_Address@SwcOut_ADS_VCU_1.ADS_1_AMAPRequest@ */ /end MEASUREMENT
/begin MEASUREMENT SwcOut_ADS_VCU_1.ADS_1_AMAPRequestVld "" UBYTE autosar_swc_val_CM_ADS_1_AMAPRequestVld_359_dt 0 0 0 255 ECU_ADDRESS 0xfe4cb2cb /* @ECU_Address@SwcOut_ADS_VCU_1.ADS_1_AMAPRequestVld@ */ /end MEASUREMENT
/begin MEASUREMENT SwcOut_ADS_VCU_1.ADS_1_AMAPTqLimit "" UWORD autosar_swc_val_CM_ADS_1_AMAPTqLimit_359_dt 0 0 0 65535 ECU_ADDRESS 0xfe4cb2ce /* @ECU_Address@SwcOut_ADS_VCU_1.ADS_1_AMAPTqLimit@ */ /end MEASUREMENT
/begin MEASUREMENT SwcOut_ADS_VCU_1.ADS_1_AMAPTqLimitVld "" UBYTE autosar_swc_val_CM_ADS_1_AMAPTqLimitVld_359_dt 0 0 0 255 ECU_ADDRESS 0xfe4cb2d0 /* @ECU_Address@SwcOut_ADS_VCU_1.ADS_1_AMAPTqLimitVld@ */ /end MEASUREMENT
/begin MEASUREMENT SwcOut_ADS_VCU_1.ADS_1_CRC1 "" UBYTE autosar_swc_val_CM_ADS_1_CRC1_359_dt 0 0 0 255 ECU_ADDRESS 0xfe4cb2c0 /* @ECU_Address@SwcOut_ADS_VCU_1.ADS_1_CRC1@ */ /end MEASUREMENT
/begin MEASUREMENT SwcOut_ADS_VCU_1.ADS_1_CRC2 "" UBYTE autosar_swc_val_CM_ADS_1_CRC2_359_dt 0 0 0 255 ECU_ADDRESS 0xfe4cb2d1 /* @ECU_Address@SwcOut_ADS_VCU_1.ADS_1_CRC2@ */ /end MEASUREMENT
/begin MEASUREMENT SwcOut_ADS_VCU_1.ADS_1_CtrlReqMod "" UBYTE autosar_swc_val_CM_ADS_1_CtrlReqMod_359_dt 0 0 0 255 ECU_ADDRESS 0xfe4cb2c8 /* @ECU_Address@SwcOut_ADS_VCU_1.ADS_1_CtrlReqMod@ */ /end MEASUREMENT
/begin MEASUREMENT SwcOut_ADS_VCU_1.ADS_1_DrvCtrlReq "" UBYTE autosar_swc_val_CM_ADS_1_DrvCtrlReq_359_dt 0 0 0 255 ECU_ADDRESS 0xfe4cb2c7 /* @ECU_Address@SwcOut_ADS_VCU_1.ADS_1_DrvCtrlReq@ */ /end MEASUREMENT
/begin MEASUREMENT SwcOut_ADS_VCU_1.ADS_1_DrvTarTq "" UWORD autosar_swc_val_CM_ADS_1_DrvTarTq_359_dt 0 0 0 65535 ECU_ADDRESS 0xfe4cb2c4 /* @ECU_Address@SwcOut_ADS_VCU_1.ADS_1_DrvTarTq@ */ /end MEASUREMENT
/begin MEASUREMENT SwcOut_ADS_VCU_1.ADS_1_DrvTarTqEnable "" UBYTE autosar_swc_val_CM_ADS_1_DrvTarTqEnable_359_dt 0 0 0 255 ECU_ADDRESS 0xfe4cb2c9 /* @ECU_Address@SwcOut_ADS_VCU_1.ADS_1_DrvTarTqEnable@ */ /end MEASUREMENT
/begin MEASUREMENT SwcOut_ADS_VCU_1.ADS_1_DrvTarTqVld "" UBYTE autosar_swc_val_CM_ADS_1_DrvTarTqVld_359_dt 0 0 0 255 ECU_ADDRESS 0xfe4cb2c6 /* @ECU_Address@SwcOut_ADS_VCU_1.ADS_1_DrvTarTqVld@ */ /end MEASUREMENT
/begin MEASUREMENT SwcOut_ADS_VCU_1.ADS_1_GearCtrlEnable "" UBYTE autosar_swc_val_CM_ADS_1_GearCtrlEnable_359_dt 0 0 0 255 ECU_ADDRESS 0xfe4cb2d6 /* @ECU_Address@SwcOut_ADS_VCU_1.ADS_1_GearCtrlEnable@ */ /end MEASUREMENT
/begin MEASUREMENT SwcOut_ADS_VCU_1.ADS_1_Resd1 "" UBYTE autosar_swc_val_CM_ADS_1_Resd1_359_dt 0 0 0 255 ECU_ADDRESS 0xfe4cb2c2 /* @ECU_Address@SwcOut_ADS_VCU_1.ADS_1_Resd1@ */ /end MEASUREMENT
/begin MEASUREMENT SwcOut_ADS_VCU_1.ADS_1_Resd2 "" UBYTE autosar_swc_val_CM_ADS_1_Resd2_359_dt 0 0 0 255 ECU_ADDRESS 0xfe4cb2d3 /* @ECU_Address@SwcOut_ADS_VCU_1.ADS_1_Resd2@ */ /end MEASUREMENT
/begin MEASUREMENT SwcOut_ADS_VCU_1.ADS_1_RollgCntr1 "" UBYTE autosar_swc_val_CM_ADS_1_RollgCntr1_359_dt 0 0 0 255 ECU_ADDRESS 0xfe4cb2c1 /* @ECU_Address@SwcOut_ADS_VCU_1.ADS_1_RollgCntr1@ */ /end MEASUREMENT
/begin MEASUREMENT SwcOut_ADS_VCU_1.ADS_1_RollgCntr2 "" UBYTE autosar_swc_val_CM_ADS_1_RollgCntr2_359_dt 0 0 0 255 ECU_ADDRESS 0xfe4cb2d2 /* @ECU_Address@SwcOut_ADS_VCU_1.ADS_1_RollgCntr2@ */ /end MEASUREMENT
/begin MEASUREMENT SwcOut_ADS_VCU_1.ADS_1_RpaPTReadyReq "" UBYTE autosar_swc_val_CM_ADS_1_RpaPTReadyReq_359_dt 0 0 0 255 ECU_ADDRESS 0xfe4cb2d7 /* @ECU_Address@SwcOut_ADS_VCU_1.ADS_1_RpaPTReadyReq@ */ /end MEASUREMENT
/begin MEASUREMENT SwcOut_ADS_VCU_1.ADS_1_TarGearReq "" UBYTE autosar_swc_val_CM_ADS_1_TarGearReq_359_dt 0 0 0 255 ECU_ADDRESS 0xfe4cb2d4 /* @ECU_Address@SwcOut_ADS_VCU_1.ADS_1_TarGearReq@ */ /end MEASUREMENT
/begin MEASUREMENT SwcOut_ADS_VCU_1.ADS_1_TarGearReqVld "" UBYTE autosar_swc_val_CM_ADS_1_TarGearReqVld_359_dt 0 0 0 255 ECU_ADDRESS 0xfe4cb2d5 /* @ECU_Address@SwcOut_ADS_VCU_1.ADS_1_TarGearReqVld@ */ /end MEASUREMENT
/begin MEASUREMENT SwcOut_Diag_FCM_RES.Diag_FCM_RES "" A_UINT64 autosar_swc_val_CM_Diag_FCM_RES_1986_dt 0 0 0.0 1.844674407370955e+19 ECU_ADDRESS 0xfe4cb2d8 /* @ECU_Address@SwcOut_Diag_FCM_RES.Diag_FCM_RES@ */ /end MEASUREMENT
/begin MEASUREMENT SwcOut_FCM_ActiveSafetyInfo.AEBTargetObjInfo.TargetObjColor "" UBYTE autosar_swc_val_CM_uint8 0 0 0 255 ECU_ADDRESS 0xfe4cb2e9 /* @ECU_Address@SwcOut_FCM_ActiveSafetyInfo.AEBTargetObjInfo.TargetObjColor@ */ /end MEASUREMENT
/begin MEASUREMENT SwcOut_FCM_ActiveSafetyInfo.AEBTargetObjInfo.TargetObjID "" UBYTE autosar_swc_val_CM_uint8 0 0 0 255 ECU_ADDRESS 0xfe4cb2e8 /* @ECU_Address@SwcOut_FCM_ActiveSafetyInfo.AEBTargetObjInfo.TargetObjID@ */ /end MEASUREMENT
/begin MEASUREMENT SwcOut_FCM_ActiveSafetyInfo.AEBTargetObjInfo.TargetObjPosX "" FLOAT32_IEEE autosar_swc_val_CM_single 0 0 -3.4E+38 3.4E+38 ECU_ADDRESS 0xfe4cb2ec /* @ECU_Address@SwcOut_FCM_ActiveSafetyInfo.AEBTargetObjInfo.TargetObjPosX@ */ /end MEASUREMENT
/begin MEASUREMENT SwcOut_FCM_ActiveSafetyInfo.AEBTargetObjInfo.TargetObjPosY "" FLOAT32_IEEE autosar_swc_val_CM_single 0 0 -3.4E+38 3.4E+38 ECU_ADDRESS 0xfe4cb2f0 /* @ECU_Address@SwcOut_FCM_ActiveSafetyInfo.AEBTargetObjInfo.TargetObjPosY@ */ /end MEASUREMENT
/begin MEASUREMENT SwcOut_FCM_ActiveSafetyInfo.AEBTargetObjInfo.TargetObjSpdX "" FLOAT32_IEEE autosar_swc_val_CM_single 0 0 -3.4E+38 3.4E+38 ECU_ADDRESS 0xfe4cb2f4 /* @ECU_Address@SwcOut_FCM_ActiveSafetyInfo.AEBTargetObjInfo.TargetObjSpdX@ */ /end MEASUREMENT
/begin MEASUREMENT SwcOut_FCM_ActiveSafetyInfo.AEBTargetObjInfo.TargetObjType "" UBYTE autosar_swc_val_CM_uint8 0 0 0 255 ECU_ADDRESS 0xfe4cb2ea /* @ECU_Address@SwcOut_FCM_ActiveSafetyInfo.AEBTargetObjInfo.TargetObjType@ */ /end MEASUREMENT
/begin MEASUREMENT SwcOut_FCM_ActiveSafetyInfo.ActiveSafetyFcnInfo.AebAcitveSt "" UBYTE autosar_swc_val_CM_uint8 0 0 0 255 ECU_ADDRESS 0xfe4cb2e4 /* @ECU_Address@SwcOut_FCM_ActiveSafetyInfo.ActiveSafetyFcnInfo.AebAcitveSt@ */ /end MEASUREMENT
/begin MEASUREMENT SwcOut_FCM_ActiveSafetyInfo.ActiveSafetyFcnInfo.AebSts "" UBYTE autosar_swc_val_CM_uint8 0 0 0 255 ECU_ADDRESS 0xfe4cb2e1 /* @ECU_Address@SwcOut_FCM_ActiveSafetyInfo.ActiveSafetyFcnInfo.AebSts@ */ /end MEASUREMENT
/begin MEASUREMENT SwcOut_FCM_ActiveSafetyInfo.ActiveSafetyFcnInfo.FcwAcitveSt "" UBYTE autosar_swc_val_CM_uint8 0 0 0 255 ECU_ADDRESS 0xfe4cb2e3 /* @ECU_Address@SwcOut_FCM_ActiveSafetyInfo.ActiveSafetyFcnInfo.FcwAcitveSt@ */ /end MEASUREMENT
/begin MEASUREMENT SwcOut_FCM_ActiveSafetyInfo.ActiveSafetyFcnInfo.FcwSts "" UBYTE autosar_swc_val_CM_uint8 0 0 0 255 ECU_ADDRESS 0xfe4cb2e0 /* @ECU_Address@SwcOut_FCM_ActiveSafetyInfo.ActiveSafetyFcnInfo.FcwSts@ */ /end MEASUREMENT
/begin MEASUREMENT SwcOut_FCM_ActiveSafetyInfo.ActiveSafetyFcnInfo.FcwWarnDist "" UBYTE autosar_swc_val_CM_uint8 0 0 0 255 ECU_ADDRESS 0xfe4cb2e2 /* @ECU_Address@SwcOut_FCM_ActiveSafetyInfo.ActiveSafetyFcnInfo.FcwWarnDist@ */ /end MEASUREMENT
/begin MEASUREMENT SwcOut_FCM_ActiveSafetyInfo.ActiveSafetyFcnInfo_2.AebAcitveSt "" UBYTE autosar_swc_val_CM_uint8 0 0 0 255 ECU_ADDRESS 0xfe4cb2fc /* @ECU_Address@SwcOut_FCM_ActiveSafetyInfo.ActiveSafetyFcnInfo_2.AebAcitveSt@ */ /end MEASUREMENT
/begin MEASUREMENT SwcOut_FCM_ActiveSafetyInfo.ActiveSafetyFcnInfo_2.AebSts "" UBYTE autosar_swc_val_CM_uint8 0 0 0 255 ECU_ADDRESS 0xfe4cb2f9 /* @ECU_Address@SwcOut_FCM_ActiveSafetyInfo.ActiveSafetyFcnInfo_2.AebSts@ */ /end MEASUREMENT
/begin MEASUREMENT SwcOut_FCM_ActiveSafetyInfo.ActiveSafetyFcnInfo_2.FCWAEBTextInfomation "" UBYTE autosar_swc_val_CM_uint8 0 0 0 255 ECU_ADDRESS 0xfe4cb2fd /* @ECU_Address@SwcOut_FCM_ActiveSafetyInfo.ActiveSafetyFcnInfo_2.FCWAEBTextInfomation@ */ /end MEASUREMENT
/begin MEASUREMENT SwcOut_FCM_ActiveSafetyInfo.ActiveSafetyFcnInfo_2.FcwAcitveSt "" UBYTE autosar_swc_val_CM_uint8 0 0 0 255 ECU_ADDRESS 0xfe4cb2fb /* @ECU_Address@SwcOut_FCM_ActiveSafetyInfo.ActiveSafetyFcnInfo_2.FcwAcitveSt@ */ /end MEASUREMENT
/begin MEASUREMENT SwcOut_FCM_ActiveSafetyInfo.ActiveSafetyFcnInfo_2.FcwSts "" UBYTE autosar_swc_val_CM_uint8 0 0 0 255 ECU_ADDRESS 0xfe4cb2f8 /* @ECU_Address@SwcOut_FCM_ActiveSafetyInfo.ActiveSafetyFcnInfo_2.FcwSts@ */ /end MEASUREMENT
/begin MEASUREMENT SwcOut_FCM_ActiveSafetyInfo.ActiveSafetyFcnInfo_2.FcwWarnDist "" UBYTE autosar_swc_val_CM_uint8 0 0 0 255 ECU_ADDRESS 0xfe4cb2fa /* @ECU_Address@SwcOut_FCM_ActiveSafetyInfo.ActiveSafetyFcnInfo_2.FcwWarnDist@ */ /end MEASUREMENT
/begin MEASUREMENT SwcOut_FCM_DVRSts.CameraInterParm "" FLOAT64_IEEE autosar_swc_val_CM_double 0 0 -1.7E+308 1.7E+308 LAYOUT COLUMN_DIR MATRIX_DIM 12 ECU_ADDRESS 0xfe4cb308 /* @ECU_Address@SwcOut_FCM_DVRSts.CameraInterParm@ */ /end MEASUREMENT
/begin MEASUREMENT SwcOut_FCM_DVRSts.DVRSts "" UBYTE autosar_swc_val_CM_uint8 0 0 0 255 ECU_ADDRESS 0xfe4cb300 /* @ECU_Address@SwcOut_FCM_DVRSts.DVRSts@ */ /end MEASUREMENT
/begin MEASUREMENT SwcOut_FCM_DVRSts.DVRcameraSts "" UBYTE autosar_swc_val_CM_uint8 0 0 0 255 ECU_ADDRESS 0xfe4cb301 /* @ECU_Address@SwcOut_FCM_DVRSts.DVRcameraSts@ */ /end MEASUREMENT
/begin MEASUREMENT SwcOut_FCM_DrivingFuncInfo.ACCInfo.ACCGoNotifier "" UBYTE autosar_swc_val_CM_uint8 0 0 0 255 ECU_ADDRESS 0xfe4ccbe6 /* @ECU_Address@SwcOut_FCM_DrivingFuncInfo.ACCInfo.ACCGoNotifier@ */ /end MEASUREMENT
/begin MEASUREMENT SwcOut_FCM_DrivingFuncInfo.ACCInfo.ACCQuitReason "" UBYTE autosar_swc_val_CM_uint8 0 0 0 255 ECU_ADDRESS 0xfe4ccbe8 /* @ECU_Address@SwcOut_FCM_DrivingFuncInfo.ACCInfo.ACCQuitReason@ */ /end MEASUREMENT
/begin MEASUREMENT SwcOut_FCM_DrivingFuncInfo.ACCInfo.ACCSts "" UBYTE autosar_swc_val_CM_uint8 0 0 0 255 ECU_ADDRESS 0xfe4ccbe0 /* @ECU_Address@SwcOut_FCM_DrivingFuncInfo.ACCInfo.ACCSts@ */ /end MEASUREMENT
/begin MEASUREMENT SwcOut_FCM_DrivingFuncInfo.ACCInfo.ACCTextMessage "" UBYTE autosar_swc_val_CM_uint8 0 0 0 255 ECU_ADDRESS 0xfe4ccbe7 /* @ECU_Address@SwcOut_FCM_DrivingFuncInfo.ACCInfo.ACCTextMessage@ */ /end MEASUREMENT
/begin MEASUREMENT SwcOut_FCM_DrivingFuncInfo.ACCInfo.ACCholdSts "" UBYTE autosar_swc_val_CM_uint8 0 0 0 255 ECU_ADDRESS 0xfe4ccbed /* @ECU_Address@SwcOut_FCM_DrivingFuncInfo.ACCInfo.ACCholdSts@ */ /end MEASUREMENT
/begin MEASUREMENT SwcOut_FCM_DrivingFuncInfo.ACCInfo.AutoResumeNotifier "" UBYTE autosar_swc_val_CM_uint8 0 0 0 255 ECU_ADDRESS 0xfe4ccbe1 /* @ECU_Address@SwcOut_FCM_DrivingFuncInfo.ACCInfo.AutoResumeNotifier@ */ /end MEASUREMENT
/begin MEASUREMENT SwcOut_FCM_DrivingFuncInfo.ACCInfo.CruiseAccelerateSts "" UBYTE autosar_swc_val_CM_uint8 0 0 0 255 ECU_ADDRESS 0xfe4ccbf1 /* @ECU_Address@SwcOut_FCM_DrivingFuncInfo.ACCInfo.CruiseAccelerateSts@ */ /end MEASUREMENT
/begin MEASUREMENT SwcOut_FCM_DrivingFuncInfo.ACCInfo.FDMDist "" UBYTE autosar_swc_val_CM_uint8 0 0 0 255 ECU_ADDRESS 0xfe4ccbf0 /* @ECU_Address@SwcOut_FCM_DrivingFuncInfo.ACCInfo.FDMDist@ */ /end MEASUREMENT
/begin MEASUREMENT SwcOut_FCM_DrivingFuncInfo.ACCInfo.FDMSt "" UBYTE autosar_swc_val_CM_uint8 0 0 0 255 ECU_ADDRESS 0xfe4ccbef /* @ECU_Address@SwcOut_FCM_DrivingFuncInfo.ACCInfo.FDMSt@ */ /end MEASUREMENT
/begin MEASUREMENT SwcOut_FCM_DrivingFuncInfo.ACCInfo.FSRACruiseSpdModFb "" UBYTE autosar_swc_val_CM_uint8 0 0 0 255 ECU_ADDRESS 0xfe4ccbe9 /* @ECU_Address@SwcOut_FCM_DrivingFuncInfo.ACCInfo.FSRACruiseSpdModFb@ */ /end MEASUREMENT
/begin MEASUREMENT SwcOut_FCM_DrivingFuncInfo.ACCInfo.FSRACruiseSpdOffsetModFb "" UBYTE autosar_swc_val_CM_uint8 0 0 0 255 ECU_ADDRESS 0xfe4ccbea /* @ECU_Address@SwcOut_FCM_DrivingFuncInfo.ACCInfo.FSRACruiseSpdOffsetModFb@ */ /end MEASUREMENT
/begin MEASUREMENT SwcOut_FCM_DrivingFuncInfo.ACCInfo.FSRASpdSetMod "" UBYTE autosar_swc_val_CM_uint8 0 0 0 255 ECU_ADDRESS 0xfe4ccbee /* @ECU_Address@SwcOut_FCM_DrivingFuncInfo.ACCInfo.FSRASpdSetMod@ */ /end MEASUREMENT
/begin MEASUREMENT SwcOut_FCM_DrivingFuncInfo.ACCInfo.LongitudinalTakeOverRequest "" UBYTE autosar_swc_val_CM_uint8 0 0 0 255 ECU_ADDRESS 0xfe4ccbe5 /* @ECU_Address@SwcOut_FCM_DrivingFuncInfo.ACCInfo.LongitudinalTakeOverRequest@ */ /end MEASUREMENT
/begin MEASUREMENT SwcOut_FCM_DrivingFuncInfo.ACCInfo.SetACCSetSpdOffset "" SBYTE autosar_swc_val_CM_int8 0 0 -128 127 ECU_ADDRESS 0xfe4ccbeb /* @ECU_Address@SwcOut_FCM_DrivingFuncInfo.ACCInfo.SetACCSetSpdOffset@ */ /end MEASUREMENT
/begin MEASUREMENT SwcOut_FCM_DrivingFuncInfo.ACCInfo.SetACCSetSpdPercOffset "" SBYTE autosar_swc_val_CM_int8 0 0 -128 127 ECU_ADDRESS 0xfe4ccbec /* @ECU_Address@SwcOut_FCM_DrivingFuncInfo.ACCInfo.SetACCSetSpdPercOffset@ */ /end MEASUREMENT
/begin MEASUREMENT SwcOut_FCM_DrivingFuncInfo.ACCInfo.SetSpeed "" UBYTE autosar_swc_val_CM_uint8 0 0 0 255 ECU_ADDRESS 0xfe4ccbe2 /* @ECU_Address@SwcOut_FCM_DrivingFuncInfo.ACCInfo.SetSpeed@ */ /end MEASUREMENT
/begin MEASUREMENT SwcOut_FCM_DrivingFuncInfo.ACCInfo.SetSpeedUnit "" UBYTE autosar_swc_val_CM_uint8 0 0 0 255 ECU_ADDRESS 0xfe4ccbe3 /* @ECU_Address@SwcOut_FCM_DrivingFuncInfo.ACCInfo.SetSpeedUnit@ */ /end MEASUREMENT
/begin MEASUREMENT SwcOut_FCM_DrivingFuncInfo.ACCInfo.TimeGapSet "" UBYTE autosar_swc_val_CM_uint8 0 0 0 255 ECU_ADDRESS 0xfe4ccbe4 /* @ECU_Address@SwcOut_FCM_DrivingFuncInfo.ACCInfo.TimeGapSet@ */ /end MEASUREMENT
/begin MEASUREMENT SwcOut_FCM_DrivingFuncInfo.DAIInfo.DAIReminder "" UBYTE autosar_swc_val_CM_uint8 0 0 0 255 ECU_ADDRESS 0xfe4ccc0a /* @ECU_Address@SwcOut_FCM_DrivingFuncInfo.DAIInfo.DAIReminder@ */ /end MEASUREMENT
/begin MEASUREMENT SwcOut_FCM_DrivingFuncInfo.DAIInfo.DAISts "" UBYTE autosar_swc_val_CM_uint8 0 0 0 255 ECU_ADDRESS 0xfe4ccc09 /* @ECU_Address@SwcOut_FCM_DrivingFuncInfo.DAIInfo.DAISts@ */ /end MEASUREMENT
/begin MEASUREMENT SwcOut_FCM_DrivingFuncInfo.DrivingSoundInfo.DrivingSoundWarn "" UBYTE autosar_swc_val_CM_uint8 0 0 0 255 ECU_ADDRESS 0xfe4ccc20 /* @ECU_Address@SwcOut_FCM_DrivingFuncInfo.DrivingSoundInfo.DrivingSoundWarn@ */ /end MEASUREMENT
/begin MEASUREMENT SwcOut_FCM_DrivingFuncInfo.ESSInfo.AESDirection "" UBYTE autosar_swc_val_CM_uint8 0 0 0 255 ECU_ADDRESS 0xfe4ccc08 /* @ECU_Address@SwcOut_FCM_DrivingFuncInfo.ESSInfo.AESDirection@ */ /end MEASUREMENT
/begin MEASUREMENT SwcOut_FCM_DrivingFuncInfo.ESSInfo.AESSts "" UBYTE autosar_swc_val_CM_uint8 0 0 0 255 ECU_ADDRESS 0xfe4ccc07 /* @ECU_Address@SwcOut_FCM_DrivingFuncInfo.ESSInfo.AESSts@ */ /end MEASUREMENT
/begin MEASUREMENT SwcOut_FCM_DrivingFuncInfo.ESSInfo.ESSDirection "" UBYTE autosar_swc_val_CM_uint8 0 0 0 255 ECU_ADDRESS 0xfe4ccc06 /* @ECU_Address@SwcOut_FCM_DrivingFuncInfo.ESSInfo.ESSDirection@ */ /end MEASUREMENT
/begin MEASUREMENT SwcOut_FCM_DrivingFuncInfo.ESSInfo.ESSSts "" UBYTE autosar_swc_val_CM_uint8 0 0 0 255 ECU_ADDRESS 0xfe4ccc05 /* @ECU_Address@SwcOut_FCM_DrivingFuncInfo.ESSInfo.ESSSts@ */ /end MEASUREMENT
/begin MEASUREMENT SwcOut_FCM_DrivingFuncInfo.HNOPfunctionInfo.NOPDegradeReminder "" UBYTE autosar_swc_val_CM_uint8 0 0 0 255 ECU_ADDRESS 0xfe4ccc23 /* @ECU_Address@SwcOut_FCM_DrivingFuncInfo.HNOPfunctionInfo.NOPDegradeReminder@ */ /end MEASUREMENT
/begin MEASUREMENT SwcOut_FCM_DrivingFuncInfo.HodDmsInfo.DMSWarning "" UBYTE autosar_swc_val_CM_uint8 0 0 0 255 ECU_ADDRESS 0xfe4ccbfa /* @ECU_Address@SwcOut_FCM_DrivingFuncInfo.HodDmsInfo.DMSWarning@ */ /end MEASUREMENT
/begin MEASUREMENT SwcOut_FCM_DrivingFuncInfo.HodDmsInfo.DriverhandsoffWarning "" UBYTE autosar_swc_val_CM_uint8 0 0 0 255 ECU_ADDRESS 0xfe4ccbf9 /* @ECU_Address@SwcOut_FCM_DrivingFuncInfo.HodDmsInfo.DriverhandsoffWarning@ */ /end MEASUREMENT
/begin MEASUREMENT SwcOut_FCM_DrivingFuncInfo.HodDmsInfo.HODWarnSettingStFb "" UBYTE autosar_swc_val_CM_uint8 0 0 0 255 ECU_ADDRESS 0xfe4ccbfc /* @ECU_Address@SwcOut_FCM_DrivingFuncInfo.HodDmsInfo.HODWarnSettingStFb@ */ /end MEASUREMENT
/begin MEASUREMENT SwcOut_FCM_DrivingFuncInfo.HodDmsInfo.HandsOnReq "" UBYTE autosar_swc_val_CM_uint8 0 0 0 255 ECU_ADDRESS 0xfe4ccbfb /* @ECU_Address@SwcOut_FCM_DrivingFuncInfo.HodDmsInfo.HandsOnReq@ */ /end MEASUREMENT
/begin MEASUREMENT SwcOut_FCM_DrivingFuncInfo.ICAInfo.ICAQuitReason "" UBYTE autosar_swc_val_CM_uint8 0 0 0 255 ECU_ADDRESS 0xfe4ccbf4 /* @ECU_Address@SwcOut_FCM_DrivingFuncInfo.ICAInfo.ICAQuitReason@ */ /end MEASUREMENT
/begin MEASUREMENT SwcOut_FCM_DrivingFuncInfo.ICAInfo.ICASenarioReminder "" UBYTE autosar_swc_val_CM_uint8 0 0 0 255 ECU_ADDRESS 0xfe4ccbf5 /* @ECU_Address@SwcOut_FCM_DrivingFuncInfo.ICAInfo.ICASenarioReminder@ */ /end MEASUREMENT
/begin MEASUREMENT SwcOut_FCM_DrivingFuncInfo.ICAInfo.ICASts "" UBYTE autosar_swc_val_CM_uint8 0 0 0 255 ECU_ADDRESS 0xfe4ccbf2 /* @ECU_Address@SwcOut_FCM_DrivingFuncInfo.ICAInfo.ICASts@ */ /end MEASUREMENT
/begin MEASUREMENT SwcOut_FCM_DrivingFuncInfo.ICAInfo.ICATextInfo "" UBYTE autosar_swc_val_CM_uint8 0 0 0 255 ECU_ADDRESS 0xfe4ccbf3 /* @ECU_Address@SwcOut_FCM_DrivingFuncInfo.ICAInfo.ICATextInfo@ */ /end MEASUREMENT
/begin MEASUREMENT SwcOut_FCM_DrivingFuncInfo.IHCInfo.IHCTextInfomation "" UBYTE autosar_swc_val_CM_uint8 0 0 0 255 ECU_ADDRESS 0xfe4ccc22 /* @ECU_Address@SwcOut_FCM_DrivingFuncInfo.IHCInfo.IHCTextInfomation@ */ /end MEASUREMENT
/begin MEASUREMENT SwcOut_FCM_DrivingFuncInfo.IHCInfo.IHC_Status "" UBYTE autosar_swc_val_CM_uint8 0 0 0 255 ECU_ADDRESS 0xfe4ccc21 /* @ECU_Address@SwcOut_FCM_DrivingFuncInfo.IHCInfo.IHC_Status@ */ /end MEASUREMENT
/begin MEASUREMENT SwcOut_FCM_DrivingFuncInfo.ISLIInfo.ISLICruiseSpdAbsOffsetFb "" UBYTE autosar_swc_val_CM_uint8 0 0 0 255 ECU_ADDRESS 0xfe4ccbde /* @ECU_Address@SwcOut_FCM_DrivingFuncInfo.ISLIInfo.ISLICruiseSpdAbsOffsetFb@ */ /end MEASUREMENT
/begin MEASUREMENT SwcOut_FCM_DrivingFuncInfo.ISLIInfo.ISLICruiseSpdRelOffsetFb "" SBYTE autosar_swc_val_CM_int8 0 0 -128 127 ECU_ADDRESS 0xfe4ccbdf /* @ECU_Address@SwcOut_FCM_DrivingFuncInfo.ISLIInfo.ISLICruiseSpdRelOffsetFb@ */ /end MEASUREMENT
/begin MEASUREMENT SwcOut_FCM_DrivingFuncInfo.ISLIInfo.ISLIOverSpeedWarn "" UBYTE autosar_swc_val_CM_uint8 0 0 0 255 ECU_ADDRESS 0xfe4ccbdb /* @ECU_Address@SwcOut_FCM_DrivingFuncInfo.ISLIInfo.ISLIOverSpeedWarn@ */ /end MEASUREMENT
/begin MEASUREMENT SwcOut_FCM_DrivingFuncInfo.ISLIInfo.ISLISpdLimType "" UBYTE autosar_swc_val_CM_uint8 0 0 0 255 ECU_ADDRESS 0xfe4ccbdd /* @ECU_Address@SwcOut_FCM_DrivingFuncInfo.ISLIInfo.ISLISpdLimType@ */ /end MEASUREMENT
/begin MEASUREMENT SwcOut_FCM_DrivingFuncInfo.ISLIInfo.ISLISpeedLimitSign "" UBYTE autosar_swc_val_CM_uint8 0 0 0 255 ECU_ADDRESS 0xfe4ccbd9 /* @ECU_Address@SwcOut_FCM_DrivingFuncInfo.ISLIInfo.ISLISpeedLimitSign@ */ /end MEASUREMENT
/begin MEASUREMENT SwcOut_FCM_DrivingFuncInfo.ISLIInfo.ISLISpeedLimitUnit "" UBYTE autosar_swc_val_CM_uint8 0 0 0 255 ECU_ADDRESS 0xfe4ccbda /* @ECU_Address@SwcOut_FCM_DrivingFuncInfo.ISLIInfo.ISLISpeedLimitUnit@ */ /end MEASUREMENT
/begin MEASUREMENT SwcOut_FCM_DrivingFuncInfo.ISLIInfo.ISLISt "" UBYTE autosar_swc_val_CM_uint8 0 0 0 255 ECU_ADDRESS 0xfe4ccbd8 /* @ECU_Address@SwcOut_FCM_DrivingFuncInfo.ISLIInfo.ISLISt@ */ /end MEASUREMENT
/begin MEASUREMENT SwcOut_FCM_DrivingFuncInfo.ISLIInfo.ISLIWarningModFb "" UBYTE autosar_swc_val_CM_uint8 0 0 0 255 ECU_ADDRESS 0xfe4ccbdc /* @ECU_Address@SwcOut_FCM_DrivingFuncInfo.ISLIInfo.ISLIWarningModFb@ */ /end MEASUREMENT
/begin MEASUREMENT SwcOut_FCM_DrivingFuncInfo.ISLIinfo_2.ISLICruiseSpdAbsOffsetFb "" UBYTE autosar_swc_val_CM_uint8 0 0 0 255 ECU_ADDRESS 0xfe4ccc11 /* @ECU_Address@SwcOut_FCM_DrivingFuncInfo.ISLIinfo_2.ISLICruiseSpdAbsOffsetFb@ */ /end MEASUREMENT
/begin MEASUREMENT SwcOut_FCM_DrivingFuncInfo.ISLIinfo_2.ISLICruiseSpdOffsetAbs "" SBYTE autosar_swc_val_CM_int8 0 0 -128 127 ECU_ADDRESS 0xfe4ccc14 /* @ECU_Address@SwcOut_FCM_DrivingFuncInfo.ISLIinfo_2.ISLICruiseSpdOffsetAbs@ */ /end MEASUREMENT
/begin MEASUREMENT SwcOut_FCM_DrivingFuncInfo.ISLIinfo_2.ISLICruiseSpdRelOffsetFb "" SBYTE autosar_swc_val_CM_int8 0 0 -128 127 ECU_ADDRESS 0xfe4ccc12 /* @ECU_Address@SwcOut_FCM_DrivingFuncInfo.ISLIinfo_2.ISLICruiseSpdRelOffsetFb@ */ /end MEASUREMENT
/begin MEASUREMENT SwcOut_FCM_DrivingFuncInfo.ISLIinfo_2.ISLIOverSpeedWarn "" UBYTE autosar_swc_val_CM_uint8 0 0 0 255 ECU_ADDRESS 0xfe4ccc0e /* @ECU_Address@SwcOut_FCM_DrivingFuncInfo.ISLIinfo_2.ISLIOverSpeedWarn@ */ /end MEASUREMENT
/begin MEASUREMENT SwcOut_FCM_DrivingFuncInfo.ISLIinfo_2.ISLISpdLimType "" UBYTE autosar_swc_val_CM_uint8 0 0 0 255 ECU_ADDRESS 0xfe4ccc10 /* @ECU_Address@SwcOut_FCM_DrivingFuncInfo.ISLIinfo_2.ISLISpdLimType@ */ /end MEASUREMENT
/begin MEASUREMENT SwcOut_FCM_DrivingFuncInfo.ISLIinfo_2.ISLISpdOffsetMod "" UBYTE autosar_swc_val_CM_uint8 0 0 0 255 ECU_ADDRESS 0xfe4ccc13 /* @ECU_Address@SwcOut_FCM_DrivingFuncInfo.ISLIinfo_2.ISLISpdOffsetMod@ */ /end MEASUREMENT
/begin MEASUREMENT SwcOut_FCM_DrivingFuncInfo.ISLIinfo_2.ISLISpeedLimitSign "" UBYTE autosar_swc_val_CM_uint8 0 0 0 255 ECU_ADDRESS 0xfe4ccc0c /* @ECU_Address@SwcOut_FCM_DrivingFuncInfo.ISLIinfo_2.ISLISpeedLimitSign@ */ /end MEASUREMENT
/begin MEASUREMENT SwcOut_FCM_DrivingFuncInfo.ISLIinfo_2.ISLISpeedLimitUnit "" UBYTE autosar_swc_val_CM_uint8 0 0 0 255 ECU_ADDRESS 0xfe4ccc0d /* @ECU_Address@SwcOut_FCM_DrivingFuncInfo.ISLIinfo_2.ISLISpeedLimitUnit@ */ /end MEASUREMENT
/begin MEASUREMENT SwcOut_FCM_DrivingFuncInfo.ISLIinfo_2.ISLISt "" UBYTE autosar_swc_val_CM_uint8 0 0 0 255 ECU_ADDRESS 0xfe4ccc0b /* @ECU_Address@SwcOut_FCM_DrivingFuncInfo.ISLIinfo_2.ISLISt@ */ /end MEASUREMENT
/begin MEASUREMENT SwcOut_FCM_DrivingFuncInfo.ISLIinfo_2.ISLITextInfomation "" UBYTE autosar_swc_val_CM_uint8 0 0 0 255 ECU_ADDRESS 0xfe4ccc15 /* @ECU_Address@SwcOut_FCM_DrivingFuncInfo.ISLIinfo_2.ISLITextInfomation@ */ /end MEASUREMENT
/begin MEASUREMENT SwcOut_FCM_DrivingFuncInfo.ISLIinfo_2.ISLIWarningModFb "" UBYTE autosar_swc_val_CM_uint8 0 0 0 255 ECU_ADDRESS 0xfe4ccc0f /* @ECU_Address@SwcOut_FCM_DrivingFuncInfo.ISLIinfo_2.ISLIWarningModFb@ */ /end MEASUREMENT
/begin MEASUREMENT SwcOut_FCM_DrivingFuncInfo.IntelligentEvasionInfo.iLOAActdirection "" UBYTE autosar_swc_val_CM_uint8 0 0 0 255 ECU_ADDRESS 0xfe4ccbf7 /* @ECU_Address@SwcOut_FCM_DrivingFuncInfo.IntelligentEvasionInfo.iLOAActdirection@ */ /end MEASUREMENT
/begin MEASUREMENT SwcOut_FCM_DrivingFuncInfo.IntelligentEvasionInfo.iLOASts "" UBYTE autosar_swc_val_CM_uint8 0 0 0 255 ECU_ADDRESS 0xfe4ccbf6 /* @ECU_Address@SwcOut_FCM_DrivingFuncInfo.IntelligentEvasionInfo.iLOASts@ */ /end MEASUREMENT
/begin MEASUREMENT SwcOut_FCM_DrivingFuncInfo.IntelligentEvasionInfo.iLOATextInfo "" UBYTE autosar_swc_val_CM_uint8 0 0 0 255 ECU_ADDRESS 0xfe4ccbf8 /* @ECU_Address@SwcOut_FCM_DrivingFuncInfo.IntelligentEvasionInfo.iLOATextInfo@ */ /end MEASUREMENT
/begin MEASUREMENT SwcOut_FCM_DrivingFuncInfo.LSSInfo.ELKLeftActiveSt "" UBYTE autosar_swc_val_CM_uint8 0 0 0 255 ECU_ADDRESS 0xfe4ccc02 /* @ECU_Address@SwcOut_FCM_DrivingFuncInfo.LSSInfo.ELKLeftActiveSt@ */ /end MEASUREMENT
/begin MEASUREMENT SwcOut_FCM_DrivingFuncInfo.LSSInfo.ELKRightActiveSt "" UBYTE autosar_swc_val_CM_uint8 0 0 0 255 ECU_ADDRESS 0xfe4ccc03 /* @ECU_Address@SwcOut_FCM_DrivingFuncInfo.LSSInfo.ELKRightActiveSt@ */ /end MEASUREMENT
/begin MEASUREMENT SwcOut_FCM_DrivingFuncInfo.LSSInfo.ELKSts "" UBYTE autosar_swc_val_CM_uint8 0 0 0 255 ECU_ADDRESS 0xfe4ccbff /* @ECU_Address@SwcOut_FCM_DrivingFuncInfo.LSSInfo.ELKSts@ */ /end MEASUREMENT
/begin MEASUREMENT SwcOut_FCM_DrivingFuncInfo.LSSInfo.LKSLeftTrackingSt "" UBYTE autosar_swc_val_CM_uint8 0 0 0 255 ECU_ADDRESS 0xfe4ccc00 /* @ECU_Address@SwcOut_FCM_DrivingFuncInfo.LSSInfo.LKSLeftTrackingSt@ */ /end MEASUREMENT
/begin MEASUREMENT SwcOut_FCM_DrivingFuncInfo.LSSInfo.LKSMod "" UBYTE autosar_swc_val_CM_uint8 0 0 0 255 ECU_ADDRESS 0xfe4ccbfe /* @ECU_Address@SwcOut_FCM_DrivingFuncInfo.LSSInfo.LKSMod@ */ /end MEASUREMENT
/begin MEASUREMENT SwcOut_FCM_DrivingFuncInfo.LSSInfo.LKSRightTrackingSt "" UBYTE autosar_swc_val_CM_uint8 0 0 0 255 ECU_ADDRESS 0xfe4ccc01 /* @ECU_Address@SwcOut_FCM_DrivingFuncInfo.LSSInfo.LKSRightTrackingSt@ */ /end MEASUREMENT
/begin MEASUREMENT SwcOut_FCM_DrivingFuncInfo.LSSInfo.LKSSts "" UBYTE autosar_swc_val_CM_uint8 0 0 0 255 ECU_ADDRESS 0xfe4ccbfd /* @ECU_Address@SwcOut_FCM_DrivingFuncInfo.LSSInfo.LKSSts@ */ /end MEASUREMENT
/begin MEASUREMENT SwcOut_FCM_DrivingFuncInfo.LSSInfo.LKSwarning "" UBYTE autosar_swc_val_CM_uint8 0 0 0 255 ECU_ADDRESS 0xfe4ccc04 /* @ECU_Address@SwcOut_FCM_DrivingFuncInfo.LSSInfo.LKSwarning@ */ /end MEASUREMENT
/begin MEASUREMENT SwcOut_FCM_DrivingFuncInfo.LSSInfo_2.ELKLeftActiveSt "" UBYTE autosar_swc_val_CM_uint8 0 0 0 255 ECU_ADDRESS 0xfe4ccc1b /* @ECU_Address@SwcOut_FCM_DrivingFuncInfo.LSSInfo_2.ELKLeftActiveSt@ */ /end MEASUREMENT
/begin MEASUREMENT SwcOut_FCM_DrivingFuncInfo.LSSInfo_2.ELKRightActiveSt "" UBYTE autosar_swc_val_CM_uint8 0 0 0 255 ECU_ADDRESS 0xfe4ccc1c /* @ECU_Address@SwcOut_FCM_DrivingFuncInfo.LSSInfo_2.ELKRightActiveSt@ */ /end MEASUREMENT
/begin MEASUREMENT SwcOut_FCM_DrivingFuncInfo.LSSInfo_2.ELKSts "" UBYTE autosar_swc_val_CM_uint8 0 0 0 255 ECU_ADDRESS 0xfe4ccc18 /* @ECU_Address@SwcOut_FCM_DrivingFuncInfo.LSSInfo_2.ELKSts@ */ /end MEASUREMENT
/begin MEASUREMENT SwcOut_FCM_DrivingFuncInfo.LSSInfo_2.LKSLeftTrackingSt "" UBYTE autosar_swc_val_CM_uint8 0 0 0 255 ECU_ADDRESS 0xfe4ccc19 /* @ECU_Address@SwcOut_FCM_DrivingFuncInfo.LSSInfo_2.LKSLeftTrackingSt@ */ /end MEASUREMENT
/begin MEASUREMENT SwcOut_FCM_DrivingFuncInfo.LSSInfo_2.LKSMod "" UBYTE autosar_swc_val_CM_uint8 0 0 0 255 ECU_ADDRESS 0xfe4ccc17 /* @ECU_Address@SwcOut_FCM_DrivingFuncInfo.LSSInfo_2.LKSMod@ */ /end MEASUREMENT
/begin MEASUREMENT SwcOut_FCM_DrivingFuncInfo.LSSInfo_2.LKSRightTrackingSt "" UBYTE autosar_swc_val_CM_uint8 0 0 0 255 ECU_ADDRESS 0xfe4ccc1a /* @ECU_Address@SwcOut_FCM_DrivingFuncInfo.LSSInfo_2.LKSRightTrackingSt@ */ /end MEASUREMENT
/begin MEASUREMENT SwcOut_FCM_DrivingFuncInfo.LSSInfo_2.LKSSts "" UBYTE autosar_swc_val_CM_uint8 0 0 0 255 ECU_ADDRESS 0xfe4ccc16 /* @ECU_Address@SwcOut_FCM_DrivingFuncInfo.LSSInfo_2.LKSSts@ */ /end MEASUREMENT
/begin MEASUREMENT SwcOut_FCM_DrivingFuncInfo.LSSInfo_2.LKSWarnSensitivity "" UBYTE autosar_swc_val_CM_uint8 0 0 0 255 ECU_ADDRESS 0xfe4ccc1e /* @ECU_Address@SwcOut_FCM_DrivingFuncInfo.LSSInfo_2.LKSWarnSensitivity@ */ /end MEASUREMENT
/begin MEASUREMENT SwcOut_FCM_DrivingFuncInfo.LSSInfo_2.LKSwarning "" UBYTE autosar_swc_val_CM_uint8 0 0 0 255 ECU_ADDRESS 0xfe4ccc1d /* @ECU_Address@SwcOut_FCM_DrivingFuncInfo.LSSInfo_2.LKSwarning@ */ /end MEASUREMENT
/begin MEASUREMENT SwcOut_FCM_DrivingFuncInfo.LSSInfo_2.LSSTextInfomation "" UBYTE autosar_swc_val_CM_uint8 0 0 0 255 ECU_ADDRESS 0xfe4ccc1f /* @ECU_Address@SwcOut_FCM_DrivingFuncInfo.LSSInfo_2.LSSTextInfomation@ */ /end MEASUREMENT
/begin MEASUREMENT SwcOut_FCM_DrivingFuncInfo.TrafficSign.TSRSt "" UBYTE autosar_swc_val_CM_uint8 0 0 0 255 ECU_ADDRESS 0xfe4ccbc8 /* @ECU_Address@SwcOut_FCM_DrivingFuncInfo.TrafficSign.TSRSt@ */ /end MEASUREMENT
/begin MEASUREMENT SwcOut_FCM_DrivingFuncInfo.TrafficSign.TrafficSignId "" UBYTE autosar_swc_val_CM_uint8 0 0 0 255 ECU_ADDRESS 0xfe4ccbc9 /* @ECU_Address@SwcOut_FCM_DrivingFuncInfo.TrafficSign.TrafficSignId@ */ /end MEASUREMENT
/begin MEASUREMENT SwcOut_FCM_DrivingFuncInfo.TrafficSign.TrafficSignPosX "" FLOAT32_IEEE autosar_swc_val_CM_single 0 0 -3.4E+38 3.4E+38 ECU_ADDRESS 0xfe4ccbcc /* @ECU_Address@SwcOut_FCM_DrivingFuncInfo.TrafficSign.TrafficSignPosX@ */ /end MEASUREMENT
/begin MEASUREMENT SwcOut_FCM_DrivingFuncInfo.TrafficSign.TrafficSignPosY "" FLOAT32_IEEE autosar_swc_val_CM_single 0 0 -3.4E+38 3.4E+38 ECU_ADDRESS 0xfe4ccbd0 /* @ECU_Address@SwcOut_FCM_DrivingFuncInfo.TrafficSign.TrafficSignPosY@ */ /end MEASUREMENT
/begin MEASUREMENT SwcOut_FCM_DrivingFuncInfo.TrafficSign.TrafficSignPosZ "" FLOAT32_IEEE autosar_swc_val_CM_single 0 0 -3.4E+38 3.4E+38 ECU_ADDRESS 0xfe4ccbd4 /* @ECU_Address@SwcOut_FCM_DrivingFuncInfo.TrafficSign.TrafficSignPosZ@ */ /end MEASUREMENT
/begin MEASUREMENT SwcOut_FCM_DrivingFuncInfo.TrafficSign.TrafficSignType "" UBYTE autosar_swc_val_CM_uint8 0 0 0 255 ECU_ADDRESS 0xfe4ccbca /* @ECU_Address@SwcOut_FCM_DrivingFuncInfo.TrafficSign.TrafficSignType@ */ /end MEASUREMENT
/begin MEASUREMENT SwcOut_FCM_DrivingHmiEnv.DynamicObjectList[0].laneID "" SBYTE autosar_swc_val_CM_int8 0 0 -128 127 ECU_ADDRESS 0xfe4cb390 /* @ECU_Address@SwcOut_FCM_DrivingHmiEnv.DynamicObjectList[0].laneID@ */ /end MEASUREMENT
/begin MEASUREMENT SwcOut_FCM_DrivingHmiEnv.DynamicObjectList[0].lightStatus "" UBYTE autosar_swc_val_CM_uint8 0 0 0 255 ECU_ADDRESS 0xfe4cb36a /* @ECU_Address@SwcOut_FCM_DrivingHmiEnv.DynamicObjectList[0].lightStatus@ */ /end MEASUREMENT
/begin MEASUREMENT SwcOut_FCM_DrivingHmiEnv.DynamicObjectList[0].objectColor "" UBYTE autosar_swc_val_CM_uint8 0 0 0 255 ECU_ADDRESS 0xfe4cb378 /* @ECU_Address@SwcOut_FCM_DrivingHmiEnv.DynamicObjectList[0].objectColor@ */ /end MEASUREMENT
/begin MEASUREMENT SwcOut_FCM_DrivingHmiEnv.DynamicObjectList[0].objectId "" UBYTE autosar_swc_val_CM_uint8 0 0 0 255 ECU_ADDRESS 0xfe4cb368 /* @ECU_Address@SwcOut_FCM_DrivingHmiEnv.DynamicObjectList[0].objectId@ */ /end MEASUREMENT
/begin MEASUREMENT SwcOut_FCM_DrivingHmiEnv.DynamicObjectList[0].objectPoseX "" FLOAT32_IEEE autosar_swc_val_CM_single 0 0 -3.4E+38 3.4E+38 ECU_ADDRESS 0xfe4cb36c /* @ECU_Address@SwcOut_FCM_DrivingHmiEnv.DynamicObjectList[0].objectPoseX@ */ /end MEASUREMENT
/begin MEASUREMENT SwcOut_FCM_DrivingHmiEnv.DynamicObjectList[0].objectPoseY "" FLOAT32_IEEE autosar_swc_val_CM_single 0 0 -3.4E+38 3.4E+38 ECU_ADDRESS 0xfe4cb370 /* @ECU_Address@SwcOut_FCM_DrivingHmiEnv.DynamicObjectList[0].objectPoseY@ */ /end MEASUREMENT
/begin MEASUREMENT SwcOut_FCM_DrivingHmiEnv.DynamicObjectList[0].objectType "" UBYTE autosar_swc_val_CM_uint8 0 0 0 255 ECU_ADDRESS 0xfe4cb369 /* @ECU_Address@SwcOut_FCM_DrivingHmiEnv.DynamicObjectList[0].objectType@ */ /end MEASUREMENT
/begin MEASUREMENT SwcOut_FCM_DrivingHmiEnv.DynamicObjectList[0].objectVelocityX "" FLOAT32_IEEE autosar_swc_val_CM_single 0 0 -3.4E+38 3.4E+38 ECU_ADDRESS 0xfe4cb37c /* @ECU_Address@SwcOut_FCM_DrivingHmiEnv.DynamicObjectList[0].objectVelocityX@ */ /end MEASUREMENT
/begin MEASUREMENT SwcOut_FCM_DrivingHmiEnv.DynamicObjectList[0].objectVelocityY "" FLOAT32_IEEE autosar_swc_val_CM_single 0 0 -3.4E+38 3.4E+38 ECU_ADDRESS 0xfe4cb380 /* @ECU_Address@SwcOut_FCM_DrivingHmiEnv.DynamicObjectList[0].objectVelocityY@ */ /end MEASUREMENT
/begin MEASUREMENT SwcOut_FCM_DrivingHmiEnv.DynamicObjectList[0].objectYaw "" FLOAT32_IEEE autosar_swc_val_CM_single 0 0 -3.4E+38 3.4E+38 ECU_ADDRESS 0xfe4cb374 /* @ECU_Address@SwcOut_FCM_DrivingHmiEnv.DynamicObjectList[0].objectYaw@ */ /end MEASUREMENT
/begin MEASUREMENT SwcOut_FCM_DrivingHmiEnv.DynamicObjectList[0].timestampnSec "" A_UINT64 autosar_swc_val_CM_uint64 0 0 0.0 1.844674407370955e+19 ECU_ADDRESS 0xfe4cb388 /* @ECU_Address@SwcOut_FCM_DrivingHmiEnv.DynamicObjectList[0].timestampnSec@ */ /end MEASUREMENT
/begin MEASUREMENT SwcOut_FCM_DrivingHmiEnv.EgoFusionPose.FusionlocalizationSD "" FLOAT32_IEEE autosar_swc_val_CM_single 0 0 -3.4E+38 3.4E+38 ECU_ADDRESS 0xfe4cb824 /* @ECU_Address@SwcOut_FCM_DrivingHmiEnv.EgoFusionPose.FusionlocalizationSD@ */ /end MEASUREMENT
/begin MEASUREMENT SwcOut_FCM_DrivingHmiEnv.EgoFusionPose.altitude "" FLOAT32_IEEE autosar_swc_val_CM_single 0 0 -3.4E+38 3.4E+38 ECU_ADDRESS 0xfe4cb818 /* @ECU_Address@SwcOut_FCM_DrivingHmiEnv.EgoFusionPose.altitude@ */ /end MEASUREMENT
/begin MEASUREMENT SwcOut_FCM_DrivingHmiEnv.EgoFusionPose.altitudeSD "" FLOAT32_IEEE autosar_swc_val_CM_single 0 0 -3.4E+38 3.4E+38 ECU_ADDRESS 0xfe4cb828 /* @ECU_Address@SwcOut_FCM_DrivingHmiEnv.EgoFusionPose.altitudeSD@ */ /end MEASUREMENT
/begin MEASUREMENT SwcOut_FCM_DrivingHmiEnv.EgoFusionPose.heading "" FLOAT32_IEEE autosar_swc_val_CM_single 0 0 -3.4E+38 3.4E+38 ECU_ADDRESS 0xfe4cb81c /* @ECU_Address@SwcOut_FCM_DrivingHmiEnv.EgoFusionPose.heading@ */ /end MEASUREMENT
/begin MEASUREMENT SwcOut_FCM_DrivingHmiEnv.EgoFusionPose.headingSD "" FLOAT32_IEEE autosar_swc_val_CM_single 0 0 -3.4E+38 3.4E+38 ECU_ADDRESS 0xfe4cb82c /* @ECU_Address@SwcOut_FCM_DrivingHmiEnv.EgoFusionPose.headingSD@ */ /end MEASUREMENT
/begin MEASUREMENT SwcOut_FCM_DrivingHmiEnv.EgoFusionPose.latitude "" FLOAT64_IEEE autosar_swc_val_CM_double 0 0 -1.7E+308 1.7E+308 ECU_ADDRESS 0xfe4cb840 /* @ECU_Address@SwcOut_FCM_DrivingHmiEnv.EgoFusionPose.latitude@ */ /end MEASUREMENT
/begin MEASUREMENT SwcOut_FCM_DrivingHmiEnv.EgoFusionPose.longitude "" FLOAT64_IEEE autosar_swc_val_CM_double 0 0 -1.7E+308 1.7E+308 ECU_ADDRESS 0xfe4cb838 /* @ECU_Address@SwcOut_FCM_DrivingHmiEnv.EgoFusionPose.longitude@ */ /end MEASUREMENT
/begin MEASUREMENT SwcOut_FCM_DrivingHmiEnv.EgoFusionPose.timestampmSec "" FLOAT32_IEEE autosar_swc_val_CM_single 0 0 -3.4E+38 3.4E+38 ECU_ADDRESS 0xfe4cb834 /* @ECU_Address@SwcOut_FCM_DrivingHmiEnv.EgoFusionPose.timestampmSec@ */ /end MEASUREMENT
/begin MEASUREMENT SwcOut_FCM_DrivingHmiEnv.EgoFusionPose.vehicleSpeed "" FLOAT32_IEEE autosar_swc_val_CM_single 0 0 -3.4E+38 3.4E+38 ECU_ADDRESS 0xfe4cb820 /* @ECU_Address@SwcOut_FCM_DrivingHmiEnv.EgoFusionPose.vehicleSpeed@ */ /end MEASUREMENT
/begin MEASUREMENT SwcOut_FCM_DrivingHmiEnv.EgoFusionPose.vehicleSpeedSD "" FLOAT32_IEEE autosar_swc_val_CM_single 0 0 -3.4E+38 3.4E+38 ECU_ADDRESS 0xfe4cb830 /* @ECU_Address@SwcOut_FCM_DrivingHmiEnv.EgoFusionPose.vehicleSpeedSD@ */ /end MEASUREMENT
/begin MEASUREMENT SwcOut_FCM_DrivingHmiEnv.LaneLineList_2[0].laneLineWidth "" FLOAT32_IEEE autosar_swc_val_CM_single 0 0 -3.4E+38 3.4E+38 ECU_ADDRESS 0xfe4cb6ec /* @ECU_Address@SwcOut_FCM_DrivingHmiEnv.LaneLineList_2[0].laneLineWidth@ */ /end MEASUREMENT
/begin MEASUREMENT SwcOut_FCM_DrivingHmiEnv.LaneLineList_2[0].lineColor "" UBYTE autosar_swc_val_CM_uint8 0 0 0 255 ECU_ADDRESS 0xfe4cb6da /* @ECU_Address@SwcOut_FCM_DrivingHmiEnv.LaneLineList_2[0].lineColor@ */ /end MEASUREMENT
/begin MEASUREMENT SwcOut_FCM_DrivingHmiEnv.LaneLineList_2[0].lineEnd_X "" FLOAT32_IEEE autosar_swc_val_CM_single 0 0 -3.4E+38 3.4E+38 ECU_ADDRESS 0xfe4cb6f8 /* @ECU_Address@SwcOut_FCM_DrivingHmiEnv.LaneLineList_2[0].lineEnd_X@ */ /end MEASUREMENT
/begin MEASUREMENT SwcOut_FCM_DrivingHmiEnv.LaneLineList_2[0].lineEnd_Y "" FLOAT32_IEEE autosar_swc_val_CM_single 0 0 -3.4E+38 3.4E+38 ECU_ADDRESS 0xfe4cb6fc /* @ECU_Address@SwcOut_FCM_DrivingHmiEnv.LaneLineList_2[0].lineEnd_Y@ */ /end MEASUREMENT
/begin MEASUREMENT SwcOut_FCM_DrivingHmiEnv.LaneLineList_2[0].lineEquation_C0 "" FLOAT32_IEEE autosar_swc_val_CM_single 0 0 -3.4E+38 3.4E+38 ECU_ADDRESS 0xfe4cb6dc /* @ECU_Address@SwcOut_FCM_DrivingHmiEnv.LaneLineList_2[0].lineEquation_C0@ */ /end MEASUREMENT
/begin MEASUREMENT SwcOut_FCM_DrivingHmiEnv.LaneLineList_2[0].lineEquation_C1 "" FLOAT32_IEEE autosar_swc_val_CM_single 0 0 -3.4E+38 3.4E+38 ECU_ADDRESS 0xfe4cb6e0 /* @ECU_Address@SwcOut_FCM_DrivingHmiEnv.LaneLineList_2[0].lineEquation_C1@ */ /end MEASUREMENT
/begin MEASUREMENT SwcOut_FCM_DrivingHmiEnv.LaneLineList_2[0].lineEquation_C2 "" FLOAT32_IEEE autosar_swc_val_CM_single 0 0 -3.4E+38 3.4E+38 ECU_ADDRESS 0xfe4cb6e4 /* @ECU_Address@SwcOut_FCM_DrivingHmiEnv.LaneLineList_2[0].lineEquation_C2@ */ /end MEASUREMENT
/begin MEASUREMENT SwcOut_FCM_DrivingHmiEnv.LaneLineList_2[0].lineEquation_C3 "" FLOAT32_IEEE autosar_swc_val_CM_single 0 0 -3.4E+38 3.4E+38 ECU_ADDRESS 0xfe4cb6e8 /* @ECU_Address@SwcOut_FCM_DrivingHmiEnv.LaneLineList_2[0].lineEquation_C3@ */ /end MEASUREMENT
/begin MEASUREMENT SwcOut_FCM_DrivingHmiEnv.LaneLineList_2[0].lineId "" UBYTE autosar_swc_val_CM_uint8 0 0 0 255 ECU_ADDRESS 0xfe4cb6d9 /* @ECU_Address@SwcOut_FCM_DrivingHmiEnv.LaneLineList_2[0].lineId@ */ /end MEASUREMENT
/begin MEASUREMENT SwcOut_FCM_DrivingHmiEnv.LaneLineList_2[0].lineIndex "" UBYTE autosar_swc_val_CM_uint8 0 0 0 255 ECU_ADDRESS 0xfe4cb6d8 /* @ECU_Address@SwcOut_FCM_DrivingHmiEnv.LaneLineList_2[0].lineIndex@ */ /end MEASUREMENT
/begin MEASUREMENT SwcOut_FCM_DrivingHmiEnv.LaneLineList_2[0].lineStart_X "" FLOAT32_IEEE autosar_swc_val_CM_single 0 0 -3.4E+38 3.4E+38 ECU_ADDRESS 0xfe4cb6f0 /* @ECU_Address@SwcOut_FCM_DrivingHmiEnv.LaneLineList_2[0].lineStart_X@ */ /end MEASUREMENT
/begin MEASUREMENT SwcOut_FCM_DrivingHmiEnv.LaneLineList_2[0].lineStart_Y "" FLOAT32_IEEE autosar_swc_val_CM_single 0 0 -3.4E+38 3.4E+38 ECU_ADDRESS 0xfe4cb6f4 /* @ECU_Address@SwcOut_FCM_DrivingHmiEnv.LaneLineList_2[0].lineStart_Y@ */ /end MEASUREMENT
/begin MEASUREMENT SwcOut_FCM_DrivingHmiEnv.LaneLineList_2[0].lineType "" UBYTE autosar_swc_val_CM_uint8 0 0 0 255 ECU_ADDRESS 0xfe4cb6db /* @ECU_Address@SwcOut_FCM_DrivingHmiEnv.LaneLineList_2[0].lineType@ */ /end MEASUREMENT
/begin MEASUREMENT SwcOut_FCM_DrivingHmiEnv.StaticObjectList[0].laneID "" SBYTE autosar_swc_val_CM_int8 0 0 -128 127 ECU_ADDRESS 0xfe4cb568 /* @ECU_Address@SwcOut_FCM_DrivingHmiEnv.StaticObjectList[0].laneID@ */ /end MEASUREMENT
/begin MEASUREMENT SwcOut_FCM_DrivingHmiEnv.StaticObjectList[0].objecWidth "" UWORD autosar_swc_val_CM_uint16 0 0 0 65535 ECU_ADDRESS 0xfe4cb55a /* @ECU_Address@SwcOut_FCM_DrivingHmiEnv.StaticObjectList[0].objecWidth@ */ /end MEASUREMENT
/begin MEASUREMENT SwcOut_FCM_DrivingHmiEnv.StaticObjectList[0].objectId "" UBYTE autosar_swc_val_CM_uint8 0 0 0 255 ECU_ADDRESS 0xfe4cb548 /* @ECU_Address@SwcOut_FCM_DrivingHmiEnv.StaticObjectList[0].objectId@ */ /end MEASUREMENT
/begin MEASUREMENT SwcOut_FCM_DrivingHmiEnv.StaticObjectList[0].objectLength "" UWORD autosar_swc_val_CM_uint16 0 0 0 65535 ECU_ADDRESS 0xfe4cb558 /* @ECU_Address@SwcOut_FCM_DrivingHmiEnv.StaticObjectList[0].objectLength@ */ /end MEASUREMENT
/begin MEASUREMENT SwcOut_FCM_DrivingHmiEnv.StaticObjectList[0].objectPoseX "" FLOAT32_IEEE autosar_swc_val_CM_single 0 0 -3.4E+38 3.4E+38 ECU_ADDRESS 0xfe4cb54c /* @ECU_Address@SwcOut_FCM_DrivingHmiEnv.StaticObjectList[0].objectPoseX@ */ /end MEASUREMENT
/begin MEASUREMENT SwcOut_FCM_DrivingHmiEnv.StaticObjectList[0].objectPoseY "" FLOAT32_IEEE autosar_swc_val_CM_single 0 0 -3.4E+38 3.4E+38 ECU_ADDRESS 0xfe4cb550 /* @ECU_Address@SwcOut_FCM_DrivingHmiEnv.StaticObjectList[0].objectPoseY@ */ /end MEASUREMENT
/begin MEASUREMENT SwcOut_FCM_DrivingHmiEnv.StaticObjectList[0].objectType "" UBYTE autosar_swc_val_CM_uint8 0 0 0 255 ECU_ADDRESS 0xfe4cb549 /* @ECU_Address@SwcOut_FCM_DrivingHmiEnv.StaticObjectList[0].objectType@ */ /end MEASUREMENT
/begin MEASUREMENT SwcOut_FCM_DrivingHmiEnv.StaticObjectList[0].objectYaw "" FLOAT32_IEEE autosar_swc_val_CM_single 0 0 -3.4E+38 3.4E+38 ECU_ADDRESS 0xfe4cb554 /* @ECU_Address@SwcOut_FCM_DrivingHmiEnv.StaticObjectList[0].objectYaw@ */ /end MEASUREMENT
/begin MEASUREMENT SwcOut_FCM_DrivingHmiEnv.StaticObjectList[0].timestampnSec "" A_UINT64 autosar_swc_val_CM_uint64 0 0 0.0 1.844674407370955e+19 ECU_ADDRESS 0xfe4cb560 /* @ECU_Address@SwcOut_FCM_DrivingHmiEnv.StaticObjectList[0].timestampnSec@ */ /end MEASUREMENT
/begin MEASUREMENT SwcOut_FCM_RemoteDiag.FCM_FaultNum1 "" UWORD autosar_swc_val_CM_FCM_FaultNum1_1283_dt 0 0 0 65535 ECU_ADDRESS 0xfe4ccc28 /* @ECU_Address@SwcOut_FCM_RemoteDiag.FCM_FaultNum1@ */ /end MEASUREMENT
/begin MEASUREMENT SwcOut_FCM_RemoteDiag.FCM_FaultNum10 "" UWORD autosar_swc_val_CM_FCM_FaultNum10_1283_dt 0 0 0 65535 ECU_ADDRESS 0xfe4ccc3a /* @ECU_Address@SwcOut_FCM_RemoteDiag.FCM_FaultNum10@ */ /end MEASUREMENT
/begin MEASUREMENT SwcOut_FCM_RemoteDiag.FCM_FaultNum11 "" UWORD autosar_swc_val_CM_FCM_FaultNum11_1283_dt 0 0 0 65535 ECU_ADDRESS 0xfe4ccc3c /* @ECU_Address@SwcOut_FCM_RemoteDiag.FCM_FaultNum11@ */ /end MEASUREMENT
/begin MEASUREMENT SwcOut_FCM_RemoteDiag.FCM_FaultNum12 "" UWORD autosar_swc_val_CM_FCM_FaultNum12_1283_dt 0 0 0 65535 ECU_ADDRESS 0xfe4ccc3e /* @ECU_Address@SwcOut_FCM_RemoteDiag.FCM_FaultNum12@ */ /end MEASUREMENT
/begin MEASUREMENT SwcOut_FCM_RemoteDiag.FCM_FaultNum13 "" UWORD autosar_swc_val_CM_FCM_FaultNum13_1283_dt 0 0 0 65535 ECU_ADDRESS 0xfe4ccc40 /* @ECU_Address@SwcOut_FCM_RemoteDiag.FCM_FaultNum13@ */ /end MEASUREMENT
/begin MEASUREMENT SwcOut_FCM_RemoteDiag.FCM_FaultNum14 "" UWORD autosar_swc_val_CM_FCM_FaultNum14_1283_dt 0 0 0 65535 ECU_ADDRESS 0xfe4ccc42 /* @ECU_Address@SwcOut_FCM_RemoteDiag.FCM_FaultNum14@ */ /end MEASUREMENT
/begin MEASUREMENT SwcOut_FCM_RemoteDiag.FCM_FaultNum15 "" UWORD autosar_swc_val_CM_FCM_FaultNum15_1283_dt 0 0 0 65535 ECU_ADDRESS 0xfe4ccc44 /* @ECU_Address@SwcOut_FCM_RemoteDiag.FCM_FaultNum15@ */ /end MEASUREMENT
/begin MEASUREMENT SwcOut_FCM_RemoteDiag.FCM_FaultNum16 "" UWORD autosar_swc_val_CM_FCM_FaultNum16_1283_dt 0 0 0 65535 ECU_ADDRESS 0xfe4ccc46 /* @ECU_Address@SwcOut_FCM_RemoteDiag.FCM_FaultNum16@ */ /end MEASUREMENT
/begin MEASUREMENT SwcOut_FCM_RemoteDiag.FCM_FaultNum17 "" UWORD autosar_swc_val_CM_FCM_FaultNum17_1283_dt 0 0 0 65535 ECU_ADDRESS 0xfe4ccc48 /* @ECU_Address@SwcOut_FCM_RemoteDiag.FCM_FaultNum17@ */ /end MEASUREMENT
/begin MEASUREMENT SwcOut_FCM_RemoteDiag.FCM_FaultNum18 "" UWORD autosar_swc_val_CM_FCM_FaultNum18_1283_dt 0 0 0 65535 ECU_ADDRESS 0xfe4ccc4a /* @ECU_Address@SwcOut_FCM_RemoteDiag.FCM_FaultNum18@ */ /end MEASUREMENT
/begin MEASUREMENT SwcOut_FCM_RemoteDiag.FCM_FaultNum19 "" UWORD autosar_swc_val_CM_FCM_FaultNum19_1283_dt 0 0 0 65535 ECU_ADDRESS 0xfe4ccc4c /* @ECU_Address@SwcOut_FCM_RemoteDiag.FCM_FaultNum19@ */ /end MEASUREMENT
/begin MEASUREMENT SwcOut_FCM_RemoteDiag.FCM_FaultNum2 "" UWORD autosar_swc_val_CM_FCM_FaultNum2_1283_dt 0 0 0 65535 ECU_ADDRESS 0xfe4ccc2a /* @ECU_Address@SwcOut_FCM_RemoteDiag.FCM_FaultNum2@ */ /end MEASUREMENT
/begin MEASUREMENT SwcOut_FCM_RemoteDiag.FCM_FaultNum20 "" UWORD autosar_swc_val_CM_FCM_FaultNum20_1283_dt 0 0 0 65535 ECU_ADDRESS 0xfe4ccc4e /* @ECU_Address@SwcOut_FCM_RemoteDiag.FCM_FaultNum20@ */ /end MEASUREMENT
/begin MEASUREMENT SwcOut_FCM_RemoteDiag.FCM_FaultNum3 "" UWORD autosar_swc_val_CM_FCM_FaultNum3_1283_dt 0 0 0 65535 ECU_ADDRESS 0xfe4ccc2c /* @ECU_Address@SwcOut_FCM_RemoteDiag.FCM_FaultNum3@ */ /end MEASUREMENT
/begin MEASUREMENT SwcOut_FCM_RemoteDiag.FCM_FaultNum4 "" UWORD autosar_swc_val_CM_FCM_FaultNum4_1283_dt 0 0 0 65535 ECU_ADDRESS 0xfe4ccc2e /* @ECU_Address@SwcOut_FCM_RemoteDiag.FCM_FaultNum4@ */ /end MEASUREMENT
/begin MEASUREMENT SwcOut_FCM_RemoteDiag.FCM_FaultNum5 "" UWORD autosar_swc_val_CM_FCM_FaultNum5_1283_dt 0 0 0 65535 ECU_ADDRESS 0xfe4ccc30 /* @ECU_Address@SwcOut_FCM_RemoteDiag.FCM_FaultNum5@ */ /end MEASUREMENT
/begin MEASUREMENT SwcOut_FCM_RemoteDiag.FCM_FaultNum6 "" UWORD autosar_swc_val_CM_FCM_FaultNum6_1283_dt 0 0 0 65535 ECU_ADDRESS 0xfe4ccc32 /* @ECU_Address@SwcOut_FCM_RemoteDiag.FCM_FaultNum6@ */ /end MEASUREMENT
/begin MEASUREMENT SwcOut_FCM_RemoteDiag.FCM_FaultNum7 "" UWORD autosar_swc_val_CM_FCM_FaultNum7_1283_dt 0 0 0 65535 ECU_ADDRESS 0xfe4ccc34 /* @ECU_Address@SwcOut_FCM_RemoteDiag.FCM_FaultNum7@ */ /end MEASUREMENT
/begin MEASUREMENT SwcOut_FCM_RemoteDiag.FCM_FaultNum8 "" UWORD autosar_swc_val_CM_FCM_FaultNum8_1283_dt 0 0 0 65535 ECU_ADDRESS 0xfe4ccc36 /* @ECU_Address@SwcOut_FCM_RemoteDiag.FCM_FaultNum8@ */ /end MEASUREMENT
/begin MEASUREMENT SwcOut_FCM_RemoteDiag.FCM_FaultNum9 "" UWORD autosar_swc_val_CM_FCM_FaultNum9_1283_dt 0 0 0 65535 ECU_ADDRESS 0xfe4ccc38 /* @ECU_Address@SwcOut_FCM_RemoteDiag.FCM_FaultNum9@ */ /end MEASUREMENT
/begin MEASUREMENT SwcOut_FCM_RemoteDiag.FCM_FrameIndex "" UBYTE autosar_swc_val_CM_FCM_FrameIndex_1283_dt 0 0 0 255 ECU_ADDRESS 0xfe4ccc25 /* @ECU_Address@SwcOut_FCM_RemoteDiag.FCM_FrameIndex@ */ /end MEASUREMENT
/begin MEASUREMENT SwcOut_FCM_RemoteDiag.FCM_SupplierNum "" UBYTE autosar_swc_val_CM_FCM_SupplierNum_1283_dt 0 0 0 255 ECU_ADDRESS 0xfe4ccc26 /* @ECU_Address@SwcOut_FCM_RemoteDiag.FCM_SupplierNum@ */ /end MEASUREMENT
/begin MEASUREMENT SwcOut_FCM_RemoteDiag.FCM_TotalFaultNum "" UBYTE autosar_swc_val_CM_FCM_TotalFaultNum_1283_dt 0 0 0 255 ECU_ADDRESS 0xfe4ccc24 /* @ECU_Address@SwcOut_FCM_RemoteDiag.FCM_TotalFaultNum@ */ /end MEASUREMENT
/begin MEASUREMENT SwcOut_FCM_SensorInfo.ADASSysSts "" UBYTE autosar_swc_val_CM_uint8 0 0 0 255 ECU_ADDRESS 0xfe4cceab /* @ECU_Address@SwcOut_FCM_SensorInfo.ADASSysSts@ */ /end MEASUREMENT
/begin MEASUREMENT SwcOut_FCM_SensorInfo.FLCameraCalSts "" UBYTE autosar_swc_val_CM_uint8 0 0 0 255 ECU_ADDRESS 0xfe4ccead /* @ECU_Address@SwcOut_FCM_SensorInfo.FLCameraCalSts@ */ /end MEASUREMENT
/begin MEASUREMENT SwcOut_FCM_SensorInfo.FLCameraSysSts "" UBYTE autosar_swc_val_CM_uint8 0 0 0 255 ECU_ADDRESS 0xfe4cceac /* @ECU_Address@SwcOut_FCM_SensorInfo.FLCameraSysSts@ */ /end MEASUREMENT
/begin MEASUREMENT SwcOut_FCM_SensorInfo.FLLidarCalSts "" UBYTE autosar_swc_val_CM_uint8 0 0 0 255 ECU_ADDRESS 0xfe4ccebd /* @ECU_Address@SwcOut_FCM_SensorInfo.FLLidarCalSts@ */ /end MEASUREMENT
/begin MEASUREMENT SwcOut_FCM_SensorInfo.FLLidarSysSts "" UBYTE autosar_swc_val_CM_uint8 0 0 0 255 ECU_ADDRESS 0xfe4ccebc /* @ECU_Address@SwcOut_FCM_SensorInfo.FLLidarSysSts@ */ /end MEASUREMENT
/begin MEASUREMENT SwcOut_FCM_SensorInfo.FRCameraCalSts "" UBYTE autosar_swc_val_CM_uint8 0 0 0 255 ECU_ADDRESS 0xfe4cceaf /* @ECU_Address@SwcOut_FCM_SensorInfo.FRCameraCalSts@ */ /end MEASUREMENT
/begin MEASUREMENT SwcOut_FCM_SensorInfo.FRCameraSysSts "" UBYTE autosar_swc_val_CM_uint8 0 0 0 255 ECU_ADDRESS 0xfe4cceae /* @ECU_Address@SwcOut_FCM_SensorInfo.FRCameraSysSts@ */ /end MEASUREMENT
/begin MEASUREMENT SwcOut_FCM_SensorInfo.FRLidarCalSts "" UBYTE autosar_swc_val_CM_uint8 0 0 0 255 ECU_ADDRESS 0xfe4ccebf /* @ECU_Address@SwcOut_FCM_SensorInfo.FRLidarCalSts@ */ /end MEASUREMENT
/begin MEASUREMENT SwcOut_FCM_SensorInfo.FRLidarSysSts "" UBYTE autosar_swc_val_CM_uint8 0 0 0 255 ECU_ADDRESS 0xfe4ccebe /* @ECU_Address@SwcOut_FCM_SensorInfo.FRLidarSysSts@ */ /end MEASUREMENT
/begin MEASUREMENT SwcOut_FCM_SensorInfo.FrontFarCameraCalSts "" UBYTE autosar_swc_val_CM_uint8 0 0 0 255 ECU_ADDRESS 0xfe4cceb7 /* @ECU_Address@SwcOut_FCM_SensorInfo.FrontFarCameraCalSts@ */ /end MEASUREMENT
/begin MEASUREMENT SwcOut_FCM_SensorInfo.FrontFarCameraSysSts "" UBYTE autosar_swc_val_CM_uint8 0 0 0 255 ECU_ADDRESS 0xfe4cceb6 /* @ECU_Address@SwcOut_FCM_SensorInfo.FrontFarCameraSysSts@ */ /end MEASUREMENT
/begin MEASUREMENT SwcOut_FCM_SensorInfo.FrontNearCameraCalSts "" UBYTE autosar_swc_val_CM_uint8 0 0 0 255 ECU_ADDRESS 0xfe4cceb9 /* @ECU_Address@SwcOut_FCM_SensorInfo.FrontNearCameraCalSts@ */ /end MEASUREMENT
/begin MEASUREMENT SwcOut_FCM_SensorInfo.FrontNearCameraSysSts "" UBYTE autosar_swc_val_CM_uint8 0 0 0 255 ECU_ADDRESS 0xfe4cceb8 /* @ECU_Address@SwcOut_FCM_SensorInfo.FrontNearCameraSysSts@ */ /end MEASUREMENT
/begin MEASUREMENT SwcOut_FCM_SensorInfo.MainLidarCalSts "" UBYTE autosar_swc_val_CM_uint8 0 0 0 255 ECU_ADDRESS 0xfe4ccebb /* @ECU_Address@SwcOut_FCM_SensorInfo.MainLidarCalSts@ */ /end MEASUREMENT
/begin MEASUREMENT SwcOut_FCM_SensorInfo.MainLidarSysSts "" UBYTE autosar_swc_val_CM_uint8 0 0 0 255 ECU_ADDRESS 0xfe4cceba /* @ECU_Address@SwcOut_FCM_SensorInfo.MainLidarSysSts@ */ /end MEASUREMENT
/begin MEASUREMENT SwcOut_FCM_SensorInfo.RLCameraCalSts "" UBYTE autosar_swc_val_CM_uint8 0 0 0 255 ECU_ADDRESS 0xfe4cceb1 /* @ECU_Address@SwcOut_FCM_SensorInfo.RLCameraCalSts@ */ /end MEASUREMENT
/begin MEASUREMENT SwcOut_FCM_SensorInfo.RLCameraSysSts "" UBYTE autosar_swc_val_CM_uint8 0 0 0 255 ECU_ADDRESS 0xfe4cceb0 /* @ECU_Address@SwcOut_FCM_SensorInfo.RLCameraSysSts@ */ /end MEASUREMENT
/begin MEASUREMENT SwcOut_FCM_SensorInfo.RRCameraCalSts "" UBYTE autosar_swc_val_CM_uint8 0 0 0 255 ECU_ADDRESS 0xfe4cceb3 /* @ECU_Address@SwcOut_FCM_SensorInfo.RRCameraCalSts@ */ /end MEASUREMENT
/begin MEASUREMENT SwcOut_FCM_SensorInfo.RRCameraSysSts "" UBYTE autosar_swc_val_CM_uint8 0 0 0 255 ECU_ADDRESS 0xfe4cceb2 /* @ECU_Address@SwcOut_FCM_SensorInfo.RRCameraSysSts@ */ /end MEASUREMENT
/begin MEASUREMENT SwcOut_FCM_SensorInfo.RearCameraCalSts "" UBYTE autosar_swc_val_CM_uint8 0 0 0 255 ECU_ADDRESS 0xfe4cceb5 /* @ECU_Address@SwcOut_FCM_SensorInfo.RearCameraCalSts@ */ /end MEASUREMENT
/begin MEASUREMENT SwcOut_FCM_SensorInfo.RearCameraSysSts "" UBYTE autosar_swc_val_CM_uint8 0 0 0 255 ECU_ADDRESS 0xfe4cceb4 /* @ECU_Address@SwcOut_FCM_SensorInfo.RearCameraSysSts@ */ /end MEASUREMENT
/begin MEASUREMENT SwcOut_FCM_SensorInfo.SVSFrontCameraCalSts "" UBYTE autosar_swc_val_CM_uint8 0 0 0 255 ECU_ADDRESS 0xfe4ccec4 /* @ECU_Address@SwcOut_FCM_SensorInfo.SVSFrontCameraCalSts@ */ /end MEASUREMENT
/begin MEASUREMENT SwcOut_FCM_SensorInfo.SVSFrontCameraSysSts "" UBYTE autosar_swc_val_CM_uint8 0 0 0 255 ECU_ADDRESS 0xfe4ccec0 /* @ECU_Address@SwcOut_FCM_SensorInfo.SVSFrontCameraSysSts@ */ /end MEASUREMENT
/begin MEASUREMENT SwcOut_FCM_SensorInfo.SVSLeftCameraCalSts "" UBYTE autosar_swc_val_CM_uint8 0 0 0 255 ECU_ADDRESS 0xfe4ccec5 /* @ECU_Address@SwcOut_FCM_SensorInfo.SVSLeftCameraCalSts@ */ /end MEASUREMENT
/begin MEASUREMENT SwcOut_FCM_SensorInfo.SVSLeftCameraSysSts "" UBYTE autosar_swc_val_CM_uint8 0 0 0 255 ECU_ADDRESS 0xfe4ccec1 /* @ECU_Address@SwcOut_FCM_SensorInfo.SVSLeftCameraSysSts@ */ /end MEASUREMENT
/begin MEASUREMENT SwcOut_FCM_SensorInfo.SVSRearCameraCalSts "" UBYTE autosar_swc_val_CM_uint8 0 0 0 255 ECU_ADDRESS 0xfe4ccec7 /* @ECU_Address@SwcOut_FCM_SensorInfo.SVSRearCameraCalSts@ */ /end MEASUREMENT
/begin MEASUREMENT SwcOut_FCM_SensorInfo.SVSRearCameraSysSts "" UBYTE autosar_swc_val_CM_uint8 0 0 0 255 ECU_ADDRESS 0xfe4ccec3 /* @ECU_Address@SwcOut_FCM_SensorInfo.SVSRearCameraSysSts@ */ /end MEASUREMENT
/begin MEASUREMENT SwcOut_FCM_SensorInfo.SVSRightCameraCalSts "" UBYTE autosar_swc_val_CM_uint8 0 0 0 255 ECU_ADDRESS 0xfe4ccec6 /* @ECU_Address@SwcOut_FCM_SensorInfo.SVSRightCameraCalSts@ */ /end MEASUREMENT
/begin MEASUREMENT SwcOut_FCM_SensorInfo.SVSRightCameraSysSts "" UBYTE autosar_swc_val_CM_uint8 0 0 0 255 ECU_ADDRESS 0xfe4ccec2 /* @ECU_Address@SwcOut_FCM_SensorInfo.SVSRightCameraSysSts@ */ /end MEASUREMENT
/begin MEASUREMENT SwcOut_FCM_UUID.VehUUIDCode "" UBYTE autosar_swc_val_CM_uint8 0 0 0 255 LAYOUT COLUMN_DIR MATRIX_DIM 128 ECU_ADDRESS 0xfe4cb848 /* @ECU_Address@SwcOut_FCM_UUID.VehUUIDCode@ */ /end MEASUREMENT
/begin MEASUREMENT SwcOut_NMm_FCM.FCM_Awake_Diag "" UBYTE autosar_swc_val_CM_FCM_Awake_Diag_1565_dt 0 0 0 255 ECU_ADDRESS 0xfe4cb8d1 /* @ECU_Address@SwcOut_NMm_FCM.FCM_Awake_Diag@ */ /end MEASUREMENT
/begin MEASUREMENT SwcOut_NMm_FCM.FCM_Awake_FLCR "" UBYTE autosar_swc_val_CM_FCM_Awake_FLCR_1565_dt 0 0 0 255 ECU_ADDRESS 0xfe4cb8d3 /* @ECU_Address@SwcOut_NMm_FCM.FCM_Awake_FLCR@ */ /end MEASUREMENT
/begin MEASUREMENT SwcOut_NMm_FCM.FCM_Awake_FRCR "" UBYTE autosar_swc_val_CM_FCM_Awake_FRCR_1565_dt 0 0 0 255 ECU_ADDRESS 0xfe4cb8d4 /* @ECU_Address@SwcOut_NMm_FCM.FCM_Awake_FRCR@ */ /end MEASUREMENT
/begin MEASUREMENT SwcOut_NMm_FCM.FCM_Awake_KL15 "" UBYTE autosar_swc_val_CM_FCM_Awake_KL15_1565_dt 0 0 0 255 ECU_ADDRESS 0xfe4cb8d7 /* @ECU_Address@SwcOut_NMm_FCM.FCM_Awake_KL15@ */ /end MEASUREMENT
/begin MEASUREMENT SwcOut_NMm_FCM.FCM_Awake_NM "" UBYTE autosar_swc_val_CM_FCM_Awake_NM_1565_dt 0 0 0 255 ECU_ADDRESS 0xfe4cb8d0 /* @ECU_Address@SwcOut_NMm_FCM.FCM_Awake_NM@ */ /end MEASUREMENT
/begin MEASUREMENT SwcOut_NMm_FCM.FCM_Awake_Poweron "" UBYTE autosar_swc_val_CM_FCM_Awake_Poweron_1565_dt 0 0 0 255 ECU_ADDRESS 0xfe4cb8cf /* @ECU_Address@SwcOut_NMm_FCM.FCM_Awake_Poweron@ */ /end MEASUREMENT
/begin MEASUREMENT SwcOut_NMm_FCM.FCM_Awake_RLCR "" UBYTE autosar_swc_val_CM_FCM_Awake_RLCR_1565_dt 0 0 0 255 ECU_ADDRESS 0xfe4cb8d5 /* @ECU_Address@SwcOut_NMm_FCM.FCM_Awake_RLCR@ */ /end MEASUREMENT
/begin MEASUREMENT SwcOut_NMm_FCM.FCM_Awake_RRCR "" UBYTE autosar_swc_val_CM_FCM_Awake_RRCR_1565_dt 0 0 0 255 ECU_ADDRESS 0xfe4cb8d6 /* @ECU_Address@SwcOut_NMm_FCM.FCM_Awake_RRCR@ */ /end MEASUREMENT
/begin MEASUREMENT SwcOut_NMm_FCM.FCM_Awake_Upload "" UBYTE autosar_swc_val_CM_FCM_Awake_Upload_1565_dt 0 0 0 255 ECU_ADDRESS 0xfe4cb8d2 /* @ECU_Address@SwcOut_NMm_FCM.FCM_Awake_Upload@ */ /end MEASUREMENT
/begin MEASUREMENT SwcOut_NMm_FCM.FCM_Wakeup_Diag "" UBYTE autosar_swc_val_CM_FCM_Wakeup_Diag_1565_dt 0 0 0 255 ECU_ADDRESS 0xfe4cb8cd /* @ECU_Address@SwcOut_NMm_FCM.FCM_Wakeup_Diag@ */ /end MEASUREMENT
/begin MEASUREMENT SwcOut_NMm_FCM.FCM_Wakeup_KL15 "" UBYTE autosar_swc_val_CM_FCM_Wakeup_KL15_1565_dt 0 0 0 255 ECU_ADDRESS 0xfe4cb8ce /* @ECU_Address@SwcOut_NMm_FCM.FCM_Wakeup_KL15@ */ /end MEASUREMENT
/begin MEASUREMENT SwcOut_NMm_FCM.FCM_Wakeup_NM "" UBYTE autosar_swc_val_CM_FCM_Wakeup_NM_1565_dt 0 0 0 255 ECU_ADDRESS 0xfe4cb8cc /* @ECU_Address@SwcOut_NMm_FCM.FCM_Wakeup_NM@ */ /end MEASUREMENT
/begin MEASUREMENT SwcOut_NMm_FCM.FCM_Wakeup_Poweron "" UBYTE autosar_swc_val_CM_FCM_Wakeup_Poweron_1565_dt 0 0 0 255 ECU_ADDRESS 0xfe4cb8cb /* @ECU_Address@SwcOut_NMm_FCM.FCM_Wakeup_Poweron@ */ /end MEASUREMENT
/begin MEASUREMENT SwcOut_NMm_FCM.NMm_FCM_Reserved1 "" UBYTE autosar_swc_val_CM_NMm_FCM_Reserved1_1565_dt 0 0 0 255 ECU_ADDRESS 0xfe4cb8ca /* @ECU_Address@SwcOut_NMm_FCM.NMm_FCM_Reserved1@ */ /end MEASUREMENT
/begin MEASUREMENT SwcOut_NMm_FCM.RMR_FCM "" UBYTE autosar_swc_val_CM_RMR_FCM_1565_dt 0 0 0 255 ECU_ADDRESS 0xfe4cb8c9 /* @ECU_Address@SwcOut_NMm_FCM.RMR_FCM@ */ /end MEASUREMENT
/begin MEASUREMENT SwcOut_NMm_FCM.srcNodeID_FCM "" UBYTE autosar_swc_val_CM_srcNodeID_FCM_1565_dt 0 0 0 255 ECU_ADDRESS 0xfe4cb8c8 /* @ECU_Address@SwcOut_NMm_FCM.srcNodeID_FCM@ */ /end MEASUREMENT
/begin MEASUREMENT SwcOut_VAL_ARBN_Feedback.AEB_Status "" UBYTE autosar_swc_val_CM_uint8 0 0 0 255 ECU_ADDRESS 0xfe4ccd68 /* @ECU_Address@SwcOut_VAL_ARBN_Feedback.AEB_Status@ */ /end MEASUREMENT
/begin MEASUREMENT SwcOut_VAL_ARBN_Feedback.FCTB_Status "" UBYTE autosar_swc_val_CM_uint8 0 0 0 255 ECU_ADDRESS 0xfe4ccd6c /* @ECU_Address@SwcOut_VAL_ARBN_Feedback.FCTB_Status@ */ /end MEASUREMENT
/begin MEASUREMENT SwcOut_VAL_ARBN_Feedback.LAEB_Status "" UBYTE autosar_swc_val_CM_uint8 0 0 0 255 ECU_ADDRESS 0xfe4ccd6b /* @ECU_Address@SwcOut_VAL_ARBN_Feedback.LAEB_Status@ */ /end MEASUREMENT
/begin MEASUREMENT SwcOut_VAL_ARBN_Feedback.MEB_Status "" UBYTE autosar_swc_val_CM_uint8 0 0 0 255 ECU_ADDRESS 0xfe4ccd6a /* @ECU_Address@SwcOut_VAL_ARBN_Feedback.MEB_Status@ */ /end MEASUREMENT
/begin MEASUREMENT SwcOut_VAL_ARBN_Feedback.RAEB_Status "" UBYTE autosar_swc_val_CM_uint8 0 0 0 255 ECU_ADDRESS 0xfe4ccd69 /* @ECU_Address@SwcOut_VAL_ARBN_Feedback.RAEB_Status@ */ /end MEASUREMENT
/begin MEASUREMENT SwcOut_VAL_ARBN_Feedback.RCTB_Status "" UBYTE autosar_swc_val_CM_uint8 0 0 0 255 ECU_ADDRESS 0xfe4ccd6d /* @ECU_Address@SwcOut_VAL_ARBN_Feedback.RCTB_Status@ */ /end MEASUREMENT
/begin MEASUREMENT SwcOut_VAL_CONFIG.AccelerateType "" UBYTE autosar_swc_val_CM_uint8 0 0 0 255 ECU_ADDRESS 0xfe4cb8da /* @ECU_Address@SwcOut_VAL_CONFIG.AccelerateType@ */ /end MEASUREMENT
/begin MEASUREMENT SwcOut_VAL_CONFIG.LKACtrlType "" UBYTE autosar_swc_val_CM_uint8 0 0 0 255 ECU_ADDRESS 0xfe4cb8d8 /* @ECU_Address@SwcOut_VAL_CONFIG.LKACtrlType@ */ /end MEASUREMENT
/begin MEASUREMENT SwcOut_VAL_CONFIG.PowerType "" UBYTE autosar_swc_val_CM_uint8 0 0 0 255 ECU_ADDRESS 0xfe4cb8d9 /* @ECU_Address@SwcOut_VAL_CONFIG.PowerType@ */ /end MEASUREMENT
/begin MEASUREMENT SwcOut_VAL_CONFIG.TimeStampMs "" A_UINT64 autosar_swc_val_CM_uint64 0 0 0.0 1.844674407370955e+19 ECU_ADDRESS 0xfe4cb8e0 /* @ECU_Address@SwcOut_VAL_CONFIG.TimeStampMs@ */ /end MEASUREMENT
/begin MEASUREMENT SwcOut_VAL_DRIVER_DRIVE.AccActPulse "" UBYTE autosar_swc_val_CM_boolean 0 0 0 1 ECU_ADDRESS 0xfe4cb8e9 /* @ECU_Address@SwcOut_VAL_DRIVER_DRIVE.AccActPulse@ */ /end MEASUREMENT
/begin MEASUREMENT SwcOut_VAL_DRIVER_DRIVE.AccOnOffPulse "" UBYTE autosar_swc_val_CM_boolean 0 0 0 1 ECU_ADDRESS 0xfe4cb8eb /* @ECU_Address@SwcOut_VAL_DRIVER_DRIVE.AccOnOffPulse@ */ /end MEASUREMENT
/begin MEASUREMENT SwcOut_VAL_DRIVER_DRIVE.AccPedalOverride "" UBYTE autosar_swc_val_CM_boolean 0 0 0 1 ECU_ADDRESS 0xfe4cb8e8 /* @ECU_Address@SwcOut_VAL_DRIVER_DRIVE.AccPedalOverride@ */ /end MEASUREMENT
/begin MEASUREMENT SwcOut_VAL_DRIVER_DRIVE.AccPedalTouchPosition "" FLOAT32_IEEE autosar_swc_val_CM_single 0 0 -3.4E+38 3.4E+38 ECU_ADDRESS 0xfe4cb90c /* @ECU_Address@SwcOut_VAL_DRIVER_DRIVE.AccPedalTouchPosition@ */ /end MEASUREMENT
/begin MEASUREMENT SwcOut_VAL_DRIVER_DRIVE.AutoLightSW "" UBYTE autosar_swc_val_CM_uint8 0 0 0 255 ECU_ADDRESS 0xfe4cb8fb /* @ECU_Address@SwcOut_VAL_DRIVER_DRIVE.AutoLightSW@ */ /end MEASUREMENT
/begin MEASUREMENT SwcOut_VAL_DRIVER_DRIVE.BrkPedalStroke "" FLOAT32_IEEE autosar_swc_val_CM_single 0 0 -3.4E+38 3.4E+38 ECU_ADDRESS 0xfe4cb908 /* @ECU_Address@SwcOut_VAL_DRIVER_DRIVE.BrkPedalStroke@ */ /end MEASUREMENT
/begin MEASUREMENT SwcOut_VAL_DRIVER_DRIVE.CancelPulse "" UBYTE autosar_swc_val_CM_boolean 0 0 0 1 ECU_ADDRESS 0xfe4cb8ee /* @ECU_Address@SwcOut_VAL_DRIVER_DRIVE.CancelPulse@ */ /end MEASUREMENT
/begin MEASUREMENT SwcOut_VAL_DRIVER_DRIVE.DecSetSpdPulse "" UBYTE autosar_swc_val_CM_boolean 0 0 0 1 ECU_ADDRESS 0xfe4cb8f0 /* @ECU_Address@SwcOut_VAL_DRIVER_DRIVE.DecSetSpdPulse@ */ /end MEASUREMENT
/begin MEASUREMENT SwcOut_VAL_DRIVER_DRIVE.DecSetSpdStep "" UBYTE autosar_swc_val_CM_uint8 0 0 0 255 ECU_ADDRESS 0xfe4cb8fd /* @ECU_Address@SwcOut_VAL_DRIVER_DRIVE.DecSetSpdStep@ */ /end MEASUREMENT
/begin MEASUREMENT SwcOut_VAL_DRIVER_DRIVE.DecTimeGapPulse "" UBYTE autosar_swc_val_CM_boolean 0 0 0 1 ECU_ADDRESS 0xfe4cb8f2 /* @ECU_Address@SwcOut_VAL_DRIVER_DRIVE.DecTimeGapPulse@ */ /end MEASUREMENT
/begin MEASUREMENT SwcOut_VAL_DRIVER_DRIVE.DrvBrakeAccel "" FLOAT32_IEEE autosar_swc_val_CM_single 0 0 -3.4E+38 3.4E+38 ECU_ADDRESS 0xfe4cb904 /* @ECU_Address@SwcOut_VAL_DRIVER_DRIVE.DrvBrakeAccel@ */ /end MEASUREMENT
/begin MEASUREMENT SwcOut_VAL_DRIVER_DRIVE.DrvBrakePedalSts "" UBYTE autosar_swc_val_CM_uint8 0 0 0 255 ECU_ADDRESS 0xfe4cb8f5 /* @ECU_Address@SwcOut_VAL_DRIVER_DRIVE.DrvBrakePedalSts@ */ /end MEASUREMENT
/begin MEASUREMENT SwcOut_VAL_DRIVER_DRIVE.DrvConfirmLC "" UBYTE autosar_swc_val_CM_uint8 0 0 0 255 ECU_ADDRESS 0xfe4cb8fe /* @ECU_Address@SwcOut_VAL_DRIVER_DRIVE.DrvConfirmLC@ */ /end MEASUREMENT
/begin MEASUREMENT SwcOut_VAL_DRIVER_DRIVE.DrvSteerTrqVal "" FLOAT32_IEEE autosar_swc_val_CM_single 0 0 -3.4E+38 3.4E+38 ECU_ADDRESS 0xfe4cb910 /* @ECU_Address@SwcOut_VAL_DRIVER_DRIVE.DrvSteerTrqVal@ */ /end MEASUREMENT
/begin MEASUREMENT SwcOut_VAL_DRIVER_DRIVE.DrvVoiceLCReq "" UBYTE autosar_swc_val_CM_uint8 0 0 0 255 ECU_ADDRESS 0xfe4cb8ff /* @ECU_Address@SwcOut_VAL_DRIVER_DRIVE.DrvVoiceLCReq@ */ /end MEASUREMENT
/begin MEASUREMENT SwcOut_VAL_DRIVER_DRIVE.DrvVoiceSpdAdjReq "" UBYTE autosar_swc_val_CM_uint8 0 0 0 255 ECU_ADDRESS 0xfe4cb902 /* @ECU_Address@SwcOut_VAL_DRIVER_DRIVE.DrvVoiceSpdAdjReq@ */ /end MEASUREMENT
/begin MEASUREMENT SwcOut_VAL_DRIVER_DRIVE.DrvVoiceSpdAdjReqValue "" UBYTE autosar_swc_val_CM_uint8 0 0 0 255 ECU_ADDRESS 0xfe4cb903 /* @ECU_Address@SwcOut_VAL_DRIVER_DRIVE.DrvVoiceSpdAdjReqValue@ */ /end MEASUREMENT
/begin MEASUREMENT SwcOut_VAL_DRIVER_DRIVE.DrvVoiceTimeGapAdjReq "" UBYTE autosar_swc_val_CM_uint8 0 0 0 255 ECU_ADDRESS 0xfe4cb900 /* @ECU_Address@SwcOut_VAL_DRIVER_DRIVE.DrvVoiceTimeGapAdjReq@ */ /end MEASUREMENT
/begin MEASUREMENT SwcOut_VAL_DRIVER_DRIVE.DrvVoiceTimeGapAdjReqValue "" UBYTE autosar_swc_val_CM_uint8 0 0 0 255 ECU_ADDRESS 0xfe4cb901 /* @ECU_Address@SwcOut_VAL_DRIVER_DRIVE.DrvVoiceTimeGapAdjReqValue@ */ /end MEASUREMENT
/begin MEASUREMENT SwcOut_VAL_DRIVER_DRIVE.EPBSwtSts "" UBYTE autosar_swc_val_CM_uint8 0 0 0 255 ECU_ADDRESS 0xfe4cb8f6 /* @ECU_Address@SwcOut_VAL_DRIVER_DRIVE.EPBSwtSts@ */ /end MEASUREMENT
/begin MEASUREMENT SwcOut_VAL_DRIVER_DRIVE.HazardLmpSwtSts "" UBYTE autosar_swc_val_CM_boolean 0 0 0 1 ECU_ADDRESS 0xfe4cb8f3 /* @ECU_Address@SwcOut_VAL_DRIVER_DRIVE.HazardLmpSwtSts@ */ /end MEASUREMENT
/begin MEASUREMENT SwcOut_VAL_DRIVER_DRIVE.HighBeamSwtSts "" UBYTE autosar_swc_val_CM_uint8 0 0 0 255 ECU_ADDRESS 0xfe4cb8f9 /* @ECU_Address@SwcOut_VAL_DRIVER_DRIVE.HighBeamSwtSts@ */ /end MEASUREMENT
/begin MEASUREMENT SwcOut_VAL_DRIVER_DRIVE.IncSetSpdPulse "" UBYTE autosar_swc_val_CM_boolean 0 0 0 1 ECU_ADDRESS 0xfe4cb8ef /* @ECU_Address@SwcOut_VAL_DRIVER_DRIVE.IncSetSpdPulse@ */ /end MEASUREMENT
/begin MEASUREMENT SwcOut_VAL_DRIVER_DRIVE.IncSetSpdStep "" UBYTE autosar_swc_val_CM_uint8 0 0 0 255 ECU_ADDRESS 0xfe4cb8fc /* @ECU_Address@SwcOut_VAL_DRIVER_DRIVE.IncSetSpdStep@ */ /end MEASUREMENT
/begin MEASUREMENT SwcOut_VAL_DRIVER_DRIVE.IncTimeGapPulse "" UBYTE autosar_swc_val_CM_boolean 0 0 0 1 ECU_ADDRESS 0xfe4cb8f1 /* @ECU_Address@SwcOut_VAL_DRIVER_DRIVE.IncTimeGapPulse@ */ /end MEASUREMENT
/begin MEASUREMENT SwcOut_VAL_DRIVER_DRIVE.LTurnLmpSwtSts "" UBYTE autosar_swc_val_CM_uint8 0 0 0 255 ECU_ADDRESS 0xfe4cb8f7 /* @ECU_Address@SwcOut_VAL_DRIVER_DRIVE.LTurnLmpSwtSts@ */ /end MEASUREMENT
/begin MEASUREMENT SwcOut_VAL_DRIVER_DRIVE.LccActPulse "" UBYTE autosar_swc_val_CM_boolean 0 0 0 1 ECU_ADDRESS 0xfe4cb8ea /* @ECU_Address@SwcOut_VAL_DRIVER_DRIVE.LccActPulse@ */ /end MEASUREMENT
/begin MEASUREMENT SwcOut_VAL_DRIVER_DRIVE.LccOnOffPulse "" UBYTE autosar_swc_val_CM_boolean 0 0 0 1 ECU_ADDRESS 0xfe4cb8ec /* @ECU_Address@SwcOut_VAL_DRIVER_DRIVE.LccOnOffPulse@ */ /end MEASUREMENT
/begin MEASUREMENT SwcOut_VAL_DRIVER_DRIVE.OverVehBeamSwtSts "" UBYTE autosar_swc_val_CM_uint8 0 0 0 255 ECU_ADDRESS 0xfe4cb8fa /* @ECU_Address@SwcOut_VAL_DRIVER_DRIVE.OverVehBeamSwtSts@ */ /end MEASUREMENT
/begin MEASUREMENT SwcOut_VAL_DRIVER_DRIVE.RTurnLmpSwtSts "" UBYTE autosar_swc_val_CM_uint8 0 0 0 255 ECU_ADDRESS 0xfe4cb8f8 /* @ECU_Address@SwcOut_VAL_DRIVER_DRIVE.RTurnLmpSwtSts@ */ /end MEASUREMENT
/begin MEASUREMENT SwcOut_VAL_DRIVER_DRIVE.ResumePulse "" UBYTE autosar_swc_val_CM_boolean 0 0 0 1 ECU_ADDRESS 0xfe4cb8ed /* @ECU_Address@SwcOut_VAL_DRIVER_DRIVE.ResumePulse@ */ /end MEASUREMENT
/begin MEASUREMENT SwcOut_VAL_DRIVER_DRIVE.ScfConfirm "" UBYTE autosar_swc_val_CM_uint8 0 0 0 255 ECU_ADDRESS 0xfe4cb8f4 /* @ECU_Address@SwcOut_VAL_DRIVER_DRIVE.ScfConfirm@ */ /end MEASUREMENT
/begin MEASUREMENT SwcOut_VAL_DRIVER_DRIVE.TimeStampMs "" A_UINT64 autosar_swc_val_CM_uint64 0 0 0.0 1.844674407370955e+19 ECU_ADDRESS 0xfe4cb918 /* @ECU_Address@SwcOut_VAL_DRIVER_DRIVE.TimeStampMs@ */ /end MEASUREMENT
/begin MEASUREMENT SwcOut_VAL_DRIVER_STATE.DMSAuthSts "" UBYTE autosar_swc_val_CM_uint8 0 0 0 255 ECU_ADDRESS 0xfe4cb922 /* @ECU_Address@SwcOut_VAL_DRIVER_STATE.DMSAuthSts@ */ /end MEASUREMENT
/begin MEASUREMENT SwcOut_VAL_DRIVER_STATE.DriverSts "" UBYTE autosar_swc_val_CM_uint8 0 0 0 255 ECU_ADDRESS 0xfe4cb921 /* @ECU_Address@SwcOut_VAL_DRIVER_STATE.DriverSts@ */ /end MEASUREMENT
/begin MEASUREMENT SwcOut_VAL_DRIVER_STATE.GPSAuthSts "" UBYTE autosar_swc_val_CM_uint8 0 0 0 255 ECU_ADDRESS 0xfe4cb923 /* @ECU_Address@SwcOut_VAL_DRIVER_STATE.GPSAuthSts@ */ /end MEASUREMENT
/begin MEASUREMENT SwcOut_VAL_DRIVER_STATE.HandsOff "" UBYTE autosar_swc_val_CM_uint8 0 0 0 255 ECU_ADDRESS 0xfe4cb920 /* @ECU_Address@SwcOut_VAL_DRIVER_STATE.HandsOff@ */ /end MEASUREMENT
/begin MEASUREMENT SwcOut_VAL_DRIVER_STATE.TimeStampMs "" A_UINT64 autosar_swc_val_CM_uint64 0 0 0.0 1.844674407370955e+19 ECU_ADDRESS 0xfe4cb928 /* @ECU_Address@SwcOut_VAL_DRIVER_STATE.TimeStampMs@ */ /end MEASUREMENT
/begin COMPU_METHOD autosar_swc_val_CM_ADAS_ParkingActiveSubFuncSt_794_dt "Q = V" IDENTICAL "%0.6" "" /end COMPU_METHOD
/begin COMPU_METHOD autosar_swc_val_CM_ADS_1_ADCCAvl_359_dt "Q = V" IDENTICAL "%0.6" "" /end COMPU_METHOD
/begin COMPU_METHOD autosar_swc_val_CM_ADS_1_ADSHealthSts_405_dt "Q = V" IDENTICAL "%0.6" "" /end COMPU_METHOD
/begin COMPU_METHOD autosar_swc_val_CM_ADS_1_AMAPRequestVld_359_dt "Q = V" IDENTICAL "%0.6" "" /end COMPU_METHOD
/begin COMPU_METHOD autosar_swc_val_CM_ADS_1_AMAPRequest_359_dt "Q = V" IDENTICAL "%0.6" "" /end COMPU_METHOD
/begin COMPU_METHOD autosar_swc_val_CM_ADS_1_AMAPTqLimitVld_359_dt "Q = V" IDENTICAL "%0.6" "" /end COMPU_METHOD
/begin COMPU_METHOD autosar_swc_val_CM_ADS_1_AMAPTqLimit_359_dt "Q = V" IDENTICAL "%0.6" "" /end COMPU_METHOD
/begin COMPU_METHOD autosar_swc_val_CM_ADS_1_CRC1_359_dt "Q = V" IDENTICAL "%0.6" "" /end COMPU_METHOD
/begin COMPU_METHOD autosar_swc_val_CM_ADS_1_CRC1_405_dt "Q = V" IDENTICAL "%0.6" "" /end COMPU_METHOD
/begin COMPU_METHOD autosar_swc_val_CM_ADS_1_CRC2_359_dt "Q = V" IDENTICAL "%0.6" "" /end COMPU_METHOD
/begin COMPU_METHOD autosar_swc_val_CM_ADS_1_CRC2_405_dt "Q = V" IDENTICAL "%0.6" "" /end COMPU_METHOD
/begin COMPU_METHOD autosar_swc_val_CM_ADS_1_CtrlReqMod_359_dt "Q = V" IDENTICAL "%0.6" "" /end COMPU_METHOD
/begin COMPU_METHOD autosar_swc_val_CM_ADS_1_DrvCtrlReq_359_dt "Q = V" IDENTICAL "%0.6" "" /end COMPU_METHOD
/begin COMPU_METHOD autosar_swc_val_CM_ADS_1_DrvTarTqEnable_359_dt "Q = V" IDENTICAL "%0.6" "" /end COMPU_METHOD
/begin COMPU_METHOD autosar_swc_val_CM_ADS_1_DrvTarTqVld_359_dt "Q = V" IDENTICAL "%0.6" "" /end COMPU_METHOD
/begin COMPU_METHOD autosar_swc_val_CM_ADS_1_DrvTarTq_359_dt "Q = V" IDENTICAL "%0.6" "" /end COMPU_METHOD
/begin COMPU_METHOD autosar_swc_val_CM_ADS_1_GearCtrlEnable_359_dt "Q = V" IDENTICAL "%0.6" "" /end COMPU_METHOD
/begin COMPU_METHOD autosar_swc_val_CM_ADS_1_LdwWarningCmdVld_405_dt "Q = V" IDENTICAL "%0.6" "" /end COMPU_METHOD
/begin COMPU_METHOD autosar_swc_val_CM_ADS_1_LdwWarningCmd_405_dt "Q = V" IDENTICAL "%0.6" "" /end COMPU_METHOD
/begin COMPU_METHOD autosar_swc_val_CM_ADS_1_Resd1_359_dt "Q = V" IDENTICAL "%0.6" "" /end COMPU_METHOD
/begin COMPU_METHOD autosar_swc_val_CM_ADS_1_Resd1_405_dt "Q = V" IDENTICAL "%0.6" "" /end COMPU_METHOD
/begin COMPU_METHOD autosar_swc_val_CM_ADS_1_Resd2_359_dt "Q = V" IDENTICAL "%0.6" "" /end COMPU_METHOD
/begin COMPU_METHOD autosar_swc_val_CM_ADS_1_Resd2_405_dt "Q = V" IDENTICAL "%0.6" "" /end COMPU_METHOD
/begin COMPU_METHOD autosar_swc_val_CM_ADS_1_RollgCntr1_359_dt "Q = V" IDENTICAL "%0.6" "" /end COMPU_METHOD
/begin COMPU_METHOD autosar_swc_val_CM_ADS_1_RollgCntr1_405_dt "Q = V" IDENTICAL "%0.6" "" /end COMPU_METHOD
/begin COMPU_METHOD autosar_swc_val_CM_ADS_1_RollgCntr2_359_dt "Q = V" IDENTICAL "%0.6" "" /end COMPU_METHOD
/begin COMPU_METHOD autosar_swc_val_CM_ADS_1_RollgCntr2_405_dt "Q = V" IDENTICAL "%0.6" "" /end COMPU_METHOD
/begin COMPU_METHOD autosar_swc_val_CM_ADS_1_RpaPTReadyReq_359_dt "Q = V" IDENTICAL "%0.6" "" /end COMPU_METHOD
/begin COMPU_METHOD autosar_swc_val_CM_ADS_1_SteerAgReq_405_dt "Q = V" IDENTICAL "%8.6" "" /end COMPU_METHOD
/begin COMPU_METHOD autosar_swc_val_CM_ADS_1_SteerAgVld_405_dt "Q = V" IDENTICAL "%0.6" "" /end COMPU_METHOD
/begin COMPU_METHOD autosar_swc_val_CM_ADS_1_SteerMaxTqReq_405_dt "Q = V" IDENTICAL "%8.6" "" /end COMPU_METHOD
/begin COMPU_METHOD autosar_swc_val_CM_ADS_1_SteerMinTqReq_405_dt "Q = V" IDENTICAL "%8.6" "" /end COMPU_METHOD
/begin COMPU_METHOD autosar_swc_val_CM_ADS_1_SteerPilotAgEna_405_dt "Q = V" IDENTICAL "%0.6" "" /end COMPU_METHOD
/begin COMPU_METHOD autosar_swc_val_CM_ADS_1_SteerTqEna_405_dt "Q = V" IDENTICAL "%0.6" "" /end COMPU_METHOD
/begin COMPU_METHOD autosar_swc_val_CM_ADS_1_TarGearReqVld_359_dt "Q = V" IDENTICAL "%0.6" "" /end COMPU_METHOD
/begin COMPU_METHOD autosar_swc_val_CM_ADS_1_TarGearReq_359_dt "Q = V" IDENTICAL "%0.6" "" /end COMPU_METHOD
/begin COMPU_METHOD autosar_swc_val_CM_ADS_2_AEBStatus_788_dt "Q = V" IDENTICAL "%0.6" "" /end COMPU_METHOD
/begin COMPU_METHOD autosar_swc_val_CM_ADS_2_CRC1_788_dt "Q = V" IDENTICAL "%0.6" "" /end COMPU_METHOD
/begin COMPU_METHOD autosar_swc_val_CM_ADS_2_ClosingSpeed_788_dt "Q = V" IDENTICAL "%0.6" "" /end COMPU_METHOD
/begin COMPU_METHOD autosar_swc_val_CM_ADS_2_FCWStatus_788_dt "Q = V" IDENTICAL "%0.6" "" /end COMPU_METHOD
/begin COMPU_METHOD autosar_swc_val_CM_ADS_2_FunctionSuppressReq_788_dt "Q = V" IDENTICAL "%0.6" "" /end COMPU_METHOD
/begin COMPU_METHOD autosar_swc_val_CM_ADS_2_HWRequest_788_dt "Q = V" IDENTICAL "%0.6" "" /end COMPU_METHOD
/begin COMPU_METHOD autosar_swc_val_CM_ADS_2_Object_788_dt "Q = V" IDENTICAL "%0.6" "" /end COMPU_METHOD
/begin COMPU_METHOD autosar_swc_val_CM_ADS_2_Object_Status_788_dt "Q = V" IDENTICAL "%0.6" "" /end COMPU_METHOD
/begin COMPU_METHOD autosar_swc_val_CM_ADS_2_PP_M_Request_788_dt "Q = V" IDENTICAL "%0.6" "" /end COMPU_METHOD
/begin COMPU_METHOD autosar_swc_val_CM_ADS_2_Resd1_788_dt "Q = V" IDENTICAL "%0.6" "" /end COMPU_METHOD
/begin COMPU_METHOD autosar_swc_val_CM_ADS_2_RollgCntr1_788_dt "Q = V" IDENTICAL "%0.6" "" /end COMPU_METHOD
/begin COMPU_METHOD autosar_swc_val_CM_ADS_2_TTC_788_dt "Q = V" IDENTICAL "%8.6" "" /end COMPU_METHOD
/begin COMPU_METHOD autosar_swc_val_CM_ADS_3_ACCSts_794_dt "Q = V" IDENTICAL "%0.6" "" /end COMPU_METHOD
/begin COMPU_METHOD autosar_swc_val_CM_ADS_3_AESStatus_794_dt "Q = V" IDENTICAL "%0.6" "" /end COMPU_METHOD
/begin COMPU_METHOD autosar_swc_val_CM_ADS_3_CRC1_794_dt "Q = V" IDENTICAL "%0.6" "" /end COMPU_METHOD
/begin COMPU_METHOD autosar_swc_val_CM_ADS_3_CRC2_794_dt "Q = V" IDENTICAL "%0.6" "" /end COMPU_METHOD
/begin COMPU_METHOD autosar_swc_val_CM_ADS_3_DriverHandsoffWarning_794_dt "Q = V" IDENTICAL "%0.6" "" /end COMPU_METHOD
/begin COMPU_METHOD autosar_swc_val_CM_ADS_3_ELKLeftActiveSt_794_dt "Q = V" IDENTICAL "%0.6" "" /end COMPU_METHOD
/begin COMPU_METHOD autosar_swc_val_CM_ADS_3_ELKRightActiveSt_794_dt "Q = V" IDENTICAL "%0.6" "" /end COMPU_METHOD
/begin COMPU_METHOD autosar_swc_val_CM_ADS_3_ELKSts_794_dt "Q = V" IDENTICAL "%0.6" "" /end COMPU_METHOD
/begin COMPU_METHOD autosar_swc_val_CM_ADS_3_ICAStatus_794_dt "Q = V" IDENTICAL "%0.6" "" /end COMPU_METHOD
/begin COMPU_METHOD autosar_swc_val_CM_ADS_3_ICATextinfo_794_dt "Q = V" IDENTICAL "%0.6" "" /end COMPU_METHOD
/begin COMPU_METHOD autosar_swc_val_CM_ADS_3_LKSLeftTrackingSt_794_dt "Q = V" IDENTICAL "%0.6" "" /end COMPU_METHOD
/begin COMPU_METHOD autosar_swc_val_CM_ADS_3_LKSMod_794_dt "Q = V" IDENTICAL "%0.6" "" /end COMPU_METHOD
/begin COMPU_METHOD autosar_swc_val_CM_ADS_3_LKSRightTrackingSt_794_dt "Q = V" IDENTICAL "%0.6" "" /end COMPU_METHOD
/begin COMPU_METHOD autosar_swc_val_CM_ADS_3_LKSSts_794_dt "Q = V" IDENTICAL "%0.6" "" /end COMPU_METHOD
/begin COMPU_METHOD autosar_swc_val_CM_ADS_3_RearViewFoldReq_794_dt "Q = V" IDENTICAL "%0.6" "" /end COMPU_METHOD
/begin COMPU_METHOD autosar_swc_val_CM_ADS_3_Resd1_794_dt "Q = V" IDENTICAL "%0.6" "" /end COMPU_METHOD
/begin COMPU_METHOD autosar_swc_val_CM_ADS_3_Resd2_794_dt "Q = V" IDENTICAL "%0.6" "" /end COMPU_METHOD
/begin COMPU_METHOD autosar_swc_val_CM_ADS_3_RollgCntr1_794_dt "Q = V" IDENTICAL "%0.6" "" /end COMPU_METHOD
/begin COMPU_METHOD autosar_swc_val_CM_ADS_3_RollgCntr2_794_dt "Q = V" IDENTICAL "%0.6" "" /end COMPU_METHOD
/begin COMPU_METHOD autosar_swc_val_CM_ADS_ALCSts_794_dt "Q = V" IDENTICAL "%0.6" "" /end COMPU_METHOD
/begin COMPU_METHOD autosar_swc_val_CM_ADS_HNOPSts_794_dt "Q = V" IDENTICAL "%0.6" "" /end COMPU_METHOD
/begin COMPU_METHOD autosar_swc_val_CM_ADS_UNOPSts_794_dt "Q = V" IDENTICAL "%0.6" "" /end COMPU_METHOD
/begin COMPU_METHOD autosar_swc_val_CM_CutOutFreshvalues_2CB_S_330_dt "Q = V" IDENTICAL "%0.6" "" /end COMPU_METHOD
/begin COMPU_METHOD autosar_swc_val_CM_CutOutFreshvalues_2CB_S_405_dt "Q = V" IDENTICAL "%0.6" "" /end COMPU_METHOD
/begin COMPU_METHOD autosar_swc_val_CM_CutOutMAC_2CB_S_330_dt "Q = V" IDENTICAL "%0.6" "" /end COMPU_METHOD
/begin COMPU_METHOD autosar_swc_val_CM_CutOutMAC_2CB_S_405_dt "Q = V" IDENTICAL "%0.6" "" /end COMPU_METHOD
/begin COMPU_METHOD autosar_swc_val_CM_Diag_FCM_RES_1986_dt "Q = V" IDENTICAL "%0.6" "" /end COMPU_METHOD
/begin COMPU_METHOD autosar_swc_val_CM_ExternalTemperatureFailSts_1172_dt "Q = V" IDENTICAL "%0.6" "" /end COMPU_METHOD
/begin COMPU_METHOD autosar_swc_val_CM_ExternalTemperature_C_1172_dt "Q = V" IDENTICAL "%8.6" "" /end COMPU_METHOD
/begin COMPU_METHOD autosar_swc_val_CM_FCM_2_AbaLvl_325_dt "Q = V" IDENTICAL "%0.6" "" /end COMPU_METHOD
/begin COMPU_METHOD autosar_swc_val_CM_FCM_2_AbaReq_325_dt "Q = V" IDENTICAL "%0.6" "" /end COMPU_METHOD
/begin COMPU_METHOD autosar_swc_val_CM_FCM_2_AebReqTyp_325_dt "Q = V" IDENTICAL "%0.6" "" /end COMPU_METHOD
/begin COMPU_METHOD autosar_swc_val_CM_FCM_2_AebTarDecVld_325_dt "Q = V" IDENTICAL "%0.6" "" /end COMPU_METHOD
/begin COMPU_METHOD autosar_swc_val_CM_FCM_2_AebTarDec_325_dt "Q = V" IDENTICAL "%8.6" "" /end COMPU_METHOD
/begin COMPU_METHOD autosar_swc_val_CM_FCM_2_Avl_325_dt "Q = V" IDENTICAL "%0.6" "" /end COMPU_METHOD
/begin COMPU_METHOD autosar_swc_val_CM_FCM_2_AwbLvl_325_dt "Q = V" IDENTICAL "%0.6" "" /end COMPU_METHOD
/begin COMPU_METHOD autosar_swc_val_CM_FCM_2_AwbReq_325_dt "Q = V" IDENTICAL "%0.6" "" /end COMPU_METHOD
/begin COMPU_METHOD autosar_swc_val_CM_FCM_2_BrkPreFillReq_325_dt "Q = V" IDENTICAL "%0.6" "" /end COMPU_METHOD
/begin COMPU_METHOD autosar_swc_val_CM_FCM_2_CRC1_325_dt "Q = V" IDENTICAL "%0.6" "" /end COMPU_METHOD
/begin COMPU_METHOD autosar_swc_val_CM_FCM_2_HazardLightReq_788_dt "Q = V" IDENTICAL "%0.6" "" /end COMPU_METHOD
/begin COMPU_METHOD autosar_swc_val_CM_FCM_2_HighBeamReq_Cmd_788_dt "Q = V" IDENTICAL "%0.6" "" /end COMPU_METHOD
/begin COMPU_METHOD autosar_swc_val_CM_FCM_2_IHCfunctionSts_788_dt "Q = V" IDENTICAL "%0.6" "" /end COMPU_METHOD
/begin COMPU_METHOD autosar_swc_val_CM_FCM_2_Resd1_325_dt "Q = V" IDENTICAL "%0.6" "" /end COMPU_METHOD
/begin COMPU_METHOD autosar_swc_val_CM_FCM_2_RollgCntr1_325_dt "Q = V" IDENTICAL "%0.6" "" /end COMPU_METHOD
/begin COMPU_METHOD autosar_swc_val_CM_FCM_2_SysStatus_788_dt "Q = V" IDENTICAL "%0.6" "" /end COMPU_METHOD
/begin COMPU_METHOD autosar_swc_val_CM_FCM_3_CRC1_330_dt "Q = V" IDENTICAL "%0.6" "" /end COMPU_METHOD
/begin COMPU_METHOD autosar_swc_val_CM_FCM_3_PilotBrkDecTarReq_330_dt "Q = V" IDENTICAL "%0.6" "" /end COMPU_METHOD
/begin COMPU_METHOD autosar_swc_val_CM_FCM_3_PilotBrkDecTarVld_330_dt "Q = V" IDENTICAL "%0.6" "" /end COMPU_METHOD
/begin COMPU_METHOD autosar_swc_val_CM_FCM_3_PilotCtrlType_330_dt "Q = V" IDENTICAL "%0.6" "" /end COMPU_METHOD
/begin COMPU_METHOD autosar_swc_val_CM_FCM_3_PilotDec2StpReq_330_dt "Q = V" IDENTICAL "%0.6" "" /end COMPU_METHOD
/begin COMPU_METHOD autosar_swc_val_CM_FCM_3_PilotDriOffReq_330_dt "Q = V" IDENTICAL "%0.6" "" /end COMPU_METHOD
/begin COMPU_METHOD autosar_swc_val_CM_FCM_3_PilotParkCtrlRepSta_330_dt "Q = V" IDENTICAL "%0.6" "" /end COMPU_METHOD
/begin COMPU_METHOD autosar_swc_val_CM_FCM_3_PilotkBrkDecTar_330_dt "Q = V" IDENTICAL "%8.6" "" /end COMPU_METHOD
/begin COMPU_METHOD autosar_swc_val_CM_FCM_3_Resd1_330_dt "Q = V" IDENTICAL "%0.6" "" /end COMPU_METHOD
/begin COMPU_METHOD autosar_swc_val_CM_FCM_3_RollgCntr1_330_dt "Q = V" IDENTICAL "%0.6" "" /end COMPU_METHOD
/begin COMPU_METHOD autosar_swc_val_CM_FCM_Awake_Diag_1565_dt "Q = V" IDENTICAL "%0.6" "" /end COMPU_METHOD
/begin COMPU_METHOD autosar_swc_val_CM_FCM_Awake_FLCR_1565_dt "Q = V" IDENTICAL "%0.6" "" /end COMPU_METHOD
/begin COMPU_METHOD autosar_swc_val_CM_FCM_Awake_FRCR_1565_dt "Q = V" IDENTICAL "%0.6" "" /end COMPU_METHOD
/begin COMPU_METHOD autosar_swc_val_CM_FCM_Awake_KL15_1565_dt "Q = V" IDENTICAL "%0.6" "" /end COMPU_METHOD
/begin COMPU_METHOD autosar_swc_val_CM_FCM_Awake_NM_1565_dt "Q = V" IDENTICAL "%0.6" "" /end COMPU_METHOD
/begin COMPU_METHOD autosar_swc_val_CM_FCM_Awake_Poweron_1565_dt "Q = V" IDENTICAL "%0.6" "" /end COMPU_METHOD
/begin COMPU_METHOD autosar_swc_val_CM_FCM_Awake_RLCR_1565_dt "Q = V" IDENTICAL "%0.6" "" /end COMPU_METHOD
/begin COMPU_METHOD autosar_swc_val_CM_FCM_Awake_RRCR_1565_dt "Q = V" IDENTICAL "%0.6" "" /end COMPU_METHOD
/begin COMPU_METHOD autosar_swc_val_CM_FCM_Awake_Upload_1565_dt "Q = V" IDENTICAL "%0.6" "" /end COMPU_METHOD
/begin COMPU_METHOD autosar_swc_val_CM_FCM_FaultNum10_1283_dt "Q = V" IDENTICAL "%0.6" "" /end COMPU_METHOD
/begin COMPU_METHOD autosar_swc_val_CM_FCM_FaultNum11_1283_dt "Q = V" IDENTICAL "%0.6" "" /end COMPU_METHOD
/begin COMPU_METHOD autosar_swc_val_CM_FCM_FaultNum12_1283_dt "Q = V" IDENTICAL "%0.6" "" /end COMPU_METHOD
/begin COMPU_METHOD autosar_swc_val_CM_FCM_FaultNum13_1283_dt "Q = V" IDENTICAL "%0.6" "" /end COMPU_METHOD
/begin COMPU_METHOD autosar_swc_val_CM_FCM_FaultNum14_1283_dt "Q = V" IDENTICAL "%0.6" "" /end COMPU_METHOD
/begin COMPU_METHOD autosar_swc_val_CM_FCM_FaultNum15_1283_dt "Q = V" IDENTICAL "%0.6" "" /end COMPU_METHOD
/begin COMPU_METHOD autosar_swc_val_CM_FCM_FaultNum16_1283_dt "Q = V" IDENTICAL "%0.6" "" /end COMPU_METHOD
/begin COMPU_METHOD autosar_swc_val_CM_FCM_FaultNum17_1283_dt "Q = V" IDENTICAL "%0.6" "" /end COMPU_METHOD
/begin COMPU_METHOD autosar_swc_val_CM_FCM_FaultNum18_1283_dt "Q = V" IDENTICAL "%0.6" "" /end COMPU_METHOD
/begin COMPU_METHOD autosar_swc_val_CM_FCM_FaultNum19_1283_dt "Q = V" IDENTICAL "%0.6" "" /end COMPU_METHOD
/begin COMPU_METHOD autosar_swc_val_CM_FCM_FaultNum1_1283_dt "Q = V" IDENTICAL "%0.6" "" /end COMPU_METHOD
/begin COMPU_METHOD autosar_swc_val_CM_FCM_FaultNum20_1283_dt "Q = V" IDENTICAL "%0.6" "" /end COMPU_METHOD
/begin COMPU_METHOD autosar_swc_val_CM_FCM_FaultNum2_1283_dt "Q = V" IDENTICAL "%0.6" "" /end COMPU_METHOD
/begin COMPU_METHOD autosar_swc_val_CM_FCM_FaultNum3_1283_dt "Q = V" IDENTICAL "%0.6" "" /end COMPU_METHOD
/begin COMPU_METHOD autosar_swc_val_CM_FCM_FaultNum4_1283_dt "Q = V" IDENTICAL "%0.6" "" /end COMPU_METHOD
/begin COMPU_METHOD autosar_swc_val_CM_FCM_FaultNum5_1283_dt "Q = V" IDENTICAL "%0.6" "" /end COMPU_METHOD
/begin COMPU_METHOD autosar_swc_val_CM_FCM_FaultNum6_1283_dt "Q = V" IDENTICAL "%0.6" "" /end COMPU_METHOD
/begin COMPU_METHOD autosar_swc_val_CM_FCM_FaultNum7_1283_dt "Q = V" IDENTICAL "%0.6" "" /end COMPU_METHOD
/begin COMPU_METHOD autosar_swc_val_CM_FCM_FaultNum8_1283_dt "Q = V" IDENTICAL "%0.6" "" /end COMPU_METHOD
/begin COMPU_METHOD autosar_swc_val_CM_FCM_FaultNum9_1283_dt "Q = V" IDENTICAL "%0.6" "" /end COMPU_METHOD
/begin COMPU_METHOD autosar_swc_val_CM_FCM_FrameIndex_1283_dt "Q = V" IDENTICAL "%0.6" "" /end COMPU_METHOD
/begin COMPU_METHOD autosar_swc_val_CM_FCM_SupplierNum_1283_dt "Q = V" IDENTICAL "%0.6" "" /end COMPU_METHOD
/begin COMPU_METHOD autosar_swc_val_CM_FCM_TotalFaultNum_1283_dt "Q = V" IDENTICAL "%0.6" "" /end COMPU_METHOD
/begin COMPU_METHOD autosar_swc_val_CM_FCM_Wakeup_Diag_1565_dt "Q = V" IDENTICAL "%0.6" "" /end COMPU_METHOD
/begin COMPU_METHOD autosar_swc_val_CM_FCM_Wakeup_KL15_1565_dt "Q = V" IDENTICAL "%0.6" "" /end COMPU_METHOD
/begin COMPU_METHOD autosar_swc_val_CM_FCM_Wakeup_NM_1565_dt "Q = V" IDENTICAL "%0.6" "" /end COMPU_METHOD
/begin COMPU_METHOD autosar_swc_val_CM_FCM_Wakeup_Poweron_1565_dt "Q = V" IDENTICAL "%0.6" "" /end COMPU_METHOD
/begin COMPU_METHOD autosar_swc_val_CM_NMm_FCM_Reserved1_1565_dt "Q = V" IDENTICAL "%0.6" "" /end COMPU_METHOD
/begin COMPU_METHOD autosar_swc_val_CM_RMR_FCM_1565_dt "Q = V" IDENTICAL "%0.6" "" /end COMPU_METHOD
/begin COMPU_METHOD autosar_swc_val_CM_TCM_1_TrailerSts_1199_dt "Q = V" IDENTICAL "%0.6" "" /end COMPU_METHOD
/begin COMPU_METHOD autosar_swc_val_CM_VCC_1_CarMode_1035_dt "Q = V" IDENTICAL "%0.6" "" /end COMPU_METHOD
/begin COMPU_METHOD autosar_swc_val_CM_VCC_1_DriveMode_1035_dt "Q = V" IDENTICAL "%0.6" "" /end COMPU_METHOD
/begin COMPU_METHOD autosar_swc_val_CM_VCC_2_ConfigurationMessageTrg_1075_dt "Q = V" IDENTICAL "%0.6" "" /end COMPU_METHOD
/begin COMPU_METHOD autosar_swc_val_CM_VCC_3_CRC_1136_dt "Q = V" IDENTICAL "%0.6" "" /end COMPU_METHOD
/begin COMPU_METHOD autosar_swc_val_CM_VCC_3_RollgCntr_1136_dt "Q = V" IDENTICAL "%0.6" "" /end COMPU_METHOD
/begin COMPU_METHOD autosar_swc_val_CM_VCC_3_SN_1136_dt "Q = V" IDENTICAL "%0.6" "" /end COMPU_METHOD
/begin COMPU_METHOD autosar_swc_val_CM_VCU_10_CRC_56_dt "Q = V" IDENTICAL "%0.6" "" /end COMPU_METHOD
/begin COMPU_METHOD autosar_swc_val_CM_VCU_10_Resd_56_dt "Q = V" IDENTICAL "%0.6" "" /end COMPU_METHOD
/begin COMPU_METHOD autosar_swc_val_CM_VCU_10_RollgCntr_56_dt "Q = V" IDENTICAL "%0.6" "" /end COMPU_METHOD
/begin COMPU_METHOD autosar_swc_val_CM_VCU_11_CRC1_59_dt "Q = V" IDENTICAL "%0.6" "" /end COMPU_METHOD
/begin COMPU_METHOD autosar_swc_val_CM_VCU_11_CRC2_59_dt "Q = V" IDENTICAL "%0.6" "" /end COMPU_METHOD
/begin COMPU_METHOD autosar_swc_val_CM_VCU_11_CRC3_59_dt "Q = V" IDENTICAL "%0.6" "" /end COMPU_METHOD
/begin COMPU_METHOD autosar_swc_val_CM_VCU_11_CRC4_59_dt "Q = V" IDENTICAL "%0.6" "" /end COMPU_METHOD
/begin COMPU_METHOD autosar_swc_val_CM_VCU_11_Resd1_59_dt "Q = V" IDENTICAL "%0.6" "" /end COMPU_METHOD
/begin COMPU_METHOD autosar_swc_val_CM_VCU_11_Resd2_59_dt "Q = V" IDENTICAL "%0.6" "" /end COMPU_METHOD
/begin COMPU_METHOD autosar_swc_val_CM_VCU_11_Resd3_59_dt "Q = V" IDENTICAL "%0.6" "" /end COMPU_METHOD
/begin COMPU_METHOD autosar_swc_val_CM_VCU_11_Resd4_59_dt "Q = V" IDENTICAL "%0.6" "" /end COMPU_METHOD
/begin COMPU_METHOD autosar_swc_val_CM_VCU_11_RollgCntr1_59_dt "Q = V" IDENTICAL "%0.6" "" /end COMPU_METHOD
/begin COMPU_METHOD autosar_swc_val_CM_VCU_11_RollgCntr2_59_dt "Q = V" IDENTICAL "%0.6" "" /end COMPU_METHOD
/begin COMPU_METHOD autosar_swc_val_CM_VCU_11_RollgCntr3_59_dt "Q = V" IDENTICAL "%0.6" "" /end COMPU_METHOD
/begin COMPU_METHOD autosar_swc_val_CM_VCU_11_RollgCntr4_59_dt "Q = V" IDENTICAL "%0.6" "" /end COMPU_METHOD
/begin COMPU_METHOD autosar_swc_val_CM_VCU_12_CRC1_75_dt "Q = V" IDENTICAL "%0.6" "" /end COMPU_METHOD
/begin COMPU_METHOD autosar_swc_val_CM_VCU_12_CRC2_75_dt "Q = V" IDENTICAL "%0.6" "" /end COMPU_METHOD
/begin COMPU_METHOD autosar_swc_val_CM_VCU_12_CRC3_75_dt "Q = V" IDENTICAL "%0.6" "" /end COMPU_METHOD
/begin COMPU_METHOD autosar_swc_val_CM_VCU_12_DriverTorqueDesired_75_dt "Q = V" IDENTICAL "%0.6" "" /end COMPU_METHOD
/begin COMPU_METHOD autosar_swc_val_CM_VCU_12_DrvrAccrPedlOvrd_75_dt "Q = V" IDENTICAL "%0.6" "" /end COMPU_METHOD
/begin COMPU_METHOD autosar_swc_val_CM_VCU_12_DrvrGearIntervention_75_dt "Q = V" IDENTICAL "%0.6" "" /end COMPU_METHOD
/begin COMPU_METHOD autosar_swc_val_CM_VCU_12_GasPedalInhabition_75_dt "Q = V" IDENTICAL "%0.6" "" /end COMPU_METHOD
/begin COMPU_METHOD autosar_swc_val_CM_VCU_12_PtTqActvSts_75_dt "Q = V" IDENTICAL "%0.6" "" /end COMPU_METHOD
/begin COMPU_METHOD autosar_swc_val_CM_VCU_12_PtTqAvl_75_dt "Q = V" IDENTICAL "%0.6" "" /end COMPU_METHOD
/begin COMPU_METHOD autosar_swc_val_CM_VCU_12_PtTqMaxVld_75_dt "Q = V" IDENTICAL "%0.6" "" /end COMPU_METHOD
/begin COMPU_METHOD autosar_swc_val_CM_VCU_12_PtTqMax_75_dt "Q = V" IDENTICAL "%0.6" "" /end COMPU_METHOD
/begin COMPU_METHOD autosar_swc_val_CM_VCU_12_Resd1_75_dt "Q = V" IDENTICAL "%0.6" "" /end COMPU_METHOD
/begin COMPU_METHOD autosar_swc_val_CM_VCU_12_Resd2_75_dt "Q = V" IDENTICAL "%0.6" "" /end COMPU_METHOD
/begin COMPU_METHOD autosar_swc_val_CM_VCU_12_Resd3_75_dt "Q = V" IDENTICAL "%0.6" "" /end COMPU_METHOD
/begin COMPU_METHOD autosar_swc_val_CM_VCU_12_RollgCntr1_75_dt "Q = V" IDENTICAL "%0.6" "" /end COMPU_METHOD
/begin COMPU_METHOD autosar_swc_val_CM_VCU_12_RollgCntr2_75_dt "Q = V" IDENTICAL "%0.6" "" /end COMPU_METHOD
/begin COMPU_METHOD autosar_swc_val_CM_VCU_12_RollgCntr3_75_dt "Q = V" IDENTICAL "%0.6" "" /end COMPU_METHOD
/begin COMPU_METHOD autosar_swc_val_CM_VCU_12_VehWhlActTqADSVld_75_dt "Q = V" IDENTICAL "%0.6" "" /end COMPU_METHOD
/begin COMPU_METHOD autosar_swc_val_CM_VCU_12_VehWhlActTqADS_75_dt "Q = V" IDENTICAL "%0.6" "" /end COMPU_METHOD
/begin COMPU_METHOD autosar_swc_val_CM_VCU_12_VehWhlActTqVld_75_dt "Q = V" IDENTICAL "%0.6" "" /end COMPU_METHOD
/begin COMPU_METHOD autosar_swc_val_CM_VCU_12_VehWhlActTq_75_dt "Q = V" IDENTICAL "%0.6" "" /end COMPU_METHOD
/begin COMPU_METHOD autosar_swc_val_CM_VCU_1_G_CRC_1204_dt "Q = V" IDENTICAL "%0.6" "" /end COMPU_METHOD
/begin COMPU_METHOD autosar_swc_val_CM_VCU_1_G_Resd_1204_dt "Q = V" IDENTICAL "%0.6" "" /end COMPU_METHOD
/begin COMPU_METHOD autosar_swc_val_CM_VCU_1_G_RollgCntr_1204_dt "Q = V" IDENTICAL "%0.6" "" /end COMPU_METHOD
/begin COMPU_METHOD autosar_swc_val_CM_VCU_2_G_CRC_1209_dt "Q = V" IDENTICAL "%0.6" "" /end COMPU_METHOD
/begin COMPU_METHOD autosar_swc_val_CM_VCU_2_G_Resd_1209_dt "Q = V" IDENTICAL "%0.6" "" /end COMPU_METHOD
/begin COMPU_METHOD autosar_swc_val_CM_VCU_2_G_RollgCntr_1209_dt "Q = V" IDENTICAL "%0.6" "" /end COMPU_METHOD
/begin COMPU_METHOD autosar_swc_val_CM_VCU_AcceleratorPosRawIVD_59_dt "Q = V" IDENTICAL "%0.6" "" /end COMPU_METHOD
/begin COMPU_METHOD autosar_swc_val_CM_VCU_AcceleratorPosRaw_1204_dt "Q = V" IDENTICAL "%8.6" "" /end COMPU_METHOD
/begin COMPU_METHOD autosar_swc_val_CM_VCU_AcceleratorPosRaw_59_dt "Q = V" IDENTICAL "%8.6" "" /end COMPU_METHOD
/begin COMPU_METHOD autosar_swc_val_CM_VCU_ActWheelSpdFA_59_dt "Q = V" IDENTICAL "%0.6" "" /end COMPU_METHOD
/begin COMPU_METHOD autosar_swc_val_CM_VCU_ActWheelSpdRA_59_dt "Q = V" IDENTICAL "%0.6" "" /end COMPU_METHOD
/begin COMPU_METHOD autosar_swc_val_CM_VCU_ActWheelSpdStsFA_59_dt "Q = V" IDENTICAL "%0.6" "" /end COMPU_METHOD
/begin COMPU_METHOD autosar_swc_val_CM_VCU_ActWheelSpdStsRA_59_dt "Q = V" IDENTICAL "%0.6" "" /end COMPU_METHOD
/begin COMPU_METHOD autosar_swc_val_CM_VCU_ActWheelTorqueFA_1212_dt "Q = V" IDENTICAL "%0.6" "" /end COMPU_METHOD
/begin COMPU_METHOD autosar_swc_val_CM_VCU_ActWheelTorqueRA_1212_dt "Q = V" IDENTICAL "%0.6" "" /end COMPU_METHOD
/begin COMPU_METHOD autosar_swc_val_CM_VCU_ActWheelTorqueStsFA_59_dt "Q = V" IDENTICAL "%0.6" "" /end COMPU_METHOD
/begin COMPU_METHOD autosar_swc_val_CM_VCU_ActWheelTorqueStsRA_59_dt "Q = V" IDENTICAL "%0.6" "" /end COMPU_METHOD
/begin COMPU_METHOD autosar_swc_val_CM_VCU_ActualGearValidData_56_dt "Q = V" IDENTICAL "%0.6" "" /end COMPU_METHOD
/begin COMPU_METHOD autosar_swc_val_CM_VCU_ActualGear_56_dt "Q = V" IDENTICAL "%0.6" "" /end COMPU_METHOD
/begin COMPU_METHOD autosar_swc_val_CM_VCU_BrakePedalStsValidData_56_dt "Q = V" IDENTICAL "%0.6" "" /end COMPU_METHOD
/begin COMPU_METHOD autosar_swc_val_CM_VCU_BrakePedalSts_56_dt "Q = V" IDENTICAL "%0.6" "" /end COMPU_METHOD
/begin COMPU_METHOD autosar_swc_val_CM_VCU_DriveMode_1204_dt "Q = V" IDENTICAL "%0.6" "" /end COMPU_METHOD
/begin COMPU_METHOD autosar_swc_val_CM_VCU_DynamicRangeAval_1229_dt "Q = V" IDENTICAL "%0.6" "" /end COMPU_METHOD
/begin COMPU_METHOD autosar_swc_val_CM_VCU_GasPedalPositionInvalidData_1209_dt "Q = V" IDENTICAL "%0.6" "" /end COMPU_METHOD
/begin COMPU_METHOD autosar_swc_val_CM_VCU_GasPedalPositionInvalidData_59_dt "Q = V" IDENTICAL "%0.6" "" /end COMPU_METHOD
/begin COMPU_METHOD autosar_swc_val_CM_VCU_GasPedalPosition_1209_dt "Q = V" IDENTICAL "%8.6" "" /end COMPU_METHOD
/begin COMPU_METHOD autosar_swc_val_CM_VCU_GasPedalPosition_59_dt "Q = V" IDENTICAL "%8.6" "" /end COMPU_METHOD
/begin COMPU_METHOD autosar_swc_val_CM_VCU_HVReady_1209_dt "Q = V" IDENTICAL "%0.6" "" /end COMPU_METHOD
/begin COMPU_METHOD autosar_swc_val_CM_VCU_IndcdDriverReqWhlTqStsFA_59_dt "Q = V" IDENTICAL "%0.6" "" /end COMPU_METHOD
/begin COMPU_METHOD autosar_swc_val_CM_VCU_IndcdDriverReqWhlTqStsRA_59_dt "Q = V" IDENTICAL "%0.6" "" /end COMPU_METHOD
/begin COMPU_METHOD autosar_swc_val_CM_VCU_IndicatedDriverReqWhlTqFA_59_dt "Q = V" IDENTICAL "%0.6" "" /end COMPU_METHOD
/begin COMPU_METHOD autosar_swc_val_CM_VCU_IndicatedDriverReqWhlTqRA_59_dt "Q = V" IDENTICAL "%0.6" "" /end COMPU_METHOD
/begin COMPU_METHOD autosar_swc_val_CM_VCU_TargetGearValidData_56_dt "Q = V" IDENTICAL "%0.6" "" /end COMPU_METHOD
/begin COMPU_METHOD autosar_swc_val_CM_VCU_TargetGear_56_dt "Q = V" IDENTICAL "%0.6" "" /end COMPU_METHOD
/begin COMPU_METHOD autosar_swc_val_CM_boolean "Q = V" IDENTICAL "%1.0" "" /end COMPU_METHOD
/begin COMPU_METHOD autosar_swc_val_CM_double "Q = V" IDENTICAL "%15.10" "" /end COMPU_METHOD
/begin COMPU_METHOD autosar_swc_val_CM_int32 "Q = V" IDENTICAL "%10.0" "" /end COMPU_METHOD
/begin COMPU_METHOD autosar_swc_val_CM_int8 "Q = V" IDENTICAL "%3.0" "" /end COMPU_METHOD
/begin COMPU_METHOD autosar_swc_val_CM_single "Q = V" IDENTICAL "%8.6" "" /end COMPU_METHOD
/begin COMPU_METHOD autosar_swc_val_CM_srcNodeID_FCM_1565_dt "Q = V" IDENTICAL "%0.6" "" /end COMPU_METHOD
/begin COMPU_METHOD autosar_swc_val_CM_uint16 "Q = V" IDENTICAL "%5.0" "" /end COMPU_METHOD
/begin COMPU_METHOD autosar_swc_val_CM_uint64 "Q = V" IDENTICAL "%20.0" "" /end COMPU_METHOD
/begin COMPU_METHOD autosar_swc_val_CM_uint8 "Q = V" IDENTICAL "%3.0" "" /end COMPU_METHOD
/begin GROUP SwcIn_SysIn_HMI_ADASSetting.ADASSettingInfo ""
 /begin REF_MEASUREMENT SwcIn_SysIn_HMI_ADASSetting.ADASSettingInfo.ICAEnableBtnSts SwcIn_SysIn_HMI_ADASSetting.ADASSettingInfo.FSRASpdSetMod SwcIn_SysIn_HMI_ADASSetting.ADASSettingInfo.FSRACruiseSpdMod SwcIn_SysIn_HMI_ADASSetting.ADASSettingInfo.FSRACruiseSpdOffsetMod SwcIn_SysIn_HMI_ADASSetting.ADASSettingInfo.FSRACruiseSpdOffsetSpd SwcIn_SysIn_HMI_ADASSetting.ADASSettingInfo.FSRACruiseSpdOffsetPercent SwcIn_SysIn_HMI_ADASSetting.ADASSettingInfo.ISLIWarnMod SwcIn_SysIn_HMI_ADASSetting.ADASSettingInfo.ISLISpdOffsetMod SwcIn_SysIn_HMI_ADASSetting.ADASSettingInfo.ISLICruiseSpdRelOffset SwcIn_SysIn_HMI_ADASSetting.ADASSettingInfo.ISLICruiseSpdAbdOffset SwcIn_SysIn_HMI_ADASSetting.ADASSettingInfo.FCWWarnDistance SwcIn_SysIn_HMI_ADASSetting.ADASSettingInfo.FCWSettingSt SwcIn_SysIn_HMI_ADASSetting.ADASSettingInfo.AEBSettingSt SwcIn_SysIn_HMI_ADASSetting.ADASSettingInfo.LKSSettingSt SwcIn_SysIn_HMI_ADASSetting.ADASSettingInfo.LDWWarnType SwcIn_SysIn_HMI_ADASSetting.ADASSettingInfo.ELKSettingSt SwcIn_SysIn_HMI_ADASSetting.ADASSettingInfo.BSDSettingSt SwcIn_SysIn_HMI_ADASSetting.ADASSettingInfo.DOWSettingSt SwcIn_SysIn_HMI_ADASSetting.ADASSettingInfo.HODWarnSettingSt SwcIn_SysIn_HMI_ADASSetting.ADASSettingInfo.FCTAWarnType SwcIn_SysIn_HMI_ADASSetting.ADASSettingInfo.RCTAWarnType SwcIn_SysIn_HMI_ADASSetting.ADASSettingInfo.ESASettingSt SwcIn_SysIn_HMI_ADASSetting.ADASSettingInfo.AMAPSettingSt SwcIn_SysIn_HMI_ADASSetting.ADASSettingInfo.NOPEnableBtnSts SwcIn_SysIn_HMI_ADASSetting.ADASSettingInfo.VoiceRemindSettingMode SwcIn_SysIn_HMI_ADASSetting.ADASSettingInfo.NOPLaneChangeStyle SwcIn_SysIn_HMI_ADASSetting.ADASSettingInfo.NOPLaneChangeMod SwcIn_SysIn_HMI_ADASSetting.ADASSettingInfo.NOPLaneChangeWarnType SwcIn_SysIn_HMI_ADASSetting.ADASSettingInfo.U_NOPEnableBtnSts SwcIn_SysIn_HMI_ADASSetting.ADASSettingInfo.HPASettingSt SwcIn_SysIn_HMI_ADASSetting.ADASSettingInfo.VPASettingSt SwcIn_SysIn_HMI_ADASSetting.ADASSettingInfo.APASettingSt SwcIn_SysIn_HMI_ADASSetting.ADASSettingInfo.VoiceRemindSettingSt SwcIn_SysIn_HMI_ADASSetting.ADASSettingInfo.DrivingVoiceRemindSettingSt SwcIn_SysIn_HMI_ADASSetting.ADASSettingInfo.NRASettingSt /end REF_MEASUREMENT
/end GROUP
/begin GROUP SwcIn_SysIn_HMI_ADASSetting.ADASSettingInfo_2 ""
 /begin REF_MEASUREMENT SwcIn_SysIn_HMI_ADASSetting.ADASSettingInfo_2.ICAEnableBtnSts SwcIn_SysIn_HMI_ADASSetting.ADASSettingInfo_2.FSRASpdSetMod SwcIn_SysIn_HMI_ADASSetting.ADASSettingInfo_2.FSRACruiseSpdMod SwcIn_SysIn_HMI_ADASSetting.ADASSettingInfo_2.FSRACruiseSpdOffsetMod SwcIn_SysIn_HMI_ADASSetting.ADASSettingInfo_2.FSRACruiseSpdOffsetSpd SwcIn_SysIn_HMI_ADASSetting.ADASSettingInfo_2.FSRACruiseSpdOffsetPercent SwcIn_SysIn_HMI_ADASSetting.ADASSettingInfo_2.ISLIWarnMod SwcIn_SysIn_HMI_ADASSetting.ADASSettingInfo_2.ISLISpdOffsetMod SwcIn_SysIn_HMI_ADASSetting.ADASSettingInfo_2.ISLICruiseSpdRelOffset SwcIn_SysIn_HMI_ADASSetting.ADASSettingInfo_2.ISLICruiseSpdAbdOffset SwcIn_SysIn_HMI_ADASSetting.ADASSettingInfo_2.FCWWarnDistance SwcIn_SysIn_HMI_ADASSetting.ADASSettingInfo_2.FCWSettingSt SwcIn_SysIn_HMI_ADASSetting.ADASSettingInfo_2.AEBSettingSt SwcIn_SysIn_HMI_ADASSetting.ADASSettingInfo_2.LKSSettingSt SwcIn_SysIn_HMI_ADASSetting.ADASSettingInfo_2.LDWWarnType SwcIn_SysIn_HMI_ADASSetting.ADASSettingInfo_2.ELKSettingSt SwcIn_SysIn_HMI_ADASSetting.ADASSettingInfo_2.BSDSettingSt SwcIn_SysIn_HMI_ADASSetting.ADASSettingInfo_2.DOWSettingSt SwcIn_SysIn_HMI_ADASSetting.ADASSettingInfo_2.ICAplusSettingSt SwcIn_SysIn_HMI_ADASSetting.ADASSettingInfo_2.FCTAWarnType SwcIn_SysIn_HMI_ADASSetting.ADASSettingInfo_2.RCTAWarnType SwcIn_SysIn_HMI_ADASSetting.ADASSettingInfo_2.ESASettingSt SwcIn_SysIn_HMI_ADASSetting.ADASSettingInfo_2.AMAPSettingSt SwcIn_SysIn_HMI_ADASSetting.ADASSettingInfo_2.NOPEnableBtnSts SwcIn_SysIn_HMI_ADASSetting.ADASSettingInfo_2.VoiceRemindSettingMode SwcIn_SysIn_HMI_ADASSetting.ADASSettingInfo_2.NOPLaneChangeStyle SwcIn_SysIn_HMI_ADASSetting.ADASSettingInfo_2.NOPLaneChangeMod SwcIn_SysIn_HMI_ADASSetting.ADASSettingInfo_2.NOPLaneChangeWarnType SwcIn_SysIn_HMI_ADASSetting.ADASSettingInfo_2.U_NOPEnableBtnSts SwcIn_SysIn_HMI_ADASSetting.ADASSettingInfo_2.HPASettingSt SwcIn_SysIn_HMI_ADASSetting.ADASSettingInfo_2.VPASettingSt SwcIn_SysIn_HMI_ADASSetting.ADASSettingInfo_2.APASettingSt SwcIn_SysIn_HMI_ADASSetting.ADASSettingInfo_2.VoiceRemindSettingSt SwcIn_SysIn_HMI_ADASSetting.ADASSettingInfo_2.DrivingVoiceRemindSettingSt SwcIn_SysIn_HMI_ADASSetting.ADASSettingInfo_2.NRASettingSt SwcIn_SysIn_HMI_ADASSetting.ADASSettingInfo_2.RPASetSettingSt SwcIn_SysIn_HMI_ADASSetting.ADASSettingInfo_2.ParkingSpeedSettingSt SwcIn_SysIn_HMI_ADASSetting.ADASSettingInfo_2.HPACrusingSpeedSettingSt SwcIn_SysIn_HMI_ADASSetting.ADASSettingInfo_2.MEBSwtSet SwcIn_SysIn_HMI_ADASSetting.ADASSettingInfo_2.AMAPSwtSet SwcIn_SysIn_HMI_ADASSetting.ADASSettingInfo_2.MNPEnableBtnSt SwcIn_SysIn_HMI_ADASSetting.ADASSettingInfo_2.LccPlusEnableBtnSt SwcIn_SysIn_HMI_ADASSetting.ADASSettingInfo_2.LKSWarnSensitivity SwcIn_SysIn_HMI_ADASSetting.ADASSettingInfo_2.DAIEnableBtnSt SwcIn_SysIn_HMI_ADASSetting.ADASSettingInfo_2.IHCEnableBtnSt SwcIn_SysIn_HMI_ADASSetting.ADASSettingInfo_2.ISLICruiseSpdOffsetAbd SwcIn_SysIn_HMI_ADASSetting.ADASSettingInfo_2.MNPNewBtnSt SwcIn_SysIn_HMI_ADASSetting.ADASSettingInfo_2.MNPMemRouteQuitBtnSt SwcIn_SysIn_HMI_ADASSetting.ADASSettingInfo_2.MNPUseRouteQuitBtnSt SwcIn_SysIn_HMI_ADASSetting.ADASSettingInfo_2.MNPMemRouteCompleteBtnSt SwcIn_SysIn_HMI_ADASSetting.ADASSettingInfo_2.MNPMemRouteNewName SwcIn_SysIn_HMI_ADASSetting.ADASSettingInfo_2.MNPDelRouteIDBtnSt SwcIn_SysIn_HMI_ADASSetting.ADASSettingInfo_2.MNPUseRouteIDBtnSt SwcIn_SysIn_HMI_ADASSetting.ADASSettingInfo_2.ADASSettingInfoReserved /end REF_MEASUREMENT
/end GROUP
/begin GROUP SwcIn_SysIn_ICC_SDmapInfo ""
 /begin SUB_GROUP SwcIn_SysIn_ICC_SDmapInfo.NtfSDmapNaviStatusInfo SwcIn_SysIn_ICC_SDmapInfo.NtfSDmapNaviRoadInfo /end SUB_GROUP
/end GROUP
/begin GROUP SwcIn_SysIn_ICC_SDmapInfo.NtfSDmapNaviRoadInfo ""
 /begin REF_MEASUREMENT SwcIn_SysIn_ICC_SDmapInfo.NtfSDmapNaviRoadInfo.NaviRoadClass SwcIn_SysIn_ICC_SDmapInfo.NtfSDmapNaviRoadInfo.Navicurrentroadspd SwcIn_SysIn_ICC_SDmapInfo.NtfSDmapNaviRoadInfo.NaviFormWay /end REF_MEASUREMENT
/end GROUP
/begin GROUP SwcIn_SysIn_ICC_SDmapInfo.NtfSDmapNaviStatusInfo ""
 /begin REF_MEASUREMENT SwcIn_SysIn_ICC_SDmapInfo.NtfSDmapNaviStatusInfo.NaviMode SwcIn_SysIn_ICC_SDmapInfo.NtfSDmapNaviStatusInfo.NaviStatus /end REF_MEASUREMENT
/end GROUP
/begin GROUP SwcIn_SysIn_NvM_Read ""
 /begin REF_MEASUREMENT SwcIn_SysIn_NvM_Read.NOHOnOff SwcIn_SysIn_NvM_Read.NOHActReq SwcIn_SysIn_NvM_Read.LDWOnOff SwcIn_SysIn_NvM_Read.LKAOnOff SwcIn_SysIn_NvM_Read.ELKOnOff SwcIn_SysIn_NvM_Read.ESSOnOff SwcIn_SysIn_NvM_Read.AESOnOff SwcIn_SysIn_NvM_Read.LCKIEOnOff SwcIn_SysIn_NvM_Read.ISLOnOff SwcIn_SysIn_NvM_Read.IntellgntCurveOnOff SwcIn_SysIn_NvM_Read.FCWOnOff SwcIn_SysIn_NvM_Read.AEBOnOff SwcIn_SysIn_NvM_Read.DAIOnOff SwcIn_SysIn_NvM_Read.SpeedLmtNumberAbs SwcIn_SysIn_NvM_Read.SpeedLmtNumberPerct SwcIn_SysIn_NvM_Read.SpeedLmtSnvtyMod SwcIn_SysIn_NvM_Read.IHCOnOff SwcIn_SysIn_NvM_Read.ICAOnOff SwcIn_SysIn_NvM_Read.SLAOnOff SwcIn_SysIn_NvM_Read.SLAWarnMod SwcIn_SysIn_NvM_Read.LASSnvtySet SwcIn_SysIn_NvM_Read.LASWarnFormSwtReq SwcIn_SysIn_NvM_Read.TSROnOff SwcIn_SysIn_NvM_Read.TLIOnOff SwcIn_SysIn_NvM_Read.ALCSet SwcIn_SysIn_NvM_Read.DCLCSet SwcIn_SysIn_NvM_Read.ALCSnvtySet SwcIn_SysIn_NvM_Read.FCWSnvty SwcIn_SysIn_NvM_Read.VoiceRemindType SwcIn_SysIn_NvM_Read.TJAICAExitTextInfoONOFF SwcIn_SysIn_NvM_Read.SpeedLimitOnOff SwcIn_SysIn_NvM_Read.SPL_noSupp_Value_Init SwcIn_SysIn_NvM_Read.SPL_whSupp_Value_Init SwcIn_SysIn_NvM_Read.TS_SignName_Value_Init SwcIn_SysIn_NvM_Read.SPL_SuppName_Value_Init SwcIn_SysIn_NvM_Read.SysOut_TimeGapInit SwcIn_SysIn_NvM_Read.SysOut_ACCStsInit SwcIn_SysIn_NvM_Read.SysOut_ICASStsInit SwcIn_SysIn_NvM_Read.Uint8_Reserve SwcIn_SysIn_NvM_Read.SysOut_SteerAngOffsetInit SwcIn_SysIn_NvM_Read.SPL_noSupp_Dist_Init SwcIn_SysIn_NvM_Read.SPL_whSupp_Dist_Init SwcIn_SysIn_NvM_Read.TS_SignName_Dist_Init SwcIn_SysIn_NvM_Read.Reserve /end REF_MEASUREMENT
/end GROUP
/begin GROUP SwcIn_TCM_1 "" /begin REF_MEASUREMENT SwcIn_TCM_1.TCM_1_TrailerSts /end REF_MEASUREMENT /end GROUP
/begin GROUP SwcIn_TMS_1 ""
 /begin REF_MEASUREMENT SwcIn_TMS_1.ExternalTemperature_C SwcIn_TMS_1.ExternalTemperatureFailSts /end REF_MEASUREMENT
/end GROUP
/begin GROUP SwcIn_VAL_MemSet_TSRInit ""
 /begin REF_MEASUREMENT SwcIn_VAL_MemSet_TSRInit.SPL_noSupp_Value_Init SwcIn_VAL_MemSet_TSRInit.SPL_whSupp_Value_Init SwcIn_VAL_MemSet_TSRInit.TS_SignName_Value_Init SwcIn_VAL_MemSet_TSRInit.SPL_SuppName_Value_Init SwcIn_VAL_MemSet_TSRInit.SPL_noSupp_Dist_Init SwcIn_VAL_MemSet_TSRInit.SPL_whSupp_Dist_Init SwcIn_VAL_MemSet_TSRInit.TS_SignName_Dist_Init /end REF_MEASUREMENT
/end GROUP
/begin GROUP SwcIn_VCC_1 "" /begin REF_MEASUREMENT SwcIn_VCC_1.VCC_1_CarMode SwcIn_VCC_1.VCC_1_DriveMode /end REF_MEASUREMENT /end GROUP
/begin GROUP SwcIn_VCC_2 "" /begin REF_MEASUREMENT SwcIn_VCC_2.VCC_2_ConfigurationMessageTrg /end REF_MEASUREMENT /end GROUP
/begin GROUP SwcIn_VCC_3 ""
 /begin REF_MEASUREMENT SwcIn_VCC_3.VCC_3_CRC SwcIn_VCC_3.VCC_3_RollgCntr SwcIn_VCC_3.VCC_3_SN /end REF_MEASUREMENT
/end GROUP
/begin GROUP SwcIn_VCU_1_G ""
 /begin REF_MEASUREMENT SwcIn_VCU_1_G.VCU_1_G_CRC SwcIn_VCU_1_G.VCU_1_G_RollgCntr SwcIn_VCU_1_G.VCU_1_G_Resd SwcIn_VCU_1_G.VCU_DriveMode SwcIn_VCU_1_G.VCU_AcceleratorPosRaw /end REF_MEASUREMENT
/end GROUP
/begin GROUP SwcIn_VCU_2_G ""
 /begin REF_MEASUREMENT SwcIn_VCU_2_G.VCU_2_G_CRC SwcIn_VCU_2_G.VCU_2_G_RollgCntr SwcIn_VCU_2_G.VCU_2_G_Resd SwcIn_VCU_2_G.VCU_GasPedalPosition SwcIn_VCU_2_G.VCU_GasPedalPositionInvalidData SwcIn_VCU_2_G.VCU_HVReady /end REF_MEASUREMENT
/end GROUP
/begin GROUP SwcIn_VCU_3_G ""
 /begin REF_MEASUREMENT SwcIn_VCU_3_G.VCU_ActWheelTorqueFA SwcIn_VCU_3_G.VCU_ActWheelTorqueRA /end REF_MEASUREMENT
/end GROUP
/begin GROUP SwcIn_VCU_4_G "" /begin REF_MEASUREMENT SwcIn_VCU_4_G.VCU_DynamicRangeAval /end REF_MEASUREMENT /end GROUP
/begin GROUP SwcIn_VCU_ADCC_12 ""
 /begin REF_MEASUREMENT SwcIn_VCU_ADCC_12.VCU_12_CRC1 SwcIn_VCU_ADCC_12.VCU_12_RollgCntr1 SwcIn_VCU_ADCC_12.VCU_12_Resd1 SwcIn_VCU_ADCC_12.VCU_12_DrvrGearIntervention SwcIn_VCU_ADCC_12.VCU_12_PtTqActvSts SwcIn_VCU_ADCC_12.VCU_12_PtTqAvl SwcIn_VCU_ADCC_12.VCU_12_DriverTorqueDesired SwcIn_VCU_ADCC_12.VCU_12_DrvrAccrPedlOvrd SwcIn_VCU_ADCC_12.VCU_12_VehWhlActTq SwcIn_VCU_ADCC_12.VCU_12_VehWhlActTqVld SwcIn_VCU_ADCC_12.VCU_12_CRC2 SwcIn_VCU_ADCC_12.VCU_12_RollgCntr2 SwcIn_VCU_ADCC_12.VCU_12_Resd2 SwcIn_VCU_ADCC_12.VCU_12_PtTqMax SwcIn_VCU_ADCC_12.VCU_12_PtTqMaxVld SwcIn_VCU_ADCC_12.VCU_12_GasPedalInhabition SwcIn_VCU_ADCC_12.VCU_12_CRC3 SwcIn_VCU_ADCC_12.VCU_12_RollgCntr3 SwcIn_VCU_ADCC_12.VCU_12_Resd3 SwcIn_VCU_ADCC_12.VCU_12_VehWhlActTqADS SwcIn_VCU_ADCC_12.VCU_12_VehWhlActTqADSVld /end REF_MEASUREMENT
/end GROUP
/begin GROUP SwcIn_VCU_COM_10 ""
 /begin REF_MEASUREMENT SwcIn_VCU_COM_10.VCU_10_CRC SwcIn_VCU_COM_10.VCU_10_RollgCntr SwcIn_VCU_COM_10.VCU_10_Resd SwcIn_VCU_COM_10.VCU_TargetGear SwcIn_VCU_COM_10.VCU_ActualGear SwcIn_VCU_COM_10.VCU_TargetGearValidData SwcIn_VCU_COM_10.VCU_ActualGearValidData SwcIn_VCU_COM_10.VCU_BrakePedalStsValidData SwcIn_VCU_COM_10.VCU_BrakePedalSts /end REF_MEASUREMENT
/end GROUP
/begin GROUP SwcIn_VCU_ONEBOX_11 ""
 /begin REF_MEASUREMENT SwcIn_VCU_ONEBOX_11.VCU_11_CRC1 SwcIn_VCU_ONEBOX_11.VCU_11_RollgCntr1 SwcIn_VCU_ONEBOX_11.VCU_11_Resd1 SwcIn_VCU_ONEBOX_11.VCU_IndicatedDriverReqWhlTqFA SwcIn_VCU_ONEBOX_11.VCU_ActWheelSpdFA SwcIn_VCU_ONEBOX_11.VCU_11_CRC2 SwcIn_VCU_ONEBOX_11.VCU_11_RollgCntr2 SwcIn_VCU_ONEBOX_11.VCU_11_Resd2 SwcIn_VCU_ONEBOX_11.VCU_IndcdDriverReqWhlTqStsFA SwcIn_VCU_ONEBOX_11.VCU_ActWheelTorqueStsFA SwcIn_VCU_ONEBOX_11.VCU_ActWheelSpdStsFA SwcIn_VCU_ONEBOX_11.VCU_IndicatedDriverReqWhlTqRA SwcIn_VCU_ONEBOX_11.VCU_11_CRC3 SwcIn_VCU_ONEBOX_11.VCU_11_RollgCntr3 SwcIn_VCU_ONEBOX_11.VCU_11_Resd3 SwcIn_VCU_ONEBOX_11.VCU_ActWheelSpdRA SwcIn_VCU_ONEBOX_11.VCU_IndcdDriverReqWhlTqStsRA SwcIn_VCU_ONEBOX_11.VCU_ActWheelTorqueStsRA SwcIn_VCU_ONEBOX_11.VCU_ActWheelSpdStsRA SwcIn_VCU_ONEBOX_11.VCU_11_CRC4 SwcIn_VCU_ONEBOX_11.VCU_11_RollgCntr4 SwcIn_VCU_ONEBOX_11.VCU_11_Resd4 SwcIn_VCU_ONEBOX_11.VCU_GasPedalPositionInvalidData SwcIn_VCU_ONEBOX_11.VCU_AcceleratorPosRawIVD SwcIn_VCU_ONEBOX_11.VCU_GasPedalPosition SwcIn_VCU_ONEBOX_11.VCU_AcceleratorPosRaw /end REF_MEASUREMENT
/end GROUP
/begin GROUP SwcOut_ADS_COM_2 ""
 /begin REF_MEASUREMENT SwcOut_ADS_COM_2.ADS_2_CRC1 SwcOut_ADS_COM_2.ADS_2_RollgCntr1 SwcOut_ADS_COM_2.ADS_2_Resd1 SwcOut_ADS_COM_2.ADS_2_FunctionSuppressReq SwcOut_ADS_COM_2.ADS_2_HWRequest SwcOut_ADS_COM_2.ADS_2_PP_M_Request SwcOut_ADS_COM_2.ADS_2_AEBStatus SwcOut_ADS_COM_2.ADS_2_ClosingSpeed SwcOut_ADS_COM_2.ADS_2_TTC SwcOut_ADS_COM_2.ADS_2_Object SwcOut_ADS_COM_2.ADS_2_Object_Status SwcOut_ADS_COM_2.ADS_2_FCWStatus SwcOut_ADS_COM_2.FCM_2_SysStatus SwcOut_ADS_COM_2.FCM_2_IHCfunctionSts SwcOut_ADS_COM_2.FCM_2_HazardLightReq SwcOut_ADS_COM_2.FCM_2_HighBeamReq_Cmd /end REF_MEASUREMENT
/end GROUP
/begin GROUP SwcOut_ADS_COM_3 ""
 /begin REF_MEASUREMENT SwcOut_ADS_COM_3.ADS_3_CRC1 SwcOut_ADS_COM_3.ADS_3_RollgCntr1 SwcOut_ADS_COM_3.ADS_3_Resd1 SwcOut_ADS_COM_3.ADS_3_ICAStatus SwcOut_ADS_COM_3.ADS_3_ICATextinfo SwcOut_ADS_COM_3.ADS_3_ACCSts SwcOut_ADS_COM_3.ADS_3_DriverHandsoffWarning SwcOut_ADS_COM_3.ADS_3_AESStatus SwcOut_ADS_COM_3.ADS_3_LKSMod SwcOut_ADS_COM_3.ADS_3_LKSSts SwcOut_ADS_COM_3.ADS_3_ELKSts SwcOut_ADS_COM_3.ADS_3_LKSLeftTrackingSt SwcOut_ADS_COM_3.ADS_3_LKSRightTrackingSt SwcOut_ADS_COM_3.ADS_3_ELKLeftActiveSt SwcOut_ADS_COM_3.ADS_3_ELKRightActiveSt SwcOut_ADS_COM_3.ADS_3_RearViewFoldReq SwcOut_ADS_COM_3.ADS_3_CRC2 SwcOut_ADS_COM_3.ADS_3_RollgCntr2 SwcOut_ADS_COM_3.ADS_3_Resd2 SwcOut_ADS_COM_3.ADS_ALCSts SwcOut_ADS_COM_3.ADS_HNOPSts SwcOut_ADS_COM_3.ADS_UNOPSts SwcOut_ADS_COM_3.ADAS_ParkingActiveSubFuncSt /end REF_MEASUREMENT
/end GROUP
/begin GROUP SwcOut_ADS_EPS_1 ""
 /begin REF_MEASUREMENT SwcOut_ADS_EPS_1.ADS_1_CRC1 SwcOut_ADS_EPS_1.ADS_1_RollgCntr1 SwcOut_ADS_EPS_1.ADS_1_Resd1 SwcOut_ADS_EPS_1.ADS_1_SteerAgReq SwcOut_ADS_EPS_1.ADS_1_SteerAgVld SwcOut_ADS_EPS_1.ADS_1_SteerPilotAgEna SwcOut_ADS_EPS_1.ADS_1_CRC2 SwcOut_ADS_EPS_1.ADS_1_RollgCntr2 SwcOut_ADS_EPS_1.ADS_1_Resd2 SwcOut_ADS_EPS_1.ADS_1_SteerTqEna SwcOut_ADS_EPS_1.ADS_1_LdwWarningCmd SwcOut_ADS_EPS_1.ADS_1_LdwWarningCmdVld SwcOut_ADS_EPS_1.ADS_1_SteerMaxTqReq SwcOut_ADS_EPS_1.ADS_1_SteerMinTqReq SwcOut_ADS_EPS_1.ADS_1_ADSHealthSts SwcOut_ADS_EPS_1.CutOutFreshvalues_2CB_S SwcOut_ADS_EPS_1.CutOutMAC_2CB_S /end REF_MEASUREMENT
/end GROUP
/begin GROUP SwcOut_ADS_ONEBOX_2 ""
 /begin REF_MEASUREMENT SwcOut_ADS_ONEBOX_2.FCM_2_CRC1 SwcOut_ADS_ONEBOX_2.FCM_2_RollgCntr1 SwcOut_ADS_ONEBOX_2.FCM_2_Resd1 SwcOut_ADS_ONEBOX_2.FCM_2_AebReqTyp SwcOut_ADS_ONEBOX_2.FCM_2_AebTarDec SwcOut_ADS_ONEBOX_2.FCM_2_AebTarDecVld SwcOut_ADS_ONEBOX_2.FCM_2_AwbReq SwcOut_ADS_ONEBOX_2.FCM_2_AwbLvl SwcOut_ADS_ONEBOX_2.FCM_2_BrkPreFillReq SwcOut_ADS_ONEBOX_2.FCM_2_AbaReq SwcOut_ADS_ONEBOX_2.FCM_2_AbaLvl SwcOut_ADS_ONEBOX_2.FCM_2_Avl /end REF_MEASUREMENT
/end GROUP
/begin GROUP SwcOut_ADS_ONEBOX_3 ""
 /begin REF_MEASUREMENT SwcOut_ADS_ONEBOX_3.FCM_3_CRC1 SwcOut_ADS_ONEBOX_3.FCM_3_RollgCntr1 SwcOut_ADS_ONEBOX_3.FCM_3_Resd1 SwcOut_ADS_ONEBOX_3.FCM_3_PilotParkCtrlRepSta SwcOut_ADS_ONEBOX_3.FCM_3_PilotCtrlType SwcOut_ADS_ONEBOX_3.FCM_3_PilotkBrkDecTar SwcOut_ADS_ONEBOX_3.FCM_3_PilotBrkDecTarVld SwcOut_ADS_ONEBOX_3.FCM_3_PilotBrkDecTarReq SwcOut_ADS_ONEBOX_3.FCM_3_PilotDec2StpReq SwcOut_ADS_ONEBOX_3.FCM_3_PilotDriOffReq SwcOut_ADS_ONEBOX_3.CutOutFreshvalues_2CB_S SwcOut_ADS_ONEBOX_3.CutOutMAC_2CB_S /end REF_MEASUREMENT
/end GROUP
/begin GROUP SwcOut_ADS_VCU_1 ""
 /begin REF_MEASUREMENT SwcOut_ADS_VCU_1.ADS_1_CRC1 SwcOut_ADS_VCU_1.ADS_1_RollgCntr1 SwcOut_ADS_VCU_1.ADS_1_Resd1 SwcOut_ADS_VCU_1.ADS_1_DrvTarTq SwcOut_ADS_VCU_1.ADS_1_DrvTarTqVld SwcOut_ADS_VCU_1.ADS_1_DrvCtrlReq SwcOut_ADS_VCU_1.ADS_1_CtrlReqMod SwcOut_ADS_VCU_1.ADS_1_DrvTarTqEnable SwcOut_ADS_VCU_1.ADS_1_AMAPRequest SwcOut_ADS_VCU_1.ADS_1_AMAPRequestVld SwcOut_ADS_VCU_1.ADS_1_ADCCAvl SwcOut_ADS_VCU_1.ADS_1_AMAPTqLimit SwcOut_ADS_VCU_1.ADS_1_AMAPTqLimitVld SwcOut_ADS_VCU_1.ADS_1_CRC2 SwcOut_ADS_VCU_1.ADS_1_RollgCntr2 SwcOut_ADS_VCU_1.ADS_1_Resd2 SwcOut_ADS_VCU_1.ADS_1_TarGearReq SwcOut_ADS_VCU_1.ADS_1_TarGearReqVld SwcOut_ADS_VCU_1.ADS_1_GearCtrlEnable SwcOut_ADS_VCU_1.ADS_1_RpaPTReadyReq /end REF_MEASUREMENT
/end GROUP
/begin GROUP SwcOut_Diag_FCM_RES "" /begin REF_MEASUREMENT SwcOut_Diag_FCM_RES.Diag_FCM_RES /end REF_MEASUREMENT /end GROUP
/begin GROUP SwcOut_FCM_ActiveSafetyInfo ""
 /begin SUB_GROUP SwcOut_FCM_ActiveSafetyInfo.ActiveSafetyFcnInfo SwcOut_FCM_ActiveSafetyInfo.AEBTargetObjInfo SwcOut_FCM_ActiveSafetyInfo.ActiveSafetyFcnInfo_2 /end SUB_GROUP
/end GROUP
/begin GROUP SwcOut_FCM_ActiveSafetyInfo.AEBTargetObjInfo ""
 /begin REF_MEASUREMENT SwcOut_FCM_ActiveSafetyInfo.AEBTargetObjInfo.TargetObjID SwcOut_FCM_ActiveSafetyInfo.AEBTargetObjInfo.TargetObjColor SwcOut_FCM_ActiveSafetyInfo.AEBTargetObjInfo.TargetObjType SwcOut_FCM_ActiveSafetyInfo.AEBTargetObjInfo.TargetObjPosX SwcOut_FCM_ActiveSafetyInfo.AEBTargetObjInfo.TargetObjPosY SwcOut_FCM_ActiveSafetyInfo.AEBTargetObjInfo.TargetObjSpdX /end REF_MEASUREMENT
/end GROUP
/begin GROUP SwcOut_FCM_ActiveSafetyInfo.ActiveSafetyFcnInfo ""
 /begin REF_MEASUREMENT SwcOut_FCM_ActiveSafetyInfo.ActiveSafetyFcnInfo.FcwSts SwcOut_FCM_ActiveSafetyInfo.ActiveSafetyFcnInfo.AebSts SwcOut_FCM_ActiveSafetyInfo.ActiveSafetyFcnInfo.FcwWarnDist SwcOut_FCM_ActiveSafetyInfo.ActiveSafetyFcnInfo.FcwAcitveSt SwcOut_FCM_ActiveSafetyInfo.ActiveSafetyFcnInfo.AebAcitveSt /end REF_MEASUREMENT
/end GROUP
/begin GROUP SwcOut_FCM_ActiveSafetyInfo.ActiveSafetyFcnInfo_2 ""
 /begin REF_MEASUREMENT SwcOut_FCM_ActiveSafetyInfo.ActiveSafetyFcnInfo_2.FcwSts SwcOut_FCM_ActiveSafetyInfo.ActiveSafetyFcnInfo_2.AebSts SwcOut_FCM_ActiveSafetyInfo.ActiveSafetyFcnInfo_2.FcwWarnDist SwcOut_FCM_ActiveSafetyInfo.ActiveSafetyFcnInfo_2.FcwAcitveSt SwcOut_FCM_ActiveSafetyInfo.ActiveSafetyFcnInfo_2.AebAcitveSt SwcOut_FCM_ActiveSafetyInfo.ActiveSafetyFcnInfo_2.FCWAEBTextInfomation /end REF_MEASUREMENT
/end GROUP
/begin GROUP SwcOut_FCM_DVRSts ""
 /begin REF_MEASUREMENT SwcOut_FCM_DVRSts.DVRSts SwcOut_FCM_DVRSts.DVRcameraSts SwcOut_FCM_DVRSts.CameraInterParm /end REF_MEASUREMENT
/end GROUP
/begin GROUP SwcOut_FCM_DrivingFuncInfo ""
 /begin SUB_GROUP SwcOut_FCM_DrivingFuncInfo.TrafficSign SwcOut_FCM_DrivingFuncInfo.ISLIInfo SwcOut_FCM_DrivingFuncInfo.ACCInfo SwcOut_FCM_DrivingFuncInfo.ICAInfo SwcOut_FCM_DrivingFuncInfo.IntelligentEvasionInfo SwcOut_FCM_DrivingFuncInfo.HodDmsInfo SwcOut_FCM_DrivingFuncInfo.LSSInfo SwcOut_FCM_DrivingFuncInfo.ESSInfo SwcOut_FCM_DrivingFuncInfo.DAIInfo SwcOut_FCM_DrivingFuncInfo.ISLIinfo_2 SwcOut_FCM_DrivingFuncInfo.LSSInfo_2 SwcOut_FCM_DrivingFuncInfo.DrivingSoundInfo SwcOut_FCM_DrivingFuncInfo.IHCInfo SwcOut_FCM_DrivingFuncInfo.HNOPfunctionInfo /end SUB_GROUP
/end GROUP
/begin GROUP SwcOut_FCM_DrivingFuncInfo.ACCInfo ""
 /begin REF_MEASUREMENT SwcOut_FCM_DrivingFuncInfo.ACCInfo.ACCSts SwcOut_FCM_DrivingFuncInfo.ACCInfo.AutoResumeNotifier SwcOut_FCM_DrivingFuncInfo.ACCInfo.SetSpeed SwcOut_FCM_DrivingFuncInfo.ACCInfo.SetSpeedUnit SwcOut_FCM_DrivingFuncInfo.ACCInfo.TimeGapSet SwcOut_FCM_DrivingFuncInfo.ACCInfo.LongitudinalTakeOverRequest SwcOut_FCM_DrivingFuncInfo.ACCInfo.ACCGoNotifier SwcOut_FCM_DrivingFuncInfo.ACCInfo.ACCTextMessage SwcOut_FCM_DrivingFuncInfo.ACCInfo.ACCQuitReason SwcOut_FCM_DrivingFuncInfo.ACCInfo.FSRACruiseSpdModFb SwcOut_FCM_DrivingFuncInfo.ACCInfo.FSRACruiseSpdOffsetModFb SwcOut_FCM_DrivingFuncInfo.ACCInfo.SetACCSetSpdOffset SwcOut_FCM_DrivingFuncInfo.ACCInfo.SetACCSetSpdPercOffset SwcOut_FCM_DrivingFuncInfo.ACCInfo.ACCholdSts SwcOut_FCM_DrivingFuncInfo.ACCInfo.FSRASpdSetMod SwcOut_FCM_DrivingFuncInfo.ACCInfo.FDMSt SwcOut_FCM_DrivingFuncInfo.ACCInfo.FDMDist SwcOut_FCM_DrivingFuncInfo.ACCInfo.CruiseAccelerateSts /end REF_MEASUREMENT
/end GROUP
/begin GROUP SwcOut_FCM_DrivingFuncInfo.DAIInfo ""
 /begin REF_MEASUREMENT SwcOut_FCM_DrivingFuncInfo.DAIInfo.DAISts SwcOut_FCM_DrivingFuncInfo.DAIInfo.DAIReminder /end REF_MEASUREMENT
/end GROUP
/begin GROUP SwcOut_FCM_DrivingFuncInfo.DrivingSoundInfo ""
 /begin REF_MEASUREMENT SwcOut_FCM_DrivingFuncInfo.DrivingSoundInfo.DrivingSoundWarn /end REF_MEASUREMENT
/end GROUP
/begin GROUP SwcOut_FCM_DrivingFuncInfo.ESSInfo ""
 /begin REF_MEASUREMENT SwcOut_FCM_DrivingFuncInfo.ESSInfo.ESSSts SwcOut_FCM_DrivingFuncInfo.ESSInfo.ESSDirection SwcOut_FCM_DrivingFuncInfo.ESSInfo.AESSts SwcOut_FCM_DrivingFuncInfo.ESSInfo.AESDirection /end REF_MEASUREMENT
/end GROUP
/begin GROUP SwcOut_FCM_DrivingFuncInfo.HNOPfunctionInfo ""
 /begin REF_MEASUREMENT SwcOut_FCM_DrivingFuncInfo.HNOPfunctionInfo.NOPDegradeReminder /end REF_MEASUREMENT
/end GROUP
/begin GROUP SwcOut_FCM_DrivingFuncInfo.HodDmsInfo ""
 /begin REF_MEASUREMENT SwcOut_FCM_DrivingFuncInfo.HodDmsInfo.DriverhandsoffWarning SwcOut_FCM_DrivingFuncInfo.HodDmsInfo.DMSWarning SwcOut_FCM_DrivingFuncInfo.HodDmsInfo.HandsOnReq SwcOut_FCM_DrivingFuncInfo.HodDmsInfo.HODWarnSettingStFb /end REF_MEASUREMENT
/end GROUP
/begin GROUP SwcOut_FCM_DrivingFuncInfo.ICAInfo ""
 /begin REF_MEASUREMENT SwcOut_FCM_DrivingFuncInfo.ICAInfo.ICASts SwcOut_FCM_DrivingFuncInfo.ICAInfo.ICATextInfo SwcOut_FCM_DrivingFuncInfo.ICAInfo.ICAQuitReason SwcOut_FCM_DrivingFuncInfo.ICAInfo.ICASenarioReminder /end REF_MEASUREMENT
/end GROUP
/begin GROUP SwcOut_FCM_DrivingFuncInfo.IHCInfo ""
 /begin REF_MEASUREMENT SwcOut_FCM_DrivingFuncInfo.IHCInfo.IHC_Status SwcOut_FCM_DrivingFuncInfo.IHCInfo.IHCTextInfomation /end REF_MEASUREMENT
/end GROUP
/begin GROUP SwcOut_FCM_DrivingFuncInfo.ISLIInfo ""
 /begin REF_MEASUREMENT SwcOut_FCM_DrivingFuncInfo.ISLIInfo.ISLISt SwcOut_FCM_DrivingFuncInfo.ISLIInfo.ISLISpeedLimitSign SwcOut_FCM_DrivingFuncInfo.ISLIInfo.ISLISpeedLimitUnit SwcOut_FCM_DrivingFuncInfo.ISLIInfo.ISLIOverSpeedWarn SwcOut_FCM_DrivingFuncInfo.ISLIInfo.ISLIWarningModFb SwcOut_FCM_DrivingFuncInfo.ISLIInfo.ISLISpdLimType SwcOut_FCM_DrivingFuncInfo.ISLIInfo.ISLICruiseSpdAbsOffsetFb SwcOut_FCM_DrivingFuncInfo.ISLIInfo.ISLICruiseSpdRelOffsetFb /end REF_MEASUREMENT
/end GROUP
/begin GROUP SwcOut_FCM_DrivingFuncInfo.ISLIinfo_2 ""
 /begin REF_MEASUREMENT SwcOut_FCM_DrivingFuncInfo.ISLIinfo_2.ISLISt SwcOut_FCM_DrivingFuncInfo.ISLIinfo_2.ISLISpeedLimitSign SwcOut_FCM_DrivingFuncInfo.ISLIinfo_2.ISLISpeedLimitUnit SwcOut_FCM_DrivingFuncInfo.ISLIinfo_2.ISLIOverSpeedWarn SwcOut_FCM_DrivingFuncInfo.ISLIinfo_2.ISLIWarningModFb SwcOut_FCM_DrivingFuncInfo.ISLIinfo_2.ISLISpdLimType SwcOut_FCM_DrivingFuncInfo.ISLIinfo_2.ISLICruiseSpdAbsOffsetFb SwcOut_FCM_DrivingFuncInfo.ISLIinfo_2.ISLICruiseSpdRelOffsetFb SwcOut_FCM_DrivingFuncInfo.ISLIinfo_2.ISLISpdOffsetMod SwcOut_FCM_DrivingFuncInfo.ISLIinfo_2.ISLICruiseSpdOffsetAbs SwcOut_FCM_DrivingFuncInfo.ISLIinfo_2.ISLITextInfomation /end REF_MEASUREMENT
/end GROUP
/begin GROUP SwcOut_FCM_DrivingFuncInfo.IntelligentEvasionInfo ""
 /begin REF_MEASUREMENT SwcOut_FCM_DrivingFuncInfo.IntelligentEvasionInfo.iLOASts SwcOut_FCM_DrivingFuncInfo.IntelligentEvasionInfo.iLOAActdirection SwcOut_FCM_DrivingFuncInfo.IntelligentEvasionInfo.iLOATextInfo /end REF_MEASUREMENT
/end GROUP
/begin GROUP SwcOut_FCM_DrivingFuncInfo.LSSInfo ""
 /begin REF_MEASUREMENT SwcOut_FCM_DrivingFuncInfo.LSSInfo.LKSSts SwcOut_FCM_DrivingFuncInfo.LSSInfo.LKSMod SwcOut_FCM_DrivingFuncInfo.LSSInfo.ELKSts SwcOut_FCM_DrivingFuncInfo.LSSInfo.LKSLeftTrackingSt SwcOut_FCM_DrivingFuncInfo.LSSInfo.LKSRightTrackingSt SwcOut_FCM_DrivingFuncInfo.LSSInfo.ELKLeftActiveSt SwcOut_FCM_DrivingFuncInfo.LSSInfo.ELKRightActiveSt SwcOut_FCM_DrivingFuncInfo.LSSInfo.LKSwarning /end REF_MEASUREMENT
/end GROUP
/begin GROUP SwcOut_FCM_DrivingFuncInfo.LSSInfo_2 ""
 /begin REF_MEASUREMENT SwcOut_FCM_DrivingFuncInfo.LSSInfo_2.LKSSts SwcOut_FCM_DrivingFuncInfo.LSSInfo_2.LKSMod SwcOut_FCM_DrivingFuncInfo.LSSInfo_2.ELKSts SwcOut_FCM_DrivingFuncInfo.LSSInfo_2.LKSLeftTrackingSt SwcOut_FCM_DrivingFuncInfo.LSSInfo_2.LKSRightTrackingSt SwcOut_FCM_DrivingFuncInfo.LSSInfo_2.ELKLeftActiveSt SwcOut_FCM_DrivingFuncInfo.LSSInfo_2.ELKRightActiveSt SwcOut_FCM_DrivingFuncInfo.LSSInfo_2.LKSwarning SwcOut_FCM_DrivingFuncInfo.LSSInfo_2.LKSWarnSensitivity SwcOut_FCM_DrivingFuncInfo.LSSInfo_2.LSSTextInfomation /end REF_MEASUREMENT
/end GROUP
/begin GROUP SwcOut_FCM_DrivingFuncInfo.TrafficSign ""
 /begin REF_MEASUREMENT SwcOut_FCM_DrivingFuncInfo.TrafficSign.TSRSt SwcOut_FCM_DrivingFuncInfo.TrafficSign.TrafficSignId SwcOut_FCM_DrivingFuncInfo.TrafficSign.TrafficSignType SwcOut_FCM_DrivingFuncInfo.TrafficSign.TrafficSignPosX SwcOut_FCM_DrivingFuncInfo.TrafficSign.TrafficSignPosY SwcOut_FCM_DrivingFuncInfo.TrafficSign.TrafficSignPosZ /end REF_MEASUREMENT
/end GROUP
/begin GROUP SwcOut_FCM_DrivingHmiEnv "" /begin SUB_GROUP SwcOut_FCM_DrivingHmiEnv.EgoFusionPose /end SUB_GROUP /begin REF_MEASUREMENT /end REF_MEASUREMENT /end GROUP
/begin GROUP SwcOut_FCM_DrivingHmiEnv.DynamicObjectList[0] ""
 /begin REF_MEASUREMENT SwcOut_FCM_DrivingHmiEnv.DynamicObjectList[0].objectId SwcOut_FCM_DrivingHmiEnv.DynamicObjectList[0].objectType SwcOut_FCM_DrivingHmiEnv.DynamicObjectList[0].lightStatus SwcOut_FCM_DrivingHmiEnv.DynamicObjectList[0].objectPoseX SwcOut_FCM_DrivingHmiEnv.DynamicObjectList[0].objectPoseY SwcOut_FCM_DrivingHmiEnv.DynamicObjectList[0].objectYaw SwcOut_FCM_DrivingHmiEnv.DynamicObjectList[0].objectColor SwcOut_FCM_DrivingHmiEnv.DynamicObjectList[0].objectVelocityX SwcOut_FCM_DrivingHmiEnv.DynamicObjectList[0].objectVelocityY SwcOut_FCM_DrivingHmiEnv.DynamicObjectList[0].timestampnSec SwcOut_FCM_DrivingHmiEnv.DynamicObjectList[0].laneID /end REF_MEASUREMENT
/end GROUP
/begin GROUP SwcOut_FCM_DrivingHmiEnv.EgoFusionPose ""
 /begin REF_MEASUREMENT SwcOut_FCM_DrivingHmiEnv.EgoFusionPose.altitude SwcOut_FCM_DrivingHmiEnv.EgoFusionPose.heading SwcOut_FCM_DrivingHmiEnv.EgoFusionPose.vehicleSpeed SwcOut_FCM_DrivingHmiEnv.EgoFusionPose.FusionlocalizationSD SwcOut_FCM_DrivingHmiEnv.EgoFusionPose.altitudeSD SwcOut_FCM_DrivingHmiEnv.EgoFusionPose.headingSD SwcOut_FCM_DrivingHmiEnv.EgoFusionPose.vehicleSpeedSD SwcOut_FCM_DrivingHmiEnv.EgoFusionPose.timestampmSec SwcOut_FCM_DrivingHmiEnv.EgoFusionPose.longitude SwcOut_FCM_DrivingHmiEnv.EgoFusionPose.latitude /end REF_MEASUREMENT
/end GROUP
/begin GROUP SwcOut_FCM_DrivingHmiEnv.LaneLineList_2[0] ""
 /begin REF_MEASUREMENT SwcOut_FCM_DrivingHmiEnv.LaneLineList_2[0].lineIndex SwcOut_FCM_DrivingHmiEnv.LaneLineList_2[0].lineId SwcOut_FCM_DrivingHmiEnv.LaneLineList_2[0].lineColor SwcOut_FCM_DrivingHmiEnv.LaneLineList_2[0].lineType SwcOut_FCM_DrivingHmiEnv.LaneLineList_2[0].lineEquation_C0 SwcOut_FCM_DrivingHmiEnv.LaneLineList_2[0].lineEquation_C1 SwcOut_FCM_DrivingHmiEnv.LaneLineList_2[0].lineEquation_C2 SwcOut_FCM_DrivingHmiEnv.LaneLineList_2[0].lineEquation_C3 SwcOut_FCM_DrivingHmiEnv.LaneLineList_2[0].laneLineWidth SwcOut_FCM_DrivingHmiEnv.LaneLineList_2[0].lineStart_X SwcOut_FCM_DrivingHmiEnv.LaneLineList_2[0].lineStart_Y SwcOut_FCM_DrivingHmiEnv.LaneLineList_2[0].lineEnd_X SwcOut_FCM_DrivingHmiEnv.LaneLineList_2[0].lineEnd_Y /end REF_MEASUREMENT
/end GROUP
/begin GROUP SwcOut_FCM_DrivingHmiEnv.StaticObjectList[0] ""
 /begin REF_MEASUREMENT SwcOut_FCM_DrivingHmiEnv.StaticObjectList[0].objectId SwcOut_FCM_DrivingHmiEnv.StaticObjectList[0].objectType SwcOut_FCM_DrivingHmiEnv.StaticObjectList[0].objectPoseX SwcOut_FCM_DrivingHmiEnv.StaticObjectList[0].objectPoseY SwcOut_FCM_DrivingHmiEnv.StaticObjectList[0].objectYaw SwcOut_FCM_DrivingHmiEnv.StaticObjectList[0].objectLength SwcOut_FCM_DrivingHmiEnv.StaticObjectList[0].objecWidth SwcOut_FCM_DrivingHmiEnv.StaticObjectList[0].timestampnSec SwcOut_FCM_DrivingHmiEnv.StaticObjectList[0].laneID /end REF_MEASUREMENT
/end GROUP
/begin GROUP SwcOut_FCM_RemoteDiag ""
 /begin REF_MEASUREMENT SwcOut_FCM_RemoteDiag.FCM_TotalFaultNum SwcOut_FCM_RemoteDiag.FCM_FrameIndex SwcOut_FCM_RemoteDiag.FCM_SupplierNum SwcOut_FCM_RemoteDiag.FCM_FaultNum1 SwcOut_FCM_RemoteDiag.FCM_FaultNum2 SwcOut_FCM_RemoteDiag.FCM_FaultNum3 SwcOut_FCM_RemoteDiag.FCM_FaultNum4 SwcOut_FCM_RemoteDiag.FCM_FaultNum5 SwcOut_FCM_RemoteDiag.FCM_FaultNum6 SwcOut_FCM_RemoteDiag.FCM_FaultNum7 SwcOut_FCM_RemoteDiag.FCM_FaultNum8 SwcOut_FCM_RemoteDiag.FCM_FaultNum9 SwcOut_FCM_RemoteDiag.FCM_FaultNum10 SwcOut_FCM_RemoteDiag.FCM_FaultNum11 SwcOut_FCM_RemoteDiag.FCM_FaultNum12 SwcOut_FCM_RemoteDiag.FCM_FaultNum13 SwcOut_FCM_RemoteDiag.FCM_FaultNum14 SwcOut_FCM_RemoteDiag.FCM_FaultNum15 SwcOut_FCM_RemoteDiag.FCM_FaultNum16 SwcOut_FCM_RemoteDiag.FCM_FaultNum17 SwcOut_FCM_RemoteDiag.FCM_FaultNum18 SwcOut_FCM_RemoteDiag.FCM_FaultNum19 SwcOut_FCM_RemoteDiag.FCM_FaultNum20 /end REF_MEASUREMENT
/end GROUP
/begin GROUP SwcOut_FCM_SensorInfo ""
 /begin REF_MEASUREMENT SwcOut_FCM_SensorInfo.ADASSysSts SwcOut_FCM_SensorInfo.FLCameraSysSts SwcOut_FCM_SensorInfo.FLCameraCalSts SwcOut_FCM_SensorInfo.FRCameraSysSts SwcOut_FCM_SensorInfo.FRCameraCalSts SwcOut_FCM_SensorInfo.RLCameraSysSts SwcOut_FCM_SensorInfo.RLCameraCalSts SwcOut_FCM_SensorInfo.RRCameraSysSts SwcOut_FCM_SensorInfo.RRCameraCalSts SwcOut_FCM_SensorInfo.RearCameraSysSts SwcOut_FCM_SensorInfo.RearCameraCalSts SwcOut_FCM_SensorInfo.FrontFarCameraSysSts SwcOut_FCM_SensorInfo.FrontFarCameraCalSts SwcOut_FCM_SensorInfo.FrontNearCameraSysSts SwcOut_FCM_SensorInfo.FrontNearCameraCalSts SwcOut_FCM_SensorInfo.MainLidarSysSts SwcOut_FCM_SensorInfo.MainLidarCalSts SwcOut_FCM_SensorInfo.FLLidarSysSts SwcOut_FCM_SensorInfo.FLLidarCalSts SwcOut_FCM_SensorInfo.FRLidarSysSts SwcOut_FCM_SensorInfo.FRLidarCalSts SwcOut_FCM_SensorInfo.SVSFrontCameraSysSts SwcOut_FCM_SensorInfo.SVSLeftCameraSysSts SwcOut_FCM_SensorInfo.SVSRightCameraSysSts SwcOut_FCM_SensorInfo.SVSRearCameraSysSts SwcOut_FCM_SensorInfo.SVSFrontCameraCalSts SwcOut_FCM_SensorInfo.SVSLeftCameraCalSts SwcOut_FCM_SensorInfo.SVSRightCameraCalSts SwcOut_FCM_SensorInfo.SVSRearCameraCalSts /end REF_MEASUREMENT
/end GROUP
/begin GROUP SwcOut_FCM_UUID "" /begin REF_MEASUREMENT SwcOut_FCM_UUID.VehUUIDCode /end REF_MEASUREMENT /end GROUP
/begin GROUP SwcOut_NMm_FCM ""
 /begin REF_MEASUREMENT SwcOut_NMm_FCM.srcNodeID_FCM SwcOut_NMm_FCM.RMR_FCM SwcOut_NMm_FCM.NMm_FCM_Reserved1 SwcOut_NMm_FCM.FCM_Wakeup_Poweron SwcOut_NMm_FCM.FCM_Wakeup_NM SwcOut_NMm_FCM.FCM_Wakeup_Diag SwcOut_NMm_FCM.FCM_Wakeup_KL15 SwcOut_NMm_FCM.FCM_Awake_Poweron SwcOut_NMm_FCM.FCM_Awake_NM SwcOut_NMm_FCM.FCM_Awake_Diag SwcOut_NMm_FCM.FCM_Awake_Upload SwcOut_NMm_FCM.FCM_Awake_FLCR SwcOut_NMm_FCM.FCM_Awake_FRCR SwcOut_NMm_FCM.FCM_Awake_RLCR SwcOut_NMm_FCM.FCM_Awake_RRCR SwcOut_NMm_FCM.FCM_Awake_KL15 /end REF_MEASUREMENT
/end GROUP
/begin GROUP SwcOut_VAL_ARBN_Feedback ""
 /begin REF_MEASUREMENT SwcOut_VAL_ARBN_Feedback.AEB_Status SwcOut_VAL_ARBN_Feedback.RAEB_Status SwcOut_VAL_ARBN_Feedback.MEB_Status SwcOut_VAL_ARBN_Feedback.LAEB_Status SwcOut_VAL_ARBN_Feedback.FCTB_Status SwcOut_VAL_ARBN_Feedback.RCTB_Status /end REF_MEASUREMENT
/end GROUP
/begin GROUP SwcOut_VAL_CONFIG ""
 /begin REF_MEASUREMENT SwcOut_VAL_CONFIG.LKACtrlType SwcOut_VAL_CONFIG.PowerType SwcOut_VAL_CONFIG.AccelerateType SwcOut_VAL_CONFIG.TimeStampMs /end REF_MEASUREMENT
/end GROUP
/begin GROUP SwcOut_VAL_DRIVER_DRIVE ""
 /begin REF_MEASUREMENT SwcOut_VAL_DRIVER_DRIVE.AccPedalOverride SwcOut_VAL_DRIVER_DRIVE.AccActPulse SwcOut_VAL_DRIVER_DRIVE.LccActPulse SwcOut_VAL_DRIVER_DRIVE.AccOnOffPulse SwcOut_VAL_DRIVER_DRIVE.LccOnOffPulse SwcOut_VAL_DRIVER_DRIVE.ResumePulse SwcOut_VAL_DRIVER_DRIVE.CancelPulse SwcOut_VAL_DRIVER_DRIVE.IncSetSpdPulse SwcOut_VAL_DRIVER_DRIVE.DecSetSpdPulse SwcOut_VAL_DRIVER_DRIVE.IncTimeGapPulse SwcOut_VAL_DRIVER_DRIVE.DecTimeGapPulse SwcOut_VAL_DRIVER_DRIVE.HazardLmpSwtSts SwcOut_VAL_DRIVER_DRIVE.ScfConfirm SwcOut_VAL_DRIVER_DRIVE.DrvBrakePedalSts SwcOut_VAL_DRIVER_DRIVE.EPBSwtSts SwcOut_VAL_DRIVER_DRIVE.LTurnLmpSwtSts SwcOut_VAL_DRIVER_DRIVE.RTurnLmpSwtSts SwcOut_VAL_DRIVER_DRIVE.HighBeamSwtSts SwcOut_VAL_DRIVER_DRIVE.OverVehBeamSwtSts SwcOut_VAL_DRIVER_DRIVE.AutoLightSW SwcOut_VAL_DRIVER_DRIVE.IncSetSpdStep SwcOut_VAL_DRIVER_DRIVE.DecSetSpdStep SwcOut_VAL_DRIVER_DRIVE.DrvConfirmLC SwcOut_VAL_DRIVER_DRIVE.DrvVoiceLCReq SwcOut_VAL_DRIVER_DRIVE.DrvVoiceTimeGapAdjReq SwcOut_VAL_DRIVER_DRIVE.DrvVoiceTimeGapAdjReqValue SwcOut_VAL_DRIVER_DRIVE.DrvVoiceSpdAdjReq SwcOut_VAL_DRIVER_DRIVE.DrvVoiceSpdAdjReqValue SwcOut_VAL_DRIVER_DRIVE.DrvBrakeAccel SwcOut_VAL_DRIVER_DRIVE.BrkPedalStroke SwcOut_VAL_DRIVER_DRIVE.AccPedalTouchPosition SwcOut_VAL_DRIVER_DRIVE.DrvSteerTrqVal SwcOut_VAL_DRIVER_DRIVE.TimeStampMs /end REF_MEASUREMENT
/end GROUP
/begin GROUP SwcOut_VAL_DRIVER_STATE ""
 /begin REF_MEASUREMENT SwcOut_VAL_DRIVER_STATE.HandsOff SwcOut_VAL_DRIVER_STATE.DriverSts SwcOut_VAL_DRIVER_STATE.DMSAuthSts SwcOut_VAL_DRIVER_STATE.GPSAuthSts SwcOut_VAL_DRIVER_STATE.TimeStampMs /end REF_MEASUREMENT
/end GROUP
/end MODULE
/end PROJECT
