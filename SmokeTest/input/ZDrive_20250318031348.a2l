ASAP2_VERSION 1 71
/begin PROJECT ProjectName ""
/begin MODULE ModuleName ""
/begin MOD_COMMON "" BYTE_ORDER MSB_LAST ALIGNMENT_BYTE 1 ALIGNMENT_WORD 1 ALIGNMENT_LONG 1 ALIGNMENT_INT64 1 ALIGNMENT_FLOAT16_IEEE 1 ALIGNMENT_FLOAT32_IEEE 1 ALIGNMENT_FLOAT64_IEEE 1 /end MOD_COMMON
/begin RECORD_LAYOUT Lookup1D_X_LONG AXIS_PTS_X 1 SLONG INDEX_INCR DIRECT /end RECORD_LAYOUT
/begin RECORD_LAYOUT Lookup1D_FLOAT32_IEEE FNC_VALUES 1 FLOAT32_IEEE COLUMN_DIR DIRECT /end RECORD_LAYOUT
/begin RECORD_LAYOUT Lookup1D_X_FLOAT32_IEEE AXIS_PTS_X 1 FLOAT32_IEEE INDEX_INCR DIRECT /end RECORD_LAYOUT
/begin RECORD_LAYOUT Lookup1D_FLOAT64_IEEE FNC_VALUES 1 FLOAT64_IEEE COLUMN_DIR DIRECT /end RECORD_LAYOUT
/begin RECORD_LAYOUT Lookup1D_X_FLOAT64_IEEE AXIS_PTS_X 1 FLOAT64_IEEE INDEX_INCR DIRECT /end RECORD_LAYOUT
/begin RECORD_LAYOUT Lookup2D_BOOLEAN FNC_VALUES 1 UBYTE COLUMN_DIR DIRECT /end RECORD_LAYOUT
/begin RECORD_LAYOUT Lookup2D_X_BOOLEAN AXIS_PTS_X 1 UBYTE INDEX_INCR DIRECT /end RECORD_LAYOUT
/begin RECORD_LAYOUT Lookup2D_UBYTE FNC_VALUES 1 UBYTE COLUMN_DIR DIRECT /end RECORD_LAYOUT
/begin RECORD_LAYOUT Lookup2D_X_UBYTE AXIS_PTS_X 1 UBYTE INDEX_INCR DIRECT /end RECORD_LAYOUT
/begin RECORD_LAYOUT Lookup2D_BYTE FNC_VALUES 1 SBYTE COLUMN_DIR DIRECT /end RECORD_LAYOUT
/begin RECORD_LAYOUT Lookup2D_X_BYTE AXIS_PTS_X 1 SBYTE INDEX_INCR DIRECT /end RECORD_LAYOUT
/begin RECORD_LAYOUT Record_FLOAT32_IEEE FNC_VALUES 1 FLOAT32_IEEE COLUMN_DIR DIRECT /end RECORD_LAYOUT
/begin RECORD_LAYOUT Record_SBYTE FNC_VALUES 1 SBYTE COLUMN_DIR DIRECT /end RECORD_LAYOUT
/begin RECORD_LAYOUT Record_SWORD FNC_VALUES 1 SWORD COLUMN_DIR DIRECT /end RECORD_LAYOUT
/begin RECORD_LAYOUT Record_UBYTE FNC_VALUES 1 UBYTE COLUMN_DIR DIRECT /end RECORD_LAYOUT
/begin RECORD_LAYOUT Record_ULONG FNC_VALUES 1 ULONG COLUMN_DIR DIRECT /end RECORD_LAYOUT
/begin RECORD_LAYOUT Record_UWORD FNC_VALUES 1 UWORD COLUMN_DIR DIRECT /end RECORD_LAYOUT
/begin RECORD_LAYOUT Record_FLOAT32_IEEE FNC_VALUES 1 FLOAT32_IEEE COLUMN_DIR DIRECT /end RECORD_LAYOUT
/begin RECORD_LAYOUT Record_UBYTE FNC_VALUES 1 UBYTE COLUMN_DIR DIRECT /end RECORD_LAYOUT
/begin RECORD_LAYOUT Record_ULONG FNC_VALUES 1 ULONG COLUMN_DIR DIRECT /end RECORD_LAYOUT
/begin RECORD_LAYOUT Record_UWORD FNC_VALUES 1 UWORD COLUMN_DIR DIRECT /end RECORD_LAYOUT
/begin RECORD_LAYOUT Record_FLOAT32_IEEE FNC_VALUES 1 FLOAT32_IEEE COLUMN_DIR DIRECT /end RECORD_LAYOUT
/begin RECORD_LAYOUT Record_SWORD FNC_VALUES 1 SWORD COLUMN_DIR DIRECT /end RECORD_LAYOUT
/begin RECORD_LAYOUT Record_UBYTE FNC_VALUES 1 UBYTE COLUMN_DIR DIRECT /end RECORD_LAYOUT
/begin RECORD_LAYOUT Record_ULONG FNC_VALUES 1 ULONG COLUMN_DIR DIRECT /end RECORD_LAYOUT
/begin RECORD_LAYOUT Record_FLOAT32_IEEE FNC_VALUES 1 FLOAT32_IEEE COLUMN_DIR DIRECT /end RECORD_LAYOUT
/begin RECORD_LAYOUT Record_SBYTE FNC_VALUES 1 SBYTE COLUMN_DIR DIRECT /end RECORD_LAYOUT
/begin RECORD_LAYOUT Record_UBYTE FNC_VALUES 1 UBYTE COLUMN_DIR DIRECT /end RECORD_LAYOUT
/begin RECORD_LAYOUT Record_ULONG FNC_VALUES 1 ULONG COLUMN_DIR DIRECT /end RECORD_LAYOUT
/begin RECORD_LAYOUT Record_UWORD FNC_VALUES 1 UWORD COLUMN_DIR DIRECT /end RECORD_LAYOUT
/begin RECORD_LAYOUT Record_FLOAT32_IEEE FNC_VALUES 1 FLOAT32_IEEE COLUMN_DIR DIRECT /end RECORD_LAYOUT
/begin RECORD_LAYOUT Record_SBYTE FNC_VALUES 1 SBYTE COLUMN_DIR DIRECT /end RECORD_LAYOUT
/begin RECORD_LAYOUT Record_SWORD FNC_VALUES 1 SWORD COLUMN_DIR DIRECT /end RECORD_LAYOUT
/begin RECORD_LAYOUT Record_UBYTE FNC_VALUES 1 UBYTE COLUMN_DIR DIRECT /end RECORD_LAYOUT
/begin RECORD_LAYOUT Record_ULONG FNC_VALUES 1 ULONG COLUMN_DIR DIRECT /end RECORD_LAYOUT
/begin RECORD_LAYOUT Record_UWORD FNC_VALUES 1 UWORD COLUMN_DIR DIRECT /end RECORD_LAYOUT
/begin MEASUREMENT autosar_swc_rlgs_rtARID_DEF.ARID_DEF_MATLABFunction6.Line_LaneExtraFarPointType "" UBYTE autosar_swc_rlgs_CM_uint8 0 0 0 255 ECU_ADDRESS 0xfe4aecf0 /* @ECU_Address@autosar_swc_rlgs_rtARID_DEF.ARID_DEF_MATLABFunction6.Line_LaneExtraFarPointType@ */ /end MEASUREMENT
/begin MEASUREMENT autosar_swc_rlgs_rtARID_DEF.ARID_DEF_MATLABFunction6.Line_LaneExtraNearPointPosX "" FLOAT32_IEEE autosar_swc_rlgs_CM_single 0 0 -3.4E+38 3.4E+38 ECU_ADDRESS 0xfe4aece0 /* @ECU_Address@autosar_swc_rlgs_rtARID_DEF.ARID_DEF_MATLABFunction6.Line_LaneExtraNearPointPosX@ */ /end MEASUREMENT
/begin MEASUREMENT autosar_swc_rlgs_rtARID_DEF.ARID_DEF_MATLABFunction6.Line_LaneExtraNearPointPosY "" FLOAT32_IEEE autosar_swc_rlgs_CM_single 0 0 -3.4E+38 3.4E+38 ECU_ADDRESS 0xfe4aece4 /* @ECU_Address@autosar_swc_rlgs_rtARID_DEF.ARID_DEF_MATLABFunction6.Line_LaneExtraNearPointPosY@ */ /end MEASUREMENT
/begin MEASUREMENT autosar_swc_rlgs_rtARID_DEF.ARID_DEF_MATLABFunction6.Line_LaneExtraNearPointType "" UBYTE autosar_swc_rlgs_CM_uint8 0 0 0 255 ECU_ADDRESS 0xfe4aecef /* @ECU_Address@autosar_swc_rlgs_rtARID_DEF.ARID_DEF_MATLABFunction6.Line_LaneExtraNearPointType@ */ /end MEASUREMENT
/begin MEASUREMENT autosar_swc_rlgs_rtARID_DEF.ARID_DEF_MATLABFunction6.Line_LaneParsingConfidence "" UBYTE autosar_swc_rlgs_CM_uint8 0 0 0 255 ECU_ADDRESS 0xfe4aecf1 /* @ECU_Address@autosar_swc_rlgs_rtARID_DEF.ARID_DEF_MATLABFunction6.Line_LaneParsingConfidence@ */ /end MEASUREMENT
/begin MEASUREMENT autosar_swc_rlgs_rtARID_DEF.ARID_DEF_MATLABFunction6.Line_ObstacleFlag "" UBYTE autosar_swc_rlgs_CM_uint8 0 0 0 255 ECU_ADDRESS 0xfe4aecee /* @ECU_Address@autosar_swc_rlgs_rtARID_DEF.ARID_DEF_MATLABFunction6.Line_ObstacleFlag@ */ /end MEASUREMENT
/begin MEASUREMENT autosar_swc_rlgs_rtARID_DEF.ARID_DEF_MATLABFunction6.Line_Stopline_Relevancy "" UBYTE autosar_swc_rlgs_CM_uint8 0 0 0 255 ECU_ADDRESS 0xfe4aecf2 /* @ECU_Address@autosar_swc_rlgs_rtARID_DEF.ARID_DEF_MATLABFunction6.Line_Stopline_Relevancy@ */ /end MEASUREMENT
/begin MEASUREMENT autosar_swc_rlgs_rtARID_DEF.ARID_DEF_MATLABFunction6.Line_TrackID "" UWORD autosar_swc_rlgs_CM_uint16 0 0 0 65535 ECU_ADDRESS 0xfe4aece8 /* @ECU_Address@autosar_swc_rlgs_rtARID_DEF.ARID_DEF_MATLABFunction6.Line_TrackID@ */ /end MEASUREMENT
/begin MEASUREMENT autosar_swc_rlgs_rtARID_DEF.ARID_DEF_MATLABFunction6.Line_bIsLineExist "" UBYTE autosar_swc_rlgs_CM_uint8 0 0 0 255 ECU_ADDRESS 0xfe4aecea /* @ECU_Address@autosar_swc_rlgs_rtARID_DEF.ARID_DEF_MATLABFunction6.Line_bIsLineExist@ */ /end MEASUREMENT
/begin MEASUREMENT autosar_swc_rlgs_rtARID_DEF.ARID_DEF_MATLABFunction6.Line_dC0V "" FLOAT32_IEEE autosar_swc_rlgs_CM_single 0 0 -3.4E+38 3.4E+38 ECU_ADDRESS 0xfe4aecc8 /* @ECU_Address@autosar_swc_rlgs_rtARID_DEF.ARID_DEF_MATLABFunction6.Line_dC0V@ */ /end MEASUREMENT
/begin MEASUREMENT autosar_swc_rlgs_rtARID_DEF.ARID_DEF_MATLABFunction6.Line_dC1V "" FLOAT32_IEEE autosar_swc_rlgs_CM_single 0 0 -3.4E+38 3.4E+38 ECU_ADDRESS 0xfe4aeccc /* @ECU_Address@autosar_swc_rlgs_rtARID_DEF.ARID_DEF_MATLABFunction6.Line_dC1V@ */ /end MEASUREMENT
/begin MEASUREMENT autosar_swc_rlgs_rtARID_DEF.ARID_DEF_MATLABFunction6.Line_dC2V "" FLOAT32_IEEE autosar_swc_rlgs_CM_single 0 0 -3.4E+38 3.4E+38 ECU_ADDRESS 0xfe4aecd0 /* @ECU_Address@autosar_swc_rlgs_rtARID_DEF.ARID_DEF_MATLABFunction6.Line_dC2V@ */ /end MEASUREMENT
/begin MEASUREMENT autosar_swc_rlgs_rtARID_DEF.ARID_DEF_MATLABFunction6.Line_dC3V "" FLOAT32_IEEE autosar_swc_rlgs_CM_single 0 0 -3.4E+38 3.4E+38 ECU_ADDRESS 0xfe4aecd4 /* @ECU_Address@autosar_swc_rlgs_rtARID_DEF.ARID_DEF_MATLABFunction6.Line_dC3V@ */ /end MEASUREMENT
/begin MEASUREMENT autosar_swc_rlgs_rtARID_DEF.ARID_DEF_MATLABFunction6.Line_dDisFront "" FLOAT32_IEEE autosar_swc_rlgs_CM_single 0 0 -3.4E+38 3.4E+38 ECU_ADDRESS 0xfe4aecc4 /* @ECU_Address@autosar_swc_rlgs_rtARID_DEF.ARID_DEF_MATLABFunction6.Line_dDisFront@ */ /end MEASUREMENT
/begin MEASUREMENT autosar_swc_rlgs_rtARID_DEF.ARID_DEF_MATLABFunction6.Line_dDisStart "" FLOAT32_IEEE autosar_swc_rlgs_CM_single 0 0 -3.4E+38 3.4E+38 ECU_ADDRESS 0xfe4aecc0 /* @ECU_Address@autosar_swc_rlgs_rtARID_DEF.ARID_DEF_MATLABFunction6.Line_dDisStart@ */ /end MEASUREMENT
/begin MEASUREMENT autosar_swc_rlgs_rtARID_DEF.ARID_DEF_MATLABFunction6.Line_dLaneWidth "" FLOAT32_IEEE autosar_swc_rlgs_CM_single 0 0 -3.4E+38 3.4E+38 ECU_ADDRESS 0xfe4aecbc /* @ECU_Address@autosar_swc_rlgs_rtARID_DEF.ARID_DEF_MATLABFunction6.Line_dLaneWidth@ */ /end MEASUREMENT
/begin MEASUREMENT autosar_swc_rlgs_rtARID_DEF.ARID_DEF_MATLABFunction6.Line_dQuality "" FLOAT32_IEEE autosar_swc_rlgs_CM_single 0 0 -3.4E+38 3.4E+38 ECU_ADDRESS 0xfe4aecb8 /* @ECU_Address@autosar_swc_rlgs_rtARID_DEF.ARID_DEF_MATLABFunction6.Line_dQuality@ */ /end MEASUREMENT
/begin MEASUREMENT autosar_swc_rlgs_rtARID_DEF.ARID_DEF_MATLABFunction6.Line_eColour "" UBYTE autosar_swc_rlgs_CM_uint8 0 0 0 255 ECU_ADDRESS 0xfe4aecec /* @ECU_Address@autosar_swc_rlgs_rtARID_DEF.ARID_DEF_MATLABFunction6.Line_eColour@ */ /end MEASUREMENT
/begin MEASUREMENT autosar_swc_rlgs_rtARID_DEF.ARID_DEF_MATLABFunction6.Line_eLineType "" UBYTE autosar_swc_rlgs_CM_uint8 0 0 0 255 ECU_ADDRESS 0xfe4aeceb /* @ECU_Address@autosar_swc_rlgs_rtARID_DEF.ARID_DEF_MATLABFunction6.Line_eLineType@ */ /end MEASUREMENT
/begin MEASUREMENT autosar_swc_rlgs_rtARID_DEF.ARID_DEF_MATLABFunction_g.Cnt "" UBYTE autosar_swc_rlgs_CM_uint8 0 0 0 255 ECU_ADDRESS 0xfe4aed33 /* @ECU_Address@autosar_swc_rlgs_rtARID_DEF.ARID_DEF_MATLABFunction_g.Cnt@ */ /end MEASUREMENT
/begin MEASUREMENT autosar_swc_rlgs_rtARID_DEF.ARID_DEF_MATLABFunction_g.TurnLmpIn_K1 "" UBYTE autosar_swc_rlgs_CM_uint8 0 0 0 255 ECU_ADDRESS 0xfe4aed32 /* @ECU_Address@autosar_swc_rlgs_rtARID_DEF.ARID_DEF_MATLABFunction_g.TurnLmpIn_K1@ */ /end MEASUREMENT
/begin MEASUREMENT autosar_swc_rlgs_rtARID_DEF.ARID_DEF_MATLABFunction_p.A0 "" FLOAT32_IEEE autosar_swc_rlgs_CM_single 0 0 -3.4E+38 3.4E+38 ECU_ADDRESS 0xfe4aec68 /* @ECU_Address@autosar_swc_rlgs_rtARID_DEF.ARID_DEF_MATLABFunction_p.A0@ */ /end MEASUREMENT
/begin MEASUREMENT autosar_swc_rlgs_rtARID_DEF.ARID_DEF_MATLABFunction_p.A0K1 "" FLOAT32_IEEE autosar_swc_rlgs_CM_single 0 0 -3.4E+38 3.4E+38 ECU_ADDRESS 0xfe4aec98 /* @ECU_Address@autosar_swc_rlgs_rtARID_DEF.ARID_DEF_MATLABFunction_p.A0K1@ */ /end MEASUREMENT
/begin MEASUREMENT autosar_swc_rlgs_rtARID_DEF.ARID_DEF_MATLABFunction_p.A1 "" FLOAT32_IEEE autosar_swc_rlgs_CM_single 0 0 -3.4E+38 3.4E+38 ECU_ADDRESS 0xfe4aec64 /* @ECU_Address@autosar_swc_rlgs_rtARID_DEF.ARID_DEF_MATLABFunction_p.A1@ */ /end MEASUREMENT
/begin MEASUREMENT autosar_swc_rlgs_rtARID_DEF.ARID_DEF_MATLABFunction_p.A1K1 "" FLOAT32_IEEE autosar_swc_rlgs_CM_single 0 0 -3.4E+38 3.4E+38 ECU_ADDRESS 0xfe4aec94 /* @ECU_Address@autosar_swc_rlgs_rtARID_DEF.ARID_DEF_MATLABFunction_p.A1K1@ */ /end MEASUREMENT
/begin MEASUREMENT autosar_swc_rlgs_rtARID_DEF.ARID_DEF_MATLABFunction_p.A2 "" FLOAT32_IEEE autosar_swc_rlgs_CM_single 0 0 -3.4E+38 3.4E+38 ECU_ADDRESS 0xfe4aec60 /* @ECU_Address@autosar_swc_rlgs_rtARID_DEF.ARID_DEF_MATLABFunction_p.A2@ */ /end MEASUREMENT
/begin MEASUREMENT autosar_swc_rlgs_rtARID_DEF.ARID_DEF_MATLABFunction_p.A2K1 "" FLOAT32_IEEE autosar_swc_rlgs_CM_single 0 0 -3.4E+38 3.4E+38 ECU_ADDRESS 0xfe4aec90 /* @ECU_Address@autosar_swc_rlgs_rtARID_DEF.ARID_DEF_MATLABFunction_p.A2K1@ */ /end MEASUREMENT
/begin MEASUREMENT autosar_swc_rlgs_rtARID_DEF.ARID_DEF_MATLABFunction_p.A3 "" FLOAT32_IEEE autosar_swc_rlgs_CM_single 0 0 -3.4E+38 3.4E+38 ECU_ADDRESS 0xfe4aec5c /* @ECU_Address@autosar_swc_rlgs_rtARID_DEF.ARID_DEF_MATLABFunction_p.A3@ */ /end MEASUREMENT
/begin MEASUREMENT autosar_swc_rlgs_rtARID_DEF.ARID_DEF_MATLABFunction_p.A3K1 "" FLOAT32_IEEE autosar_swc_rlgs_CM_single 0 0 -3.4E+38 3.4E+38 ECU_ADDRESS 0xfe4aec8c /* @ECU_Address@autosar_swc_rlgs_rtARID_DEF.ARID_DEF_MATLABFunction_p.A3K1@ */ /end MEASUREMENT
/begin MEASUREMENT autosar_swc_rlgs_rtARID_DEF.ARID_DEF_MATLABFunction_p.Crossing "" UBYTE autosar_swc_rlgs_CM_uint8 0 0 0 255 ECU_ADDRESS 0xfe4aecae /* @ECU_Address@autosar_swc_rlgs_rtARID_DEF.ARID_DEF_MATLABFunction_p.Crossing@ */ /end MEASUREMENT
/begin MEASUREMENT autosar_swc_rlgs_rtARID_DEF.ARID_DEF_MATLABFunction_p.LaneExtraFarPointPosX "" FLOAT32_IEEE autosar_swc_rlgs_CM_single 0 0 -3.4E+38 3.4E+38 ECU_ADDRESS 0xfe4aec78 /* @ECU_Address@autosar_swc_rlgs_rtARID_DEF.ARID_DEF_MATLABFunction_p.LaneExtraFarPointPosX@ */ /end MEASUREMENT
/begin MEASUREMENT autosar_swc_rlgs_rtARID_DEF.ARID_DEF_MATLABFunction_p.LaneExtraFarPointPosY "" FLOAT32_IEEE autosar_swc_rlgs_CM_single 0 0 -3.4E+38 3.4E+38 ECU_ADDRESS 0xfe4aec7c /* @ECU_Address@autosar_swc_rlgs_rtARID_DEF.ARID_DEF_MATLABFunction_p.LaneExtraFarPointPosY@ */ /end MEASUREMENT
/begin MEASUREMENT autosar_swc_rlgs_rtARID_DEF.ARID_DEF_MATLABFunction_p.LaneExtraFarPointType "" UBYTE autosar_swc_rlgs_CM_uint8 0 0 0 255 ECU_ADDRESS 0xfe4aecb1 /* @ECU_Address@autosar_swc_rlgs_rtARID_DEF.ARID_DEF_MATLABFunction_p.LaneExtraFarPointType@ */ /end MEASUREMENT
/begin MEASUREMENT autosar_swc_rlgs_rtARID_DEF.ARID_DEF_MATLABFunction_p.LaneExtraNearPointPosX "" FLOAT32_IEEE autosar_swc_rlgs_CM_single 0 0 -3.4E+38 3.4E+38 ECU_ADDRESS 0xfe4aec80 /* @ECU_Address@autosar_swc_rlgs_rtARID_DEF.ARID_DEF_MATLABFunction_p.LaneExtraNearPointPosX@ */ /end MEASUREMENT
/begin MEASUREMENT autosar_swc_rlgs_rtARID_DEF.ARID_DEF_MATLABFunction_p.LaneExtraNearPointPosY "" FLOAT32_IEEE autosar_swc_rlgs_CM_single 0 0 -3.4E+38 3.4E+38 ECU_ADDRESS 0xfe4aec84 /* @ECU_Address@autosar_swc_rlgs_rtARID_DEF.ARID_DEF_MATLABFunction_p.LaneExtraNearPointPosY@ */ /end MEASUREMENT
/begin MEASUREMENT autosar_swc_rlgs_rtARID_DEF.ARID_DEF_MATLABFunction_p.LaneExtraNearPointType "" UBYTE autosar_swc_rlgs_CM_uint8 0 0 0 255 ECU_ADDRESS 0xfe4aecb0 /* @ECU_Address@autosar_swc_rlgs_rtARID_DEF.ARID_DEF_MATLABFunction_p.LaneExtraNearPointType@ */ /end MEASUREMENT
/begin MEASUREMENT autosar_swc_rlgs_rtARID_DEF.ARID_DEF_MATLABFunction_p.LaneParsingConfidence "" UBYTE autosar_swc_rlgs_CM_uint8 0 0 0 255 ECU_ADDRESS 0xfe4aecb2 /* @ECU_Address@autosar_swc_rlgs_rtARID_DEF.ARID_DEF_MATLABFunction_p.LaneParsingConfidence@ */ /end MEASUREMENT
/begin MEASUREMENT autosar_swc_rlgs_rtARID_DEF.ARID_DEF_MATLABFunction_p.LaneWidth "" FLOAT32_IEEE autosar_swc_rlgs_CM_single 0 0 -3.4E+38 3.4E+38 ECU_ADDRESS 0xfe4aec74 /* @ECU_Address@autosar_swc_rlgs_rtARID_DEF.ARID_DEF_MATLABFunction_p.LaneWidth@ */ /end MEASUREMENT
/begin MEASUREMENT autosar_swc_rlgs_rtARID_DEF.ARID_DEF_MATLABFunction_p.LineConf "" UBYTE autosar_swc_rlgs_CM_uint8 0 0 0 255 ECU_ADDRESS 0xfe4aecab /* @ECU_Address@autosar_swc_rlgs_rtARID_DEF.ARID_DEF_MATLABFunction_p.LineConf@ */ /end MEASUREMENT
/begin MEASUREMENT autosar_swc_rlgs_rtARID_DEF.ARID_DEF_MATLABFunction_p.LineConfK1 "" UBYTE autosar_swc_rlgs_CM_uint8 0 0 0 255 ECU_ADDRESS 0xfe4aecb4 /* @ECU_Address@autosar_swc_rlgs_rtARID_DEF.ARID_DEF_MATLABFunction_p.LineConfK1@ */ /end MEASUREMENT
/begin MEASUREMENT autosar_swc_rlgs_rtARID_DEF.ARID_DEF_MATLABFunction_p.LineReliable "" FLOAT32_IEEE autosar_swc_rlgs_CM_single 0 0 -3.4E+38 3.4E+38 ECU_ADDRESS 0xfe4aec58 /* @ECU_Address@autosar_swc_rlgs_rtARID_DEF.ARID_DEF_MATLABFunction_p.LineReliable@ */ /end MEASUREMENT
/begin MEASUREMENT autosar_swc_rlgs_rtARID_DEF.ARID_DEF_MATLABFunction_p.LineReliableK1 "" FLOAT32_IEEE autosar_swc_rlgs_CM_single 0 0 -3.4E+38 3.4E+38 ECU_ADDRESS 0xfe4aec88 /* @ECU_Address@autosar_swc_rlgs_rtARID_DEF.ARID_DEF_MATLABFunction_p.LineReliableK1@ */ /end MEASUREMENT
/begin MEASUREMENT autosar_swc_rlgs_rtARID_DEF.ARID_DEF_MATLABFunction_p.LineType "" UBYTE autosar_swc_rlgs_CM_uint8 0 0 0 255 ECU_ADDRESS 0xfe4aecac /* @ECU_Address@autosar_swc_rlgs_rtARID_DEF.ARID_DEF_MATLABFunction_p.LineType@ */ /end MEASUREMENT
/begin MEASUREMENT autosar_swc_rlgs_rtARID_DEF.ARID_DEF_MATLABFunction_p.ObstacleFlag "" UBYTE autosar_swc_rlgs_CM_uint8 0 0 0 255 ECU_ADDRESS 0xfe4aecaf /* @ECU_Address@autosar_swc_rlgs_rtARID_DEF.ARID_DEF_MATLABFunction_p.ObstacleFlag@ */ /end MEASUREMENT
/begin MEASUREMENT autosar_swc_rlgs_rtARID_DEF.ARID_DEF_MATLABFunction_p.OperateState "" UBYTE autosar_swc_rlgs_CM_uint8 0 0 0 255 ECU_ADDRESS 0xfe4aecaa /* @ECU_Address@autosar_swc_rlgs_rtARID_DEF.ARID_DEF_MATLABFunction_p.OperateState@ */ /end MEASUREMENT
/begin MEASUREMENT autosar_swc_rlgs_rtARID_DEF.ARID_DEF_MATLABFunction_p.Range "" FLOAT32_IEEE autosar_swc_rlgs_CM_single 0 0 -3.4E+38 3.4E+38 ECU_ADDRESS 0xfe4aec70 /* @ECU_Address@autosar_swc_rlgs_rtARID_DEF.ARID_DEF_MATLABFunction_p.Range@ */ /end MEASUREMENT
/begin MEASUREMENT autosar_swc_rlgs_rtARID_DEF.ARID_DEF_MATLABFunction_p.RangeK1 "" FLOAT32_IEEE autosar_swc_rlgs_CM_single 0 0 -3.4E+38 3.4E+38 ECU_ADDRESS 0xfe4aeca0 /* @ECU_Address@autosar_swc_rlgs_rtARID_DEF.ARID_DEF_MATLABFunction_p.RangeK1@ */ /end MEASUREMENT
/begin MEASUREMENT autosar_swc_rlgs_rtARID_DEF.ARID_DEF_MATLABFunction_p.Start "" FLOAT32_IEEE autosar_swc_rlgs_CM_single 0 0 -3.4E+38 3.4E+38 ECU_ADDRESS 0xfe4aec6c /* @ECU_Address@autosar_swc_rlgs_rtARID_DEF.ARID_DEF_MATLABFunction_p.Start@ */ /end MEASUREMENT
/begin MEASUREMENT autosar_swc_rlgs_rtARID_DEF.ARID_DEF_MATLABFunction_p.StartK1 "" FLOAT32_IEEE autosar_swc_rlgs_CM_single 0 0 -3.4E+38 3.4E+38 ECU_ADDRESS 0xfe4aec9c /* @ECU_Address@autosar_swc_rlgs_rtARID_DEF.ARID_DEF_MATLABFunction_p.StartK1@ */ /end MEASUREMENT
/begin MEASUREMENT autosar_swc_rlgs_rtARID_DEF.ARID_DEF_MATLABFunction_p.Stopline_Relevancy "" UBYTE autosar_swc_rlgs_CM_uint8 0 0 0 255 ECU_ADDRESS 0xfe4aecb3 /* @ECU_Address@autosar_swc_rlgs_rtARID_DEF.ARID_DEF_MATLABFunction_p.Stopline_Relevancy@ */ /end MEASUREMENT
/begin MEASUREMENT autosar_swc_rlgs_rtARID_DEF.ARID_DEF_MATLABFunction_p.TrackID "" UWORD autosar_swc_rlgs_CM_uint16 0 0 0 65535 ECU_ADDRESS 0xfe4aeca8 /* @ECU_Address@autosar_swc_rlgs_rtARID_DEF.ARID_DEF_MATLABFunction_p.TrackID@ */ /end MEASUREMENT
/begin MEASUREMENT autosar_swc_rlgs_rtARID_DEF.ARID_DEF_MATLABFunction_p.eColor "" UBYTE autosar_swc_rlgs_CM_uint8 0 0 0 255 ECU_ADDRESS 0xfe4aecad /* @ECU_Address@autosar_swc_rlgs_rtARID_DEF.ARID_DEF_MATLABFunction_p.eColor@ */ /end MEASUREMENT
/begin MEASUREMENT autosar_swc_rlgs_rtARID_DEF.ARID_DEF_MATLABFunction_p.lineTypeK1 "" UBYTE autosar_swc_rlgs_CM_uint8 0 0 0 255 ECU_ADDRESS 0xfe4aecb5 /* @ECU_Address@autosar_swc_rlgs_rtARID_DEF.ARID_DEF_MATLABFunction_p.lineTypeK1@ */ /end MEASUREMENT
/begin MEASUREMENT autosar_swc_rlgs_rtARID_DEF.ARID_DEF_MATLABFunction_p.tLostK1 "" FLOAT32_IEEE autosar_swc_rlgs_CM_single 0 0 -3.4E+38 3.4E+38 ECU_ADDRESS 0xfe4aeca4 /* @ECU_Address@autosar_swc_rlgs_rtARID_DEF.ARID_DEF_MATLABFunction_p.tLostK1@ */ /end MEASUREMENT
/begin MEASUREMENT autosar_swc_rlgs_rtARID_DEF.UnitDelay_2_DSTATE "" UBYTE autosar_swc_rlgs_CM_logical 0 0 0 1 ECU_ADDRESS 0xfe4afdbc /* @ECU_Address@autosar_swc_rlgs_rtARID_DEF.UnitDelay_2_DSTATE@ */ /end MEASUREMENT
/begin MEASUREMENT autosar_swc_rlgs_rtARID_DEF.UnitDelay_6_DSTATE "" UBYTE autosar_swc_rlgs_CM_logical 0 0 0 1 ECU_ADDRESS 0xfe4afdba /* @ECU_Address@autosar_swc_rlgs_rtARID_DEF.UnitDelay_6_DSTATE@ */ /end MEASUREMENT
/begin COMPU_METHOD autosar_swc_rlgs_CM_logical "Q = V" IDENTICAL "%1.0" "" /end COMPU_METHOD
/begin COMPU_METHOD autosar_swc_rlgs_CM_single "Q = V" IDENTICAL "%8.6" "" /end COMPU_METHOD
/begin COMPU_METHOD autosar_swc_rlgs_CM_uint16 "Q = V" IDENTICAL "%5.0" "" /end COMPU_METHOD
/begin COMPU_METHOD autosar_swc_rlgs_CM_uint8 "Q = V" IDENTICAL "%3.0" "" /end COMPU_METHOD
/begin RECORD_LAYOUT Record_FLOAT32_IEEE FNC_VALUES 1 FLOAT32_IEEE COLUMN_DIR DIRECT /end RECORD_LAYOUT
/begin RECORD_LAYOUT Record_SBYTE FNC_VALUES 1 SBYTE COLUMN_DIR DIRECT /end RECORD_LAYOUT
/begin RECORD_LAYOUT Record_SWORD FNC_VALUES 1 SWORD COLUMN_DIR DIRECT /end RECORD_LAYOUT
/begin RECORD_LAYOUT Record_UBYTE FNC_VALUES 1 UBYTE COLUMN_DIR DIRECT /end RECORD_LAYOUT
/begin RECORD_LAYOUT Record_ULONG FNC_VALUES 1 ULONG COLUMN_DIR DIRECT /end RECORD_LAYOUT
/begin RECORD_LAYOUT Record_UWORD FNC_VALUES 1 UWORD COLUMN_DIR DIRECT /end RECORD_LAYOUT
/begin CHARACTERISTIC ZDrive_BSW_Cal_Cal.ZDrive_BSW_Cal_VehicleInfomationTable.ASU_Type "" VALUE 0x3d8081 Record_UBYTE 0 autosar_swc_tos_CM_uint8 0 255 /end CHARACTERISTIC
/begin CHARACTERISTIC ZDrive_BSW_Cal_Cal.ZDrive_BSW_Cal_VehicleInfomationTable.AccSens_LatAccSigDirect "" VALUE 0x3d8078 Record_UBYTE 0 autosar_swc_tos_CM_uint8 0 255 /end CHARACTERISTIC
/begin CHARACTERISTIC ZDrive_BSW_Cal_Cal.ZDrive_BSW_Cal_VehicleInfomationTable.AccSens_LonAccSigDirect "" VALUE 0x3d8079 Record_UBYTE 0 autosar_swc_tos_CM_uint8 0 255 /end CHARACTERISTIC
/begin CHARACTERISTIC ZDrive_BSW_Cal_Cal.ZDrive_BSW_Cal_VehicleInfomationTable.ActiveType "" VALUE 0x3d806d Record_UBYTE 0 autosar_swc_tos_CM_uint8 0 255 /end CHARACTERISTIC
/begin CHARACTERISTIC ZDrive_BSW_Cal_Cal.ZDrive_BSW_Cal_VehicleInfomationTable.AutoHold_Type "" VALUE 0x3d8077 Record_UBYTE 0 autosar_swc_tos_CM_uint8 0 255 /end CHARACTERISTIC
/begin CHARACTERISTIC ZDrive_BSW_Cal_Cal.ZDrive_BSW_Cal_VehicleInfomationTable.CURB_kg "" VALUE 0x3d810c Record_FLOAT32_IEEE 0 autosar_swc_tos_CM_single -3.4E+38 3.4E+38 /end CHARACTERISTIC
/begin CHARACTERISTIC ZDrive_BSW_Cal_Cal.ZDrive_BSW_Cal_VehicleInfomationTable.CamDistToRearAxleCenter_DZ "" VALUE 0x3d8174 Record_FLOAT32_IEEE 0 autosar_swc_tos_CM_single -3.4E+38 3.4E+38 /end CHARACTERISTIC
/begin CHARACTERISTIC ZDrive_BSW_Cal_Cal.ZDrive_BSW_Cal_VehicleInfomationTable.CharSpd_mps "" VALUE 0x3d8138 Record_FLOAT32_IEEE 0 autosar_swc_tos_CM_single -3.4E+38 3.4E+38 /end CHARACTERISTIC
/begin CHARACTERISTIC ZDrive_BSW_Cal_Cal.ZDrive_BSW_Cal_VehicleInfomationTable.Country_Code "" VALUE 0x3d8068 Record_UBYTE 0 autosar_swc_tos_CM_uint8 0 255 /end CHARACTERISTIC
/begin CHARACTERISTIC ZDrive_BSW_Cal_Cal.ZDrive_BSW_Cal_VehicleInfomationTable.DriHandTorqueDirect "" VALUE 0x3d807b Record_UBYTE 0 autosar_swc_tos_CM_uint8 0 255 /end CHARACTERISTIC
/begin CHARACTERISTIC ZDrive_BSW_Cal_Cal.ZDrive_BSW_Cal_VehicleInfomationTable.DrivingLongControlInterForm "" VALUE 0x3d8071 Record_UBYTE 0 autosar_swc_tos_CM_uint8 0 255 /end CHARACTERISTIC
/begin CHARACTERISTIC ZDrive_BSW_Cal_Cal.ZDrive_BSW_Cal_VehicleInfomationTable.Driving_Type "" VALUE 0x3d8075 Record_UBYTE 0 autosar_swc_tos_CM_uint8 0 255 /end CHARACTERISTIC
/begin CHARACTERISTIC ZDrive_BSW_Cal_Cal.ZDrive_BSW_Cal_VehicleInfomationTable.DxvFrontBumper_m "" VALUE 0x3d80cc Record_FLOAT32_IEEE 0 autosar_swc_tos_CM_single -3.4E+38 3.4E+38 /end CHARACTERISTIC
/begin CHARACTERISTIC ZDrive_BSW_Cal_Cal.ZDrive_BSW_Cal_VehicleInfomationTable.DxvRearBumper_m "" VALUE 0x3d80c8 Record_FLOAT32_IEEE 0 autosar_swc_tos_CM_single -3.4E+38 3.4E+38 /end CHARACTERISTIC
/begin CHARACTERISTIC ZDrive_BSW_Cal_Cal.ZDrive_BSW_Cal_VehicleInfomationTable.EPS_Inter "" VALUE 0x3d8070 Record_UBYTE 0 autosar_swc_tos_CM_uint8 0 255 /end CHARACTERISTIC
/begin CHARACTERISTIC ZDrive_BSW_Cal_Cal.ZDrive_BSW_Cal_VehicleInfomationTable.ESP_Type "" VALUE 0x3d806b Record_UBYTE 0 autosar_swc_tos_CM_uint8 0 255 /end CHARACTERISTIC
/begin CHARACTERISTIC ZDrive_BSW_Cal_Cal.ZDrive_BSW_Cal_VehicleInfomationTable.Empty_mass_kg "" VALUE 0x3d8118 Record_FLOAT32_IEEE 0 autosar_swc_tos_CM_single -3.4E+38 3.4E+38 /end CHARACTERISTIC
/begin CHARACTERISTIC ZDrive_BSW_Cal_Cal.ZDrive_BSW_Cal_VehicleInfomationTable.EngineMaxiTorque_N "" VALUE 0x3d80a0 Record_FLOAT32_IEEE 0 autosar_swc_tos_CM_single -3.4E+38 3.4E+38 /end CHARACTERISTIC
/begin CHARACTERISTIC ZDrive_BSW_Cal_Cal.ZDrive_BSW_Cal_VehicleInfomationTable.Engine_Type "" VALUE 0x3d806f Record_UBYTE 0 autosar_swc_tos_CM_uint8 0 255 /end CHARACTERISTIC
/begin CHARACTERISTIC ZDrive_BSW_Cal_Cal.ZDrive_BSW_Cal_VehicleInfomationTable.FC2LeftWheel_m "" VALUE 0x3d8188 Record_FLOAT32_IEEE 0 autosar_swc_tos_CM_single -3.4E+38 3.4E+38 /end CHARACTERISTIC
/begin CHARACTERISTIC ZDrive_BSW_Cal_Cal.ZDrive_BSW_Cal_VehicleInfomationTable.FC2RearAxisX_m "" VALUE 0x3d816c Record_FLOAT32_IEEE 0 autosar_swc_tos_CM_single -3.4E+38 3.4E+38 /end CHARACTERISTIC
/begin CHARACTERISTIC ZDrive_BSW_Cal_Cal.ZDrive_BSW_Cal_VehicleInfomationTable.FC2RearAxisY_m "" VALUE 0x3d8170 Record_FLOAT32_IEEE 0 autosar_swc_tos_CM_single -3.4E+38 3.4E+38 /end CHARACTERISTIC
/begin CHARACTERISTIC ZDrive_BSW_Cal_Cal.ZDrive_BSW_Cal_VehicleInfomationTable.FC2RightWheel_m "" VALUE 0x3d818c Record_FLOAT32_IEEE 0 autosar_swc_tos_CM_single -3.4E+38 3.4E+38 /end CHARACTERISTIC
/begin CHARACTERISTIC ZDrive_BSW_Cal_Cal.ZDrive_BSW_Cal_VehicleInfomationTable.FCFirstViewPointDist_m "" VALUE 0x3d8178 Record_FLOAT32_IEEE 0 autosar_swc_tos_CM_single -3.4E+38 3.4E+38 /end CHARACTERISTIC
/begin CHARACTERISTIC ZDrive_BSW_Cal_Cal.ZDrive_BSW_Cal_VehicleInfomationTable.FCFocus2FrAxleDist_Y_m "" VALUE 0x3d8164 Record_FLOAT32_IEEE 0 autosar_swc_tos_CM_single -3.4E+38 3.4E+38 /end CHARACTERISTIC
/begin CHARACTERISTIC ZDrive_BSW_Cal_Cal.ZDrive_BSW_Cal_VehicleInfomationTable.FCFocus2FrAxleDist_Z_m "" VALUE 0x3d8168 Record_FLOAT32_IEEE 0 autosar_swc_tos_CM_single -3.4E+38 3.4E+38 /end CHARACTERISTIC
/begin CHARACTERISTIC ZDrive_BSW_Cal_Cal.ZDrive_BSW_Cal_VehicleInfomationTable.FRollingRadius_m "" VALUE 0x3d8150 Record_FLOAT32_IEEE 0 autosar_swc_tos_CM_single -3.4E+38 3.4E+38 /end CHARACTERISTIC
/begin CHARACTERISTIC ZDrive_BSW_Cal_Cal.ZDrive_BSW_Cal_VehicleInfomationTable.FrSCBlindSpotLength_m "" VALUE 0x3d81d0 Record_FLOAT32_IEEE 0 autosar_swc_tos_CM_single -3.4E+38 3.4E+38 /end CHARACTERISTIC
/begin CHARACTERISTIC ZDrive_BSW_Cal_Cal.ZDrive_BSW_Cal_VehicleInfomationTable.FrSCDist2OuterMostSide_m "" VALUE 0x3d81d4 Record_FLOAT32_IEEE 0 autosar_swc_tos_CM_single -3.4E+38 3.4E+38 /end CHARACTERISTIC
/begin CHARACTERISTIC ZDrive_BSW_Cal_Cal.ZDrive_BSW_Cal_VehicleInfomationTable.FrWhlHousingHeight_m "" VALUE 0x3d80c0 Record_FLOAT32_IEEE 0 autosar_swc_tos_CM_single -3.4E+38 3.4E+38 /end CHARACTERISTIC
/begin CHARACTERISTIC ZDrive_BSW_Cal_Cal.ZDrive_BSW_Cal_VehicleInfomationTable.FrWhlTrack_m "" VALUE 0x3d80b0 Record_FLOAT32_IEEE 0 autosar_swc_tos_CM_single -3.4E+38 3.4E+38 /end CHARACTERISTIC
/begin CHARACTERISTIC ZDrive_BSW_Cal_Cal.ZDrive_BSW_Cal_VehicleInfomationTable.FrntLeCrnrUss_Dx "" VALUE 0x3d8260 Record_FLOAT32_IEEE 0 autosar_swc_tos_CM_single -3.4E+38 3.4E+38 /end CHARACTERISTIC
/begin CHARACTERISTIC ZDrive_BSW_Cal_Cal.ZDrive_BSW_Cal_VehicleInfomationTable.FrntLeCrnrUss_Dy "" VALUE 0x3d8264 Record_FLOAT32_IEEE 0 autosar_swc_tos_CM_single -3.4E+38 3.4E+38 /end CHARACTERISTIC
/begin CHARACTERISTIC ZDrive_BSW_Cal_Cal.ZDrive_BSW_Cal_VehicleInfomationTable.FrntLeCrnrUss_Dz "" VALUE 0x3d8268 Record_FLOAT32_IEEE 0 autosar_swc_tos_CM_single -3.4E+38 3.4E+38 /end CHARACTERISTIC
/begin CHARACTERISTIC ZDrive_BSW_Cal_Cal.ZDrive_BSW_Cal_VehicleInfomationTable.FrntLeCrnrUss_Pitch "" VALUE 0x3d8274 Record_FLOAT32_IEEE 0 autosar_swc_tos_CM_single -3.4E+38 3.4E+38 /end CHARACTERISTIC
/begin CHARACTERISTIC ZDrive_BSW_Cal_Cal.ZDrive_BSW_Cal_VehicleInfomationTable.FrntLeCrnrUss_Roll "" VALUE 0x3d8270 Record_FLOAT32_IEEE 0 autosar_swc_tos_CM_single -3.4E+38 3.4E+38 /end CHARACTERISTIC
/begin CHARACTERISTIC ZDrive_BSW_Cal_Cal.ZDrive_BSW_Cal_VehicleInfomationTable.FrntLeCrnrUss_Yaw "" VALUE 0x3d8278 Record_FLOAT32_IEEE 0 autosar_swc_tos_CM_single -3.4E+38 3.4E+38 /end CHARACTERISTIC
/begin CHARACTERISTIC ZDrive_BSW_Cal_Cal.ZDrive_BSW_Cal_VehicleInfomationTable.FrntLeMidUss_Dx "" VALUE 0x3d827c Record_FLOAT32_IEEE 0 autosar_swc_tos_CM_single -3.4E+38 3.4E+38 /end CHARACTERISTIC
/begin CHARACTERISTIC ZDrive_BSW_Cal_Cal.ZDrive_BSW_Cal_VehicleInfomationTable.FrntLeMidUss_Dy "" VALUE 0x3d8280 Record_FLOAT32_IEEE 0 autosar_swc_tos_CM_single -3.4E+38 3.4E+38 /end CHARACTERISTIC
/begin CHARACTERISTIC ZDrive_BSW_Cal_Cal.ZDrive_BSW_Cal_VehicleInfomationTable.FrntLeMidUss_Dz "" VALUE 0x3d8284 Record_FLOAT32_IEEE 0 autosar_swc_tos_CM_single -3.4E+38 3.4E+38 /end CHARACTERISTIC
/begin CHARACTERISTIC ZDrive_BSW_Cal_Cal.ZDrive_BSW_Cal_VehicleInfomationTable.FrntLeMidUss_Pitch "" VALUE 0x3d8290 Record_FLOAT32_IEEE 0 autosar_swc_tos_CM_single -3.4E+38 3.4E+38 /end CHARACTERISTIC
/begin CHARACTERISTIC ZDrive_BSW_Cal_Cal.ZDrive_BSW_Cal_VehicleInfomationTable.FrntLeMidUss_Roll "" VALUE 0x3d828c Record_FLOAT32_IEEE 0 autosar_swc_tos_CM_single -3.4E+38 3.4E+38 /end CHARACTERISTIC
/begin CHARACTERISTIC ZDrive_BSW_Cal_Cal.ZDrive_BSW_Cal_VehicleInfomationTable.FrntLeMidUss_Yaw "" VALUE 0x3d8294 Record_FLOAT32_IEEE 0 autosar_swc_tos_CM_single -3.4E+38 3.4E+38 /end CHARACTERISTIC
/begin CHARACTERISTIC ZDrive_BSW_Cal_Cal.ZDrive_BSW_Cal_VehicleInfomationTable.FrntLeSideUss_Dx "" VALUE 0x3d8244 Record_FLOAT32_IEEE 0 autosar_swc_tos_CM_single -3.4E+38 3.4E+38 /end CHARACTERISTIC
/begin CHARACTERISTIC ZDrive_BSW_Cal_Cal.ZDrive_BSW_Cal_VehicleInfomationTable.FrntLeSideUss_Dy "" VALUE 0x3d8248 Record_FLOAT32_IEEE 0 autosar_swc_tos_CM_single -3.4E+38 3.4E+38 /end CHARACTERISTIC
/begin CHARACTERISTIC ZDrive_BSW_Cal_Cal.ZDrive_BSW_Cal_VehicleInfomationTable.FrntLeSideUss_Dz "" VALUE 0x3d824c Record_FLOAT32_IEEE 0 autosar_swc_tos_CM_single -3.4E+38 3.4E+38 /end CHARACTERISTIC
/begin CHARACTERISTIC ZDrive_BSW_Cal_Cal.ZDrive_BSW_Cal_VehicleInfomationTable.FrntLeSideUss_Pitch "" VALUE 0x3d8258 Record_FLOAT32_IEEE 0 autosar_swc_tos_CM_single -3.4E+38 3.4E+38 /end CHARACTERISTIC
/begin CHARACTERISTIC ZDrive_BSW_Cal_Cal.ZDrive_BSW_Cal_VehicleInfomationTable.FrntLeSideUss_Roll "" VALUE 0x3d8254 Record_FLOAT32_IEEE 0 autosar_swc_tos_CM_single -3.4E+38 3.4E+38 /end CHARACTERISTIC
/begin CHARACTERISTIC ZDrive_BSW_Cal_Cal.ZDrive_BSW_Cal_VehicleInfomationTable.FrntLeSideUss_Yaw "" VALUE 0x3d825c Record_FLOAT32_IEEE 0 autosar_swc_tos_CM_single -3.4E+38 3.4E+38 /end CHARACTERISTIC
/begin CHARACTERISTIC ZDrive_BSW_Cal_Cal.ZDrive_BSW_Cal_VehicleInfomationTable.FrntRiCrnrUss_Dx "" VALUE 0x3d82b4 Record_FLOAT32_IEEE 0 autosar_swc_tos_CM_single -3.4E+38 3.4E+38 /end CHARACTERISTIC
/begin CHARACTERISTIC ZDrive_BSW_Cal_Cal.ZDrive_BSW_Cal_VehicleInfomationTable.FrntRiCrnrUss_Dy "" VALUE 0x3d82b8 Record_FLOAT32_IEEE 0 autosar_swc_tos_CM_single -3.4E+38 3.4E+38 /end CHARACTERISTIC
/begin CHARACTERISTIC ZDrive_BSW_Cal_Cal.ZDrive_BSW_Cal_VehicleInfomationTable.FrntRiCrnrUss_Dz "" VALUE 0x3d82bc Record_FLOAT32_IEEE 0 autosar_swc_tos_CM_single -3.4E+38 3.4E+38 /end CHARACTERISTIC
/begin CHARACTERISTIC ZDrive_BSW_Cal_Cal.ZDrive_BSW_Cal_VehicleInfomationTable.FrntRiCrnrUss_Pitch "" VALUE 0x3d82c8 Record_FLOAT32_IEEE 0 autosar_swc_tos_CM_single -3.4E+38 3.4E+38 /end CHARACTERISTIC
/begin CHARACTERISTIC ZDrive_BSW_Cal_Cal.ZDrive_BSW_Cal_VehicleInfomationTable.FrntRiCrnrUss_Roll "" VALUE 0x3d82c4 Record_FLOAT32_IEEE 0 autosar_swc_tos_CM_single -3.4E+38 3.4E+38 /end CHARACTERISTIC
/begin CHARACTERISTIC ZDrive_BSW_Cal_Cal.ZDrive_BSW_Cal_VehicleInfomationTable.FrntRiCrnrUss_Yaw "" VALUE 0x3d82cc Record_FLOAT32_IEEE 0 autosar_swc_tos_CM_single -3.4E+38 3.4E+38 /end CHARACTERISTIC
/begin CHARACTERISTIC ZDrive_BSW_Cal_Cal.ZDrive_BSW_Cal_VehicleInfomationTable.FrntRiMidUss_Dx "" VALUE 0x3d8298 Record_FLOAT32_IEEE 0 autosar_swc_tos_CM_single -3.4E+38 3.4E+38 /end CHARACTERISTIC
/begin CHARACTERISTIC ZDrive_BSW_Cal_Cal.ZDrive_BSW_Cal_VehicleInfomationTable.FrntRiMidUss_Dy "" VALUE 0x3d829c Record_FLOAT32_IEEE 0 autosar_swc_tos_CM_single -3.4E+38 3.4E+38 /end CHARACTERISTIC
/begin CHARACTERISTIC ZDrive_BSW_Cal_Cal.ZDrive_BSW_Cal_VehicleInfomationTable.FrntRiMidUss_Dz "" VALUE 0x3d82a0 Record_FLOAT32_IEEE 0 autosar_swc_tos_CM_single -3.4E+38 3.4E+38 /end CHARACTERISTIC
/begin CHARACTERISTIC ZDrive_BSW_Cal_Cal.ZDrive_BSW_Cal_VehicleInfomationTable.FrntRiMidUss_Pitch "" VALUE 0x3d82ac Record_FLOAT32_IEEE 0 autosar_swc_tos_CM_single -3.4E+38 3.4E+38 /end CHARACTERISTIC
/begin CHARACTERISTIC ZDrive_BSW_Cal_Cal.ZDrive_BSW_Cal_VehicleInfomationTable.FrntRiMidUss_Roll "" VALUE 0x3d82a8 Record_FLOAT32_IEEE 0 autosar_swc_tos_CM_single -3.4E+38 3.4E+38 /end CHARACTERISTIC
/begin CHARACTERISTIC ZDrive_BSW_Cal_Cal.ZDrive_BSW_Cal_VehicleInfomationTable.FrntRiMidUss_Yaw "" VALUE 0x3d82b0 Record_FLOAT32_IEEE 0 autosar_swc_tos_CM_single -3.4E+38 3.4E+38 /end CHARACTERISTIC
/begin CHARACTERISTIC ZDrive_BSW_Cal_Cal.ZDrive_BSW_Cal_VehicleInfomationTable.FrntRiSideUss_Dx "" VALUE 0x3d82d0 Record_FLOAT32_IEEE 0 autosar_swc_tos_CM_single -3.4E+38 3.4E+38 /end CHARACTERISTIC
/begin CHARACTERISTIC ZDrive_BSW_Cal_Cal.ZDrive_BSW_Cal_VehicleInfomationTable.FrntRiSideUss_Dy "" VALUE 0x3d82d4 Record_FLOAT32_IEEE 0 autosar_swc_tos_CM_single -3.4E+38 3.4E+38 /end CHARACTERISTIC
/begin CHARACTERISTIC ZDrive_BSW_Cal_Cal.ZDrive_BSW_Cal_VehicleInfomationTable.FrntRiSideUss_Dz "" VALUE 0x3d82d8 Record_FLOAT32_IEEE 0 autosar_swc_tos_CM_single -3.4E+38 3.4E+38 /end CHARACTERISTIC
/begin CHARACTERISTIC ZDrive_BSW_Cal_Cal.ZDrive_BSW_Cal_VehicleInfomationTable.FrntRiSideUss_Pitch "" VALUE 0x3d82e4 Record_FLOAT32_IEEE 0 autosar_swc_tos_CM_single -3.4E+38 3.4E+38 /end CHARACTERISTIC
/begin CHARACTERISTIC ZDrive_BSW_Cal_Cal.ZDrive_BSW_Cal_VehicleInfomationTable.FrntRiSideUss_Roll "" VALUE 0x3d82e0 Record_FLOAT32_IEEE 0 autosar_swc_tos_CM_single -3.4E+38 3.4E+38 /end CHARACTERISTIC
/begin CHARACTERISTIC ZDrive_BSW_Cal_Cal.ZDrive_BSW_Cal_VehicleInfomationTable.FrntRiSideUss_Yaw "" VALUE 0x3d82e8 Record_FLOAT32_IEEE 0 autosar_swc_tos_CM_single -3.4E+38 3.4E+38 /end CHARACTERISTIC
/begin CHARACTERISTIC ZDrive_BSW_Cal_Cal.ZDrive_BSW_Cal_VehicleInfomationTable.FrontAxleToCenter_m "" VALUE 0x3d80d0 Record_FLOAT32_IEEE 0 autosar_swc_tos_CM_single -3.4E+38 3.4E+38 /end CHARACTERISTIC
/begin CHARACTERISTIC ZDrive_BSW_Cal_Cal.ZDrive_BSW_Cal_VehicleInfomationTable.FrontAxleToRearAxLeCenterX_m "" VALUE 0x3d80a8 Record_FLOAT32_IEEE 0 autosar_swc_tos_CM_single -3.4E+38 3.4E+38 /end CHARACTERISTIC
/begin CHARACTERISTIC ZDrive_BSW_Cal_Cal.ZDrive_BSW_Cal_VehicleInfomationTable.FrontLeftFrontPointToCenterLine_Distance_m "" VALUE 0x3d80f0 Record_FLOAT32_IEEE 0 autosar_swc_tos_CM_single -3.4E+38 3.4E+38 /end CHARACTERISTIC
/begin CHARACTERISTIC ZDrive_BSW_Cal_Cal.ZDrive_BSW_Cal_VehicleInfomationTable.FrontLeftFrontPointToRearAxleCenter_Distance_m "" VALUE 0x3d80ec Record_FLOAT32_IEEE 0 autosar_swc_tos_CM_single -3.4E+38 3.4E+38 /end CHARACTERISTIC
/begin CHARACTERISTIC ZDrive_BSW_Cal_Cal.ZDrive_BSW_Cal_VehicleInfomationTable.FrontLeftOutsidePointToCenterLine_Distance_m "" VALUE 0x3d80f8 Record_FLOAT32_IEEE 0 autosar_swc_tos_CM_single -3.4E+38 3.4E+38 /end CHARACTERISTIC
/begin CHARACTERISTIC ZDrive_BSW_Cal_Cal.ZDrive_BSW_Cal_VehicleInfomationTable.FrontLeftOutsidePointToRearAxleCenter_Distance_m "" VALUE 0x3d80f4 Record_FLOAT32_IEEE 0 autosar_swc_tos_CM_single -3.4E+38 3.4E+38 /end CHARACTERISTIC
/begin CHARACTERISTIC ZDrive_BSW_Cal_Cal.ZDrive_BSW_Cal_VehicleInfomationTable.FrontOverhang_Length_m "" VALUE 0x3d80b8 Record_FLOAT32_IEEE 0 autosar_swc_tos_CM_single -3.4E+38 3.4E+38 /end CHARACTERISTIC
/begin CHARACTERISTIC ZDrive_BSW_Cal_Cal.ZDrive_BSW_Cal_VehicleInfomationTable.FrontShortCamera_Dx "" VALUE 0x3d81b4 Record_FLOAT32_IEEE 0 autosar_swc_tos_CM_single -3.4E+38 3.4E+38 /end CHARACTERISTIC
/begin CHARACTERISTIC ZDrive_BSW_Cal_Cal.ZDrive_BSW_Cal_VehicleInfomationTable.FrontShortCamera_Dy "" VALUE 0x3d81b8 Record_FLOAT32_IEEE 0 autosar_swc_tos_CM_single -3.4E+38 3.4E+38 /end CHARACTERISTIC
/begin CHARACTERISTIC ZDrive_BSW_Cal_Cal.ZDrive_BSW_Cal_VehicleInfomationTable.FrontShortCamera_Dz "" VALUE 0x3d81bc Record_FLOAT32_IEEE 0 autosar_swc_tos_CM_single -3.4E+38 3.4E+38 /end CHARACTERISTIC
/begin CHARACTERISTIC ZDrive_BSW_Cal_Cal.ZDrive_BSW_Cal_VehicleInfomationTable.FrontShortCamera_Pitch "" VALUE 0x3d81c8 Record_FLOAT32_IEEE 0 autosar_swc_tos_CM_single -3.4E+38 3.4E+38 /end CHARACTERISTIC
/begin CHARACTERISTIC ZDrive_BSW_Cal_Cal.ZDrive_BSW_Cal_VehicleInfomationTable.FrontShortCamera_Roll "" VALUE 0x3d81c4 Record_FLOAT32_IEEE 0 autosar_swc_tos_CM_single -3.4E+38 3.4E+38 /end CHARACTERISTIC
/begin CHARACTERISTIC ZDrive_BSW_Cal_Cal.ZDrive_BSW_Cal_VehicleInfomationTable.FrontShortCamera_Yaw "" VALUE 0x3d81cc Record_FLOAT32_IEEE 0 autosar_swc_tos_CM_single -3.4E+38 3.4E+38 /end CHARACTERISTIC
/begin CHARACTERISTIC ZDrive_BSW_Cal_Cal.ZDrive_BSW_Cal_VehicleInfomationTable.GVW_kg "" VALUE 0x3d8114 Record_FLOAT32_IEEE 0 autosar_swc_tos_CM_single -3.4E+38 3.4E+38 /end CHARACTERISTIC
/begin CHARACTERISTIC ZDrive_BSW_Cal_Cal.ZDrive_BSW_Cal_VehicleInfomationTable.Gear_Box "" VALUE 0x3d806e Record_UBYTE 0 autosar_swc_tos_CM_uint8 0 255 /end CHARACTERISTIC
/begin CHARACTERISTIC ZDrive_BSW_Cal_Cal.ZDrive_BSW_Cal_VehicleInfomationTable.Height_m "" VALUE 0x3d809c Record_FLOAT32_IEEE 0 autosar_swc_tos_CM_single -3.4E+38 3.4E+38 /end CHARACTERISTIC
/begin CHARACTERISTIC ZDrive_BSW_Cal_Cal.ZDrive_BSW_Cal_VehicleInfomationTable.IEnviroment_Bottom_Crop "" VALUE 0x3d8184 Record_SWORD 0 autosar_swc_tos_CM_int16 -32768 32767 /end CHARACTERISTIC
/begin CHARACTERISTIC ZDrive_BSW_Cal_Cal.ZDrive_BSW_Cal_VehicleInfomationTable.IEnviroment_Top_Crop "" VALUE 0x3d8182 Record_UWORD 0 autosar_swc_tos_CM_uint16 0 65535 /end CHARACTERISTIC
/begin CHARACTERISTIC ZDrive_BSW_Cal_Cal.ZDrive_BSW_Cal_VehicleInfomationTable.IEnvironment_CamToFrontAxle "" VALUE 0x3d8160 Record_FLOAT32_IEEE 0 autosar_swc_tos_CM_single -3.4E+38 3.4E+38 /end CHARACTERISTIC
/begin CHARACTERISTIC ZDrive_BSW_Cal_Cal.ZDrive_BSW_Cal_VehicleInfomationTable.IEnvironment_RefPX_Front_Bumper "" VALUE 0x3d817c Record_FLOAT32_IEEE 0 autosar_swc_tos_CM_single -3.4E+38 3.4E+38 /end CHARACTERISTIC
/begin CHARACTERISTIC ZDrive_BSW_Cal_Cal.ZDrive_BSW_Cal_VehicleInfomationTable.IEnvironment_WheelWidth "" VALUE 0x3d8120 Record_FLOAT32_IEEE 0 autosar_swc_tos_CM_single -3.4E+38 3.4E+38 /end CHARACTERISTIC
/begin CHARACTERISTIC ZDrive_BSW_Cal_Cal.ZDrive_BSW_Cal_VehicleInfomationTable.LeSCBlindSpotLength_m "" VALUE 0x3d81f4 Record_FLOAT32_IEEE 0 autosar_swc_tos_CM_single -3.4E+38 3.4E+38 /end CHARACTERISTIC
/begin CHARACTERISTIC ZDrive_BSW_Cal_Cal.ZDrive_BSW_Cal_VehicleInfomationTable.LeSCVerticalDist2Body_m "" VALUE 0x3d81f8 Record_FLOAT32_IEEE 0 autosar_swc_tos_CM_single -3.4E+38 3.4E+38 /end CHARACTERISTIC
/begin CHARACTERISTIC ZDrive_BSW_Cal_Cal.ZDrive_BSW_Cal_VehicleInfomationTable.LeftShortCamera_Dx "" VALUE 0x3d81d8 Record_FLOAT32_IEEE 0 autosar_swc_tos_CM_single -3.4E+38 3.4E+38 /end CHARACTERISTIC
/begin CHARACTERISTIC ZDrive_BSW_Cal_Cal.ZDrive_BSW_Cal_VehicleInfomationTable.LeftShortCamera_Dy "" VALUE 0x3d81dc Record_FLOAT32_IEEE 0 autosar_swc_tos_CM_single -3.4E+38 3.4E+38 /end CHARACTERISTIC
/begin CHARACTERISTIC ZDrive_BSW_Cal_Cal.ZDrive_BSW_Cal_VehicleInfomationTable.LeftShortCamera_Dz "" VALUE 0x3d81e0 Record_FLOAT32_IEEE 0 autosar_swc_tos_CM_single -3.4E+38 3.4E+38 /end CHARACTERISTIC
/begin CHARACTERISTIC ZDrive_BSW_Cal_Cal.ZDrive_BSW_Cal_VehicleInfomationTable.LeftShortCamera_Pitch "" VALUE 0x3d81ec Record_FLOAT32_IEEE 0 autosar_swc_tos_CM_single -3.4E+38 3.4E+38 /end CHARACTERISTIC
/begin CHARACTERISTIC ZDrive_BSW_Cal_Cal.ZDrive_BSW_Cal_VehicleInfomationTable.LeftShortCamera_Roll "" VALUE 0x3d81e8 Record_FLOAT32_IEEE 0 autosar_swc_tos_CM_single -3.4E+38 3.4E+38 /end CHARACTERISTIC
/begin CHARACTERISTIC ZDrive_BSW_Cal_Cal.ZDrive_BSW_Cal_VehicleInfomationTable.LeftShortCamera_Yaw "" VALUE 0x3d81f0 Record_FLOAT32_IEEE 0 autosar_swc_tos_CM_single -3.4E+38 3.4E+38 /end CHARACTERISTIC
/begin CHARACTERISTIC ZDrive_BSW_Cal_Cal.ZDrive_BSW_Cal_VehicleInfomationTable.Left_Right_handType "" VALUE 0x3d8076 Record_UBYTE 0 autosar_swc_tos_CM_uint8 0 255 /end CHARACTERISTIC
/begin CHARACTERISTIC ZDrive_BSW_Cal_Cal.ZDrive_BSW_Cal_VehicleInfomationTable.MaxSteeringAngle "" VALUE 0x3d8140 Record_FLOAT32_IEEE 0 autosar_swc_tos_CM_single -3.4E+38 3.4E+38 /end CHARACTERISTIC
/begin CHARACTERISTIC ZDrive_BSW_Cal_Cal.ZDrive_BSW_Cal_VehicleInfomationTable.ParkingBrakeType "" VALUE 0x3d8072 Record_UBYTE 0 autosar_swc_tos_CM_uint8 0 255 /end CHARACTERISTIC
/begin CHARACTERISTIC ZDrive_BSW_Cal_Cal.ZDrive_BSW_Cal_VehicleInfomationTable.ParkingLongControlInterForm "" VALUE 0x3d8074 Record_UBYTE 0 autosar_swc_tos_CM_uint8 0 255 /end CHARACTERISTIC
/begin CHARACTERISTIC ZDrive_BSW_Cal_Cal.ZDrive_BSW_Cal_VehicleInfomationTable.PitchAngOfCAD "" VALUE 0x3d81ac Record_FLOAT32_IEEE 0 autosar_swc_tos_CM_single -3.4E+38 3.4E+38 /end CHARACTERISTIC
/begin CHARACTERISTIC ZDrive_BSW_Cal_Cal.ZDrive_BSW_Cal_VehicleInfomationTable.PowerTransRatio "" VALUE 0x3d8158 Record_FLOAT32_IEEE 0 autosar_swc_tos_CM_single -3.4E+38 3.4E+38 /end CHARACTERISTIC
/begin CHARACTERISTIC ZDrive_BSW_Cal_Cal.ZDrive_BSW_Cal_VehicleInfomationTable.PowerType "" VALUE 0x3d806a Record_UBYTE 0 autosar_swc_tos_CM_uint8 0 255 /end CHARACTERISTIC
/begin CHARACTERISTIC ZDrive_BSW_Cal_Cal.ZDrive_BSW_Cal_VehicleInfomationTable.RADAR_MOUNT_PARAM_FL_X_POSITION "" VALUE 0x3d83fc Record_FLOAT32_IEEE 0 autosar_swc_tos_CM_single -3.4E+38 3.4E+38 /end CHARACTERISTIC
/begin CHARACTERISTIC ZDrive_BSW_Cal_Cal.ZDrive_BSW_Cal_VehicleInfomationTable.RADAR_MOUNT_PARAM_FL_YAW_ANGLE "" VALUE 0x3d8404 Record_FLOAT32_IEEE 0 autosar_swc_tos_CM_single -3.4E+38 3.4E+38 /end CHARACTERISTIC
/begin CHARACTERISTIC ZDrive_BSW_Cal_Cal.ZDrive_BSW_Cal_VehicleInfomationTable.RADAR_MOUNT_PARAM_FL_Y_POSITION "" VALUE 0x3d8400 Record_FLOAT32_IEEE 0 autosar_swc_tos_CM_single -3.4E+38 3.4E+38 /end CHARACTERISTIC
/begin CHARACTERISTIC ZDrive_BSW_Cal_Cal.ZDrive_BSW_Cal_VehicleInfomationTable.RADAR_MOUNT_PARAM_FRONT_X_POSITION "" VALUE 0x3d83f0 Record_FLOAT32_IEEE 0 autosar_swc_tos_CM_single -3.4E+38 3.4E+38 /end CHARACTERISTIC
/begin CHARACTERISTIC ZDrive_BSW_Cal_Cal.ZDrive_BSW_Cal_VehicleInfomationTable.RADAR_MOUNT_PARAM_FRONT_YAW_ANGLE "" VALUE 0x3d83f8 Record_FLOAT32_IEEE 0 autosar_swc_tos_CM_single -3.4E+38 3.4E+38 /end CHARACTERISTIC
/begin CHARACTERISTIC ZDrive_BSW_Cal_Cal.ZDrive_BSW_Cal_VehicleInfomationTable.RADAR_MOUNT_PARAM_FRONT_Y_POSITION "" VALUE 0x3d83f4 Record_FLOAT32_IEEE 0 autosar_swc_tos_CM_single -3.4E+38 3.4E+38 /end CHARACTERISTIC
/begin CHARACTERISTIC ZDrive_BSW_Cal_Cal.ZDrive_BSW_Cal_VehicleInfomationTable.RADAR_MOUNT_PARAM_FR_X_POSITION "" VALUE 0x3d8408 Record_FLOAT32_IEEE 0 autosar_swc_tos_CM_single -3.4E+38 3.4E+38 /end CHARACTERISTIC
/begin CHARACTERISTIC ZDrive_BSW_Cal_Cal.ZDrive_BSW_Cal_VehicleInfomationTable.RADAR_MOUNT_PARAM_FR_YAW_ANGLE "" VALUE 0x3d8410 Record_FLOAT32_IEEE 0 autosar_swc_tos_CM_single -3.4E+38 3.4E+38 /end CHARACTERISTIC
/begin CHARACTERISTIC ZDrive_BSW_Cal_Cal.ZDrive_BSW_Cal_VehicleInfomationTable.RADAR_MOUNT_PARAM_FR_Y_POSITION "" VALUE 0x3d840c Record_FLOAT32_IEEE 0 autosar_swc_tos_CM_single -3.4E+38 3.4E+38 /end CHARACTERISTIC
/begin CHARACTERISTIC ZDrive_BSW_Cal_Cal.ZDrive_BSW_Cal_VehicleInfomationTable.RADAR_MOUNT_PARAM_RL_X_POSITION "" VALUE 0x3d8414 Record_FLOAT32_IEEE 0 autosar_swc_tos_CM_single -3.4E+38 3.4E+38 /end CHARACTERISTIC
/begin CHARACTERISTIC ZDrive_BSW_Cal_Cal.ZDrive_BSW_Cal_VehicleInfomationTable.RADAR_MOUNT_PARAM_RL_YAW_ANGLE "" VALUE 0x3d841c Record_FLOAT32_IEEE 0 autosar_swc_tos_CM_single -3.4E+38 3.4E+38 /end CHARACTERISTIC
/begin CHARACTERISTIC ZDrive_BSW_Cal_Cal.ZDrive_BSW_Cal_VehicleInfomationTable.RADAR_MOUNT_PARAM_RL_Y_POSITION "" VALUE 0x3d8418 Record_FLOAT32_IEEE 0 autosar_swc_tos_CM_single -3.4E+38 3.4E+38 /end CHARACTERISTIC
/begin CHARACTERISTIC ZDrive_BSW_Cal_Cal.ZDrive_BSW_Cal_VehicleInfomationTable.RADAR_MOUNT_PARAM_RR_X_POSITION "" VALUE 0x3d8420 Record_FLOAT32_IEEE 0 autosar_swc_tos_CM_single -3.4E+38 3.4E+38 /end CHARACTERISTIC
/begin CHARACTERISTIC ZDrive_BSW_Cal_Cal.ZDrive_BSW_Cal_VehicleInfomationTable.RADAR_MOUNT_PARAM_RR_YAW_ANGLE "" VALUE 0x3d8428 Record_FLOAT32_IEEE 0 autosar_swc_tos_CM_single -3.4E+38 3.4E+38 /end CHARACTERISTIC
/begin CHARACTERISTIC ZDrive_BSW_Cal_Cal.ZDrive_BSW_Cal_VehicleInfomationTable.RADAR_MOUNT_PARAM_RR_Y_POSITION "" VALUE 0x3d8424 Record_FLOAT32_IEEE 0 autosar_swc_tos_CM_single -3.4E+38 3.4E+38 /end CHARACTERISTIC
/begin CHARACTERISTIC ZDrive_BSW_Cal_Cal.ZDrive_BSW_Cal_VehicleInfomationTable.RRollingRadius_m "" VALUE 0x3d8154 Record_FLOAT32_IEEE 0 autosar_swc_tos_CM_single -3.4E+38 3.4E+38 /end CHARACTERISTIC
/begin CHARACTERISTIC ZDrive_BSW_Cal_Cal.ZDrive_BSW_Cal_VehicleInfomationTable.ReLeCrnrUss_Dx "" VALUE 0x3d835c Record_FLOAT32_IEEE 0 autosar_swc_tos_CM_single -3.4E+38 3.4E+38 /end CHARACTERISTIC
/begin CHARACTERISTIC ZDrive_BSW_Cal_Cal.ZDrive_BSW_Cal_VehicleInfomationTable.ReLeCrnrUss_Dy "" VALUE 0x3d8360 Record_FLOAT32_IEEE 0 autosar_swc_tos_CM_single -3.4E+38 3.4E+38 /end CHARACTERISTIC
/begin CHARACTERISTIC ZDrive_BSW_Cal_Cal.ZDrive_BSW_Cal_VehicleInfomationTable.ReLeCrnrUss_Dz "" VALUE 0x3d8364 Record_FLOAT32_IEEE 0 autosar_swc_tos_CM_single -3.4E+38 3.4E+38 /end CHARACTERISTIC
/begin CHARACTERISTIC ZDrive_BSW_Cal_Cal.ZDrive_BSW_Cal_VehicleInfomationTable.ReLeCrnrUss_Pitch "" VALUE 0x3d8370 Record_FLOAT32_IEEE 0 autosar_swc_tos_CM_single -3.4E+38 3.4E+38 /end CHARACTERISTIC
/begin CHARACTERISTIC ZDrive_BSW_Cal_Cal.ZDrive_BSW_Cal_VehicleInfomationTable.ReLeCrnrUss_Roll "" VALUE 0x3d836c Record_FLOAT32_IEEE 0 autosar_swc_tos_CM_single -3.4E+38 3.4E+38 /end CHARACTERISTIC
/begin CHARACTERISTIC ZDrive_BSW_Cal_Cal.ZDrive_BSW_Cal_VehicleInfomationTable.ReLeCrnrUss_Yaw "" VALUE 0x3d8374 Record_FLOAT32_IEEE 0 autosar_swc_tos_CM_single -3.4E+38 3.4E+38 /end CHARACTERISTIC
/begin CHARACTERISTIC ZDrive_BSW_Cal_Cal.ZDrive_BSW_Cal_VehicleInfomationTable.ReLeMidUss_Dx "" VALUE 0x3d8340 Record_FLOAT32_IEEE 0 autosar_swc_tos_CM_single -3.4E+38 3.4E+38 /end CHARACTERISTIC
/begin CHARACTERISTIC ZDrive_BSW_Cal_Cal.ZDrive_BSW_Cal_VehicleInfomationTable.ReLeMidUss_Dy "" VALUE 0x3d8344 Record_FLOAT32_IEEE 0 autosar_swc_tos_CM_single -3.4E+38 3.4E+38 /end CHARACTERISTIC
/begin CHARACTERISTIC ZDrive_BSW_Cal_Cal.ZDrive_BSW_Cal_VehicleInfomationTable.ReLeMidUss_Dz "" VALUE 0x3d8348 Record_FLOAT32_IEEE 0 autosar_swc_tos_CM_single -3.4E+38 3.4E+38 /end CHARACTERISTIC
/begin CHARACTERISTIC ZDrive_BSW_Cal_Cal.ZDrive_BSW_Cal_VehicleInfomationTable.ReLeMidUss_Pitch "" VALUE 0x3d8354 Record_FLOAT32_IEEE 0 autosar_swc_tos_CM_single -3.4E+38 3.4E+38 /end CHARACTERISTIC
/begin CHARACTERISTIC ZDrive_BSW_Cal_Cal.ZDrive_BSW_Cal_VehicleInfomationTable.ReLeMidUss_Roll "" VALUE 0x3d8350 Record_FLOAT32_IEEE 0 autosar_swc_tos_CM_single -3.4E+38 3.4E+38 /end CHARACTERISTIC
/begin CHARACTERISTIC ZDrive_BSW_Cal_Cal.ZDrive_BSW_Cal_VehicleInfomationTable.ReLeMidUss_Yaw "" VALUE 0x3d8358 Record_FLOAT32_IEEE 0 autosar_swc_tos_CM_single -3.4E+38 3.4E+38 /end CHARACTERISTIC
/begin CHARACTERISTIC ZDrive_BSW_Cal_Cal.ZDrive_BSW_Cal_VehicleInfomationTable.ReLeSideUss_Dx "" VALUE 0x3d8378 Record_FLOAT32_IEEE 0 autosar_swc_tos_CM_single -3.4E+38 3.4E+38 /end CHARACTERISTIC
/begin CHARACTERISTIC ZDrive_BSW_Cal_Cal.ZDrive_BSW_Cal_VehicleInfomationTable.ReLeSideUss_Dy "" VALUE 0x3d837c Record_FLOAT32_IEEE 0 autosar_swc_tos_CM_single -3.4E+38 3.4E+38 /end CHARACTERISTIC
/begin CHARACTERISTIC ZDrive_BSW_Cal_Cal.ZDrive_BSW_Cal_VehicleInfomationTable.ReLeSideUss_Dz "" VALUE 0x3d8380 Record_FLOAT32_IEEE 0 autosar_swc_tos_CM_single -3.4E+38 3.4E+38 /end CHARACTERISTIC
/begin CHARACTERISTIC ZDrive_BSW_Cal_Cal.ZDrive_BSW_Cal_VehicleInfomationTable.ReLeSideUss_Pitch "" VALUE 0x3d838c Record_FLOAT32_IEEE 0 autosar_swc_tos_CM_single -3.4E+38 3.4E+38 /end CHARACTERISTIC
/begin CHARACTERISTIC ZDrive_BSW_Cal_Cal.ZDrive_BSW_Cal_VehicleInfomationTable.ReLeSideUss_Roll "" VALUE 0x3d8388 Record_FLOAT32_IEEE 0 autosar_swc_tos_CM_single -3.4E+38 3.4E+38 /end CHARACTERISTIC
/begin CHARACTERISTIC ZDrive_BSW_Cal_Cal.ZDrive_BSW_Cal_VehicleInfomationTable.ReLeSideUss_Yaw "" VALUE 0x3d8390 Record_FLOAT32_IEEE 0 autosar_swc_tos_CM_single -3.4E+38 3.4E+38 /end CHARACTERISTIC
/begin CHARACTERISTIC ZDrive_BSW_Cal_Cal.ZDrive_BSW_Cal_VehicleInfomationTable.ReRiCrnrUss_Dx "" VALUE 0x3d8308 Record_FLOAT32_IEEE 0 autosar_swc_tos_CM_single -3.4E+38 3.4E+38 /end CHARACTERISTIC
/begin CHARACTERISTIC ZDrive_BSW_Cal_Cal.ZDrive_BSW_Cal_VehicleInfomationTable.ReRiCrnrUss_Dy "" VALUE 0x3d830c Record_FLOAT32_IEEE 0 autosar_swc_tos_CM_single -3.4E+38 3.4E+38 /end CHARACTERISTIC
/begin CHARACTERISTIC ZDrive_BSW_Cal_Cal.ZDrive_BSW_Cal_VehicleInfomationTable.ReRiCrnrUss_Dz "" VALUE 0x3d8310 Record_FLOAT32_IEEE 0 autosar_swc_tos_CM_single -3.4E+38 3.4E+38 /end CHARACTERISTIC
/begin CHARACTERISTIC ZDrive_BSW_Cal_Cal.ZDrive_BSW_Cal_VehicleInfomationTable.ReRiCrnrUss_Pitch "" VALUE 0x3d831c Record_FLOAT32_IEEE 0 autosar_swc_tos_CM_single -3.4E+38 3.4E+38 /end CHARACTERISTIC
/begin CHARACTERISTIC ZDrive_BSW_Cal_Cal.ZDrive_BSW_Cal_VehicleInfomationTable.ReRiCrnrUss_Roll "" VALUE 0x3d8318 Record_FLOAT32_IEEE 0 autosar_swc_tos_CM_single -3.4E+38 3.4E+38 /end CHARACTERISTIC
/begin CHARACTERISTIC ZDrive_BSW_Cal_Cal.ZDrive_BSW_Cal_VehicleInfomationTable.ReRiCrnrUss_Yaw "" VALUE 0x3d8320 Record_FLOAT32_IEEE 0 autosar_swc_tos_CM_single -3.4E+38 3.4E+38 /end CHARACTERISTIC
/begin CHARACTERISTIC ZDrive_BSW_Cal_Cal.ZDrive_BSW_Cal_VehicleInfomationTable.ReRiMidUss_Dx "" VALUE 0x3d8324 Record_FLOAT32_IEEE 0 autosar_swc_tos_CM_single -3.4E+38 3.4E+38 /end CHARACTERISTIC
/begin CHARACTERISTIC ZDrive_BSW_Cal_Cal.ZDrive_BSW_Cal_VehicleInfomationTable.ReRiMidUss_Dy "" VALUE 0x3d8328 Record_FLOAT32_IEEE 0 autosar_swc_tos_CM_single -3.4E+38 3.4E+38 /end CHARACTERISTIC
/begin CHARACTERISTIC ZDrive_BSW_Cal_Cal.ZDrive_BSW_Cal_VehicleInfomationTable.ReRiMidUss_Dz "" VALUE 0x3d832c Record_FLOAT32_IEEE 0 autosar_swc_tos_CM_single -3.4E+38 3.4E+38 /end CHARACTERISTIC
/begin CHARACTERISTIC ZDrive_BSW_Cal_Cal.ZDrive_BSW_Cal_VehicleInfomationTable.ReRiMidUss_Pitch "" VALUE 0x3d8338 Record_FLOAT32_IEEE 0 autosar_swc_tos_CM_single -3.4E+38 3.4E+38 /end CHARACTERISTIC
/begin CHARACTERISTIC ZDrive_BSW_Cal_Cal.ZDrive_BSW_Cal_VehicleInfomationTable.ReRiMidUss_Roll "" VALUE 0x3d8334 Record_FLOAT32_IEEE 0 autosar_swc_tos_CM_single -3.4E+38 3.4E+38 /end CHARACTERISTIC
/begin CHARACTERISTIC ZDrive_BSW_Cal_Cal.ZDrive_BSW_Cal_VehicleInfomationTable.ReRiMidUss_Yaw "" VALUE 0x3d833c Record_FLOAT32_IEEE 0 autosar_swc_tos_CM_single -3.4E+38 3.4E+38 /end CHARACTERISTIC
/begin CHARACTERISTIC ZDrive_BSW_Cal_Cal.ZDrive_BSW_Cal_VehicleInfomationTable.ReRiSideUss_Dx "" VALUE 0x3d82ec Record_FLOAT32_IEEE 0 autosar_swc_tos_CM_single -3.4E+38 3.4E+38 /end CHARACTERISTIC
/begin CHARACTERISTIC ZDrive_BSW_Cal_Cal.ZDrive_BSW_Cal_VehicleInfomationTable.ReRiSideUss_Dy "" VALUE 0x3d82f0 Record_FLOAT32_IEEE 0 autosar_swc_tos_CM_single -3.4E+38 3.4E+38 /end CHARACTERISTIC
/begin CHARACTERISTIC ZDrive_BSW_Cal_Cal.ZDrive_BSW_Cal_VehicleInfomationTable.ReRiSideUss_Dz "" VALUE 0x3d82f4 Record_FLOAT32_IEEE 0 autosar_swc_tos_CM_single -3.4E+38 3.4E+38 /end CHARACTERISTIC
/begin CHARACTERISTIC ZDrive_BSW_Cal_Cal.ZDrive_BSW_Cal_VehicleInfomationTable.ReRiSideUss_Pitch "" VALUE 0x3d8300 Record_FLOAT32_IEEE 0 autosar_swc_tos_CM_single -3.4E+38 3.4E+38 /end CHARACTERISTIC
/begin CHARACTERISTIC ZDrive_BSW_Cal_Cal.ZDrive_BSW_Cal_VehicleInfomationTable.ReRiSideUss_Roll "" VALUE 0x3d82fc Record_FLOAT32_IEEE 0 autosar_swc_tos_CM_single -3.4E+38 3.4E+38 /end CHARACTERISTIC
/begin CHARACTERISTIC ZDrive_BSW_Cal_Cal.ZDrive_BSW_Cal_VehicleInfomationTable.ReRiSideUss_Yaw "" VALUE 0x3d8304 Record_FLOAT32_IEEE 0 autosar_swc_tos_CM_single -3.4E+38 3.4E+38 /end CHARACTERISTIC
/begin CHARACTERISTIC ZDrive_BSW_Cal_Cal.ZDrive_BSW_Cal_VehicleInfomationTable.ReSCBlindSpotLength_m "" VALUE 0x3d8218 Record_FLOAT32_IEEE 0 autosar_swc_tos_CM_single -3.4E+38 3.4E+38 /end CHARACTERISTIC
/begin CHARACTERISTIC ZDrive_BSW_Cal_Cal.ZDrive_BSW_Cal_VehicleInfomationTable.ReSCDist2OuterMostSide_m "" VALUE 0x3d821c Record_FLOAT32_IEEE 0 autosar_swc_tos_CM_single -3.4E+38 3.4E+38 /end CHARACTERISTIC
/begin CHARACTERISTIC ZDrive_BSW_Cal_Cal.ZDrive_BSW_Cal_VehicleInfomationTable.ReWhlHousingHeight_m "" VALUE 0x3d80c4 Record_FLOAT32_IEEE 0 autosar_swc_tos_CM_single -3.4E+38 3.4E+38 /end CHARACTERISTIC
/begin CHARACTERISTIC ZDrive_BSW_Cal_Cal.ZDrive_BSW_Cal_VehicleInfomationTable.ReWhlTrack_m "" VALUE 0x3d80b4 Record_FLOAT32_IEEE 0 autosar_swc_tos_CM_single -3.4E+38 3.4E+38 /end CHARACTERISTIC
/begin CHARACTERISTIC ZDrive_BSW_Cal_Cal.ZDrive_BSW_Cal_VehicleInfomationTable.RearAxleToCenter_m "" VALUE 0x3d80d4 Record_FLOAT32_IEEE 0 autosar_swc_tos_CM_single -3.4E+38 3.4E+38 /end CHARACTERISTIC
/begin CHARACTERISTIC ZDrive_BSW_Cal_Cal.ZDrive_BSW_Cal_VehicleInfomationTable.RearAxlecCenterTurningCircle "" VALUE 0x3d8148 Record_FLOAT32_IEEE 0 autosar_swc_tos_CM_single -3.4E+38 3.4E+38 /end CHARACTERISTIC
/begin CHARACTERISTIC ZDrive_BSW_Cal_Cal.ZDrive_BSW_Cal_VehicleInfomationTable.RearLeftOutsidePointToCenterLine_Distance_m "" VALUE 0x3d8100 Record_FLOAT32_IEEE 0 autosar_swc_tos_CM_single -3.4E+38 3.4E+38 /end CHARACTERISTIC
/begin CHARACTERISTIC ZDrive_BSW_Cal_Cal.ZDrive_BSW_Cal_VehicleInfomationTable.RearLeftOutsidePointToRearAxleCenter_Distance_m "" VALUE 0x3d80fc Record_FLOAT32_IEEE 0 autosar_swc_tos_CM_single -3.4E+38 3.4E+38 /end CHARACTERISTIC
/begin CHARACTERISTIC ZDrive_BSW_Cal_Cal.ZDrive_BSW_Cal_VehicleInfomationTable.RearLeftRearPointToCenterLine_Distance_m "" VALUE 0x3d8108 Record_FLOAT32_IEEE 0 autosar_swc_tos_CM_single -3.4E+38 3.4E+38 /end CHARACTERISTIC
/begin CHARACTERISTIC ZDrive_BSW_Cal_Cal.ZDrive_BSW_Cal_VehicleInfomationTable.RearLeftRearPointToRearAxleCenter_Distance_m "" VALUE 0x3d8104 Record_FLOAT32_IEEE 0 autosar_swc_tos_CM_single -3.4E+38 3.4E+38 /end CHARACTERISTIC
/begin CHARACTERISTIC ZDrive_BSW_Cal_Cal.ZDrive_BSW_Cal_VehicleInfomationTable.RearOverhang_Length_m "" VALUE 0x3d80bc Record_FLOAT32_IEEE 0 autosar_swc_tos_CM_single -3.4E+38 3.4E+38 /end CHARACTERISTIC
/begin CHARACTERISTIC ZDrive_BSW_Cal_Cal.ZDrive_BSW_Cal_VehicleInfomationTable.RearShortCamera_Dx "" VALUE 0x3d81fc Record_FLOAT32_IEEE 0 autosar_swc_tos_CM_single -3.4E+38 3.4E+38 /end CHARACTERISTIC
/begin CHARACTERISTIC ZDrive_BSW_Cal_Cal.ZDrive_BSW_Cal_VehicleInfomationTable.RearShortCamera_Dy "" VALUE 0x3d8200 Record_FLOAT32_IEEE 0 autosar_swc_tos_CM_single -3.4E+38 3.4E+38 /end CHARACTERISTIC
/begin CHARACTERISTIC ZDrive_BSW_Cal_Cal.ZDrive_BSW_Cal_VehicleInfomationTable.RearShortCamera_Dz "" VALUE 0x3d8204 Record_FLOAT32_IEEE 0 autosar_swc_tos_CM_single -3.4E+38 3.4E+38 /end CHARACTERISTIC
/begin CHARACTERISTIC ZDrive_BSW_Cal_Cal.ZDrive_BSW_Cal_VehicleInfomationTable.RearShortCamera_Pitch "" VALUE 0x3d8210 Record_FLOAT32_IEEE 0 autosar_swc_tos_CM_single -3.4E+38 3.4E+38 /end CHARACTERISTIC
/begin CHARACTERISTIC ZDrive_BSW_Cal_Cal.ZDrive_BSW_Cal_VehicleInfomationTable.RearShortCamera_Roll "" VALUE 0x3d820c Record_FLOAT32_IEEE 0 autosar_swc_tos_CM_single -3.4E+38 3.4E+38 /end CHARACTERISTIC
/begin CHARACTERISTIC ZDrive_BSW_Cal_Cal.ZDrive_BSW_Cal_VehicleInfomationTable.RearShortCamera_Yaw "" VALUE 0x3d8214 Record_FLOAT32_IEEE 0 autosar_swc_tos_CM_single -3.4E+38 3.4E+38 /end CHARACTERISTIC
/begin CHARACTERISTIC ZDrive_BSW_Cal_Cal.ZDrive_BSW_Cal_VehicleInfomationTable.RearViewMirrorBottomSide_Height "" VALUE 0x3d80e4 Record_FLOAT32_IEEE 0 autosar_swc_tos_CM_single -3.4E+38 3.4E+38 /end CHARACTERISTIC
/begin CHARACTERISTIC ZDrive_BSW_Cal_Cal.ZDrive_BSW_Cal_VehicleInfomationTable.RearViewMirrorLength_On_X "" VALUE 0x3d80dc Record_FLOAT32_IEEE 0 autosar_swc_tos_CM_single -3.4E+38 3.4E+38 /end CHARACTERISTIC
/begin CHARACTERISTIC ZDrive_BSW_Cal_Cal.ZDrive_BSW_Cal_VehicleInfomationTable.RearViewMirrorLength_On_Y "" VALUE 0x3d80d8 Record_FLOAT32_IEEE 0 autosar_swc_tos_CM_single -3.4E+38 3.4E+38 /end CHARACTERISTIC
/begin CHARACTERISTIC ZDrive_BSW_Cal_Cal.ZDrive_BSW_Cal_VehicleInfomationTable.RearViewMirrorOutsidePointToRearAxle_Diatance_m "" VALUE 0x3d80e8 Record_FLOAT32_IEEE 0 autosar_swc_tos_CM_single -3.4E+38 3.4E+38 /end CHARACTERISTIC
/begin CHARACTERISTIC ZDrive_BSW_Cal_Cal.ZDrive_BSW_Cal_VehicleInfomationTable.RearViewMirrorTopSide_Height "" VALUE 0x3d80e0 Record_FLOAT32_IEEE 0 autosar_swc_tos_CM_single -3.4E+38 3.4E+38 /end CHARACTERISTIC
/begin CHARACTERISTIC ZDrive_BSW_Cal_Cal.ZDrive_BSW_Cal_VehicleInfomationTable.RiSCBlindSpotLength_m "" VALUE 0x3d823c Record_FLOAT32_IEEE 0 autosar_swc_tos_CM_single -3.4E+38 3.4E+38 /end CHARACTERISTIC
/begin CHARACTERISTIC ZDrive_BSW_Cal_Cal.ZDrive_BSW_Cal_VehicleInfomationTable.RiSCVerticalDist2Body_m "" VALUE 0x3d8240 Record_FLOAT32_IEEE 0 autosar_swc_tos_CM_single -3.4E+38 3.4E+38 /end CHARACTERISTIC
/begin CHARACTERISTIC ZDrive_BSW_Cal_Cal.ZDrive_BSW_Cal_VehicleInfomationTable.RightShortCamera_Dx "" VALUE 0x3d8220 Record_FLOAT32_IEEE 0 autosar_swc_tos_CM_single -3.4E+38 3.4E+38 /end CHARACTERISTIC
/begin CHARACTERISTIC ZDrive_BSW_Cal_Cal.ZDrive_BSW_Cal_VehicleInfomationTable.RightShortCamera_Dy "" VALUE 0x3d8224 Record_FLOAT32_IEEE 0 autosar_swc_tos_CM_single -3.4E+38 3.4E+38 /end CHARACTERISTIC
/begin CHARACTERISTIC ZDrive_BSW_Cal_Cal.ZDrive_BSW_Cal_VehicleInfomationTable.RightShortCamera_Dz "" VALUE 0x3d8228 Record_FLOAT32_IEEE 0 autosar_swc_tos_CM_single -3.4E+38 3.4E+38 /end CHARACTERISTIC
/begin CHARACTERISTIC ZDrive_BSW_Cal_Cal.ZDrive_BSW_Cal_VehicleInfomationTable.RightShortCamera_Pitch "" VALUE 0x3d8234 Record_FLOAT32_IEEE 0 autosar_swc_tos_CM_single -3.4E+38 3.4E+38 /end CHARACTERISTIC
/begin CHARACTERISTIC ZDrive_BSW_Cal_Cal.ZDrive_BSW_Cal_VehicleInfomationTable.RightShortCamera_Roll "" VALUE 0x3d8230 Record_FLOAT32_IEEE 0 autosar_swc_tos_CM_single -3.4E+38 3.4E+38 /end CHARACTERISTIC
/begin CHARACTERISTIC ZDrive_BSW_Cal_Cal.ZDrive_BSW_Cal_VehicleInfomationTable.RightShortCamera_Yaw "" VALUE 0x3d8238 Record_FLOAT32_IEEE 0 autosar_swc_tos_CM_single -3.4E+38 3.4E+38 /end CHARACTERISTIC
/begin CHARACTERISTIC ZDrive_BSW_Cal_Cal.ZDrive_BSW_Cal_VehicleInfomationTable.RollingAngOfCAD "" VALUE 0x3d81a8 Record_FLOAT32_IEEE 0 autosar_swc_tos_CM_single -3.4E+38 3.4E+38 /end CHARACTERISTIC
/begin CHARACTERISTIC ZDrive_BSW_Cal_Cal.ZDrive_BSW_Cal_VehicleInfomationTable.SideSlipAnglefactor "" VALUE 0x3d813c Record_FLOAT32_IEEE 0 autosar_swc_tos_CM_single -3.4E+38 3.4E+38 /end CHARACTERISTIC
/begin CHARACTERISTIC ZDrive_BSW_Cal_Cal.ZDrive_BSW_Cal_VehicleInfomationTable.SteeringAngleRatio "" VALUE 0x3d8144 Record_FLOAT32_IEEE 0 autosar_swc_tos_CM_single -3.4E+38 3.4E+38 /end CHARACTERISTIC
/begin CHARACTERISTIC ZDrive_BSW_Cal_Cal.ZDrive_BSW_Cal_VehicleInfomationTable.StrWhlAngSigDirect "" VALUE 0x3d807a Record_UBYTE 0 autosar_swc_tos_CM_uint8 0 255 /end CHARACTERISTIC
/begin CHARACTERISTIC ZDrive_BSW_Cal_Cal.ZDrive_BSW_Cal_VehicleInfomationTable.StrWhlConfig "" VALUE 0x3d8073 Record_UBYTE 0 autosar_swc_tos_CM_uint8 0 255 /end CHARACTERISTIC
/begin CHARACTERISTIC ZDrive_BSW_Cal_Cal.ZDrive_BSW_Cal_VehicleInfomationTable.StrWhlMappingTable "" VALUE 0x3d814c Record_FLOAT32_IEEE 0 autosar_swc_tos_CM_single -3.4E+38 3.4E+38 /end CHARACTERISTIC
/begin CHARACTERISTIC ZDrive_BSW_Cal_Cal.ZDrive_BSW_Cal_VehicleInfomationTable.Suspension "" VALUE 0x3d8082 Record_UBYTE 0 autosar_swc_tos_CM_uint8 0 255 /end CHARACTERISTIC
/begin CHARACTERISTIC ZDrive_BSW_Cal_Cal.ZDrive_BSW_Cal_VehicleInfomationTable.TAC_Bottom "" VALUE 0x3d8180 Record_SBYTE 0 autosar_swc_tos_CM_int8 -128 127 /end CHARACTERISTIC
/begin CHARACTERISTIC ZDrive_BSW_Cal_Cal.ZDrive_BSW_Cal_VehicleInfomationTable.TAC_Camera_Height "" VALUE 0x3d815c Record_FLOAT32_IEEE 0 autosar_swc_tos_CM_single -3.4E+38 3.4E+38 /end CHARACTERISTIC
/begin CHARACTERISTIC ZDrive_BSW_Cal_Cal.ZDrive_BSW_Cal_VehicleInfomationTable.TAC_Targets_Num "" VALUE 0x3d8190 Record_UBYTE 0 autosar_swc_tos_CM_uint8 0 255 /end CHARACTERISTIC
/begin CHARACTERISTIC ZDrive_BSW_Cal_Cal.ZDrive_BSW_Cal_VehicleInfomationTable.TireRadius_m "" VALUE 0x3d811c Record_FLOAT32_IEEE 0 autosar_swc_tos_CM_single -3.4E+38 3.4E+38 /end CHARACTERISTIC
/begin CHARACTERISTIC ZDrive_BSW_Cal_Cal.ZDrive_BSW_Cal_VehicleInfomationTable.TurnLevelType "" VALUE 0x3d806c Record_UBYTE 0 autosar_swc_tos_CM_uint8 0 255 /end CHARACTERISTIC
/begin CHARACTERISTIC ZDrive_BSW_Cal_Cal.ZDrive_BSW_Cal_VehicleInfomationTable.UltraInstallAng_FA "" VALUE 0x3d8398 Record_FLOAT32_IEEE 0 autosar_swc_tos_CM_single -3.4E+38 3.4E+38 /end CHARACTERISTIC
/begin CHARACTERISTIC ZDrive_BSW_Cal_Cal.ZDrive_BSW_Cal_VehicleInfomationTable.UltraInstallAng_FM "" VALUE 0x3d8394 Record_FLOAT32_IEEE 0 autosar_swc_tos_CM_single -3.4E+38 3.4E+38 /end CHARACTERISTIC
/begin CHARACTERISTIC ZDrive_BSW_Cal_Cal.ZDrive_BSW_Cal_VehicleInfomationTable.UltraInstallAng_FS "" VALUE 0x3d839c Record_FLOAT32_IEEE 0 autosar_swc_tos_CM_single -3.4E+38 3.4E+38 /end CHARACTERISTIC
/begin CHARACTERISTIC ZDrive_BSW_Cal_Cal.ZDrive_BSW_Cal_VehicleInfomationTable.UltraInstallAng_RA "" VALUE 0x3d83b4 Record_FLOAT32_IEEE 0 autosar_swc_tos_CM_single -3.4E+38 3.4E+38 /end CHARACTERISTIC
/begin CHARACTERISTIC ZDrive_BSW_Cal_Cal.ZDrive_BSW_Cal_VehicleInfomationTable.UltraInstallAng_RM "" VALUE 0x3d83b0 Record_FLOAT32_IEEE 0 autosar_swc_tos_CM_single -3.4E+38 3.4E+38 /end CHARACTERISTIC
/begin CHARACTERISTIC ZDrive_BSW_Cal_Cal.ZDrive_BSW_Cal_VehicleInfomationTable.UltraInstallAng_RS "" VALUE 0x3d83b8 Record_FLOAT32_IEEE 0 autosar_swc_tos_CM_single -3.4E+38 3.4E+38 /end CHARACTERISTIC
/begin CHARACTERISTIC ZDrive_BSW_Cal_Cal.ZDrive_BSW_Cal_VehicleInfomationTable.UltraInstallHeight_FA_m "" VALUE 0x3d83cc Record_FLOAT32_IEEE 0 autosar_swc_tos_CM_single -3.4E+38 3.4E+38 /end CHARACTERISTIC
/begin CHARACTERISTIC ZDrive_BSW_Cal_Cal.ZDrive_BSW_Cal_VehicleInfomationTable.UltraInstallHeight_FM_m "" VALUE 0x3d83c8 Record_FLOAT32_IEEE 0 autosar_swc_tos_CM_single -3.4E+38 3.4E+38 /end CHARACTERISTIC
/begin CHARACTERISTIC ZDrive_BSW_Cal_Cal.ZDrive_BSW_Cal_VehicleInfomationTable.UltraInstallHeight_FS_m "" VALUE 0x3d83d0 Record_FLOAT32_IEEE 0 autosar_swc_tos_CM_single -3.4E+38 3.4E+38 /end CHARACTERISTIC
/begin CHARACTERISTIC ZDrive_BSW_Cal_Cal.ZDrive_BSW_Cal_VehicleInfomationTable.UltraInstallHeight_RA_m "" VALUE 0x3d83d8 Record_FLOAT32_IEEE 0 autosar_swc_tos_CM_single -3.4E+38 3.4E+38 /end CHARACTERISTIC
/begin CHARACTERISTIC ZDrive_BSW_Cal_Cal.ZDrive_BSW_Cal_VehicleInfomationTable.UltraInstallHeight_RM_m "" VALUE 0x3d83d4 Record_FLOAT32_IEEE 0 autosar_swc_tos_CM_single -3.4E+38 3.4E+38 /end CHARACTERISTIC
/begin CHARACTERISTIC ZDrive_BSW_Cal_Cal.ZDrive_BSW_Cal_VehicleInfomationTable.UltraInstallHeight_RS_m "" VALUE 0x3d83dc Record_FLOAT32_IEEE 0 autosar_swc_tos_CM_single -3.4E+38 3.4E+38 /end CHARACTERISTIC
/begin CHARACTERISTIC ZDrive_BSW_Cal_Cal.ZDrive_BSW_Cal_VehicleInfomationTable.UltraInstallLatOffset_FA_m "" VALUE 0x3d83a4 Record_FLOAT32_IEEE 0 autosar_swc_tos_CM_single -3.4E+38 3.4E+38 /end CHARACTERISTIC
/begin CHARACTERISTIC ZDrive_BSW_Cal_Cal.ZDrive_BSW_Cal_VehicleInfomationTable.UltraInstallLatOffset_FM_m "" VALUE 0x3d83a0 Record_FLOAT32_IEEE 0 autosar_swc_tos_CM_single -3.4E+38 3.4E+38 /end CHARACTERISTIC
/begin CHARACTERISTIC ZDrive_BSW_Cal_Cal.ZDrive_BSW_Cal_VehicleInfomationTable.UltraInstallLatOffset_FS_m "" VALUE 0x3d83a8 Record_FLOAT32_IEEE 0 autosar_swc_tos_CM_single -3.4E+38 3.4E+38 /end CHARACTERISTIC
/begin CHARACTERISTIC ZDrive_BSW_Cal_Cal.ZDrive_BSW_Cal_VehicleInfomationTable.UltraInstallLatOffset_RA_m "" VALUE 0x3d83c0 Record_FLOAT32_IEEE 0 autosar_swc_tos_CM_single -3.4E+38 3.4E+38 /end CHARACTERISTIC
/begin CHARACTERISTIC ZDrive_BSW_Cal_Cal.ZDrive_BSW_Cal_VehicleInfomationTable.UltraInstallLatOffset_RM_m "" VALUE 0x3d83bc Record_FLOAT32_IEEE 0 autosar_swc_tos_CM_single -3.4E+38 3.4E+38 /end CHARACTERISTIC
/begin CHARACTERISTIC ZDrive_BSW_Cal_Cal.ZDrive_BSW_Cal_VehicleInfomationTable.UltraInstallLatOffset_RS_m "" VALUE 0x3d83c4 Record_FLOAT32_IEEE 0 autosar_swc_tos_CM_single -3.4E+38 3.4E+38 /end CHARACTERISTIC
/begin CHARACTERISTIC ZDrive_BSW_Cal_Cal.ZDrive_BSW_Cal_VehicleInfomationTable.VISION_MOUNT_PARAM_FRONT_X_POSITION "" VALUE 0x3d83e4 Record_FLOAT32_IEEE 0 autosar_swc_tos_CM_single -3.4E+38 3.4E+38 /end CHARACTERISTIC
/begin CHARACTERISTIC ZDrive_BSW_Cal_Cal.ZDrive_BSW_Cal_VehicleInfomationTable.VISION_MOUNT_PARAM_FRONT_YAW_ANGLE "" VALUE 0x3d83ec Record_FLOAT32_IEEE 0 autosar_swc_tos_CM_single -3.4E+38 3.4E+38 /end CHARACTERISTIC
/begin CHARACTERISTIC ZDrive_BSW_Cal_Cal.ZDrive_BSW_Cal_VehicleInfomationTable.VISION_MOUNT_PARAM_FRONT_Y_POSITION "" VALUE 0x3d83e8 Record_FLOAT32_IEEE 0 autosar_swc_tos_CM_single -3.4E+38 3.4E+38 /end CHARACTERISTIC
/begin CHARACTERISTIC ZDrive_BSW_Cal_Cal.ZDrive_BSW_Cal_VehicleInfomationTable.ValFunc_Reserve1 "" VALUE 0x3d807f Record_UBYTE 0 autosar_swc_tos_CM_uint8 0 255 /end CHARACTERISTIC
/begin CHARACTERISTIC ZDrive_BSW_Cal_Cal.ZDrive_BSW_Cal_VehicleInfomationTable.ValFunc_Reserve2 "" VALUE 0x3d8080 Record_UBYTE 0 autosar_swc_tos_CM_uint8 0 255 /end CHARACTERISTIC
/begin CHARACTERISTIC ZDrive_BSW_Cal_Cal.ZDrive_BSW_Cal_VehicleInfomationTable.VehConfig_Code1 "" VALUE 0x3d8060 Record_ULONG 0 autosar_swc_tos_CM_uint32 0 4294967295 /end CHARACTERISTIC
/begin CHARACTERISTIC ZDrive_BSW_Cal_Cal.ZDrive_BSW_Cal_VehicleInfomationTable.VehConfig_Code2 "" VALUE 0x3d8064 Record_ULONG 0 autosar_swc_tos_CM_uint32 0 4294967295 /end CHARACTERISTIC
/begin CHARACTERISTIC ZDrive_BSW_Cal_Cal.ZDrive_BSW_Cal_VehicleInfomationTable.VehicleWidthMax_m "" VALUE 0x3d8094 Record_FLOAT32_IEEE 0 autosar_swc_tos_CM_single -3.4E+38 3.4E+38 /end CHARACTERISTIC
/begin CHARACTERISTIC ZDrive_BSW_Cal_Cal.ZDrive_BSW_Cal_VehicleInfomationTable.VehicleWidthMin_m "" VALUE 0x3d8098 Record_FLOAT32_IEEE 0 autosar_swc_tos_CM_single -3.4E+38 3.4E+38 /end CHARACTERISTIC
/begin CHARACTERISTIC ZDrive_BSW_Cal_Cal.ZDrive_BSW_Cal_VehicleInfomationTable.Vehicle_Information_End_Tag "" VALUE 0x3d855f Record_UBYTE 0 autosar_swc_tos_CM_uint8 0 255 /end CHARACTERISTIC
/begin CHARACTERISTIC ZDrive_BSW_Cal_Cal.ZDrive_BSW_Cal_VehicleInfomationTable.Vehicle_Information_Reserved_Line102 "" VALUE 0x3d8181 Record_UBYTE 0 autosar_swc_tos_CM_uint8 0 255 /end CHARACTERISTIC
/begin CHARACTERISTIC ZDrive_BSW_Cal_Cal.ZDrive_BSW_Cal_VehicleInfomationTable.Vehicle_Information_Reserved_Line105 "" VALUE 0x3d8186 Record_UWORD 0 autosar_swc_tos_CM_uint16 0 65535 /end CHARACTERISTIC
/begin CHARACTERISTIC ZDrive_BSW_Cal_Cal.ZDrive_BSW_Cal_VehicleInfomationTable.Vehicle_Information_Reserved_Line109 "" VALUE 0x3d8191 Record_UBYTE 0 autosar_swc_tos_CM_uint8 0 255 /end CHARACTERISTIC
/begin CHARACTERISTIC ZDrive_BSW_Cal_Cal.ZDrive_BSW_Cal_VehicleInfomationTable.Vehicle_Information_Reserved_Line110 "" VALUE 0x3d8192 Record_UWORD 0 autosar_swc_tos_CM_uint16 0 65535 /end CHARACTERISTIC
/begin CHARACTERISTIC ZDrive_BSW_Cal_Cal.ZDrive_BSW_Cal_VehicleInfomationTable.Vehicle_Information_Reserved_Line115 "" VALUE 0x3d81a4 Record_ULONG 0 autosar_swc_tos_CM_uint32 0 4294967295 /end CHARACTERISTIC
/begin CHARACTERISTIC ZDrive_BSW_Cal_Cal.ZDrive_BSW_Cal_VehicleInfomationTable.Vehicle_Information_Reserved_Line122 "" VALUE 0x3d81c0 Record_ULONG 0 autosar_swc_tos_CM_uint32 0 4294967295 /end CHARACTERISTIC
/begin CHARACTERISTIC ZDrive_BSW_Cal_Cal.ZDrive_BSW_Cal_VehicleInfomationTable.Vehicle_Information_Reserved_Line131 "" VALUE 0x3d81e4 Record_ULONG 0 autosar_swc_tos_CM_uint32 0 4294967295 /end CHARACTERISTIC
/begin CHARACTERISTIC ZDrive_BSW_Cal_Cal.ZDrive_BSW_Cal_VehicleInfomationTable.Vehicle_Information_Reserved_Line140 "" VALUE 0x3d8208 Record_ULONG 0 autosar_swc_tos_CM_uint32 0 4294967295 /end CHARACTERISTIC
/begin CHARACTERISTIC ZDrive_BSW_Cal_Cal.ZDrive_BSW_Cal_VehicleInfomationTable.Vehicle_Information_Reserved_Line149 "" VALUE 0x3d822c Record_ULONG 0 autosar_swc_tos_CM_uint32 0 4294967295 /end CHARACTERISTIC
/begin CHARACTERISTIC ZDrive_BSW_Cal_Cal.ZDrive_BSW_Cal_VehicleInfomationTable.Vehicle_Information_Reserved_Line158 "" VALUE 0x3d8250 Record_ULONG 0 autosar_swc_tos_CM_uint32 0 4294967295 /end CHARACTERISTIC
/begin CHARACTERISTIC ZDrive_BSW_Cal_Cal.ZDrive_BSW_Cal_VehicleInfomationTable.Vehicle_Information_Reserved_Line165 "" VALUE 0x3d826c Record_ULONG 0 autosar_swc_tos_CM_uint32 0 4294967295 /end CHARACTERISTIC
/begin CHARACTERISTIC ZDrive_BSW_Cal_Cal.ZDrive_BSW_Cal_VehicleInfomationTable.Vehicle_Information_Reserved_Line172 "" VALUE 0x3d8288 Record_ULONG 0 autosar_swc_tos_CM_uint32 0 4294967295 /end CHARACTERISTIC
/begin CHARACTERISTIC ZDrive_BSW_Cal_Cal.ZDrive_BSW_Cal_VehicleInfomationTable.Vehicle_Information_Reserved_Line179 "" VALUE 0x3d82a4 Record_ULONG 0 autosar_swc_tos_CM_uint32 0 4294967295 /end CHARACTERISTIC
/begin CHARACTERISTIC ZDrive_BSW_Cal_Cal.ZDrive_BSW_Cal_VehicleInfomationTable.Vehicle_Information_Reserved_Line186 "" VALUE 0x3d82c0 Record_ULONG 0 autosar_swc_tos_CM_uint32 0 4294967295 /end CHARACTERISTIC
/begin CHARACTERISTIC ZDrive_BSW_Cal_Cal.ZDrive_BSW_Cal_VehicleInfomationTable.Vehicle_Information_Reserved_Line193 "" VALUE 0x3d82dc Record_ULONG 0 autosar_swc_tos_CM_uint32 0 4294967295 /end CHARACTERISTIC
/begin CHARACTERISTIC ZDrive_BSW_Cal_Cal.ZDrive_BSW_Cal_VehicleInfomationTable.Vehicle_Information_Reserved_Line200 "" VALUE 0x3d82f8 Record_ULONG 0 autosar_swc_tos_CM_uint32 0 4294967295 /end CHARACTERISTIC
/begin CHARACTERISTIC ZDrive_BSW_Cal_Cal.ZDrive_BSW_Cal_VehicleInfomationTable.Vehicle_Information_Reserved_Line207 "" VALUE 0x3d8314 Record_ULONG 0 autosar_swc_tos_CM_uint32 0 4294967295 /end CHARACTERISTIC
/begin CHARACTERISTIC ZDrive_BSW_Cal_Cal.ZDrive_BSW_Cal_VehicleInfomationTable.Vehicle_Information_Reserved_Line214 "" VALUE 0x3d8330 Record_ULONG 0 autosar_swc_tos_CM_uint32 0 4294967295 /end CHARACTERISTIC
/begin CHARACTERISTIC ZDrive_BSW_Cal_Cal.ZDrive_BSW_Cal_VehicleInfomationTable.Vehicle_Information_Reserved_Line221 "" VALUE 0x3d834c Record_ULONG 0 autosar_swc_tos_CM_uint32 0 4294967295 /end CHARACTERISTIC
/begin CHARACTERISTIC ZDrive_BSW_Cal_Cal.ZDrive_BSW_Cal_VehicleInfomationTable.Vehicle_Information_Reserved_Line228 "" VALUE 0x3d8368 Record_ULONG 0 autosar_swc_tos_CM_uint32 0 4294967295 /end CHARACTERISTIC
/begin CHARACTERISTIC ZDrive_BSW_Cal_Cal.ZDrive_BSW_Cal_VehicleInfomationTable.Vehicle_Information_Reserved_Line235 "" VALUE 0x3d8384 Record_ULONG 0 autosar_swc_tos_CM_uint32 0 4294967295 /end CHARACTERISTIC
/begin CHARACTERISTIC ZDrive_BSW_Cal_Cal.ZDrive_BSW_Cal_VehicleInfomationTable.Vehicle_Information_Reserved_Line24 "" VALUE 0x0 Record_UBYTE 0 autosar_swc_tos_CM_uint8 0 255 /end CHARACTERISTIC
/begin CHARACTERISTIC ZDrive_BSW_Cal_Cal.ZDrive_BSW_Cal_VehicleInfomationTable.Vehicle_Information_Reserved_Line245 "" VALUE 0x3d83ac Record_ULONG 0 autosar_swc_tos_CM_uint32 0 4294967295 /end CHARACTERISTIC
/begin CHARACTERISTIC ZDrive_BSW_Cal_Cal.ZDrive_BSW_Cal_VehicleInfomationTable.Vehicle_Information_Reserved_Line25 "" VALUE 0x0 Record_UBYTE 0 autosar_swc_tos_CM_uint8 0 255 /end CHARACTERISTIC
/begin CHARACTERISTIC ZDrive_BSW_Cal_Cal.ZDrive_BSW_Cal_VehicleInfomationTable.Vehicle_Information_Reserved_Line258 "" VALUE 0x3d83e0 Record_ULONG 0 autosar_swc_tos_CM_uint32 0 4294967295 /end CHARACTERISTIC
/begin CHARACTERISTIC ZDrive_BSW_Cal_Cal.ZDrive_BSW_Cal_VehicleInfomationTable.Vehicle_Information_Reserved_Line26 "" VALUE 0x3d807e Record_UBYTE 0 autosar_swc_tos_CM_uint8 0 255 /end CHARACTERISTIC
/begin CHARACTERISTIC ZDrive_BSW_Cal_Cal.ZDrive_BSW_Cal_VehicleInfomationTable.Vehicle_Information_Reserved_Line277 "" VALUE 0x3d842c Record_ULONG 0 autosar_swc_tos_CM_uint32 0 4294967295 /end CHARACTERISTIC
/begin CHARACTERISTIC ZDrive_BSW_Cal_Cal.ZDrive_BSW_Cal_VehicleInfomationTable.Vehicle_Information_Reserved_Line278 "" VALUE 0x3d8430 Record_ULONG 0 autosar_swc_tos_CM_uint32 0 4294967295 /end CHARACTERISTIC
/begin CHARACTERISTIC ZDrive_BSW_Cal_Cal.ZDrive_BSW_Cal_VehicleInfomationTable.Vehicle_Information_Reserved_Line279 "" VALUE 0x3d8434 Record_ULONG 0 autosar_swc_tos_CM_uint32 0 4294967295 /end CHARACTERISTIC
/begin CHARACTERISTIC ZDrive_BSW_Cal_Cal.ZDrive_BSW_Cal_VehicleInfomationTable.Vehicle_Information_Reserved_Line280 "" VALUE 0x3d8438 Record_ULONG 0 autosar_swc_tos_CM_uint32 0 4294967295 /end CHARACTERISTIC
/begin CHARACTERISTIC ZDrive_BSW_Cal_Cal.ZDrive_BSW_Cal_VehicleInfomationTable.Vehicle_Information_Reserved_Line281 "" VALUE 0x3d843c Record_ULONG 0 autosar_swc_tos_CM_uint32 0 4294967295 /end CHARACTERISTIC
/begin CHARACTERISTIC ZDrive_BSW_Cal_Cal.ZDrive_BSW_Cal_VehicleInfomationTable.Vehicle_Information_Reserved_Line282 "" VALUE 0x3d8440 Record_ULONG 0 autosar_swc_tos_CM_uint32 0 4294967295 /end CHARACTERISTIC
/begin CHARACTERISTIC ZDrive_BSW_Cal_Cal.ZDrive_BSW_Cal_VehicleInfomationTable.Vehicle_Information_Reserved_Line283 "" VALUE 0x3d8444 Record_ULONG 0 autosar_swc_tos_CM_uint32 0 4294967295 /end CHARACTERISTIC
/begin CHARACTERISTIC ZDrive_BSW_Cal_Cal.ZDrive_BSW_Cal_VehicleInfomationTable.Vehicle_Information_Reserved_Line284 "" VALUE 0x3d8448 Record_ULONG 0 autosar_swc_tos_CM_uint32 0 4294967295 /end CHARACTERISTIC
/begin CHARACTERISTIC ZDrive_BSW_Cal_Cal.ZDrive_BSW_Cal_VehicleInfomationTable.Vehicle_Information_Reserved_Line285 "" VALUE 0x3d844c Record_ULONG 0 autosar_swc_tos_CM_uint32 0 4294967295 /end CHARACTERISTIC
/begin CHARACTERISTIC ZDrive_BSW_Cal_Cal.ZDrive_BSW_Cal_VehicleInfomationTable.Vehicle_Information_Reserved_Line286 "" VALUE 0x3d8450 Record_ULONG 0 autosar_swc_tos_CM_uint32 0 4294967295 /end CHARACTERISTIC
/begin CHARACTERISTIC ZDrive_BSW_Cal_Cal.ZDrive_BSW_Cal_VehicleInfomationTable.Vehicle_Information_Reserved_Line287 "" VALUE 0x3d8454 Record_ULONG 0 autosar_swc_tos_CM_uint32 0 4294967295 /end CHARACTERISTIC
/begin CHARACTERISTIC ZDrive_BSW_Cal_Cal.ZDrive_BSW_Cal_VehicleInfomationTable.Vehicle_Information_Reserved_Line288 "" VALUE 0x3d8458 Record_ULONG 0 autosar_swc_tos_CM_uint32 0 4294967295 /end CHARACTERISTIC
/begin CHARACTERISTIC ZDrive_BSW_Cal_Cal.ZDrive_BSW_Cal_VehicleInfomationTable.Vehicle_Information_Reserved_Line289 "" VALUE 0x3d845c Record_ULONG 0 autosar_swc_tos_CM_uint32 0 4294967295 /end CHARACTERISTIC
/begin CHARACTERISTIC ZDrive_BSW_Cal_Cal.ZDrive_BSW_Cal_VehicleInfomationTable.Vehicle_Information_Reserved_Line290 "" VALUE 0x3d8460 Record_ULONG 0 autosar_swc_tos_CM_uint32 0 4294967295 /end CHARACTERISTIC
/begin CHARACTERISTIC ZDrive_BSW_Cal_Cal.ZDrive_BSW_Cal_VehicleInfomationTable.Vehicle_Information_Reserved_Line291 "" VALUE 0x3d8464 Record_ULONG 0 autosar_swc_tos_CM_uint32 0 4294967295 /end CHARACTERISTIC
/begin CHARACTERISTIC ZDrive_BSW_Cal_Cal.ZDrive_BSW_Cal_VehicleInfomationTable.Vehicle_Information_Reserved_Line292 "" VALUE 0x3d8468 Record_ULONG 0 autosar_swc_tos_CM_uint32 0 4294967295 /end CHARACTERISTIC
/begin CHARACTERISTIC ZDrive_BSW_Cal_Cal.ZDrive_BSW_Cal_VehicleInfomationTable.Vehicle_Information_Reserved_Line293 "" VALUE 0x3d846c Record_ULONG 0 autosar_swc_tos_CM_uint32 0 4294967295 /end CHARACTERISTIC
/begin CHARACTERISTIC ZDrive_BSW_Cal_Cal.ZDrive_BSW_Cal_VehicleInfomationTable.Vehicle_Information_Reserved_Line294 "" VALUE 0x3d8470 Record_ULONG 0 autosar_swc_tos_CM_uint32 0 4294967295 /end CHARACTERISTIC
/begin CHARACTERISTIC ZDrive_BSW_Cal_Cal.ZDrive_BSW_Cal_VehicleInfomationTable.Vehicle_Information_Reserved_Line295 "" VALUE 0x3d8474 Record_ULONG 0 autosar_swc_tos_CM_uint32 0 4294967295 /end CHARACTERISTIC
/begin CHARACTERISTIC ZDrive_BSW_Cal_Cal.ZDrive_BSW_Cal_VehicleInfomationTable.Vehicle_Information_Reserved_Line296 "" VALUE 0x3d8478 Record_ULONG 0 autosar_swc_tos_CM_uint32 0 4294967295 /end CHARACTERISTIC
/begin CHARACTERISTIC ZDrive_BSW_Cal_Cal.ZDrive_BSW_Cal_VehicleInfomationTable.Vehicle_Information_Reserved_Line297 "" VALUE 0x3d847c Record_ULONG 0 autosar_swc_tos_CM_uint32 0 4294967295 /end CHARACTERISTIC
/begin CHARACTERISTIC ZDrive_BSW_Cal_Cal.ZDrive_BSW_Cal_VehicleInfomationTable.Vehicle_Information_Reserved_Line298 "" VALUE 0x3d8480 Record_ULONG 0 autosar_swc_tos_CM_uint32 0 4294967295 /end CHARACTERISTIC
/begin CHARACTERISTIC ZDrive_BSW_Cal_Cal.ZDrive_BSW_Cal_VehicleInfomationTable.Vehicle_Information_Reserved_Line299 "" VALUE 0x3d8484 Record_ULONG 0 autosar_swc_tos_CM_uint32 0 4294967295 /end CHARACTERISTIC
/begin CHARACTERISTIC ZDrive_BSW_Cal_Cal.ZDrive_BSW_Cal_VehicleInfomationTable.Vehicle_Information_Reserved_Line300 "" VALUE 0x3d8488 Record_ULONG 0 autosar_swc_tos_CM_uint32 0 4294967295 /end CHARACTERISTIC
/begin CHARACTERISTIC ZDrive_BSW_Cal_Cal.ZDrive_BSW_Cal_VehicleInfomationTable.Vehicle_Information_Reserved_Line301 "" VALUE 0x3d848c Record_ULONG 0 autosar_swc_tos_CM_uint32 0 4294967295 /end CHARACTERISTIC
/begin CHARACTERISTIC ZDrive_BSW_Cal_Cal.ZDrive_BSW_Cal_VehicleInfomationTable.Vehicle_Information_Reserved_Line302 "" VALUE 0x3d8490 Record_ULONG 0 autosar_swc_tos_CM_uint32 0 4294967295 /end CHARACTERISTIC
/begin CHARACTERISTIC ZDrive_BSW_Cal_Cal.ZDrive_BSW_Cal_VehicleInfomationTable.Vehicle_Information_Reserved_Line303 "" VALUE 0x3d8494 Record_ULONG 0 autosar_swc_tos_CM_uint32 0 4294967295 /end CHARACTERISTIC
/begin CHARACTERISTIC ZDrive_BSW_Cal_Cal.ZDrive_BSW_Cal_VehicleInfomationTable.Vehicle_Information_Reserved_Line304 "" VALUE 0x3d8498 Record_ULONG 0 autosar_swc_tos_CM_uint32 0 4294967295 /end CHARACTERISTIC
/begin CHARACTERISTIC ZDrive_BSW_Cal_Cal.ZDrive_BSW_Cal_VehicleInfomationTable.Vehicle_Information_Reserved_Line305 "" VALUE 0x3d849c Record_ULONG 0 autosar_swc_tos_CM_uint32 0 4294967295 /end CHARACTERISTIC
/begin CHARACTERISTIC ZDrive_BSW_Cal_Cal.ZDrive_BSW_Cal_VehicleInfomationTable.Vehicle_Information_Reserved_Line306 "" VALUE 0x3d84a0 Record_ULONG 0 autosar_swc_tos_CM_uint32 0 4294967295 /end CHARACTERISTIC
/begin CHARACTERISTIC ZDrive_BSW_Cal_Cal.ZDrive_BSW_Cal_VehicleInfomationTable.Vehicle_Information_Reserved_Line307 "" VALUE 0x3d84a4 Record_ULONG 0 autosar_swc_tos_CM_uint32 0 4294967295 /end CHARACTERISTIC
/begin CHARACTERISTIC ZDrive_BSW_Cal_Cal.ZDrive_BSW_Cal_VehicleInfomationTable.Vehicle_Information_Reserved_Line308 "" VALUE 0x3d84a8 Record_ULONG 0 autosar_swc_tos_CM_uint32 0 4294967295 /end CHARACTERISTIC
/begin CHARACTERISTIC ZDrive_BSW_Cal_Cal.ZDrive_BSW_Cal_VehicleInfomationTable.Vehicle_Information_Reserved_Line309 "" VALUE 0x3d84ac Record_ULONG 0 autosar_swc_tos_CM_uint32 0 4294967295 /end CHARACTERISTIC
/begin CHARACTERISTIC ZDrive_BSW_Cal_Cal.ZDrive_BSW_Cal_VehicleInfomationTable.Vehicle_Information_Reserved_Line31 "" VALUE 0x3d8083 Record_UBYTE 0 autosar_swc_tos_CM_uint8 0 255 /end CHARACTERISTIC
/begin CHARACTERISTIC ZDrive_BSW_Cal_Cal.ZDrive_BSW_Cal_VehicleInfomationTable.Vehicle_Information_Reserved_Line310 "" VALUE 0x3d84b0 Record_ULONG 0 autosar_swc_tos_CM_uint32 0 4294967295 /end CHARACTERISTIC
/begin CHARACTERISTIC ZDrive_BSW_Cal_Cal.ZDrive_BSW_Cal_VehicleInfomationTable.Vehicle_Information_Reserved_Line311 "" VALUE 0x3d84b4 Record_ULONG 0 autosar_swc_tos_CM_uint32 0 4294967295 /end CHARACTERISTIC
/begin CHARACTERISTIC ZDrive_BSW_Cal_Cal.ZDrive_BSW_Cal_VehicleInfomationTable.Vehicle_Information_Reserved_Line312 "" VALUE 0x3d84b8 Record_ULONG 0 autosar_swc_tos_CM_uint32 0 4294967295 /end CHARACTERISTIC
/begin CHARACTERISTIC ZDrive_BSW_Cal_Cal.ZDrive_BSW_Cal_VehicleInfomationTable.Vehicle_Information_Reserved_Line313 "" VALUE 0x3d84bc Record_ULONG 0 autosar_swc_tos_CM_uint32 0 4294967295 /end CHARACTERISTIC
/begin CHARACTERISTIC ZDrive_BSW_Cal_Cal.ZDrive_BSW_Cal_VehicleInfomationTable.Vehicle_Information_Reserved_Line314 "" VALUE 0x3d84c0 Record_ULONG 0 autosar_swc_tos_CM_uint32 0 4294967295 /end CHARACTERISTIC
/begin CHARACTERISTIC ZDrive_BSW_Cal_Cal.ZDrive_BSW_Cal_VehicleInfomationTable.Vehicle_Information_Reserved_Line315 "" VALUE 0x3d84c4 Record_ULONG 0 autosar_swc_tos_CM_uint32 0 4294967295 /end CHARACTERISTIC
/begin CHARACTERISTIC ZDrive_BSW_Cal_Cal.ZDrive_BSW_Cal_VehicleInfomationTable.Vehicle_Information_Reserved_Line316 "" VALUE 0x3d84c8 Record_ULONG 0 autosar_swc_tos_CM_uint32 0 4294967295 /end CHARACTERISTIC
/begin CHARACTERISTIC ZDrive_BSW_Cal_Cal.ZDrive_BSW_Cal_VehicleInfomationTable.Vehicle_Information_Reserved_Line317 "" VALUE 0x3d84cc Record_ULONG 0 autosar_swc_tos_CM_uint32 0 4294967295 /end CHARACTERISTIC
/begin CHARACTERISTIC ZDrive_BSW_Cal_Cal.ZDrive_BSW_Cal_VehicleInfomationTable.Vehicle_Information_Reserved_Line318 "" VALUE 0x3d84d0 Record_ULONG 0 autosar_swc_tos_CM_uint32 0 4294967295 /end CHARACTERISTIC
/begin CHARACTERISTIC ZDrive_BSW_Cal_Cal.ZDrive_BSW_Cal_VehicleInfomationTable.Vehicle_Information_Reserved_Line319 "" VALUE 0x3d84d4 Record_ULONG 0 autosar_swc_tos_CM_uint32 0 4294967295 /end CHARACTERISTIC
/begin CHARACTERISTIC ZDrive_BSW_Cal_Cal.ZDrive_BSW_Cal_VehicleInfomationTable.Vehicle_Information_Reserved_Line32 "" VALUE 0x3d8084 Record_UWORD 0 autosar_swc_tos_CM_uint16 0 65535 /end CHARACTERISTIC
/begin CHARACTERISTIC ZDrive_BSW_Cal_Cal.ZDrive_BSW_Cal_VehicleInfomationTable.Vehicle_Information_Reserved_Line320 "" VALUE 0x3d84d8 Record_ULONG 0 autosar_swc_tos_CM_uint32 0 4294967295 /end CHARACTERISTIC
/begin CHARACTERISTIC ZDrive_BSW_Cal_Cal.ZDrive_BSW_Cal_VehicleInfomationTable.Vehicle_Information_Reserved_Line321 "" VALUE 0x3d84dc Record_ULONG 0 autosar_swc_tos_CM_uint32 0 4294967295 /end CHARACTERISTIC
/begin CHARACTERISTIC ZDrive_BSW_Cal_Cal.ZDrive_BSW_Cal_VehicleInfomationTable.Vehicle_Information_Reserved_Line322 "" VALUE 0x3d84e0 Record_ULONG 0 autosar_swc_tos_CM_uint32 0 4294967295 /end CHARACTERISTIC
/begin CHARACTERISTIC ZDrive_BSW_Cal_Cal.ZDrive_BSW_Cal_VehicleInfomationTable.Vehicle_Information_Reserved_Line323 "" VALUE 0x3d84e4 Record_ULONG 0 autosar_swc_tos_CM_uint32 0 4294967295 /end CHARACTERISTIC
/begin CHARACTERISTIC ZDrive_BSW_Cal_Cal.ZDrive_BSW_Cal_VehicleInfomationTable.Vehicle_Information_Reserved_Line324 "" VALUE 0x3d84e8 Record_ULONG 0 autosar_swc_tos_CM_uint32 0 4294967295 /end CHARACTERISTIC
/begin CHARACTERISTIC ZDrive_BSW_Cal_Cal.ZDrive_BSW_Cal_VehicleInfomationTable.Vehicle_Information_Reserved_Line325 "" VALUE 0x3d84ec Record_ULONG 0 autosar_swc_tos_CM_uint32 0 4294967295 /end CHARACTERISTIC
/begin CHARACTERISTIC ZDrive_BSW_Cal_Cal.ZDrive_BSW_Cal_VehicleInfomationTable.Vehicle_Information_Reserved_Line326 "" VALUE 0x3d84f0 Record_ULONG 0 autosar_swc_tos_CM_uint32 0 4294967295 /end CHARACTERISTIC
/begin CHARACTERISTIC ZDrive_BSW_Cal_Cal.ZDrive_BSW_Cal_VehicleInfomationTable.Vehicle_Information_Reserved_Line327 "" VALUE 0x3d84f4 Record_ULONG 0 autosar_swc_tos_CM_uint32 0 4294967295 /end CHARACTERISTIC
/begin CHARACTERISTIC ZDrive_BSW_Cal_Cal.ZDrive_BSW_Cal_VehicleInfomationTable.Vehicle_Information_Reserved_Line328 "" VALUE 0x3d84f8 Record_ULONG 0 autosar_swc_tos_CM_uint32 0 4294967295 /end CHARACTERISTIC
/begin CHARACTERISTIC ZDrive_BSW_Cal_Cal.ZDrive_BSW_Cal_VehicleInfomationTable.Vehicle_Information_Reserved_Line329 "" VALUE 0x3d84fc Record_ULONG 0 autosar_swc_tos_CM_uint32 0 4294967295 /end CHARACTERISTIC
/begin CHARACTERISTIC ZDrive_BSW_Cal_Cal.ZDrive_BSW_Cal_VehicleInfomationTable.Vehicle_Information_Reserved_Line33 "" VALUE 0x3d8086 Record_UWORD 0 autosar_swc_tos_CM_uint16 0 65535 /end CHARACTERISTIC
/begin CHARACTERISTIC ZDrive_BSW_Cal_Cal.ZDrive_BSW_Cal_VehicleInfomationTable.Vehicle_Information_Reserved_Line330 "" VALUE 0x3d8500 Record_ULONG 0 autosar_swc_tos_CM_uint32 0 4294967295 /end CHARACTERISTIC
/begin CHARACTERISTIC ZDrive_BSW_Cal_Cal.ZDrive_BSW_Cal_VehicleInfomationTable.Vehicle_Information_Reserved_Line331 "" VALUE 0x3d8504 Record_ULONG 0 autosar_swc_tos_CM_uint32 0 4294967295 /end CHARACTERISTIC
/begin CHARACTERISTIC ZDrive_BSW_Cal_Cal.ZDrive_BSW_Cal_VehicleInfomationTable.Vehicle_Information_Reserved_Line332 "" VALUE 0x3d8508 Record_ULONG 0 autosar_swc_tos_CM_uint32 0 4294967295 /end CHARACTERISTIC
/begin CHARACTERISTIC ZDrive_BSW_Cal_Cal.ZDrive_BSW_Cal_VehicleInfomationTable.Vehicle_Information_Reserved_Line333 "" VALUE 0x3d850c Record_ULONG 0 autosar_swc_tos_CM_uint32 0 4294967295 /end CHARACTERISTIC
/begin CHARACTERISTIC ZDrive_BSW_Cal_Cal.ZDrive_BSW_Cal_VehicleInfomationTable.Vehicle_Information_Reserved_Line334 "" VALUE 0x3d8510 Record_ULONG 0 autosar_swc_tos_CM_uint32 0 4294967295 /end CHARACTERISTIC
/begin CHARACTERISTIC ZDrive_BSW_Cal_Cal.ZDrive_BSW_Cal_VehicleInfomationTable.Vehicle_Information_Reserved_Line335 "" VALUE 0x3d8514 Record_ULONG 0 autosar_swc_tos_CM_uint32 0 4294967295 /end CHARACTERISTIC
/begin CHARACTERISTIC ZDrive_BSW_Cal_Cal.ZDrive_BSW_Cal_VehicleInfomationTable.Vehicle_Information_Reserved_Line336 "" VALUE 0x3d8518 Record_ULONG 0 autosar_swc_tos_CM_uint32 0 4294967295 /end CHARACTERISTIC
/begin CHARACTERISTIC ZDrive_BSW_Cal_Cal.ZDrive_BSW_Cal_VehicleInfomationTable.Vehicle_Information_Reserved_Line337 "" VALUE 0x3d851c Record_ULONG 0 autosar_swc_tos_CM_uint32 0 4294967295 /end CHARACTERISTIC
/begin CHARACTERISTIC ZDrive_BSW_Cal_Cal.ZDrive_BSW_Cal_VehicleInfomationTable.Vehicle_Information_Reserved_Line338 "" VALUE 0x3d8520 Record_ULONG 0 autosar_swc_tos_CM_uint32 0 4294967295 /end CHARACTERISTIC
/begin CHARACTERISTIC ZDrive_BSW_Cal_Cal.ZDrive_BSW_Cal_VehicleInfomationTable.Vehicle_Information_Reserved_Line339 "" VALUE 0x3d8524 Record_ULONG 0 autosar_swc_tos_CM_uint32 0 4294967295 /end CHARACTERISTIC
/begin CHARACTERISTIC ZDrive_BSW_Cal_Cal.ZDrive_BSW_Cal_VehicleInfomationTable.Vehicle_Information_Reserved_Line34 "" VALUE 0x3d8088 Record_UWORD 0 autosar_swc_tos_CM_uint16 0 65535 /end CHARACTERISTIC
/begin CHARACTERISTIC ZDrive_BSW_Cal_Cal.ZDrive_BSW_Cal_VehicleInfomationTable.Vehicle_Information_Reserved_Line340 "" VALUE 0x3d8528 Record_ULONG 0 autosar_swc_tos_CM_uint32 0 4294967295 /end CHARACTERISTIC
/begin CHARACTERISTIC ZDrive_BSW_Cal_Cal.ZDrive_BSW_Cal_VehicleInfomationTable.Vehicle_Information_Reserved_Line341 "" VALUE 0x3d852c Record_ULONG 0 autosar_swc_tos_CM_uint32 0 4294967295 /end CHARACTERISTIC
/begin CHARACTERISTIC ZDrive_BSW_Cal_Cal.ZDrive_BSW_Cal_VehicleInfomationTable.Vehicle_Information_Reserved_Line342 "" VALUE 0x3d8530 Record_ULONG 0 autosar_swc_tos_CM_uint32 0 4294967295 /end CHARACTERISTIC
/begin CHARACTERISTIC ZDrive_BSW_Cal_Cal.ZDrive_BSW_Cal_VehicleInfomationTable.Vehicle_Information_Reserved_Line343 "" VALUE 0x3d8534 Record_ULONG 0 autosar_swc_tos_CM_uint32 0 4294967295 /end CHARACTERISTIC
/begin CHARACTERISTIC ZDrive_BSW_Cal_Cal.ZDrive_BSW_Cal_VehicleInfomationTable.Vehicle_Information_Reserved_Line344 "" VALUE 0x3d8538 Record_ULONG 0 autosar_swc_tos_CM_uint32 0 4294967295 /end CHARACTERISTIC
/begin CHARACTERISTIC ZDrive_BSW_Cal_Cal.ZDrive_BSW_Cal_VehicleInfomationTable.Vehicle_Information_Reserved_Line345 "" VALUE 0x3d853c Record_ULONG 0 autosar_swc_tos_CM_uint32 0 4294967295 /end CHARACTERISTIC
/begin CHARACTERISTIC ZDrive_BSW_Cal_Cal.ZDrive_BSW_Cal_VehicleInfomationTable.Vehicle_Information_Reserved_Line346 "" VALUE 0x3d8540 Record_ULONG 0 autosar_swc_tos_CM_uint32 0 4294967295 /end CHARACTERISTIC
/begin CHARACTERISTIC ZDrive_BSW_Cal_Cal.ZDrive_BSW_Cal_VehicleInfomationTable.Vehicle_Information_Reserved_Line347 "" VALUE 0x3d8544 Record_ULONG 0 autosar_swc_tos_CM_uint32 0 4294967295 /end CHARACTERISTIC
/begin CHARACTERISTIC ZDrive_BSW_Cal_Cal.ZDrive_BSW_Cal_VehicleInfomationTable.Vehicle_Information_Reserved_Line348 "" VALUE 0x3d8548 Record_ULONG 0 autosar_swc_tos_CM_uint32 0 4294967295 /end CHARACTERISTIC
/begin CHARACTERISTIC ZDrive_BSW_Cal_Cal.ZDrive_BSW_Cal_VehicleInfomationTable.Vehicle_Information_Reserved_Line349 "" VALUE 0x3d854c Record_ULONG 0 autosar_swc_tos_CM_uint32 0 4294967295 /end CHARACTERISTIC
/begin CHARACTERISTIC ZDrive_BSW_Cal_Cal.ZDrive_BSW_Cal_VehicleInfomationTable.Vehicle_Information_Reserved_Line35 "" VALUE 0x3d808a Record_UWORD 0 autosar_swc_tos_CM_uint16 0 65535 /end CHARACTERISTIC
/begin CHARACTERISTIC ZDrive_BSW_Cal_Cal.ZDrive_BSW_Cal_VehicleInfomationTable.Vehicle_Information_Reserved_Line350 "" VALUE 0x3d8550 Record_ULONG 0 autosar_swc_tos_CM_uint32 0 4294967295 /end CHARACTERISTIC
/begin CHARACTERISTIC ZDrive_BSW_Cal_Cal.ZDrive_BSW_Cal_VehicleInfomationTable.Vehicle_Information_Reserved_Line351 "" VALUE 0x3d8554 Record_ULONG 0 autosar_swc_tos_CM_uint32 0 4294967295 /end CHARACTERISTIC
/begin CHARACTERISTIC ZDrive_BSW_Cal_Cal.ZDrive_BSW_Cal_VehicleInfomationTable.Vehicle_Information_Reserved_Line352 "" VALUE 0x3d8558 Record_ULONG 0 autosar_swc_tos_CM_uint32 0 4294967295 /end CHARACTERISTIC
/begin CHARACTERISTIC ZDrive_BSW_Cal_Cal.ZDrive_BSW_Cal_VehicleInfomationTable.Vehicle_Information_Reserved_Line353 "" VALUE 0x3d855c Record_UWORD 0 autosar_swc_tos_CM_uint16 0 65535 /end CHARACTERISTIC
/begin CHARACTERISTIC ZDrive_BSW_Cal_Cal.ZDrive_BSW_Cal_VehicleInfomationTable.Vehicle_Information_Reserved_Line354 "" VALUE 0x3d855e Record_UBYTE 0 autosar_swc_tos_CM_uint8 0 255 /end CHARACTERISTIC
/begin CHARACTERISTIC ZDrive_BSW_Cal_Cal.ZDrive_BSW_Cal_VehicleInfomationTable.Vehicle_Information_Reserved_Line36 "" VALUE 0x3d808c Record_UWORD 0 autosar_swc_tos_CM_uint16 0 65535 /end CHARACTERISTIC
/begin CHARACTERISTIC ZDrive_BSW_Cal_Cal.ZDrive_BSW_Cal_VehicleInfomationTable.Vehicle_Information_Reserved_Line37 "" VALUE 0x3d808e Record_UWORD 0 autosar_swc_tos_CM_uint16 0 65535 /end CHARACTERISTIC
/begin CHARACTERISTIC ZDrive_BSW_Cal_Cal.ZDrive_BSW_Cal_VehicleInfomationTable.Vehicle_Information_Reserved_Line81 "" VALUE 0x3d8134 Record_UWORD 0 autosar_swc_tos_CM_uint16 0 65535 /end CHARACTERISTIC
/begin CHARACTERISTIC ZDrive_BSW_Cal_Cal.ZDrive_BSW_Cal_VehicleInfomationTable.Vehicle_Information_Reserved_Line82 "" VALUE 0x3d8136 Record_UWORD 0 autosar_swc_tos_CM_uint16 0 65535 /end CHARACTERISTIC
/begin CHARACTERISTIC ZDrive_BSW_Cal_Cal.ZDrive_BSW_Cal_VehicleInfomationTable.Vehicle_Length_m "" VALUE 0x3d8090 Record_FLOAT32_IEEE 0 autosar_swc_tos_CM_single -3.4E+38 3.4E+38 /end CHARACTERISTIC
/begin CHARACTERISTIC ZDrive_BSW_Cal_Cal.ZDrive_BSW_Cal_VehicleInfomationTable.Vehicle_Model "" VALUE 0x3d8069 Record_UBYTE 0 autosar_swc_tos_CM_uint8 0 255 /end CHARACTERISTIC
/begin CHARACTERISTIC ZDrive_BSW_Cal_Cal.ZDrive_BSW_Cal_VehicleInfomationTable.Weight_N "" VALUE 0x3d8110 Record_FLOAT32_IEEE 0 autosar_swc_tos_CM_single -3.4E+38 3.4E+38 /end CHARACTERISTIC
/begin CHARACTERISTIC ZDrive_BSW_Cal_Cal.ZDrive_BSW_Cal_VehicleInfomationTable.WheelBase_m "" VALUE 0x3d80a4 Record_FLOAT32_IEEE 0 autosar_swc_tos_CM_single -3.4E+38 3.4E+38 /end CHARACTERISTIC
/begin CHARACTERISTIC ZDrive_BSW_Cal_Cal.ZDrive_BSW_Cal_VehicleInfomationTable.WheelDiameter "" VALUE 0x3d8124 Record_FLOAT32_IEEE 0 autosar_swc_tos_CM_single -3.4E+38 3.4E+38 /end CHARACTERISTIC
/begin CHARACTERISTIC ZDrive_BSW_Cal_Cal.ZDrive_BSW_Cal_VehicleInfomationTable.WheelSpeedCounterIsUnsigned "" VALUE 0x3d8130 Record_UWORD 0 autosar_swc_tos_CM_uint16 0 65535 /end CHARACTERISTIC
/begin CHARACTERISTIC ZDrive_BSW_Cal_Cal.ZDrive_BSW_Cal_VehicleInfomationTable.WheelSpeedCounterMax "" VALUE 0x3d812c Record_UWORD 0 autosar_swc_tos_CM_uint16 0 65535 /end CHARACTERISTIC
/begin CHARACTERISTIC ZDrive_BSW_Cal_Cal.ZDrive_BSW_Cal_VehicleInfomationTable.WheelSpeedCounterMin "" VALUE 0x3d8132 Record_UWORD 0 autosar_swc_tos_CM_uint16 0 65535 /end CHARACTERISTIC
/begin CHARACTERISTIC ZDrive_BSW_Cal_Cal.ZDrive_BSW_Cal_VehicleInfomationTable.WheelSpeedCounterPulse "" VALUE 0x3d812e Record_UWORD 0 autosar_swc_tos_CM_uint16 0 65535 /end CHARACTERISTIC
/begin CHARACTERISTIC ZDrive_BSW_Cal_Cal.ZDrive_BSW_Cal_VehicleInfomationTable.WheelTrack_m "" VALUE 0x3d80ac Record_FLOAT32_IEEE 0 autosar_swc_tos_CM_single -3.4E+38 3.4E+38 /end CHARACTERISTIC
/begin CHARACTERISTIC ZDrive_BSW_Cal_Cal.ZDrive_BSW_Cal_VehicleInfomationTable.WhlSpdSensUnitPulseDist "" VALUE 0x3d8128 Record_FLOAT32_IEEE 0 autosar_swc_tos_CM_single -3.4E+38 3.4E+38 /end CHARACTERISTIC
/begin CHARACTERISTIC ZDrive_BSW_Cal_Cal.ZDrive_BSW_Cal_VehicleInfomationTable.YawAngOfCAD "" VALUE 0x3d81b0 Record_FLOAT32_IEEE 0 autosar_swc_tos_CM_single -3.4E+38 3.4E+38 /end CHARACTERISTIC
/begin CHARACTERISTIC ZDrive_BSW_Cal_Cal.ZDrive_BSW_Cal_VehicleInfomationTable.camera_x_m "" VALUE 0x3d8194 Record_FLOAT32_IEEE 0 autosar_swc_tos_CM_single -3.4E+38 3.4E+38 /end CHARACTERISTIC
/begin CHARACTERISTIC ZDrive_BSW_Cal_Cal.ZDrive_BSW_Cal_VehicleInfomationTable.camera_y_m "" VALUE 0x3d8198 Record_FLOAT32_IEEE 0 autosar_swc_tos_CM_single -3.4E+38 3.4E+38 /end CHARACTERISTIC
/begin CHARACTERISTIC ZDrive_BSW_Cal_Cal.ZDrive_BSW_Cal_VehicleInfomationTable.camera_z_m "" VALUE 0x3d819c Record_FLOAT32_IEEE 0 autosar_swc_tos_CM_single -3.4E+38 3.4E+38 /end CHARACTERISTIC
/begin CHARACTERISTIC ZDrive_BSW_Cal_Cal.ZDrive_BSW_Cal_VehicleInfomationTable.translation_x_m "" VALUE 0x3d81a0 Record_FLOAT32_IEEE 0 autosar_swc_tos_CM_single -3.4E+38 3.4E+38 /end CHARACTERISTIC
/begin MEASUREMENT autosar_swc_tos_rtARID_DEF.ARID_DEF_Chart.is_active_c589_autosar_swc_tos "" UBYTE autosar_swc_tos_CM_uint8 0 0 0 255 ECU_ADDRESS 0xfe4bc068 /* @ECU_Address@autosar_swc_tos_rtARID_DEF.ARID_DEF_Chart.is_active_c589_autosar_swc_tos@ */ /end MEASUREMENT
/begin MEASUREMENT autosar_swc_tos_rtARID_DEF.ARID_DEF_Chart.is_c589_autosar_swc_tos "" UBYTE autosar_swc_tos_CM_uint8 0 0 0 255 ECU_ADDRESS 0xfe4bc069 /* @ECU_Address@autosar_swc_tos_rtARID_DEF.ARID_DEF_Chart.is_c589_autosar_swc_tos@ */ /end MEASUREMENT
/begin MEASUREMENT autosar_swc_tos_rtARID_DEF.ARID_DEF_Chart1.is_active_c551_autosar_swc_tos "" UBYTE autosar_swc_tos_CM_uint8 0 0 0 255 ECU_ADDRESS 0xfe4bc06a /* @ECU_Address@autosar_swc_tos_rtARID_DEF.ARID_DEF_Chart1.is_active_c551_autosar_swc_tos@ */ /end MEASUREMENT
/begin MEASUREMENT autosar_swc_tos_rtARID_DEF.ARID_DEF_Chart1.is_c551_autosar_swc_tos "" UBYTE autosar_swc_tos_CM_uint8 0 0 0 255 ECU_ADDRESS 0xfe4bc06b /* @ECU_Address@autosar_swc_tos_rtARID_DEF.ARID_DEF_Chart1.is_c551_autosar_swc_tos@ */ /end MEASUREMENT
/begin MEASUREMENT autosar_swc_tos_rtARID_DEF.ARID_DEF_Chart4.is_active_c827_autosar_swc_tos "" UBYTE autosar_swc_tos_CM_uint8 0 0 0 255 ECU_ADDRESS 0xfe4bc070 /* @ECU_Address@autosar_swc_tos_rtARID_DEF.ARID_DEF_Chart4.is_active_c827_autosar_swc_tos@ */ /end MEASUREMENT
/begin MEASUREMENT autosar_swc_tos_rtARID_DEF.ARID_DEF_Chart4.is_c827_autosar_swc_tos "" UBYTE autosar_swc_tos_CM_uint8 0 0 0 255 ECU_ADDRESS 0xfe4bc071 /* @ECU_Address@autosar_swc_tos_rtARID_DEF.ARID_DEF_Chart4.is_c827_autosar_swc_tos@ */ /end MEASUREMENT
/begin MEASUREMENT autosar_swc_tos_rtARID_DEF.ARID_DEF_Chart5.is_active_c827_autosar_swc_tos "" UBYTE autosar_swc_tos_CM_uint8 0 0 0 255 ECU_ADDRESS 0xfe4bc06e /* @ECU_Address@autosar_swc_tos_rtARID_DEF.ARID_DEF_Chart5.is_active_c827_autosar_swc_tos@ */ /end MEASUREMENT
/begin MEASUREMENT autosar_swc_tos_rtARID_DEF.ARID_DEF_Chart5.is_c827_autosar_swc_tos "" UBYTE autosar_swc_tos_CM_uint8 0 0 0 255 ECU_ADDRESS 0xfe4bc06f /* @ECU_Address@autosar_swc_tos_rtARID_DEF.ARID_DEF_Chart5.is_c827_autosar_swc_tos@ */ /end MEASUREMENT
/begin MEASUREMENT autosar_swc_tos_rtARID_DEF.ARID_DEF_Chart_k.is_active_c551_autosar_swc_tos "" UBYTE autosar_swc_tos_CM_uint8 0 0 0 255 ECU_ADDRESS 0xfe4bc06c /* @ECU_Address@autosar_swc_tos_rtARID_DEF.ARID_DEF_Chart_k.is_active_c551_autosar_swc_tos@ */ /end MEASUREMENT
/begin MEASUREMENT autosar_swc_tos_rtARID_DEF.ARID_DEF_Chart_k.is_c551_autosar_swc_tos "" UBYTE autosar_swc_tos_CM_uint8 0 0 0 255 ECU_ADDRESS 0xfe4bc06d /* @ECU_Address@autosar_swc_tos_rtARID_DEF.ARID_DEF_Chart_k.is_c551_autosar_swc_tos@ */ /end MEASUREMENT
/begin MEASUREMENT autosar_swc_tos_rtARID_DEF.ARID_DEF_MATLABFunction10.LowSpdtime_MovTruck_in "" UBYTE autosar_swc_tos_CM_uint8 0 0 0 255 ECU_ADDRESS 0xfe4bc11e /* @ECU_Address@autosar_swc_tos_rtARID_DEF.ARID_DEF_MATLABFunction10.LowSpdtime_MovTruck_in@ */ /end MEASUREMENT
/begin MEASUREMENT autosar_swc_tos_rtARID_DEF.ARID_DEF_MATLABFunction10.LowSpdtime_MovTruck_out "" UBYTE autosar_swc_tos_CM_uint8 0 0 0 255 ECU_ADDRESS 0xfe4bc126 /* @ECU_Address@autosar_swc_tos_rtARID_DEF.ARID_DEF_MATLABFunction10.LowSpdtime_MovTruck_out@ */ /end MEASUREMENT
/begin MEASUREMENT autosar_swc_tos_rtARID_DEF.ARID_DEF_MATLABFunction10.time_MovCar_in "" UBYTE autosar_swc_tos_CM_uint8 0 0 0 255 ECU_ADDRESS 0xfe4bc11c /* @ECU_Address@autosar_swc_tos_rtARID_DEF.ARID_DEF_MATLABFunction10.time_MovCar_in@ */ /end MEASUREMENT
/begin MEASUREMENT autosar_swc_tos_rtARID_DEF.ARID_DEF_MATLABFunction10.time_MovCar_out "" UBYTE autosar_swc_tos_CM_uint8 0 0 0 255 ECU_ADDRESS 0xfe4bc125 /* @ECU_Address@autosar_swc_tos_rtARID_DEF.ARID_DEF_MATLABFunction10.time_MovCar_out@ */ /end MEASUREMENT
/begin MEASUREMENT autosar_swc_tos_rtARID_DEF.ARID_DEF_MATLABFunction10.time_MovTruck_in "" UBYTE autosar_swc_tos_CM_uint8 0 0 0 255 ECU_ADDRESS 0xfe4bc11b /* @ECU_Address@autosar_swc_tos_rtARID_DEF.ARID_DEF_MATLABFunction10.time_MovTruck_in@ */ /end MEASUREMENT
/begin MEASUREMENT autosar_swc_tos_rtARID_DEF.ARID_DEF_MATLABFunction10.time_MovTruck_out "" UBYTE autosar_swc_tos_CM_uint8 0 0 0 255 ECU_ADDRESS 0xfe4bc124 /* @ECU_Address@autosar_swc_tos_rtARID_DEF.ARID_DEF_MATLABFunction10.time_MovTruck_out@ */ /end MEASUREMENT
/begin MEASUREMENT autosar_swc_tos_rtARID_DEF.ARID_DEF_MATLABFunction10.time_StaCar_in "" UBYTE autosar_swc_tos_CM_uint8 0 0 0 255 ECU_ADDRESS 0xfe4bc11a /* @ECU_Address@autosar_swc_tos_rtARID_DEF.ARID_DEF_MATLABFunction10.time_StaCar_in@ */ /end MEASUREMENT
/begin MEASUREMENT autosar_swc_tos_rtARID_DEF.ARID_DEF_MATLABFunction10.time_StaCar_out "" UBYTE autosar_swc_tos_CM_uint8 0 0 0 255 ECU_ADDRESS 0xfe4bc123 /* @ECU_Address@autosar_swc_tos_rtARID_DEF.ARID_DEF_MATLABFunction10.time_StaCar_out@ */ /end MEASUREMENT
/begin MEASUREMENT autosar_swc_tos_rtARID_DEF.ARID_DEF_MATLABFunction10.time_StaCar_presslane_out "" UBYTE autosar_swc_tos_CM_uint8 0 0 0 255 ECU_ADDRESS 0xfe4bc122 /* @ECU_Address@autosar_swc_tos_rtARID_DEF.ARID_DEF_MATLABFunction10.time_StaCar_presslane_out@ */ /end MEASUREMENT
/begin MEASUREMENT autosar_swc_tos_rtARID_DEF.ARID_DEF_MATLABFunction10.time_StaTruck_in "" UBYTE autosar_swc_tos_CM_uint8 0 0 0 255 ECU_ADDRESS 0xfe4bc119 /* @ECU_Address@autosar_swc_tos_rtARID_DEF.ARID_DEF_MATLABFunction10.time_StaTruck_in@ */ /end MEASUREMENT
/begin MEASUREMENT autosar_swc_tos_rtARID_DEF.ARID_DEF_MATLABFunction10.time_StaTruck_out "" UBYTE autosar_swc_tos_CM_uint8 0 0 0 255 ECU_ADDRESS 0xfe4bc121 /* @ECU_Address@autosar_swc_tos_rtARID_DEF.ARID_DEF_MATLABFunction10.time_StaTruck_out@ */ /end MEASUREMENT
/begin MEASUREMENT autosar_swc_tos_rtARID_DEF.ARID_DEF_MATLABFunction10.time_StaTruck_presslane_out "" UBYTE autosar_swc_tos_CM_uint8 0 0 0 255 ECU_ADDRESS 0xfe4bc120 /* @ECU_Address@autosar_swc_tos_rtARID_DEF.ARID_DEF_MATLABFunction10.time_StaTruck_presslane_out@ */ /end MEASUREMENT
/begin MEASUREMENT autosar_swc_tos_rtARID_DEF.ARID_DEF_MATLABFunction10.time_StaVeh_in "" UBYTE autosar_swc_tos_CM_uint8 0 0 0 255 ECU_ADDRESS 0xfe4bc11d /* @ECU_Address@autosar_swc_tos_rtARID_DEF.ARID_DEF_MATLABFunction10.time_StaVeh_in@ */ /end MEASUREMENT
/begin MEASUREMENT autosar_swc_tos_rtARID_DEF.ARID_DEF_MATLABFunction10.time_Vru_in "" UBYTE autosar_swc_tos_CM_uint8 0 0 0 255 ECU_ADDRESS 0xfe4bc118 /* @ECU_Address@autosar_swc_tos_rtARID_DEF.ARID_DEF_MATLABFunction10.time_Vru_in@ */ /end MEASUREMENT
/begin MEASUREMENT autosar_swc_tos_rtARID_DEF.ARID_DEF_MATLABFunction10.time_Vru_out "" UBYTE autosar_swc_tos_CM_uint8 0 0 0 255 ECU_ADDRESS 0xfe4bc11f /* @ECU_Address@autosar_swc_tos_rtARID_DEF.ARID_DEF_MATLABFunction10.time_Vru_out@ */ /end MEASUREMENT
/begin MEASUREMENT autosar_swc_tos_rtARID_DEF.ARID_DEF_MATLABFunction11.Maxoffset "" FLOAT32_IEEE autosar_swc_tos_CM_single 0 0 -3.4E+38 3.4E+38 ECU_ADDRESS 0xfe4bc114 /* @ECU_Address@autosar_swc_tos_rtARID_DEF.ARID_DEF_MATLABFunction11.Maxoffset@ */ /end MEASUREMENT
/begin MEASUREMENT autosar_swc_tos_rtARID_DEF.ARID_DEF_MATLABFunction12.LowSpdtime_MovTruck_in "" UBYTE autosar_swc_tos_CM_uint8 0 0 0 255 ECU_ADDRESS 0xfe4bc10a /* @ECU_Address@autosar_swc_tos_rtARID_DEF.ARID_DEF_MATLABFunction12.LowSpdtime_MovTruck_in@ */ /end MEASUREMENT
/begin MEASUREMENT autosar_swc_tos_rtARID_DEF.ARID_DEF_MATLABFunction12.LowSpdtime_MovTruck_out "" UBYTE autosar_swc_tos_CM_uint8 0 0 0 255 ECU_ADDRESS 0xfe4bc112 /* @ECU_Address@autosar_swc_tos_rtARID_DEF.ARID_DEF_MATLABFunction12.LowSpdtime_MovTruck_out@ */ /end MEASUREMENT
/begin MEASUREMENT autosar_swc_tos_rtARID_DEF.ARID_DEF_MATLABFunction12.time_MovCar_in "" UBYTE autosar_swc_tos_CM_uint8 0 0 0 255 ECU_ADDRESS 0xfe4bc108 /* @ECU_Address@autosar_swc_tos_rtARID_DEF.ARID_DEF_MATLABFunction12.time_MovCar_in@ */ /end MEASUREMENT
/begin MEASUREMENT autosar_swc_tos_rtARID_DEF.ARID_DEF_MATLABFunction12.time_MovCar_out "" UBYTE autosar_swc_tos_CM_uint8 0 0 0 255 ECU_ADDRESS 0xfe4bc111 /* @ECU_Address@autosar_swc_tos_rtARID_DEF.ARID_DEF_MATLABFunction12.time_MovCar_out@ */ /end MEASUREMENT
/begin MEASUREMENT autosar_swc_tos_rtARID_DEF.ARID_DEF_MATLABFunction12.time_MovTruck_in "" UBYTE autosar_swc_tos_CM_uint8 0 0 0 255 ECU_ADDRESS 0xfe4bc107 /* @ECU_Address@autosar_swc_tos_rtARID_DEF.ARID_DEF_MATLABFunction12.time_MovTruck_in@ */ /end MEASUREMENT
/begin MEASUREMENT autosar_swc_tos_rtARID_DEF.ARID_DEF_MATLABFunction12.time_MovTruck_out "" UBYTE autosar_swc_tos_CM_uint8 0 0 0 255 ECU_ADDRESS 0xfe4bc110 /* @ECU_Address@autosar_swc_tos_rtARID_DEF.ARID_DEF_MATLABFunction12.time_MovTruck_out@ */ /end MEASUREMENT
/begin MEASUREMENT autosar_swc_tos_rtARID_DEF.ARID_DEF_MATLABFunction12.time_StaCar_in "" UBYTE autosar_swc_tos_CM_uint8 0 0 0 255 ECU_ADDRESS 0xfe4bc106 /* @ECU_Address@autosar_swc_tos_rtARID_DEF.ARID_DEF_MATLABFunction12.time_StaCar_in@ */ /end MEASUREMENT
/begin MEASUREMENT autosar_swc_tos_rtARID_DEF.ARID_DEF_MATLABFunction12.time_StaCar_out "" UBYTE autosar_swc_tos_CM_uint8 0 0 0 255 ECU_ADDRESS 0xfe4bc10f /* @ECU_Address@autosar_swc_tos_rtARID_DEF.ARID_DEF_MATLABFunction12.time_StaCar_out@ */ /end MEASUREMENT
/begin MEASUREMENT autosar_swc_tos_rtARID_DEF.ARID_DEF_MATLABFunction12.time_StaCar_presslane_out "" UBYTE autosar_swc_tos_CM_uint8 0 0 0 255 ECU_ADDRESS 0xfe4bc10e /* @ECU_Address@autosar_swc_tos_rtARID_DEF.ARID_DEF_MATLABFunction12.time_StaCar_presslane_out@ */ /end MEASUREMENT
/begin MEASUREMENT autosar_swc_tos_rtARID_DEF.ARID_DEF_MATLABFunction12.time_StaTruck_in "" UBYTE autosar_swc_tos_CM_uint8 0 0 0 255 ECU_ADDRESS 0xfe4bc105 /* @ECU_Address@autosar_swc_tos_rtARID_DEF.ARID_DEF_MATLABFunction12.time_StaTruck_in@ */ /end MEASUREMENT
/begin MEASUREMENT autosar_swc_tos_rtARID_DEF.ARID_DEF_MATLABFunction12.time_StaTruck_out "" UBYTE autosar_swc_tos_CM_uint8 0 0 0 255 ECU_ADDRESS 0xfe4bc10d /* @ECU_Address@autosar_swc_tos_rtARID_DEF.ARID_DEF_MATLABFunction12.time_StaTruck_out@ */ /end MEASUREMENT
/begin MEASUREMENT autosar_swc_tos_rtARID_DEF.ARID_DEF_MATLABFunction12.time_StaTruck_presslane_out "" UBYTE autosar_swc_tos_CM_uint8 0 0 0 255 ECU_ADDRESS 0xfe4bc10c /* @ECU_Address@autosar_swc_tos_rtARID_DEF.ARID_DEF_MATLABFunction12.time_StaTruck_presslane_out@ */ /end MEASUREMENT
/begin MEASUREMENT autosar_swc_tos_rtARID_DEF.ARID_DEF_MATLABFunction12.time_StaVeh_in "" UBYTE autosar_swc_tos_CM_uint8 0 0 0 255 ECU_ADDRESS 0xfe4bc109 /* @ECU_Address@autosar_swc_tos_rtARID_DEF.ARID_DEF_MATLABFunction12.time_StaVeh_in@ */ /end MEASUREMENT
/begin MEASUREMENT autosar_swc_tos_rtARID_DEF.ARID_DEF_MATLABFunction12.time_Vru_in "" UBYTE autosar_swc_tos_CM_uint8 0 0 0 255 ECU_ADDRESS 0xfe4bc104 /* @ECU_Address@autosar_swc_tos_rtARID_DEF.ARID_DEF_MATLABFunction12.time_Vru_in@ */ /end MEASUREMENT
/begin MEASUREMENT autosar_swc_tos_rtARID_DEF.ARID_DEF_MATLABFunction12.time_Vru_out "" UBYTE autosar_swc_tos_CM_uint8 0 0 0 255 ECU_ADDRESS 0xfe4bc10b /* @ECU_Address@autosar_swc_tos_rtARID_DEF.ARID_DEF_MATLABFunction12.time_Vru_out@ */ /end MEASUREMENT
/begin MEASUREMENT autosar_swc_tos_rtARID_DEF.ARID_DEF_MATLABFunction13.Maxoffset "" FLOAT32_IEEE autosar_swc_tos_CM_single 0 0 -3.4E+38 3.4E+38 ECU_ADDRESS 0xfe4bc100 /* @ECU_Address@autosar_swc_tos_rtARID_DEF.ARID_DEF_MATLABFunction13.Maxoffset@ */ /end MEASUREMENT
/begin MEASUREMENT autosar_swc_tos_rtARID_DEF.ARID_DEF_MATLABFunction14.LowSpdtime_MovTruck_in "" UBYTE autosar_swc_tos_CM_uint8 0 0 0 255 ECU_ADDRESS 0xfe4bc0f6 /* @ECU_Address@autosar_swc_tos_rtARID_DEF.ARID_DEF_MATLABFunction14.LowSpdtime_MovTruck_in@ */ /end MEASUREMENT
/begin MEASUREMENT autosar_swc_tos_rtARID_DEF.ARID_DEF_MATLABFunction14.LowSpdtime_MovTruck_out "" UBYTE autosar_swc_tos_CM_uint8 0 0 0 255 ECU_ADDRESS 0xfe4bc0fe /* @ECU_Address@autosar_swc_tos_rtARID_DEF.ARID_DEF_MATLABFunction14.LowSpdtime_MovTruck_out@ */ /end MEASUREMENT
/begin MEASUREMENT autosar_swc_tos_rtARID_DEF.ARID_DEF_MATLABFunction14.time_MovCar_in "" UBYTE autosar_swc_tos_CM_uint8 0 0 0 255 ECU_ADDRESS 0xfe4bc0f4 /* @ECU_Address@autosar_swc_tos_rtARID_DEF.ARID_DEF_MATLABFunction14.time_MovCar_in@ */ /end MEASUREMENT
/begin MEASUREMENT autosar_swc_tos_rtARID_DEF.ARID_DEF_MATLABFunction14.time_MovCar_out "" UBYTE autosar_swc_tos_CM_uint8 0 0 0 255 ECU_ADDRESS 0xfe4bc0fd /* @ECU_Address@autosar_swc_tos_rtARID_DEF.ARID_DEF_MATLABFunction14.time_MovCar_out@ */ /end MEASUREMENT
/begin MEASUREMENT autosar_swc_tos_rtARID_DEF.ARID_DEF_MATLABFunction14.time_MovTruck_in "" UBYTE autosar_swc_tos_CM_uint8 0 0 0 255 ECU_ADDRESS 0xfe4bc0f3 /* @ECU_Address@autosar_swc_tos_rtARID_DEF.ARID_DEF_MATLABFunction14.time_MovTruck_in@ */ /end MEASUREMENT
/begin MEASUREMENT autosar_swc_tos_rtARID_DEF.ARID_DEF_MATLABFunction14.time_MovTruck_out "" UBYTE autosar_swc_tos_CM_uint8 0 0 0 255 ECU_ADDRESS 0xfe4bc0fc /* @ECU_Address@autosar_swc_tos_rtARID_DEF.ARID_DEF_MATLABFunction14.time_MovTruck_out@ */ /end MEASUREMENT
/begin MEASUREMENT autosar_swc_tos_rtARID_DEF.ARID_DEF_MATLABFunction14.time_StaCar_in "" UBYTE autosar_swc_tos_CM_uint8 0 0 0 255 ECU_ADDRESS 0xfe4bc0f2 /* @ECU_Address@autosar_swc_tos_rtARID_DEF.ARID_DEF_MATLABFunction14.time_StaCar_in@ */ /end MEASUREMENT
/begin MEASUREMENT autosar_swc_tos_rtARID_DEF.ARID_DEF_MATLABFunction14.time_StaCar_out "" UBYTE autosar_swc_tos_CM_uint8 0 0 0 255 ECU_ADDRESS 0xfe4bc0fb /* @ECU_Address@autosar_swc_tos_rtARID_DEF.ARID_DEF_MATLABFunction14.time_StaCar_out@ */ /end MEASUREMENT
/begin MEASUREMENT autosar_swc_tos_rtARID_DEF.ARID_DEF_MATLABFunction14.time_StaCar_presslane_out "" UBYTE autosar_swc_tos_CM_uint8 0 0 0 255 ECU_ADDRESS 0xfe4bc0fa /* @ECU_Address@autosar_swc_tos_rtARID_DEF.ARID_DEF_MATLABFunction14.time_StaCar_presslane_out@ */ /end MEASUREMENT
/begin MEASUREMENT autosar_swc_tos_rtARID_DEF.ARID_DEF_MATLABFunction14.time_StaTruck_in "" UBYTE autosar_swc_tos_CM_uint8 0 0 0 255 ECU_ADDRESS 0xfe4bc0f1 /* @ECU_Address@autosar_swc_tos_rtARID_DEF.ARID_DEF_MATLABFunction14.time_StaTruck_in@ */ /end MEASUREMENT
/begin MEASUREMENT autosar_swc_tos_rtARID_DEF.ARID_DEF_MATLABFunction14.time_StaTruck_out "" UBYTE autosar_swc_tos_CM_uint8 0 0 0 255 ECU_ADDRESS 0xfe4bc0f9 /* @ECU_Address@autosar_swc_tos_rtARID_DEF.ARID_DEF_MATLABFunction14.time_StaTruck_out@ */ /end MEASUREMENT
/begin MEASUREMENT autosar_swc_tos_rtARID_DEF.ARID_DEF_MATLABFunction14.time_StaTruck_presslane_out "" UBYTE autosar_swc_tos_CM_uint8 0 0 0 255 ECU_ADDRESS 0xfe4bc0f8 /* @ECU_Address@autosar_swc_tos_rtARID_DEF.ARID_DEF_MATLABFunction14.time_StaTruck_presslane_out@ */ /end MEASUREMENT
/begin MEASUREMENT autosar_swc_tos_rtARID_DEF.ARID_DEF_MATLABFunction14.time_StaVeh_in "" UBYTE autosar_swc_tos_CM_uint8 0 0 0 255 ECU_ADDRESS 0xfe4bc0f5 /* @ECU_Address@autosar_swc_tos_rtARID_DEF.ARID_DEF_MATLABFunction14.time_StaVeh_in@ */ /end MEASUREMENT
/begin MEASUREMENT autosar_swc_tos_rtARID_DEF.ARID_DEF_MATLABFunction14.time_Vru_in "" UBYTE autosar_swc_tos_CM_uint8 0 0 0 255 ECU_ADDRESS 0xfe4bc0f0 /* @ECU_Address@autosar_swc_tos_rtARID_DEF.ARID_DEF_MATLABFunction14.time_Vru_in@ */ /end MEASUREMENT
/begin MEASUREMENT autosar_swc_tos_rtARID_DEF.ARID_DEF_MATLABFunction14.time_Vru_out "" UBYTE autosar_swc_tos_CM_uint8 0 0 0 255 ECU_ADDRESS 0xfe4bc0f7 /* @ECU_Address@autosar_swc_tos_rtARID_DEF.ARID_DEF_MATLABFunction14.time_Vru_out@ */ /end MEASUREMENT
/begin MEASUREMENT autosar_swc_tos_rtARID_DEF.ARID_DEF_MATLABFunction15.Maxoffset "" FLOAT32_IEEE autosar_swc_tos_CM_single 0 0 -3.4E+38 3.4E+38 ECU_ADDRESS 0xfe4bc0ec /* @ECU_Address@autosar_swc_tos_rtARID_DEF.ARID_DEF_MATLABFunction15.Maxoffset@ */ /end MEASUREMENT
/begin MEASUREMENT autosar_swc_tos_rtARID_DEF.ARID_DEF_MATLABFunction16.LowSpdtime_MovTruck_in "" UBYTE autosar_swc_tos_CM_uint8 0 0 0 255 ECU_ADDRESS 0xfe4bc0e2 /* @ECU_Address@autosar_swc_tos_rtARID_DEF.ARID_DEF_MATLABFunction16.LowSpdtime_MovTruck_in@ */ /end MEASUREMENT
/begin MEASUREMENT autosar_swc_tos_rtARID_DEF.ARID_DEF_MATLABFunction16.LowSpdtime_MovTruck_out "" UBYTE autosar_swc_tos_CM_uint8 0 0 0 255 ECU_ADDRESS 0xfe4bc0ea /* @ECU_Address@autosar_swc_tos_rtARID_DEF.ARID_DEF_MATLABFunction16.LowSpdtime_MovTruck_out@ */ /end MEASUREMENT
/begin MEASUREMENT autosar_swc_tos_rtARID_DEF.ARID_DEF_MATLABFunction16.time_MovCar_in "" UBYTE autosar_swc_tos_CM_uint8 0 0 0 255 ECU_ADDRESS 0xfe4bc0e0 /* @ECU_Address@autosar_swc_tos_rtARID_DEF.ARID_DEF_MATLABFunction16.time_MovCar_in@ */ /end MEASUREMENT
/begin MEASUREMENT autosar_swc_tos_rtARID_DEF.ARID_DEF_MATLABFunction16.time_MovCar_out "" UBYTE autosar_swc_tos_CM_uint8 0 0 0 255 ECU_ADDRESS 0xfe4bc0e9 /* @ECU_Address@autosar_swc_tos_rtARID_DEF.ARID_DEF_MATLABFunction16.time_MovCar_out@ */ /end MEASUREMENT
/begin MEASUREMENT autosar_swc_tos_rtARID_DEF.ARID_DEF_MATLABFunction16.time_MovTruck_in "" UBYTE autosar_swc_tos_CM_uint8 0 0 0 255 ECU_ADDRESS 0xfe4bc0df /* @ECU_Address@autosar_swc_tos_rtARID_DEF.ARID_DEF_MATLABFunction16.time_MovTruck_in@ */ /end MEASUREMENT
/begin MEASUREMENT autosar_swc_tos_rtARID_DEF.ARID_DEF_MATLABFunction16.time_MovTruck_out "" UBYTE autosar_swc_tos_CM_uint8 0 0 0 255 ECU_ADDRESS 0xfe4bc0e8 /* @ECU_Address@autosar_swc_tos_rtARID_DEF.ARID_DEF_MATLABFunction16.time_MovTruck_out@ */ /end MEASUREMENT
/begin MEASUREMENT autosar_swc_tos_rtARID_DEF.ARID_DEF_MATLABFunction16.time_StaCar_in "" UBYTE autosar_swc_tos_CM_uint8 0 0 0 255 ECU_ADDRESS 0xfe4bc0de /* @ECU_Address@autosar_swc_tos_rtARID_DEF.ARID_DEF_MATLABFunction16.time_StaCar_in@ */ /end MEASUREMENT
/begin MEASUREMENT autosar_swc_tos_rtARID_DEF.ARID_DEF_MATLABFunction16.time_StaCar_out "" UBYTE autosar_swc_tos_CM_uint8 0 0 0 255 ECU_ADDRESS 0xfe4bc0e7 /* @ECU_Address@autosar_swc_tos_rtARID_DEF.ARID_DEF_MATLABFunction16.time_StaCar_out@ */ /end MEASUREMENT
/begin MEASUREMENT autosar_swc_tos_rtARID_DEF.ARID_DEF_MATLABFunction16.time_StaCar_presslane_out "" UBYTE autosar_swc_tos_CM_uint8 0 0 0 255 ECU_ADDRESS 0xfe4bc0e6 /* @ECU_Address@autosar_swc_tos_rtARID_DEF.ARID_DEF_MATLABFunction16.time_StaCar_presslane_out@ */ /end MEASUREMENT
/begin MEASUREMENT autosar_swc_tos_rtARID_DEF.ARID_DEF_MATLABFunction16.time_StaTruck_in "" UBYTE autosar_swc_tos_CM_uint8 0 0 0 255 ECU_ADDRESS 0xfe4bc0dd /* @ECU_Address@autosar_swc_tos_rtARID_DEF.ARID_DEF_MATLABFunction16.time_StaTruck_in@ */ /end MEASUREMENT
/begin MEASUREMENT autosar_swc_tos_rtARID_DEF.ARID_DEF_MATLABFunction16.time_StaTruck_out "" UBYTE autosar_swc_tos_CM_uint8 0 0 0 255 ECU_ADDRESS 0xfe4bc0e5 /* @ECU_Address@autosar_swc_tos_rtARID_DEF.ARID_DEF_MATLABFunction16.time_StaTruck_out@ */ /end MEASUREMENT
/begin MEASUREMENT autosar_swc_tos_rtARID_DEF.ARID_DEF_MATLABFunction16.time_StaTruck_presslane_out "" UBYTE autosar_swc_tos_CM_uint8 0 0 0 255 ECU_ADDRESS 0xfe4bc0e4 /* @ECU_Address@autosar_swc_tos_rtARID_DEF.ARID_DEF_MATLABFunction16.time_StaTruck_presslane_out@ */ /end MEASUREMENT
/begin MEASUREMENT autosar_swc_tos_rtARID_DEF.ARID_DEF_MATLABFunction16.time_StaVeh_in "" UBYTE autosar_swc_tos_CM_uint8 0 0 0 255 ECU_ADDRESS 0xfe4bc0e1 /* @ECU_Address@autosar_swc_tos_rtARID_DEF.ARID_DEF_MATLABFunction16.time_StaVeh_in@ */ /end MEASUREMENT
/begin MEASUREMENT autosar_swc_tos_rtARID_DEF.ARID_DEF_MATLABFunction16.time_Vru_in "" UBYTE autosar_swc_tos_CM_uint8 0 0 0 255 ECU_ADDRESS 0xfe4bc0dc /* @ECU_Address@autosar_swc_tos_rtARID_DEF.ARID_DEF_MATLABFunction16.time_Vru_in@ */ /end MEASUREMENT
/begin MEASUREMENT autosar_swc_tos_rtARID_DEF.ARID_DEF_MATLABFunction16.time_Vru_out "" UBYTE autosar_swc_tos_CM_uint8 0 0 0 255 ECU_ADDRESS 0xfe4bc0e3 /* @ECU_Address@autosar_swc_tos_rtARID_DEF.ARID_DEF_MATLABFunction16.time_Vru_out@ */ /end MEASUREMENT
/begin MEASUREMENT autosar_swc_tos_rtARID_DEF.ARID_DEF_MATLABFunction17.Maxoffset "" FLOAT32_IEEE autosar_swc_tos_CM_single 0 0 -3.4E+38 3.4E+38 ECU_ADDRESS 0xfe4bc0d8 /* @ECU_Address@autosar_swc_tos_rtARID_DEF.ARID_DEF_MATLABFunction17.Maxoffset@ */ /end MEASUREMENT
/begin MEASUREMENT autosar_swc_tos_rtARID_DEF.ARID_DEF_MATLABFunction18.LowSpdtime_MovTruck_in "" UBYTE autosar_swc_tos_CM_uint8 0 0 0 255 ECU_ADDRESS 0xfe4bc0ce /* @ECU_Address@autosar_swc_tos_rtARID_DEF.ARID_DEF_MATLABFunction18.LowSpdtime_MovTruck_in@ */ /end MEASUREMENT
/begin MEASUREMENT autosar_swc_tos_rtARID_DEF.ARID_DEF_MATLABFunction18.LowSpdtime_MovTruck_out "" UBYTE autosar_swc_tos_CM_uint8 0 0 0 255 ECU_ADDRESS 0xfe4bc0d6 /* @ECU_Address@autosar_swc_tos_rtARID_DEF.ARID_DEF_MATLABFunction18.LowSpdtime_MovTruck_out@ */ /end MEASUREMENT
/begin MEASUREMENT autosar_swc_tos_rtARID_DEF.ARID_DEF_MATLABFunction18.time_MovCar_in "" UBYTE autosar_swc_tos_CM_uint8 0 0 0 255 ECU_ADDRESS 0xfe4bc0cc /* @ECU_Address@autosar_swc_tos_rtARID_DEF.ARID_DEF_MATLABFunction18.time_MovCar_in@ */ /end MEASUREMENT
/begin MEASUREMENT autosar_swc_tos_rtARID_DEF.ARID_DEF_MATLABFunction18.time_MovCar_out "" UBYTE autosar_swc_tos_CM_uint8 0 0 0 255 ECU_ADDRESS 0xfe4bc0d5 /* @ECU_Address@autosar_swc_tos_rtARID_DEF.ARID_DEF_MATLABFunction18.time_MovCar_out@ */ /end MEASUREMENT
/begin MEASUREMENT autosar_swc_tos_rtARID_DEF.ARID_DEF_MATLABFunction18.time_MovTruck_in "" UBYTE autosar_swc_tos_CM_uint8 0 0 0 255 ECU_ADDRESS 0xfe4bc0cb /* @ECU_Address@autosar_swc_tos_rtARID_DEF.ARID_DEF_MATLABFunction18.time_MovTruck_in@ */ /end MEASUREMENT
/begin MEASUREMENT autosar_swc_tos_rtARID_DEF.ARID_DEF_MATLABFunction18.time_MovTruck_out "" UBYTE autosar_swc_tos_CM_uint8 0 0 0 255 ECU_ADDRESS 0xfe4bc0d4 /* @ECU_Address@autosar_swc_tos_rtARID_DEF.ARID_DEF_MATLABFunction18.time_MovTruck_out@ */ /end MEASUREMENT
/begin MEASUREMENT autosar_swc_tos_rtARID_DEF.ARID_DEF_MATLABFunction18.time_StaCar_in "" UBYTE autosar_swc_tos_CM_uint8 0 0 0 255 ECU_ADDRESS 0xfe4bc0ca /* @ECU_Address@autosar_swc_tos_rtARID_DEF.ARID_DEF_MATLABFunction18.time_StaCar_in@ */ /end MEASUREMENT
/begin MEASUREMENT autosar_swc_tos_rtARID_DEF.ARID_DEF_MATLABFunction18.time_StaCar_out "" UBYTE autosar_swc_tos_CM_uint8 0 0 0 255 ECU_ADDRESS 0xfe4bc0d3 /* @ECU_Address@autosar_swc_tos_rtARID_DEF.ARID_DEF_MATLABFunction18.time_StaCar_out@ */ /end MEASUREMENT
/begin MEASUREMENT autosar_swc_tos_rtARID_DEF.ARID_DEF_MATLABFunction18.time_StaCar_presslane_out "" UBYTE autosar_swc_tos_CM_uint8 0 0 0 255 ECU_ADDRESS 0xfe4bc0d2 /* @ECU_Address@autosar_swc_tos_rtARID_DEF.ARID_DEF_MATLABFunction18.time_StaCar_presslane_out@ */ /end MEASUREMENT
/begin MEASUREMENT autosar_swc_tos_rtARID_DEF.ARID_DEF_MATLABFunction18.time_StaTruck_in "" UBYTE autosar_swc_tos_CM_uint8 0 0 0 255 ECU_ADDRESS 0xfe4bc0c9 /* @ECU_Address@autosar_swc_tos_rtARID_DEF.ARID_DEF_MATLABFunction18.time_StaTruck_in@ */ /end MEASUREMENT
/begin MEASUREMENT autosar_swc_tos_rtARID_DEF.ARID_DEF_MATLABFunction18.time_StaTruck_out "" UBYTE autosar_swc_tos_CM_uint8 0 0 0 255 ECU_ADDRESS 0xfe4bc0d1 /* @ECU_Address@autosar_swc_tos_rtARID_DEF.ARID_DEF_MATLABFunction18.time_StaTruck_out@ */ /end MEASUREMENT
/begin MEASUREMENT autosar_swc_tos_rtARID_DEF.ARID_DEF_MATLABFunction18.time_StaTruck_presslane_out "" UBYTE autosar_swc_tos_CM_uint8 0 0 0 255 ECU_ADDRESS 0xfe4bc0d0 /* @ECU_Address@autosar_swc_tos_rtARID_DEF.ARID_DEF_MATLABFunction18.time_StaTruck_presslane_out@ */ /end MEASUREMENT
/begin MEASUREMENT autosar_swc_tos_rtARID_DEF.ARID_DEF_MATLABFunction18.time_StaVeh_in "" UBYTE autosar_swc_tos_CM_uint8 0 0 0 255 ECU_ADDRESS 0xfe4bc0cd /* @ECU_Address@autosar_swc_tos_rtARID_DEF.ARID_DEF_MATLABFunction18.time_StaVeh_in@ */ /end MEASUREMENT
/begin MEASUREMENT autosar_swc_tos_rtARID_DEF.ARID_DEF_MATLABFunction18.time_Vru_in "" UBYTE autosar_swc_tos_CM_uint8 0 0 0 255 ECU_ADDRESS 0xfe4bc0c8 /* @ECU_Address@autosar_swc_tos_rtARID_DEF.ARID_DEF_MATLABFunction18.time_Vru_in@ */ /end MEASUREMENT
/begin MEASUREMENT autosar_swc_tos_rtARID_DEF.ARID_DEF_MATLABFunction18.time_Vru_out "" UBYTE autosar_swc_tos_CM_uint8 0 0 0 255 ECU_ADDRESS 0xfe4bc0cf /* @ECU_Address@autosar_swc_tos_rtARID_DEF.ARID_DEF_MATLABFunction18.time_Vru_out@ */ /end MEASUREMENT
/begin MEASUREMENT autosar_swc_tos_rtARID_DEF.ARID_DEF_MATLABFunction19.Maxoffset "" FLOAT32_IEEE autosar_swc_tos_CM_single 0 0 -3.4E+38 3.4E+38 ECU_ADDRESS 0xfe4bc0c4 /* @ECU_Address@autosar_swc_tos_rtARID_DEF.ARID_DEF_MATLABFunction19.Maxoffset@ */ /end MEASUREMENT
/begin MEASUREMENT autosar_swc_tos_rtARID_DEF.ARID_DEF_MATLABFunction2.Maxoffset "" FLOAT32_IEEE autosar_swc_tos_CM_single 0 0 -3.4E+38 3.4E+38 ECU_ADDRESS 0xfe4bc0c0 /* @ECU_Address@autosar_swc_tos_rtARID_DEF.ARID_DEF_MATLABFunction2.Maxoffset@ */ /end MEASUREMENT
/begin MEASUREMENT autosar_swc_tos_rtARID_DEF.ARID_DEF_MATLABFunction20.LowSpdtime_MovTruck_in "" UBYTE autosar_swc_tos_CM_uint8 0 0 0 255 ECU_ADDRESS 0xfe4bc0b5 /* @ECU_Address@autosar_swc_tos_rtARID_DEF.ARID_DEF_MATLABFunction20.LowSpdtime_MovTruck_in@ */ /end MEASUREMENT
/begin MEASUREMENT autosar_swc_tos_rtARID_DEF.ARID_DEF_MATLABFunction20.LowSpdtime_MovTruck_out "" UBYTE autosar_swc_tos_CM_uint8 0 0 0 255 ECU_ADDRESS 0xfe4bc0bd /* @ECU_Address@autosar_swc_tos_rtARID_DEF.ARID_DEF_MATLABFunction20.LowSpdtime_MovTruck_out@ */ /end MEASUREMENT
/begin MEASUREMENT autosar_swc_tos_rtARID_DEF.ARID_DEF_MATLABFunction20.time_MovCar_in "" UBYTE autosar_swc_tos_CM_uint8 0 0 0 255 ECU_ADDRESS 0xfe4bc0b3 /* @ECU_Address@autosar_swc_tos_rtARID_DEF.ARID_DEF_MATLABFunction20.time_MovCar_in@ */ /end MEASUREMENT
/begin MEASUREMENT autosar_swc_tos_rtARID_DEF.ARID_DEF_MATLABFunction20.time_MovCar_out "" UBYTE autosar_swc_tos_CM_uint8 0 0 0 255 ECU_ADDRESS 0xfe4bc0bc /* @ECU_Address@autosar_swc_tos_rtARID_DEF.ARID_DEF_MATLABFunction20.time_MovCar_out@ */ /end MEASUREMENT
/begin MEASUREMENT autosar_swc_tos_rtARID_DEF.ARID_DEF_MATLABFunction20.time_MovTruck_in "" UBYTE autosar_swc_tos_CM_uint8 0 0 0 255 ECU_ADDRESS 0xfe4bc0b2 /* @ECU_Address@autosar_swc_tos_rtARID_DEF.ARID_DEF_MATLABFunction20.time_MovTruck_in@ */ /end MEASUREMENT
/begin MEASUREMENT autosar_swc_tos_rtARID_DEF.ARID_DEF_MATLABFunction20.time_MovTruck_out "" UBYTE autosar_swc_tos_CM_uint8 0 0 0 255 ECU_ADDRESS 0xfe4bc0bb /* @ECU_Address@autosar_swc_tos_rtARID_DEF.ARID_DEF_MATLABFunction20.time_MovTruck_out@ */ /end MEASUREMENT
/begin MEASUREMENT autosar_swc_tos_rtARID_DEF.ARID_DEF_MATLABFunction20.time_StaCar_in "" UBYTE autosar_swc_tos_CM_uint8 0 0 0 255 ECU_ADDRESS 0xfe4bc0b1 /* @ECU_Address@autosar_swc_tos_rtARID_DEF.ARID_DEF_MATLABFunction20.time_StaCar_in@ */ /end MEASUREMENT
/begin MEASUREMENT autosar_swc_tos_rtARID_DEF.ARID_DEF_MATLABFunction20.time_StaCar_out "" UBYTE autosar_swc_tos_CM_uint8 0 0 0 255 ECU_ADDRESS 0xfe4bc0ba /* @ECU_Address@autosar_swc_tos_rtARID_DEF.ARID_DEF_MATLABFunction20.time_StaCar_out@ */ /end MEASUREMENT
/begin MEASUREMENT autosar_swc_tos_rtARID_DEF.ARID_DEF_MATLABFunction20.time_StaCar_presslane_out "" UBYTE autosar_swc_tos_CM_uint8 0 0 0 255 ECU_ADDRESS 0xfe4bc0b9 /* @ECU_Address@autosar_swc_tos_rtARID_DEF.ARID_DEF_MATLABFunction20.time_StaCar_presslane_out@ */ /end MEASUREMENT
/begin MEASUREMENT autosar_swc_tos_rtARID_DEF.ARID_DEF_MATLABFunction20.time_StaTruck_in "" UBYTE autosar_swc_tos_CM_uint8 0 0 0 255 ECU_ADDRESS 0xfe4bc0b0 /* @ECU_Address@autosar_swc_tos_rtARID_DEF.ARID_DEF_MATLABFunction20.time_StaTruck_in@ */ /end MEASUREMENT
/begin MEASUREMENT autosar_swc_tos_rtARID_DEF.ARID_DEF_MATLABFunction20.time_StaTruck_out "" UBYTE autosar_swc_tos_CM_uint8 0 0 0 255 ECU_ADDRESS 0xfe4bc0b8 /* @ECU_Address@autosar_swc_tos_rtARID_DEF.ARID_DEF_MATLABFunction20.time_StaTruck_out@ */ /end MEASUREMENT
/begin MEASUREMENT autosar_swc_tos_rtARID_DEF.ARID_DEF_MATLABFunction20.time_StaTruck_presslane_out "" UBYTE autosar_swc_tos_CM_uint8 0 0 0 255 ECU_ADDRESS 0xfe4bc0b7 /* @ECU_Address@autosar_swc_tos_rtARID_DEF.ARID_DEF_MATLABFunction20.time_StaTruck_presslane_out@ */ /end MEASUREMENT
/begin MEASUREMENT autosar_swc_tos_rtARID_DEF.ARID_DEF_MATLABFunction20.time_StaVeh_in "" UBYTE autosar_swc_tos_CM_uint8 0 0 0 255 ECU_ADDRESS 0xfe4bc0b4 /* @ECU_Address@autosar_swc_tos_rtARID_DEF.ARID_DEF_MATLABFunction20.time_StaVeh_in@ */ /end MEASUREMENT
/begin MEASUREMENT autosar_swc_tos_rtARID_DEF.ARID_DEF_MATLABFunction20.time_Vru_in "" UBYTE autosar_swc_tos_CM_uint8 0 0 0 255 ECU_ADDRESS 0xfe4bc0af /* @ECU_Address@autosar_swc_tos_rtARID_DEF.ARID_DEF_MATLABFunction20.time_Vru_in@ */ /end MEASUREMENT
/begin MEASUREMENT autosar_swc_tos_rtARID_DEF.ARID_DEF_MATLABFunction20.time_Vru_out "" UBYTE autosar_swc_tos_CM_uint8 0 0 0 255 ECU_ADDRESS 0xfe4bc0b6 /* @ECU_Address@autosar_swc_tos_rtARID_DEF.ARID_DEF_MATLABFunction20.time_Vru_out@ */ /end MEASUREMENT
/begin MEASUREMENT autosar_swc_tos_rtARID_DEF.ARID_DEF_MATLABFunction22.LowSpdtime_MovTruck_in "" UBYTE autosar_swc_tos_CM_uint8 0 0 0 255 ECU_ADDRESS 0xfe4bc0a6 /* @ECU_Address@autosar_swc_tos_rtARID_DEF.ARID_DEF_MATLABFunction22.LowSpdtime_MovTruck_in@ */ /end MEASUREMENT
/begin MEASUREMENT autosar_swc_tos_rtARID_DEF.ARID_DEF_MATLABFunction22.LowSpdtime_MovTruck_out "" UBYTE autosar_swc_tos_CM_uint8 0 0 0 255 ECU_ADDRESS 0xfe4bc0ae /* @ECU_Address@autosar_swc_tos_rtARID_DEF.ARID_DEF_MATLABFunction22.LowSpdtime_MovTruck_out@ */ /end MEASUREMENT
/begin MEASUREMENT autosar_swc_tos_rtARID_DEF.ARID_DEF_MATLABFunction22.time_MovCar_in "" UBYTE autosar_swc_tos_CM_uint8 0 0 0 255 ECU_ADDRESS 0xfe4bc0a4 /* @ECU_Address@autosar_swc_tos_rtARID_DEF.ARID_DEF_MATLABFunction22.time_MovCar_in@ */ /end MEASUREMENT
/begin MEASUREMENT autosar_swc_tos_rtARID_DEF.ARID_DEF_MATLABFunction22.time_MovCar_out "" UBYTE autosar_swc_tos_CM_uint8 0 0 0 255 ECU_ADDRESS 0xfe4bc0ad /* @ECU_Address@autosar_swc_tos_rtARID_DEF.ARID_DEF_MATLABFunction22.time_MovCar_out@ */ /end MEASUREMENT
/begin MEASUREMENT autosar_swc_tos_rtARID_DEF.ARID_DEF_MATLABFunction22.time_MovTruck_in "" UBYTE autosar_swc_tos_CM_uint8 0 0 0 255 ECU_ADDRESS 0xfe4bc0a3 /* @ECU_Address@autosar_swc_tos_rtARID_DEF.ARID_DEF_MATLABFunction22.time_MovTruck_in@ */ /end MEASUREMENT
/begin MEASUREMENT autosar_swc_tos_rtARID_DEF.ARID_DEF_MATLABFunction22.time_MovTruck_out "" UBYTE autosar_swc_tos_CM_uint8 0 0 0 255 ECU_ADDRESS 0xfe4bc0ac /* @ECU_Address@autosar_swc_tos_rtARID_DEF.ARID_DEF_MATLABFunction22.time_MovTruck_out@ */ /end MEASUREMENT
/begin MEASUREMENT autosar_swc_tos_rtARID_DEF.ARID_DEF_MATLABFunction22.time_StaCar_in "" UBYTE autosar_swc_tos_CM_uint8 0 0 0 255 ECU_ADDRESS 0xfe4bc0a2 /* @ECU_Address@autosar_swc_tos_rtARID_DEF.ARID_DEF_MATLABFunction22.time_StaCar_in@ */ /end MEASUREMENT
/begin MEASUREMENT autosar_swc_tos_rtARID_DEF.ARID_DEF_MATLABFunction22.time_StaCar_out "" UBYTE autosar_swc_tos_CM_uint8 0 0 0 255 ECU_ADDRESS 0xfe4bc0ab /* @ECU_Address@autosar_swc_tos_rtARID_DEF.ARID_DEF_MATLABFunction22.time_StaCar_out@ */ /end MEASUREMENT
/begin MEASUREMENT autosar_swc_tos_rtARID_DEF.ARID_DEF_MATLABFunction22.time_StaCar_presslane_out "" UBYTE autosar_swc_tos_CM_uint8 0 0 0 255 ECU_ADDRESS 0xfe4bc0aa /* @ECU_Address@autosar_swc_tos_rtARID_DEF.ARID_DEF_MATLABFunction22.time_StaCar_presslane_out@ */ /end MEASUREMENT
/begin MEASUREMENT autosar_swc_tos_rtARID_DEF.ARID_DEF_MATLABFunction22.time_StaTruck_in "" UBYTE autosar_swc_tos_CM_uint8 0 0 0 255 ECU_ADDRESS 0xfe4bc0a1 /* @ECU_Address@autosar_swc_tos_rtARID_DEF.ARID_DEF_MATLABFunction22.time_StaTruck_in@ */ /end MEASUREMENT
/begin MEASUREMENT autosar_swc_tos_rtARID_DEF.ARID_DEF_MATLABFunction22.time_StaTruck_out "" UBYTE autosar_swc_tos_CM_uint8 0 0 0 255 ECU_ADDRESS 0xfe4bc0a9 /* @ECU_Address@autosar_swc_tos_rtARID_DEF.ARID_DEF_MATLABFunction22.time_StaTruck_out@ */ /end MEASUREMENT
/begin MEASUREMENT autosar_swc_tos_rtARID_DEF.ARID_DEF_MATLABFunction22.time_StaTruck_presslane_out "" UBYTE autosar_swc_tos_CM_uint8 0 0 0 255 ECU_ADDRESS 0xfe4bc0a8 /* @ECU_Address@autosar_swc_tos_rtARID_DEF.ARID_DEF_MATLABFunction22.time_StaTruck_presslane_out@ */ /end MEASUREMENT
/begin MEASUREMENT autosar_swc_tos_rtARID_DEF.ARID_DEF_MATLABFunction22.time_StaVeh_in "" UBYTE autosar_swc_tos_CM_uint8 0 0 0 255 ECU_ADDRESS 0xfe4bc0a5 /* @ECU_Address@autosar_swc_tos_rtARID_DEF.ARID_DEF_MATLABFunction22.time_StaVeh_in@ */ /end MEASUREMENT
/begin MEASUREMENT autosar_swc_tos_rtARID_DEF.ARID_DEF_MATLABFunction22.time_Vru_in "" UBYTE autosar_swc_tos_CM_uint8 0 0 0 255 ECU_ADDRESS 0xfe4bc0a0 /* @ECU_Address@autosar_swc_tos_rtARID_DEF.ARID_DEF_MATLABFunction22.time_Vru_in@ */ /end MEASUREMENT
/begin MEASUREMENT autosar_swc_tos_rtARID_DEF.ARID_DEF_MATLABFunction22.time_Vru_out "" UBYTE autosar_swc_tos_CM_uint8 0 0 0 255 ECU_ADDRESS 0xfe4bc0a7 /* @ECU_Address@autosar_swc_tos_rtARID_DEF.ARID_DEF_MATLABFunction22.time_Vru_out@ */ /end MEASUREMENT
/begin MEASUREMENT autosar_swc_tos_rtARID_DEF.ARID_DEF_MATLABFunction3.Maxoffset "" FLOAT32_IEEE autosar_swc_tos_CM_single 0 0 -3.4E+38 3.4E+38 ECU_ADDRESS 0xfe4bc09c /* @ECU_Address@autosar_swc_tos_rtARID_DEF.ARID_DEF_MATLABFunction3.Maxoffset@ */ /end MEASUREMENT
/begin MEASUREMENT autosar_swc_tos_rtARID_DEF.ARID_DEF_MATLABFunction6.LowSpdtime_MovTruck_in "" UBYTE autosar_swc_tos_CM_uint8 0 0 0 255 ECU_ADDRESS 0xfe4bc092 /* @ECU_Address@autosar_swc_tos_rtARID_DEF.ARID_DEF_MATLABFunction6.LowSpdtime_MovTruck_in@ */ /end MEASUREMENT
/begin MEASUREMENT autosar_swc_tos_rtARID_DEF.ARID_DEF_MATLABFunction6.LowSpdtime_MovTruck_out "" UBYTE autosar_swc_tos_CM_uint8 0 0 0 255 ECU_ADDRESS 0xfe4bc09a /* @ECU_Address@autosar_swc_tos_rtARID_DEF.ARID_DEF_MATLABFunction6.LowSpdtime_MovTruck_out@ */ /end MEASUREMENT
/begin MEASUREMENT autosar_swc_tos_rtARID_DEF.ARID_DEF_MATLABFunction6.time_MovCar_in "" UBYTE autosar_swc_tos_CM_uint8 0 0 0 255 ECU_ADDRESS 0xfe4bc090 /* @ECU_Address@autosar_swc_tos_rtARID_DEF.ARID_DEF_MATLABFunction6.time_MovCar_in@ */ /end MEASUREMENT
/begin MEASUREMENT autosar_swc_tos_rtARID_DEF.ARID_DEF_MATLABFunction6.time_MovCar_out "" UBYTE autosar_swc_tos_CM_uint8 0 0 0 255 ECU_ADDRESS 0xfe4bc099 /* @ECU_Address@autosar_swc_tos_rtARID_DEF.ARID_DEF_MATLABFunction6.time_MovCar_out@ */ /end MEASUREMENT
/begin MEASUREMENT autosar_swc_tos_rtARID_DEF.ARID_DEF_MATLABFunction6.time_MovTruck_in "" UBYTE autosar_swc_tos_CM_uint8 0 0 0 255 ECU_ADDRESS 0xfe4bc08f /* @ECU_Address@autosar_swc_tos_rtARID_DEF.ARID_DEF_MATLABFunction6.time_MovTruck_in@ */ /end MEASUREMENT
/begin MEASUREMENT autosar_swc_tos_rtARID_DEF.ARID_DEF_MATLABFunction6.time_MovTruck_out "" UBYTE autosar_swc_tos_CM_uint8 0 0 0 255 ECU_ADDRESS 0xfe4bc098 /* @ECU_Address@autosar_swc_tos_rtARID_DEF.ARID_DEF_MATLABFunction6.time_MovTruck_out@ */ /end MEASUREMENT
/begin MEASUREMENT autosar_swc_tos_rtARID_DEF.ARID_DEF_MATLABFunction6.time_StaCar_in "" UBYTE autosar_swc_tos_CM_uint8 0 0 0 255 ECU_ADDRESS 0xfe4bc08e /* @ECU_Address@autosar_swc_tos_rtARID_DEF.ARID_DEF_MATLABFunction6.time_StaCar_in@ */ /end MEASUREMENT
/begin MEASUREMENT autosar_swc_tos_rtARID_DEF.ARID_DEF_MATLABFunction6.time_StaCar_out "" UBYTE autosar_swc_tos_CM_uint8 0 0 0 255 ECU_ADDRESS 0xfe4bc097 /* @ECU_Address@autosar_swc_tos_rtARID_DEF.ARID_DEF_MATLABFunction6.time_StaCar_out@ */ /end MEASUREMENT
/begin MEASUREMENT autosar_swc_tos_rtARID_DEF.ARID_DEF_MATLABFunction6.time_StaCar_presslane_out "" UBYTE autosar_swc_tos_CM_uint8 0 0 0 255 ECU_ADDRESS 0xfe4bc096 /* @ECU_Address@autosar_swc_tos_rtARID_DEF.ARID_DEF_MATLABFunction6.time_StaCar_presslane_out@ */ /end MEASUREMENT
/begin MEASUREMENT autosar_swc_tos_rtARID_DEF.ARID_DEF_MATLABFunction6.time_StaTruck_in "" UBYTE autosar_swc_tos_CM_uint8 0 0 0 255 ECU_ADDRESS 0xfe4bc08d /* @ECU_Address@autosar_swc_tos_rtARID_DEF.ARID_DEF_MATLABFunction6.time_StaTruck_in@ */ /end MEASUREMENT
/begin MEASUREMENT autosar_swc_tos_rtARID_DEF.ARID_DEF_MATLABFunction6.time_StaTruck_out "" UBYTE autosar_swc_tos_CM_uint8 0 0 0 255 ECU_ADDRESS 0xfe4bc095 /* @ECU_Address@autosar_swc_tos_rtARID_DEF.ARID_DEF_MATLABFunction6.time_StaTruck_out@ */ /end MEASUREMENT
/begin MEASUREMENT autosar_swc_tos_rtARID_DEF.ARID_DEF_MATLABFunction6.time_StaTruck_presslane_out "" UBYTE autosar_swc_tos_CM_uint8 0 0 0 255 ECU_ADDRESS 0xfe4bc094 /* @ECU_Address@autosar_swc_tos_rtARID_DEF.ARID_DEF_MATLABFunction6.time_StaTruck_presslane_out@ */ /end MEASUREMENT
/begin MEASUREMENT autosar_swc_tos_rtARID_DEF.ARID_DEF_MATLABFunction6.time_StaVeh_in "" UBYTE autosar_swc_tos_CM_uint8 0 0 0 255 ECU_ADDRESS 0xfe4bc091 /* @ECU_Address@autosar_swc_tos_rtARID_DEF.ARID_DEF_MATLABFunction6.time_StaVeh_in@ */ /end MEASUREMENT
/begin MEASUREMENT autosar_swc_tos_rtARID_DEF.ARID_DEF_MATLABFunction6.time_Vru_in "" UBYTE autosar_swc_tos_CM_uint8 0 0 0 255 ECU_ADDRESS 0xfe4bc08c /* @ECU_Address@autosar_swc_tos_rtARID_DEF.ARID_DEF_MATLABFunction6.time_Vru_in@ */ /end MEASUREMENT
/begin MEASUREMENT autosar_swc_tos_rtARID_DEF.ARID_DEF_MATLABFunction6.time_Vru_out "" UBYTE autosar_swc_tos_CM_uint8 0 0 0 255 ECU_ADDRESS 0xfe4bc093 /* @ECU_Address@autosar_swc_tos_rtARID_DEF.ARID_DEF_MATLABFunction6.time_Vru_out@ */ /end MEASUREMENT
/begin MEASUREMENT autosar_swc_tos_rtARID_DEF.ARID_DEF_MATLABFunction7.Maxoffset "" FLOAT32_IEEE autosar_swc_tos_CM_single 0 0 -3.4E+38 3.4E+38 ECU_ADDRESS 0xfe4bc088 /* @ECU_Address@autosar_swc_tos_rtARID_DEF.ARID_DEF_MATLABFunction7.Maxoffset@ */ /end MEASUREMENT
/begin MEASUREMENT autosar_swc_tos_rtARID_DEF.ARID_DEF_MATLABFunction8.LowSpdtime_MovTruck_in "" UBYTE autosar_swc_tos_CM_uint8 0 0 0 255 ECU_ADDRESS 0xfe4bc07e /* @ECU_Address@autosar_swc_tos_rtARID_DEF.ARID_DEF_MATLABFunction8.LowSpdtime_MovTruck_in@ */ /end MEASUREMENT
/begin MEASUREMENT autosar_swc_tos_rtARID_DEF.ARID_DEF_MATLABFunction8.LowSpdtime_MovTruck_out "" UBYTE autosar_swc_tos_CM_uint8 0 0 0 255 ECU_ADDRESS 0xfe4bc086 /* @ECU_Address@autosar_swc_tos_rtARID_DEF.ARID_DEF_MATLABFunction8.LowSpdtime_MovTruck_out@ */ /end MEASUREMENT
/begin MEASUREMENT autosar_swc_tos_rtARID_DEF.ARID_DEF_MATLABFunction8.time_MovCar_in "" UBYTE autosar_swc_tos_CM_uint8 0 0 0 255 ECU_ADDRESS 0xfe4bc07c /* @ECU_Address@autosar_swc_tos_rtARID_DEF.ARID_DEF_MATLABFunction8.time_MovCar_in@ */ /end MEASUREMENT
/begin MEASUREMENT autosar_swc_tos_rtARID_DEF.ARID_DEF_MATLABFunction8.time_MovCar_out "" UBYTE autosar_swc_tos_CM_uint8 0 0 0 255 ECU_ADDRESS 0xfe4bc085 /* @ECU_Address@autosar_swc_tos_rtARID_DEF.ARID_DEF_MATLABFunction8.time_MovCar_out@ */ /end MEASUREMENT
/begin MEASUREMENT autosar_swc_tos_rtARID_DEF.ARID_DEF_MATLABFunction8.time_MovTruck_in "" UBYTE autosar_swc_tos_CM_uint8 0 0 0 255 ECU_ADDRESS 0xfe4bc07b /* @ECU_Address@autosar_swc_tos_rtARID_DEF.ARID_DEF_MATLABFunction8.time_MovTruck_in@ */ /end MEASUREMENT
/begin MEASUREMENT autosar_swc_tos_rtARID_DEF.ARID_DEF_MATLABFunction8.time_MovTruck_out "" UBYTE autosar_swc_tos_CM_uint8 0 0 0 255 ECU_ADDRESS 0xfe4bc084 /* @ECU_Address@autosar_swc_tos_rtARID_DEF.ARID_DEF_MATLABFunction8.time_MovTruck_out@ */ /end MEASUREMENT
/begin MEASUREMENT autosar_swc_tos_rtARID_DEF.ARID_DEF_MATLABFunction8.time_StaCar_in "" UBYTE autosar_swc_tos_CM_uint8 0 0 0 255 ECU_ADDRESS 0xfe4bc07a /* @ECU_Address@autosar_swc_tos_rtARID_DEF.ARID_DEF_MATLABFunction8.time_StaCar_in@ */ /end MEASUREMENT
/begin MEASUREMENT autosar_swc_tos_rtARID_DEF.ARID_DEF_MATLABFunction8.time_StaCar_out "" UBYTE autosar_swc_tos_CM_uint8 0 0 0 255 ECU_ADDRESS 0xfe4bc083 /* @ECU_Address@autosar_swc_tos_rtARID_DEF.ARID_DEF_MATLABFunction8.time_StaCar_out@ */ /end MEASUREMENT
/begin MEASUREMENT autosar_swc_tos_rtARID_DEF.ARID_DEF_MATLABFunction8.time_StaCar_presslane_out "" UBYTE autosar_swc_tos_CM_uint8 0 0 0 255 ECU_ADDRESS 0xfe4bc082 /* @ECU_Address@autosar_swc_tos_rtARID_DEF.ARID_DEF_MATLABFunction8.time_StaCar_presslane_out@ */ /end MEASUREMENT
/begin MEASUREMENT autosar_swc_tos_rtARID_DEF.ARID_DEF_MATLABFunction8.time_StaTruck_in "" UBYTE autosar_swc_tos_CM_uint8 0 0 0 255 ECU_ADDRESS 0xfe4bc079 /* @ECU_Address@autosar_swc_tos_rtARID_DEF.ARID_DEF_MATLABFunction8.time_StaTruck_in@ */ /end MEASUREMENT
/begin MEASUREMENT autosar_swc_tos_rtARID_DEF.ARID_DEF_MATLABFunction8.time_StaTruck_out "" UBYTE autosar_swc_tos_CM_uint8 0 0 0 255 ECU_ADDRESS 0xfe4bc081 /* @ECU_Address@autosar_swc_tos_rtARID_DEF.ARID_DEF_MATLABFunction8.time_StaTruck_out@ */ /end MEASUREMENT
/begin MEASUREMENT autosar_swc_tos_rtARID_DEF.ARID_DEF_MATLABFunction8.time_StaTruck_presslane_out "" UBYTE autosar_swc_tos_CM_uint8 0 0 0 255 ECU_ADDRESS 0xfe4bc080 /* @ECU_Address@autosar_swc_tos_rtARID_DEF.ARID_DEF_MATLABFunction8.time_StaTruck_presslane_out@ */ /end MEASUREMENT
/begin MEASUREMENT autosar_swc_tos_rtARID_DEF.ARID_DEF_MATLABFunction8.time_StaVeh_in "" UBYTE autosar_swc_tos_CM_uint8 0 0 0 255 ECU_ADDRESS 0xfe4bc07d /* @ECU_Address@autosar_swc_tos_rtARID_DEF.ARID_DEF_MATLABFunction8.time_StaVeh_in@ */ /end MEASUREMENT
/begin MEASUREMENT autosar_swc_tos_rtARID_DEF.ARID_DEF_MATLABFunction8.time_Vru_in "" UBYTE autosar_swc_tos_CM_uint8 0 0 0 255 ECU_ADDRESS 0xfe4bc078 /* @ECU_Address@autosar_swc_tos_rtARID_DEF.ARID_DEF_MATLABFunction8.time_Vru_in@ */ /end MEASUREMENT
/begin MEASUREMENT autosar_swc_tos_rtARID_DEF.ARID_DEF_MATLABFunction8.time_Vru_out "" UBYTE autosar_swc_tos_CM_uint8 0 0 0 255 ECU_ADDRESS 0xfe4bc07f /* @ECU_Address@autosar_swc_tos_rtARID_DEF.ARID_DEF_MATLABFunction8.time_Vru_out@ */ /end MEASUREMENT
/begin MEASUREMENT autosar_swc_tos_rtARID_DEF.ARID_DEF_MATLABFunction9.Maxoffset "" FLOAT32_IEEE autosar_swc_tos_CM_single 0 0 -3.4E+38 3.4E+38 ECU_ADDRESS 0xfe4bc074 /* @ECU_Address@autosar_swc_tos_rtARID_DEF.ARID_DEF_MATLABFunction9.Maxoffset@ */ /end MEASUREMENT
/begin MEASUREMENT autosar_swc_tos_rtARID_DEF.Delay_2_DSTATE "" UBYTE autosar_swc_tos_CM_uint8 0 0 0 255 ECU_ADDRESS 0xfe4ca383 /* @ECU_Address@autosar_swc_tos_rtARID_DEF.Delay_2_DSTATE@ */ /end MEASUREMENT
/begin MEASUREMENT autosar_swc_tos_rtARID_DEF.LastLM.Lines[1].Source "" UBYTE autosar_swc_tos_CM_uint8 0 0 0 255 ECU_ADDRESS 0xfe4c3354 /* @ECU_Address@autosar_swc_tos_rtARID_DEF.LastLM.Lines[1].Source@ */ /end MEASUREMENT
/begin MEASUREMENT autosar_swc_tos_rtARID_DEF.LastLM.Lines[1].bIsLineExist "" UBYTE autosar_swc_tos_CM_uint8 0 0 0 255 ECU_ADDRESS 0xfe4c3355 /* @ECU_Address@autosar_swc_tos_rtARID_DEF.LastLM.Lines[1].bIsLineExist@ */ /end MEASUREMENT
/begin MEASUREMENT autosar_swc_tos_rtARID_DEF.LastLM.Lines[1].dC0V "" FLOAT32_IEEE autosar_swc_tos_CM_single 0 0 -10.000000 10.000000 ECU_ADDRESS 0xfe4c3358 /* @ECU_Address@autosar_swc_tos_rtARID_DEF.LastLM.Lines[1].dC0V@ */ /end MEASUREMENT
/begin MEASUREMENT autosar_swc_tos_rtARID_DEF.LastLM.Lines[1].dC1V "" FLOAT32_IEEE autosar_swc_tos_CM_single 0 0 -3.000000 3.000000 ECU_ADDRESS 0xfe4c335c /* @ECU_Address@autosar_swc_tos_rtARID_DEF.LastLM.Lines[1].dC1V@ */ /end MEASUREMENT
/begin MEASUREMENT autosar_swc_tos_rtARID_DEF.LastLM.Lines[1].dC2V "" FLOAT32_IEEE autosar_swc_tos_CM_single 0 0 -0.200000 0.200000 ECU_ADDRESS 0xfe4c3360 /* @ECU_Address@autosar_swc_tos_rtARID_DEF.LastLM.Lines[1].dC2V@ */ /end MEASUREMENT
/begin MEASUREMENT autosar_swc_tos_rtARID_DEF.LastLM.Lines[1].dC3V "" FLOAT32_IEEE autosar_swc_tos_CM_single 0 0 -0.100000 0.100000 ECU_ADDRESS 0xfe4c3364 /* @ECU_Address@autosar_swc_tos_rtARID_DEF.LastLM.Lines[1].dC3V@ */ /end MEASUREMENT
/begin MEASUREMENT autosar_swc_tos_rtARID_DEF.LastLM.Lines[1].dC4V "" FLOAT32_IEEE autosar_swc_tos_CM_single 0 0 -3.4E+38 3.4E+38 ECU_ADDRESS 0xfe4c3368 /* @ECU_Address@autosar_swc_tos_rtARID_DEF.LastLM.Lines[1].dC4V@ */ /end MEASUREMENT
/begin MEASUREMENT autosar_swc_tos_rtARID_DEF.LastLM.Lines[1].dC5V "" FLOAT32_IEEE autosar_swc_tos_CM_single 0 0 -3.4E+38 3.4E+38 ECU_ADDRESS 0xfe4c336c /* @ECU_Address@autosar_swc_tos_rtARID_DEF.LastLM.Lines[1].dC5V@ */ /end MEASUREMENT
/begin MEASUREMENT autosar_swc_tos_rtARID_DEF.LastLM.Lines[1].dDisFront "" FLOAT32_IEEE autosar_swc_tos_CM_single 0 0 0.000000 200.000000 ECU_ADDRESS 0xfe4c3378 /* @ECU_Address@autosar_swc_tos_rtARID_DEF.LastLM.Lines[1].dDisFront@ */ /end MEASUREMENT
/begin MEASUREMENT autosar_swc_tos_rtARID_DEF.LastLM.Lines[1].dDisStart "" FLOAT32_IEEE autosar_swc_tos_CM_single 0 0 0.000000 200.000000 ECU_ADDRESS 0xfe4c3374 /* @ECU_Address@autosar_swc_tos_rtARID_DEF.LastLM.Lines[1].dDisStart@ */ /end MEASUREMENT
/begin MEASUREMENT autosar_swc_tos_rtARID_DEF.LastLM.Lines[1].dLaneWidth "" FLOAT32_IEEE autosar_swc_tos_CM_single 0 0 0.000000 10.000000 ECU_ADDRESS 0xfe4c3380 /* @ECU_Address@autosar_swc_tos_rtARID_DEF.LastLM.Lines[1].dLaneWidth@ */ /end MEASUREMENT
/begin MEASUREMENT autosar_swc_tos_rtARID_DEF.LastLM.Lines[1].dQuality "" FLOAT32_IEEE autosar_swc_tos_CM_single 0 0 -3.4E+38 3.4E+38 ECU_ADDRESS 0xfe4c337c /* @ECU_Address@autosar_swc_tos_rtARID_DEF.LastLM.Lines[1].dQuality@ */ /end MEASUREMENT
/begin MEASUREMENT autosar_swc_tos_rtARID_DEF.LastLM.Lines[1].eLineType "" UBYTE autosar_swc_tos_CM_uint8 0 0 0 255 ECU_ADDRESS 0xfe4c3370 /* @ECU_Address@autosar_swc_tos_rtARID_DEF.LastLM.Lines[1].eLineType@ */ /end MEASUREMENT
/begin MEASUREMENT autosar_swc_tos_rtARID_DEF.LastLM.Lines[1].eLinefusType "" UBYTE autosar_swc_tos_CM_uint8 0 0 0 255 ECU_ADDRESS 0xfe4c3384 /* @ECU_Address@autosar_swc_tos_rtARID_DEF.LastLM.Lines[1].eLinefusType@ */ /end MEASUREMENT
/begin MEASUREMENT autosar_swc_tos_rtARID_DEF.LastLM.Lines[2].Source "" UBYTE autosar_swc_tos_CM_uint8 0 0 0 255 ECU_ADDRESS 0xfe4c3388 /* @ECU_Address@autosar_swc_tos_rtARID_DEF.LastLM.Lines[2].Source@ */ /end MEASUREMENT
/begin MEASUREMENT autosar_swc_tos_rtARID_DEF.LastLM.Lines[2].bIsLineExist "" UBYTE autosar_swc_tos_CM_uint8 0 0 0 255 ECU_ADDRESS 0xfe4c3389 /* @ECU_Address@autosar_swc_tos_rtARID_DEF.LastLM.Lines[2].bIsLineExist@ */ /end MEASUREMENT
/begin MEASUREMENT autosar_swc_tos_rtARID_DEF.LastLM.Lines[2].dC0V "" FLOAT32_IEEE autosar_swc_tos_CM_single 0 0 -10.000000 10.000000 ECU_ADDRESS 0xfe4c338c /* @ECU_Address@autosar_swc_tos_rtARID_DEF.LastLM.Lines[2].dC0V@ */ /end MEASUREMENT
/begin MEASUREMENT autosar_swc_tos_rtARID_DEF.LastLM.Lines[2].dC1V "" FLOAT32_IEEE autosar_swc_tos_CM_single 0 0 -3.000000 3.000000 ECU_ADDRESS 0xfe4c3390 /* @ECU_Address@autosar_swc_tos_rtARID_DEF.LastLM.Lines[2].dC1V@ */ /end MEASUREMENT
/begin MEASUREMENT autosar_swc_tos_rtARID_DEF.LastLM.Lines[2].dC2V "" FLOAT32_IEEE autosar_swc_tos_CM_single 0 0 -0.200000 0.200000 ECU_ADDRESS 0xfe4c3394 /* @ECU_Address@autosar_swc_tos_rtARID_DEF.LastLM.Lines[2].dC2V@ */ /end MEASUREMENT
/begin MEASUREMENT autosar_swc_tos_rtARID_DEF.LastLM.Lines[2].dC3V "" FLOAT32_IEEE autosar_swc_tos_CM_single 0 0 -0.100000 0.100000 ECU_ADDRESS 0xfe4c3398 /* @ECU_Address@autosar_swc_tos_rtARID_DEF.LastLM.Lines[2].dC3V@ */ /end MEASUREMENT
/begin MEASUREMENT autosar_swc_tos_rtARID_DEF.LastLM.Lines[2].dC4V "" FLOAT32_IEEE autosar_swc_tos_CM_single 0 0 -3.4E+38 3.4E+38 ECU_ADDRESS 0xfe4c339c /* @ECU_Address@autosar_swc_tos_rtARID_DEF.LastLM.Lines[2].dC4V@ */ /end MEASUREMENT
/begin MEASUREMENT autosar_swc_tos_rtARID_DEF.LastLM.Lines[2].dC5V "" FLOAT32_IEEE autosar_swc_tos_CM_single 0 0 -3.4E+38 3.4E+38 ECU_ADDRESS 0xfe4c33a0 /* @ECU_Address@autosar_swc_tos_rtARID_DEF.LastLM.Lines[2].dC5V@ */ /end MEASUREMENT
/begin MEASUREMENT autosar_swc_tos_rtARID_DEF.LastLM.Lines[2].dDisFront "" FLOAT32_IEEE autosar_swc_tos_CM_single 0 0 0.000000 200.000000 ECU_ADDRESS 0xfe4c33ac /* @ECU_Address@autosar_swc_tos_rtARID_DEF.LastLM.Lines[2].dDisFront@ */ /end MEASUREMENT
/begin MEASUREMENT autosar_swc_tos_rtARID_DEF.LastLM.Lines[2].dDisStart "" FLOAT32_IEEE autosar_swc_tos_CM_single 0 0 0.000000 200.000000 ECU_ADDRESS 0xfe4c33a8 /* @ECU_Address@autosar_swc_tos_rtARID_DEF.LastLM.Lines[2].dDisStart@ */ /end MEASUREMENT
/begin MEASUREMENT autosar_swc_tos_rtARID_DEF.LastLM.Lines[2].dLaneWidth "" FLOAT32_IEEE autosar_swc_tos_CM_single 0 0 0.000000 10.000000 ECU_ADDRESS 0xfe4c33b4 /* @ECU_Address@autosar_swc_tos_rtARID_DEF.LastLM.Lines[2].dLaneWidth@ */ /end MEASUREMENT
/begin MEASUREMENT autosar_swc_tos_rtARID_DEF.LastLM.Lines[2].dQuality "" FLOAT32_IEEE autosar_swc_tos_CM_single 0 0 -3.4E+38 3.4E+38 ECU_ADDRESS 0xfe4c33b0 /* @ECU_Address@autosar_swc_tos_rtARID_DEF.LastLM.Lines[2].dQuality@ */ /end MEASUREMENT
/begin MEASUREMENT autosar_swc_tos_rtARID_DEF.LastLM.Lines[2].eLineType "" UBYTE autosar_swc_tos_CM_uint8 0 0 0 255 ECU_ADDRESS 0xfe4c33a4 /* @ECU_Address@autosar_swc_tos_rtARID_DEF.LastLM.Lines[2].eLineType@ */ /end MEASUREMENT
/begin MEASUREMENT autosar_swc_tos_rtARID_DEF.LastLM.Lines[2].eLinefusType "" UBYTE autosar_swc_tos_CM_uint8 0 0 0 255 ECU_ADDRESS 0xfe4c33b8 /* @ECU_Address@autosar_swc_tos_rtARID_DEF.LastLM.Lines[2].eLinefusType@ */ /end MEASUREMENT
/begin MEASUREMENT autosar_swc_tos_rtARID_DEF.LastLM.Lines[3].Source "" UBYTE autosar_swc_tos_CM_uint8 0 0 0 255 ECU_ADDRESS 0xfe4c33bc /* @ECU_Address@autosar_swc_tos_rtARID_DEF.LastLM.Lines[3].Source@ */ /end MEASUREMENT
/begin MEASUREMENT autosar_swc_tos_rtARID_DEF.LastLM.Lines[3].bIsLineExist "" UBYTE autosar_swc_tos_CM_uint8 0 0 0 255 ECU_ADDRESS 0xfe4c33bd /* @ECU_Address@autosar_swc_tos_rtARID_DEF.LastLM.Lines[3].bIsLineExist@ */ /end MEASUREMENT
/begin MEASUREMENT autosar_swc_tos_rtARID_DEF.LastLM.Lines[3].dC0V "" FLOAT32_IEEE autosar_swc_tos_CM_single 0 0 -10.000000 10.000000 ECU_ADDRESS 0xfe4c33c0 /* @ECU_Address@autosar_swc_tos_rtARID_DEF.LastLM.Lines[3].dC0V@ */ /end MEASUREMENT
/begin MEASUREMENT autosar_swc_tos_rtARID_DEF.LastLM.Lines[3].dC1V "" FLOAT32_IEEE autosar_swc_tos_CM_single 0 0 -3.000000 3.000000 ECU_ADDRESS 0xfe4c33c4 /* @ECU_Address@autosar_swc_tos_rtARID_DEF.LastLM.Lines[3].dC1V@ */ /end MEASUREMENT
/begin MEASUREMENT autosar_swc_tos_rtARID_DEF.LastLM.Lines[3].dC2V "" FLOAT32_IEEE autosar_swc_tos_CM_single 0 0 -0.200000 0.200000 ECU_ADDRESS 0xfe4c33c8 /* @ECU_Address@autosar_swc_tos_rtARID_DEF.LastLM.Lines[3].dC2V@ */ /end MEASUREMENT
/begin MEASUREMENT autosar_swc_tos_rtARID_DEF.LastLM.Lines[3].dC3V "" FLOAT32_IEEE autosar_swc_tos_CM_single 0 0 -0.100000 0.100000 ECU_ADDRESS 0xfe4c33cc /* @ECU_Address@autosar_swc_tos_rtARID_DEF.LastLM.Lines[3].dC3V@ */ /end MEASUREMENT
/begin MEASUREMENT autosar_swc_tos_rtARID_DEF.LastLM.Lines[3].dC4V "" FLOAT32_IEEE autosar_swc_tos_CM_single 0 0 -3.4E+38 3.4E+38 ECU_ADDRESS 0xfe4c33d0 /* @ECU_Address@autosar_swc_tos_rtARID_DEF.LastLM.Lines[3].dC4V@ */ /end MEASUREMENT
/begin MEASUREMENT autosar_swc_tos_rtARID_DEF.LastLM.Lines[3].dC5V "" FLOAT32_IEEE autosar_swc_tos_CM_single 0 0 -3.4E+38 3.4E+38 ECU_ADDRESS 0xfe4c33d4 /* @ECU_Address@autosar_swc_tos_rtARID_DEF.LastLM.Lines[3].dC5V@ */ /end MEASUREMENT
/begin MEASUREMENT autosar_swc_tos_rtARID_DEF.LastLM.Lines[3].dDisFront "" FLOAT32_IEEE autosar_swc_tos_CM_single 0 0 0.000000 200.000000 ECU_ADDRESS 0xfe4c33e0 /* @ECU_Address@autosar_swc_tos_rtARID_DEF.LastLM.Lines[3].dDisFront@ */ /end MEASUREMENT
/begin MEASUREMENT autosar_swc_tos_rtARID_DEF.LastLM.Lines[3].dDisStart "" FLOAT32_IEEE autosar_swc_tos_CM_single 0 0 0.000000 200.000000 ECU_ADDRESS 0xfe4c33dc /* @ECU_Address@autosar_swc_tos_rtARID_DEF.LastLM.Lines[3].dDisStart@ */ /end MEASUREMENT
/begin MEASUREMENT autosar_swc_tos_rtARID_DEF.LastLM.Lines[3].dLaneWidth "" FLOAT32_IEEE autosar_swc_tos_CM_single 0 0 0.000000 10.000000 ECU_ADDRESS 0xfe4c33e8 /* @ECU_Address@autosar_swc_tos_rtARID_DEF.LastLM.Lines[3].dLaneWidth@ */ /end MEASUREMENT
/begin MEASUREMENT autosar_swc_tos_rtARID_DEF.LastLM.Lines[3].dQuality "" FLOAT32_IEEE autosar_swc_tos_CM_single 0 0 -3.4E+38 3.4E+38 ECU_ADDRESS 0xfe4c33e4 /* @ECU_Address@autosar_swc_tos_rtARID_DEF.LastLM.Lines[3].dQuality@ */ /end MEASUREMENT
/begin MEASUREMENT autosar_swc_tos_rtARID_DEF.LastLM.Lines[3].eLineType "" UBYTE autosar_swc_tos_CM_uint8 0 0 0 255 ECU_ADDRESS 0xfe4c33d8 /* @ECU_Address@autosar_swc_tos_rtARID_DEF.LastLM.Lines[3].eLineType@ */ /end MEASUREMENT
/begin MEASUREMENT autosar_swc_tos_rtARID_DEF.LastLM.Lines[3].eLinefusType "" UBYTE autosar_swc_tos_CM_uint8 0 0 0 255 ECU_ADDRESS 0xfe4c33ec /* @ECU_Address@autosar_swc_tos_rtARID_DEF.LastLM.Lines[3].eLinefusType@ */ /end MEASUREMENT
/begin MEASUREMENT autosar_swc_tos_rtARID_DEF.UnitDelay1_3_DSTATE "" UBYTE autosar_swc_tos_CM_uint8 0 0 0 255 LAYOUT COLUMN_DIR MATRIX_DIM 5 ECU_ADDRESS 0xfe4c52e4 /* @ECU_Address@autosar_swc_tos_rtARID_DEF.UnitDelay1_3_DSTATE@ */ /end MEASUREMENT
/begin MEASUREMENT autosar_swc_tos_rtARID_DEF.UnitDelay1_3_DSTATE_f "" UBYTE autosar_swc_tos_CM_uint8 0 0 0 255 LAYOUT COLUMN_DIR MATRIX_DIM 5 ECU_ADDRESS 0xfe4c5332 /* @ECU_Address@autosar_swc_tos_rtARID_DEF.UnitDelay1_3_DSTATE_f@ */ /end MEASUREMENT
/begin COMPU_METHOD autosar_swc_tos_CM_int16 "Q = V" IDENTICAL "%5.0" "" /end COMPU_METHOD
/begin COMPU_METHOD autosar_swc_tos_CM_int8 "Q = V" IDENTICAL "%3.0" "" /end COMPU_METHOD
/begin COMPU_METHOD autosar_swc_tos_CM_single "Q = V" IDENTICAL "%8.6" "" /end COMPU_METHOD
/begin COMPU_METHOD autosar_swc_tos_CM_uint16 "Q = V" IDENTICAL "%5.0" "" /end COMPU_METHOD
/begin COMPU_METHOD autosar_swc_tos_CM_uint32 "Q = V" IDENTICAL "%10.0" "" /end COMPU_METHOD
/begin COMPU_METHOD autosar_swc_tos_CM_uint8 "Q = V" IDENTICAL "%3.0" "" /end COMPU_METHOD
/begin RECORD_LAYOUT Record_FLOAT32_IEEE FNC_VALUES 1 FLOAT32_IEEE COLUMN_DIR DIRECT /end RECORD_LAYOUT
/begin RECORD_LAYOUT Record_SBYTE FNC_VALUES 1 SBYTE COLUMN_DIR DIRECT /end RECORD_LAYOUT
/begin RECORD_LAYOUT Record_SWORD FNC_VALUES 1 SWORD COLUMN_DIR DIRECT /end RECORD_LAYOUT
/begin RECORD_LAYOUT Record_UBYTE FNC_VALUES 1 UBYTE COLUMN_DIR DIRECT /end RECORD_LAYOUT
/begin RECORD_LAYOUT Record_ULONG FNC_VALUES 1 ULONG COLUMN_DIR DIRECT /end RECORD_LAYOUT
/begin RECORD_LAYOUT Record_UWORD FNC_VALUES 1 UWORD COLUMN_DIR DIRECT /end RECORD_LAYOUT
/begin CHARACTERISTIC ZDrive_BSW_Cal_Cal.ZDrive_BSW_Cal_VehicleInfomationTable.ASU_Type "" VALUE 0x3d8081 Record_UBYTE 0 autosar_swc_vmc_CM_uint8 0 255 /end CHARACTERISTIC
/begin CHARACTERISTIC ZDrive_BSW_Cal_Cal.ZDrive_BSW_Cal_VehicleInfomationTable.AccSens_LatAccSigDirect "" VALUE 0x3d8078 Record_UBYTE 0 autosar_swc_vmc_CM_uint8 0 255 /end CHARACTERISTIC
/begin CHARACTERISTIC ZDrive_BSW_Cal_Cal.ZDrive_BSW_Cal_VehicleInfomationTable.AccSens_LonAccSigDirect "" VALUE 0x3d8079 Record_UBYTE 0 autosar_swc_vmc_CM_uint8 0 255 /end CHARACTERISTIC
/begin CHARACTERISTIC ZDrive_BSW_Cal_Cal.ZDrive_BSW_Cal_VehicleInfomationTable.ActiveType "" VALUE 0x3d806d Record_UBYTE 0 autosar_swc_vmc_CM_uint8 0 255 /end CHARACTERISTIC
/begin CHARACTERISTIC ZDrive_BSW_Cal_Cal.ZDrive_BSW_Cal_VehicleInfomationTable.AutoHold_Type "" VALUE 0x3d8077 Record_UBYTE 0 autosar_swc_vmc_CM_uint8 0 255 /end CHARACTERISTIC
/begin CHARACTERISTIC ZDrive_BSW_Cal_Cal.ZDrive_BSW_Cal_VehicleInfomationTable.CURB_kg "" VALUE 0x3d810c Record_FLOAT32_IEEE 0 autosar_swc_vmc_CM_single -3.4E+38 3.4E+38 /end CHARACTERISTIC
/begin CHARACTERISTIC ZDrive_BSW_Cal_Cal.ZDrive_BSW_Cal_VehicleInfomationTable.CamDistToRearAxleCenter_DZ "" VALUE 0x3d8174 Record_FLOAT32_IEEE 0 autosar_swc_vmc_CM_single -3.4E+38 3.4E+38 /end CHARACTERISTIC
/begin CHARACTERISTIC ZDrive_BSW_Cal_Cal.ZDrive_BSW_Cal_VehicleInfomationTable.CharSpd_mps "" VALUE 0x3d8138 Record_FLOAT32_IEEE 0 autosar_swc_vmc_CM_single -3.4E+38 3.4E+38 /end CHARACTERISTIC
/begin CHARACTERISTIC ZDrive_BSW_Cal_Cal.ZDrive_BSW_Cal_VehicleInfomationTable.Country_Code "" VALUE 0x3d8068 Record_UBYTE 0 autosar_swc_vmc_CM_uint8 0 255 /end CHARACTERISTIC
/begin CHARACTERISTIC ZDrive_BSW_Cal_Cal.ZDrive_BSW_Cal_VehicleInfomationTable.DriHandTorqueDirect "" VALUE 0x3d807b Record_UBYTE 0 autosar_swc_vmc_CM_uint8 0 255 /end CHARACTERISTIC
/begin CHARACTERISTIC ZDrive_BSW_Cal_Cal.ZDrive_BSW_Cal_VehicleInfomationTable.DrivingLongControlInterForm "" VALUE 0x3d8071 Record_UBYTE 0 autosar_swc_vmc_CM_uint8 0 255 /end CHARACTERISTIC
/begin CHARACTERISTIC ZDrive_BSW_Cal_Cal.ZDrive_BSW_Cal_VehicleInfomationTable.Driving_Type "" VALUE 0x3d8075 Record_UBYTE 0 autosar_swc_vmc_CM_uint8 0 255 /end CHARACTERISTIC
/begin CHARACTERISTIC ZDrive_BSW_Cal_Cal.ZDrive_BSW_Cal_VehicleInfomationTable.DxvFrontBumper_m "" VALUE 0x3d80cc Record_FLOAT32_IEEE 0 autosar_swc_vmc_CM_single -3.4E+38 3.4E+38 /end CHARACTERISTIC
/begin CHARACTERISTIC ZDrive_BSW_Cal_Cal.ZDrive_BSW_Cal_VehicleInfomationTable.DxvRearBumper_m "" VALUE 0x3d80c8 Record_FLOAT32_IEEE 0 autosar_swc_vmc_CM_single -3.4E+38 3.4E+38 /end CHARACTERISTIC
/begin CHARACTERISTIC ZDrive_BSW_Cal_Cal.ZDrive_BSW_Cal_VehicleInfomationTable.EPS_Inter "" VALUE 0x3d8070 Record_UBYTE 0 autosar_swc_vmc_CM_uint8 0 255 /end CHARACTERISTIC
/begin CHARACTERISTIC ZDrive_BSW_Cal_Cal.ZDrive_BSW_Cal_VehicleInfomationTable.ESP_Type "" VALUE 0x3d806b Record_UBYTE 0 autosar_swc_vmc_CM_uint8 0 255 /end CHARACTERISTIC
/begin CHARACTERISTIC ZDrive_BSW_Cal_Cal.ZDrive_BSW_Cal_VehicleInfomationTable.Empty_mass_kg "" VALUE 0x3d8118 Record_FLOAT32_IEEE 0 autosar_swc_vmc_CM_single -3.4E+38 3.4E+38 /end CHARACTERISTIC
/begin CHARACTERISTIC ZDrive_BSW_Cal_Cal.ZDrive_BSW_Cal_VehicleInfomationTable.EngineMaxiTorque_N "" VALUE 0x3d80a0 Record_FLOAT32_IEEE 0 autosar_swc_vmc_CM_single -3.4E+38 3.4E+38 /end CHARACTERISTIC
/begin CHARACTERISTIC ZDrive_BSW_Cal_Cal.ZDrive_BSW_Cal_VehicleInfomationTable.Engine_Type "" VALUE 0x3d806f Record_UBYTE 0 autosar_swc_vmc_CM_uint8 0 255 /end CHARACTERISTIC
/begin CHARACTERISTIC ZDrive_BSW_Cal_Cal.ZDrive_BSW_Cal_VehicleInfomationTable.FC2LeftWheel_m "" VALUE 0x3d8188 Record_FLOAT32_IEEE 0 autosar_swc_vmc_CM_single -3.4E+38 3.4E+38 /end CHARACTERISTIC
/begin CHARACTERISTIC ZDrive_BSW_Cal_Cal.ZDrive_BSW_Cal_VehicleInfomationTable.FC2RearAxisX_m "" VALUE 0x3d816c Record_FLOAT32_IEEE 0 autosar_swc_vmc_CM_single -3.4E+38 3.4E+38 /end CHARACTERISTIC
/begin CHARACTERISTIC ZDrive_BSW_Cal_Cal.ZDrive_BSW_Cal_VehicleInfomationTable.FC2RearAxisY_m "" VALUE 0x3d8170 Record_FLOAT32_IEEE 0 autosar_swc_vmc_CM_single -3.4E+38 3.4E+38 /end CHARACTERISTIC
/begin CHARACTERISTIC ZDrive_BSW_Cal_Cal.ZDrive_BSW_Cal_VehicleInfomationTable.FC2RightWheel_m "" VALUE 0x3d818c Record_FLOAT32_IEEE 0 autosar_swc_vmc_CM_single -3.4E+38 3.4E+38 /end CHARACTERISTIC
/begin CHARACTERISTIC ZDrive_BSW_Cal_Cal.ZDrive_BSW_Cal_VehicleInfomationTable.FCFirstViewPointDist_m "" VALUE 0x3d8178 Record_FLOAT32_IEEE 0 autosar_swc_vmc_CM_single -3.4E+38 3.4E+38 /end CHARACTERISTIC
/begin CHARACTERISTIC ZDrive_BSW_Cal_Cal.ZDrive_BSW_Cal_VehicleInfomationTable.FCFocus2FrAxleDist_Y_m "" VALUE 0x3d8164 Record_FLOAT32_IEEE 0 autosar_swc_vmc_CM_single -3.4E+38 3.4E+38 /end CHARACTERISTIC
/begin CHARACTERISTIC ZDrive_BSW_Cal_Cal.ZDrive_BSW_Cal_VehicleInfomationTable.FCFocus2FrAxleDist_Z_m "" VALUE 0x3d8168 Record_FLOAT32_IEEE 0 autosar_swc_vmc_CM_single -3.4E+38 3.4E+38 /end CHARACTERISTIC
/begin CHARACTERISTIC ZDrive_BSW_Cal_Cal.ZDrive_BSW_Cal_VehicleInfomationTable.FRollingRadius_m "" VALUE 0x3d8150 Record_FLOAT32_IEEE 0 autosar_swc_vmc_CM_single -3.4E+38 3.4E+38 /end CHARACTERISTIC
/begin CHARACTERISTIC ZDrive_BSW_Cal_Cal.ZDrive_BSW_Cal_VehicleInfomationTable.FrSCBlindSpotLength_m "" VALUE 0x3d81d0 Record_FLOAT32_IEEE 0 autosar_swc_vmc_CM_single -3.4E+38 3.4E+38 /end CHARACTERISTIC
/begin CHARACTERISTIC ZDrive_BSW_Cal_Cal.ZDrive_BSW_Cal_VehicleInfomationTable.FrSCDist2OuterMostSide_m "" VALUE 0x3d81d4 Record_FLOAT32_IEEE 0 autosar_swc_vmc_CM_single -3.4E+38 3.4E+38 /end CHARACTERISTIC
/begin CHARACTERISTIC ZDrive_BSW_Cal_Cal.ZDrive_BSW_Cal_VehicleInfomationTable.FrWhlHousingHeight_m "" VALUE 0x3d80c0 Record_FLOAT32_IEEE 0 autosar_swc_vmc_CM_single -3.4E+38 3.4E+38 /end CHARACTERISTIC
/begin CHARACTERISTIC ZDrive_BSW_Cal_Cal.ZDrive_BSW_Cal_VehicleInfomationTable.FrWhlTrack_m "" VALUE 0x3d80b0 Record_FLOAT32_IEEE 0 autosar_swc_vmc_CM_single -3.4E+38 3.4E+38 /end CHARACTERISTIC
/begin CHARACTERISTIC ZDrive_BSW_Cal_Cal.ZDrive_BSW_Cal_VehicleInfomationTable.FrntLeCrnrUss_Dx "" VALUE 0x3d8260 Record_FLOAT32_IEEE 0 autosar_swc_vmc_CM_single -3.4E+38 3.4E+38 /end CHARACTERISTIC
/begin CHARACTERISTIC ZDrive_BSW_Cal_Cal.ZDrive_BSW_Cal_VehicleInfomationTable.FrntLeCrnrUss_Dy "" VALUE 0x3d8264 Record_FLOAT32_IEEE 0 autosar_swc_vmc_CM_single -3.4E+38 3.4E+38 /end CHARACTERISTIC
/begin CHARACTERISTIC ZDrive_BSW_Cal_Cal.ZDrive_BSW_Cal_VehicleInfomationTable.FrntLeCrnrUss_Dz "" VALUE 0x3d8268 Record_FLOAT32_IEEE 0 autosar_swc_vmc_CM_single -3.4E+38 3.4E+38 /end CHARACTERISTIC
/begin CHARACTERISTIC ZDrive_BSW_Cal_Cal.ZDrive_BSW_Cal_VehicleInfomationTable.FrntLeCrnrUss_Pitch "" VALUE 0x3d8274 Record_FLOAT32_IEEE 0 autosar_swc_vmc_CM_single -3.4E+38 3.4E+38 /end CHARACTERISTIC
/begin CHARACTERISTIC ZDrive_BSW_Cal_Cal.ZDrive_BSW_Cal_VehicleInfomationTable.FrntLeCrnrUss_Roll "" VALUE 0x3d8270 Record_FLOAT32_IEEE 0 autosar_swc_vmc_CM_single -3.4E+38 3.4E+38 /end CHARACTERISTIC
/begin CHARACTERISTIC ZDrive_BSW_Cal_Cal.ZDrive_BSW_Cal_VehicleInfomationTable.FrntLeCrnrUss_Yaw "" VALUE 0x3d8278 Record_FLOAT32_IEEE 0 autosar_swc_vmc_CM_single -3.4E+38 3.4E+38 /end CHARACTERISTIC
/begin CHARACTERISTIC ZDrive_BSW_Cal_Cal.ZDrive_BSW_Cal_VehicleInfomationTable.FrntLeMidUss_Dx "" VALUE 0x3d827c Record_FLOAT32_IEEE 0 autosar_swc_vmc_CM_single -3.4E+38 3.4E+38 /end CHARACTERISTIC
/begin CHARACTERISTIC ZDrive_BSW_Cal_Cal.ZDrive_BSW_Cal_VehicleInfomationTable.FrntLeMidUss_Dy "" VALUE 0x3d8280 Record_FLOAT32_IEEE 0 autosar_swc_vmc_CM_single -3.4E+38 3.4E+38 /end CHARACTERISTIC
/begin CHARACTERISTIC ZDrive_BSW_Cal_Cal.ZDrive_BSW_Cal_VehicleInfomationTable.FrntLeMidUss_Dz "" VALUE 0x3d8284 Record_FLOAT32_IEEE 0 autosar_swc_vmc_CM_single -3.4E+38 3.4E+38 /end CHARACTERISTIC
/begin CHARACTERISTIC ZDrive_BSW_Cal_Cal.ZDrive_BSW_Cal_VehicleInfomationTable.FrntLeMidUss_Pitch "" VALUE 0x3d8290 Record_FLOAT32_IEEE 0 autosar_swc_vmc_CM_single -3.4E+38 3.4E+38 /end CHARACTERISTIC
/begin CHARACTERISTIC ZDrive_BSW_Cal_Cal.ZDrive_BSW_Cal_VehicleInfomationTable.FrntLeMidUss_Roll "" VALUE 0x3d828c Record_FLOAT32_IEEE 0 autosar_swc_vmc_CM_single -3.4E+38 3.4E+38 /end CHARACTERISTIC
/begin CHARACTERISTIC ZDrive_BSW_Cal_Cal.ZDrive_BSW_Cal_VehicleInfomationTable.FrntLeMidUss_Yaw "" VALUE 0x3d8294 Record_FLOAT32_IEEE 0 autosar_swc_vmc_CM_single -3.4E+38 3.4E+38 /end CHARACTERISTIC
/begin CHARACTERISTIC ZDrive_BSW_Cal_Cal.ZDrive_BSW_Cal_VehicleInfomationTable.FrntLeSideUss_Dx "" VALUE 0x3d8244 Record_FLOAT32_IEEE 0 autosar_swc_vmc_CM_single -3.4E+38 3.4E+38 /end CHARACTERISTIC
/begin CHARACTERISTIC ZDrive_BSW_Cal_Cal.ZDrive_BSW_Cal_VehicleInfomationTable.FrntLeSideUss_Dy "" VALUE 0x3d8248 Record_FLOAT32_IEEE 0 autosar_swc_vmc_CM_single -3.4E+38 3.4E+38 /end CHARACTERISTIC
/begin CHARACTERISTIC ZDrive_BSW_Cal_Cal.ZDrive_BSW_Cal_VehicleInfomationTable.FrntLeSideUss_Dz "" VALUE 0x3d824c Record_FLOAT32_IEEE 0 autosar_swc_vmc_CM_single -3.4E+38 3.4E+38 /end CHARACTERISTIC
/begin CHARACTERISTIC ZDrive_BSW_Cal_Cal.ZDrive_BSW_Cal_VehicleInfomationTable.FrntLeSideUss_Pitch "" VALUE 0x3d8258 Record_FLOAT32_IEEE 0 autosar_swc_vmc_CM_single -3.4E+38 3.4E+38 /end CHARACTERISTIC
/begin CHARACTERISTIC ZDrive_BSW_Cal_Cal.ZDrive_BSW_Cal_VehicleInfomationTable.FrntLeSideUss_Roll "" VALUE 0x3d8254 Record_FLOAT32_IEEE 0 autosar_swc_vmc_CM_single -3.4E+38 3.4E+38 /end CHARACTERISTIC
/begin CHARACTERISTIC ZDrive_BSW_Cal_Cal.ZDrive_BSW_Cal_VehicleInfomationTable.FrntLeSideUss_Yaw "" VALUE 0x3d825c Record_FLOAT32_IEEE 0 autosar_swc_vmc_CM_single -3.4E+38 3.4E+38 /end CHARACTERISTIC
/begin CHARACTERISTIC ZDrive_BSW_Cal_Cal.ZDrive_BSW_Cal_VehicleInfomationTable.FrntRiCrnrUss_Dx "" VALUE 0x3d82b4 Record_FLOAT32_IEEE 0 autosar_swc_vmc_CM_single -3.4E+38 3.4E+38 /end CHARACTERISTIC
/begin CHARACTERISTIC ZDrive_BSW_Cal_Cal.ZDrive_BSW_Cal_VehicleInfomationTable.FrntRiCrnrUss_Dy "" VALUE 0x3d82b8 Record_FLOAT32_IEEE 0 autosar_swc_vmc_CM_single -3.4E+38 3.4E+38 /end CHARACTERISTIC
/begin CHARACTERISTIC ZDrive_BSW_Cal_Cal.ZDrive_BSW_Cal_VehicleInfomationTable.FrntRiCrnrUss_Dz "" VALUE 0x3d82bc Record_FLOAT32_IEEE 0 autosar_swc_vmc_CM_single -3.4E+38 3.4E+38 /end CHARACTERISTIC
/begin CHARACTERISTIC ZDrive_BSW_Cal_Cal.ZDrive_BSW_Cal_VehicleInfomationTable.FrntRiCrnrUss_Pitch "" VALUE 0x3d82c8 Record_FLOAT32_IEEE 0 autosar_swc_vmc_CM_single -3.4E+38 3.4E+38 /end CHARACTERISTIC
/begin CHARACTERISTIC ZDrive_BSW_Cal_Cal.ZDrive_BSW_Cal_VehicleInfomationTable.FrntRiCrnrUss_Roll "" VALUE 0x3d82c4 Record_FLOAT32_IEEE 0 autosar_swc_vmc_CM_single -3.4E+38 3.4E+38 /end CHARACTERISTIC
/begin CHARACTERISTIC ZDrive_BSW_Cal_Cal.ZDrive_BSW_Cal_VehicleInfomationTable.FrntRiCrnrUss_Yaw "" VALUE 0x3d82cc Record_FLOAT32_IEEE 0 autosar_swc_vmc_CM_single -3.4E+38 3.4E+38 /end CHARACTERISTIC
/begin CHARACTERISTIC ZDrive_BSW_Cal_Cal.ZDrive_BSW_Cal_VehicleInfomationTable.FrntRiMidUss_Dx "" VALUE 0x3d8298 Record_FLOAT32_IEEE 0 autosar_swc_vmc_CM_single -3.4E+38 3.4E+38 /end CHARACTERISTIC
/begin CHARACTERISTIC ZDrive_BSW_Cal_Cal.ZDrive_BSW_Cal_VehicleInfomationTable.FrntRiMidUss_Dy "" VALUE 0x3d829c Record_FLOAT32_IEEE 0 autosar_swc_vmc_CM_single -3.4E+38 3.4E+38 /end CHARACTERISTIC
/begin CHARACTERISTIC ZDrive_BSW_Cal_Cal.ZDrive_BSW_Cal_VehicleInfomationTable.FrntRiMidUss_Dz "" VALUE 0x3d82a0 Record_FLOAT32_IEEE 0 autosar_swc_vmc_CM_single -3.4E+38 3.4E+38 /end CHARACTERISTIC
/begin CHARACTERISTIC ZDrive_BSW_Cal_Cal.ZDrive_BSW_Cal_VehicleInfomationTable.FrntRiMidUss_Pitch "" VALUE 0x3d82ac Record_FLOAT32_IEEE 0 autosar_swc_vmc_CM_single -3.4E+38 3.4E+38 /end CHARACTERISTIC
/begin CHARACTERISTIC ZDrive_BSW_Cal_Cal.ZDrive_BSW_Cal_VehicleInfomationTable.FrntRiMidUss_Roll "" VALUE 0x3d82a8 Record_FLOAT32_IEEE 0 autosar_swc_vmc_CM_single -3.4E+38 3.4E+38 /end CHARACTERISTIC
/begin CHARACTERISTIC ZDrive_BSW_Cal_Cal.ZDrive_BSW_Cal_VehicleInfomationTable.FrntRiMidUss_Yaw "" VALUE 0x3d82b0 Record_FLOAT32_IEEE 0 autosar_swc_vmc_CM_single -3.4E+38 3.4E+38 /end CHARACTERISTIC
/begin CHARACTERISTIC ZDrive_BSW_Cal_Cal.ZDrive_BSW_Cal_VehicleInfomationTable.FrntRiSideUss_Dx "" VALUE 0x3d82d0 Record_FLOAT32_IEEE 0 autosar_swc_vmc_CM_single -3.4E+38 3.4E+38 /end CHARACTERISTIC
/begin CHARACTERISTIC ZDrive_BSW_Cal_Cal.ZDrive_BSW_Cal_VehicleInfomationTable.FrntRiSideUss_Dy "" VALUE 0x3d82d4 Record_FLOAT32_IEEE 0 autosar_swc_vmc_CM_single -3.4E+38 3.4E+38 /end CHARACTERISTIC
/begin CHARACTERISTIC ZDrive_BSW_Cal_Cal.ZDrive_BSW_Cal_VehicleInfomationTable.FrntRiSideUss_Dz "" VALUE 0x3d82d8 Record_FLOAT32_IEEE 0 autosar_swc_vmc_CM_single -3.4E+38 3.4E+38 /end CHARACTERISTIC
/begin CHARACTERISTIC ZDrive_BSW_Cal_Cal.ZDrive_BSW_Cal_VehicleInfomationTable.FrntRiSideUss_Pitch "" VALUE 0x3d82e4 Record_FLOAT32_IEEE 0 autosar_swc_vmc_CM_single -3.4E+38 3.4E+38 /end CHARACTERISTIC
/begin CHARACTERISTIC ZDrive_BSW_Cal_Cal.ZDrive_BSW_Cal_VehicleInfomationTable.FrntRiSideUss_Roll "" VALUE 0x3d82e0 Record_FLOAT32_IEEE 0 autosar_swc_vmc_CM_single -3.4E+38 3.4E+38 /end CHARACTERISTIC
/begin CHARACTERISTIC ZDrive_BSW_Cal_Cal.ZDrive_BSW_Cal_VehicleInfomationTable.FrntRiSideUss_Yaw "" VALUE 0x3d82e8 Record_FLOAT32_IEEE 0 autosar_swc_vmc_CM_single -3.4E+38 3.4E+38 /end CHARACTERISTIC
/begin CHARACTERISTIC ZDrive_BSW_Cal_Cal.ZDrive_BSW_Cal_VehicleInfomationTable.FrontAxleToCenter_m "" VALUE 0x3d80d0 Record_FLOAT32_IEEE 0 autosar_swc_vmc_CM_single -3.4E+38 3.4E+38 /end CHARACTERISTIC
/begin CHARACTERISTIC ZDrive_BSW_Cal_Cal.ZDrive_BSW_Cal_VehicleInfomationTable.FrontAxleToRearAxLeCenterX_m "" VALUE 0x3d80a8 Record_FLOAT32_IEEE 0 autosar_swc_vmc_CM_single -3.4E+38 3.4E+38 /end CHARACTERISTIC
/begin CHARACTERISTIC ZDrive_BSW_Cal_Cal.ZDrive_BSW_Cal_VehicleInfomationTable.FrontLeftFrontPointToCenterLine_Distance_m "" VALUE 0x3d80f0 Record_FLOAT32_IEEE 0 autosar_swc_vmc_CM_single -3.4E+38 3.4E+38 /end CHARACTERISTIC
/begin CHARACTERISTIC ZDrive_BSW_Cal_Cal.ZDrive_BSW_Cal_VehicleInfomationTable.FrontLeftFrontPointToRearAxleCenter_Distance_m "" VALUE 0x3d80ec Record_FLOAT32_IEEE 0 autosar_swc_vmc_CM_single -3.4E+38 3.4E+38 /end CHARACTERISTIC
/begin CHARACTERISTIC ZDrive_BSW_Cal_Cal.ZDrive_BSW_Cal_VehicleInfomationTable.FrontLeftOutsidePointToCenterLine_Distance_m "" VALUE 0x3d80f8 Record_FLOAT32_IEEE 0 autosar_swc_vmc_CM_single -3.4E+38 3.4E+38 /end CHARACTERISTIC
/begin CHARACTERISTIC ZDrive_BSW_Cal_Cal.ZDrive_BSW_Cal_VehicleInfomationTable.FrontLeftOutsidePointToRearAxleCenter_Distance_m "" VALUE 0x3d80f4 Record_FLOAT32_IEEE 0 autosar_swc_vmc_CM_single -3.4E+38 3.4E+38 /end CHARACTERISTIC
/begin CHARACTERISTIC ZDrive_BSW_Cal_Cal.ZDrive_BSW_Cal_VehicleInfomationTable.FrontOverhang_Length_m "" VALUE 0x3d80b8 Record_FLOAT32_IEEE 0 autosar_swc_vmc_CM_single -3.4E+38 3.4E+38 /end CHARACTERISTIC
/begin CHARACTERISTIC ZDrive_BSW_Cal_Cal.ZDrive_BSW_Cal_VehicleInfomationTable.FrontShortCamera_Dx "" VALUE 0x3d81b4 Record_FLOAT32_IEEE 0 autosar_swc_vmc_CM_single -3.4E+38 3.4E+38 /end CHARACTERISTIC
/begin CHARACTERISTIC ZDrive_BSW_Cal_Cal.ZDrive_BSW_Cal_VehicleInfomationTable.FrontShortCamera_Dy "" VALUE 0x3d81b8 Record_FLOAT32_IEEE 0 autosar_swc_vmc_CM_single -3.4E+38 3.4E+38 /end CHARACTERISTIC
/begin CHARACTERISTIC ZDrive_BSW_Cal_Cal.ZDrive_BSW_Cal_VehicleInfomationTable.FrontShortCamera_Dz "" VALUE 0x3d81bc Record_FLOAT32_IEEE 0 autosar_swc_vmc_CM_single -3.4E+38 3.4E+38 /end CHARACTERISTIC
/begin CHARACTERISTIC ZDrive_BSW_Cal_Cal.ZDrive_BSW_Cal_VehicleInfomationTable.FrontShortCamera_Pitch "" VALUE 0x3d81c8 Record_FLOAT32_IEEE 0 autosar_swc_vmc_CM_single -3.4E+38 3.4E+38 /end CHARACTERISTIC
/begin CHARACTERISTIC ZDrive_BSW_Cal_Cal.ZDrive_BSW_Cal_VehicleInfomationTable.FrontShortCamera_Roll "" VALUE 0x3d81c4 Record_FLOAT32_IEEE 0 autosar_swc_vmc_CM_single -3.4E+38 3.4E+38 /end CHARACTERISTIC
/begin CHARACTERISTIC ZDrive_BSW_Cal_Cal.ZDrive_BSW_Cal_VehicleInfomationTable.FrontShortCamera_Yaw "" VALUE 0x3d81cc Record_FLOAT32_IEEE 0 autosar_swc_vmc_CM_single -3.4E+38 3.4E+38 /end CHARACTERISTIC
/begin CHARACTERISTIC ZDrive_BSW_Cal_Cal.ZDrive_BSW_Cal_VehicleInfomationTable.GVW_kg "" VALUE 0x3d8114 Record_FLOAT32_IEEE 0 autosar_swc_vmc_CM_single -3.4E+38 3.4E+38 /end CHARACTERISTIC
/begin CHARACTERISTIC ZDrive_BSW_Cal_Cal.ZDrive_BSW_Cal_VehicleInfomationTable.Gear_Box "" VALUE 0x3d806e Record_UBYTE 0 autosar_swc_vmc_CM_uint8 0 255 /end CHARACTERISTIC
/begin CHARACTERISTIC ZDrive_BSW_Cal_Cal.ZDrive_BSW_Cal_VehicleInfomationTable.Height_m "" VALUE 0x3d809c Record_FLOAT32_IEEE 0 autosar_swc_vmc_CM_single -3.4E+38 3.4E+38 /end CHARACTERISTIC
/begin CHARACTERISTIC ZDrive_BSW_Cal_Cal.ZDrive_BSW_Cal_VehicleInfomationTable.IEnviroment_Bottom_Crop "" VALUE 0x3d8184 Record_SWORD 0 autosar_swc_vmc_CM_int16 -32768 32767 /end CHARACTERISTIC
/begin CHARACTERISTIC ZDrive_BSW_Cal_Cal.ZDrive_BSW_Cal_VehicleInfomationTable.IEnviroment_Top_Crop "" VALUE 0x3d8182 Record_UWORD 0 autosar_swc_vmc_CM_uint16 0 65535 /end CHARACTERISTIC
/begin CHARACTERISTIC ZDrive_BSW_Cal_Cal.ZDrive_BSW_Cal_VehicleInfomationTable.IEnvironment_CamToFrontAxle "" VALUE 0x3d8160 Record_FLOAT32_IEEE 0 autosar_swc_vmc_CM_single -3.4E+38 3.4E+38 /end CHARACTERISTIC
/begin CHARACTERISTIC ZDrive_BSW_Cal_Cal.ZDrive_BSW_Cal_VehicleInfomationTable.IEnvironment_RefPX_Front_Bumper "" VALUE 0x3d817c Record_FLOAT32_IEEE 0 autosar_swc_vmc_CM_single -3.4E+38 3.4E+38 /end CHARACTERISTIC
/begin CHARACTERISTIC ZDrive_BSW_Cal_Cal.ZDrive_BSW_Cal_VehicleInfomationTable.IEnvironment_WheelWidth "" VALUE 0x3d8120 Record_FLOAT32_IEEE 0 autosar_swc_vmc_CM_single -3.4E+38 3.4E+38 /end CHARACTERISTIC
/begin CHARACTERISTIC ZDrive_BSW_Cal_Cal.ZDrive_BSW_Cal_VehicleInfomationTable.LeSCBlindSpotLength_m "" VALUE 0x3d81f4 Record_FLOAT32_IEEE 0 autosar_swc_vmc_CM_single -3.4E+38 3.4E+38 /end CHARACTERISTIC
/begin CHARACTERISTIC ZDrive_BSW_Cal_Cal.ZDrive_BSW_Cal_VehicleInfomationTable.LeSCVerticalDist2Body_m "" VALUE 0x3d81f8 Record_FLOAT32_IEEE 0 autosar_swc_vmc_CM_single -3.4E+38 3.4E+38 /end CHARACTERISTIC
/begin CHARACTERISTIC ZDrive_BSW_Cal_Cal.ZDrive_BSW_Cal_VehicleInfomationTable.LeftShortCamera_Dx "" VALUE 0x3d81d8 Record_FLOAT32_IEEE 0 autosar_swc_vmc_CM_single -3.4E+38 3.4E+38 /end CHARACTERISTIC
/begin CHARACTERISTIC ZDrive_BSW_Cal_Cal.ZDrive_BSW_Cal_VehicleInfomationTable.LeftShortCamera_Dy "" VALUE 0x3d81dc Record_FLOAT32_IEEE 0 autosar_swc_vmc_CM_single -3.4E+38 3.4E+38 /end CHARACTERISTIC
/begin CHARACTERISTIC ZDrive_BSW_Cal_Cal.ZDrive_BSW_Cal_VehicleInfomationTable.LeftShortCamera_Dz "" VALUE 0x3d81e0 Record_FLOAT32_IEEE 0 autosar_swc_vmc_CM_single -3.4E+38 3.4E+38 /end CHARACTERISTIC
/begin CHARACTERISTIC ZDrive_BSW_Cal_Cal.ZDrive_BSW_Cal_VehicleInfomationTable.LeftShortCamera_Pitch "" VALUE 0x3d81ec Record_FLOAT32_IEEE 0 autosar_swc_vmc_CM_single -3.4E+38 3.4E+38 /end CHARACTERISTIC
/begin CHARACTERISTIC ZDrive_BSW_Cal_Cal.ZDrive_BSW_Cal_VehicleInfomationTable.LeftShortCamera_Roll "" VALUE 0x3d81e8 Record_FLOAT32_IEEE 0 autosar_swc_vmc_CM_single -3.4E+38 3.4E+38 /end CHARACTERISTIC
/begin CHARACTERISTIC ZDrive_BSW_Cal_Cal.ZDrive_BSW_Cal_VehicleInfomationTable.LeftShortCamera_Yaw "" VALUE 0x3d81f0 Record_FLOAT32_IEEE 0 autosar_swc_vmc_CM_single -3.4E+38 3.4E+38 /end CHARACTERISTIC
/begin CHARACTERISTIC ZDrive_BSW_Cal_Cal.ZDrive_BSW_Cal_VehicleInfomationTable.Left_Right_handType "" VALUE 0x3d8076 Record_UBYTE 0 autosar_swc_vmc_CM_uint8 0 255 /end CHARACTERISTIC
/begin CHARACTERISTIC ZDrive_BSW_Cal_Cal.ZDrive_BSW_Cal_VehicleInfomationTable.MaxSteeringAngle "" VALUE 0x3d8140 Record_FLOAT32_IEEE 0 autosar_swc_vmc_CM_single -3.4E+38 3.4E+38 /end CHARACTERISTIC
/begin CHARACTERISTIC ZDrive_BSW_Cal_Cal.ZDrive_BSW_Cal_VehicleInfomationTable.ParkingBrakeType "" VALUE 0x3d8072 Record_UBYTE 0 autosar_swc_vmc_CM_uint8 0 255 /end CHARACTERISTIC
/begin CHARACTERISTIC ZDrive_BSW_Cal_Cal.ZDrive_BSW_Cal_VehicleInfomationTable.ParkingLongControlInterForm "" VALUE 0x3d8074 Record_UBYTE 0 autosar_swc_vmc_CM_uint8 0 255 /end CHARACTERISTIC
/begin CHARACTERISTIC ZDrive_BSW_Cal_Cal.ZDrive_BSW_Cal_VehicleInfomationTable.PitchAngOfCAD "" VALUE 0x3d81ac Record_FLOAT32_IEEE 0 autosar_swc_vmc_CM_single -3.4E+38 3.4E+38 /end CHARACTERISTIC
/begin CHARACTERISTIC ZDrive_BSW_Cal_Cal.ZDrive_BSW_Cal_VehicleInfomationTable.PowerTransRatio "" VALUE 0x3d8158 Record_FLOAT32_IEEE 0 autosar_swc_vmc_CM_single -3.4E+38 3.4E+38 /end CHARACTERISTIC
/begin CHARACTERISTIC ZDrive_BSW_Cal_Cal.ZDrive_BSW_Cal_VehicleInfomationTable.PowerType "" VALUE 0x3d806a Record_UBYTE 0 autosar_swc_vmc_CM_uint8 0 255 /end CHARACTERISTIC
/begin CHARACTERISTIC ZDrive_BSW_Cal_Cal.ZDrive_BSW_Cal_VehicleInfomationTable.RADAR_MOUNT_PARAM_FL_X_POSITION "" VALUE 0x3d83fc Record_FLOAT32_IEEE 0 autosar_swc_vmc_CM_single -3.4E+38 3.4E+38 /end CHARACTERISTIC
/begin CHARACTERISTIC ZDrive_BSW_Cal_Cal.ZDrive_BSW_Cal_VehicleInfomationTable.RADAR_MOUNT_PARAM_FL_YAW_ANGLE "" VALUE 0x3d8404 Record_FLOAT32_IEEE 0 autosar_swc_vmc_CM_single -3.4E+38 3.4E+38 /end CHARACTERISTIC
/begin CHARACTERISTIC ZDrive_BSW_Cal_Cal.ZDrive_BSW_Cal_VehicleInfomationTable.RADAR_MOUNT_PARAM_FL_Y_POSITION "" VALUE 0x3d8400 Record_FLOAT32_IEEE 0 autosar_swc_vmc_CM_single -3.4E+38 3.4E+38 /end CHARACTERISTIC
/begin CHARACTERISTIC ZDrive_BSW_Cal_Cal.ZDrive_BSW_Cal_VehicleInfomationTable.RADAR_MOUNT_PARAM_FRONT_X_POSITION "" VALUE 0x3d83f0 Record_FLOAT32_IEEE 0 autosar_swc_vmc_CM_single -3.4E+38 3.4E+38 /end CHARACTERISTIC
/begin CHARACTERISTIC ZDrive_BSW_Cal_Cal.ZDrive_BSW_Cal_VehicleInfomationTable.RADAR_MOUNT_PARAM_FRONT_YAW_ANGLE "" VALUE 0x3d83f8 Record_FLOAT32_IEEE 0 autosar_swc_vmc_CM_single -3.4E+38 3.4E+38 /end CHARACTERISTIC
/begin CHARACTERISTIC ZDrive_BSW_Cal_Cal.ZDrive_BSW_Cal_VehicleInfomationTable.RADAR_MOUNT_PARAM_FRONT_Y_POSITION "" VALUE 0x3d83f4 Record_FLOAT32_IEEE 0 autosar_swc_vmc_CM_single -3.4E+38 3.4E+38 /end CHARACTERISTIC
/begin CHARACTERISTIC ZDrive_BSW_Cal_Cal.ZDrive_BSW_Cal_VehicleInfomationTable.RADAR_MOUNT_PARAM_FR_X_POSITION "" VALUE 0x3d8408 Record_FLOAT32_IEEE 0 autosar_swc_vmc_CM_single -3.4E+38 3.4E+38 /end CHARACTERISTIC
/begin CHARACTERISTIC ZDrive_BSW_Cal_Cal.ZDrive_BSW_Cal_VehicleInfomationTable.RADAR_MOUNT_PARAM_FR_YAW_ANGLE "" VALUE 0x3d8410 Record_FLOAT32_IEEE 0 autosar_swc_vmc_CM_single -3.4E+38 3.4E+38 /end CHARACTERISTIC
/begin CHARACTERISTIC ZDrive_BSW_Cal_Cal.ZDrive_BSW_Cal_VehicleInfomationTable.RADAR_MOUNT_PARAM_FR_Y_POSITION "" VALUE 0x3d840c Record_FLOAT32_IEEE 0 autosar_swc_vmc_CM_single -3.4E+38 3.4E+38 /end CHARACTERISTIC
/begin CHARACTERISTIC ZDrive_BSW_Cal_Cal.ZDrive_BSW_Cal_VehicleInfomationTable.RADAR_MOUNT_PARAM_RL_X_POSITION "" VALUE 0x3d8414 Record_FLOAT32_IEEE 0 autosar_swc_vmc_CM_single -3.4E+38 3.4E+38 /end CHARACTERISTIC
/begin CHARACTERISTIC ZDrive_BSW_Cal_Cal.ZDrive_BSW_Cal_VehicleInfomationTable.RADAR_MOUNT_PARAM_RL_YAW_ANGLE "" VALUE 0x3d841c Record_FLOAT32_IEEE 0 autosar_swc_vmc_CM_single -3.4E+38 3.4E+38 /end CHARACTERISTIC
/begin CHARACTERISTIC ZDrive_BSW_Cal_Cal.ZDrive_BSW_Cal_VehicleInfomationTable.RADAR_MOUNT_PARAM_RL_Y_POSITION "" VALUE 0x3d8418 Record_FLOAT32_IEEE 0 autosar_swc_vmc_CM_single -3.4E+38 3.4E+38 /end CHARACTERISTIC
/begin CHARACTERISTIC ZDrive_BSW_Cal_Cal.ZDrive_BSW_Cal_VehicleInfomationTable.RADAR_MOUNT_PARAM_RR_X_POSITION "" VALUE 0x3d8420 Record_FLOAT32_IEEE 0 autosar_swc_vmc_CM_single -3.4E+38 3.4E+38 /end CHARACTERISTIC
/begin CHARACTERISTIC ZDrive_BSW_Cal_Cal.ZDrive_BSW_Cal_VehicleInfomationTable.RADAR_MOUNT_PARAM_RR_YAW_ANGLE "" VALUE 0x3d8428 Record_FLOAT32_IEEE 0 autosar_swc_vmc_CM_single -3.4E+38 3.4E+38 /end CHARACTERISTIC
/begin CHARACTERISTIC ZDrive_BSW_Cal_Cal.ZDrive_BSW_Cal_VehicleInfomationTable.RADAR_MOUNT_PARAM_RR_Y_POSITION "" VALUE 0x3d8424 Record_FLOAT32_IEEE 0 autosar_swc_vmc_CM_single -3.4E+38 3.4E+38 /end CHARACTERISTIC
/begin CHARACTERISTIC ZDrive_BSW_Cal_Cal.ZDrive_BSW_Cal_VehicleInfomationTable.RRollingRadius_m "" VALUE 0x3d8154 Record_FLOAT32_IEEE 0 autosar_swc_vmc_CM_single -3.4E+38 3.4E+38 /end CHARACTERISTIC
/begin CHARACTERISTIC ZDrive_BSW_Cal_Cal.ZDrive_BSW_Cal_VehicleInfomationTable.ReLeCrnrUss_Dx "" VALUE 0x3d835c Record_FLOAT32_IEEE 0 autosar_swc_vmc_CM_single -3.4E+38 3.4E+38 /end CHARACTERISTIC
/begin CHARACTERISTIC ZDrive_BSW_Cal_Cal.ZDrive_BSW_Cal_VehicleInfomationTable.ReLeCrnrUss_Dy "" VALUE 0x3d8360 Record_FLOAT32_IEEE 0 autosar_swc_vmc_CM_single -3.4E+38 3.4E+38 /end CHARACTERISTIC
/begin CHARACTERISTIC ZDrive_BSW_Cal_Cal.ZDrive_BSW_Cal_VehicleInfomationTable.ReLeCrnrUss_Dz "" VALUE 0x3d8364 Record_FLOAT32_IEEE 0 autosar_swc_vmc_CM_single -3.4E+38 3.4E+38 /end CHARACTERISTIC
/begin CHARACTERISTIC ZDrive_BSW_Cal_Cal.ZDrive_BSW_Cal_VehicleInfomationTable.ReLeCrnrUss_Pitch "" VALUE 0x3d8370 Record_FLOAT32_IEEE 0 autosar_swc_vmc_CM_single -3.4E+38 3.4E+38 /end CHARACTERISTIC
/begin CHARACTERISTIC ZDrive_BSW_Cal_Cal.ZDrive_BSW_Cal_VehicleInfomationTable.ReLeCrnrUss_Roll "" VALUE 0x3d836c Record_FLOAT32_IEEE 0 autosar_swc_vmc_CM_single -3.4E+38 3.4E+38 /end CHARACTERISTIC
/begin CHARACTERISTIC ZDrive_BSW_Cal_Cal.ZDrive_BSW_Cal_VehicleInfomationTable.ReLeCrnrUss_Yaw "" VALUE 0x3d8374 Record_FLOAT32_IEEE 0 autosar_swc_vmc_CM_single -3.4E+38 3.4E+38 /end CHARACTERISTIC
/begin CHARACTERISTIC ZDrive_BSW_Cal_Cal.ZDrive_BSW_Cal_VehicleInfomationTable.ReLeMidUss_Dx "" VALUE 0x3d8340 Record_FLOAT32_IEEE 0 autosar_swc_vmc_CM_single -3.4E+38 3.4E+38 /end CHARACTERISTIC
/begin CHARACTERISTIC ZDrive_BSW_Cal_Cal.ZDrive_BSW_Cal_VehicleInfomationTable.ReLeMidUss_Dy "" VALUE 0x3d8344 Record_FLOAT32_IEEE 0 autosar_swc_vmc_CM_single -3.4E+38 3.4E+38 /end CHARACTERISTIC
/begin CHARACTERISTIC ZDrive_BSW_Cal_Cal.ZDrive_BSW_Cal_VehicleInfomationTable.ReLeMidUss_Dz "" VALUE 0x3d8348 Record_FLOAT32_IEEE 0 autosar_swc_vmc_CM_single -3.4E+38 3.4E+38 /end CHARACTERISTIC
/begin CHARACTERISTIC ZDrive_BSW_Cal_Cal.ZDrive_BSW_Cal_VehicleInfomationTable.ReLeMidUss_Pitch "" VALUE 0x3d8354 Record_FLOAT32_IEEE 0 autosar_swc_vmc_CM_single -3.4E+38 3.4E+38 /end CHARACTERISTIC
/begin CHARACTERISTIC ZDrive_BSW_Cal_Cal.ZDrive_BSW_Cal_VehicleInfomationTable.ReLeMidUss_Roll "" VALUE 0x3d8350 Record_FLOAT32_IEEE 0 autosar_swc_vmc_CM_single -3.4E+38 3.4E+38 /end CHARACTERISTIC
/begin CHARACTERISTIC ZDrive_BSW_Cal_Cal.ZDrive_BSW_Cal_VehicleInfomationTable.ReLeMidUss_Yaw "" VALUE 0x3d8358 Record_FLOAT32_IEEE 0 autosar_swc_vmc_CM_single -3.4E+38 3.4E+38 /end CHARACTERISTIC
/begin CHARACTERISTIC ZDrive_BSW_Cal_Cal.ZDrive_BSW_Cal_VehicleInfomationTable.ReLeSideUss_Dx "" VALUE 0x3d8378 Record_FLOAT32_IEEE 0 autosar_swc_vmc_CM_single -3.4E+38 3.4E+38 /end CHARACTERISTIC
/begin CHARACTERISTIC ZDrive_BSW_Cal_Cal.ZDrive_BSW_Cal_VehicleInfomationTable.ReLeSideUss_Dy "" VALUE 0x3d837c Record_FLOAT32_IEEE 0 autosar_swc_vmc_CM_single -3.4E+38 3.4E+38 /end CHARACTERISTIC
/begin CHARACTERISTIC ZDrive_BSW_Cal_Cal.ZDrive_BSW_Cal_VehicleInfomationTable.ReLeSideUss_Dz "" VALUE 0x3d8380 Record_FLOAT32_IEEE 0 autosar_swc_vmc_CM_single -3.4E+38 3.4E+38 /end CHARACTERISTIC
/begin CHARACTERISTIC ZDrive_BSW_Cal_Cal.ZDrive_BSW_Cal_VehicleInfomationTable.ReLeSideUss_Pitch "" VALUE 0x3d838c Record_FLOAT32_IEEE 0 autosar_swc_vmc_CM_single -3.4E+38 3.4E+38 /end CHARACTERISTIC
/begin CHARACTERISTIC ZDrive_BSW_Cal_Cal.ZDrive_BSW_Cal_VehicleInfomationTable.ReLeSideUss_Roll "" VALUE 0x3d8388 Record_FLOAT32_IEEE 0 autosar_swc_vmc_CM_single -3.4E+38 3.4E+38 /end CHARACTERISTIC
/begin CHARACTERISTIC ZDrive_BSW_Cal_Cal.ZDrive_BSW_Cal_VehicleInfomationTable.ReLeSideUss_Yaw "" VALUE 0x3d8390 Record_FLOAT32_IEEE 0 autosar_swc_vmc_CM_single -3.4E+38 3.4E+38 /end CHARACTERISTIC
/begin CHARACTERISTIC ZDrive_BSW_Cal_Cal.ZDrive_BSW_Cal_VehicleInfomationTable.ReRiCrnrUss_Dx "" VALUE 0x3d8308 Record_FLOAT32_IEEE 0 autosar_swc_vmc_CM_single -3.4E+38 3.4E+38 /end CHARACTERISTIC
/begin CHARACTERISTIC ZDrive_BSW_Cal_Cal.ZDrive_BSW_Cal_VehicleInfomationTable.ReRiCrnrUss_Dy "" VALUE 0x3d830c Record_FLOAT32_IEEE 0 autosar_swc_vmc_CM_single -3.4E+38 3.4E+38 /end CHARACTERISTIC
/begin CHARACTERISTIC ZDrive_BSW_Cal_Cal.ZDrive_BSW_Cal_VehicleInfomationTable.ReRiCrnrUss_Dz "" VALUE 0x3d8310 Record_FLOAT32_IEEE 0 autosar_swc_vmc_CM_single -3.4E+38 3.4E+38 /end CHARACTERISTIC
/begin CHARACTERISTIC ZDrive_BSW_Cal_Cal.ZDrive_BSW_Cal_VehicleInfomationTable.ReRiCrnrUss_Pitch "" VALUE 0x3d831c Record_FLOAT32_IEEE 0 autosar_swc_vmc_CM_single -3.4E+38 3.4E+38 /end CHARACTERISTIC
/begin CHARACTERISTIC ZDrive_BSW_Cal_Cal.ZDrive_BSW_Cal_VehicleInfomationTable.ReRiCrnrUss_Roll "" VALUE 0x3d8318 Record_FLOAT32_IEEE 0 autosar_swc_vmc_CM_single -3.4E+38 3.4E+38 /end CHARACTERISTIC
/begin CHARACTERISTIC ZDrive_BSW_Cal_Cal.ZDrive_BSW_Cal_VehicleInfomationTable.ReRiCrnrUss_Yaw "" VALUE 0x3d8320 Record_FLOAT32_IEEE 0 autosar_swc_vmc_CM_single -3.4E+38 3.4E+38 /end CHARACTERISTIC
/begin CHARACTERISTIC ZDrive_BSW_Cal_Cal.ZDrive_BSW_Cal_VehicleInfomationTable.ReRiMidUss_Dx "" VALUE 0x3d8324 Record_FLOAT32_IEEE 0 autosar_swc_vmc_CM_single -3.4E+38 3.4E+38 /end CHARACTERISTIC
/begin CHARACTERISTIC ZDrive_BSW_Cal_Cal.ZDrive_BSW_Cal_VehicleInfomationTable.ReRiMidUss_Dy "" VALUE 0x3d8328 Record_FLOAT32_IEEE 0 autosar_swc_vmc_CM_single -3.4E+38 3.4E+38 /end CHARACTERISTIC
/begin CHARACTERISTIC ZDrive_BSW_Cal_Cal.ZDrive_BSW_Cal_VehicleInfomationTable.ReRiMidUss_Dz "" VALUE 0x3d832c Record_FLOAT32_IEEE 0 autosar_swc_vmc_CM_single -3.4E+38 3.4E+38 /end CHARACTERISTIC
/begin CHARACTERISTIC ZDrive_BSW_Cal_Cal.ZDrive_BSW_Cal_VehicleInfomationTable.ReRiMidUss_Pitch "" VALUE 0x3d8338 Record_FLOAT32_IEEE 0 autosar_swc_vmc_CM_single -3.4E+38 3.4E+38 /end CHARACTERISTIC
/begin CHARACTERISTIC ZDrive_BSW_Cal_Cal.ZDrive_BSW_Cal_VehicleInfomationTable.ReRiMidUss_Roll "" VALUE 0x3d8334 Record_FLOAT32_IEEE 0 autosar_swc_vmc_CM_single -3.4E+38 3.4E+38 /end CHARACTERISTIC
/begin CHARACTERISTIC ZDrive_BSW_Cal_Cal.ZDrive_BSW_Cal_VehicleInfomationTable.ReRiMidUss_Yaw "" VALUE 0x3d833c Record_FLOAT32_IEEE 0 autosar_swc_vmc_CM_single -3.4E+38 3.4E+38 /end CHARACTERISTIC
/begin CHARACTERISTIC ZDrive_BSW_Cal_Cal.ZDrive_BSW_Cal_VehicleInfomationTable.ReRiSideUss_Dx "" VALUE 0x3d82ec Record_FLOAT32_IEEE 0 autosar_swc_vmc_CM_single -3.4E+38 3.4E+38 /end CHARACTERISTIC
/begin CHARACTERISTIC ZDrive_BSW_Cal_Cal.ZDrive_BSW_Cal_VehicleInfomationTable.ReRiSideUss_Dy "" VALUE 0x3d82f0 Record_FLOAT32_IEEE 0 autosar_swc_vmc_CM_single -3.4E+38 3.4E+38 /end CHARACTERISTIC
/begin CHARACTERISTIC ZDrive_BSW_Cal_Cal.ZDrive_BSW_Cal_VehicleInfomationTable.ReRiSideUss_Dz "" VALUE 0x3d82f4 Record_FLOAT32_IEEE 0 autosar_swc_vmc_CM_single -3.4E+38 3.4E+38 /end CHARACTERISTIC
/begin CHARACTERISTIC ZDrive_BSW_Cal_Cal.ZDrive_BSW_Cal_VehicleInfomationTable.ReRiSideUss_Pitch "" VALUE 0x3d8300 Record_FLOAT32_IEEE 0 autosar_swc_vmc_CM_single -3.4E+38 3.4E+38 /end CHARACTERISTIC
/begin CHARACTERISTIC ZDrive_BSW_Cal_Cal.ZDrive_BSW_Cal_VehicleInfomationTable.ReRiSideUss_Roll "" VALUE 0x3d82fc Record_FLOAT32_IEEE 0 autosar_swc_vmc_CM_single -3.4E+38 3.4E+38 /end CHARACTERISTIC
/begin CHARACTERISTIC ZDrive_BSW_Cal_Cal.ZDrive_BSW_Cal_VehicleInfomationTable.ReRiSideUss_Yaw "" VALUE 0x3d8304 Record_FLOAT32_IEEE 0 autosar_swc_vmc_CM_single -3.4E+38 3.4E+38 /end CHARACTERISTIC
/begin CHARACTERISTIC ZDrive_BSW_Cal_Cal.ZDrive_BSW_Cal_VehicleInfomationTable.ReSCBlindSpotLength_m "" VALUE 0x3d8218 Record_FLOAT32_IEEE 0 autosar_swc_vmc_CM_single -3.4E+38 3.4E+38 /end CHARACTERISTIC
/begin CHARACTERISTIC ZDrive_BSW_Cal_Cal.ZDrive_BSW_Cal_VehicleInfomationTable.ReSCDist2OuterMostSide_m "" VALUE 0x3d821c Record_FLOAT32_IEEE 0 autosar_swc_vmc_CM_single -3.4E+38 3.4E+38 /end CHARACTERISTIC
/begin CHARACTERISTIC ZDrive_BSW_Cal_Cal.ZDrive_BSW_Cal_VehicleInfomationTable.ReWhlHousingHeight_m "" VALUE 0x3d80c4 Record_FLOAT32_IEEE 0 autosar_swc_vmc_CM_single -3.4E+38 3.4E+38 /end CHARACTERISTIC
/begin CHARACTERISTIC ZDrive_BSW_Cal_Cal.ZDrive_BSW_Cal_VehicleInfomationTable.ReWhlTrack_m "" VALUE 0x3d80b4 Record_FLOAT32_IEEE 0 autosar_swc_vmc_CM_single -3.4E+38 3.4E+38 /end CHARACTERISTIC
/begin CHARACTERISTIC ZDrive_BSW_Cal_Cal.ZDrive_BSW_Cal_VehicleInfomationTable.RearAxleToCenter_m "" VALUE 0x3d80d4 Record_FLOAT32_IEEE 0 autosar_swc_vmc_CM_single -3.4E+38 3.4E+38 /end CHARACTERISTIC
/begin CHARACTERISTIC ZDrive_BSW_Cal_Cal.ZDrive_BSW_Cal_VehicleInfomationTable.RearAxlecCenterTurningCircle "" VALUE 0x3d8148 Record_FLOAT32_IEEE 0 autosar_swc_vmc_CM_single -3.4E+38 3.4E+38 /end CHARACTERISTIC
/begin CHARACTERISTIC ZDrive_BSW_Cal_Cal.ZDrive_BSW_Cal_VehicleInfomationTable.RearLeftOutsidePointToCenterLine_Distance_m "" VALUE 0x3d8100 Record_FLOAT32_IEEE 0 autosar_swc_vmc_CM_single -3.4E+38 3.4E+38 /end CHARACTERISTIC
/begin CHARACTERISTIC ZDrive_BSW_Cal_Cal.ZDrive_BSW_Cal_VehicleInfomationTable.RearLeftOutsidePointToRearAxleCenter_Distance_m "" VALUE 0x3d80fc Record_FLOAT32_IEEE 0 autosar_swc_vmc_CM_single -3.4E+38 3.4E+38 /end CHARACTERISTIC
/begin CHARACTERISTIC ZDrive_BSW_Cal_Cal.ZDrive_BSW_Cal_VehicleInfomationTable.RearLeftRearPointToCenterLine_Distance_m "" VALUE 0x3d8108 Record_FLOAT32_IEEE 0 autosar_swc_vmc_CM_single -3.4E+38 3.4E+38 /end CHARACTERISTIC
/begin CHARACTERISTIC ZDrive_BSW_Cal_Cal.ZDrive_BSW_Cal_VehicleInfomationTable.RearLeftRearPointToRearAxleCenter_Distance_m "" VALUE 0x3d8104 Record_FLOAT32_IEEE 0 autosar_swc_vmc_CM_single -3.4E+38 3.4E+38 /end CHARACTERISTIC
/begin CHARACTERISTIC ZDrive_BSW_Cal_Cal.ZDrive_BSW_Cal_VehicleInfomationTable.RearOverhang_Length_m "" VALUE 0x3d80bc Record_FLOAT32_IEEE 0 autosar_swc_vmc_CM_single -3.4E+38 3.4E+38 /end CHARACTERISTIC
/begin CHARACTERISTIC ZDrive_BSW_Cal_Cal.ZDrive_BSW_Cal_VehicleInfomationTable.RearShortCamera_Dx "" VALUE 0x3d81fc Record_FLOAT32_IEEE 0 autosar_swc_vmc_CM_single -3.4E+38 3.4E+38 /end CHARACTERISTIC
/begin CHARACTERISTIC ZDrive_BSW_Cal_Cal.ZDrive_BSW_Cal_VehicleInfomationTable.RearShortCamera_Dy "" VALUE 0x3d8200 Record_FLOAT32_IEEE 0 autosar_swc_vmc_CM_single -3.4E+38 3.4E+38 /end CHARACTERISTIC
/begin CHARACTERISTIC ZDrive_BSW_Cal_Cal.ZDrive_BSW_Cal_VehicleInfomationTable.RearShortCamera_Dz "" VALUE 0x3d8204 Record_FLOAT32_IEEE 0 autosar_swc_vmc_CM_single -3.4E+38 3.4E+38 /end CHARACTERISTIC
/begin CHARACTERISTIC ZDrive_BSW_Cal_Cal.ZDrive_BSW_Cal_VehicleInfomationTable.RearShortCamera_Pitch "" VALUE 0x3d8210 Record_FLOAT32_IEEE 0 autosar_swc_vmc_CM_single -3.4E+38 3.4E+38 /end CHARACTERISTIC
/begin CHARACTERISTIC ZDrive_BSW_Cal_Cal.ZDrive_BSW_Cal_VehicleInfomationTable.RearShortCamera_Roll "" VALUE 0x3d820c Record_FLOAT32_IEEE 0 autosar_swc_vmc_CM_single -3.4E+38 3.4E+38 /end CHARACTERISTIC
/begin CHARACTERISTIC ZDrive_BSW_Cal_Cal.ZDrive_BSW_Cal_VehicleInfomationTable.RearShortCamera_Yaw "" VALUE 0x3d8214 Record_FLOAT32_IEEE 0 autosar_swc_vmc_CM_single -3.4E+38 3.4E+38 /end CHARACTERISTIC
/begin CHARACTERISTIC ZDrive_BSW_Cal_Cal.ZDrive_BSW_Cal_VehicleInfomationTable.RearViewMirrorBottomSide_Height "" VALUE 0x3d80e4 Record_FLOAT32_IEEE 0 autosar_swc_vmc_CM_single -3.4E+38 3.4E+38 /end CHARACTERISTIC
/begin CHARACTERISTIC ZDrive_BSW_Cal_Cal.ZDrive_BSW_Cal_VehicleInfomationTable.RearViewMirrorLength_On_X "" VALUE 0x3d80dc Record_FLOAT32_IEEE 0 autosar_swc_vmc_CM_single -3.4E+38 3.4E+38 /end CHARACTERISTIC
/begin CHARACTERISTIC ZDrive_BSW_Cal_Cal.ZDrive_BSW_Cal_VehicleInfomationTable.RearViewMirrorLength_On_Y "" VALUE 0x3d80d8 Record_FLOAT32_IEEE 0 autosar_swc_vmc_CM_single -3.4E+38 3.4E+38 /end CHARACTERISTIC
/begin CHARACTERISTIC ZDrive_BSW_Cal_Cal.ZDrive_BSW_Cal_VehicleInfomationTable.RearViewMirrorOutsidePointToRearAxle_Diatance_m "" VALUE 0x3d80e8 Record_FLOAT32_IEEE 0 autosar_swc_vmc_CM_single -3.4E+38 3.4E+38 /end CHARACTERISTIC
/begin CHARACTERISTIC ZDrive_BSW_Cal_Cal.ZDrive_BSW_Cal_VehicleInfomationTable.RearViewMirrorTopSide_Height "" VALUE 0x3d80e0 Record_FLOAT32_IEEE 0 autosar_swc_vmc_CM_single -3.4E+38 3.4E+38 /end CHARACTERISTIC
/begin CHARACTERISTIC ZDrive_BSW_Cal_Cal.ZDrive_BSW_Cal_VehicleInfomationTable.RiSCBlindSpotLength_m "" VALUE 0x3d823c Record_FLOAT32_IEEE 0 autosar_swc_vmc_CM_single -3.4E+38 3.4E+38 /end CHARACTERISTIC
/begin CHARACTERISTIC ZDrive_BSW_Cal_Cal.ZDrive_BSW_Cal_VehicleInfomationTable.RiSCVerticalDist2Body_m "" VALUE 0x3d8240 Record_FLOAT32_IEEE 0 autosar_swc_vmc_CM_single -3.4E+38 3.4E+38 /end CHARACTERISTIC
/begin CHARACTERISTIC ZDrive_BSW_Cal_Cal.ZDrive_BSW_Cal_VehicleInfomationTable.RightShortCamera_Dx "" VALUE 0x3d8220 Record_FLOAT32_IEEE 0 autosar_swc_vmc_CM_single -3.4E+38 3.4E+38 /end CHARACTERISTIC
/begin CHARACTERISTIC ZDrive_BSW_Cal_Cal.ZDrive_BSW_Cal_VehicleInfomationTable.RightShortCamera_Dy "" VALUE 0x3d8224 Record_FLOAT32_IEEE 0 autosar_swc_vmc_CM_single -3.4E+38 3.4E+38 /end CHARACTERISTIC
/begin CHARACTERISTIC ZDrive_BSW_Cal_Cal.ZDrive_BSW_Cal_VehicleInfomationTable.RightShortCamera_Dz "" VALUE 0x3d8228 Record_FLOAT32_IEEE 0 autosar_swc_vmc_CM_single -3.4E+38 3.4E+38 /end CHARACTERISTIC
/begin CHARACTERISTIC ZDrive_BSW_Cal_Cal.ZDrive_BSW_Cal_VehicleInfomationTable.RightShortCamera_Pitch "" VALUE 0x3d8234 Record_FLOAT32_IEEE 0 autosar_swc_vmc_CM_single -3.4E+38 3.4E+38 /end CHARACTERISTIC
/begin CHARACTERISTIC ZDrive_BSW_Cal_Cal.ZDrive_BSW_Cal_VehicleInfomationTable.RightShortCamera_Roll "" VALUE 0x3d8230 Record_FLOAT32_IEEE 0 autosar_swc_vmc_CM_single -3.4E+38 3.4E+38 /end CHARACTERISTIC
/begin CHARACTERISTIC ZDrive_BSW_Cal_Cal.ZDrive_BSW_Cal_VehicleInfomationTable.RightShortCamera_Yaw "" VALUE 0x3d8238 Record_FLOAT32_IEEE 0 autosar_swc_vmc_CM_single -3.4E+38 3.4E+38 /end CHARACTERISTIC
/begin CHARACTERISTIC ZDrive_BSW_Cal_Cal.ZDrive_BSW_Cal_VehicleInfomationTable.RollingAngOfCAD "" VALUE 0x3d81a8 Record_FLOAT32_IEEE 0 autosar_swc_vmc_CM_single -3.4E+38 3.4E+38 /end CHARACTERISTIC
/begin CHARACTERISTIC ZDrive_BSW_Cal_Cal.ZDrive_BSW_Cal_VehicleInfomationTable.SideSlipAnglefactor "" VALUE 0x3d813c Record_FLOAT32_IEEE 0 autosar_swc_vmc_CM_single -3.4E+38 3.4E+38 /end CHARACTERISTIC
/begin CHARACTERISTIC ZDrive_BSW_Cal_Cal.ZDrive_BSW_Cal_VehicleInfomationTable.SteeringAngleRatio "" VALUE 0x3d8144 Record_FLOAT32_IEEE 0 autosar_swc_vmc_CM_single -3.4E+38 3.4E+38 /end CHARACTERISTIC
/begin CHARACTERISTIC ZDrive_BSW_Cal_Cal.ZDrive_BSW_Cal_VehicleInfomationTable.StrWhlAngSigDirect "" VALUE 0x3d807a Record_UBYTE 0 autosar_swc_vmc_CM_uint8 0 255 /end CHARACTERISTIC
/begin CHARACTERISTIC ZDrive_BSW_Cal_Cal.ZDrive_BSW_Cal_VehicleInfomationTable.StrWhlConfig "" VALUE 0x3d8073 Record_UBYTE 0 autosar_swc_vmc_CM_uint8 0 255 /end CHARACTERISTIC
/begin CHARACTERISTIC ZDrive_BSW_Cal_Cal.ZDrive_BSW_Cal_VehicleInfomationTable.StrWhlMappingTable "" VALUE 0x3d814c Record_FLOAT32_IEEE 0 autosar_swc_vmc_CM_single -3.4E+38 3.4E+38 /end CHARACTERISTIC
/begin CHARACTERISTIC ZDrive_BSW_Cal_Cal.ZDrive_BSW_Cal_VehicleInfomationTable.Suspension "" VALUE 0x3d8082 Record_UBYTE 0 autosar_swc_vmc_CM_uint8 0 255 /end CHARACTERISTIC
/begin CHARACTERISTIC ZDrive_BSW_Cal_Cal.ZDrive_BSW_Cal_VehicleInfomationTable.TAC_Bottom "" VALUE 0x3d8180 Record_SBYTE 0 autosar_swc_vmc_CM_int8 -128 127 /end CHARACTERISTIC
/begin CHARACTERISTIC ZDrive_BSW_Cal_Cal.ZDrive_BSW_Cal_VehicleInfomationTable.TAC_Camera_Height "" VALUE 0x3d815c Record_FLOAT32_IEEE 0 autosar_swc_vmc_CM_single -3.4E+38 3.4E+38 /end CHARACTERISTIC
/begin CHARACTERISTIC ZDrive_BSW_Cal_Cal.ZDrive_BSW_Cal_VehicleInfomationTable.TAC_Targets_Num "" VALUE 0x3d8190 Record_UBYTE 0 autosar_swc_vmc_CM_uint8 0 255 /end CHARACTERISTIC
/begin CHARACTERISTIC ZDrive_BSW_Cal_Cal.ZDrive_BSW_Cal_VehicleInfomationTable.TireRadius_m "" VALUE 0x3d811c Record_FLOAT32_IEEE 0 autosar_swc_vmc_CM_single -3.4E+38 3.4E+38 /end CHARACTERISTIC
/begin CHARACTERISTIC ZDrive_BSW_Cal_Cal.ZDrive_BSW_Cal_VehicleInfomationTable.TurnLevelType "" VALUE 0x3d806c Record_UBYTE 0 autosar_swc_vmc_CM_uint8 0 255 /end CHARACTERISTIC
/begin CHARACTERISTIC ZDrive_BSW_Cal_Cal.ZDrive_BSW_Cal_VehicleInfomationTable.UltraInstallAng_FA "" VALUE 0x3d8398 Record_FLOAT32_IEEE 0 autosar_swc_vmc_CM_single -3.4E+38 3.4E+38 /end CHARACTERISTIC
/begin CHARACTERISTIC ZDrive_BSW_Cal_Cal.ZDrive_BSW_Cal_VehicleInfomationTable.UltraInstallAng_FM "" VALUE 0x3d8394 Record_FLOAT32_IEEE 0 autosar_swc_vmc_CM_single -3.4E+38 3.4E+38 /end CHARACTERISTIC
/begin CHARACTERISTIC ZDrive_BSW_Cal_Cal.ZDrive_BSW_Cal_VehicleInfomationTable.UltraInstallAng_FS "" VALUE 0x3d839c Record_FLOAT32_IEEE 0 autosar_swc_vmc_CM_single -3.4E+38 3.4E+38 /end CHARACTERISTIC
/begin CHARACTERISTIC ZDrive_BSW_Cal_Cal.ZDrive_BSW_Cal_VehicleInfomationTable.UltraInstallAng_RA "" VALUE 0x3d83b4 Record_FLOAT32_IEEE 0 autosar_swc_vmc_CM_single -3.4E+38 3.4E+38 /end CHARACTERISTIC
/begin CHARACTERISTIC ZDrive_BSW_Cal_Cal.ZDrive_BSW_Cal_VehicleInfomationTable.UltraInstallAng_RM "" VALUE 0x3d83b0 Record_FLOAT32_IEEE 0 autosar_swc_vmc_CM_single -3.4E+38 3.4E+38 /end CHARACTERISTIC
/begin CHARACTERISTIC ZDrive_BSW_Cal_Cal.ZDrive_BSW_Cal_VehicleInfomationTable.UltraInstallAng_RS "" VALUE 0x3d83b8 Record_FLOAT32_IEEE 0 autosar_swc_vmc_CM_single -3.4E+38 3.4E+38 /end CHARACTERISTIC
/begin CHARACTERISTIC ZDrive_BSW_Cal_Cal.ZDrive_BSW_Cal_VehicleInfomationTable.UltraInstallHeight_FA_m "" VALUE 0x3d83cc Record_FLOAT32_IEEE 0 autosar_swc_vmc_CM_single -3.4E+38 3.4E+38 /end CHARACTERISTIC
/begin CHARACTERISTIC ZDrive_BSW_Cal_Cal.ZDrive_BSW_Cal_VehicleInfomationTable.UltraInstallHeight_FM_m "" VALUE 0x3d83c8 Record_FLOAT32_IEEE 0 autosar_swc_vmc_CM_single -3.4E+38 3.4E+38 /end CHARACTERISTIC
/begin CHARACTERISTIC ZDrive_BSW_Cal_Cal.ZDrive_BSW_Cal_VehicleInfomationTable.UltraInstallHeight_FS_m "" VALUE 0x3d83d0 Record_FLOAT32_IEEE 0 autosar_swc_vmc_CM_single -3.4E+38 3.4E+38 /end CHARACTERISTIC
/begin CHARACTERISTIC ZDrive_BSW_Cal_Cal.ZDrive_BSW_Cal_VehicleInfomationTable.UltraInstallHeight_RA_m "" VALUE 0x3d83d8 Record_FLOAT32_IEEE 0 autosar_swc_vmc_CM_single -3.4E+38 3.4E+38 /end CHARACTERISTIC
/begin CHARACTERISTIC ZDrive_BSW_Cal_Cal.ZDrive_BSW_Cal_VehicleInfomationTable.UltraInstallHeight_RM_m "" VALUE 0x3d83d4 Record_FLOAT32_IEEE 0 autosar_swc_vmc_CM_single -3.4E+38 3.4E+38 /end CHARACTERISTIC
/begin CHARACTERISTIC ZDrive_BSW_Cal_Cal.ZDrive_BSW_Cal_VehicleInfomationTable.UltraInstallHeight_RS_m "" VALUE 0x3d83dc Record_FLOAT32_IEEE 0 autosar_swc_vmc_CM_single -3.4E+38 3.4E+38 /end CHARACTERISTIC
/begin CHARACTERISTIC ZDrive_BSW_Cal_Cal.ZDrive_BSW_Cal_VehicleInfomationTable.UltraInstallLatOffset_FA_m "" VALUE 0x3d83a4 Record_FLOAT32_IEEE 0 autosar_swc_vmc_CM_single -3.4E+38 3.4E+38 /end CHARACTERISTIC
/begin CHARACTERISTIC ZDrive_BSW_Cal_Cal.ZDrive_BSW_Cal_VehicleInfomationTable.UltraInstallLatOffset_FM_m "" VALUE 0x3d83a0 Record_FLOAT32_IEEE 0 autosar_swc_vmc_CM_single -3.4E+38 3.4E+38 /end CHARACTERISTIC
/begin CHARACTERISTIC ZDrive_BSW_Cal_Cal.ZDrive_BSW_Cal_VehicleInfomationTable.UltraInstallLatOffset_FS_m "" VALUE 0x3d83a8 Record_FLOAT32_IEEE 0 autosar_swc_vmc_CM_single -3.4E+38 3.4E+38 /end CHARACTERISTIC
/begin CHARACTERISTIC ZDrive_BSW_Cal_Cal.ZDrive_BSW_Cal_VehicleInfomationTable.UltraInstallLatOffset_RA_m "" VALUE 0x3d83c0 Record_FLOAT32_IEEE 0 autosar_swc_vmc_CM_single -3.4E+38 3.4E+38 /end CHARACTERISTIC
/begin CHARACTERISTIC ZDrive_BSW_Cal_Cal.ZDrive_BSW_Cal_VehicleInfomationTable.UltraInstallLatOffset_RM_m "" VALUE 0x3d83bc Record_FLOAT32_IEEE 0 autosar_swc_vmc_CM_single -3.4E+38 3.4E+38 /end CHARACTERISTIC
/begin CHARACTERISTIC ZDrive_BSW_Cal_Cal.ZDrive_BSW_Cal_VehicleInfomationTable.UltraInstallLatOffset_RS_m "" VALUE 0x3d83c4 Record_FLOAT32_IEEE 0 autosar_swc_vmc_CM_single -3.4E+38 3.4E+38 /end CHARACTERISTIC
/begin CHARACTERISTIC ZDrive_BSW_Cal_Cal.ZDrive_BSW_Cal_VehicleInfomationTable.VISION_MOUNT_PARAM_FRONT_X_POSITION "" VALUE 0x3d83e4 Record_FLOAT32_IEEE 0 autosar_swc_vmc_CM_single -3.4E+38 3.4E+38 /end CHARACTERISTIC
/begin CHARACTERISTIC ZDrive_BSW_Cal_Cal.ZDrive_BSW_Cal_VehicleInfomationTable.VISION_MOUNT_PARAM_FRONT_YAW_ANGLE "" VALUE 0x3d83ec Record_FLOAT32_IEEE 0 autosar_swc_vmc_CM_single -3.4E+38 3.4E+38 /end CHARACTERISTIC
/begin CHARACTERISTIC ZDrive_BSW_Cal_Cal.ZDrive_BSW_Cal_VehicleInfomationTable.VISION_MOUNT_PARAM_FRONT_Y_POSITION "" VALUE 0x3d83e8 Record_FLOAT32_IEEE 0 autosar_swc_vmc_CM_single -3.4E+38 3.4E+38 /end CHARACTERISTIC
/begin CHARACTERISTIC ZDrive_BSW_Cal_Cal.ZDrive_BSW_Cal_VehicleInfomationTable.ValFunc_Reserve1 "" VALUE 0x3d807f Record_UBYTE 0 autosar_swc_vmc_CM_uint8 0 255 /end CHARACTERISTIC
/begin CHARACTERISTIC ZDrive_BSW_Cal_Cal.ZDrive_BSW_Cal_VehicleInfomationTable.ValFunc_Reserve2 "" VALUE 0x3d8080 Record_UBYTE 0 autosar_swc_vmc_CM_uint8 0 255 /end CHARACTERISTIC
/begin CHARACTERISTIC ZDrive_BSW_Cal_Cal.ZDrive_BSW_Cal_VehicleInfomationTable.VehConfig_Code1 "" VALUE 0x3d8060 Record_ULONG 0 autosar_swc_vmc_CM_uint32 0 4294967295 /end CHARACTERISTIC
/begin CHARACTERISTIC ZDrive_BSW_Cal_Cal.ZDrive_BSW_Cal_VehicleInfomationTable.VehConfig_Code2 "" VALUE 0x3d8064 Record_ULONG 0 autosar_swc_vmc_CM_uint32 0 4294967295 /end CHARACTERISTIC
/begin CHARACTERISTIC ZDrive_BSW_Cal_Cal.ZDrive_BSW_Cal_VehicleInfomationTable.VehicleWidthMax_m "" VALUE 0x3d8094 Record_FLOAT32_IEEE 0 autosar_swc_vmc_CM_single -3.4E+38 3.4E+38 /end CHARACTERISTIC
/begin CHARACTERISTIC ZDrive_BSW_Cal_Cal.ZDrive_BSW_Cal_VehicleInfomationTable.VehicleWidthMin_m "" VALUE 0x3d8098 Record_FLOAT32_IEEE 0 autosar_swc_vmc_CM_single -3.4E+38 3.4E+38 /end CHARACTERISTIC
/begin CHARACTERISTIC ZDrive_BSW_Cal_Cal.ZDrive_BSW_Cal_VehicleInfomationTable.Vehicle_Information_End_Tag "" VALUE 0x3d855f Record_UBYTE 0 autosar_swc_vmc_CM_uint8 0 255 /end CHARACTERISTIC
/begin CHARACTERISTIC ZDrive_BSW_Cal_Cal.ZDrive_BSW_Cal_VehicleInfomationTable.Vehicle_Information_Reserved_Line102 "" VALUE 0x3d8181 Record_UBYTE 0 autosar_swc_vmc_CM_uint8 0 255 /end CHARACTERISTIC
/begin CHARACTERISTIC ZDrive_BSW_Cal_Cal.ZDrive_BSW_Cal_VehicleInfomationTable.Vehicle_Information_Reserved_Line105 "" VALUE 0x3d8186 Record_UWORD 0 autosar_swc_vmc_CM_uint16 0 65535 /end CHARACTERISTIC
/begin CHARACTERISTIC ZDrive_BSW_Cal_Cal.ZDrive_BSW_Cal_VehicleInfomationTable.Vehicle_Information_Reserved_Line109 "" VALUE 0x3d8191 Record_UBYTE 0 autosar_swc_vmc_CM_uint8 0 255 /end CHARACTERISTIC
/begin CHARACTERISTIC ZDrive_BSW_Cal_Cal.ZDrive_BSW_Cal_VehicleInfomationTable.Vehicle_Information_Reserved_Line110 "" VALUE 0x3d8192 Record_UWORD 0 autosar_swc_vmc_CM_uint16 0 65535 /end CHARACTERISTIC
/begin CHARACTERISTIC ZDrive_BSW_Cal_Cal.ZDrive_BSW_Cal_VehicleInfomationTable.Vehicle_Information_Reserved_Line115 "" VALUE 0x3d81a4 Record_ULONG 0 autosar_swc_vmc_CM_uint32 0 4294967295 /end CHARACTERISTIC
/begin CHARACTERISTIC ZDrive_BSW_Cal_Cal.ZDrive_BSW_Cal_VehicleInfomationTable.Vehicle_Information_Reserved_Line122 "" VALUE 0x3d81c0 Record_ULONG 0 autosar_swc_vmc_CM_uint32 0 4294967295 /end CHARACTERISTIC
/begin CHARACTERISTIC ZDrive_BSW_Cal_Cal.ZDrive_BSW_Cal_VehicleInfomationTable.Vehicle_Information_Reserved_Line131 "" VALUE 0x3d81e4 Record_ULONG 0 autosar_swc_vmc_CM_uint32 0 4294967295 /end CHARACTERISTIC
/begin CHARACTERISTIC ZDrive_BSW_Cal_Cal.ZDrive_BSW_Cal_VehicleInfomationTable.Vehicle_Information_Reserved_Line140 "" VALUE 0x3d8208 Record_ULONG 0 autosar_swc_vmc_CM_uint32 0 4294967295 /end CHARACTERISTIC
/begin CHARACTERISTIC ZDrive_BSW_Cal_Cal.ZDrive_BSW_Cal_VehicleInfomationTable.Vehicle_Information_Reserved_Line149 "" VALUE 0x3d822c Record_ULONG 0 autosar_swc_vmc_CM_uint32 0 4294967295 /end CHARACTERISTIC
/begin CHARACTERISTIC ZDrive_BSW_Cal_Cal.ZDrive_BSW_Cal_VehicleInfomationTable.Vehicle_Information_Reserved_Line158 "" VALUE 0x3d8250 Record_ULONG 0 autosar_swc_vmc_CM_uint32 0 4294967295 /end CHARACTERISTIC
/begin CHARACTERISTIC ZDrive_BSW_Cal_Cal.ZDrive_BSW_Cal_VehicleInfomationTable.Vehicle_Information_Reserved_Line165 "" VALUE 0x3d826c Record_ULONG 0 autosar_swc_vmc_CM_uint32 0 4294967295 /end CHARACTERISTIC
/begin CHARACTERISTIC ZDrive_BSW_Cal_Cal.ZDrive_BSW_Cal_VehicleInfomationTable.Vehicle_Information_Reserved_Line172 "" VALUE 0x3d8288 Record_ULONG 0 autosar_swc_vmc_CM_uint32 0 4294967295 /end CHARACTERISTIC
/begin CHARACTERISTIC ZDrive_BSW_Cal_Cal.ZDrive_BSW_Cal_VehicleInfomationTable.Vehicle_Information_Reserved_Line179 "" VALUE 0x3d82a4 Record_ULONG 0 autosar_swc_vmc_CM_uint32 0 4294967295 /end CHARACTERISTIC
/begin CHARACTERISTIC ZDrive_BSW_Cal_Cal.ZDrive_BSW_Cal_VehicleInfomationTable.Vehicle_Information_Reserved_Line186 "" VALUE 0x3d82c0 Record_ULONG 0 autosar_swc_vmc_CM_uint32 0 4294967295 /end CHARACTERISTIC
/begin CHARACTERISTIC ZDrive_BSW_Cal_Cal.ZDrive_BSW_Cal_VehicleInfomationTable.Vehicle_Information_Reserved_Line193 "" VALUE 0x3d82dc Record_ULONG 0 autosar_swc_vmc_CM_uint32 0 4294967295 /end CHARACTERISTIC
/begin CHARACTERISTIC ZDrive_BSW_Cal_Cal.ZDrive_BSW_Cal_VehicleInfomationTable.Vehicle_Information_Reserved_Line200 "" VALUE 0x3d82f8 Record_ULONG 0 autosar_swc_vmc_CM_uint32 0 4294967295 /end CHARACTERISTIC
/begin CHARACTERISTIC ZDrive_BSW_Cal_Cal.ZDrive_BSW_Cal_VehicleInfomationTable.Vehicle_Information_Reserved_Line207 "" VALUE 0x3d8314 Record_ULONG 0 autosar_swc_vmc_CM_uint32 0 4294967295 /end CHARACTERISTIC
/begin COMPU_METHOD autosar_swc_vmc_CM_int16 "Q = V" IDENTICAL "%5.0" "" /end COMPU_METHOD
/begin COMPU_METHOD autosar_swc_vmc_CM_int8 "Q = V" IDENTICAL "%3.0" "" /end COMPU_METHOD
/begin COMPU_METHOD autosar_swc_vmc_CM_single "Q = V" IDENTICAL "%8.6" "" /end COMPU_METHOD
/begin COMPU_METHOD autosar_swc_vmc_CM_uint16 "Q = V" IDENTICAL "%5.0" "" /end COMPU_METHOD
/begin COMPU_METHOD autosar_swc_vmc_CM_uint32 "Q = V" IDENTICAL "%10.0" "" /end COMPU_METHOD
/begin COMPU_METHOD autosar_swc_vmc_CM_uint8 "Q = V" IDENTICAL "%3.0" "" /end COMPU_METHOD
/begin RECORD_LAYOUT Record_FLOAT32_IEEE FNC_VALUES 1 FLOAT32_IEEE COLUMN_DIR DIRECT /end RECORD_LAYOUT
/begin RECORD_LAYOUT Record_SBYTE FNC_VALUES 1 SBYTE COLUMN_DIR DIRECT /end RECORD_LAYOUT
/begin RECORD_LAYOUT Record_SWORD FNC_VALUES 1 SWORD COLUMN_DIR DIRECT /end RECORD_LAYOUT
/begin RECORD_LAYOUT Record_UBYTE FNC_VALUES 1 UBYTE COLUMN_DIR DIRECT /end RECORD_LAYOUT
/begin RECORD_LAYOUT Record_ULONG FNC_VALUES 1 ULONG COLUMN_DIR DIRECT /end RECORD_LAYOUT
/begin RECORD_LAYOUT Record_UWORD FNC_VALUES 1 UWORD COLUMN_DIR DIRECT /end RECORD_LAYOUT
/begin RECORD_LAYOUT Record_FLOAT32_IEEE FNC_VALUES 1 FLOAT32_IEEE COLUMN_DIR DIRECT /end RECORD_LAYOUT
/begin RECORD_LAYOUT Record_SBYTE FNC_VALUES 1 SBYTE COLUMN_DIR DIRECT /end RECORD_LAYOUT
/begin RECORD_LAYOUT Record_SWORD FNC_VALUES 1 SWORD COLUMN_DIR DIRECT /end RECORD_LAYOUT
/begin RECORD_LAYOUT Record_UBYTE FNC_VALUES 1 UBYTE COLUMN_DIR DIRECT /end RECORD_LAYOUT
/begin RECORD_LAYOUT Record_ULONG FNC_VALUES 1 ULONG COLUMN_DIR DIRECT /end RECORD_LAYOUT
/begin RECORD_LAYOUT Record_UWORD FNC_VALUES 1 UWORD COLUMN_DIR DIRECT /end RECORD_LAYOUT
/begin RECORD_LAYOUT Record_FLOAT32_IEEE FNC_VALUES 1 FLOAT32_IEEE COLUMN_DIR DIRECT /end RECORD_LAYOUT
/begin RECORD_LAYOUT Record_SBYTE FNC_VALUES 1 SBYTE COLUMN_DIR DIRECT /end RECORD_LAYOUT
/begin RECORD_LAYOUT Record_SWORD FNC_VALUES 1 SWORD COLUMN_DIR DIRECT /end RECORD_LAYOUT
/begin RECORD_LAYOUT Record_UBYTE FNC_VALUES 1 UBYTE COLUMN_DIR DIRECT /end RECORD_LAYOUT
/begin RECORD_LAYOUT Record_ULONG FNC_VALUES 1 ULONG COLUMN_DIR DIRECT /end RECORD_LAYOUT
/begin RECORD_LAYOUT Record_UWORD FNC_VALUES 1 UWORD COLUMN_DIR DIRECT /end RECORD_LAYOUT
/begin RECORD_LAYOUT Record_FLOAT32_IEEE FNC_VALUES 1 FLOAT32_IEEE COLUMN_DIR DIRECT /end RECORD_LAYOUT
/begin RECORD_LAYOUT Record_SBYTE FNC_VALUES 1 SBYTE COLUMN_DIR DIRECT /end RECORD_LAYOUT
/begin RECORD_LAYOUT Record_SWORD FNC_VALUES 1 SWORD COLUMN_DIR DIRECT /end RECORD_LAYOUT
/begin RECORD_LAYOUT Record_UBYTE FNC_VALUES 1 UBYTE COLUMN_DIR DIRECT /end RECORD_LAYOUT
/begin RECORD_LAYOUT Record_ULONG FNC_VALUES 1 ULONG COLUMN_DIR DIRECT /end RECORD_LAYOUT
/begin RECORD_LAYOUT Record_UWORD FNC_VALUES 1 UWORD COLUMN_DIR DIRECT /end RECORD_LAYOUT
/end MODULE
/end PROJECT
