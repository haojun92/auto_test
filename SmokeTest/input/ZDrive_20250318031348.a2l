ASAP2_VERSION 1 71
/begin PROJECT ProjectName ""
/begin MODULE ModuleName ""
/begin MOD_COMMON "" BYTE_ORDER MSB_LAST ALIGNMENT_BYTE 1 ALIGNMENT_WORD 1 ALIGNMENT_LONG 1 ALIGNMENT_INT64 1 ALIGNMENT_FLOAT16_IEEE 1 ALIGNMENT_FLOAT32_IEEE 1 ALIGNMENT_FLOAT64_IEEE 1 /end MOD_COMMON
/begin RECORD_LAYOUT __SBYTE_S FNC_VALUES 1 SBYTE COLUMN_DIR DIRECT /end RECORD_LAYOUT
/begin RECORD_LAYOUT __SWORD_S FNC_VALUES 1 SWORD COLUMN_DIR DIRECT /end RECORD_LAYOUT
/begin RECORD_LAYOUT Record_BOOLEAN FNC_VALUES 1 UBYTE COLUMN_DIR DIRECT /end RECORD_LAYOUT
/begin RECORD_LAYOUT Record_FLOAT32_IEEE FNC_VALUES 1 FLOAT32_IEEE COLUMN_DIR DIRECT /end RECORD_LAYOUT
/begin RECORD_LAYOUT Record_UBYTE FNC_VALUES 1 UBYTE COLUMN_DIR DIRECT /end RECORD_LAYOUT
/begin RECORD_LAYOUT Record_ULONG FNC_VALUES 1 ULONG COLUMN_DIR DIRECT /end RECORD_LAYOUT
/begin RECORD_LAYOUT Record_UWORD FNC_VALUES 1 UWORD COLUMN_DIR DIRECT /end RECORD_LAYOUT
/begin RECORD_LAYOUT Axis_FLOAT32_IEEE AXIS_PTS_X 1 FLOAT32_IEEE INDEX_INCR DIRECT /end RECORD_LAYOUT
/begin CHARACTERISTIC CAL_ACCAbnJumpTi "" VALUE 0xfe82033a /* @ECU_Address@CAL_ACCAbnJumpTi@ */ Record_UBYTE 0 autosar_swc_fusamon_CM_uint8 0 255 /end CHARACTERISTIC
/begin CHARACTERISTIC CAL_AEBAccePedlChkTiWin "" VALUE 0xfe8202f4 /* @ECU_Address@CAL_AEBAccePedlChkTiWin@ */ Record_UWORD 0 autosar_swc_fusamon_CM_uint16 0 65535 /end CHARACTERISTIC
/begin CHARACTERISTIC CAL_AEBAccePedlRateChgUlim "" VALUE 0xfe8202f6 /* @ECU_Address@CAL_AEBAccePedlRateChgUlim@ */ Record_UWORD 0 autosar_swc_fusamon_CM_uint16 0 65535 /end CHARACTERISTIC
/begin CHARACTERISTIC CAL_AEBDrvAccePedlOvrdThd "" VALUE 0xfe820278 /* @ECU_Address@CAL_AEBDrvAccePedlOvrdThd@ */ Record_FLOAT32_IEEE 0 autosar_swc_fusamon_CM_single -3.4E+38 3.4E+38 /end CHARACTERISTIC
/begin CHARACTERISTIC CAL_AEBSteerWhlAngSpdOvrdThld "" VALUE 0xfe8202f8 /* @ECU_Address@CAL_AEBSteerWhlAngSpdOvrdThld@ */ Record_UWORD 0 autosar_swc_fusamon_CM_uint16 0 65535 /end CHARACTERISTIC
/begin CHARACTERISTIC CAL_AebFuSaSumRiskThld "" VALUE 0xfe82027c /* @ECU_Address@CAL_AebFuSaSumRiskThld@ */ Record_FLOAT32_IEEE 0 autosar_swc_fusamon_CM_single -3.4E+38 3.4E+38 /end CHARACTERISTIC
/begin CHARACTERISTIC CAL_AebTarConfiChkThld "" VALUE 0xfe820280 /* @ECU_Address@CAL_AebTarConfiChkThld@ */ Record_FLOAT32_IEEE 0 autosar_swc_fusamon_CM_single -3.4E+38 3.4E+38 /end CHARACTERISTIC
/begin CHARACTERISTIC CAL_AftTrigCvrtAbnDebThld "" VALUE 0xfe82033b /* @ECU_Address@CAL_AftTrigCvrtAbnDebThld@ */ Record_UBYTE 0 autosar_swc_fusamon_CM_uint8 0 255 /end CHARACTERISTIC
/begin CHARACTERISTIC CAL_AftTrigCvrtDefault "" VALUE 0xfe820284 /* @ECU_Address@CAL_AftTrigCvrtDefault@ */ Record_FLOAT32_IEEE 0 autosar_swc_fusamon_CM_single -3.4E+38 3.4E+38 /end CHARACTERISTIC
/begin CHARACTERISTIC CAL_AftTrigCvrtSpdThld1 "" VALUE 0xfe82033c /* @ECU_Address@CAL_AftTrigCvrtSpdThld1@ */ Record_UBYTE 0 autosar_swc_fusamon_CM_uint8 0 255 /end CHARACTERISTIC
/begin CHARACTERISTIC CAL_AftTrigCvrtSpdThld2 "" VALUE 0xfe82033d /* @ECU_Address@CAL_AftTrigCvrtSpdThld2@ */ Record_UBYTE 0 autosar_swc_fusamon_CM_uint8 0 255 /end CHARACTERISTIC
/begin CHARACTERISTIC CAL_AftTrigCvrtThld1 "" VALUE 0xfe820288 /* @ECU_Address@CAL_AftTrigCvrtThld1@ */ Record_FLOAT32_IEEE 0 autosar_swc_fusamon_CM_single -3.4E+38 3.4E+38 /end CHARACTERISTIC
/begin CHARACTERISTIC CAL_AftTrigCvrtThld2 "" VALUE 0xfe82028c /* @ECU_Address@CAL_AftTrigCvrtThld2@ */ Record_FLOAT32_IEEE 0 autosar_swc_fusamon_CM_single -3.4E+38 3.4E+38 /end CHARACTERISTIC
/begin CHARACTERISTIC CAL_AftTrigJerkAbnDebThld "" VALUE 0xfe82033e /* @ECU_Address@CAL_AftTrigJerkAbnDebThld@ */ Record_UBYTE 0 autosar_swc_fusamon_CM_uint8 0 255 /end CHARACTERISTIC
/begin CHARACTERISTIC CAL_AftTrigJerkAbnThld "" VALUE 0xfe820290 /* @ECU_Address@CAL_AftTrigJerkAbnThld@ */ Record_FLOAT32_IEEE 0 autosar_swc_fusamon_CM_single -3.4E+38 3.4E+38 /end CHARACTERISTIC
/begin CHARACTERISTIC CAL_AftTrigTarOvrlapDebThld "" VALUE 0xfe82033f /* @ECU_Address@CAL_AftTrigTarOvrlapDebThld@ */ Record_UBYTE 0 autosar_swc_fusamon_CM_uint8 0 255 /end CHARACTERISTIC
/begin CHARACTERISTIC CAL_AftTrigTarOvrlapXThld "" VALUE 0xfe820294 /* @ECU_Address@CAL_AftTrigTarOvrlapXThld@ */ Record_FLOAT32_IEEE 0 autosar_swc_fusamon_CM_single -3.4E+38 3.4E+38 /end CHARACTERISTIC
/begin CHARACTERISTIC CAL_AftTrigTarOvrlapYLThld "" VALUE 0xfe820298 /* @ECU_Address@CAL_AftTrigTarOvrlapYLThld@ */ Record_FLOAT32_IEEE 0 autosar_swc_fusamon_CM_single -3.4E+38 3.4E+38 /end CHARACTERISTIC
/begin CHARACTERISTIC CAL_AftTrigTarOvrlapYRThld "" VALUE 0xfe82029c /* @ECU_Address@CAL_AftTrigTarOvrlapYRThld@ */ Record_FLOAT32_IEEE 0 autosar_swc_fusamon_CM_single -3.4E+38 3.4E+38 /end CHARACTERISTIC
/begin CHARACTERISTIC CAL_CoriDAebTarDecThld "" VALUE 0xfe8202a0 /* @ECU_Address@CAL_CoriDAebTarDecThld@ */ Record_FLOAT32_IEEE 0 autosar_swc_fusamon_CM_single -3.4E+38 3.4E+38 /end CHARACTERISTIC
/begin CHARACTERISTIC CAL_CoriDDebThld1 "" VALUE 0xfe8202fa /* @ECU_Address@CAL_CoriDDebThld1@ */ Record_UWORD 0 autosar_swc_fusamon_CM_uint16 0 65535 /end CHARACTERISTIC
/begin CHARACTERISTIC CAL_CoriDDebThld2 "" VALUE 0xfe8202fc /* @ECU_Address@CAL_CoriDDebThld2@ */ Record_UWORD 0 autosar_swc_fusamon_CM_uint16 0 65535 /end CHARACTERISTIC
/begin CHARACTERISTIC CAL_CoriDDecThld1 "" VALUE 0xfe8202a4 /* @ECU_Address@CAL_CoriDDecThld1@ */ Record_FLOAT32_IEEE 0 autosar_swc_fusamon_CM_single -3.4E+38 3.4E+38 /end CHARACTERISTIC
/begin CHARACTERISTIC CAL_Deb_SftyFlg_AEB_Ovrd_Inhibit "" VALUE 0xfe8202fe /* @ECU_Address@CAL_Deb_SftyFlg_AEB_Ovrd_Inhibit@ */ Record_UWORD 0 autosar_swc_fusamon_CM_uint16 0 65535 /end CHARACTERISTIC
/begin CHARACTERISTIC CAL_Deb_SftyFlg_AEB_RGear_Inhibit "" VALUE 0xfe820340 /* @ECU_Address@CAL_Deb_SftyFlg_AEB_RGear_Inhibit@ */ Record_UBYTE 0 autosar_swc_fusamon_CM_uint8 0 255 /end CHARACTERISTIC
/begin CHARACTERISTIC CAL_Deb_SftyFlg_AccSwtStsE2E "" VALUE 0xfe820300 /* @ECU_Address@CAL_Deb_SftyFlg_AccSwtStsE2E@ */ Record_UWORD 0 autosar_swc_fusamon_CM_uint16 0 65535 /end CHARACTERISTIC
/begin CHARACTERISTIC CAL_Deb_SftyFlg_AccSwtStsVld "" VALUE 0xfe820302 /* @ECU_Address@CAL_Deb_SftyFlg_AccSwtStsVld@ */ Record_UWORD 0 autosar_swc_fusamon_CM_uint16 0 65535 /end CHARACTERISTIC
/begin CHARACTERISTIC CAL_Deb_SftyFlg_ActGearE2E "" VALUE 0xfe820341 /* @ECU_Address@CAL_Deb_SftyFlg_ActGearE2E@ */ Record_UBYTE 0 autosar_swc_fusamon_CM_uint8 0 255 /end CHARACTERISTIC
/begin CHARACTERISTIC CAL_Deb_SftyFlg_ActGearVld "" VALUE 0xfe820342 /* @ECU_Address@CAL_Deb_SftyFlg_ActGearVld@ */ Record_UBYTE 0 autosar_swc_fusamon_CM_uint8 0 255 /end CHARACTERISTIC
/begin CHARACTERISTIC CAL_Deb_SftyFlg_AxE2E "" VALUE 0xfe820343 /* @ECU_Address@CAL_Deb_SftyFlg_AxE2E@ */ Record_UBYTE 0 autosar_swc_fusamon_CM_uint8 0 255 /end CHARACTERISTIC
/begin CHARACTERISTIC CAL_Deb_SftyFlg_AxVld "" VALUE 0xfe820344 /* @ECU_Address@CAL_Deb_SftyFlg_AxVld@ */ Record_UBYTE 0 autosar_swc_fusamon_CM_uint8 0 255 /end CHARACTERISTIC
/begin CHARACTERISTIC CAL_Deb_SftyFlg_AyE2E "" VALUE 0xfe820345 /* @ECU_Address@CAL_Deb_SftyFlg_AyE2E@ */ Record_UBYTE 0 autosar_swc_fusamon_CM_uint8 0 255 /end CHARACTERISTIC
/begin CHARACTERISTIC CAL_Deb_SftyFlg_AyVld "" VALUE 0xfe820346 /* @ECU_Address@CAL_Deb_SftyFlg_AyVld@ */ Record_UBYTE 0 autosar_swc_fusamon_CM_uint8 0 255 /end CHARACTERISTIC
/begin CHARACTERISTIC CAL_Deb_SftyFlg_BodyAvlE2E "" VALUE 0xfe820347 /* @ECU_Address@CAL_Deb_SftyFlg_BodyAvlE2E@ */ Record_UBYTE 0 autosar_swc_fusamon_CM_uint8 0 255 /end CHARACTERISTIC
/begin CHARACTERISTIC CAL_Deb_SftyFlg_BrkAvl "" VALUE 0xfe820348 /* @ECU_Address@CAL_Deb_SftyFlg_BrkAvl@ */ Record_UBYTE 0 autosar_swc_fusamon_CM_uint8 0 255 /end CHARACTERISTIC
/begin CHARACTERISTIC CAL_Deb_SftyFlg_BrkAvlE2E "" VALUE 0xfe820349 /* @ECU_Address@CAL_Deb_SftyFlg_BrkAvlE2E@ */ Record_UBYTE 0 autosar_swc_fusamon_CM_uint8 0 255 /end CHARACTERISTIC
/begin CHARACTERISTIC CAL_Deb_SftyFlg_BrkMstCylPrsE2E "" VALUE 0xfe82034a /* @ECU_Address@CAL_Deb_SftyFlg_BrkMstCylPrsE2E@ */ Record_UBYTE 0 autosar_swc_fusamon_CM_uint8 0 255 /end CHARACTERISTIC
/begin CHARACTERISTIC CAL_Deb_SftyFlg_BrkMstCylPrsVld "" VALUE 0xfe82034b /* @ECU_Address@CAL_Deb_SftyFlg_BrkMstCylPrsVld@ */ Record_UBYTE 0 autosar_swc_fusamon_CM_uint8 0 255 /end CHARACTERISTIC
/begin CHARACTERISTIC CAL_Deb_SftyFlg_Chassis_ABSFailSts "" VALUE 0xfe82034c /* @ECU_Address@CAL_Deb_SftyFlg_Chassis_ABSFailSts@ */ Record_UBYTE 0 autosar_swc_fusamon_CM_uint8 0 255 /end CHARACTERISTIC
/begin CHARACTERISTIC CAL_Deb_SftyFlg_Chassis_EBDFailSts "" VALUE 0xfe82034d /* @ECU_Address@CAL_Deb_SftyFlg_Chassis_EBDFailSts@ */ Record_UBYTE 0 autosar_swc_fusamon_CM_uint8 0 255 /end CHARACTERISTIC
/begin CHARACTERISTIC CAL_Deb_SftyFlg_Chassis_HDCFailSts "" VALUE 0xfe82034e /* @ECU_Address@CAL_Deb_SftyFlg_Chassis_HDCFailSts@ */ Record_UBYTE 0 autosar_swc_fusamon_CM_uint8 0 255 /end CHARACTERISTIC
/begin CHARACTERISTIC CAL_Deb_SftyFlg_Chassis_TCSFailSts "" VALUE 0xfe82034f /* @ECU_Address@CAL_Deb_SftyFlg_Chassis_TCSFailSts@ */ Record_UBYTE 0 autosar_swc_fusamon_CM_uint8 0 255 /end CHARACTERISTIC
/begin CHARACTERISTIC CAL_Deb_SftyFlg_Chassis_VDCFailSts "" VALUE 0xfe820350 /* @ECU_Address@CAL_Deb_SftyFlg_Chassis_VDCFailSts@ */ Record_UBYTE 0 autosar_swc_fusamon_CM_uint8 0 255 /end CHARACTERISTIC
/begin CHARACTERISTIC CAL_Deb_SftyFlg_DrvAccePedlPosnE2E "" VALUE 0xfe820351 /* @ECU_Address@CAL_Deb_SftyFlg_DrvAccePedlPosnE2E@ */ Record_UBYTE 0 autosar_swc_fusamon_CM_uint8 0 255 /end CHARACTERISTIC
/begin CHARACTERISTIC CAL_Deb_SftyFlg_DrvAccePedlPosnVld "" VALUE 0xfe820352 /* @ECU_Address@CAL_Deb_SftyFlg_DrvAccePedlPosnVld@ */ Record_UBYTE 0 autosar_swc_fusamon_CM_uint8 0 255 /end CHARACTERISTIC
/begin CHARACTERISTIC CAL_Deb_SftyFlg_EpbAvl "" VALUE 0xfe820353 /* @ECU_Address@CAL_Deb_SftyFlg_EpbAvl@ */ Record_UBYTE 0 autosar_swc_fusamon_CM_uint8 0 255 /end CHARACTERISTIC
/begin CHARACTERISTIC CAL_Deb_SftyFlg_EpbAvlE2E "" VALUE 0xfe820354 /* @ECU_Address@CAL_Deb_SftyFlg_EpbAvlE2E@ */ Record_UBYTE 0 autosar_swc_fusamon_CM_uint8 0 255 /end CHARACTERISTIC
/begin CHARACTERISTIC CAL_Deb_SftyFlg_F_Cam_Err "" VALUE 0xfe820308 /* @ECU_Address@CAL_Deb_SftyFlg_F_Cam_Err@ */ Record_UWORD 0 autosar_swc_fusamon_CM_uint16 0 65535 /end CHARACTERISTIC
/begin CHARACTERISTIC CAL_Deb_SftyFlg_HandsOff "" VALUE 0xfe82030a /* @ECU_Address@CAL_Deb_SftyFlg_HandsOff@ */ Record_UWORD 0 autosar_swc_fusamon_CM_uint16 0 65535 /end CHARACTERISTIC
/begin CHARACTERISTIC CAL_Deb_SftyFlg_PTAvl "" VALUE 0xfe820355 /* @ECU_Address@CAL_Deb_SftyFlg_PTAvl@ */ Record_UBYTE 0 autosar_swc_fusamon_CM_uint8 0 255 /end CHARACTERISTIC
/begin CHARACTERISTIC CAL_Deb_SftyFlg_PTAvlE2E "" VALUE 0xfe820356 /* @ECU_Address@CAL_Deb_SftyFlg_PTAvlE2E@ */ Record_UBYTE 0 autosar_swc_fusamon_CM_uint8 0 255 /end CHARACTERISTIC
/begin CHARACTERISTIC CAL_Deb_SftyFlg_Pilot_AccPosAbn_Error "" VALUE 0xfe82030e /* @ECU_Address@CAL_Deb_SftyFlg_Pilot_AccPosAbn_Error@ */ Record_UWORD 0 autosar_swc_fusamon_CM_uint16 0 65535 /end CHARACTERISTIC
/begin CHARACTERISTIC CAL_Deb_SftyFlg_RL_Radar_Err "" VALUE 0xfe820310 /* @ECU_Address@CAL_Deb_SftyFlg_RL_Radar_Err@ */ Record_UWORD 0 autosar_swc_fusamon_CM_uint16 0 65535 /end CHARACTERISTIC
/begin CHARACTERISTIC CAL_Deb_SftyFlg_RR_Radar_Err "" VALUE 0xfe820312 /* @ECU_Address@CAL_Deb_SftyFlg_RR_Radar_Err@ */ Record_UWORD 0 autosar_swc_fusamon_CM_uint16 0 65535 /end CHARACTERISTIC
/begin CHARACTERISTIC CAL_Deb_SftyFlg_SteerAvl "" VALUE 0xfe820357 /* @ECU_Address@CAL_Deb_SftyFlg_SteerAvl@ */ Record_UBYTE 0 autosar_swc_fusamon_CM_uint8 0 255 /end CHARACTERISTIC
/begin CHARACTERISTIC CAL_Deb_SftyFlg_SteerAvlE2E "" VALUE 0xfe820358 /* @ECU_Address@CAL_Deb_SftyFlg_SteerAvlE2E@ */ Record_UBYTE 0 autosar_swc_fusamon_CM_uint8 0 255 /end CHARACTERISTIC
/begin CHARACTERISTIC CAL_Deb_SftyFlg_SteerWhlAngE2E "" VALUE 0xfe820359 /* @ECU_Address@CAL_Deb_SftyFlg_SteerWhlAngE2E@ */ Record_UBYTE 0 autosar_swc_fusamon_CM_uint8 0 255 /end CHARACTERISTIC
/begin CHARACTERISTIC CAL_Deb_SftyFlg_SteerWhlAngSpdE2E "" VALUE 0xfe82035a /* @ECU_Address@CAL_Deb_SftyFlg_SteerWhlAngSpdE2E@ */ Record_UBYTE 0 autosar_swc_fusamon_CM_uint8 0 255 /end CHARACTERISTIC
/begin CHARACTERISTIC CAL_Deb_SftyFlg_SteerWhlAngSpdVld "" VALUE 0xfe82035b /* @ECU_Address@CAL_Deb_SftyFlg_SteerWhlAngSpdVld@ */ Record_UBYTE 0 autosar_swc_fusamon_CM_uint8 0 255 /end CHARACTERISTIC
/begin CHARACTERISTIC CAL_Deb_SftyFlg_SteerWhlAngVld "" VALUE 0xfe82035c /* @ECU_Address@CAL_Deb_SftyFlg_SteerWhlAngVld@ */ Record_UBYTE 0 autosar_swc_fusamon_CM_uint8 0 255 /end CHARACTERISTIC
/begin CHARACTERISTIC CAL_Deb_SftyFlg_SysFuSa_Err "" VALUE 0xfe82031a /* @ECU_Address@CAL_Deb_SftyFlg_SysFuSa_Err@ */ Record_UWORD 0 autosar_swc_fusamon_CM_uint16 0 65535 /end CHARACTERISTIC
/begin CHARACTERISTIC CAL_Deb_SftyFlg_VehSpdChassisE2E "" VALUE 0xfe82035d /* @ECU_Address@CAL_Deb_SftyFlg_VehSpdChassisE2E@ */ Record_UBYTE 0 autosar_swc_fusamon_CM_uint8 0 255 /end CHARACTERISTIC
/begin CHARACTERISTIC CAL_Deb_SftyFlg_VehSpdChassisVld "" VALUE 0xfe82035e /* @ECU_Address@CAL_Deb_SftyFlg_VehSpdChassisVld@ */ Record_UBYTE 0 autosar_swc_fusamon_CM_uint8 0 255 /end CHARACTERISTIC
/begin CHARACTERISTIC CAL_Deb_SftyFlg_WhlAvl "" VALUE 0xfe82035f /* @ECU_Address@CAL_Deb_SftyFlg_WhlAvl@ */ Record_UBYTE 0 autosar_swc_fusamon_CM_uint8 0 255 /end CHARACTERISTIC
/begin CHARACTERISTIC CAL_Deb_SftyFlg_WhlAvlE2E "" VALUE 0xfe820360 /* @ECU_Address@CAL_Deb_SftyFlg_WhlAvlE2E@ */ Record_UBYTE 0 autosar_swc_fusamon_CM_uint8 0 255 /end CHARACTERISTIC
/begin CHARACTERISTIC CAL_Deb_SftyFlg_YawRateE2E "" VALUE 0xfe820361 /* @ECU_Address@CAL_Deb_SftyFlg_YawRateE2E@ */ Record_UBYTE 0 autosar_swc_fusamon_CM_uint8 0 255 /end CHARACTERISTIC
/begin CHARACTERISTIC CAL_Deb_SftyFlg_YawRateVld "" VALUE 0xfe820362 /* @ECU_Address@CAL_Deb_SftyFlg_YawRateVld@ */ Record_UBYTE 0 autosar_swc_fusamon_CM_uint8 0 255 /end CHARACTERISTIC
/begin CHARACTERISTIC CAL_DlyTiMon "" VALUE 0xfe82031c /* @ECU_Address@CAL_DlyTiMon@ */ Record_UWORD 0 autosar_swc_fusamon_CM_uint16 0 65535 /end CHARACTERISTIC
/begin CHARACTERISTIC CAL_DrvAccePedlGent "" VALUE 0xfe820363 /* @ECU_Address@CAL_DrvAccePedlGent@ */ Record_UBYTE 0 autosar_swc_fusamon_CM_uint8 0 255 /end CHARACTERISTIC
/begin CHARACTERISTIC CAL_DrvAccePedlNotPressTiWin "" VALUE 0xfe82031e /* @ECU_Address@CAL_DrvAccePedlNotPressTiWin@ */ Record_UWORD 0 autosar_swc_fusamon_CM_uint16 0 65535 /end CHARACTERISTIC
/begin CHARACTERISTIC CAL_EgoChkAxAbnThld "" VALUE 0xfe8202a8 /* @ECU_Address@CAL_EgoChkAxAbnThld@ */ Record_FLOAT32_IEEE 0 autosar_swc_fusamon_CM_single -3.4E+38 3.4E+38 /end CHARACTERISTIC
/begin CHARACTERISTIC CAL_EgoChkAxDebThld "" VALUE 0xfe820364 /* @ECU_Address@CAL_EgoChkAxDebThld@ */ Record_UBYTE 0 autosar_swc_fusamon_CM_uint8 0 255 /end CHARACTERISTIC
/begin CHARACTERISTIC CAL_EgoChkAyAbnThld "" VALUE 0xfe8202ac /* @ECU_Address@CAL_EgoChkAyAbnThld@ */ Record_FLOAT32_IEEE 0 autosar_swc_fusamon_CM_single -3.4E+38 3.4E+38 /end CHARACTERISTIC
/begin CHARACTERISTIC CAL_EgoChkAyDebThld "" VALUE 0xfe820365 /* @ECU_Address@CAL_EgoChkAyDebThld@ */ Record_UBYTE 0 autosar_swc_fusamon_CM_uint8 0 255 /end CHARACTERISTIC
/begin CHARACTERISTIC CAL_EgoChkStrWhlAngAbnThld "" VALUE 0xfe820320 /* @ECU_Address@CAL_EgoChkStrWhlAngAbnThld@ */ Record_UWORD 0 autosar_swc_fusamon_CM_uint16 0 65535 /end CHARACTERISTIC
/begin CHARACTERISTIC CAL_EgoChkVehSpdAbnDebThld "" VALUE 0xfe820366 /* @ECU_Address@CAL_EgoChkVehSpdAbnDebThld@ */ Record_UBYTE 0 autosar_swc_fusamon_CM_uint8 0 255 /end CHARACTERISTIC
/begin CHARACTERISTIC CAL_EgoChkVehSpdAbnThld "" VALUE 0xfe820322 /* @ECU_Address@CAL_EgoChkVehSpdAbnThld@ */ Record_UWORD 0 autosar_swc_fusamon_CM_uint16 0 65535 /end CHARACTERISTIC
/begin CHARACTERISTIC CAL_EgoChkYawRAbnThld "" VALUE 0xfe820367 /* @ECU_Address@CAL_EgoChkYawRAbnThld@ */ Record_UBYTE 0 autosar_swc_fusamon_CM_uint8 0 255 /end CHARACTERISTIC
/begin CHARACTERISTIC CAL_EgoChkYawRDebThld "" VALUE 0xfe820368 /* @ECU_Address@CAL_EgoChkYawRDebThld@ */ Record_UBYTE 0 autosar_swc_fusamon_CM_uint8 0 255 /end CHARACTERISTIC
/begin CHARACTERISTIC CAL_EgoCrvtChkDebThld "" VALUE 0xfe820369 /* @ECU_Address@CAL_EgoCrvtChkDebThld@ */ Record_UBYTE 0 autosar_swc_fusamon_CM_uint8 0 255 /end CHARACTERISTIC
/begin CHARACTERISTIC CAL_EgoCrvtChkThld "" VALUE 0xfe8202b0 /* @ECU_Address@CAL_EgoCrvtChkThld@ */ Record_FLOAT32_IEEE 0 autosar_swc_fusamon_CM_single -3.4E+38 3.4E+38 /end CHARACTERISTIC
/begin CHARACTERISTIC CAL_EgoTrajChkAbnPntHeadingThld "" VALUE 0xfe82036a /* @ECU_Address@CAL_EgoTrajChkAbnPntHeadingThld@ */ Record_UBYTE 0 autosar_swc_fusamon_CM_uint8 0 255 /end CHARACTERISTIC
/begin CHARACTERISTIC CAL_EgoTrajChkAbnPntNum "" VALUE 0xfe82036b /* @ECU_Address@CAL_EgoTrajChkAbnPntNum@ */ Record_UBYTE 0 autosar_swc_fusamon_CM_uint8 0 255 /end CHARACTERISTIC
/begin CHARACTERISTIC CAL_EgoTrajChkAdjAbnDstThld "" VALUE 0xfe82036c /* @ECU_Address@CAL_EgoTrajChkAdjAbnDstThld@ */ Record_UBYTE 0 autosar_swc_fusamon_CM_uint8 0 255 /end CHARACTERISTIC
/begin CHARACTERISTIC CAL_EgoTrajChkDebThld "" VALUE 0xfe82036d /* @ECU_Address@CAL_EgoTrajChkDebThld@ */ Record_UBYTE 0 autosar_swc_fusamon_CM_uint8 0 255 /end CHARACTERISTIC
/begin CHARACTERISTIC CAL_EgoTrajChkVehSpdThld "" VALUE 0xfe82036e /* @ECU_Address@CAL_EgoTrajChkVehSpdThld@ */ Record_UBYTE 0 autosar_swc_fusamon_CM_uint8 0 255 /end CHARACTERISTIC
/begin CHARACTERISTIC CAL_PercpObjLatenTiThld "" VALUE 0xfe820324 /* @ECU_Address@CAL_PercpObjLatenTiThld@ */ Record_UWORD 0 autosar_swc_fusamon_CM_uint16 0 65535 /end CHARACTERISTIC
/begin CHARACTERISTIC CAL_PiAcceRamp1 "" VALUE 0xfe8202b4 /* @ECU_Address@CAL_PiAcceRamp1@ */ Record_FLOAT32_IEEE 0 autosar_swc_fusamon_CM_single -3.4E+38 3.4E+38 /end CHARACTERISTIC
/begin CHARACTERISTIC CAL_PiAcceRamp2 "" VALUE 0xfe8202b8 /* @ECU_Address@CAL_PiAcceRamp2@ */ Record_FLOAT32_IEEE 0 autosar_swc_fusamon_CM_single -3.4E+38 3.4E+38 /end CHARACTERISTIC
/begin CHARACTERISTIC CAL_PiAcceThd1 "" VALUE 0xfe8202bc /* @ECU_Address@CAL_PiAcceThd1@ */ Record_FLOAT32_IEEE 0 autosar_swc_fusamon_CM_single -3.4E+38 3.4E+38 /end CHARACTERISTIC
/begin CHARACTERISTIC CAL_PiAcceThd2 "" VALUE 0xfe8202c0 /* @ECU_Address@CAL_PiAcceThd2@ */ Record_FLOAT32_IEEE 0 autosar_swc_fusamon_CM_single -3.4E+38 3.4E+38 /end CHARACTERISTIC
/begin CHARACTERISTIC CAL_PilSpdThd1 "" VALUE 0xfe8202c4 /* @ECU_Address@CAL_PilSpdThd1@ */ Record_FLOAT32_IEEE 0 autosar_swc_fusamon_CM_single -3.4E+38 3.4E+38 /end CHARACTERISTIC
/begin CHARACTERISTIC CAL_PilSpdThd2 "" VALUE 0xfe8202c8 /* @ECU_Address@CAL_PilSpdThd2@ */ Record_FLOAT32_IEEE 0 autosar_swc_fusamon_CM_single -3.4E+38 3.4E+38 /end CHARACTERISTIC
/begin CHARACTERISTIC CAL_PriorVec "" VAL_BLK 0xfe8204b4 /* @ECU_Address@CAL_PriorVec@ */ Record_FLOAT32_IEEE 0 autosar_swc_fusamon_CM_single -3.4E+38 3.4E+38 MATRIX_DIM 23 1 /end CHARACTERISTIC
/begin CHARACTERISTIC CAL_SAFKEEP "" VALUE 0xfe8202cc /* @ECU_Address@CAL_SAFKEEP@ */ Record_ULONG 0 autosar_swc_fusamon_CM_uint32 0 4294967295 /end CHARACTERISTIC
/begin CHARACTERISTIC CAL_SAFMONEMG "" VALUE 0xfe8202d0 /* @ECU_Address@CAL_SAFMONEMG@ */ Record_ULONG 0 autosar_swc_fusamon_CM_uint32 0 4294967295 /end CHARACTERISTIC
/begin CHARACTERISTIC CAL_SafAdsActvSpd_ACC "" VALUE 0xfe8202d4 /* @ECU_Address@CAL_SafAdsActvSpd_ACC@ */ Record_FLOAT32_IEEE 0 autosar_swc_fusamon_CM_single -3.4E+38 3.4E+38 /end CHARACTERISTIC
/begin CHARACTERISTIC CAL_SafAdsActvSpd_AEB "" VALUE 0xfe8202d8 /* @ECU_Address@CAL_SafAdsActvSpd_AEB@ */ Record_FLOAT32_IEEE 0 autosar_swc_fusamon_CM_single -3.4E+38 3.4E+38 /end CHARACTERISTIC
/begin CHARACTERISTIC CAL_SafAdsActvSpd_ELK "" VALUE 0xfe8202dc /* @ECU_Address@CAL_SafAdsActvSpd_ELK@ */ Record_FLOAT32_IEEE 0 autosar_swc_fusamon_CM_single -3.4E+38 3.4E+38 /end CHARACTERISTIC
/begin CHARACTERISTIC CAL_SafAdsActvSpd_LCC "" VALUE 0xfe8202e0 /* @ECU_Address@CAL_SafAdsActvSpd_LCC@ */ Record_FLOAT32_IEEE 0 autosar_swc_fusamon_CM_single -3.4E+38 3.4E+38 /end CHARACTERISTIC
/begin CHARACTERISTIC CAL_SafAdsActvSpd_LKA "" VALUE 0xfe8202e4 /* @ECU_Address@CAL_SafAdsActvSpd_LKA@ */ Record_FLOAT32_IEEE 0 autosar_swc_fusamon_CM_single -3.4E+38 3.4E+38 /end CHARACTERISTIC
/begin CHARACTERISTIC CAL_SftyAebTarAcceDebThld "" VALUE 0xfe820326 /* @ECU_Address@CAL_SftyAebTarAcceDebThld@ */ Record_UWORD 0 autosar_swc_fusamon_CM_uint16 0 65535 /end CHARACTERISTIC
/begin CHARACTERISTIC CAL_SftyAebTarCamIdDebThld "" VALUE 0xfe820328 /* @ECU_Address@CAL_SftyAebTarCamIdDebThld@ */ Record_UWORD 0 autosar_swc_fusamon_CM_uint16 0 65535 /end CHARACTERISTIC
/begin CHARACTERISTIC CAL_SftyAebTarConfiDebThld "" VALUE 0xfe82036f /* @ECU_Address@CAL_SftyAebTarConfiDebThld@ */ Record_UBYTE 0 autosar_swc_fusamon_CM_uint8 0 255 /end CHARACTERISTIC
/begin CHARACTERISTIC CAL_SftyAebTarHeadingDebThld "" VALUE 0xfe82032a /* @ECU_Address@CAL_SftyAebTarHeadingDebThld@ */ Record_UWORD 0 autosar_swc_fusamon_CM_uint16 0 65535 /end CHARACTERISTIC
/begin CHARACTERISTIC CAL_SftyAebTarHeadingInVldThld "" VALUE 0xfe82032c /* @ECU_Address@CAL_SftyAebTarHeadingInVldThld@ */ Record_UWORD 0 autosar_swc_fusamon_CM_uint16 0 65535 /end CHARACTERISTIC
/begin CHARACTERISTIC CAL_SftyAebTarHeadingSignJump "" VALUE 0xfe82032e /* @ECU_Address@CAL_SftyAebTarHeadingSignJump@ */ Record_UWORD 0 autosar_swc_fusamon_CM_uint16 0 65535 /end CHARACTERISTIC
/begin CHARACTERISTIC CAL_SftyAebTarPercpAxInVldThld "" VALUE 0xfe820370 /* @ECU_Address@CAL_SftyAebTarPercpAxInVldThld@ */ Record_UBYTE 0 autosar_swc_fusamon_CM_uint8 0 255 /end CHARACTERISTIC
/begin CHARACTERISTIC CAL_SftyAebTarPercpAyInVldThld "" VALUE 0xfe820371 /* @ECU_Address@CAL_SftyAebTarPercpAyInVldThld@ */ Record_UBYTE 0 autosar_swc_fusamon_CM_uint8 0 255 /end CHARACTERISTIC
/begin CHARACTERISTIC CAL_SftyAebTarPercpVxInVldThld "" VALUE 0xfe820372 /* @ECU_Address@CAL_SftyAebTarPercpVxInVldThld@ */ Record_UBYTE 0 autosar_swc_fusamon_CM_uint8 0 255 /end CHARACTERISTIC
/begin CHARACTERISTIC CAL_SftyAebTarPercpVyInVldThld "" VALUE 0xfe820373 /* @ECU_Address@CAL_SftyAebTarPercpVyInVldThld@ */ Record_UBYTE 0 autosar_swc_fusamon_CM_uint8 0 255 /end CHARACTERISTIC
/begin CHARACTERISTIC CAL_SftyAebTarPercpXInVldThld "" VALUE 0xfe820330 /* @ECU_Address@CAL_SftyAebTarPercpXInVldThld@ */ Record_UWORD 0 autosar_swc_fusamon_CM_uint16 0 65535 /end CHARACTERISTIC
/begin CHARACTERISTIC CAL_SftyAebTarPercpYInVldThld "" VALUE 0xfe820332 /* @ECU_Address@CAL_SftyAebTarPercpYInVldThld@ */ Record_UWORD 0 autosar_swc_fusamon_CM_uint16 0 65535 /end CHARACTERISTIC
/begin CHARACTERISTIC CAL_SftyAebTarPosDebThld "" VALUE 0xfe820334 /* @ECU_Address@CAL_SftyAebTarPosDebThld@ */ Record_UWORD 0 autosar_swc_fusamon_CM_uint16 0 65535 /end CHARACTERISTIC
/begin CHARACTERISTIC CAL_SftyAebTarSourceTTCEna "" VALUE 0xfe8202e8 /* @ECU_Address@CAL_SftyAebTarSourceTTCEna@ */ Record_FLOAT32_IEEE 0 autosar_swc_fusamon_CM_single -3.4E+38 3.4E+38 /end CHARACTERISTIC
/begin CHARACTERISTIC CAL_SftyAebTarTTCDebThld "" VALUE 0xfe820374 /* @ECU_Address@CAL_SftyAebTarTTCDebThld@ */ Record_UBYTE 0 autosar_swc_fusamon_CM_uint8 0 255 /end CHARACTERISTIC
/begin CHARACTERISTIC CAL_SftyAebTarTypeDebThld "" VALUE 0xfe820375 /* @ECU_Address@CAL_SftyAebTarTypeDebThld@ */ Record_UBYTE 0 autosar_swc_fusamon_CM_uint8 0 255 /end CHARACTERISTIC
/begin CHARACTERISTIC CAL_SftyAebTarVelocityDebThld "" VALUE 0xfe820336 /* @ECU_Address@CAL_SftyAebTarVelocityDebThld@ */ Record_UWORD 0 autosar_swc_fusamon_CM_uint16 0 65535 /end CHARACTERISTIC
/begin CHARACTERISTIC CAL_SftyAebTarVldDebThld "" VALUE 0xfe820376 /* @ECU_Address@CAL_SftyAebTarVldDebThld@ */ Record_UBYTE 0 autosar_swc_fusamon_CM_uint8 0 255 /end CHARACTERISTIC
/begin CHARACTERISTIC CAL_SftyErrMaxCnt "" VALUE 0xfe820377 /* @ECU_Address@CAL_SftyErrMaxCnt@ */ Record_UBYTE 0 autosar_swc_fusamon_CM_uint8 0 255 /end CHARACTERISTIC
/begin CHARACTERISTIC CAL_StdStilDtrm "" VALUE 0xfe8202ec /* @ECU_Address@CAL_StdStilDtrm@ */ Record_FLOAT32_IEEE 0 autosar_swc_fusamon_CM_single -3.4E+38 3.4E+38 /end CHARACTERISTIC
/begin CHARACTERISTIC CAL_TTCChkVehSpdAxisY_Byc "" CURVE 0xfe820398 /* @ECU_Address@CAL_TTCChkVehSpdAxisY_Byc@ */ Record_FLOAT32_IEEE 0 autosar_swc_fusamon_CM_single -3.4E+38 3.4E+38
 /begin AXIS_DESCR COM_AXIS NO_INPUT_QUANTITY autosar_swc_fusamon_CM_single 8 -3.4E+38 3.4E+38 AXIS_PTS_REF CAL_TTCChkVehSpdAxisX /end AXIS_DESCR
/end CHARACTERISTIC
/begin CHARACTERISTIC CAL_TTCChkVehSpdAxisY_Car "" CURVE 0xfe8203b8 /* @ECU_Address@CAL_TTCChkVehSpdAxisY_Car@ */ Record_FLOAT32_IEEE 0 autosar_swc_fusamon_CM_single -3.4E+38 3.4E+38
 /begin AXIS_DESCR COM_AXIS NO_INPUT_QUANTITY autosar_swc_fusamon_CM_single 8 -3.4E+38 3.4E+38 AXIS_PTS_REF CAL_TTCChkVehSpdAxisX /end AXIS_DESCR
/end CHARACTERISTIC
/begin CHARACTERISTIC CAL_TTCChkVehSpdAxisY_Ped "" CURVE 0xfe8203d8 /* @ECU_Address@CAL_TTCChkVehSpdAxisY_Ped@ */ Record_FLOAT32_IEEE 0 autosar_swc_fusamon_CM_single -3.4E+38 3.4E+38
 /begin AXIS_DESCR COM_AXIS NO_INPUT_QUANTITY autosar_swc_fusamon_CM_single 8 -3.4E+38 3.4E+38 AXIS_PTS_REF CAL_TTCChkVehSpdAxisX /end AXIS_DESCR
/end CHARACTERISTIC
/begin CHARACTERISTIC CAL_TiCntHandsOffPlaus "" VALUE 0xfe820338 /* @ECU_Address@CAL_TiCntHandsOffPlaus@ */ Record_UWORD 0 autosar_swc_fusamon_CM_uint16 0 65535 /end CHARACTERISTIC
/begin CHARACTERISTIC CAL_TtcXPoint "" VAL_BLK 0xfe8203f8 /* @ECU_Address@CAL_TtcXPoint@ */ Record_FLOAT32_IEEE 0 autosar_swc_fusamon_CM_single -3.4E+38 3.4E+38 MATRIX_DIM 4 1 /end CHARACTERISTIC
/begin CHARACTERISTIC CAL_TtcYLookupVal "" VAL_BLK 0xfe820408 /* @ECU_Address@CAL_TtcYLookupVal@ */ Record_FLOAT32_IEEE 0 autosar_swc_fusamon_CM_single -3.4E+38 3.4E+38 MATRIX_DIM 4 1 /end CHARACTERISTIC
/begin CHARACTERISTIC CAL_YawRateRange "" VALUE 0xfe8202f0 /* @ECU_Address@CAL_YawRateRange@ */ Record_FLOAT32_IEEE 0 autosar_swc_fusamon_CM_single -3.4E+38 3.4E+38 /end CHARACTERISTIC
/begin CHARACTERISTIC P_Fusa_ErrInfoQue "" VAL_BLK 0xfe820510 /* @ECU_Address@P_Fusa_ErrInfoQue@ */ Record_ULONG 0 autosar_swc_fusamon_CM_uint32 0 4294967295 MATRIX_DIM 5 52 /end CHARACTERISTIC
/begin CHARACTERISTIC P_Fusa_SftyCmd "" VAL_BLK 0xfe820920 /* @ECU_Address@P_Fusa_SftyCmd@ */ Record_ULONG 0 autosar_swc_fusamon_CM_uint32 0 4294967295 MATRIX_DIM 5 52 /end CHARACTERISTIC
/begin CHARACTERISTIC P_Fusa_SftyCmdAEB "" VAL_BLK 0xfe820418 /* @ECU_Address@P_Fusa_SftyCmdAEB@ */ Record_BOOLEAN 0 autosar_swc_fusamon_CM_boolean 0 1 MATRIX_DIM 1 52 /end CHARACTERISTIC
/begin CHARACTERISTIC P_Fusa_SftyCmdLateral "" VAL_BLK 0xfe82044c /* @ECU_Address@P_Fusa_SftyCmdLateral@ */ Record_BOOLEAN 0 autosar_swc_fusamon_CM_boolean 0 1 MATRIX_DIM 1 52 /end CHARACTERISTIC
/begin CHARACTERISTIC P_Fusa_SftyCmdLongi "" VAL_BLK 0xfe820480 /* @ECU_Address@P_Fusa_SftyCmdLongi@ */ Record_BOOLEAN 0 autosar_swc_fusamon_CM_boolean 0 1 MATRIX_DIM 1 52 /end CHARACTERISTIC
/begin CHARACTERISTIC P_Fusa_SftyLvl "" VAL_BLK 0xfe820d30 /* @ECU_Address@P_Fusa_SftyLvl@ */ Record_UBYTE 0 autosar_swc_fusamon_CM_uint8 0 255 MATRIX_DIM 5 52 /end CHARACTERISTIC
/begin MEASUREMENT autosar_swc_fusamon_rtARID_DEF.ACCK1 "" UBYTE autosar_swc_fusamon_CM_uint8 0 0 0 255 LAYOUT COLUMN_DIR MATRIX_DIM 5 ECU_ADDRESS 0xfe4ace70 /* @ECU_Address@autosar_swc_fusamon_rtARID_DEF.ACCK1@ */ /end MEASUREMENT
/begin MEASUREMENT autosar_swc_fusamon_rtARID_DEF.Delay1_DSTATE "" FLOAT32_IEEE autosar_swc_fusamon_CM_single 0 0 -3.4E+38 3.4E+38 LAYOUT COLUMN_DIR MATRIX_DIM 4 ECU_ADDRESS 0xfe4ac718 /* @ECU_Address@autosar_swc_fusamon_rtARID_DEF.Delay1_DSTATE@ */ /end MEASUREMENT
/begin MEASUREMENT autosar_swc_fusamon_rtARID_DEF.Delay1_DSTATE_n "" FLOAT32_IEEE autosar_swc_fusamon_CM_single 0 0 -3.4E+38 3.4E+38 LAYOUT COLUMN_DIR MATRIX_DIM 4 ECU_ADDRESS 0xfe4ac760 /* @ECU_Address@autosar_swc_fusamon_rtARID_DEF.Delay1_DSTATE_n@ */ /end MEASUREMENT
/begin MEASUREMENT autosar_swc_fusamon_rtARID_DEF.Delay2_DSTATE "" FLOAT32_IEEE autosar_swc_fusamon_CM_single 0 0 -3.4E+38 3.4E+38 LAYOUT COLUMN_DIR MATRIX_DIM 4 ECU_ADDRESS 0xfe4ac770 /* @ECU_Address@autosar_swc_fusamon_rtARID_DEF.Delay2_DSTATE@ */ /end MEASUREMENT
/begin MEASUREMENT autosar_swc_fusamon_rtARID_DEF.Delay3_DSTATE "" FLOAT32_IEEE autosar_swc_fusamon_CM_single 0 0 -3.4E+38 3.4E+38 LAYOUT COLUMN_DIR MATRIX_DIM 4 ECU_ADDRESS 0xfe4ac780 /* @ECU_Address@autosar_swc_fusamon_rtARID_DEF.Delay3_DSTATE@ */ /end MEASUREMENT
/begin MEASUREMENT autosar_swc_fusamon_rtARID_DEF.Delay4_DSTATE "" FLOAT32_IEEE autosar_swc_fusamon_CM_single 0 0 -3.4E+38 3.4E+38 LAYOUT COLUMN_DIR MATRIX_DIM 4 ECU_ADDRESS 0xfe4ac790 /* @ECU_Address@autosar_swc_fusamon_rtARID_DEF.Delay4_DSTATE@ */ /end MEASUREMENT
/begin MEASUREMENT autosar_swc_fusamon_rtARID_DEF.Delay5_DSTATE "" ULONG autosar_swc_fusamon_CM_uint32 0 0 0 4294967295 LAYOUT COLUMN_DIR MATRIX_DIM 4 ECU_ADDRESS 0xfe4ac918 /* @ECU_Address@autosar_swc_fusamon_rtARID_DEF.Delay5_DSTATE@ */ /end MEASUREMENT
/begin MEASUREMENT autosar_swc_fusamon_rtARID_DEF.Delay_DSTATE "" FLOAT32_IEEE autosar_swc_fusamon_CM_single 0 0 -3.4E+38 3.4E+38 LAYOUT COLUMN_DIR MATRIX_DIM 10 ECU_ADDRESS 0xfe4ac728 /* @ECU_Address@autosar_swc_fusamon_rtARID_DEF.Delay_DSTATE@ */ /end MEASUREMENT
/begin MEASUREMENT autosar_swc_fusamon_rtARID_DEF.Delay_DSTATE_d "" FLOAT32_IEEE autosar_swc_fusamon_CM_single 0 0 -3.4E+38 3.4E+38 LAYOUT COLUMN_DIR MATRIX_DIM 4 ECU_ADDRESS 0xfe4ac7b0 /* @ECU_Address@autosar_swc_fusamon_rtARID_DEF.Delay_DSTATE_d@ */ /end MEASUREMENT
/begin MEASUREMENT autosar_swc_fusamon_rtARID_DEF.Delay_DSTATE_f "" FLOAT32_IEEE autosar_swc_fusamon_CM_single 0 0 -3.4E+38 3.4E+38 LAYOUT COLUMN_DIR MATRIX_DIM 4 ECU_ADDRESS 0xfe4ac750 /* @ECU_Address@autosar_swc_fusamon_rtARID_DEF.Delay_DSTATE_f@ */ /end MEASUREMENT
/begin MEASUREMENT autosar_swc_fusamon_rtARID_DEF.Delay_DSTATE_g "" FLOAT32_IEEE autosar_swc_fusamon_CM_single 0 0 -3.4E+38 3.4E+38 LAYOUT COLUMN_DIR MATRIX_DIM 4 ECU_ADDRESS 0xfe4ac7c0 /* @ECU_Address@autosar_swc_fusamon_rtARID_DEF.Delay_DSTATE_g@ */ /end MEASUREMENT
/begin MEASUREMENT autosar_swc_fusamon_rtARID_DEF.Delay_DSTATE_i "" FLOAT32_IEEE autosar_swc_fusamon_CM_single 0 0 -3.4E+38 3.4E+38 LAYOUT COLUMN_DIR MATRIX_DIM 4 ECU_ADDRESS 0xfe4ac7a0 /* @ECU_Address@autosar_swc_fusamon_rtARID_DEF.Delay_DSTATE_i@ */ /end MEASUREMENT
/begin MEASUREMENT autosar_swc_fusamon_rtARID_DEF.PosK1 "" FLOAT32_IEEE autosar_swc_fusamon_CM_single 0 0 -3.4E+38 3.4E+38 LAYOUT COLUMN_DIR MATRIX_DIM 18 ECU_ADDRESS 0xfe4ac7d0 /* @ECU_Address@autosar_swc_fusamon_rtARID_DEF.PosK1@ */ /end MEASUREMENT
/begin MEASUREMENT autosar_swc_fusamon_rtARID_DEF.SftyCmdOriginal "" ULONG autosar_swc_fusamon_CM_uint32 0 0 0 4294967295 ECU_ADDRESS 0xfe4ace38 /* @ECU_Address@autosar_swc_fusamon_rtARID_DEF.SftyCmdOriginal@ */ /end MEASUREMENT
/begin MEASUREMENT autosar_swc_fusamon_rtARID_DEF.SftyErrQue_Vector "" ULONG autosar_swc_fusamon_CM_uint32 0 0 0 4294967295 LAYOUT COLUMN_DIR MATRIX_DIM 1 32 ECU_ADDRESS 0xfe4ac818 /* @ECU_Address@autosar_swc_fusamon_rtARID_DEF.SftyErrQue_Vector@ */ /end MEASUREMENT
/begin MEASUREMENT autosar_swc_fusamon_rtARID_DEF.SftyErrQue_Vector_c "" ULONG autosar_swc_fusamon_CM_uint32 0 0 0 4294967295 LAYOUT COLUMN_DIR MATRIX_DIM 1 32 ECU_ADDRESS 0xfe4ac898 /* @ECU_Address@autosar_swc_fusamon_rtARID_DEF.SftyErrQue_Vector_c@ */ /end MEASUREMENT
/begin MEASUREMENT autosar_swc_fusamon_rtARID_DEF.SftyFlg_HandsOff "" UBYTE autosar_swc_fusamon_CM_logical 0 0 0 1 ECU_ADDRESS 0xfe4aceb2 /* @ECU_Address@autosar_swc_fusamon_rtARID_DEF.SftyFlg_HandsOff@ */ /end MEASUREMENT
/begin MEASUREMENT autosar_swc_fusamon_rtARID_DEF.SftyFlg_SysFuSa_Err "" UBYTE autosar_swc_fusamon_CM_logical 0 0 0 1 ECU_ADDRESS 0xfe4aceb0 /* @ECU_Address@autosar_swc_fusamon_rtARID_DEF.SftyFlg_SysFuSa_Err@ */ /end MEASUREMENT
/begin MEASUREMENT autosar_swc_fusamon_rtARID_DEF.UnitDelay1_DSTATE "" ULONG autosar_swc_fusamon_CM_uint32 0 0 0 4294967295 LAYOUT COLUMN_DIR MATRIX_DIM 32 ECU_ADDRESS 0xfe4ac9a8 /* @ECU_Address@autosar_swc_fusamon_rtARID_DEF.UnitDelay1_DSTATE@ */ /end MEASUREMENT
/begin MEASUREMENT autosar_swc_fusamon_rtARID_DEF.UnitDelay_DSTATE "" ULONG autosar_swc_fusamon_CM_uint32 0 0 0 4294967295 LAYOUT COLUMN_DIR MATRIX_DIM 32 ECU_ADDRESS 0xfe4ac928 /* @ECU_Address@autosar_swc_fusamon_rtARID_DEF.UnitDelay_DSTATE@ */ /end MEASUREMENT
/begin MEASUREMENT autosar_swc_fusamon_rtARID_DEF.UnitDelay_DSTATE_aq "" UBYTE autosar_swc_fusamon_CM_uint8 0 0 0 255 ECU_ADDRESS 0xfe4ace7c /* @ECU_Address@autosar_swc_fusamon_rtARID_DEF.UnitDelay_DSTATE_aq@ */ /end MEASUREMENT
/begin MEASUREMENT autosar_swc_fusamon_rtARID_DEF.UnitDelay_DSTATE_b "" ULONG autosar_swc_fusamon_CM_uint32 0 0 0 4294967295 ECU_ADDRESS 0xfe4ace3c /* @ECU_Address@autosar_swc_fusamon_rtARID_DEF.UnitDelay_DSTATE_b@ */ /end MEASUREMENT
/begin MEASUREMENT autosar_swc_fusamon_rtARID_DEF.UnitDelay_DSTATE_bg "" UBYTE autosar_swc_fusamon_CM_uint8 0 0 0 255 ECU_ADDRESS 0xfe4ace9e /* @ECU_Address@autosar_swc_fusamon_rtARID_DEF.UnitDelay_DSTATE_bg@ */ /end MEASUREMENT
/begin MEASUREMENT autosar_swc_fusamon_rtARID_DEF.UnitDelay_DSTATE_bk "" UBYTE autosar_swc_fusamon_CM_uint8 0 0 0 255 ECU_ADDRESS 0xfe4ace9f /* @ECU_Address@autosar_swc_fusamon_rtARID_DEF.UnitDelay_DSTATE_bk@ */ /end MEASUREMENT
/begin MEASUREMENT autosar_swc_fusamon_rtARID_DEF.UnitDelay_DSTATE_bl "" UBYTE autosar_swc_fusamon_CM_uint8 0 0 0 255 ECU_ADDRESS 0xfe4ace7d /* @ECU_Address@autosar_swc_fusamon_rtARID_DEF.UnitDelay_DSTATE_bl@ */ /end MEASUREMENT
/begin MEASUREMENT autosar_swc_fusamon_rtARID_DEF.UnitDelay_DSTATE_bo "" UBYTE autosar_swc_fusamon_CM_uint8 0 0 0 255 ECU_ADDRESS 0xfe4ace7f /* @ECU_Address@autosar_swc_fusamon_rtARID_DEF.UnitDelay_DSTATE_bo@ */ /end MEASUREMENT
/begin MEASUREMENT autosar_swc_fusamon_rtARID_DEF.UnitDelay_DSTATE_bp "" UBYTE autosar_swc_fusamon_CM_uint8 0 0 0 255 ECU_ADDRESS 0xfe4ace85 /* @ECU_Address@autosar_swc_fusamon_rtARID_DEF.UnitDelay_DSTATE_bp@ */ /end MEASUREMENT
/begin MEASUREMENT autosar_swc_fusamon_rtARID_DEF.UnitDelay_DSTATE_bq "" UBYTE autosar_swc_fusamon_CM_uint8 0 0 0 255 ECU_ADDRESS 0xfe4ace92 /* @ECU_Address@autosar_swc_fusamon_rtARID_DEF.UnitDelay_DSTATE_bq@ */ /end MEASUREMENT
/begin MEASUREMENT autosar_swc_fusamon_rtARID_DEF.UnitDelay_DSTATE_br "" UBYTE autosar_swc_fusamon_CM_uint8 0 0 0 255 ECU_ADDRESS 0xfe4ace87 /* @ECU_Address@autosar_swc_fusamon_rtARID_DEF.UnitDelay_DSTATE_br@ */ /end MEASUREMENT
/begin MEASUREMENT autosar_swc_fusamon_rtARID_DEF.UnitDelay_DSTATE_bs "" UBYTE autosar_swc_fusamon_CM_uint8 0 0 0 255 ECU_ADDRESS 0xfe4ace7a /* @ECU_Address@autosar_swc_fusamon_rtARID_DEF.UnitDelay_DSTATE_bs@ */ /end MEASUREMENT
/begin MEASUREMENT autosar_swc_fusamon_rtARID_DEF.UnitDelay_DSTATE_c0 "" UBYTE autosar_swc_fusamon_CM_uint8 0 0 0 255 ECU_ADDRESS 0xfe4ace8c /* @ECU_Address@autosar_swc_fusamon_rtARID_DEF.UnitDelay_DSTATE_c0@ */ /end MEASUREMENT
/begin MEASUREMENT autosar_swc_fusamon_rtARID_DEF.UnitDelay_DSTATE_c3 "" UBYTE autosar_swc_fusamon_CM_uint8 0 0 0 255 ECU_ADDRESS 0xfe4ace8e /* @ECU_Address@autosar_swc_fusamon_rtARID_DEF.UnitDelay_DSTATE_c3@ */ /end MEASUREMENT
/begin MEASUREMENT autosar_swc_fusamon_rtARID_DEF.UnitDelay_DSTATE_cm "" UWORD autosar_swc_fusamon_CM_uint16 0 0 0 65535 ECU_ADDRESS 0xfe4ace66 /* @ECU_Address@autosar_swc_fusamon_rtARID_DEF.UnitDelay_DSTATE_cm@ */ /end MEASUREMENT
/begin MEASUREMENT autosar_swc_fusamon_rtARID_DEF.UnitDelay_DSTATE_cn "" UWORD autosar_swc_fusamon_CM_uint16 0 0 0 65535 ECU_ADDRESS 0xfe4ace5c /* @ECU_Address@autosar_swc_fusamon_rtARID_DEF.UnitDelay_DSTATE_cn@ */ /end MEASUREMENT
/begin MEASUREMENT autosar_swc_fusamon_rtARID_DEF.UnitDelay_DSTATE_cz "" UBYTE autosar_swc_fusamon_CM_uint8 0 0 0 255 ECU_ADDRESS 0xfe4ace84 /* @ECU_Address@autosar_swc_fusamon_rtARID_DEF.UnitDelay_DSTATE_cz@ */ /end MEASUREMENT
/begin MEASUREMENT autosar_swc_fusamon_rtARID_DEF.UnitDelay_DSTATE_dd "" UBYTE autosar_swc_fusamon_CM_uint8 0 0 0 255 ECU_ADDRESS 0xfe4ace86 /* @ECU_Address@autosar_swc_fusamon_rtARID_DEF.UnitDelay_DSTATE_dd@ */ /end MEASUREMENT
/begin MEASUREMENT autosar_swc_fusamon_rtARID_DEF.UnitDelay_DSTATE_dd1 "" UBYTE autosar_swc_fusamon_CM_uint8 0 0 0 255 ECU_ADDRESS 0xfe4ace97 /* @ECU_Address@autosar_swc_fusamon_rtARID_DEF.UnitDelay_DSTATE_dd1@ */ /end MEASUREMENT
/begin MEASUREMENT autosar_swc_fusamon_rtARID_DEF.UnitDelay_DSTATE_dh "" UBYTE autosar_swc_fusamon_CM_uint8 0 0 0 255 ECU_ADDRESS 0xfe4ace98 /* @ECU_Address@autosar_swc_fusamon_rtARID_DEF.UnitDelay_DSTATE_dh@ */ /end MEASUREMENT
/begin MEASUREMENT autosar_swc_fusamon_rtARID_DEF.UnitDelay_DSTATE_dp "" UBYTE autosar_swc_fusamon_CM_uint8 0 0 0 255 ECU_ADDRESS 0xfe4acea4 /* @ECU_Address@autosar_swc_fusamon_rtARID_DEF.UnitDelay_DSTATE_dp@ */ /end MEASUREMENT
/begin MEASUREMENT autosar_swc_fusamon_rtARID_DEF.UnitDelay_DSTATE_dz "" UBYTE autosar_swc_fusamon_CM_uint8 0 0 0 255 ECU_ADDRESS 0xfe4ace7e /* @ECU_Address@autosar_swc_fusamon_rtARID_DEF.UnitDelay_DSTATE_dz@ */ /end MEASUREMENT
/begin MEASUREMENT autosar_swc_fusamon_rtARID_DEF.UnitDelay_DSTATE_e "" UWORD autosar_swc_fusamon_CM_uint16 0 0 0 65535 ECU_ADDRESS 0xfe4ace54 /* @ECU_Address@autosar_swc_fusamon_rtARID_DEF.UnitDelay_DSTATE_e@ */ /end MEASUREMENT
/begin MEASUREMENT autosar_swc_fusamon_rtARID_DEF.UnitDelay_DSTATE_ec "" UBYTE autosar_swc_fusamon_CM_uint8 0 0 0 255 ECU_ADDRESS 0xfe4ace89 /* @ECU_Address@autosar_swc_fusamon_rtARID_DEF.UnitDelay_DSTATE_ec@ */ /end MEASUREMENT
/begin MEASUREMENT autosar_swc_fusamon_rtARID_DEF.UnitDelay_DSTATE_f "" UWORD autosar_swc_fusamon_CM_uint16 0 0 0 65535 ECU_ADDRESS 0xfe4ace52 /* @ECU_Address@autosar_swc_fusamon_rtARID_DEF.UnitDelay_DSTATE_f@ */ /end MEASUREMENT
/begin MEASUREMENT autosar_swc_fusamon_rtARID_DEF.UnitDelay_DSTATE_f3 "" UBYTE autosar_swc_fusamon_CM_uint8 0 0 0 255 ECU_ADDRESS 0xfe4ace78 /* @ECU_Address@autosar_swc_fusamon_rtARID_DEF.UnitDelay_DSTATE_f3@ */ /end MEASUREMENT
/begin MEASUREMENT autosar_swc_fusamon_rtARID_DEF.UnitDelay_DSTATE_fd "" UBYTE autosar_swc_fusamon_CM_uint8 0 0 0 255 ECU_ADDRESS 0xfe4ace9d /* @ECU_Address@autosar_swc_fusamon_rtARID_DEF.UnitDelay_DSTATE_fd@ */ /end MEASUREMENT
/begin MEASUREMENT autosar_swc_fusamon_rtARID_DEF.UnitDelay_DSTATE_fg "" UBYTE autosar_swc_fusamon_CM_uint8 0 0 0 255 ECU_ADDRESS 0xfe4ace7b /* @ECU_Address@autosar_swc_fusamon_rtARID_DEF.UnitDelay_DSTATE_fg@ */ /end MEASUREMENT
/begin MEASUREMENT autosar_swc_fusamon_rtARID_DEF.UnitDelay_DSTATE_fh "" UBYTE autosar_swc_fusamon_CM_uint8 0 0 0 255 ECU_ADDRESS 0xfe4ace90 /* @ECU_Address@autosar_swc_fusamon_rtARID_DEF.UnitDelay_DSTATE_fh@ */ /end MEASUREMENT
/begin MEASUREMENT autosar_swc_fusamon_rtARID_DEF.UnitDelay_DSTATE_fi "" UWORD autosar_swc_fusamon_CM_uint16 0 0 0 65535 ECU_ADDRESS 0xfe4ace56 /* @ECU_Address@autosar_swc_fusamon_rtARID_DEF.UnitDelay_DSTATE_fi@ */ /end MEASUREMENT
/begin MEASUREMENT autosar_swc_fusamon_rtARID_DEF.UnitDelay_DSTATE_fq "" UBYTE autosar_swc_fusamon_CM_uint8 0 0 0 255 ECU_ADDRESS 0xfe4ace99 /* @ECU_Address@autosar_swc_fusamon_rtARID_DEF.UnitDelay_DSTATE_fq@ */ /end MEASUREMENT
/begin MEASUREMENT autosar_swc_fusamon_rtARID_DEF.UnitDelay_DSTATE_fv "" UBYTE autosar_swc_fusamon_CM_uint8 0 0 0 255 ECU_ADDRESS 0xfe4ace79 /* @ECU_Address@autosar_swc_fusamon_rtARID_DEF.UnitDelay_DSTATE_fv@ */ /end MEASUREMENT
/begin MEASUREMENT autosar_swc_fusamon_rtARID_DEF.UnitDelay_DSTATE_fvp "" UBYTE autosar_swc_fusamon_CM_uint8 0 0 0 255 ECU_ADDRESS 0xfe4acea6 /* @ECU_Address@autosar_swc_fusamon_rtARID_DEF.UnitDelay_DSTATE_fvp@ */ /end MEASUREMENT
/begin MEASUREMENT autosar_swc_fusamon_rtARID_DEF.UnitDelay_DSTATE_h "" UWORD autosar_swc_fusamon_CM_uint16 0 0 0 65535 ECU_ADDRESS 0xfe4ace4e /* @ECU_Address@autosar_swc_fusamon_rtARID_DEF.UnitDelay_DSTATE_h@ */ /end MEASUREMENT
/begin MEASUREMENT autosar_swc_fusamon_rtARID_DEF.UnitDelay_DSTATE_hh "" UWORD autosar_swc_fusamon_CM_uint16 0 0 0 65535 ECU_ADDRESS 0xfe4ace64 /* @ECU_Address@autosar_swc_fusamon_rtARID_DEF.UnitDelay_DSTATE_hh@ */ /end MEASUREMENT
/begin MEASUREMENT autosar_swc_fusamon_rtARID_DEF.UnitDelay_DSTATE_i "" UBYTE autosar_swc_fusamon_CM_uint8 0 0 0 255 ECU_ADDRESS 0xfe4ace77 /* @ECU_Address@autosar_swc_fusamon_rtARID_DEF.UnitDelay_DSTATE_i@ */ /end MEASUREMENT
/begin MEASUREMENT autosar_swc_fusamon_rtARID_DEF.UnitDelay_DSTATE_ib "" UBYTE autosar_swc_fusamon_CM_uint8 0 0 0 255 ECU_ADDRESS 0xfe4ace88 /* @ECU_Address@autosar_swc_fusamon_rtARID_DEF.UnitDelay_DSTATE_ib@ */ /end MEASUREMENT
/begin MEASUREMENT autosar_swc_fusamon_rtARID_DEF.UnitDelay_DSTATE_im "" UBYTE autosar_swc_fusamon_CM_uint8 0 0 0 255 ECU_ADDRESS 0xfe4ace91 /* @ECU_Address@autosar_swc_fusamon_rtARID_DEF.UnitDelay_DSTATE_im@ */ /end MEASUREMENT
/begin MEASUREMENT autosar_swc_fusamon_rtARID_DEF.UnitDelay_DSTATE_iy "" UBYTE autosar_swc_fusamon_CM_uint8 0 0 0 255 ECU_ADDRESS 0xfe4ace8a /* @ECU_Address@autosar_swc_fusamon_rtARID_DEF.UnitDelay_DSTATE_iy@ */ /end MEASUREMENT
/begin MEASUREMENT autosar_swc_fusamon_rtARID_DEF.UnitDelay_DSTATE_j "" UWORD autosar_swc_fusamon_CM_uint16 0 0 0 65535 ECU_ADDRESS 0xfe4ace60 /* @ECU_Address@autosar_swc_fusamon_rtARID_DEF.UnitDelay_DSTATE_j@ */ /end MEASUREMENT
/begin MEASUREMENT autosar_swc_fusamon_rtARID_DEF.UnitDelay_DSTATE_jb "" UBYTE autosar_swc_fusamon_CM_uint8 0 0 0 255 ECU_ADDRESS 0xfe4ace76 /* @ECU_Address@autosar_swc_fusamon_rtARID_DEF.UnitDelay_DSTATE_jb@ */ /end MEASUREMENT
/begin MEASUREMENT autosar_swc_fusamon_rtARID_DEF.UnitDelay_DSTATE_je "" UBYTE autosar_swc_fusamon_CM_uint8 0 0 0 255 ECU_ADDRESS 0xfe4acea0 /* @ECU_Address@autosar_swc_fusamon_rtARID_DEF.UnitDelay_DSTATE_je@ */ /end MEASUREMENT
/begin MEASUREMENT autosar_swc_fusamon_rtARID_DEF.UnitDelay_DSTATE_ko "" UBYTE autosar_swc_fusamon_CM_uint8 0 0 0 255 ECU_ADDRESS 0xfe4ace9b /* @ECU_Address@autosar_swc_fusamon_rtARID_DEF.UnitDelay_DSTATE_ko@ */ /end MEASUREMENT
/begin MEASUREMENT autosar_swc_fusamon_rtARID_DEF.UnitDelay_DSTATE_ks "" UBYTE autosar_swc_fusamon_CM_uint8 0 0 0 255 ECU_ADDRESS 0xfe4acea1 /* @ECU_Address@autosar_swc_fusamon_rtARID_DEF.UnitDelay_DSTATE_ks@ */ /end MEASUREMENT
/begin MEASUREMENT autosar_swc_fusamon_rtARID_DEF.UnitDelay_DSTATE_l "" UWORD autosar_swc_fusamon_CM_uint16 0 0 0 65535 ECU_ADDRESS 0xfe4ace50 /* @ECU_Address@autosar_swc_fusamon_rtARID_DEF.UnitDelay_DSTATE_l@ */ /end MEASUREMENT
/begin MEASUREMENT autosar_swc_fusamon_rtARID_DEF.UnitDelay_DSTATE_l4 "" UBYTE autosar_swc_fusamon_CM_uint8 0 0 0 255 ECU_ADDRESS 0xfe4acea5 /* @ECU_Address@autosar_swc_fusamon_rtARID_DEF.UnitDelay_DSTATE_l4@ */ /end MEASUREMENT
/begin MEASUREMENT autosar_swc_fusamon_rtARID_DEF.UnitDelay_DSTATE_ll "" UBYTE autosar_swc_fusamon_CM_uint8 0 0 0 255 ECU_ADDRESS 0xfe4ace80 /* @ECU_Address@autosar_swc_fusamon_rtARID_DEF.UnitDelay_DSTATE_ll@ */ /end MEASUREMENT
/begin MEASUREMENT autosar_swc_fusamon_rtARID_DEF.UnitDelay_DSTATE_lr "" UBYTE autosar_swc_fusamon_CM_uint8 0 0 0 255 ECU_ADDRESS 0xfe4ace94 /* @ECU_Address@autosar_swc_fusamon_rtARID_DEF.UnitDelay_DSTATE_lr@ */ /end MEASUREMENT
/begin MEASUREMENT autosar_swc_fusamon_rtARID_DEF.UnitDelay_DSTATE_ls "" UBYTE autosar_swc_fusamon_CM_uint8 0 0 0 255 ECU_ADDRESS 0xfe4ace96 /* @ECU_Address@autosar_swc_fusamon_rtARID_DEF.UnitDelay_DSTATE_ls@ */ /end MEASUREMENT
/begin MEASUREMENT autosar_swc_fusamon_rtARID_DEF.UnitDelay_DSTATE_lt "" UWORD autosar_swc_fusamon_CM_uint16 0 0 0 65535 ECU_ADDRESS 0xfe4ace5e /* @ECU_Address@autosar_swc_fusamon_rtARID_DEF.UnitDelay_DSTATE_lt@ */ /end MEASUREMENT
/begin MEASUREMENT autosar_swc_fusamon_rtARID_DEF.UnitDelay_DSTATE_m "" UWORD autosar_swc_fusamon_CM_uint16 0 0 0 65535 ECU_ADDRESS 0xfe4ace5a /* @ECU_Address@autosar_swc_fusamon_rtARID_DEF.UnitDelay_DSTATE_m@ */ /end MEASUREMENT
/begin MEASUREMENT autosar_swc_fusamon_rtARID_DEF.UnitDelay_DSTATE_m2 "" UBYTE autosar_swc_fusamon_CM_uint8 0 0 0 255 ECU_ADDRESS 0xfe4ace9a /* @ECU_Address@autosar_swc_fusamon_rtARID_DEF.UnitDelay_DSTATE_m2@ */ /end MEASUREMENT
/begin MEASUREMENT autosar_swc_fusamon_rtARID_DEF.UnitDelay_DSTATE_n "" UBYTE autosar_swc_fusamon_CM_uint8 0 0 0 255 ECU_ADDRESS 0xfe4ace8f /* @ECU_Address@autosar_swc_fusamon_rtARID_DEF.UnitDelay_DSTATE_n@ */ /end MEASUREMENT
/begin MEASUREMENT autosar_swc_fusamon_rtARID_DEF.UnitDelay_DSTATE_o0 "" UWORD autosar_swc_fusamon_CM_uint16 0 0 0 65535 ECU_ADDRESS 0xfe4ace58 /* @ECU_Address@autosar_swc_fusamon_rtARID_DEF.UnitDelay_DSTATE_o0@ */ /end MEASUREMENT
/begin MEASUREMENT autosar_swc_fusamon_rtARID_DEF.UnitDelay_DSTATE_o0n "" UBYTE autosar_swc_fusamon_CM_uint8 0 0 0 255 ECU_ADDRESS 0xfe4ace8d /* @ECU_Address@autosar_swc_fusamon_rtARID_DEF.UnitDelay_DSTATE_o0n@ */ /end MEASUREMENT
/begin MEASUREMENT autosar_swc_fusamon_rtARID_DEF.UnitDelay_DSTATE_o0v "" UBYTE autosar_swc_fusamon_CM_uint8 0 0 0 255 ECU_ADDRESS 0xfe4ace93 /* @ECU_Address@autosar_swc_fusamon_rtARID_DEF.UnitDelay_DSTATE_o0v@ */ /end MEASUREMENT
/begin MEASUREMENT autosar_swc_fusamon_rtARID_DEF.UnitDelay_DSTATE_o5 "" UBYTE autosar_swc_fusamon_CM_uint8 0 0 0 255 ECU_ADDRESS 0xfe4acea3 /* @ECU_Address@autosar_swc_fusamon_rtARID_DEF.UnitDelay_DSTATE_o5@ */ /end MEASUREMENT
/begin MEASUREMENT autosar_swc_fusamon_rtARID_DEF.UnitDelay_DSTATE_ob "" UBYTE autosar_swc_fusamon_CM_uint8 0 0 0 255 ECU_ADDRESS 0xfe4ace95 /* @ECU_Address@autosar_swc_fusamon_rtARID_DEF.UnitDelay_DSTATE_ob@ */ /end MEASUREMENT
/begin MEASUREMENT autosar_swc_fusamon_rtARID_DEF.UnitDelay_DSTATE_oj "" UBYTE autosar_swc_fusamon_CM_uint8 0 0 0 255 ECU_ADDRESS 0xfe4ace82 /* @ECU_Address@autosar_swc_fusamon_rtARID_DEF.UnitDelay_DSTATE_oj@ */ /end MEASUREMENT
/begin MEASUREMENT autosar_swc_fusamon_rtARID_DEF.UnitDelay_DSTATE_om "" UBYTE autosar_swc_fusamon_CM_uint8 0 0 0 255 ECU_ADDRESS 0xfe4acea2 /* @ECU_Address@autosar_swc_fusamon_rtARID_DEF.UnitDelay_DSTATE_om@ */ /end MEASUREMENT
/begin MEASUREMENT autosar_swc_fusamon_rtARID_DEF.UnitDelay_DSTATE_on "" UBYTE autosar_swc_fusamon_CM_uint8 0 0 0 255 ECU_ADDRESS 0xfe4ace81 /* @ECU_Address@autosar_swc_fusamon_rtARID_DEF.UnitDelay_DSTATE_on@ */ /end MEASUREMENT
/begin MEASUREMENT autosar_swc_fusamon_rtARID_DEF.UnitDelay_DSTATE_p "" UWORD autosar_swc_fusamon_CM_uint16 0 0 0 65535 ECU_ADDRESS 0xfe4ace62 /* @ECU_Address@autosar_swc_fusamon_rtARID_DEF.UnitDelay_DSTATE_p@ */ /end MEASUREMENT
/begin MEASUREMENT autosar_swc_fusamon_rtARID_DEF.UnitDelay_DSTATE_p1 "" UBYTE autosar_swc_fusamon_CM_uint8 0 0 0 255 ECU_ADDRESS 0xfe4ace8b /* @ECU_Address@autosar_swc_fusamon_rtARID_DEF.UnitDelay_DSTATE_p1@ */ /end MEASUREMENT
/begin MEASUREMENT autosar_swc_fusamon_rtARID_DEF.UnitDelay_DSTATE_po "" UBYTE autosar_swc_fusamon_CM_uint8 0 0 0 255 ECU_ADDRESS 0xfe4ace9c /* @ECU_Address@autosar_swc_fusamon_rtARID_DEF.UnitDelay_DSTATE_po@ */ /end MEASUREMENT
/begin MEASUREMENT autosar_swc_fusamon_rtARID_DEF.UnitDelay_DSTATE_pz "" UBYTE autosar_swc_fusamon_CM_uint8 0 0 0 255 ECU_ADDRESS 0xfe4ace83 /* @ECU_Address@autosar_swc_fusamon_rtARID_DEF.UnitDelay_DSTATE_pz@ */ /end MEASUREMENT
/begin MEASUREMENT autosar_swc_fusamon_rtARID_DEF.WindowCounter "" UWORD autosar_swc_fusamon_CM_uint16 0 0 0 65535 ECU_ADDRESS 0xfe4ace6e /* @ECU_Address@autosar_swc_fusamon_rtARID_DEF.WindowCounter@ */ /end MEASUREMENT
/begin MEASUREMENT autosar_swc_fusamon_rtARID_DEF.cnt "" UWORD autosar_swc_fusamon_CM_uint16 0 0 0 65535 ECU_ADDRESS 0xfe4ace68 /* @ECU_Address@autosar_swc_fusamon_rtARID_DEF.cnt@ */ /end MEASUREMENT
/begin MEASUREMENT autosar_swc_fusamon_rtARID_DEF.cnt_j "" UWORD autosar_swc_fusamon_CM_uint16 0 0 0 65535 ECU_ADDRESS 0xfe4ace6c /* @ECU_Address@autosar_swc_fusamon_rtARID_DEF.cnt_j@ */ /end MEASUREMENT
/begin MEASUREMENT autosar_swc_fusamon_rtARID_DEF.cnt_n "" UWORD autosar_swc_fusamon_CM_uint16 0 0 0 65535 ECU_ADDRESS 0xfe4ace6a /* @ECU_Address@autosar_swc_fusamon_rtARID_DEF.cnt_n@ */ /end MEASUREMENT
/begin MEASUREMENT autosar_swc_fusamon_rtARID_DEF.is_ON "" UBYTE autosar_swc_fusamon_CM_uint8 0 0 0 255 ECU_ADDRESS 0xfe4aceac /* @ECU_Address@autosar_swc_fusamon_rtARID_DEF.is_ON@ */ /end MEASUREMENT
/begin MEASUREMENT autosar_swc_fusamon_rtARID_DEF.is_Warn "" UBYTE autosar_swc_fusamon_CM_uint8 0 0 0 255 ECU_ADDRESS 0xfe4aceaf /* @ECU_Address@autosar_swc_fusamon_rtARID_DEF.is_Warn@ */ /end MEASUREMENT
/begin MEASUREMENT autosar_swc_fusamon_rtARID_DEF.is_active_c16_autosar_swc_fusamon "" UBYTE autosar_swc_fusamon_CM_uint8 0 0 0 255 ECU_ADDRESS 0xfe4acead /* @ECU_Address@autosar_swc_fusamon_rtARID_DEF.is_active_c16_autosar_swc_fusamon@ */ /end MEASUREMENT
/begin MEASUREMENT autosar_swc_fusamon_rtARID_DEF.is_active_c2_autosar_swc_fusamon "" UBYTE autosar_swc_fusamon_CM_uint8 0 0 0 255 ECU_ADDRESS 0xfe4acea7 /* @ECU_Address@autosar_swc_fusamon_rtARID_DEF.is_active_c2_autosar_swc_fusamon@ */ /end MEASUREMENT
/begin MEASUREMENT autosar_swc_fusamon_rtARID_DEF.is_active_c9_autosar_swc_fusamon "" UBYTE autosar_swc_fusamon_CM_uint8 0 0 0 255 ECU_ADDRESS 0xfe4aceaa /* @ECU_Address@autosar_swc_fusamon_rtARID_DEF.is_active_c9_autosar_swc_fusamon@ */ /end MEASUREMENT
/begin MEASUREMENT autosar_swc_fusamon_rtARID_DEF.is_c16_autosar_swc_fusamon "" UBYTE autosar_swc_fusamon_CM_uint8 0 0 0 255 ECU_ADDRESS 0xfe4aceae /* @ECU_Address@autosar_swc_fusamon_rtARID_DEF.is_c16_autosar_swc_fusamon@ */ /end MEASUREMENT
/begin MEASUREMENT autosar_swc_fusamon_rtARID_DEF.is_c2_autosar_swc_fusamon "" UBYTE autosar_swc_fusamon_CM_uint8 0 0 0 255 ECU_ADDRESS 0xfe4acea8 /* @ECU_Address@autosar_swc_fusamon_rtARID_DEF.is_c2_autosar_swc_fusamon@ */ /end MEASUREMENT
/begin MEASUREMENT autosar_swc_fusamon_rtARID_DEF.is_c9_autosar_swc_fusamon "" UBYTE autosar_swc_fusamon_CM_uint8 0 0 0 255 ECU_ADDRESS 0xfe4aceab /* @ECU_Address@autosar_swc_fusamon_rtARID_DEF.is_c9_autosar_swc_fusamon@ */ /end MEASUREMENT
/begin MEASUREMENT autosar_swc_fusamon_rtARID_DEF.memCmd "" ULONG autosar_swc_fusamon_CM_uint32 0 0 0 4294967295 ECU_ADDRESS 0xfe4ace40 /* @ECU_Address@autosar_swc_fusamon_rtARID_DEF.memCmd@ */ /end MEASUREMENT
/begin MEASUREMENT autosar_swc_fusamon_rtARID_DEF.t "" UBYTE autosar_swc_fusamon_CM_uint8 0 0 0 255 ECU_ADDRESS 0xfe4acea9 /* @ECU_Address@autosar_swc_fusamon_rtARID_DEF.t@ */ /end MEASUREMENT
/begin MEASUREMENT autosar_swc_fusamon_rtARID_DEF.x "" UBYTE autosar_swc_fusamon_CM_logical 0 0 0 1 ECU_ADDRESS 0xfe4aceb3 /* @ECU_Address@autosar_swc_fusamon_rtARID_DEF.x@ */ /end MEASUREMENT
/begin AXIS_PTS CAL_TTCChkVehSpdAxisX "" 0xfe820378 /* @ECU_Address@CAL_TTCChkVehSpdAxisX@ */ NO_INPUT_QUANTITY Axis_FLOAT32_IEEE 0 autosar_swc_fusamon_CM_single 8 -3.4E+38 3.4E+38 /end AXIS_PTS
/begin COMPU_METHOD autosar_swc_fusamon_CM_boolean "Q = V" IDENTICAL "%1.0" "" /end COMPU_METHOD
/begin COMPU_METHOD autosar_swc_fusamon_CM_logical "Q = V" IDENTICAL "%1.0" "" /end COMPU_METHOD
/begin COMPU_METHOD autosar_swc_fusamon_CM_single "Q = V" IDENTICAL "%8.6" "" /end COMPU_METHOD
/begin COMPU_METHOD autosar_swc_fusamon_CM_uint16 "Q = V" IDENTICAL "%5.0" "" /end COMPU_METHOD
/begin COMPU_METHOD autosar_swc_fusamon_CM_uint32 "Q = V" IDENTICAL "%10.0" "" /end COMPU_METHOD
/begin COMPU_METHOD autosar_swc_fusamon_CM_uint8 "Q = V" IDENTICAL "%3.0" "" /end COMPU_METHOD
/begin RECORD_LAYOUT Record_BOOLEAN FNC_VALUES 1 UBYTE COLUMN_DIR DIRECT /end RECORD_LAYOUT
/begin RECORD_LAYOUT Record_FLOAT32_IEEE FNC_VALUES 1 FLOAT32_IEEE COLUMN_DIR DIRECT /end RECORD_LAYOUT
/begin RECORD_LAYOUT Record_UBYTE FNC_VALUES 1 UBYTE COLUMN_DIR DIRECT /end RECORD_LAYOUT
/begin RECORD_LAYOUT Record_ULONG FNC_VALUES 1 ULONG COLUMN_DIR DIRECT /end RECORD_LAYOUT
/begin RECORD_LAYOUT Record_UWORD FNC_VALUES 1 UWORD COLUMN_DIR DIRECT /end RECORD_LAYOUT
/begin RECORD_LAYOUT Axis_FLOAT32_IEEE AXIS_PTS_X 1 FLOAT32_IEEE INDEX_INCR DIRECT /end RECORD_LAYOUT
/begin GROUP autosar_swc_fusamon_Subsystem_Reference_DrvEvInMon_SSR_FuSaMonitor_DrvEvlnMon_6 "autosar_swc_fusamon/Subsystem Reference/DrvEvInMon/SSR_FuSaMonitor_DrvEvlnMon_6"
 /begin REF_CHARACTERISTIC CAL_Deb_SftyFlg_HandsOff CAL_StdStilDtrm CAL_TiCntHandsOffPlaus /end REF_CHARACTERISTIC
 /begin REF_MEASUREMENT autosar_swc_fusamon_rtARID_DEF.SftyFlg_HandsOff autosar_swc_fusamon_rtARID_DEF.WindowCounter autosar_swc_fusamon_rtARID_DEF.cnt_j autosar_swc_fusamon_rtARID_DEF.is_Warn autosar_swc_fusamon_rtARID_DEF.is_active_c16_autosar_swc_fusamon autosar_swc_fusamon_rtARID_DEF.is_c16_autosar_swc_fusamon /end REF_MEASUREMENT
/end GROUP
/begin GROUP autosar_swc_fusamon_Subsystem_Reference_OutProcAdpt "autosar_swc_fusamon/Subsystem Reference/OutProcAdpt"
 /begin SUB_GROUP autosar_swc_fusamon_Subsystem_Reference_OutProcAdpt_AdsMode_Fusa_Detrm autosar_swc_fusamon_Subsystem_Reference_OutProcAdpt_FuSaStateM autosar_swc_fusamon_Subsystem_Reference_OutProcAdpt_getSftyCmd /end SUB_GROUP
/end GROUP
/begin GROUP autosar_swc_fusamon_Subsystem_Reference_OutProcAdpt_AdsMode_Fusa_Detrm "autosar_swc_fusamon/Subsystem Reference/OutProcAdpt/AdsMode_Fusa_Detrm"
 /begin SUB_GROUP autosar_swc_fusamon_Subsystem_Reference_OutProcAdpt_AdsMode_Fusa_Detrm_SSR_FuSaMonitor_OutProcAdpr_0 autosar_swc_fusamon_Subsystem_Reference_OutProcAdpt_AdsMode_Fusa_Detrm_SSR_FuSaMonitor_OutProcAdpr_1 autosar_swc_fusamon_Subsystem_Reference_OutProcAdpt_AdsMode_Fusa_Detrm_SSR_FuSaMonitor_OutProcAdpr_2 autosar_swc_fusamon_Subsystem_Reference_OutProcAdpt_AdsMode_Fusa_Detrm_SSR_FuSaMonitor_OutProcAdpr_3 autosar_swc_fusamon_Subsystem_Reference_OutProcAdpt_AdsMode_Fusa_Detrm_SSR_FuSaMonitor_OutProcAdpr_4 /end SUB_GROUP
/end GROUP
/begin GROUP autosar_swc_fusamon_Subsystem_Reference_OutProcAdpt_AdsMode_Fusa_Detrm_SSR_FuSaMonitor_OutProcAdpr_0 "autosar_swc_fusamon/Subsystem Reference/OutProcAdpt/AdsMode_Fusa_Detrm/SSR_FuSaMonitor_OutProcAdpr_0"
 /begin SUB_GROUP autosar_swc_fusamon_Subsystem_Reference_OutProcAdpt_AdsMode_Fusa_Detrm_SSR_FuSaMonitor_OutProcAdpr_0_Compare_To_Constant1 /end SUB_GROUP
/end GROUP
/begin GROUP autosar_swc_fusamon_Subsystem_Reference_OutProcAdpt_AdsMode_Fusa_Detrm_SSR_FuSaMonitor_OutProcAdpr_0_Compare_To_Constant1 "autosar_swc_fusamon/Subsystem Reference/OutProcAdpt/AdsMode_Fusa_Detrm/SSR_FuSaMonitor_OutProcAdpr_0/Compare\nTo Constant1" /begin REF_CHARACTERISTIC CAL_SafAdsActvSpd_ACC /end REF_CHARACTERISTIC /end GROUP
/begin GROUP autosar_swc_fusamon_Subsystem_Reference_OutProcAdpt_AdsMode_Fusa_Detrm_SSR_FuSaMonitor_OutProcAdpr_1 "autosar_swc_fusamon/Subsystem Reference/OutProcAdpt/AdsMode_Fusa_Detrm/SSR_FuSaMonitor_OutProcAdpr_1"
 /begin SUB_GROUP autosar_swc_fusamon_Subsystem_Reference_OutProcAdpt_AdsMode_Fusa_Detrm_SSR_FuSaMonitor_OutProcAdpr_1_Compare_To_Constant3 /end SUB_GROUP
/end GROUP
/begin GROUP autosar_swc_fusamon_Subsystem_Reference_OutProcAdpt_AdsMode_Fusa_Detrm_SSR_FuSaMonitor_OutProcAdpr_1_Compare_To_Constant3 "autosar_swc_fusamon/Subsystem Reference/OutProcAdpt/AdsMode_Fusa_Detrm/SSR_FuSaMonitor_OutProcAdpr_1/Compare\nTo Constant3" /begin REF_CHARACTERISTIC CAL_SafAdsActvSpd_LCC /end REF_CHARACTERISTIC /end GROUP
/begin GROUP autosar_swc_fusamon_Subsystem_Reference_OutProcAdpt_AdsMode_Fusa_Detrm_SSR_FuSaMonitor_OutProcAdpr_2 "autosar_swc_fusamon/Subsystem Reference/OutProcAdpt/AdsMode_Fusa_Detrm/SSR_FuSaMonitor_OutProcAdpr_2"
 /begin SUB_GROUP autosar_swc_fusamon_Subsystem_Reference_OutProcAdpt_AdsMode_Fusa_Detrm_SSR_FuSaMonitor_OutProcAdpr_2_Compare_To_Constant5 /end SUB_GROUP
/end GROUP
/begin GROUP autosar_swc_fusamon_Subsystem_Reference_OutProcAdpt_AdsMode_Fusa_Detrm_SSR_FuSaMonitor_OutProcAdpr_2_Compare_To_Constant5 "autosar_swc_fusamon/Subsystem Reference/OutProcAdpt/AdsMode_Fusa_Detrm/SSR_FuSaMonitor_OutProcAdpr_2/Compare\nTo Constant5" /begin REF_CHARACTERISTIC CAL_SafAdsActvSpd_LKA /end REF_CHARACTERISTIC /end GROUP
/begin GROUP autosar_swc_fusamon_Subsystem_Reference_OutProcAdpt_AdsMode_Fusa_Detrm_SSR_FuSaMonitor_OutProcAdpr_3 "autosar_swc_fusamon/Subsystem Reference/OutProcAdpt/AdsMode_Fusa_Detrm/SSR_FuSaMonitor_OutProcAdpr_3"
 /begin SUB_GROUP autosar_swc_fusamon_Subsystem_Reference_OutProcAdpt_AdsMode_Fusa_Detrm_SSR_FuSaMonitor_OutProcAdpr_3_Compare_To_Constant8 /end SUB_GROUP
/end GROUP
/begin GROUP autosar_swc_fusamon_Subsystem_Reference_OutProcAdpt_AdsMode_Fusa_Detrm_SSR_FuSaMonitor_OutProcAdpr_3_Compare_To_Constant8 "autosar_swc_fusamon/Subsystem Reference/OutProcAdpt/AdsMode_Fusa_Detrm/SSR_FuSaMonitor_OutProcAdpr_3/Compare\nTo Constant8" /begin REF_CHARACTERISTIC CAL_SafAdsActvSpd_ELK /end REF_CHARACTERISTIC /end GROUP
/begin GROUP autosar_swc_fusamon_Subsystem_Reference_OutProcAdpt_AdsMode_Fusa_Detrm_SSR_FuSaMonitor_OutProcAdpr_4 "autosar_swc_fusamon/Subsystem Reference/OutProcAdpt/AdsMode_Fusa_Detrm/SSR_FuSaMonitor_OutProcAdpr_4"
 /begin SUB_GROUP autosar_swc_fusamon_Subsystem_Reference_OutProcAdpt_AdsMode_Fusa_Detrm_SSR_FuSaMonitor_OutProcAdpr_4_Compare_To_Constant13 /end SUB_GROUP
/end GROUP
/begin GROUP autosar_swc_fusamon_Subsystem_Reference_OutProcAdpt_AdsMode_Fusa_Detrm_SSR_FuSaMonitor_OutProcAdpr_4_Compare_To_Constant13 "autosar_swc_fusamon/Subsystem Reference/OutProcAdpt/AdsMode_Fusa_Detrm/SSR_FuSaMonitor_OutProcAdpr_4/Compare\nTo Constant13" /begin REF_CHARACTERISTIC CAL_SafAdsActvSpd_AEB /end REF_CHARACTERISTIC /end GROUP
/begin GROUP autosar_swc_fusamon_Subsystem_Reference_OutProcAdpt_FuSaStateM "autosar_swc_fusamon/Subsystem Reference/OutProcAdpt/FuSaStateM"
 /begin SUB_GROUP autosar_swc_fusamon_Subsystem_Reference_OutProcAdpt_FuSaStateM_SSR_FuSaMonitor_OutProcAdpr_24 /end SUB_GROUP
 /begin REF_CHARACTERISTIC CAL_DlyTiMon CAL_SAFKEEP CAL_SAFMONEMG P_Fusa_SftyCmdAEB P_Fusa_SftyCmdLateral P_Fusa_SftyCmdLongi /end REF_CHARACTERISTIC
 /begin REF_MEASUREMENT autosar_swc_fusamon_rtARID_DEF.SftyCmdOriginal autosar_swc_fusamon_rtARID_DEF.UnitDelay_DSTATE_b autosar_swc_fusamon_rtARID_DEF.cnt_n autosar_swc_fusamon_rtARID_DEF.is_ON autosar_swc_fusamon_rtARID_DEF.is_active_c9_autosar_swc_fusamon autosar_swc_fusamon_rtARID_DEF.is_c9_autosar_swc_fusamon autosar_swc_fusamon_rtARID_DEF.memCmd /end REF_MEASUREMENT
/end GROUP
/begin GROUP autosar_swc_fusamon_Subsystem_Reference_OutProcAdpt_FuSaStateM_SSR_FuSaMonitor_OutProcAdpr_24 "autosar_swc_fusamon/Subsystem Reference/OutProcAdpt/FuSaStateM/SSR_FuSaMonitor_OutProcAdpr_24"
 /begin SUB_GROUP autosar_swc_fusamon_Subsystem_Reference_OutProcAdpt_FuSaStateM_SSR_FuSaMonitor_OutProcAdpr_24_Compare_To_Constant8 /end SUB_GROUP
/end GROUP
/begin GROUP autosar_swc_fusamon_Subsystem_Reference_OutProcAdpt_FuSaStateM_SSR_FuSaMonitor_OutProcAdpr_24_Compare_To_Constant8 "autosar_swc_fusamon/Subsystem Reference/OutProcAdpt/FuSaStateM/SSR_FuSaMonitor_OutProcAdpr_24/Compare\nTo Constant8" /begin REF_CHARACTERISTIC CAL_SftyErrMaxCnt /end REF_CHARACTERISTIC /end GROUP
/begin GROUP autosar_swc_fusamon_Subsystem_Reference_OutProcAdpt_getSftyCmd "autosar_swc_fusamon/Subsystem Reference/OutProcAdpt/getSftyCmd" /begin REF_CHARACTERISTIC P_Fusa_ErrInfoQue P_Fusa_SftyCmd P_Fusa_SftyLvl /end REF_CHARACTERISTIC
 /begin REF_MEASUREMENT autosar_swc_fusamon_rtARID_DEF.SftyErrQue_Vector autosar_swc_fusamon_rtARID_DEF.SftyErrQue_Vector_c autosar_swc_fusamon_rtARID_DEF.UnitDelay1_DSTATE autosar_swc_fusamon_rtARID_DEF.UnitDelay_DSTATE /end REF_MEASUREMENT
/end GROUP
/begin GROUP autosar_swc_fusamon_Subsystem_Reference_RelCptMon "autosar_swc_fusamon/Subsystem Reference/RelCptMon"
 /begin SUB_GROUP autosar_swc_fusamon_Subsystem_Reference_RelCptMon_SSR_FuSaMonitor_RelCptMon_0 autosar_swc_fusamon_Subsystem_Reference_RelCptMon_SSR_FuSaMonitor_RelCptMon_1 autosar_swc_fusamon_Subsystem_Reference_RelCptMon_SSR_FuSaMonitor_RelCptMon_10 autosar_swc_fusamon_Subsystem_Reference_RelCptMon_SSR_FuSaMonitor_RelCptMon_11 autosar_swc_fusamon_Subsystem_Reference_RelCptMon_SSR_FuSaMonitor_RelCptMon_12 autosar_swc_fusamon_Subsystem_Reference_RelCptMon_SSR_FuSaMonitor_RelCptMon_13 autosar_swc_fusamon_Subsystem_Reference_RelCptMon_SSR_FuSaMonitor_RelCptMon_14 autosar_swc_fusamon_Subsystem_Reference_RelCptMon_SSR_FuSaMonitor_RelCptMon_15 autosar_swc_fusamon_Subsystem_Reference_RelCptMon_SSR_FuSaMonitor_RelCptMon_16 autosar_swc_fusamon_Subsystem_Reference_RelCptMon_SSR_FuSaMonitor_RelCptMon_17 autosar_swc_fusamon_Subsystem_Reference_RelCptMon_SSR_FuSaMonitor_RelCptMon_18 autosar_swc_fusamon_Subsystem_Reference_RelCptMon_SSR_FuSaMonitor_RelCptMon_19 autosar_swc_fusamon_Subsystem_Reference_RelCptMon_SSR_FuSaMonitor_RelCptMon_2 autosar_swc_fusamon_Subsystem_Reference_RelCptMon_SSR_FuSaMonitor_RelCptMon_20 autosar_swc_fusamon_Subsystem_Reference_RelCptMon_SSR_FuSaMonitor_RelCptMon_22 autosar_swc_fusamon_Subsystem_Reference_RelCptMon_SSR_FuSaMonitor_RelCptMon_23 autosar_swc_fusamon_Subsystem_Reference_RelCptMon_SSR_FuSaMonitor_RelCptMon_24 autosar_swc_fusamon_Subsystem_Reference_RelCptMon_SSR_FuSaMonitor_RelCptMon_25 autosar_swc_fusamon_Subsystem_Reference_RelCptMon_SSR_FuSaMonitor_RelCptMon_26 autosar_swc_fusamon_Subsystem_Reference_RelCptMon_SSR_FuSaMonitor_RelCptMon_27 autosar_swc_fusamon_Subsystem_Reference_RelCptMon_SSR_FuSaMonitor_RelCptMon_28 autosar_swc_fusamon_Subsystem_Reference_RelCptMon_SSR_FuSaMonitor_RelCptMon_29 autosar_swc_fusamon_Subsystem_Reference_RelCptMon_SSR_FuSaMonitor_RelCptMon_3 autosar_swc_fusamon_Subsystem_Reference_RelCptMon_SSR_FuSaMonitor_RelCptMon_30 autosar_swc_fusamon_Subsystem_Reference_RelCptMon_SSR_FuSaMonitor_RelCptMon_31 autosar_swc_fusamon_Subsystem_Reference_RelCptMon_SSR_FuSaMonitor_RelCptMon_32 autosar_swc_fusamon_Subsystem_Reference_RelCptMon_SSR_FuSaMonitor_RelCptMon_33 autosar_swc_fusamon_Subsystem_Reference_RelCptMon_SSR_FuSaMonitor_RelCptMon_34 autosar_swc_fusamon_Subsystem_Reference_RelCptMon_SSR_FuSaMonitor_RelCptMon_35 autosar_swc_fusamon_Subsystem_Reference_RelCptMon_SSR_FuSaMonitor_RelCptMon_36 autosar_swc_fusamon_Subsystem_Reference_RelCptMon_SSR_FuSaMonitor_RelCptMon_37 autosar_swc_fusamon_Subsystem_Reference_RelCptMon_SSR_FuSaMonitor_RelCptMon_38 autosar_swc_fusamon_Subsystem_Reference_RelCptMon_SSR_FuSaMonitor_RelCptMon_39 autosar_swc_fusamon_Subsystem_Reference_RelCptMon_SSR_FuSaMonitor_RelCptMon_4 autosar_swc_fusamon_Subsystem_Reference_RelCptMon_SSR_FuSaMonitor_RelCptMon_5 autosar_swc_fusamon_Subsystem_Reference_RelCptMon_SSR_FuSaMonitor_RelCptMon_6 autosar_swc_fusamon_Subsystem_Reference_RelCptMon_SSR_FuSaMonitor_RelCptMon_7 autosar_swc_fusamon_Subsystem_Reference_RelCptMon_SSR_FuSaMonitor_RelCptMon_8 autosar_swc_fusamon_Subsystem_Reference_RelCptMon_SSR_FuSaMonitor_RelCptMon_9 /end SUB_GROUP
/end GROUP
/begin GROUP autosar_swc_fusamon_Subsystem_Reference_RelCptMon_SSR_FuSaMonitor_RelCptMon_0 "autosar_swc_fusamon/Subsystem Reference/RelCptMon/SSR_FuSaMonitor_RelCptMon_0" /begin REF_CHARACTERISTIC CAL_Deb_SftyFlg_BrkAvl /end REF_CHARACTERISTIC /begin REF_MEASUREMENT autosar_swc_fusamon_rtARID_DEF.UnitDelay_DSTATE_jb /end REF_MEASUREMENT /end GROUP
/begin GROUP autosar_swc_fusamon_Subsystem_Reference_RelCptMon_SSR_FuSaMonitor_RelCptMon_1 "autosar_swc_fusamon/Subsystem Reference/RelCptMon/SSR_FuSaMonitor_RelCptMon_1" /begin REF_CHARACTERISTIC CAL_Deb_SftyFlg_BrkAvlE2E /end REF_CHARACTERISTIC /begin REF_MEASUREMENT autosar_swc_fusamon_rtARID_DEF.UnitDelay_DSTATE_i /end REF_MEASUREMENT /end GROUP
/begin GROUP autosar_swc_fusamon_Subsystem_Reference_RelCptMon_SSR_FuSaMonitor_RelCptMon_10 "autosar_swc_fusamon/Subsystem Reference/RelCptMon/SSR_FuSaMonitor_RelCptMon_10" /begin REF_CHARACTERISTIC CAL_Deb_SftyFlg_WhlAvl /end REF_CHARACTERISTIC /begin REF_MEASUREMENT autosar_swc_fusamon_rtARID_DEF.UnitDelay_DSTATE_ll /end REF_MEASUREMENT /end GROUP
/begin GROUP autosar_swc_fusamon_Subsystem_Reference_RelCptMon_SSR_FuSaMonitor_RelCptMon_11 "autosar_swc_fusamon/Subsystem Reference/RelCptMon/SSR_FuSaMonitor_RelCptMon_11" /begin REF_CHARACTERISTIC CAL_Deb_SftyFlg_EpbAvlE2E /end REF_CHARACTERISTIC /begin REF_MEASUREMENT autosar_swc_fusamon_rtARID_DEF.UnitDelay_DSTATE_on /end REF_MEASUREMENT /end GROUP
/begin GROUP autosar_swc_fusamon_Subsystem_Reference_RelCptMon_SSR_FuSaMonitor_RelCptMon_12 "autosar_swc_fusamon/Subsystem Reference/RelCptMon/SSR_FuSaMonitor_RelCptMon_12" /begin REF_CHARACTERISTIC CAL_Deb_SftyFlg_EpbAvl /end REF_CHARACTERISTIC /begin REF_MEASUREMENT autosar_swc_fusamon_rtARID_DEF.UnitDelay_DSTATE_oj /end REF_MEASUREMENT /end GROUP
/begin GROUP autosar_swc_fusamon_Subsystem_Reference_RelCptMon_SSR_FuSaMonitor_RelCptMon_13 "autosar_swc_fusamon/Subsystem Reference/RelCptMon/SSR_FuSaMonitor_RelCptMon_13" /begin REF_CHARACTERISTIC CAL_Deb_SftyFlg_VehSpdChassisE2E /end REF_CHARACTERISTIC /begin REF_MEASUREMENT autosar_swc_fusamon_rtARID_DEF.UnitDelay_DSTATE_pz /end REF_MEASUREMENT /end GROUP
/begin GROUP autosar_swc_fusamon_Subsystem_Reference_RelCptMon_SSR_FuSaMonitor_RelCptMon_14 "autosar_swc_fusamon/Subsystem Reference/RelCptMon/SSR_FuSaMonitor_RelCptMon_14" /begin REF_CHARACTERISTIC CAL_Deb_SftyFlg_VehSpdChassisVld /end REF_CHARACTERISTIC /begin REF_MEASUREMENT autosar_swc_fusamon_rtARID_DEF.UnitDelay_DSTATE_cz /end REF_MEASUREMENT /end GROUP
/begin GROUP autosar_swc_fusamon_Subsystem_Reference_RelCptMon_SSR_FuSaMonitor_RelCptMon_15 "autosar_swc_fusamon/Subsystem Reference/RelCptMon/SSR_FuSaMonitor_RelCptMon_15" /begin REF_CHARACTERISTIC CAL_Deb_SftyFlg_SteerAvl /end REF_CHARACTERISTIC /begin REF_MEASUREMENT autosar_swc_fusamon_rtARID_DEF.UnitDelay_DSTATE_bp /end REF_MEASUREMENT /end GROUP
/begin GROUP autosar_swc_fusamon_Subsystem_Reference_RelCptMon_SSR_FuSaMonitor_RelCptMon_16 "autosar_swc_fusamon/Subsystem Reference/RelCptMon/SSR_FuSaMonitor_RelCptMon_16" /begin REF_CHARACTERISTIC CAL_Deb_SftyFlg_SteerAvlE2E /end REF_CHARACTERISTIC /begin REF_MEASUREMENT autosar_swc_fusamon_rtARID_DEF.UnitDelay_DSTATE_dd /end REF_MEASUREMENT /end GROUP
/begin GROUP autosar_swc_fusamon_Subsystem_Reference_RelCptMon_SSR_FuSaMonitor_RelCptMon_17 "autosar_swc_fusamon/Subsystem Reference/RelCptMon/SSR_FuSaMonitor_RelCptMon_17" /begin REF_CHARACTERISTIC CAL_Deb_SftyFlg_SteerWhlAngE2E /end REF_CHARACTERISTIC /begin REF_MEASUREMENT autosar_swc_fusamon_rtARID_DEF.UnitDelay_DSTATE_br /end REF_MEASUREMENT /end GROUP
/begin GROUP autosar_swc_fusamon_Subsystem_Reference_RelCptMon_SSR_FuSaMonitor_RelCptMon_18 "autosar_swc_fusamon/Subsystem Reference/RelCptMon/SSR_FuSaMonitor_RelCptMon_18" /begin REF_CHARACTERISTIC CAL_Deb_SftyFlg_SteerWhlAngVld /end REF_CHARACTERISTIC /begin REF_MEASUREMENT autosar_swc_fusamon_rtARID_DEF.UnitDelay_DSTATE_ib /end REF_MEASUREMENT /end GROUP
/begin GROUP autosar_swc_fusamon_Subsystem_Reference_RelCptMon_SSR_FuSaMonitor_RelCptMon_19 "autosar_swc_fusamon/Subsystem Reference/RelCptMon/SSR_FuSaMonitor_RelCptMon_19" /begin REF_CHARACTERISTIC CAL_Deb_SftyFlg_SteerWhlAngSpdE2E /end REF_CHARACTERISTIC /begin REF_MEASUREMENT autosar_swc_fusamon_rtARID_DEF.UnitDelay_DSTATE_ec /end REF_MEASUREMENT /end GROUP
/begin GROUP autosar_swc_fusamon_Subsystem_Reference_RelCptMon_SSR_FuSaMonitor_RelCptMon_2 "autosar_swc_fusamon/Subsystem Reference/RelCptMon/SSR_FuSaMonitor_RelCptMon_2" /begin REF_CHARACTERISTIC CAL_Deb_SftyFlg_BrkMstCylPrsE2E /end REF_CHARACTERISTIC /begin REF_MEASUREMENT autosar_swc_fusamon_rtARID_DEF.UnitDelay_DSTATE_f3 /end REF_MEASUREMENT /end GROUP
/begin GROUP autosar_swc_fusamon_Subsystem_Reference_RelCptMon_SSR_FuSaMonitor_RelCptMon_20 "autosar_swc_fusamon/Subsystem Reference/RelCptMon/SSR_FuSaMonitor_RelCptMon_20" /begin REF_CHARACTERISTIC CAL_Deb_SftyFlg_SteerWhlAngSpdVld /end REF_CHARACTERISTIC /begin REF_MEASUREMENT autosar_swc_fusamon_rtARID_DEF.UnitDelay_DSTATE_iy /end REF_MEASUREMENT /end GROUP
/begin GROUP autosar_swc_fusamon_Subsystem_Reference_RelCptMon_SSR_FuSaMonitor_RelCptMon_22 "autosar_swc_fusamon/Subsystem Reference/RelCptMon/SSR_FuSaMonitor_RelCptMon_22" /begin REF_CHARACTERISTIC CAL_Deb_SftyFlg_F_Cam_Err /end REF_CHARACTERISTIC /begin REF_MEASUREMENT autosar_swc_fusamon_rtARID_DEF.UnitDelay_DSTATE_h /end REF_MEASUREMENT /end GROUP
/begin GROUP autosar_swc_fusamon_Subsystem_Reference_RelCptMon_SSR_FuSaMonitor_RelCptMon_23 "autosar_swc_fusamon/Subsystem Reference/RelCptMon/SSR_FuSaMonitor_RelCptMon_23" /begin REF_CHARACTERISTIC CAL_Deb_SftyFlg_RL_Radar_Err /end REF_CHARACTERISTIC /begin REF_MEASUREMENT autosar_swc_fusamon_rtARID_DEF.UnitDelay_DSTATE_l /end REF_MEASUREMENT /end GROUP
/begin GROUP autosar_swc_fusamon_Subsystem_Reference_RelCptMon_SSR_FuSaMonitor_RelCptMon_24 "autosar_swc_fusamon/Subsystem Reference/RelCptMon/SSR_FuSaMonitor_RelCptMon_24" /begin REF_CHARACTERISTIC CAL_Deb_SftyFlg_RR_Radar_Err /end REF_CHARACTERISTIC /begin REF_MEASUREMENT autosar_swc_fusamon_rtARID_DEF.UnitDelay_DSTATE_f /end REF_MEASUREMENT /end GROUP
/begin GROUP autosar_swc_fusamon_Subsystem_Reference_RelCptMon_SSR_FuSaMonitor_RelCptMon_25 "autosar_swc_fusamon/Subsystem Reference/RelCptMon/SSR_FuSaMonitor_RelCptMon_25" /begin REF_CHARACTERISTIC CAL_Deb_SftyFlg_ActGearE2E /end REF_CHARACTERISTIC /begin REF_MEASUREMENT autosar_swc_fusamon_rtARID_DEF.UnitDelay_DSTATE_p1 /end REF_MEASUREMENT /end GROUP
/begin GROUP autosar_swc_fusamon_Subsystem_Reference_RelCptMon_SSR_FuSaMonitor_RelCptMon_26 "autosar_swc_fusamon/Subsystem Reference/RelCptMon/SSR_FuSaMonitor_RelCptMon_26" /begin REF_CHARACTERISTIC CAL_Deb_SftyFlg_ActGearVld /end REF_CHARACTERISTIC /begin REF_MEASUREMENT autosar_swc_fusamon_rtARID_DEF.UnitDelay_DSTATE_c0 /end REF_MEASUREMENT /end GROUP
/begin GROUP autosar_swc_fusamon_Subsystem_Reference_RelCptMon_SSR_FuSaMonitor_RelCptMon_27 "autosar_swc_fusamon/Subsystem Reference/RelCptMon/SSR_FuSaMonitor_RelCptMon_27" /begin REF_CHARACTERISTIC CAL_Deb_SftyFlg_DrvAccePedlPosnE2E /end REF_CHARACTERISTIC /begin REF_MEASUREMENT autosar_swc_fusamon_rtARID_DEF.UnitDelay_DSTATE_o0n /end REF_MEASUREMENT /end GROUP
/begin GROUP autosar_swc_fusamon_Subsystem_Reference_RelCptMon_SSR_FuSaMonitor_RelCptMon_28 "autosar_swc_fusamon/Subsystem Reference/RelCptMon/SSR_FuSaMonitor_RelCptMon_28" /begin REF_CHARACTERISTIC CAL_Deb_SftyFlg_DrvAccePedlPosnVld /end REF_CHARACTERISTIC /begin REF_MEASUREMENT autosar_swc_fusamon_rtARID_DEF.UnitDelay_DSTATE_c3 /end REF_MEASUREMENT /end GROUP
/begin GROUP autosar_swc_fusamon_Subsystem_Reference_RelCptMon_SSR_FuSaMonitor_RelCptMon_29 "autosar_swc_fusamon/Subsystem Reference/RelCptMon/SSR_FuSaMonitor_RelCptMon_29" /begin REF_CHARACTERISTIC CAL_Deb_SftyFlg_PTAvlE2E /end REF_CHARACTERISTIC /begin REF_MEASUREMENT autosar_swc_fusamon_rtARID_DEF.UnitDelay_DSTATE_n /end REF_MEASUREMENT /end GROUP
/begin GROUP autosar_swc_fusamon_Subsystem_Reference_RelCptMon_SSR_FuSaMonitor_RelCptMon_3 "autosar_swc_fusamon/Subsystem Reference/RelCptMon/SSR_FuSaMonitor_RelCptMon_3" /begin REF_CHARACTERISTIC CAL_Deb_SftyFlg_BrkMstCylPrsVld /end REF_CHARACTERISTIC /begin REF_MEASUREMENT autosar_swc_fusamon_rtARID_DEF.UnitDelay_DSTATE_fv /end REF_MEASUREMENT /end GROUP
/begin GROUP autosar_swc_fusamon_Subsystem_Reference_RelCptMon_SSR_FuSaMonitor_RelCptMon_30 "autosar_swc_fusamon/Subsystem Reference/RelCptMon/SSR_FuSaMonitor_RelCptMon_30" /begin REF_CHARACTERISTIC CAL_Deb_SftyFlg_PTAvl /end REF_CHARACTERISTIC /begin REF_MEASUREMENT autosar_swc_fusamon_rtARID_DEF.UnitDelay_DSTATE_fh /end REF_MEASUREMENT /end GROUP
/begin GROUP autosar_swc_fusamon_Subsystem_Reference_RelCptMon_SSR_FuSaMonitor_RelCptMon_31 "autosar_swc_fusamon/Subsystem Reference/RelCptMon/SSR_FuSaMonitor_RelCptMon_31" /begin REF_CHARACTERISTIC CAL_Deb_SftyFlg_BodyAvlE2E /end REF_CHARACTERISTIC /begin REF_MEASUREMENT autosar_swc_fusamon_rtARID_DEF.UnitDelay_DSTATE_im /end REF_MEASUREMENT /end GROUP
/begin GROUP autosar_swc_fusamon_Subsystem_Reference_RelCptMon_SSR_FuSaMonitor_RelCptMon_32 "autosar_swc_fusamon/Subsystem Reference/RelCptMon/SSR_FuSaMonitor_RelCptMon_32" /begin REF_CHARACTERISTIC CAL_Deb_SftyFlg_AccSwtStsVld /end REF_CHARACTERISTIC /begin REF_MEASUREMENT autosar_swc_fusamon_rtARID_DEF.UnitDelay_DSTATE_e /end REF_MEASUREMENT /end GROUP
/begin GROUP autosar_swc_fusamon_Subsystem_Reference_RelCptMon_SSR_FuSaMonitor_RelCptMon_33 "autosar_swc_fusamon/Subsystem Reference/RelCptMon/SSR_FuSaMonitor_RelCptMon_33" /begin REF_CHARACTERISTIC CAL_Deb_SftyFlg_AccSwtStsE2E /end REF_CHARACTERISTIC /begin REF_MEASUREMENT autosar_swc_fusamon_rtARID_DEF.UnitDelay_DSTATE_fi /end REF_MEASUREMENT /end GROUP
/begin GROUP autosar_swc_fusamon_Subsystem_Reference_RelCptMon_SSR_FuSaMonitor_RelCptMon_34 "autosar_swc_fusamon/Subsystem Reference/RelCptMon/SSR_FuSaMonitor_RelCptMon_34" /begin REF_CHARACTERISTIC CAL_Deb_SftyFlg_YawRateE2E /end REF_CHARACTERISTIC /begin REF_MEASUREMENT autosar_swc_fusamon_rtARID_DEF.UnitDelay_DSTATE_bq /end REF_MEASUREMENT /end GROUP
/begin GROUP autosar_swc_fusamon_Subsystem_Reference_RelCptMon_SSR_FuSaMonitor_RelCptMon_35 "autosar_swc_fusamon/Subsystem Reference/RelCptMon/SSR_FuSaMonitor_RelCptMon_35" /begin REF_CHARACTERISTIC CAL_Deb_SftyFlg_YawRateVld /end REF_CHARACTERISTIC /begin REF_MEASUREMENT autosar_swc_fusamon_rtARID_DEF.UnitDelay_DSTATE_o0v /end REF_MEASUREMENT /end GROUP
/begin GROUP autosar_swc_fusamon_Subsystem_Reference_RelCptMon_SSR_FuSaMonitor_RelCptMon_36 "autosar_swc_fusamon/Subsystem Reference/RelCptMon/SSR_FuSaMonitor_RelCptMon_36" /begin REF_CHARACTERISTIC CAL_Deb_SftyFlg_AyE2E /end REF_CHARACTERISTIC /begin REF_MEASUREMENT autosar_swc_fusamon_rtARID_DEF.UnitDelay_DSTATE_lr /end REF_MEASUREMENT /end GROUP
/begin GROUP autosar_swc_fusamon_Subsystem_Reference_RelCptMon_SSR_FuSaMonitor_RelCptMon_37 "autosar_swc_fusamon/Subsystem Reference/RelCptMon/SSR_FuSaMonitor_RelCptMon_37" /begin REF_CHARACTERISTIC CAL_Deb_SftyFlg_AyVld /end REF_CHARACTERISTIC /begin REF_MEASUREMENT autosar_swc_fusamon_rtARID_DEF.UnitDelay_DSTATE_ob /end REF_MEASUREMENT /end GROUP
/begin GROUP autosar_swc_fusamon_Subsystem_Reference_RelCptMon_SSR_FuSaMonitor_RelCptMon_38 "autosar_swc_fusamon/Subsystem Reference/RelCptMon/SSR_FuSaMonitor_RelCptMon_38" /begin REF_CHARACTERISTIC CAL_Deb_SftyFlg_AxE2E /end REF_CHARACTERISTIC /begin REF_MEASUREMENT autosar_swc_fusamon_rtARID_DEF.UnitDelay_DSTATE_ls /end REF_MEASUREMENT /end GROUP
/begin GROUP autosar_swc_fusamon_Subsystem_Reference_RelCptMon_SSR_FuSaMonitor_RelCptMon_39 "autosar_swc_fusamon/Subsystem Reference/RelCptMon/SSR_FuSaMonitor_RelCptMon_39" /begin REF_CHARACTERISTIC CAL_Deb_SftyFlg_AxVld /end REF_CHARACTERISTIC /begin REF_MEASUREMENT autosar_swc_fusamon_rtARID_DEF.UnitDelay_DSTATE_dd1 /end REF_MEASUREMENT /end GROUP
/begin GROUP autosar_swc_fusamon_Subsystem_Reference_RelCptMon_SSR_FuSaMonitor_RelCptMon_4 "autosar_swc_fusamon/Subsystem Reference/RelCptMon/SSR_FuSaMonitor_RelCptMon_4" /begin REF_CHARACTERISTIC CAL_Deb_SftyFlg_Chassis_ABSFailSts /end REF_CHARACTERISTIC /begin REF_MEASUREMENT autosar_swc_fusamon_rtARID_DEF.UnitDelay_DSTATE_bs /end REF_MEASUREMENT /end GROUP
/begin GROUP autosar_swc_fusamon_Subsystem_Reference_RelCptMon_SSR_FuSaMonitor_RelCptMon_5 "autosar_swc_fusamon/Subsystem Reference/RelCptMon/SSR_FuSaMonitor_RelCptMon_5" /begin REF_CHARACTERISTIC CAL_Deb_SftyFlg_Chassis_TCSFailSts /end REF_CHARACTERISTIC /begin REF_MEASUREMENT autosar_swc_fusamon_rtARID_DEF.UnitDelay_DSTATE_fg /end REF_MEASUREMENT /end GROUP
/begin GROUP autosar_swc_fusamon_Subsystem_Reference_RelCptMon_SSR_FuSaMonitor_RelCptMon_6 "autosar_swc_fusamon/Subsystem Reference/RelCptMon/SSR_FuSaMonitor_RelCptMon_6" /begin REF_CHARACTERISTIC CAL_Deb_SftyFlg_Chassis_VDCFailSts /end REF_CHARACTERISTIC /begin REF_MEASUREMENT autosar_swc_fusamon_rtARID_DEF.UnitDelay_DSTATE_aq /end REF_MEASUREMENT /end GROUP
/begin GROUP autosar_swc_fusamon_Subsystem_Reference_RelCptMon_SSR_FuSaMonitor_RelCptMon_7 "autosar_swc_fusamon/Subsystem Reference/RelCptMon/SSR_FuSaMonitor_RelCptMon_7" /begin REF_CHARACTERISTIC CAL_Deb_SftyFlg_Chassis_HDCFailSts /end REF_CHARACTERISTIC /begin REF_MEASUREMENT autosar_swc_fusamon_rtARID_DEF.UnitDelay_DSTATE_bl /end REF_MEASUREMENT /end GROUP
/begin GROUP autosar_swc_fusamon_Subsystem_Reference_RelCptMon_SSR_FuSaMonitor_RelCptMon_8 "autosar_swc_fusamon/Subsystem Reference/RelCptMon/SSR_FuSaMonitor_RelCptMon_8" /begin REF_CHARACTERISTIC CAL_Deb_SftyFlg_Chassis_EBDFailSts /end REF_CHARACTERISTIC /begin REF_MEASUREMENT autosar_swc_fusamon_rtARID_DEF.UnitDelay_DSTATE_dz /end REF_MEASUREMENT /end GROUP
/begin GROUP autosar_swc_fusamon_Subsystem_Reference_RelCptMon_SSR_FuSaMonitor_RelCptMon_9 "autosar_swc_fusamon/Subsystem Reference/RelCptMon/SSR_FuSaMonitor_RelCptMon_9" /begin REF_CHARACTERISTIC CAL_Deb_SftyFlg_WhlAvlE2E /end REF_CHARACTERISTIC /begin REF_MEASUREMENT autosar_swc_fusamon_rtARID_DEF.UnitDelay_DSTATE_bo /end REF_MEASUREMENT /end GROUP
/begin GROUP autosar_swc_fusamon_Subsystem_Reference_SysStMon "autosar_swc_fusamon/Subsystem Reference/SysStMon"
 /begin SUB_GROUP autosar_swc_fusamon_Subsystem_Reference_SysStMon_AEBMCUMonitor autosar_swc_fusamon_Subsystem_Reference_SysStMon_PilotMCUMonitor autosar_swc_fusamon_Subsystem_Reference_SysStMon_SSR_FuSaMonitor_SysStMon_34 autosar_swc_fusamon_Subsystem_Reference_SysStMon_SSR_FuSaMonitor_SysStMon_35 /end SUB_GROUP
/end GROUP
/begin GROUP autosar_swc_fusamon_Subsystem_Reference_SysStMon_AEBMCUMonitor "autosar_swc_fusamon/Subsystem Reference/SysStMon/AEBMCUMonitor"
 /begin SUB_GROUP autosar_swc_fusamon_Subsystem_Reference_SysStMon_AEBMCUMonitor_AEB_MCU_Monitor autosar_swc_fusamon_Subsystem_Reference_SysStMon_AEBMCUMonitor_SSR_FuSaMonitor_SysStMon_3 autosar_swc_fusamon_Subsystem_Reference_SysStMon_AEBMCUMonitor_SSR_FuSaMonitor_SysStMon_4 /end SUB_GROUP
/end GROUP
/begin GROUP autosar_swc_fusamon_Subsystem_Reference_SysStMon_AEBMCUMonitor_AEB_MCU_Monitor "autosar_swc_fusamon/Subsystem Reference/SysStMon/AEBMCUMonitor/AEB_MCU_Monitor"
 /begin SUB_GROUP autosar_swc_fusamon_Subsystem_Reference_SysStMon_AEBMCUMonitor_AEB_MCU_Monitor_AEBFuSaRisk autosar_swc_fusamon_Subsystem_Reference_SysStMon_AEBMCUMonitor_AEB_MCU_Monitor_AfterTrigger_Mon autosar_swc_fusamon_Subsystem_Reference_SysStMon_AEBMCUMonitor_AEB_MCU_Monitor_Corridor_Mon autosar_swc_fusamon_Subsystem_Reference_SysStMon_AEBMCUMonitor_AEB_MCU_Monitor_Ego_Mon autosar_swc_fusamon_Subsystem_Reference_SysStMon_AEBMCUMonitor_AEB_MCU_Monitor_MainTarget_Map autosar_swc_fusamon_Subsystem_Reference_SysStMon_AEBMCUMonitor_AEB_MCU_Monitor_MainTarget_Mon autosar_swc_fusamon_Subsystem_Reference_SysStMon_AEBMCUMonitor_AEB_MCU_Monitor_Safety_AxRqrd_Cal autosar_swc_fusamon_Subsystem_Reference_SysStMon_AEBMCUMonitor_AEB_MCU_Monitor_Safety_TTC_Cal /end SUB_GROUP
/end GROUP
/begin GROUP autosar_swc_fusamon_Subsystem_Reference_SysStMon_AEBMCUMonitor_AEB_MCU_Monitor_AEBFuSaRisk "autosar_swc_fusamon/Subsystem Reference/SysStMon/AEBMCUMonitor/AEB_MCU_Monitor/AEBFuSaRisk" /begin REF_CHARACTERISTIC CAL_AebFuSaSumRiskThld CAL_PriorVec /end REF_CHARACTERISTIC /end GROUP
/begin GROUP autosar_swc_fusamon_Subsystem_Reference_SysStMon_AEBMCUMonitor_AEB_MCU_Monitor_AfterTrigger_Mon "autosar_swc_fusamon/Subsystem Reference/SysStMon/AEBMCUMonitor/AEB_MCU_Monitor/AfterTrigger_Mon"
 /begin SUB_GROUP autosar_swc_fusamon_Subsystem_Reference_SysStMon_AEBMCUMonitor_AEB_MCU_Monitor_AfterTrigger_Mon_Compare_To_Constant3 autosar_swc_fusamon_Subsystem_Reference_SysStMon_AEBMCUMonitor_AEB_MCU_Monitor_AfterTrigger_Mon_Compare_To_Constant4 autosar_swc_fusamon_Subsystem_Reference_SysStMon_AEBMCUMonitor_AEB_MCU_Monitor_AfterTrigger_Mon_Compare_To_Constant5 autosar_swc_fusamon_Subsystem_Reference_SysStMon_AEBMCUMonitor_AEB_MCU_Monitor_AfterTrigger_Mon_Compare_To_Constant6 autosar_swc_fusamon_Subsystem_Reference_SysStMon_AEBMCUMonitor_AEB_MCU_Monitor_AfterTrigger_Mon_Compare_To_Constant7 autosar_swc_fusamon_Subsystem_Reference_SysStMon_AEBMCUMonitor_AEB_MCU_Monitor_AfterTrigger_Mon_Compare_To_Constant8 autosar_swc_fusamon_Subsystem_Reference_SysStMon_AEBMCUMonitor_AEB_MCU_Monitor_AfterTrigger_Mon_Derivative autosar_swc_fusamon_Subsystem_Reference_SysStMon_AEBMCUMonitor_AEB_MCU_Monitor_AfterTrigger_Mon_Filter autosar_swc_fusamon_Subsystem_Reference_SysStMon_AEBMCUMonitor_AEB_MCU_Monitor_AfterTrigger_Mon_Filter1 autosar_swc_fusamon_Subsystem_Reference_SysStMon_AEBMCUMonitor_AEB_MCU_Monitor_AfterTrigger_Mon_SSR_FuSaMonitor_SysStMon_26 autosar_swc_fusamon_Subsystem_Reference_SysStMon_AEBMCUMonitor_AEB_MCU_Monitor_AfterTrigger_Mon_SSR_FuSaMonitor_SysStMon_27 autosar_swc_fusamon_Subsystem_Reference_SysStMon_AEBMCUMonitor_AEB_MCU_Monitor_AfterTrigger_Mon_SSR_FuSaMonitor_SysStMon_28 /end SUB_GROUP
 /begin REF_CHARACTERISTIC CAL_AftTrigCvrtAbnDebThld CAL_AftTrigCvrtDefault CAL_AftTrigCvrtThld1 CAL_AftTrigCvrtThld2 CAL_AftTrigJerkAbnDebThld CAL_AftTrigTarOvrlapDebThld /end REF_CHARACTERISTIC
/end GROUP
/begin GROUP autosar_swc_fusamon_Subsystem_Reference_SysStMon_AEBMCUMonitor_AEB_MCU_Monitor_AfterTrigger_Mon_Compare_To_Constant3 "autosar_swc_fusamon/Subsystem Reference/SysStMon/AEBMCUMonitor/AEB_MCU_Monitor/AfterTrigger_Mon/Compare\nTo Constant3" /begin REF_CHARACTERISTIC CAL_AftTrigJerkAbnThld /end REF_CHARACTERISTIC /end GROUP
/begin GROUP autosar_swc_fusamon_Subsystem_Reference_SysStMon_AEBMCUMonitor_AEB_MCU_Monitor_AfterTrigger_Mon_Compare_To_Constant4 "autosar_swc_fusamon/Subsystem Reference/SysStMon/AEBMCUMonitor/AEB_MCU_Monitor/AfterTrigger_Mon/Compare\nTo Constant4" /begin REF_CHARACTERISTIC CAL_AftTrigCvrtSpdThld1 /end REF_CHARACTERISTIC /end GROUP
/begin GROUP autosar_swc_fusamon_Subsystem_Reference_SysStMon_AEBMCUMonitor_AEB_MCU_Monitor_AfterTrigger_Mon_Compare_To_Constant5 "autosar_swc_fusamon/Subsystem Reference/SysStMon/AEBMCUMonitor/AEB_MCU_Monitor/AfterTrigger_Mon/Compare\nTo Constant5" /begin REF_CHARACTERISTIC CAL_AftTrigCvrtSpdThld2 /end REF_CHARACTERISTIC /end GROUP
/begin GROUP autosar_swc_fusamon_Subsystem_Reference_SysStMon_AEBMCUMonitor_AEB_MCU_Monitor_AfterTrigger_Mon_Compare_To_Constant6 "autosar_swc_fusamon/Subsystem Reference/SysStMon/AEBMCUMonitor/AEB_MCU_Monitor/AfterTrigger_Mon/Compare\nTo Constant6" /begin REF_CHARACTERISTIC CAL_AftTrigTarOvrlapXThld /end REF_CHARACTERISTIC /end GROUP
/begin GROUP autosar_swc_fusamon_Subsystem_Reference_SysStMon_AEBMCUMonitor_AEB_MCU_Monitor_AfterTrigger_Mon_Compare_To_Constant7 "autosar_swc_fusamon/Subsystem Reference/SysStMon/AEBMCUMonitor/AEB_MCU_Monitor/AfterTrigger_Mon/Compare\nTo Constant7" /begin REF_CHARACTERISTIC CAL_AftTrigTarOvrlapYLThld /end REF_CHARACTERISTIC /end GROUP
/begin GROUP autosar_swc_fusamon_Subsystem_Reference_SysStMon_AEBMCUMonitor_AEB_MCU_Monitor_AfterTrigger_Mon_Compare_To_Constant8 "autosar_swc_fusamon/Subsystem Reference/SysStMon/AEBMCUMonitor/AEB_MCU_Monitor/AfterTrigger_Mon/Compare\nTo Constant8" /begin REF_CHARACTERISTIC CAL_AftTrigTarOvrlapYRThld /end REF_CHARACTERISTIC /end GROUP
/begin GROUP autosar_swc_fusamon_Subsystem_Reference_SysStMon_AEBMCUMonitor_AEB_MCU_Monitor_AfterTrigger_Mon_Derivative "autosar_swc_fusamon/Subsystem Reference/SysStMon/AEBMCUMonitor/AEB_MCU_Monitor/AfterTrigger_Mon/Derivative" /begin REF_MEASUREMENT autosar_swc_fusamon_rtARID_DEF.Delay_DSTATE_d /end REF_MEASUREMENT /end GROUP
/begin GROUP autosar_swc_fusamon_Subsystem_Reference_SysStMon_AEBMCUMonitor_AEB_MCU_Monitor_AfterTrigger_Mon_Filter "autosar_swc_fusamon/Subsystem Reference/SysStMon/AEBMCUMonitor/AEB_MCU_Monitor/AfterTrigger_Mon/Filter" /begin REF_MEASUREMENT autosar_swc_fusamon_rtARID_DEF.Delay_DSTATE_i /end REF_MEASUREMENT /end GROUP
/begin GROUP autosar_swc_fusamon_Subsystem_Reference_SysStMon_AEBMCUMonitor_AEB_MCU_Monitor_AfterTrigger_Mon_Filter1 "autosar_swc_fusamon/Subsystem Reference/SysStMon/AEBMCUMonitor/AEB_MCU_Monitor/AfterTrigger_Mon/Filter1" /begin REF_MEASUREMENT autosar_swc_fusamon_rtARID_DEF.Delay_DSTATE_g /end REF_MEASUREMENT /end GROUP
/begin GROUP autosar_swc_fusamon_Subsystem_Reference_SysStMon_AEBMCUMonitor_AEB_MCU_Monitor_AfterTrigger_Mon_SSR_FuSaMonitor_SysStMon_26 "autosar_swc_fusamon/Subsystem Reference/SysStMon/AEBMCUMonitor/AEB_MCU_Monitor/AfterTrigger_Mon/SSR_FuSaMonitor_SysStMon_26" /begin REF_MEASUREMENT autosar_swc_fusamon_rtARID_DEF.UnitDelay_DSTATE_o5 /end REF_MEASUREMENT /end GROUP
/begin GROUP autosar_swc_fusamon_Subsystem_Reference_SysStMon_AEBMCUMonitor_AEB_MCU_Monitor_AfterTrigger_Mon_SSR_FuSaMonitor_SysStMon_27 "autosar_swc_fusamon/Subsystem Reference/SysStMon/AEBMCUMonitor/AEB_MCU_Monitor/AfterTrigger_Mon/SSR_FuSaMonitor_SysStMon_27" /begin REF_MEASUREMENT autosar_swc_fusamon_rtARID_DEF.UnitDelay_DSTATE_dp /end REF_MEASUREMENT /end GROUP
/begin GROUP autosar_swc_fusamon_Subsystem_Reference_SysStMon_AEBMCUMonitor_AEB_MCU_Monitor_AfterTrigger_Mon_SSR_FuSaMonitor_SysStMon_28 "autosar_swc_fusamon/Subsystem Reference/SysStMon/AEBMCUMonitor/AEB_MCU_Monitor/AfterTrigger_Mon/SSR_FuSaMonitor_SysStMon_28" /begin REF_MEASUREMENT autosar_swc_fusamon_rtARID_DEF.UnitDelay_DSTATE_l4 /end REF_MEASUREMENT /end GROUP
/begin GROUP autosar_swc_fusamon_Subsystem_Reference_SysStMon_AEBMCUMonitor_AEB_MCU_Monitor_Corridor_Mon "autosar_swc_fusamon/Subsystem Reference/SysStMon/AEBMCUMonitor/AEB_MCU_Monitor/Corridor_Mon"
 /begin SUB_GROUP autosar_swc_fusamon_Subsystem_Reference_SysStMon_AEBMCUMonitor_AEB_MCU_Monitor_Corridor_Mon_Compare_To_Constant3 autosar_swc_fusamon_Subsystem_Reference_SysStMon_AEBMCUMonitor_AEB_MCU_Monitor_Corridor_Mon_Compare_To_Constant5 autosar_swc_fusamon_Subsystem_Reference_SysStMon_AEBMCUMonitor_AEB_MCU_Monitor_Corridor_Mon_SSR_FuSaMonitor_SysStMon_30 /end SUB_GROUP
 /begin REF_CHARACTERISTIC CAL_CoriDAebTarDecThld CAL_CoriDDebThld1 CAL_CoriDDebThld2 /end REF_CHARACTERISTIC
/end GROUP
/begin GROUP autosar_swc_fusamon_Subsystem_Reference_SysStMon_AEBMCUMonitor_AEB_MCU_Monitor_Corridor_Mon_Compare_To_Constant3 "autosar_swc_fusamon/Subsystem Reference/SysStMon/AEBMCUMonitor/AEB_MCU_Monitor/Corridor_Mon/Compare\nTo Constant3" /begin REF_CHARACTERISTIC CAL_CoriDDecThld1 /end REF_CHARACTERISTIC /end GROUP
/begin GROUP autosar_swc_fusamon_Subsystem_Reference_SysStMon_AEBMCUMonitor_AEB_MCU_Monitor_Corridor_Mon_Compare_To_Constant5 "autosar_swc_fusamon/Subsystem Reference/SysStMon/AEBMCUMonitor/AEB_MCU_Monitor/Corridor_Mon/Compare\nTo Constant5" /begin REF_CHARACTERISTIC CAL_YawRateRange /end REF_CHARACTERISTIC /end GROUP
/begin GROUP autosar_swc_fusamon_Subsystem_Reference_SysStMon_AEBMCUMonitor_AEB_MCU_Monitor_Corridor_Mon_SSR_FuSaMonitor_SysStMon_30 "autosar_swc_fusamon/Subsystem Reference/SysStMon/AEBMCUMonitor/AEB_MCU_Monitor/Corridor_Mon/SSR_FuSaMonitor_SysStMon_30" /begin REF_MEASUREMENT autosar_swc_fusamon_rtARID_DEF.UnitDelay_DSTATE_cm /end REF_MEASUREMENT /end GROUP
/begin GROUP autosar_swc_fusamon_Subsystem_Reference_SysStMon_AEBMCUMonitor_AEB_MCU_Monitor_Ego_Mon "autosar_swc_fusamon/Subsystem Reference/SysStMon/AEBMCUMonitor/AEB_MCU_Monitor/Ego_Mon"
 /begin SUB_GROUP autosar_swc_fusamon_Subsystem_Reference_SysStMon_AEBMCUMonitor_AEB_MCU_Monitor_Ego_Mon_Compare_To_Constant autosar_swc_fusamon_Subsystem_Reference_SysStMon_AEBMCUMonitor_AEB_MCU_Monitor_Ego_Mon_Compare_To_Constant1 autosar_swc_fusamon_Subsystem_Reference_SysStMon_AEBMCUMonitor_AEB_MCU_Monitor_Ego_Mon_Compare_To_Constant2 autosar_swc_fusamon_Subsystem_Reference_SysStMon_AEBMCUMonitor_AEB_MCU_Monitor_Ego_Mon_Compare_To_Constant3 autosar_swc_fusamon_Subsystem_Reference_SysStMon_AEBMCUMonitor_AEB_MCU_Monitor_Ego_Mon_Compare_To_Constant4 autosar_swc_fusamon_Subsystem_Reference_SysStMon_AEBMCUMonitor_AEB_MCU_Monitor_Ego_Mon_SSR_FuSaMonitor_SysStMon_18 autosar_swc_fusamon_Subsystem_Reference_SysStMon_AEBMCUMonitor_AEB_MCU_Monitor_Ego_Mon_SSR_FuSaMonitor_SysStMon_20 autosar_swc_fusamon_Subsystem_Reference_SysStMon_AEBMCUMonitor_AEB_MCU_Monitor_Ego_Mon_SSR_FuSaMonitor_SysStMon_21 autosar_swc_fusamon_Subsystem_Reference_SysStMon_AEBMCUMonitor_AEB_MCU_Monitor_Ego_Mon_SSR_FuSaMonitor_SysStMon_22 autosar_swc_fusamon_Subsystem_Reference_SysStMon_AEBMCUMonitor_AEB_MCU_Monitor_Ego_Mon_SSR_FuSaMonitor_SysStMon_23 autosar_swc_fusamon_Subsystem_Reference_SysStMon_AEBMCUMonitor_AEB_MCU_Monitor_Ego_Mon_SSR_FuSaMonitor_SysStMon_24 autosar_swc_fusamon_Subsystem_Reference_SysStMon_AEBMCUMonitor_AEB_MCU_Monitor_Ego_Mon_SSR_FuSaMonitor_SysStMon_25 /end SUB_GROUP
 /begin REF_CHARACTERISTIC CAL_EgoChkAxDebThld CAL_EgoChkAyDebThld CAL_EgoChkVehSpdAbnDebThld CAL_EgoChkYawRDebThld CAL_EgoCrvtChkDebThld CAL_EgoCrvtChkThld CAL_EgoTrajChkAbnPntHeadingThld CAL_EgoTrajChkAbnPntNum CAL_EgoTrajChkAdjAbnDstThld CAL_EgoTrajChkDebThld CAL_EgoTrajChkVehSpdThld /end REF_CHARACTERISTIC
/end GROUP
/begin GROUP autosar_swc_fusamon_Subsystem_Reference_SysStMon_AEBMCUMonitor_AEB_MCU_Monitor_Ego_Mon_Compare_To_Constant "autosar_swc_fusamon/Subsystem Reference/SysStMon/AEBMCUMonitor/AEB_MCU_Monitor/Ego_Mon/Compare\nTo Constant" /begin REF_CHARACTERISTIC CAL_EgoChkVehSpdAbnThld /end REF_CHARACTERISTIC /end GROUP
/begin GROUP autosar_swc_fusamon_Subsystem_Reference_SysStMon_AEBMCUMonitor_AEB_MCU_Monitor_Ego_Mon_Compare_To_Constant1 "autosar_swc_fusamon/Subsystem Reference/SysStMon/AEBMCUMonitor/AEB_MCU_Monitor/Ego_Mon/Compare\nTo Constant1" /begin REF_CHARACTERISTIC CAL_EgoChkStrWhlAngAbnThld /end REF_CHARACTERISTIC /end GROUP
/begin GROUP autosar_swc_fusamon_Subsystem_Reference_SysStMon_AEBMCUMonitor_AEB_MCU_Monitor_Ego_Mon_Compare_To_Constant2 "autosar_swc_fusamon/Subsystem Reference/SysStMon/AEBMCUMonitor/AEB_MCU_Monitor/Ego_Mon/Compare\nTo Constant2" /begin REF_CHARACTERISTIC CAL_EgoChkAyAbnThld /end REF_CHARACTERISTIC /end GROUP
/begin GROUP autosar_swc_fusamon_Subsystem_Reference_SysStMon_AEBMCUMonitor_AEB_MCU_Monitor_Ego_Mon_Compare_To_Constant3 "autosar_swc_fusamon/Subsystem Reference/SysStMon/AEBMCUMonitor/AEB_MCU_Monitor/Ego_Mon/Compare\nTo Constant3" /begin REF_CHARACTERISTIC CAL_EgoChkAxAbnThld /end REF_CHARACTERISTIC /end GROUP
/begin GROUP autosar_swc_fusamon_Subsystem_Reference_SysStMon_AEBMCUMonitor_AEB_MCU_Monitor_Ego_Mon_Compare_To_Constant4 "autosar_swc_fusamon/Subsystem Reference/SysStMon/AEBMCUMonitor/AEB_MCU_Monitor/Ego_Mon/Compare\nTo Constant4" /begin REF_CHARACTERISTIC CAL_EgoChkYawRAbnThld /end REF_CHARACTERISTIC /end GROUP
/begin GROUP autosar_swc_fusamon_Subsystem_Reference_SysStMon_AEBMCUMonitor_AEB_MCU_Monitor_Ego_Mon_SSR_FuSaMonitor_SysStMon_18 "autosar_swc_fusamon/Subsystem Reference/SysStMon/AEBMCUMonitor/AEB_MCU_Monitor/Ego_Mon/SSR_FuSaMonitor_SysStMon_18" /begin REF_MEASUREMENT autosar_swc_fusamon_rtARID_DEF.UnitDelay_DSTATE_po /end REF_MEASUREMENT /end GROUP
/begin GROUP autosar_swc_fusamon_Subsystem_Reference_SysStMon_AEBMCUMonitor_AEB_MCU_Monitor_Ego_Mon_SSR_FuSaMonitor_SysStMon_20 "autosar_swc_fusamon/Subsystem Reference/SysStMon/AEBMCUMonitor/AEB_MCU_Monitor/Ego_Mon/SSR_FuSaMonitor_SysStMon_20" /begin REF_MEASUREMENT autosar_swc_fusamon_rtARID_DEF.UnitDelay_DSTATE_fd /end REF_MEASUREMENT /end GROUP
/begin GROUP autosar_swc_fusamon_Subsystem_Reference_SysStMon_AEBMCUMonitor_AEB_MCU_Monitor_Ego_Mon_SSR_FuSaMonitor_SysStMon_21 "autosar_swc_fusamon/Subsystem Reference/SysStMon/AEBMCUMonitor/AEB_MCU_Monitor/Ego_Mon/SSR_FuSaMonitor_SysStMon_21" /begin REF_MEASUREMENT autosar_swc_fusamon_rtARID_DEF.UnitDelay_DSTATE_bg /end REF_MEASUREMENT /end GROUP
/begin GROUP autosar_swc_fusamon_Subsystem_Reference_SysStMon_AEBMCUMonitor_AEB_MCU_Monitor_Ego_Mon_SSR_FuSaMonitor_SysStMon_22 "autosar_swc_fusamon/Subsystem Reference/SysStMon/AEBMCUMonitor/AEB_MCU_Monitor/Ego_Mon/SSR_FuSaMonitor_SysStMon_22" /begin REF_MEASUREMENT autosar_swc_fusamon_rtARID_DEF.UnitDelay_DSTATE_bk /end REF_MEASUREMENT /end GROUP
/begin GROUP autosar_swc_fusamon_Subsystem_Reference_SysStMon_AEBMCUMonitor_AEB_MCU_Monitor_Ego_Mon_SSR_FuSaMonitor_SysStMon_23 "autosar_swc_fusamon/Subsystem Reference/SysStMon/AEBMCUMonitor/AEB_MCU_Monitor/Ego_Mon/SSR_FuSaMonitor_SysStMon_23" /begin REF_MEASUREMENT autosar_swc_fusamon_rtARID_DEF.UnitDelay_DSTATE_je /end REF_MEASUREMENT /end GROUP
/begin GROUP autosar_swc_fusamon_Subsystem_Reference_SysStMon_AEBMCUMonitor_AEB_MCU_Monitor_Ego_Mon_SSR_FuSaMonitor_SysStMon_24 "autosar_swc_fusamon/Subsystem Reference/SysStMon/AEBMCUMonitor/AEB_MCU_Monitor/Ego_Mon/SSR_FuSaMonitor_SysStMon_24" /begin REF_MEASUREMENT autosar_swc_fusamon_rtARID_DEF.UnitDelay_DSTATE_ks /end REF_MEASUREMENT /end GROUP
/begin GROUP autosar_swc_fusamon_Subsystem_Reference_SysStMon_AEBMCUMonitor_AEB_MCU_Monitor_Ego_Mon_SSR_FuSaMonitor_SysStMon_25 "autosar_swc_fusamon/Subsystem Reference/SysStMon/AEBMCUMonitor/AEB_MCU_Monitor/Ego_Mon/SSR_FuSaMonitor_SysStMon_25" /begin REF_MEASUREMENT autosar_swc_fusamon_rtARID_DEF.UnitDelay_DSTATE_om /end REF_MEASUREMENT /end GROUP
/begin GROUP autosar_swc_fusamon_Subsystem_Reference_SysStMon_AEBMCUMonitor_AEB_MCU_Monitor_MainTarget_Map "autosar_swc_fusamon/Subsystem Reference/SysStMon/AEBMCUMonitor/AEB_MCU_Monitor/MainTarget_Map" /begin REF_CHARACTERISTIC CAL_PercpObjLatenTiThld /end REF_CHARACTERISTIC /end GROUP
/begin GROUP autosar_swc_fusamon_Subsystem_Reference_SysStMon_AEBMCUMonitor_AEB_MCU_Monitor_MainTarget_Mon "autosar_swc_fusamon/Subsystem Reference/SysStMon/AEBMCUMonitor/AEB_MCU_Monitor/MainTarget_Mon"
 /begin SUB_GROUP autosar_swc_fusamon_Subsystem_Reference_SysStMon_AEBMCUMonitor_AEB_MCU_Monitor_MainTarget_Mon_SSR_FuSaMonitor_SysStMon_10 autosar_swc_fusamon_Subsystem_Reference_SysStMon_AEBMCUMonitor_AEB_MCU_Monitor_MainTarget_Mon_SSR_FuSaMonitor_SysStMon_11 autosar_swc_fusamon_Subsystem_Reference_SysStMon_AEBMCUMonitor_AEB_MCU_Monitor_MainTarget_Mon_SSR_FuSaMonitor_SysStMon_12 autosar_swc_fusamon_Subsystem_Reference_SysStMon_AEBMCUMonitor_AEB_MCU_Monitor_MainTarget_Mon_SSR_FuSaMonitor_SysStMon_13 autosar_swc_fusamon_Subsystem_Reference_SysStMon_AEBMCUMonitor_AEB_MCU_Monitor_MainTarget_Mon_SSR_FuSaMonitor_SysStMon_14 autosar_swc_fusamon_Subsystem_Reference_SysStMon_AEBMCUMonitor_AEB_MCU_Monitor_MainTarget_Mon_SSR_FuSaMonitor_SysStMon_15 autosar_swc_fusamon_Subsystem_Reference_SysStMon_AEBMCUMonitor_AEB_MCU_Monitor_MainTarget_Mon_SSR_FuSaMonitor_SysStMon_16 autosar_swc_fusamon_Subsystem_Reference_SysStMon_AEBMCUMonitor_AEB_MCU_Monitor_MainTarget_Mon_SSR_FuSaMonitor_SysStMon_17 autosar_swc_fusamon_Subsystem_Reference_SysStMon_AEBMCUMonitor_AEB_MCU_Monitor_MainTarget_Mon_SSR_FuSaMonitor_SysStMon_9 /end SUB_GROUP
/end GROUP
/begin GROUP autosar_swc_fusamon_Subsystem_Reference_SysStMon_AEBMCUMonitor_AEB_MCU_Monitor_MainTarget_Mon_SSR_FuSaMonitor_SysStMon_10 "autosar_swc_fusamon/Subsystem Reference/SysStMon/AEBMCUMonitor/AEB_MCU_Monitor/MainTarget_Mon/SSR_FuSaMonitor_SysStMon_10"
 /begin SUB_GROUP autosar_swc_fusamon_Subsystem_Reference_SysStMon_AEBMCUMonitor_AEB_MCU_Monitor_MainTarget_Mon_SSR_FuSaMonitor_SysStMon_10_Compare_To_Constant8 autosar_swc_fusamon_Subsystem_Reference_SysStMon_AEBMCUMonitor_AEB_MCU_Monitor_MainTarget_Mon_SSR_FuSaMonitor_SysStMon_10_SSR_FuSaMonitor_SysStMon_10 /end SUB_GROUP
 /begin REF_CHARACTERISTIC CAL_SftyAebTarPercpVxInVldThld CAL_SftyAebTarPercpVyInVldThld CAL_SftyAebTarVelocityDebThld /end REF_CHARACTERISTIC
 /begin REF_MEASUREMENT autosar_swc_fusamon_rtARID_DEF.Delay2_DSTATE autosar_swc_fusamon_rtARID_DEF.Delay3_DSTATE /end REF_MEASUREMENT
/end GROUP
/begin GROUP autosar_swc_fusamon_Subsystem_Reference_SysStMon_AEBMCUMonitor_AEB_MCU_Monitor_MainTarget_Mon_SSR_FuSaMonitor_SysStMon_10_Compare_To_Constant8 "autosar_swc_fusamon/Subsystem Reference/SysStMon/AEBMCUMonitor/AEB_MCU_Monitor/MainTarget_Mon/SSR_FuSaMonitor_SysStMon_10/Compare\nTo Constant8" /begin REF_CHARACTERISTIC CAL_SftyAebTarSourceTTCEna /end REF_CHARACTERISTIC /end GROUP
/begin GROUP autosar_swc_fusamon_Subsystem_Reference_SysStMon_AEBMCUMonitor_AEB_MCU_Monitor_MainTarget_Mon_SSR_FuSaMonitor_SysStMon_10_SSR_FuSaMonitor_SysStMon_10 "autosar_swc_fusamon/Subsystem Reference/SysStMon/AEBMCUMonitor/AEB_MCU_Monitor/MainTarget_Mon/SSR_FuSaMonitor_SysStMon_10/SSR_FuSaMonitor_SysStMon_10" /begin REF_MEASUREMENT autosar_swc_fusamon_rtARID_DEF.UnitDelay_DSTATE_lt /end REF_MEASUREMENT /end GROUP
/begin GROUP autosar_swc_fusamon_Subsystem_Reference_SysStMon_AEBMCUMonitor_AEB_MCU_Monitor_MainTarget_Mon_SSR_FuSaMonitor_SysStMon_11 "autosar_swc_fusamon/Subsystem Reference/SysStMon/AEBMCUMonitor/AEB_MCU_Monitor/MainTarget_Mon/SSR_FuSaMonitor_SysStMon_11"
 /begin SUB_GROUP autosar_swc_fusamon_Subsystem_Reference_SysStMon_AEBMCUMonitor_AEB_MCU_Monitor_MainTarget_Mon_SSR_FuSaMonitor_SysStMon_11_Compare_To_Constant9 autosar_swc_fusamon_Subsystem_Reference_SysStMon_AEBMCUMonitor_AEB_MCU_Monitor_MainTarget_Mon_SSR_FuSaMonitor_SysStMon_11_SSR_FuSaMonitor_SysStMon_11 /end SUB_GROUP
 /begin REF_CHARACTERISTIC CAL_SftyAebTarAcceDebThld CAL_SftyAebTarPercpAxInVldThld CAL_SftyAebTarPercpAyInVldThld /end REF_CHARACTERISTIC
/end GROUP
/begin GROUP autosar_swc_fusamon_Subsystem_Reference_SysStMon_AEBMCUMonitor_AEB_MCU_Monitor_MainTarget_Mon_SSR_FuSaMonitor_SysStMon_11_Compare_To_Constant9 "autosar_swc_fusamon/Subsystem Reference/SysStMon/AEBMCUMonitor/AEB_MCU_Monitor/MainTarget_Mon/SSR_FuSaMonitor_SysStMon_11/Compare\nTo Constant9" /begin REF_CHARACTERISTIC CAL_SftyAebTarSourceTTCEna /end REF_CHARACTERISTIC /end GROUP
/begin GROUP autosar_swc_fusamon_Subsystem_Reference_SysStMon_AEBMCUMonitor_AEB_MCU_Monitor_MainTarget_Mon_SSR_FuSaMonitor_SysStMon_11_SSR_FuSaMonitor_SysStMon_11 "autosar_swc_fusamon/Subsystem Reference/SysStMon/AEBMCUMonitor/AEB_MCU_Monitor/MainTarget_Mon/SSR_FuSaMonitor_SysStMon_11/SSR_FuSaMonitor_SysStMon_11" /begin REF_MEASUREMENT autosar_swc_fusamon_rtARID_DEF.UnitDelay_DSTATE_j /end REF_MEASUREMENT /end GROUP
/begin GROUP autosar_swc_fusamon_Subsystem_Reference_SysStMon_AEBMCUMonitor_AEB_MCU_Monitor_MainTarget_Mon_SSR_FuSaMonitor_SysStMon_12 "autosar_swc_fusamon/Subsystem Reference/SysStMon/AEBMCUMonitor/AEB_MCU_Monitor/MainTarget_Mon/SSR_FuSaMonitor_SysStMon_12"
 /begin SUB_GROUP autosar_swc_fusamon_Subsystem_Reference_SysStMon_AEBMCUMonitor_AEB_MCU_Monitor_MainTarget_Mon_SSR_FuSaMonitor_SysStMon_12_Compare_To_Constant10 autosar_swc_fusamon_Subsystem_Reference_SysStMon_AEBMCUMonitor_AEB_MCU_Monitor_MainTarget_Mon_SSR_FuSaMonitor_SysStMon_12_SSR_FuSaMonitor_SysStMon_12 /end SUB_GROUP
 /begin REF_CHARACTERISTIC CAL_SftyAebTarHeadingDebThld CAL_SftyAebTarHeadingInVldThld CAL_SftyAebTarHeadingSignJump /end REF_CHARACTERISTIC
 /begin REF_MEASUREMENT autosar_swc_fusamon_rtARID_DEF.Delay4_DSTATE /end REF_MEASUREMENT
/end GROUP
/begin GROUP autosar_swc_fusamon_Subsystem_Reference_SysStMon_AEBMCUMonitor_AEB_MCU_Monitor_MainTarget_Mon_SSR_FuSaMonitor_SysStMon_12_Compare_To_Constant10 "autosar_swc_fusamon/Subsystem Reference/SysStMon/AEBMCUMonitor/AEB_MCU_Monitor/MainTarget_Mon/SSR_FuSaMonitor_SysStMon_12/Compare\nTo Constant10" /begin REF_CHARACTERISTIC CAL_SftyAebTarSourceTTCEna /end REF_CHARACTERISTIC /end GROUP
/begin GROUP autosar_swc_fusamon_Subsystem_Reference_SysStMon_AEBMCUMonitor_AEB_MCU_Monitor_MainTarget_Mon_SSR_FuSaMonitor_SysStMon_12_SSR_FuSaMonitor_SysStMon_12 "autosar_swc_fusamon/Subsystem Reference/SysStMon/AEBMCUMonitor/AEB_MCU_Monitor/MainTarget_Mon/SSR_FuSaMonitor_SysStMon_12/SSR_FuSaMonitor_SysStMon_12" /begin REF_MEASUREMENT autosar_swc_fusamon_rtARID_DEF.UnitDelay_DSTATE_p /end REF_MEASUREMENT /end GROUP
/begin GROUP autosar_swc_fusamon_Subsystem_Reference_SysStMon_AEBMCUMonitor_AEB_MCU_Monitor_MainTarget_Mon_SSR_FuSaMonitor_SysStMon_13 "autosar_swc_fusamon/Subsystem Reference/SysStMon/AEBMCUMonitor/AEB_MCU_Monitor/MainTarget_Mon/SSR_FuSaMonitor_SysStMon_13"
 /begin SUB_GROUP autosar_swc_fusamon_Subsystem_Reference_SysStMon_AEBMCUMonitor_AEB_MCU_Monitor_MainTarget_Mon_SSR_FuSaMonitor_SysStMon_13_Compare_To_Constant11 autosar_swc_fusamon_Subsystem_Reference_SysStMon_AEBMCUMonitor_AEB_MCU_Monitor_MainTarget_Mon_SSR_FuSaMonitor_SysStMon_13_SSR_FuSaMonitor_SysStMon_13 /end SUB_GROUP
 /begin REF_CHARACTERISTIC CAL_SftyAebTarCamIdDebThld /end REF_CHARACTERISTIC
 /begin REF_MEASUREMENT autosar_swc_fusamon_rtARID_DEF.Delay5_DSTATE /end REF_MEASUREMENT
/end GROUP
/begin GROUP autosar_swc_fusamon_Subsystem_Reference_SysStMon_AEBMCUMonitor_AEB_MCU_Monitor_MainTarget_Mon_SSR_FuSaMonitor_SysStMon_13_Compare_To_Constant11 "autosar_swc_fusamon/Subsystem Reference/SysStMon/AEBMCUMonitor/AEB_MCU_Monitor/MainTarget_Mon/SSR_FuSaMonitor_SysStMon_13/Compare\nTo Constant11" /begin REF_CHARACTERISTIC CAL_SftyAebTarSourceTTCEna /end REF_CHARACTERISTIC /end GROUP
/begin GROUP autosar_swc_fusamon_Subsystem_Reference_SysStMon_AEBMCUMonitor_AEB_MCU_Monitor_MainTarget_Mon_SSR_FuSaMonitor_SysStMon_13_SSR_FuSaMonitor_SysStMon_13 "autosar_swc_fusamon/Subsystem Reference/SysStMon/AEBMCUMonitor/AEB_MCU_Monitor/MainTarget_Mon/SSR_FuSaMonitor_SysStMon_13/SSR_FuSaMonitor_SysStMon_13" /begin REF_MEASUREMENT autosar_swc_fusamon_rtARID_DEF.UnitDelay_DSTATE_hh /end REF_MEASUREMENT /end GROUP
/begin GROUP autosar_swc_fusamon_Subsystem_Reference_SysStMon_AEBMCUMonitor_AEB_MCU_Monitor_MainTarget_Mon_SSR_FuSaMonitor_SysStMon_14 "autosar_swc_fusamon/Subsystem Reference/SysStMon/AEBMCUMonitor/AEB_MCU_Monitor/MainTarget_Mon/SSR_FuSaMonitor_SysStMon_14"
 /begin SUB_GROUP autosar_swc_fusamon_Subsystem_Reference_SysStMon_AEBMCUMonitor_AEB_MCU_Monitor_MainTarget_Mon_SSR_FuSaMonitor_SysStMon_14_Compare_To_Constant13 autosar_swc_fusamon_Subsystem_Reference_SysStMon_AEBMCUMonitor_AEB_MCU_Monitor_MainTarget_Mon_SSR_FuSaMonitor_SysStMon_14_SSR_FuSaMonitor_SysStMon_14 /end SUB_GROUP
 /begin REF_CHARACTERISTIC CAL_SftyAebTarTypeDebThld /end REF_CHARACTERISTIC
/end GROUP
/begin GROUP autosar_swc_fusamon_Subsystem_Reference_SysStMon_AEBMCUMonitor_AEB_MCU_Monitor_MainTarget_Mon_SSR_FuSaMonitor_SysStMon_14_Compare_To_Constant13 "autosar_swc_fusamon/Subsystem Reference/SysStMon/AEBMCUMonitor/AEB_MCU_Monitor/MainTarget_Mon/SSR_FuSaMonitor_SysStMon_14/Compare\nTo Constant13" /begin REF_CHARACTERISTIC CAL_SftyAebTarSourceTTCEna /end REF_CHARACTERISTIC /end GROUP
/begin GROUP autosar_swc_fusamon_Subsystem_Reference_SysStMon_AEBMCUMonitor_AEB_MCU_Monitor_MainTarget_Mon_SSR_FuSaMonitor_SysStMon_14_SSR_FuSaMonitor_SysStMon_14 "autosar_swc_fusamon/Subsystem Reference/SysStMon/AEBMCUMonitor/AEB_MCU_Monitor/MainTarget_Mon/SSR_FuSaMonitor_SysStMon_14/SSR_FuSaMonitor_SysStMon_14" /begin REF_MEASUREMENT autosar_swc_fusamon_rtARID_DEF.UnitDelay_DSTATE_dh /end REF_MEASUREMENT /end GROUP
/begin GROUP autosar_swc_fusamon_Subsystem_Reference_SysStMon_AEBMCUMonitor_AEB_MCU_Monitor_MainTarget_Mon_SSR_FuSaMonitor_SysStMon_15 "autosar_swc_fusamon/Subsystem Reference/SysStMon/AEBMCUMonitor/AEB_MCU_Monitor/MainTarget_Mon/SSR_FuSaMonitor_SysStMon_15"
 /begin SUB_GROUP autosar_swc_fusamon_Subsystem_Reference_SysStMon_AEBMCUMonitor_AEB_MCU_Monitor_MainTarget_Mon_SSR_FuSaMonitor_SysStMon_15_Compare_To_Constant12 autosar_swc_fusamon_Subsystem_Reference_SysStMon_AEBMCUMonitor_AEB_MCU_Monitor_MainTarget_Mon_SSR_FuSaMonitor_SysStMon_15_SSR_FuSaMonitor_SysStMon_15 /end SUB_GROUP
 /begin REF_CHARACTERISTIC CAL_SftyAebTarVldDebThld /end REF_CHARACTERISTIC
/end GROUP
/begin GROUP autosar_swc_fusamon_Subsystem_Reference_SysStMon_AEBMCUMonitor_AEB_MCU_Monitor_MainTarget_Mon_SSR_FuSaMonitor_SysStMon_15_Compare_To_Constant12 "autosar_swc_fusamon/Subsystem Reference/SysStMon/AEBMCUMonitor/AEB_MCU_Monitor/MainTarget_Mon/SSR_FuSaMonitor_SysStMon_15/Compare\nTo Constant12" /begin REF_CHARACTERISTIC CAL_SftyAebTarSourceTTCEna /end REF_CHARACTERISTIC /end GROUP
/begin GROUP autosar_swc_fusamon_Subsystem_Reference_SysStMon_AEBMCUMonitor_AEB_MCU_Monitor_MainTarget_Mon_SSR_FuSaMonitor_SysStMon_15_SSR_FuSaMonitor_SysStMon_15 "autosar_swc_fusamon/Subsystem Reference/SysStMon/AEBMCUMonitor/AEB_MCU_Monitor/MainTarget_Mon/SSR_FuSaMonitor_SysStMon_15/SSR_FuSaMonitor_SysStMon_15" /begin REF_MEASUREMENT autosar_swc_fusamon_rtARID_DEF.UnitDelay_DSTATE_fq /end REF_MEASUREMENT /end GROUP
/begin GROUP autosar_swc_fusamon_Subsystem_Reference_SysStMon_AEBMCUMonitor_AEB_MCU_Monitor_MainTarget_Mon_SSR_FuSaMonitor_SysStMon_16 "autosar_swc_fusamon/Subsystem Reference/SysStMon/AEBMCUMonitor/AEB_MCU_Monitor/MainTarget_Mon/SSR_FuSaMonitor_SysStMon_16"
 /begin SUB_GROUP autosar_swc_fusamon_Subsystem_Reference_SysStMon_AEBMCUMonitor_AEB_MCU_Monitor_MainTarget_Mon_SSR_FuSaMonitor_SysStMon_16_Compare_To_Constant14 autosar_swc_fusamon_Subsystem_Reference_SysStMon_AEBMCUMonitor_AEB_MCU_Monitor_MainTarget_Mon_SSR_FuSaMonitor_SysStMon_16_SSR_FuSaMonitor_SysStMon_16 /end SUB_GROUP
 /begin REF_CHARACTERISTIC CAL_AebTarConfiChkThld CAL_SftyAebTarConfiDebThld /end REF_CHARACTERISTIC
/end GROUP
/begin GROUP autosar_swc_fusamon_Subsystem_Reference_SysStMon_AEBMCUMonitor_AEB_MCU_Monitor_MainTarget_Mon_SSR_FuSaMonitor_SysStMon_16_Compare_To_Constant14 "autosar_swc_fusamon/Subsystem Reference/SysStMon/AEBMCUMonitor/AEB_MCU_Monitor/MainTarget_Mon/SSR_FuSaMonitor_SysStMon_16/Compare\nTo Constant14" /begin REF_CHARACTERISTIC CAL_SftyAebTarSourceTTCEna /end REF_CHARACTERISTIC /end GROUP
/begin GROUP autosar_swc_fusamon_Subsystem_Reference_SysStMon_AEBMCUMonitor_AEB_MCU_Monitor_MainTarget_Mon_SSR_FuSaMonitor_SysStMon_16_SSR_FuSaMonitor_SysStMon_16 "autosar_swc_fusamon/Subsystem Reference/SysStMon/AEBMCUMonitor/AEB_MCU_Monitor/MainTarget_Mon/SSR_FuSaMonitor_SysStMon_16/SSR_FuSaMonitor_SysStMon_16" /begin REF_MEASUREMENT autosar_swc_fusamon_rtARID_DEF.UnitDelay_DSTATE_m2 /end REF_MEASUREMENT /end GROUP
/begin GROUP autosar_swc_fusamon_Subsystem_Reference_SysStMon_AEBMCUMonitor_AEB_MCU_Monitor_MainTarget_Mon_SSR_FuSaMonitor_SysStMon_17 "autosar_swc_fusamon/Subsystem Reference/SysStMon/AEBMCUMonitor/AEB_MCU_Monitor/MainTarget_Mon/SSR_FuSaMonitor_SysStMon_17"
 /begin SUB_GROUP autosar_swc_fusamon_Subsystem_Reference_SysStMon_AEBMCUMonitor_AEB_MCU_Monitor_MainTarget_Mon_SSR_FuSaMonitor_SysStMon_17_Compare_To_Constant15 autosar_swc_fusamon_Subsystem_Reference_SysStMon_AEBMCUMonitor_AEB_MCU_Monitor_MainTarget_Mon_SSR_FuSaMonitor_SysStMon_17_Compare_To_Constant6 autosar_swc_fusamon_Subsystem_Reference_SysStMon_AEBMCUMonitor_AEB_MCU_Monitor_MainTarget_Mon_SSR_FuSaMonitor_SysStMon_17_SSR_FuSaMonitor_SysStMon_17 /end SUB_GROUP
 /begin REF_CHARACTERISTIC CAL_SftyAebTarTTCDebThld CAL_TTCChkVehSpdAxisX CAL_TTCChkVehSpdAxisY_Byc CAL_TTCChkVehSpdAxisY_Car CAL_TTCChkVehSpdAxisY_Ped CAL_TtcXPoint CAL_TtcYLookupVal /end REF_CHARACTERISTIC
/end GROUP
/begin GROUP autosar_swc_fusamon_Subsystem_Reference_SysStMon_AEBMCUMonitor_AEB_MCU_Monitor_MainTarget_Mon_SSR_FuSaMonitor_SysStMon_17_Compare_To_Constant15 "autosar_swc_fusamon/Subsystem Reference/SysStMon/AEBMCUMonitor/AEB_MCU_Monitor/MainTarget_Mon/SSR_FuSaMonitor_SysStMon_17/Compare\nTo Constant15" /begin REF_CHARACTERISTIC CAL_SftyAebTarSourceTTCEna /end REF_CHARACTERISTIC /end GROUP
/begin GROUP autosar_swc_fusamon_Subsystem_Reference_SysStMon_AEBMCUMonitor_AEB_MCU_Monitor_MainTarget_Mon_SSR_FuSaMonitor_SysStMon_17_Compare_To_Constant6 "autosar_swc_fusamon/Subsystem Reference/SysStMon/AEBMCUMonitor/AEB_MCU_Monitor/MainTarget_Mon/SSR_FuSaMonitor_SysStMon_17/Compare\nTo Constant6" /begin REF_CHARACTERISTIC CAL_YawRateRange /end REF_CHARACTERISTIC /end GROUP
/begin GROUP autosar_swc_fusamon_Subsystem_Reference_SysStMon_AEBMCUMonitor_AEB_MCU_Monitor_MainTarget_Mon_SSR_FuSaMonitor_SysStMon_17_SSR_FuSaMonitor_SysStMon_17 "autosar_swc_fusamon/Subsystem Reference/SysStMon/AEBMCUMonitor/AEB_MCU_Monitor/MainTarget_Mon/SSR_FuSaMonitor_SysStMon_17/SSR_FuSaMonitor_SysStMon_17" /begin REF_MEASUREMENT autosar_swc_fusamon_rtARID_DEF.UnitDelay_DSTATE_ko /end REF_MEASUREMENT /end GROUP
/begin GROUP autosar_swc_fusamon_Subsystem_Reference_SysStMon_AEBMCUMonitor_AEB_MCU_Monitor_MainTarget_Mon_SSR_FuSaMonitor_SysStMon_9 "autosar_swc_fusamon/Subsystem Reference/SysStMon/AEBMCUMonitor/AEB_MCU_Monitor/MainTarget_Mon/SSR_FuSaMonitor_SysStMon_9"
 /begin SUB_GROUP autosar_swc_fusamon_Subsystem_Reference_SysStMon_AEBMCUMonitor_AEB_MCU_Monitor_MainTarget_Mon_SSR_FuSaMonitor_SysStMon_9_Compare_To_Constant7 autosar_swc_fusamon_Subsystem_Reference_SysStMon_AEBMCUMonitor_AEB_MCU_Monitor_MainTarget_Mon_SSR_FuSaMonitor_SysStMon_9_SSR_FuSaMonitor_SysStMon_9 /end SUB_GROUP
 /begin REF_CHARACTERISTIC CAL_SftyAebTarPercpXInVldThld CAL_SftyAebTarPercpYInVldThld CAL_SftyAebTarPosDebThld /end REF_CHARACTERISTIC
 /begin REF_MEASUREMENT autosar_swc_fusamon_rtARID_DEF.Delay1_DSTATE_n autosar_swc_fusamon_rtARID_DEF.Delay_DSTATE_f /end REF_MEASUREMENT
/end GROUP
/begin GROUP autosar_swc_fusamon_Subsystem_Reference_SysStMon_AEBMCUMonitor_AEB_MCU_Monitor_MainTarget_Mon_SSR_FuSaMonitor_SysStMon_9_Compare_To_Constant7 "autosar_swc_fusamon/Subsystem Reference/SysStMon/AEBMCUMonitor/AEB_MCU_Monitor/MainTarget_Mon/SSR_FuSaMonitor_SysStMon_9/Compare\nTo Constant7" /begin REF_CHARACTERISTIC CAL_SftyAebTarSourceTTCEna /end REF_CHARACTERISTIC /end GROUP
/begin GROUP autosar_swc_fusamon_Subsystem_Reference_SysStMon_AEBMCUMonitor_AEB_MCU_Monitor_MainTarget_Mon_SSR_FuSaMonitor_SysStMon_9_SSR_FuSaMonitor_SysStMon_9 "autosar_swc_fusamon/Subsystem Reference/SysStMon/AEBMCUMonitor/AEB_MCU_Monitor/MainTarget_Mon/SSR_FuSaMonitor_SysStMon_9/SSR_FuSaMonitor_SysStMon_9" /begin REF_MEASUREMENT autosar_swc_fusamon_rtARID_DEF.UnitDelay_DSTATE_cn /end REF_MEASUREMENT /end GROUP
/begin GROUP autosar_swc_fusamon_Subsystem_Reference_SysStMon_AEBMCUMonitor_AEB_MCU_Monitor_Safety_AxRqrd_Cal "autosar_swc_fusamon/Subsystem Reference/SysStMon/AEBMCUMonitor/AEB_MCU_Monitor/Safety_AxRqrd_Cal"
 /begin SUB_GROUP autosar_swc_fusamon_Subsystem_Reference_SysStMon_AEBMCUMonitor_AEB_MCU_Monitor_Safety_AxRqrd_Cal_SSR_FuSaMonitor_SysStMon_29 /end SUB_GROUP
/end GROUP
/begin GROUP autosar_swc_fusamon_Subsystem_Reference_SysStMon_AEBMCUMonitor_AEB_MCU_Monitor_Safety_AxRqrd_Cal_SSR_FuSaMonitor_SysStMon_29 "autosar_swc_fusamon/Subsystem Reference/SysStMon/AEBMCUMonitor/AEB_MCU_Monitor/Safety_AxRqrd_Cal/SSR_FuSaMonitor_SysStMon_29"
 /begin SUB_GROUP autosar_swc_fusamon_Subsystem_Reference_SysStMon_AEBMCUMonitor_AEB_MCU_Monitor_Safety_AxRqrd_Cal_SSR_FuSaMonitor_SysStMon_29_Compare_To_Constant /end SUB_GROUP
/end GROUP
/begin GROUP autosar_swc_fusamon_Subsystem_Reference_SysStMon_AEBMCUMonitor_AEB_MCU_Monitor_Safety_AxRqrd_Cal_SSR_FuSaMonitor_SysStMon_29_Compare_To_Constant "autosar_swc_fusamon/Subsystem Reference/SysStMon/AEBMCUMonitor/AEB_MCU_Monitor/Safety_AxRqrd_Cal/SSR_FuSaMonitor_SysStMon_29/Compare\nTo Constant" /begin REF_CHARACTERISTIC CAL_YawRateRange /end REF_CHARACTERISTIC /end GROUP
/begin GROUP autosar_swc_fusamon_Subsystem_Reference_SysStMon_AEBMCUMonitor_AEB_MCU_Monitor_Safety_TTC_Cal "autosar_swc_fusamon/Subsystem Reference/SysStMon/AEBMCUMonitor/AEB_MCU_Monitor/Safety_TTC_Cal" /begin REF_CHARACTERISTIC CAL_YawRateRange /end REF_CHARACTERISTIC /end GROUP
/begin GROUP autosar_swc_fusamon_Subsystem_Reference_SysStMon_AEBMCUMonitor_SSR_FuSaMonitor_SysStMon_3 "autosar_swc_fusamon/Subsystem Reference/SysStMon/AEBMCUMonitor/SSR_FuSaMonitor_SysStMon_3"
 /begin REF_CHARACTERISTIC CAL_AEBAccePedlChkTiWin CAL_AEBAccePedlRateChgUlim CAL_AEBDrvAccePedlOvrdThd CAL_AEBSteerWhlAngSpdOvrdThld /end REF_CHARACTERISTIC
 /begin REF_MEASUREMENT autosar_swc_fusamon_rtARID_DEF.Delay_DSTATE /end REF_MEASUREMENT
/end GROUP
/begin GROUP autosar_swc_fusamon_Subsystem_Reference_SysStMon_AEBMCUMonitor_SSR_FuSaMonitor_SysStMon_4 "autosar_swc_fusamon/Subsystem Reference/SysStMon/AEBMCUMonitor/SSR_FuSaMonitor_SysStMon_4" /begin REF_CHARACTERISTIC CAL_Deb_SftyFlg_AEB_Ovrd_Inhibit /end REF_CHARACTERISTIC /begin REF_MEASUREMENT autosar_swc_fusamon_rtARID_DEF.UnitDelay_DSTATE_m /end REF_MEASUREMENT /end GROUP
/begin GROUP autosar_swc_fusamon_Subsystem_Reference_SysStMon_PilotMCUMonitor "autosar_swc_fusamon/Subsystem Reference/SysStMon/PilotMCUMonitor"
 /begin SUB_GROUP autosar_swc_fusamon_Subsystem_Reference_SysStMon_PilotMCUMonitor_SSR_FuSaMonitor_SysStMon_0 autosar_swc_fusamon_Subsystem_Reference_SysStMon_PilotMCUMonitor_SSR_FuSaMonitor_SysStMon_1 autosar_swc_fusamon_Subsystem_Reference_SysStMon_PilotMCUMonitor_SSR_FuSaMonitor_SysStMon_2 /end SUB_GROUP
/end GROUP
/begin GROUP autosar_swc_fusamon_Subsystem_Reference_SysStMon_PilotMCUMonitor_SSR_FuSaMonitor_SysStMon_0 "autosar_swc_fusamon/Subsystem Reference/SysStMon/PilotMCUMonitor/SSR_FuSaMonitor_SysStMon_0"
 /begin REF_CHARACTERISTIC CAL_PiAcceRamp1 CAL_PiAcceRamp2 CAL_PiAcceThd1 CAL_PiAcceThd2 CAL_PilSpdThd1 CAL_PilSpdThd2 /end REF_CHARACTERISTIC
 /begin REF_MEASUREMENT autosar_swc_fusamon_rtARID_DEF.Delay1_DSTATE /end REF_MEASUREMENT
/end GROUP
/begin GROUP autosar_swc_fusamon_Subsystem_Reference_SysStMon_PilotMCUMonitor_SSR_FuSaMonitor_SysStMon_1 "autosar_swc_fusamon/Subsystem Reference/SysStMon/PilotMCUMonitor/SSR_FuSaMonitor_SysStMon_1" /begin REF_CHARACTERISTIC CAL_Deb_SftyFlg_Pilot_AccPosAbn_Error /end REF_CHARACTERISTIC /begin REF_MEASUREMENT autosar_swc_fusamon_rtARID_DEF.UnitDelay_DSTATE_o0 /end REF_MEASUREMENT /end GROUP
/begin GROUP autosar_swc_fusamon_Subsystem_Reference_SysStMon_PilotMCUMonitor_SSR_FuSaMonitor_SysStMon_2 "autosar_swc_fusamon/Subsystem Reference/SysStMon/PilotMCUMonitor/SSR_FuSaMonitor_SysStMon_2"
 /begin REF_CHARACTERISTIC CAL_ACCAbnJumpTi CAL_DrvAccePedlGent CAL_DrvAccePedlNotPressTiWin /end REF_CHARACTERISTIC
 /begin REF_MEASUREMENT autosar_swc_fusamon_rtARID_DEF.ACCK1 autosar_swc_fusamon_rtARID_DEF.PosK1 autosar_swc_fusamon_rtARID_DEF.t autosar_swc_fusamon_rtARID_DEF.x /end REF_MEASUREMENT
/end GROUP
/begin GROUP autosar_swc_fusamon_Subsystem_Reference_SysStMon_SSR_FuSaMonitor_SysStMon_34 "autosar_swc_fusamon/Subsystem Reference/SysStMon/SSR_FuSaMonitor_SysStMon_34" /begin REF_CHARACTERISTIC CAL_Deb_SftyFlg_SysFuSa_Err /end REF_CHARACTERISTIC
 /begin REF_MEASUREMENT autosar_swc_fusamon_rtARID_DEF.SftyFlg_SysFuSa_Err autosar_swc_fusamon_rtARID_DEF.cnt autosar_swc_fusamon_rtARID_DEF.is_active_c2_autosar_swc_fusamon autosar_swc_fusamon_rtARID_DEF.is_c2_autosar_swc_fusamon /end REF_MEASUREMENT
/end GROUP
/begin GROUP autosar_swc_fusamon_Subsystem_Reference_SysStMon_SSR_FuSaMonitor_SysStMon_35 "autosar_swc_fusamon/Subsystem Reference/SysStMon/SSR_FuSaMonitor_SysStMon_35" /begin REF_CHARACTERISTIC CAL_Deb_SftyFlg_AEB_RGear_Inhibit /end REF_CHARACTERISTIC /begin REF_MEASUREMENT autosar_swc_fusamon_rtARID_DEF.UnitDelay_DSTATE_fvp /end REF_MEASUREMENT /end GROUP
/begin MEASUREMENT HMI_ExecTimestamp.nanoseconds "" ULONG autosar_swc_hmi_CM_uint32 0 0 0 4294967295 ECU_ADDRESS 0xfe4acffc /* @ECU_Address@HMI_ExecTimestamp.nanoseconds@ */ /end MEASUREMENT
/begin MEASUREMENT HMI_ExecTimestamp.seconds "" A_UINT64 autosar_swc_hmi_CM_uint64 0 0 0 18446744073709551615 ECU_ADDRESS 0xfe4ad000 /* @ECU_Address@HMI_ExecTimestamp.seconds@ */ /end MEASUREMENT
/begin MEASUREMENT HMI_ExecTimestamp.timeBaseStatus "" UBYTE autosar_swc_hmi_CM_uint8 0 0 0 255 ECU_ADDRESS 0xfe4acff8 /* @ECU_Address@HMI_ExecTimestamp.timeBaseStatus@ */ /end MEASUREMENT
/begin MEASUREMENT HMI_Update "" UBYTE autosar_swc_hmi_CM_uint8 0 0 0 255 ECU_ADDRESS 0xfe4ad640 /* @ECU_Address@HMI_Update@ */ /end MEASUREMENT
/begin MEASUREMENT HMI_Version "" ULONG autosar_swc_hmi_CM_uint32 0 0 0 4294967295 ECU_ADDRESS 0xfe4ad630 /* @ECU_Address@HMI_Version@ */ /end MEASUREMENT
/begin MEASUREMENT SwcOut_HMI_GENERAL_INFO.ACC_SpdSet "" UBYTE autosar_swc_hmi_CM_uint8 0 0 0 255 ECU_ADDRESS 0xfe4ad019 /* @ECU_Address@SwcOut_HMI_GENERAL_INFO.ACC_SpdSet@ */ /end MEASUREMENT
/begin MEASUREMENT SwcOut_HMI_GENERAL_INFO.ACC_Status "" UBYTE autosar_swc_hmi_CM_uint8 0 0 0 255 ECU_ADDRESS 0xfe4ad008 /* @ECU_Address@SwcOut_HMI_GENERAL_INFO.ACC_Status@ */ /end MEASUREMENT
/begin MEASUREMENT SwcOut_HMI_GENERAL_INFO.ACC_Text_Info "" UBYTE autosar_swc_hmi_CM_uint8 0 0 0 255 ECU_ADDRESS 0xfe4ad022 /* @ECU_Address@SwcOut_HMI_GENERAL_INFO.ACC_Text_Info@ */ /end MEASUREMENT
/begin MEASUREMENT SwcOut_HMI_GENERAL_INFO.ACC_TimeGapSet "" UBYTE autosar_swc_hmi_CM_uint8 0 0 0 255 ECU_ADDRESS 0xfe4ad01a /* @ECU_Address@SwcOut_HMI_GENERAL_INFO.ACC_TimeGapSet@ */ /end MEASUREMENT
/begin MEASUREMENT SwcOut_HMI_GENERAL_INFO.ADC_Text_Info "" UBYTE autosar_swc_hmi_CM_uint8 0 0 0 255 ECU_ADDRESS 0xfe4ad027 /* @ECU_Address@SwcOut_HMI_GENERAL_INFO.ADC_Text_Info@ */ /end MEASUREMENT
/begin MEASUREMENT SwcOut_HMI_GENERAL_INFO.ADC_Text_Warn "" UBYTE autosar_swc_hmi_CM_uint8 0 0 0 255 ECU_ADDRESS 0xfe4ad028 /* @ECU_Address@SwcOut_HMI_GENERAL_INFO.ADC_Text_Warn@ */ /end MEASUREMENT
/begin MEASUREMENT SwcOut_HMI_GENERAL_INFO.ADC_Voice_Info "" UBYTE autosar_swc_hmi_CM_uint8 0 0 0 255 ECU_ADDRESS 0xfe4ad029 /* @ECU_Address@SwcOut_HMI_GENERAL_INFO.ADC_Voice_Info@ */ /end MEASUREMENT
/begin MEASUREMENT SwcOut_HMI_GENERAL_INFO.ADC_WarnForm "" UBYTE autosar_swc_hmi_CM_uint8 0 0 0 255 ECU_ADDRESS 0xfe4ad02a /* @ECU_Address@SwcOut_HMI_GENERAL_INFO.ADC_WarnForm@ */ /end MEASUREMENT
/begin MEASUREMENT SwcOut_HMI_GENERAL_INFO.AEB_Status "" UBYTE autosar_swc_hmi_CM_uint8 0 0 0 255 ECU_ADDRESS 0xfe4ad00a /* @ECU_Address@SwcOut_HMI_GENERAL_INFO.AEB_Status@ */ /end MEASUREMENT
/begin MEASUREMENT SwcOut_HMI_GENERAL_INFO.AEB_Text_Info "" UBYTE autosar_swc_hmi_CM_uint8 0 0 0 255 ECU_ADDRESS 0xfe4ad026 /* @ECU_Address@SwcOut_HMI_GENERAL_INFO.AEB_Text_Info@ */ /end MEASUREMENT
/begin MEASUREMENT SwcOut_HMI_GENERAL_INFO.ALC_Status "" UBYTE autosar_swc_hmi_CM_uint8 0 0 0 255 ECU_ADDRESS 0xfe4ad017 /* @ECU_Address@SwcOut_HMI_GENERAL_INFO.ALC_Status@ */ /end MEASUREMENT
/begin MEASUREMENT SwcOut_HMI_GENERAL_INFO.ALC_Text_Info "" UBYTE autosar_swc_hmi_CM_uint8 0 0 0 255 ECU_ADDRESS 0xfe4ad024 /* @ECU_Address@SwcOut_HMI_GENERAL_INFO.ALC_Text_Info@ */ /end MEASUREMENT
/begin MEASUREMENT SwcOut_HMI_GENERAL_INFO.DAI_Status "" UBYTE autosar_swc_hmi_CM_uint8 0 0 0 255 ECU_ADDRESS 0xfe4ad010 /* @ECU_Address@SwcOut_HMI_GENERAL_INFO.DAI_Status@ */ /end MEASUREMENT
/begin MEASUREMENT SwcOut_HMI_GENERAL_INFO.DW_Status "" UBYTE autosar_swc_hmi_CM_uint8 0 0 0 255 ECU_ADDRESS 0xfe4ad00b /* @ECU_Address@SwcOut_HMI_GENERAL_INFO.DW_Status@ */ /end MEASUREMENT
/begin MEASUREMENT SwcOut_HMI_GENERAL_INFO.ELK_Status "" UBYTE autosar_swc_hmi_CM_uint8 0 0 0 255 ECU_ADDRESS 0xfe4ad00e /* @ECU_Address@SwcOut_HMI_GENERAL_INFO.ELK_Status@ */ /end MEASUREMENT
/begin MEASUREMENT SwcOut_HMI_GENERAL_INFO.FCW_Status "" UBYTE autosar_swc_hmi_CM_uint8 0 0 0 255 ECU_ADDRESS 0xfe4ad009 /* @ECU_Address@SwcOut_HMI_GENERAL_INFO.FCW_Status@ */ /end MEASUREMENT
/begin MEASUREMENT SwcOut_HMI_GENERAL_INFO.ICA_Status "" UBYTE autosar_swc_hmi_CM_uint8 0 0 0 255 ECU_ADDRESS 0xfe4ad00f /* @ECU_Address@SwcOut_HMI_GENERAL_INFO.ICA_Status@ */ /end MEASUREMENT
/begin MEASUREMENT SwcOut_HMI_GENERAL_INFO.IE_Status "" UBYTE autosar_swc_hmi_CM_uint8 0 0 0 255 ECU_ADDRESS 0xfe4ad011 /* @ECU_Address@SwcOut_HMI_GENERAL_INFO.IE_Status@ */ /end MEASUREMENT
/begin MEASUREMENT SwcOut_HMI_GENERAL_INFO.IHBC_Status "" UBYTE autosar_swc_hmi_CM_uint8 0 0 0 255 ECU_ADDRESS 0xfe4ad012 /* @ECU_Address@SwcOut_HMI_GENERAL_INFO.IHBC_Status@ */ /end MEASUREMENT
/begin MEASUREMENT SwcOut_HMI_GENERAL_INFO.ISL_Status "" UBYTE autosar_swc_hmi_CM_uint8 0 0 0 255 ECU_ADDRESS 0xfe4ad015 /* @ECU_Address@SwcOut_HMI_GENERAL_INFO.ISL_Status@ */ /end MEASUREMENT
/begin MEASUREMENT SwcOut_HMI_GENERAL_INFO.LDP_Status "" UBYTE autosar_swc_hmi_CM_uint8 0 0 0 255 ECU_ADDRESS 0xfe4ad00d /* @ECU_Address@SwcOut_HMI_GENERAL_INFO.LDP_Status@ */ /end MEASUREMENT
/begin MEASUREMENT SwcOut_HMI_GENERAL_INFO.LDW_Status "" UBYTE autosar_swc_hmi_CM_uint8 0 0 0 255 ECU_ADDRESS 0xfe4ad00c /* @ECU_Address@SwcOut_HMI_GENERAL_INFO.LDW_Status@ */ /end MEASUREMENT
/begin MEASUREMENT SwcOut_HMI_GENERAL_INFO.LSSIntervention "" UBYTE autosar_swc_hmi_CM_uint8 0 0 0 255 ECU_ADDRESS 0xfe4ad021 /* @ECU_Address@SwcOut_HMI_GENERAL_INFO.LSSIntervention@ */ /end MEASUREMENT
/begin MEASUREMENT SwcOut_HMI_GENERAL_INFO.LaneChange_Display "" UBYTE autosar_swc_hmi_CM_uint8 0 0 0 255 ECU_ADDRESS 0xfe4ad02c /* @ECU_Address@SwcOut_HMI_GENERAL_INFO.LaneChange_Display@ */ /end MEASUREMENT
/begin MEASUREMENT SwcOut_HMI_GENERAL_INFO.LaneChange_dxEnd "" FLOAT32_IEEE autosar_swc_hmi_CM_single 0 0 -3.4E+38 3.4E+38 ECU_ADDRESS 0xfe4ad030 /* @ECU_Address@SwcOut_HMI_GENERAL_INFO.LaneChange_dxEnd@ */ /end MEASUREMENT
/begin MEASUREMENT SwcOut_HMI_GENERAL_INFO.LaneChange_dyEnd "" FLOAT32_IEEE autosar_swc_hmi_CM_single 0 0 -3.4E+38 3.4E+38 ECU_ADDRESS 0xfe4ad034 /* @ECU_Address@SwcOut_HMI_GENERAL_INFO.LaneChange_dyEnd@ */ /end MEASUREMENT
/begin MEASUREMENT SwcOut_HMI_GENERAL_INFO.NOA_Text_Info "" UBYTE autosar_swc_hmi_CM_uint8 0 0 0 255 ECU_ADDRESS 0xfe4ad025 /* @ECU_Address@SwcOut_HMI_GENERAL_INFO.NOA_Text_Info@ */ /end MEASUREMENT
/begin MEASUREMENT SwcOut_HMI_GENERAL_INFO.Pilot_Status "" UBYTE autosar_swc_hmi_CM_uint8 0 0 0 255 ECU_ADDRESS 0xfe4ad018 /* @ECU_Address@SwcOut_HMI_GENERAL_INFO.Pilot_Status@ */ /end MEASUREMENT
/begin MEASUREMENT SwcOut_HMI_GENERAL_INFO.SLASpdLim "" UBYTE autosar_swc_hmi_CM_uint8 0 0 0 255 ECU_ADDRESS 0xfe4ad01b /* @ECU_Address@SwcOut_HMI_GENERAL_INFO.SLASpdLim@ */ /end MEASUREMENT
/begin MEASUREMENT SwcOut_HMI_GENERAL_INFO.SLASpdLimWarn "" UBYTE autosar_swc_hmi_CM_uint8 0 0 0 255 ECU_ADDRESS 0xfe4ad01c /* @ECU_Address@SwcOut_HMI_GENERAL_INFO.SLASpdLimWarn@ */ /end MEASUREMENT
/begin MEASUREMENT SwcOut_HMI_GENERAL_INFO.SLA_Status "" UBYTE autosar_swc_hmi_CM_uint8 0 0 0 255 ECU_ADDRESS 0xfe4ad014 /* @ECU_Address@SwcOut_HMI_GENERAL_INFO.SLA_Status@ */ /end MEASUREMENT
/begin MEASUREMENT SwcOut_HMI_GENERAL_INFO.TJA_Text_Info "" UBYTE autosar_swc_hmi_CM_uint8 0 0 0 255 ECU_ADDRESS 0xfe4ad023 /* @ECU_Address@SwcOut_HMI_GENERAL_INFO.TJA_Text_Info@ */ /end MEASUREMENT
/begin MEASUREMENT SwcOut_HMI_GENERAL_INFO.TLI_Info "" UBYTE autosar_swc_hmi_CM_uint8 0 0 0 255 ECU_ADDRESS 0xfe4ad02b /* @ECU_Address@SwcOut_HMI_GENERAL_INFO.TLI_Info@ */ /end MEASUREMENT
/begin MEASUREMENT SwcOut_HMI_GENERAL_INFO.TLI_Status "" UBYTE autosar_swc_hmi_CM_uint8 0 0 0 255 ECU_ADDRESS 0xfe4ad016 /* @ECU_Address@SwcOut_HMI_GENERAL_INFO.TLI_Status@ */ /end MEASUREMENT
/begin MEASUREMENT SwcOut_HMI_GENERAL_INFO.TSRNoParkWarn "" UBYTE autosar_swc_hmi_CM_uint8 0 0 0 255 ECU_ADDRESS 0xfe4ad020 /* @ECU_Address@SwcOut_HMI_GENERAL_INFO.TSRNoParkWarn@ */ /end MEASUREMENT
/begin MEASUREMENT SwcOut_HMI_GENERAL_INFO.TSRSgnForb "" UBYTE autosar_swc_hmi_CM_uint8 0 0 0 255 ECU_ADDRESS 0xfe4ad01e /* @ECU_Address@SwcOut_HMI_GENERAL_INFO.TSRSgnForb@ */ /end MEASUREMENT
/begin MEASUREMENT SwcOut_HMI_GENERAL_INFO.TSRSgnGiWay "" UBYTE autosar_swc_hmi_CM_uint8 0 0 0 255 ECU_ADDRESS 0xfe4ad01d /* @ECU_Address@SwcOut_HMI_GENERAL_INFO.TSRSgnGiWay@ */ /end MEASUREMENT
/begin MEASUREMENT SwcOut_HMI_GENERAL_INFO.TSRSgnLongStayDisp "" UBYTE autosar_swc_hmi_CM_uint8 0 0 0 255 ECU_ADDRESS 0xfe4ad01f /* @ECU_Address@SwcOut_HMI_GENERAL_INFO.TSRSgnLongStayDisp@ */ /end MEASUREMENT
/begin MEASUREMENT SwcOut_HMI_GENERAL_INFO.TSR_Status "" UBYTE autosar_swc_hmi_CM_uint8 0 0 0 255 ECU_ADDRESS 0xfe4ad013 /* @ECU_Address@SwcOut_HMI_GENERAL_INFO.TSR_Status@ */ /end MEASUREMENT
/begin MEASUREMENT SwcOut_HMI_Herbeat_Info.inner_error "" ULONG autosar_swc_hmi_CM_uint32 0 0 0 4294967295 ECU_ADDRESS 0xfe4ad638 /* @ECU_Address@SwcOut_HMI_Herbeat_Info.inner_error@ */ /end MEASUREMENT
/begin MEASUREMENT SwcOut_HMI_Herbeat_Info.module_status "" UBYTE autosar_swc_hmi_CM_SM_MODULE_STATUS 0 0 0 3 ECU_ADDRESS 0xfe4ad63c /* @ECU_Address@SwcOut_HMI_Herbeat_Info.module_status@ */ /end MEASUREMENT
/begin MEASUREMENT SwcOut_HMI_Herbeat_Info.sequence_num "" UBYTE autosar_swc_hmi_CM_uint8 0 0 0 255 ECU_ADDRESS 0xfe4ad635 /* @ECU_Address@SwcOut_HMI_Herbeat_Info.sequence_num@ */ /end MEASUREMENT
/begin MEASUREMENT SwcOut_HMI_Herbeat_Info.swc_id "" UBYTE autosar_swc_hmi_CM_uint8 0 0 0 255 ECU_ADDRESS 0xfe4ad634 /* @ECU_Address@SwcOut_HMI_Herbeat_Info.swc_id@ */ /end MEASUREMENT
/begin MEASUREMENT SwcOut_HMI_LANE[0].Line_C0 "" FLOAT32_IEEE autosar_swc_hmi_CM_single 0 0 -3.4E+38 3.4E+38 ECU_ADDRESS 0xfe4ad044 /* @ECU_Address@SwcOut_HMI_LANE[0].Line_C0@ */ /end MEASUREMENT
/begin MEASUREMENT SwcOut_HMI_LANE[0].Line_C1 "" FLOAT32_IEEE autosar_swc_hmi_CM_single 0 0 -3.4E+38 3.4E+38 ECU_ADDRESS 0xfe4ad048 /* @ECU_Address@SwcOut_HMI_LANE[0].Line_C1@ */ /end MEASUREMENT
/begin MEASUREMENT SwcOut_HMI_LANE[0].Line_C2 "" FLOAT32_IEEE autosar_swc_hmi_CM_single 0 0 -3.4E+38 3.4E+38 ECU_ADDRESS 0xfe4ad04c /* @ECU_Address@SwcOut_HMI_LANE[0].Line_C2@ */ /end MEASUREMENT
/begin MEASUREMENT SwcOut_HMI_LANE[0].Line_C3 "" FLOAT32_IEEE autosar_swc_hmi_CM_single 0 0 -3.4E+38 3.4E+38 ECU_ADDRESS 0xfe4ad050 /* @ECU_Address@SwcOut_HMI_LANE[0].Line_C3@ */ /end MEASUREMENT
/begin MEASUREMENT SwcOut_HMI_LANE[0].Line_Color "" UBYTE autosar_swc_hmi_CM_uint8 0 0 0 255 ECU_ADDRESS 0xfe4ad03a /* @ECU_Address@SwcOut_HMI_LANE[0].Line_Color@ */ /end MEASUREMENT
/begin MEASUREMENT SwcOut_HMI_LANE[0].Line_Confidence "" FLOAT32_IEEE autosar_swc_hmi_CM_single 0 0 -3.4E+38 3.4E+38 ECU_ADDRESS 0xfe4ad058 /* @ECU_Address@SwcOut_HMI_LANE[0].Line_Confidence@ */ /end MEASUREMENT
/begin MEASUREMENT SwcOut_HMI_LANE[0].Line_ID "" UBYTE autosar_swc_hmi_CM_uint8 0 0 0 255 ECU_ADDRESS 0xfe4ad038 /* @ECU_Address@SwcOut_HMI_LANE[0].Line_ID@ */ /end MEASUREMENT
/begin MEASUREMENT SwcOut_HMI_LANE[0].Line_MarkingWidth "" FLOAT32_IEEE autosar_swc_hmi_CM_single 0 0 -3.4E+38 3.4E+38 ECU_ADDRESS 0xfe4ad054 /* @ECU_Address@SwcOut_HMI_LANE[0].Line_MarkingWidth@ */ /end MEASUREMENT
/begin MEASUREMENT SwcOut_HMI_LANE[0].Line_Type "" UBYTE autosar_swc_hmi_CM_uint8 0 0 0 255 ECU_ADDRESS 0xfe4ad039 /* @ECU_Address@SwcOut_HMI_LANE[0].Line_Type@ */ /end MEASUREMENT
/begin MEASUREMENT SwcOut_HMI_LANE[0].Line_dxEnd "" FLOAT32_IEEE autosar_swc_hmi_CM_single 0 0 -3.4E+38 3.4E+38 ECU_ADDRESS 0xfe4ad040 /* @ECU_Address@SwcOut_HMI_LANE[0].Line_dxEnd@ */ /end MEASUREMENT
/begin MEASUREMENT SwcOut_HMI_LANE[0].Line_dxStart "" FLOAT32_IEEE autosar_swc_hmi_CM_single 0 0 -3.4E+38 3.4E+38 ECU_ADDRESS 0xfe4ad03c /* @ECU_Address@SwcOut_HMI_LANE[0].Line_dxStart@ */ /end MEASUREMENT
/begin MEASUREMENT SwcOut_HMI_LANE[1].Line_C0 "" FLOAT32_IEEE autosar_swc_hmi_CM_single 0 0 -3.4E+38 3.4E+38 ECU_ADDRESS 0xfe4ad068 /* @ECU_Address@SwcOut_HMI_LANE[1].Line_C0@ */ /end MEASUREMENT
/begin MEASUREMENT SwcOut_HMI_LANE[1].Line_C1 "" FLOAT32_IEEE autosar_swc_hmi_CM_single 0 0 -3.4E+38 3.4E+38 ECU_ADDRESS 0xfe4ad06c /* @ECU_Address@SwcOut_HMI_LANE[1].Line_C1@ */ /end MEASUREMENT
/begin MEASUREMENT SwcOut_HMI_LANE[1].Line_C2 "" FLOAT32_IEEE autosar_swc_hmi_CM_single 0 0 -3.4E+38 3.4E+38 ECU_ADDRESS 0xfe4ad070 /* @ECU_Address@SwcOut_HMI_LANE[1].Line_C2@ */ /end MEASUREMENT
/begin MEASUREMENT SwcOut_HMI_LANE[1].Line_C3 "" FLOAT32_IEEE autosar_swc_hmi_CM_single 0 0 -3.4E+38 3.4E+38 ECU_ADDRESS 0xfe4ad074 /* @ECU_Address@SwcOut_HMI_LANE[1].Line_C3@ */ /end MEASUREMENT
/begin MEASUREMENT SwcOut_HMI_LANE[1].Line_Color "" UBYTE autosar_swc_hmi_CM_uint8 0 0 0 255 ECU_ADDRESS 0xfe4ad05e /* @ECU_Address@SwcOut_HMI_LANE[1].Line_Color@ */ /end MEASUREMENT
/begin MEASUREMENT SwcOut_HMI_LANE[1].Line_Confidence "" FLOAT32_IEEE autosar_swc_hmi_CM_single 0 0 -3.4E+38 3.4E+38 ECU_ADDRESS 0xfe4ad07c /* @ECU_Address@SwcOut_HMI_LANE[1].Line_Confidence@ */ /end MEASUREMENT
/begin MEASUREMENT SwcOut_HMI_LANE[1].Line_ID "" UBYTE autosar_swc_hmi_CM_uint8 0 0 0 255 ECU_ADDRESS 0xfe4ad05c /* @ECU_Address@SwcOut_HMI_LANE[1].Line_ID@ */ /end MEASUREMENT
/begin MEASUREMENT SwcOut_HMI_LANE[1].Line_MarkingWidth "" FLOAT32_IEEE autosar_swc_hmi_CM_single 0 0 -3.4E+38 3.4E+38 ECU_ADDRESS 0xfe4ad078 /* @ECU_Address@SwcOut_HMI_LANE[1].Line_MarkingWidth@ */ /end MEASUREMENT
/begin MEASUREMENT SwcOut_HMI_LANE[1].Line_Type "" UBYTE autosar_swc_hmi_CM_uint8 0 0 0 255 ECU_ADDRESS 0xfe4ad05d /* @ECU_Address@SwcOut_HMI_LANE[1].Line_Type@ */ /end MEASUREMENT
/begin MEASUREMENT SwcOut_HMI_LANE[1].Line_dxEnd "" FLOAT32_IEEE autosar_swc_hmi_CM_single 0 0 -3.4E+38 3.4E+38 ECU_ADDRESS 0xfe4ad064 /* @ECU_Address@SwcOut_HMI_LANE[1].Line_dxEnd@ */ /end MEASUREMENT
/begin MEASUREMENT SwcOut_HMI_LANE[1].Line_dxStart "" FLOAT32_IEEE autosar_swc_hmi_CM_single 0 0 -3.4E+38 3.4E+38 ECU_ADDRESS 0xfe4ad060 /* @ECU_Address@SwcOut_HMI_LANE[1].Line_dxStart@ */ /end MEASUREMENT
/begin MEASUREMENT SwcOut_HMI_LANE[2].Line_C0 "" FLOAT32_IEEE autosar_swc_hmi_CM_single 0 0 -3.4E+38 3.4E+38 ECU_ADDRESS 0xfe4ad08c /* @ECU_Address@SwcOut_HMI_LANE[2].Line_C0@ */ /end MEASUREMENT
/begin MEASUREMENT SwcOut_HMI_LANE[2].Line_C1 "" FLOAT32_IEEE autosar_swc_hmi_CM_single 0 0 -3.4E+38 3.4E+38 ECU_ADDRESS 0xfe4ad090 /* @ECU_Address@SwcOut_HMI_LANE[2].Line_C1@ */ /end MEASUREMENT
/begin MEASUREMENT SwcOut_HMI_LANE[2].Line_C2 "" FLOAT32_IEEE autosar_swc_hmi_CM_single 0 0 -3.4E+38 3.4E+38 ECU_ADDRESS 0xfe4ad094 /* @ECU_Address@SwcOut_HMI_LANE[2].Line_C2@ */ /end MEASUREMENT
/begin MEASUREMENT SwcOut_HMI_LANE[2].Line_C3 "" FLOAT32_IEEE autosar_swc_hmi_CM_single 0 0 -3.4E+38 3.4E+38 ECU_ADDRESS 0xfe4ad098 /* @ECU_Address@SwcOut_HMI_LANE[2].Line_C3@ */ /end MEASUREMENT
/begin MEASUREMENT SwcOut_HMI_LANE[2].Line_Color "" UBYTE autosar_swc_hmi_CM_uint8 0 0 0 255 ECU_ADDRESS 0xfe4ad082 /* @ECU_Address@SwcOut_HMI_LANE[2].Line_Color@ */ /end MEASUREMENT
/begin MEASUREMENT SwcOut_HMI_LANE[2].Line_Confidence "" FLOAT32_IEEE autosar_swc_hmi_CM_single 0 0 -3.4E+38 3.4E+38 ECU_ADDRESS 0xfe4ad0a0 /* @ECU_Address@SwcOut_HMI_LANE[2].Line_Confidence@ */ /end MEASUREMENT
/begin MEASUREMENT SwcOut_HMI_LANE[2].Line_ID "" UBYTE autosar_swc_hmi_CM_uint8 0 0 0 255 ECU_ADDRESS 0xfe4ad080 /* @ECU_Address@SwcOut_HMI_LANE[2].Line_ID@ */ /end MEASUREMENT
/begin MEASUREMENT SwcOut_HMI_LANE[2].Line_MarkingWidth "" FLOAT32_IEEE autosar_swc_hmi_CM_single 0 0 -3.4E+38 3.4E+38 ECU_ADDRESS 0xfe4ad09c /* @ECU_Address@SwcOut_HMI_LANE[2].Line_MarkingWidth@ */ /end MEASUREMENT
/begin MEASUREMENT SwcOut_HMI_LANE[2].Line_Type "" UBYTE autosar_swc_hmi_CM_uint8 0 0 0 255 ECU_ADDRESS 0xfe4ad081 /* @ECU_Address@SwcOut_HMI_LANE[2].Line_Type@ */ /end MEASUREMENT
/begin MEASUREMENT SwcOut_HMI_LANE[2].Line_dxEnd "" FLOAT32_IEEE autosar_swc_hmi_CM_single 0 0 -3.4E+38 3.4E+38 ECU_ADDRESS 0xfe4ad088 /* @ECU_Address@SwcOut_HMI_LANE[2].Line_dxEnd@ */ /end MEASUREMENT
/begin MEASUREMENT SwcOut_HMI_LANE[2].Line_dxStart "" FLOAT32_IEEE autosar_swc_hmi_CM_single 0 0 -3.4E+38 3.4E+38 ECU_ADDRESS 0xfe4ad084 /* @ECU_Address@SwcOut_HMI_LANE[2].Line_dxStart@ */ /end MEASUREMENT
/begin MEASUREMENT SwcOut_HMI_LANE[3].Line_C0 "" FLOAT32_IEEE autosar_swc_hmi_CM_single 0 0 -3.4E+38 3.4E+38 ECU_ADDRESS 0xfe4ad0b0 /* @ECU_Address@SwcOut_HMI_LANE[3].Line_C0@ */ /end MEASUREMENT
/begin MEASUREMENT SwcOut_HMI_LANE[3].Line_C1 "" FLOAT32_IEEE autosar_swc_hmi_CM_single 0 0 -3.4E+38 3.4E+38 ECU_ADDRESS 0xfe4ad0b4 /* @ECU_Address@SwcOut_HMI_LANE[3].Line_C1@ */ /end MEASUREMENT
/begin MEASUREMENT SwcOut_HMI_LANE[3].Line_C2 "" FLOAT32_IEEE autosar_swc_hmi_CM_single 0 0 -3.4E+38 3.4E+38 ECU_ADDRESS 0xfe4ad0b8 /* @ECU_Address@SwcOut_HMI_LANE[3].Line_C2@ */ /end MEASUREMENT
/begin MEASUREMENT SwcOut_HMI_LANE[3].Line_C3 "" FLOAT32_IEEE autosar_swc_hmi_CM_single 0 0 -3.4E+38 3.4E+38 ECU_ADDRESS 0xfe4ad0bc /* @ECU_Address@SwcOut_HMI_LANE[3].Line_C3@ */ /end MEASUREMENT
/begin MEASUREMENT SwcOut_HMI_LANE[3].Line_Color "" UBYTE autosar_swc_hmi_CM_uint8 0 0 0 255 ECU_ADDRESS 0xfe4ad0a6 /* @ECU_Address@SwcOut_HMI_LANE[3].Line_Color@ */ /end MEASUREMENT
/begin MEASUREMENT SwcOut_HMI_LANE[3].Line_Confidence "" FLOAT32_IEEE autosar_swc_hmi_CM_single 0 0 -3.4E+38 3.4E+38 ECU_ADDRESS 0xfe4ad0c4 /* @ECU_Address@SwcOut_HMI_LANE[3].Line_Confidence@ */ /end MEASUREMENT
/begin MEASUREMENT SwcOut_HMI_LANE[3].Line_ID "" UBYTE autosar_swc_hmi_CM_uint8 0 0 0 255 ECU_ADDRESS 0xfe4ad0a4 /* @ECU_Address@SwcOut_HMI_LANE[3].Line_ID@ */ /end MEASUREMENT
/begin MEASUREMENT SwcOut_HMI_LANE[3].Line_MarkingWidth "" FLOAT32_IEEE autosar_swc_hmi_CM_single 0 0 -3.4E+38 3.4E+38 ECU_ADDRESS 0xfe4ad0c0 /* @ECU_Address@SwcOut_HMI_LANE[3].Line_MarkingWidth@ */ /end MEASUREMENT
/begin MEASUREMENT SwcOut_HMI_LANE[3].Line_Type "" UBYTE autosar_swc_hmi_CM_uint8 0 0 0 255 ECU_ADDRESS 0xfe4ad0a5 /* @ECU_Address@SwcOut_HMI_LANE[3].Line_Type@ */ /end MEASUREMENT
/begin MEASUREMENT SwcOut_HMI_LANE[3].Line_dxEnd "" FLOAT32_IEEE autosar_swc_hmi_CM_single 0 0 -3.4E+38 3.4E+38 ECU_ADDRESS 0xfe4ad0ac /* @ECU_Address@SwcOut_HMI_LANE[3].Line_dxEnd@ */ /end MEASUREMENT
/begin MEASUREMENT SwcOut_HMI_LANE[3].Line_dxStart "" FLOAT32_IEEE autosar_swc_hmi_CM_single 0 0 -3.4E+38 3.4E+38 ECU_ADDRESS 0xfe4ad0a8 /* @ECU_Address@SwcOut_HMI_LANE[3].Line_dxStart@ */ /end MEASUREMENT
/begin MEASUREMENT SwcOut_HMI_LANE[4].Line_C0 "" FLOAT32_IEEE autosar_swc_hmi_CM_single 0 0 -3.4E+38 3.4E+38 ECU_ADDRESS 0xfe4ad0d4 /* @ECU_Address@SwcOut_HMI_LANE[4].Line_C0@ */ /end MEASUREMENT
/begin MEASUREMENT SwcOut_HMI_LANE[4].Line_C1 "" FLOAT32_IEEE autosar_swc_hmi_CM_single 0 0 -3.4E+38 3.4E+38 ECU_ADDRESS 0xfe4ad0d8 /* @ECU_Address@SwcOut_HMI_LANE[4].Line_C1@ */ /end MEASUREMENT
/begin MEASUREMENT SwcOut_HMI_LANE[4].Line_C2 "" FLOAT32_IEEE autosar_swc_hmi_CM_single 0 0 -3.4E+38 3.4E+38 ECU_ADDRESS 0xfe4ad0dc /* @ECU_Address@SwcOut_HMI_LANE[4].Line_C2@ */ /end MEASUREMENT
/begin MEASUREMENT SwcOut_HMI_LANE[4].Line_C3 "" FLOAT32_IEEE autosar_swc_hmi_CM_single 0 0 -3.4E+38 3.4E+38 ECU_ADDRESS 0xfe4ad0e0 /* @ECU_Address@SwcOut_HMI_LANE[4].Line_C3@ */ /end MEASUREMENT
/begin MEASUREMENT SwcOut_HMI_LANE[4].Line_Color "" UBYTE autosar_swc_hmi_CM_uint8 0 0 0 255 ECU_ADDRESS 0xfe4ad0ca /* @ECU_Address@SwcOut_HMI_LANE[4].Line_Color@ */ /end MEASUREMENT
/begin MEASUREMENT SwcOut_HMI_LANE[4].Line_Confidence "" FLOAT32_IEEE autosar_swc_hmi_CM_single 0 0 -3.4E+38 3.4E+38 ECU_ADDRESS 0xfe4ad0e8 /* @ECU_Address@SwcOut_HMI_LANE[4].Line_Confidence@ */ /end MEASUREMENT
/begin MEASUREMENT SwcOut_HMI_LANE[4].Line_ID "" UBYTE autosar_swc_hmi_CM_uint8 0 0 0 255 ECU_ADDRESS 0xfe4ad0c8 /* @ECU_Address@SwcOut_HMI_LANE[4].Line_ID@ */ /end MEASUREMENT
/begin MEASUREMENT SwcOut_HMI_LANE[4].Line_MarkingWidth "" FLOAT32_IEEE autosar_swc_hmi_CM_single 0 0 -3.4E+38 3.4E+38 ECU_ADDRESS 0xfe4ad0e4 /* @ECU_Address@SwcOut_HMI_LANE[4].Line_MarkingWidth@ */ /end MEASUREMENT
/begin MEASUREMENT SwcOut_HMI_LANE[4].Line_Type "" UBYTE autosar_swc_hmi_CM_uint8 0 0 0 255 ECU_ADDRESS 0xfe4ad0c9 /* @ECU_Address@SwcOut_HMI_LANE[4].Line_Type@ */ /end MEASUREMENT
/begin MEASUREMENT SwcOut_HMI_LANE[4].Line_dxEnd "" FLOAT32_IEEE autosar_swc_hmi_CM_single 0 0 -3.4E+38 3.4E+38 ECU_ADDRESS 0xfe4ad0d0 /* @ECU_Address@SwcOut_HMI_LANE[4].Line_dxEnd@ */ /end MEASUREMENT
/begin MEASUREMENT SwcOut_HMI_LANE[4].Line_dxStart "" FLOAT32_IEEE autosar_swc_hmi_CM_single 0 0 -3.4E+38 3.4E+38 ECU_ADDRESS 0xfe4ad0cc /* @ECU_Address@SwcOut_HMI_LANE[4].Line_dxStart@ */ /end MEASUREMENT
/begin MEASUREMENT SwcOut_HMI_LANE[5].Line_C0 "" FLOAT32_IEEE autosar_swc_hmi_CM_single 0 0 -3.4E+38 3.4E+38 ECU_ADDRESS 0xfe4ad0f8 /* @ECU_Address@SwcOut_HMI_LANE[5].Line_C0@ */ /end MEASUREMENT
/begin MEASUREMENT SwcOut_HMI_LANE[5].Line_C1 "" FLOAT32_IEEE autosar_swc_hmi_CM_single 0 0 -3.4E+38 3.4E+38 ECU_ADDRESS 0xfe4ad0fc /* @ECU_Address@SwcOut_HMI_LANE[5].Line_C1@ */ /end MEASUREMENT
/begin MEASUREMENT SwcOut_HMI_LANE[5].Line_C2 "" FLOAT32_IEEE autosar_swc_hmi_CM_single 0 0 -3.4E+38 3.4E+38 ECU_ADDRESS 0xfe4ad100 /* @ECU_Address@SwcOut_HMI_LANE[5].Line_C2@ */ /end MEASUREMENT
/begin MEASUREMENT SwcOut_HMI_LANE[5].Line_C3 "" FLOAT32_IEEE autosar_swc_hmi_CM_single 0 0 -3.4E+38 3.4E+38 ECU_ADDRESS 0xfe4ad104 /* @ECU_Address@SwcOut_HMI_LANE[5].Line_C3@ */ /end MEASUREMENT
/begin MEASUREMENT SwcOut_HMI_LANE[5].Line_Color "" UBYTE autosar_swc_hmi_CM_uint8 0 0 0 255 ECU_ADDRESS 0xfe4ad0ee /* @ECU_Address@SwcOut_HMI_LANE[5].Line_Color@ */ /end MEASUREMENT
/begin MEASUREMENT SwcOut_HMI_LANE[5].Line_Confidence "" FLOAT32_IEEE autosar_swc_hmi_CM_single 0 0 -3.4E+38 3.4E+38 ECU_ADDRESS 0xfe4ad10c /* @ECU_Address@SwcOut_HMI_LANE[5].Line_Confidence@ */ /end MEASUREMENT
/begin MEASUREMENT SwcOut_HMI_LANE[5].Line_ID "" UBYTE autosar_swc_hmi_CM_uint8 0 0 0 255 ECU_ADDRESS 0xfe4ad0ec /* @ECU_Address@SwcOut_HMI_LANE[5].Line_ID@ */ /end MEASUREMENT
/begin MEASUREMENT SwcOut_HMI_LANE[5].Line_MarkingWidth "" FLOAT32_IEEE autosar_swc_hmi_CM_single 0 0 -3.4E+38 3.4E+38 ECU_ADDRESS 0xfe4ad108 /* @ECU_Address@SwcOut_HMI_LANE[5].Line_MarkingWidth@ */ /end MEASUREMENT
/begin MEASUREMENT SwcOut_HMI_LANE[5].Line_Type "" UBYTE autosar_swc_hmi_CM_uint8 0 0 0 255 ECU_ADDRESS 0xfe4ad0ed /* @ECU_Address@SwcOut_HMI_LANE[5].Line_Type@ */ /end MEASUREMENT
/begin MEASUREMENT SwcOut_HMI_LANE[5].Line_dxEnd "" FLOAT32_IEEE autosar_swc_hmi_CM_single 0 0 -3.4E+38 3.4E+38 ECU_ADDRESS 0xfe4ad0f4 /* @ECU_Address@SwcOut_HMI_LANE[5].Line_dxEnd@ */ /end MEASUREMENT
/begin MEASUREMENT SwcOut_HMI_LANE[5].Line_dxStart "" FLOAT32_IEEE autosar_swc_hmi_CM_single 0 0 -3.4E+38 3.4E+38 ECU_ADDRESS 0xfe4ad0f0 /* @ECU_Address@SwcOut_HMI_LANE[5].Line_dxStart@ */ /end MEASUREMENT
/begin MEASUREMENT SwcOut_HMI_LANE[6].Line_C0 "" FLOAT32_IEEE autosar_swc_hmi_CM_single 0 0 -3.4E+38 3.4E+38 ECU_ADDRESS 0xfe4ad11c /* @ECU_Address@SwcOut_HMI_LANE[6].Line_C0@ */ /end MEASUREMENT
/begin MEASUREMENT SwcOut_HMI_LANE[6].Line_C1 "" FLOAT32_IEEE autosar_swc_hmi_CM_single 0 0 -3.4E+38 3.4E+38 ECU_ADDRESS 0xfe4ad120 /* @ECU_Address@SwcOut_HMI_LANE[6].Line_C1@ */ /end MEASUREMENT
/begin MEASUREMENT SwcOut_HMI_LANE[6].Line_C2 "" FLOAT32_IEEE autosar_swc_hmi_CM_single 0 0 -3.4E+38 3.4E+38 ECU_ADDRESS 0xfe4ad124 /* @ECU_Address@SwcOut_HMI_LANE[6].Line_C2@ */ /end MEASUREMENT
/begin MEASUREMENT SwcOut_HMI_LANE[6].Line_C3 "" FLOAT32_IEEE autosar_swc_hmi_CM_single 0 0 -3.4E+38 3.4E+38 ECU_ADDRESS 0xfe4ad128 /* @ECU_Address@SwcOut_HMI_LANE[6].Line_C3@ */ /end MEASUREMENT
/begin MEASUREMENT SwcOut_HMI_LANE[6].Line_Color "" UBYTE autosar_swc_hmi_CM_uint8 0 0 0 255 ECU_ADDRESS 0xfe4ad112 /* @ECU_Address@SwcOut_HMI_LANE[6].Line_Color@ */ /end MEASUREMENT
/begin MEASUREMENT SwcOut_HMI_LANE[6].Line_Confidence "" FLOAT32_IEEE autosar_swc_hmi_CM_single 0 0 -3.4E+38 3.4E+38 ECU_ADDRESS 0xfe4ad130 /* @ECU_Address@SwcOut_HMI_LANE[6].Line_Confidence@ */ /end MEASUREMENT
/begin MEASUREMENT SwcOut_HMI_LANE[6].Line_ID "" UBYTE autosar_swc_hmi_CM_uint8 0 0 0 255 ECU_ADDRESS 0xfe4ad110 /* @ECU_Address@SwcOut_HMI_LANE[6].Line_ID@ */ /end MEASUREMENT
/begin MEASUREMENT SwcOut_HMI_LANE[6].Line_MarkingWidth "" FLOAT32_IEEE autosar_swc_hmi_CM_single 0 0 -3.4E+38 3.4E+38 ECU_ADDRESS 0xfe4ad12c /* @ECU_Address@SwcOut_HMI_LANE[6].Line_MarkingWidth@ */ /end MEASUREMENT
/begin MEASUREMENT SwcOut_HMI_LANE[6].Line_Type "" UBYTE autosar_swc_hmi_CM_uint8 0 0 0 255 ECU_ADDRESS 0xfe4ad111 /* @ECU_Address@SwcOut_HMI_LANE[6].Line_Type@ */ /end MEASUREMENT
/begin MEASUREMENT SwcOut_HMI_LANE[6].Line_dxEnd "" FLOAT32_IEEE autosar_swc_hmi_CM_single 0 0 -3.4E+38 3.4E+38 ECU_ADDRESS 0xfe4ad118 /* @ECU_Address@SwcOut_HMI_LANE[6].Line_dxEnd@ */ /end MEASUREMENT
/begin MEASUREMENT SwcOut_HMI_LANE[6].Line_dxStart "" FLOAT32_IEEE autosar_swc_hmi_CM_single 0 0 -3.4E+38 3.4E+38 ECU_ADDRESS 0xfe4ad114 /* @ECU_Address@SwcOut_HMI_LANE[6].Line_dxStart@ */ /end MEASUREMENT
/begin MEASUREMENT SwcOut_HMI_LANE[7].Line_C0 "" FLOAT32_IEEE autosar_swc_hmi_CM_single 0 0 -3.4E+38 3.4E+38 ECU_ADDRESS 0xfe4ad140 /* @ECU_Address@SwcOut_HMI_LANE[7].Line_C0@ */ /end MEASUREMENT
/begin MEASUREMENT SwcOut_HMI_LANE[7].Line_C1 "" FLOAT32_IEEE autosar_swc_hmi_CM_single 0 0 -3.4E+38 3.4E+38 ECU_ADDRESS 0xfe4ad144 /* @ECU_Address@SwcOut_HMI_LANE[7].Line_C1@ */ /end MEASUREMENT
/begin MEASUREMENT SwcOut_HMI_LANE[7].Line_C2 "" FLOAT32_IEEE autosar_swc_hmi_CM_single 0 0 -3.4E+38 3.4E+38 ECU_ADDRESS 0xfe4ad148 /* @ECU_Address@SwcOut_HMI_LANE[7].Line_C2@ */ /end MEASUREMENT
/begin MEASUREMENT SwcOut_HMI_LANE[7].Line_C3 "" FLOAT32_IEEE autosar_swc_hmi_CM_single 0 0 -3.4E+38 3.4E+38 ECU_ADDRESS 0xfe4ad14c /* @ECU_Address@SwcOut_HMI_LANE[7].Line_C3@ */ /end MEASUREMENT
/begin MEASUREMENT SwcOut_HMI_LANE[7].Line_Color "" UBYTE autosar_swc_hmi_CM_uint8 0 0 0 255 ECU_ADDRESS 0xfe4ad136 /* @ECU_Address@SwcOut_HMI_LANE[7].Line_Color@ */ /end MEASUREMENT
/begin MEASUREMENT SwcOut_HMI_LANE[7].Line_Confidence "" FLOAT32_IEEE autosar_swc_hmi_CM_single 0 0 -3.4E+38 3.4E+38 ECU_ADDRESS 0xfe4ad154 /* @ECU_Address@SwcOut_HMI_LANE[7].Line_Confidence@ */ /end MEASUREMENT
/begin MEASUREMENT SwcOut_HMI_LANE[7].Line_ID "" UBYTE autosar_swc_hmi_CM_uint8 0 0 0 255 ECU_ADDRESS 0xfe4ad134 /* @ECU_Address@SwcOut_HMI_LANE[7].Line_ID@ */ /end MEASUREMENT
/begin MEASUREMENT SwcOut_HMI_LANE[7].Line_MarkingWidth "" FLOAT32_IEEE autosar_swc_hmi_CM_single 0 0 -3.4E+38 3.4E+38 ECU_ADDRESS 0xfe4ad150 /* @ECU_Address@SwcOut_HMI_LANE[7].Line_MarkingWidth@ */ /end MEASUREMENT
/begin MEASUREMENT SwcOut_HMI_LANE[7].Line_Type "" UBYTE autosar_swc_hmi_CM_uint8 0 0 0 255 ECU_ADDRESS 0xfe4ad135 /* @ECU_Address@SwcOut_HMI_LANE[7].Line_Type@ */ /end MEASUREMENT
/begin MEASUREMENT SwcOut_HMI_LANE[7].Line_dxEnd "" FLOAT32_IEEE autosar_swc_hmi_CM_single 0 0 -3.4E+38 3.4E+38 ECU_ADDRESS 0xfe4ad13c /* @ECU_Address@SwcOut_HMI_LANE[7].Line_dxEnd@ */ /end MEASUREMENT
/begin MEASUREMENT SwcOut_HMI_LANE[7].Line_dxStart "" FLOAT32_IEEE autosar_swc_hmi_CM_single 0 0 -3.4E+38 3.4E+38 ECU_ADDRESS 0xfe4ad138 /* @ECU_Address@SwcOut_HMI_LANE[7].Line_dxStart@ */ /end MEASUREMENT
/begin MEASUREMENT SwcOut_HMI_Light_Req.BeamactiveSts "" UBYTE autosar_swc_hmi_CM_uint8 0 0 0 255 ECU_ADDRESS 0xfe4ad15b /* @ECU_Address@SwcOut_HMI_Light_Req.BeamactiveSts@ */ /end MEASUREMENT
/begin MEASUREMENT SwcOut_HMI_Light_Req.Beamlightreq "" UBYTE autosar_swc_hmi_CM_uint8 0 0 0 255 ECU_ADDRESS 0xfe4ad15c /* @ECU_Address@SwcOut_HMI_Light_Req.Beamlightreq@ */ /end MEASUREMENT
/begin MEASUREMENT SwcOut_HMI_Light_Req.BrkLiReq "" UBYTE autosar_swc_hmi_CM_uint8 0 0 0 255 ECU_ADDRESS 0xfe4ad158 /* @ECU_Address@SwcOut_HMI_Light_Req.BrkLiReq@ */ /end MEASUREMENT
/begin MEASUREMENT SwcOut_HMI_Light_Req.EmeglampReq "" UBYTE autosar_swc_hmi_CM_uint8 0 0 0 255 ECU_ADDRESS 0xfe4ad15d /* @ECU_Address@SwcOut_HMI_Light_Req.EmeglampReq@ */ /end MEASUREMENT
/begin MEASUREMENT SwcOut_HMI_Light_Req.Frntwiprsts "" UBYTE autosar_swc_hmi_CM_uint8 0 0 0 255 ECU_ADDRESS 0xfe4ad159 /* @ECU_Address@SwcOut_HMI_Light_Req.Frntwiprsts@ */ /end MEASUREMENT
/begin MEASUREMENT SwcOut_HMI_Light_Req.IHBC_HighBeamReq "" UBYTE autosar_swc_hmi_CM_uint8 0 0 0 255 ECU_ADDRESS 0xfe4ad15f /* @ECU_Address@SwcOut_HMI_Light_Req.IHBC_HighBeamReq@ */ /end MEASUREMENT
/begin MEASUREMENT SwcOut_HMI_Light_Req.IHBC_Status "" UBYTE autosar_swc_hmi_CM_uint8 0 0 0 255 ECU_ADDRESS 0xfe4ad15e /* @ECU_Address@SwcOut_HMI_Light_Req.IHBC_Status@ */ /end MEASUREMENT
/begin MEASUREMENT SwcOut_HMI_Light_Req.Turnlightind "" UBYTE autosar_swc_hmi_CM_uint8 0 0 0 255 ECU_ADDRESS 0xfe4ad15a /* @ECU_Address@SwcOut_HMI_Light_Req.Turnlightind@ */ /end MEASUREMENT
/begin MEASUREMENT SwcOut_HMI_OBJECT[0].Tgt_Color "" UBYTE autosar_swc_hmi_CM_uint8 0 0 0 255 ECU_ADDRESS 0xfe4ad162 /* @ECU_Address@SwcOut_HMI_OBJECT[0].Tgt_Color@ */ /end MEASUREMENT
/begin MEASUREMENT SwcOut_HMI_OBJECT[0].Tgt_Detn "" UBYTE autosar_swc_hmi_CM_uint8 0 0 0 255 ECU_ADDRESS 0xfe4ad163 /* @ECU_Address@SwcOut_HMI_OBJECT[0].Tgt_Detn@ */ /end MEASUREMENT
/begin MEASUREMENT SwcOut_HMI_OBJECT[0].Tgt_Dx "" FLOAT32_IEEE autosar_swc_hmi_CM_single 0 0 -3.4E+38 3.4E+38 ECU_ADDRESS 0xfe4ad168 /* @ECU_Address@SwcOut_HMI_OBJECT[0].Tgt_Dx@ */ /end MEASUREMENT
/begin MEASUREMENT SwcOut_HMI_OBJECT[0].Tgt_Dy "" FLOAT32_IEEE autosar_swc_hmi_CM_single 0 0 -3.4E+38 3.4E+38 ECU_ADDRESS 0xfe4ad16c /* @ECU_Address@SwcOut_HMI_OBJECT[0].Tgt_Dy@ */ /end MEASUREMENT
/begin MEASUREMENT SwcOut_HMI_OBJECT[0].Tgt_Heading "" SWORD autosar_swc_hmi_CM_int16 0 0 -32768 32767 ECU_ADDRESS 0xfe4ad166 /* @ECU_Address@SwcOut_HMI_OBJECT[0].Tgt_Heading@ */ /end MEASUREMENT
/begin MEASUREMENT SwcOut_HMI_OBJECT[0].Tgt_Height "" FLOAT32_IEEE autosar_swc_hmi_CM_single 0 0 -3.4E+38 3.4E+38 ECU_ADDRESS 0xfe4ad17c /* @ECU_Address@SwcOut_HMI_OBJECT[0].Tgt_Height@ */ /end MEASUREMENT
/begin MEASUREMENT SwcOut_HMI_OBJECT[0].Tgt_ID "" UBYTE autosar_swc_hmi_CM_uint8 0 0 0 255 ECU_ADDRESS 0xfe4ad160 /* @ECU_Address@SwcOut_HMI_OBJECT[0].Tgt_ID@ */ /end MEASUREMENT
/begin MEASUREMENT SwcOut_HMI_OBJECT[0].Tgt_Type "" UBYTE autosar_swc_hmi_CM_uint8 0 0 0 255 ECU_ADDRESS 0xfe4ad161 /* @ECU_Address@SwcOut_HMI_OBJECT[0].Tgt_Type@ */ /end MEASUREMENT
/begin MEASUREMENT SwcOut_HMI_OBJECT[0].Tgt_Vx "" FLOAT32_IEEE autosar_swc_hmi_CM_single 0 0 -3.4E+38 3.4E+38 ECU_ADDRESS 0xfe4ad170 /* @ECU_Address@SwcOut_HMI_OBJECT[0].Tgt_Vx@ */ /end MEASUREMENT
/begin MEASUREMENT SwcOut_HMI_OBJECT[0].Tgt_Vy "" FLOAT32_IEEE autosar_swc_hmi_CM_single 0 0 -3.4E+38 3.4E+38 ECU_ADDRESS 0xfe4ad174 /* @ECU_Address@SwcOut_HMI_OBJECT[0].Tgt_Vy@ */ /end MEASUREMENT
/begin MEASUREMENT SwcOut_HMI_OBJECT[0].Tgt_Width "" FLOAT32_IEEE autosar_swc_hmi_CM_single 0 0 -3.4E+38 3.4E+38 ECU_ADDRESS 0xfe4ad178 /* @ECU_Address@SwcOut_HMI_OBJECT[0].Tgt_Width@ */ /end MEASUREMENT
/begin MEASUREMENT SwcOut_HMI_OBJECT[0].Tgt_length "" FLOAT32_IEEE autosar_swc_hmi_CM_single 0 0 -3.4E+38 3.4E+38 ECU_ADDRESS 0xfe4ad180 /* @ECU_Address@SwcOut_HMI_OBJECT[0].Tgt_length@ */ /end MEASUREMENT
/begin MEASUREMENT SwcOut_HMI_OBJECT[0].Tgt_light "" UBYTE autosar_swc_hmi_CM_uint8 0 0 0 255 ECU_ADDRESS 0xfe4ad165 /* @ECU_Address@SwcOut_HMI_OBJECT[0].Tgt_light@ */ /end MEASUREMENT
/begin MEASUREMENT SwcOut_HMI_OBJECT[0].Tgt_movingStatus "" UBYTE autosar_swc_hmi_CM_uint8 0 0 0 255 ECU_ADDRESS 0xfe4ad164 /* @ECU_Address@SwcOut_HMI_OBJECT[0].Tgt_movingStatus@ */ /end MEASUREMENT
/begin MEASUREMENT SwcOut_HMI_OBJECT[1].Tgt_Color "" UBYTE autosar_swc_hmi_CM_uint8 0 0 0 255 ECU_ADDRESS 0xfe4ad186 /* @ECU_Address@SwcOut_HMI_OBJECT[1].Tgt_Color@ */ /end MEASUREMENT
/begin MEASUREMENT SwcOut_HMI_OBJECT[1].Tgt_Detn "" UBYTE autosar_swc_hmi_CM_uint8 0 0 0 255 ECU_ADDRESS 0xfe4ad187 /* @ECU_Address@SwcOut_HMI_OBJECT[1].Tgt_Detn@ */ /end MEASUREMENT
/begin MEASUREMENT SwcOut_HMI_OBJECT[1].Tgt_Dx "" FLOAT32_IEEE autosar_swc_hmi_CM_single 0 0 -3.4E+38 3.4E+38 ECU_ADDRESS 0xfe4ad18c /* @ECU_Address@SwcOut_HMI_OBJECT[1].Tgt_Dx@ */ /end MEASUREMENT
/begin MEASUREMENT SwcOut_HMI_OBJECT[1].Tgt_Dy "" FLOAT32_IEEE autosar_swc_hmi_CM_single 0 0 -3.4E+38 3.4E+38 ECU_ADDRESS 0xfe4ad190 /* @ECU_Address@SwcOut_HMI_OBJECT[1].Tgt_Dy@ */ /end MEASUREMENT
/begin MEASUREMENT SwcOut_HMI_OBJECT[1].Tgt_Heading "" SWORD autosar_swc_hmi_CM_int16 0 0 -32768 32767 ECU_ADDRESS 0xfe4ad18a /* @ECU_Address@SwcOut_HMI_OBJECT[1].Tgt_Heading@ */ /end MEASUREMENT
/begin MEASUREMENT SwcOut_HMI_OBJECT[1].Tgt_Height "" FLOAT32_IEEE autosar_swc_hmi_CM_single 0 0 -3.4E+38 3.4E+38 ECU_ADDRESS 0xfe4ad1a0 /* @ECU_Address@SwcOut_HMI_OBJECT[1].Tgt_Height@ */ /end MEASUREMENT
/begin MEASUREMENT SwcOut_HMI_OBJECT[1].Tgt_ID "" UBYTE autosar_swc_hmi_CM_uint8 0 0 0 255 ECU_ADDRESS 0xfe4ad184 /* @ECU_Address@SwcOut_HMI_OBJECT[1].Tgt_ID@ */ /end MEASUREMENT
/begin MEASUREMENT SwcOut_HMI_OBJECT[1].Tgt_Type "" UBYTE autosar_swc_hmi_CM_uint8 0 0 0 255 ECU_ADDRESS 0xfe4ad185 /* @ECU_Address@SwcOut_HMI_OBJECT[1].Tgt_Type@ */ /end MEASUREMENT
/begin MEASUREMENT SwcOut_HMI_OBJECT[1].Tgt_Vx "" FLOAT32_IEEE autosar_swc_hmi_CM_single 0 0 -3.4E+38 3.4E+38 ECU_ADDRESS 0xfe4ad194 /* @ECU_Address@SwcOut_HMI_OBJECT[1].Tgt_Vx@ */ /end MEASUREMENT
/begin MEASUREMENT SwcOut_HMI_OBJECT[1].Tgt_Vy "" FLOAT32_IEEE autosar_swc_hmi_CM_single 0 0 -3.4E+38 3.4E+38 ECU_ADDRESS 0xfe4ad198 /* @ECU_Address@SwcOut_HMI_OBJECT[1].Tgt_Vy@ */ /end MEASUREMENT
/begin MEASUREMENT SwcOut_HMI_OBJECT[1].Tgt_Width "" FLOAT32_IEEE autosar_swc_hmi_CM_single 0 0 -3.4E+38 3.4E+38 ECU_ADDRESS 0xfe4ad19c /* @ECU_Address@SwcOut_HMI_OBJECT[1].Tgt_Width@ */ /end MEASUREMENT
/begin MEASUREMENT SwcOut_HMI_OBJECT[1].Tgt_length "" FLOAT32_IEEE autosar_swc_hmi_CM_single 0 0 -3.4E+38 3.4E+38 ECU_ADDRESS 0xfe4ad1a4 /* @ECU_Address@SwcOut_HMI_OBJECT[1].Tgt_length@ */ /end MEASUREMENT
/begin MEASUREMENT SwcOut_HMI_OBJECT[1].Tgt_light "" UBYTE autosar_swc_hmi_CM_uint8 0 0 0 255 ECU_ADDRESS 0xfe4ad189 /* @ECU_Address@SwcOut_HMI_OBJECT[1].Tgt_light@ */ /end MEASUREMENT
/begin MEASUREMENT SwcOut_HMI_OBJECT[1].Tgt_movingStatus "" UBYTE autosar_swc_hmi_CM_uint8 0 0 0 255 ECU_ADDRESS 0xfe4ad188 /* @ECU_Address@SwcOut_HMI_OBJECT[1].Tgt_movingStatus@ */ /end MEASUREMENT
/begin MEASUREMENT SwcOut_HMI_OBJECT[2].Tgt_Color "" UBYTE autosar_swc_hmi_CM_uint8 0 0 0 255 ECU_ADDRESS 0xfe4ad1aa /* @ECU_Address@SwcOut_HMI_OBJECT[2].Tgt_Color@ */ /end MEASUREMENT
/begin MEASUREMENT SwcOut_HMI_OBJECT[2].Tgt_Detn "" UBYTE autosar_swc_hmi_CM_uint8 0 0 0 255 ECU_ADDRESS 0xfe4ad1ab /* @ECU_Address@SwcOut_HMI_OBJECT[2].Tgt_Detn@ */ /end MEASUREMENT
/begin MEASUREMENT SwcOut_HMI_OBJECT[2].Tgt_Dx "" FLOAT32_IEEE autosar_swc_hmi_CM_single 0 0 -3.4E+38 3.4E+38 ECU_ADDRESS 0xfe4ad1b0 /* @ECU_Address@SwcOut_HMI_OBJECT[2].Tgt_Dx@ */ /end MEASUREMENT
/begin MEASUREMENT SwcOut_HMI_OBJECT[2].Tgt_Dy "" FLOAT32_IEEE autosar_swc_hmi_CM_single 0 0 -3.4E+38 3.4E+38 ECU_ADDRESS 0xfe4ad1b4 /* @ECU_Address@SwcOut_HMI_OBJECT[2].Tgt_Dy@ */ /end MEASUREMENT
/begin MEASUREMENT SwcOut_HMI_OBJECT[2].Tgt_Heading "" SWORD autosar_swc_hmi_CM_int16 0 0 -32768 32767 ECU_ADDRESS 0xfe4ad1ae /* @ECU_Address@SwcOut_HMI_OBJECT[2].Tgt_Heading@ */ /end MEASUREMENT
/begin MEASUREMENT SwcOut_HMI_OBJECT[2].Tgt_Height "" FLOAT32_IEEE autosar_swc_hmi_CM_single 0 0 -3.4E+38 3.4E+38 ECU_ADDRESS 0xfe4ad1c4 /* @ECU_Address@SwcOut_HMI_OBJECT[2].Tgt_Height@ */ /end MEASUREMENT
/begin MEASUREMENT SwcOut_HMI_OBJECT[2].Tgt_ID "" UBYTE autosar_swc_hmi_CM_uint8 0 0 0 255 ECU_ADDRESS 0xfe4ad1a8 /* @ECU_Address@SwcOut_HMI_OBJECT[2].Tgt_ID@ */ /end MEASUREMENT
/begin MEASUREMENT SwcOut_HMI_OBJECT[2].Tgt_Type "" UBYTE autosar_swc_hmi_CM_uint8 0 0 0 255 ECU_ADDRESS 0xfe4ad1a9 /* @ECU_Address@SwcOut_HMI_OBJECT[2].Tgt_Type@ */ /end MEASUREMENT
/begin MEASUREMENT SwcOut_HMI_OBJECT[2].Tgt_Vx "" FLOAT32_IEEE autosar_swc_hmi_CM_single 0 0 -3.4E+38 3.4E+38 ECU_ADDRESS 0xfe4ad1b8 /* @ECU_Address@SwcOut_HMI_OBJECT[2].Tgt_Vx@ */ /end MEASUREMENT
/begin MEASUREMENT SwcOut_HMI_OBJECT[2].Tgt_Vy "" FLOAT32_IEEE autosar_swc_hmi_CM_single 0 0 -3.4E+38 3.4E+38 ECU_ADDRESS 0xfe4ad1bc /* @ECU_Address@SwcOut_HMI_OBJECT[2].Tgt_Vy@ */ /end MEASUREMENT
/begin MEASUREMENT SwcOut_HMI_OBJECT[2].Tgt_Width "" FLOAT32_IEEE autosar_swc_hmi_CM_single 0 0 -3.4E+38 3.4E+38 ECU_ADDRESS 0xfe4ad1c0 /* @ECU_Address@SwcOut_HMI_OBJECT[2].Tgt_Width@ */ /end MEASUREMENT
/begin MEASUREMENT SwcOut_HMI_OBJECT[2].Tgt_length "" FLOAT32_IEEE autosar_swc_hmi_CM_single 0 0 -3.4E+38 3.4E+38 ECU_ADDRESS 0xfe4ad1c8 /* @ECU_Address@SwcOut_HMI_OBJECT[2].Tgt_length@ */ /end MEASUREMENT
/begin MEASUREMENT SwcOut_HMI_OBJECT[2].Tgt_light "" UBYTE autosar_swc_hmi_CM_uint8 0 0 0 255 ECU_ADDRESS 0xfe4ad1ad /* @ECU_Address@SwcOut_HMI_OBJECT[2].Tgt_light@ */ /end MEASUREMENT
/begin MEASUREMENT SwcOut_HMI_OBJECT[2].Tgt_movingStatus "" UBYTE autosar_swc_hmi_CM_uint8 0 0 0 255 ECU_ADDRESS 0xfe4ad1ac /* @ECU_Address@SwcOut_HMI_OBJECT[2].Tgt_movingStatus@ */ /end MEASUREMENT
/begin MEASUREMENT SwcOut_HMI_OBJECT[3].Tgt_Color "" UBYTE autosar_swc_hmi_CM_uint8 0 0 0 255 ECU_ADDRESS 0xfe4ad1ce /* @ECU_Address@SwcOut_HMI_OBJECT[3].Tgt_Color@ */ /end MEASUREMENT
/begin MEASUREMENT SwcOut_HMI_OBJECT[3].Tgt_Detn "" UBYTE autosar_swc_hmi_CM_uint8 0 0 0 255 ECU_ADDRESS 0xfe4ad1cf /* @ECU_Address@SwcOut_HMI_OBJECT[3].Tgt_Detn@ */ /end MEASUREMENT
/begin MEASUREMENT SwcOut_HMI_OBJECT[3].Tgt_Dx "" FLOAT32_IEEE autosar_swc_hmi_CM_single 0 0 -3.4E+38 3.4E+38 ECU_ADDRESS 0xfe4ad1d4 /* @ECU_Address@SwcOut_HMI_OBJECT[3].Tgt_Dx@ */ /end MEASUREMENT
/begin MEASUREMENT SwcOut_HMI_OBJECT[3].Tgt_Dy "" FLOAT32_IEEE autosar_swc_hmi_CM_single 0 0 -3.4E+38 3.4E+38 ECU_ADDRESS 0xfe4ad1d8 /* @ECU_Address@SwcOut_HMI_OBJECT[3].Tgt_Dy@ */ /end MEASUREMENT
/begin MEASUREMENT SwcOut_HMI_OBJECT[3].Tgt_Heading "" SWORD autosar_swc_hmi_CM_int16 0 0 -32768 32767 ECU_ADDRESS 0xfe4ad1d2 /* @ECU_Address@SwcOut_HMI_OBJECT[3].Tgt_Heading@ */ /end MEASUREMENT
/begin MEASUREMENT SwcOut_HMI_OBJECT[3].Tgt_Height "" FLOAT32_IEEE autosar_swc_hmi_CM_single 0 0 -3.4E+38 3.4E+38 ECU_ADDRESS 0xfe4ad1e8 /* @ECU_Address@SwcOut_HMI_OBJECT[3].Tgt_Height@ */ /end MEASUREMENT
/begin MEASUREMENT SwcOut_HMI_OBJECT[3].Tgt_ID "" UBYTE autosar_swc_hmi_CM_uint8 0 0 0 255 ECU_ADDRESS 0xfe4ad1cc /* @ECU_Address@SwcOut_HMI_OBJECT[3].Tgt_ID@ */ /end MEASUREMENT
/begin MEASUREMENT SwcOut_HMI_OBJECT[3].Tgt_Type "" UBYTE autosar_swc_hmi_CM_uint8 0 0 0 255 ECU_ADDRESS 0xfe4ad1cd /* @ECU_Address@SwcOut_HMI_OBJECT[3].Tgt_Type@ */ /end MEASUREMENT
/begin MEASUREMENT SwcOut_HMI_OBJECT[3].Tgt_Vx "" FLOAT32_IEEE autosar_swc_hmi_CM_single 0 0 -3.4E+38 3.4E+38 ECU_ADDRESS 0xfe4ad1dc /* @ECU_Address@SwcOut_HMI_OBJECT[3].Tgt_Vx@ */ /end MEASUREMENT
/begin MEASUREMENT SwcOut_HMI_OBJECT[3].Tgt_Vy "" FLOAT32_IEEE autosar_swc_hmi_CM_single 0 0 -3.4E+38 3.4E+38 ECU_ADDRESS 0xfe4ad1e0 /* @ECU_Address@SwcOut_HMI_OBJECT[3].Tgt_Vy@ */ /end MEASUREMENT
/begin MEASUREMENT SwcOut_HMI_OBJECT[3].Tgt_Width "" FLOAT32_IEEE autosar_swc_hmi_CM_single 0 0 -3.4E+38 3.4E+38 ECU_ADDRESS 0xfe4ad1e4 /* @ECU_Address@SwcOut_HMI_OBJECT[3].Tgt_Width@ */ /end MEASUREMENT
/begin MEASUREMENT SwcOut_HMI_OBJECT[3].Tgt_length "" FLOAT32_IEEE autosar_swc_hmi_CM_single 0 0 -3.4E+38 3.4E+38 ECU_ADDRESS 0xfe4ad1ec /* @ECU_Address@SwcOut_HMI_OBJECT[3].Tgt_length@ */ /end MEASUREMENT
/begin MEASUREMENT SwcOut_HMI_OBJECT[3].Tgt_light "" UBYTE autosar_swc_hmi_CM_uint8 0 0 0 255 ECU_ADDRESS 0xfe4ad1d1 /* @ECU_Address@SwcOut_HMI_OBJECT[3].Tgt_light@ */ /end MEASUREMENT
/begin MEASUREMENT SwcOut_HMI_OBJECT[3].Tgt_movingStatus "" UBYTE autosar_swc_hmi_CM_uint8 0 0 0 255 ECU_ADDRESS 0xfe4ad1d0 /* @ECU_Address@SwcOut_HMI_OBJECT[3].Tgt_movingStatus@ */ /end MEASUREMENT
/begin MEASUREMENT SwcOut_HMI_OBJECT[4].Tgt_Color "" UBYTE autosar_swc_hmi_CM_uint8 0 0 0 255 ECU_ADDRESS 0xfe4ad1f2 /* @ECU_Address@SwcOut_HMI_OBJECT[4].Tgt_Color@ */ /end MEASUREMENT
/begin MEASUREMENT SwcOut_HMI_OBJECT[4].Tgt_Detn "" UBYTE autosar_swc_hmi_CM_uint8 0 0 0 255 ECU_ADDRESS 0xfe4ad1f3 /* @ECU_Address@SwcOut_HMI_OBJECT[4].Tgt_Detn@ */ /end MEASUREMENT
/begin MEASUREMENT SwcOut_HMI_OBJECT[4].Tgt_Dx "" FLOAT32_IEEE autosar_swc_hmi_CM_single 0 0 -3.4E+38 3.4E+38 ECU_ADDRESS 0xfe4ad1f8 /* @ECU_Address@SwcOut_HMI_OBJECT[4].Tgt_Dx@ */ /end MEASUREMENT
/begin MEASUREMENT SwcOut_HMI_OBJECT[4].Tgt_Dy "" FLOAT32_IEEE autosar_swc_hmi_CM_single 0 0 -3.4E+38 3.4E+38 ECU_ADDRESS 0xfe4ad1fc /* @ECU_Address@SwcOut_HMI_OBJECT[4].Tgt_Dy@ */ /end MEASUREMENT
/begin MEASUREMENT SwcOut_HMI_OBJECT[4].Tgt_Heading "" SWORD autosar_swc_hmi_CM_int16 0 0 -32768 32767 ECU_ADDRESS 0xfe4ad1f6 /* @ECU_Address@SwcOut_HMI_OBJECT[4].Tgt_Heading@ */ /end MEASUREMENT
/begin MEASUREMENT SwcOut_HMI_OBJECT[4].Tgt_Height "" FLOAT32_IEEE autosar_swc_hmi_CM_single 0 0 -3.4E+38 3.4E+38 ECU_ADDRESS 0xfe4ad20c /* @ECU_Address@SwcOut_HMI_OBJECT[4].Tgt_Height@ */ /end MEASUREMENT
/begin MEASUREMENT SwcOut_HMI_OBJECT[4].Tgt_ID "" UBYTE autosar_swc_hmi_CM_uint8 0 0 0 255 ECU_ADDRESS 0xfe4ad1f0 /* @ECU_Address@SwcOut_HMI_OBJECT[4].Tgt_ID@ */ /end MEASUREMENT
/begin MEASUREMENT SwcOut_HMI_OBJECT[4].Tgt_Type "" UBYTE autosar_swc_hmi_CM_uint8 0 0 0 255 ECU_ADDRESS 0xfe4ad1f1 /* @ECU_Address@SwcOut_HMI_OBJECT[4].Tgt_Type@ */ /end MEASUREMENT
/begin MEASUREMENT SwcOut_HMI_OBJECT[4].Tgt_Vx "" FLOAT32_IEEE autosar_swc_hmi_CM_single 0 0 -3.4E+38 3.4E+38 ECU_ADDRESS 0xfe4ad200 /* @ECU_Address@SwcOut_HMI_OBJECT[4].Tgt_Vx@ */ /end MEASUREMENT
/begin MEASUREMENT SwcOut_HMI_OBJECT[4].Tgt_Vy "" FLOAT32_IEEE autosar_swc_hmi_CM_single 0 0 -3.4E+38 3.4E+38 ECU_ADDRESS 0xfe4ad204 /* @ECU_Address@SwcOut_HMI_OBJECT[4].Tgt_Vy@ */ /end MEASUREMENT
/begin MEASUREMENT SwcOut_HMI_OBJECT[4].Tgt_Width "" FLOAT32_IEEE autosar_swc_hmi_CM_single 0 0 -3.4E+38 3.4E+38 ECU_ADDRESS 0xfe4ad208 /* @ECU_Address@SwcOut_HMI_OBJECT[4].Tgt_Width@ */ /end MEASUREMENT
/begin MEASUREMENT SwcOut_HMI_OBJECT[4].Tgt_length "" FLOAT32_IEEE autosar_swc_hmi_CM_single 0 0 -3.4E+38 3.4E+38 ECU_ADDRESS 0xfe4ad210 /* @ECU_Address@SwcOut_HMI_OBJECT[4].Tgt_length@ */ /end MEASUREMENT
/begin MEASUREMENT SwcOut_HMI_OBJECT[4].Tgt_light "" UBYTE autosar_swc_hmi_CM_uint8 0 0 0 255 ECU_ADDRESS 0xfe4ad1f5 /* @ECU_Address@SwcOut_HMI_OBJECT[4].Tgt_light@ */ /end MEASUREMENT
/begin MEASUREMENT SwcOut_HMI_OBJECT[4].Tgt_movingStatus "" UBYTE autosar_swc_hmi_CM_uint8 0 0 0 255 ECU_ADDRESS 0xfe4ad1f4 /* @ECU_Address@SwcOut_HMI_OBJECT[4].Tgt_movingStatus@ */ /end MEASUREMENT
/begin MEASUREMENT SwcOut_HMI_OBJECT[5].Tgt_Color "" UBYTE autosar_swc_hmi_CM_uint8 0 0 0 255 ECU_ADDRESS 0xfe4ad216 /* @ECU_Address@SwcOut_HMI_OBJECT[5].Tgt_Color@ */ /end MEASUREMENT
/begin MEASUREMENT SwcOut_HMI_OBJECT[5].Tgt_Detn "" UBYTE autosar_swc_hmi_CM_uint8 0 0 0 255 ECU_ADDRESS 0xfe4ad217 /* @ECU_Address@SwcOut_HMI_OBJECT[5].Tgt_Detn@ */ /end MEASUREMENT
/begin MEASUREMENT SwcOut_HMI_OBJECT[5].Tgt_Dx "" FLOAT32_IEEE autosar_swc_hmi_CM_single 0 0 -3.4E+38 3.4E+38 ECU_ADDRESS 0xfe4ad21c /* @ECU_Address@SwcOut_HMI_OBJECT[5].Tgt_Dx@ */ /end MEASUREMENT
/begin MEASUREMENT SwcOut_HMI_OBJECT[5].Tgt_Dy "" FLOAT32_IEEE autosar_swc_hmi_CM_single 0 0 -3.4E+38 3.4E+38 ECU_ADDRESS 0xfe4ad220 /* @ECU_Address@SwcOut_HMI_OBJECT[5].Tgt_Dy@ */ /end MEASUREMENT
/begin MEASUREMENT SwcOut_HMI_OBJECT[5].Tgt_Heading "" SWORD autosar_swc_hmi_CM_int16 0 0 -32768 32767 ECU_ADDRESS 0xfe4ad21a /* @ECU_Address@SwcOut_HMI_OBJECT[5].Tgt_Heading@ */ /end MEASUREMENT
/begin MEASUREMENT SwcOut_HMI_OBJECT[5].Tgt_Height "" FLOAT32_IEEE autosar_swc_hmi_CM_single 0 0 -3.4E+38 3.4E+38 ECU_ADDRESS 0xfe4ad230 /* @ECU_Address@SwcOut_HMI_OBJECT[5].Tgt_Height@ */ /end MEASUREMENT
/begin MEASUREMENT SwcOut_HMI_OBJECT[5].Tgt_ID "" UBYTE autosar_swc_hmi_CM_uint8 0 0 0 255 ECU_ADDRESS 0xfe4ad214 /* @ECU_Address@SwcOut_HMI_OBJECT[5].Tgt_ID@ */ /end MEASUREMENT
/begin MEASUREMENT SwcOut_HMI_OBJECT[5].Tgt_Type "" UBYTE autosar_swc_hmi_CM_uint8 0 0 0 255 ECU_ADDRESS 0xfe4ad215 /* @ECU_Address@SwcOut_HMI_OBJECT[5].Tgt_Type@ */ /end MEASUREMENT
/begin MEASUREMENT SwcOut_HMI_OBJECT[5].Tgt_Vx "" FLOAT32_IEEE autosar_swc_hmi_CM_single 0 0 -3.4E+38 3.4E+38 ECU_ADDRESS 0xfe4ad224 /* @ECU_Address@SwcOut_HMI_OBJECT[5].Tgt_Vx@ */ /end MEASUREMENT
/begin MEASUREMENT SwcOut_HMI_OBJECT[5].Tgt_Vy "" FLOAT32_IEEE autosar_swc_hmi_CM_single 0 0 -3.4E+38 3.4E+38 ECU_ADDRESS 0xfe4ad228 /* @ECU_Address@SwcOut_HMI_OBJECT[5].Tgt_Vy@ */ /end MEASUREMENT
/begin MEASUREMENT SwcOut_HMI_OBJECT[5].Tgt_Width "" FLOAT32_IEEE autosar_swc_hmi_CM_single 0 0 -3.4E+38 3.4E+38 ECU_ADDRESS 0xfe4ad22c /* @ECU_Address@SwcOut_HMI_OBJECT[5].Tgt_Width@ */ /end MEASUREMENT
/begin MEASUREMENT SwcOut_HMI_OBJECT[5].Tgt_length "" FLOAT32_IEEE autosar_swc_hmi_CM_single 0 0 -3.4E+38 3.4E+38 ECU_ADDRESS 0xfe4ad234 /* @ECU_Address@SwcOut_HMI_OBJECT[5].Tgt_length@ */ /end MEASUREMENT
/begin MEASUREMENT SwcOut_HMI_OBJECT[5].Tgt_light "" UBYTE autosar_swc_hmi_CM_uint8 0 0 0 255 ECU_ADDRESS 0xfe4ad219 /* @ECU_Address@SwcOut_HMI_OBJECT[5].Tgt_light@ */ /end MEASUREMENT
/begin MEASUREMENT SwcOut_HMI_OBJECT[5].Tgt_movingStatus "" UBYTE autosar_swc_hmi_CM_uint8 0 0 0 255 ECU_ADDRESS 0xfe4ad218 /* @ECU_Address@SwcOut_HMI_OBJECT[5].Tgt_movingStatus@ */ /end MEASUREMENT
/begin MEASUREMENT SwcOut_HMI_OBJECT[6].Tgt_Color "" UBYTE autosar_swc_hmi_CM_uint8 0 0 0 255 ECU_ADDRESS 0xfe4ad23a /* @ECU_Address@SwcOut_HMI_OBJECT[6].Tgt_Color@ */ /end MEASUREMENT
/begin MEASUREMENT SwcOut_HMI_OBJECT[6].Tgt_Detn "" UBYTE autosar_swc_hmi_CM_uint8 0 0 0 255 ECU_ADDRESS 0xfe4ad23b /* @ECU_Address@SwcOut_HMI_OBJECT[6].Tgt_Detn@ */ /end MEASUREMENT
/begin MEASUREMENT SwcOut_HMI_OBJECT[6].Tgt_Dx "" FLOAT32_IEEE autosar_swc_hmi_CM_single 0 0 -3.4E+38 3.4E+38 ECU_ADDRESS 0xfe4ad240 /* @ECU_Address@SwcOut_HMI_OBJECT[6].Tgt_Dx@ */ /end MEASUREMENT
/begin MEASUREMENT SwcOut_HMI_OBJECT[6].Tgt_Dy "" FLOAT32_IEEE autosar_swc_hmi_CM_single 0 0 -3.4E+38 3.4E+38 ECU_ADDRESS 0xfe4ad244 /* @ECU_Address@SwcOut_HMI_OBJECT[6].Tgt_Dy@ */ /end MEASUREMENT
/begin MEASUREMENT SwcOut_HMI_OBJECT[6].Tgt_Heading "" SWORD autosar_swc_hmi_CM_int16 0 0 -32768 32767 ECU_ADDRESS 0xfe4ad23e /* @ECU_Address@SwcOut_HMI_OBJECT[6].Tgt_Heading@ */ /end MEASUREMENT
/begin MEASUREMENT SwcOut_HMI_OBJECT[6].Tgt_Height "" FLOAT32_IEEE autosar_swc_hmi_CM_single 0 0 -3.4E+38 3.4E+38 ECU_ADDRESS 0xfe4ad254 /* @ECU_Address@SwcOut_HMI_OBJECT[6].Tgt_Height@ */ /end MEASUREMENT
/begin MEASUREMENT SwcOut_HMI_OBJECT[6].Tgt_ID "" UBYTE autosar_swc_hmi_CM_uint8 0 0 0 255 ECU_ADDRESS 0xfe4ad238 /* @ECU_Address@SwcOut_HMI_OBJECT[6].Tgt_ID@ */ /end MEASUREMENT
/begin MEASUREMENT SwcOut_HMI_OBJECT[6].Tgt_Type "" UBYTE autosar_swc_hmi_CM_uint8 0 0 0 255 ECU_ADDRESS 0xfe4ad239 /* @ECU_Address@SwcOut_HMI_OBJECT[6].Tgt_Type@ */ /end MEASUREMENT
/begin MEASUREMENT SwcOut_HMI_OBJECT[6].Tgt_Vx "" FLOAT32_IEEE autosar_swc_hmi_CM_single 0 0 -3.4E+38 3.4E+38 ECU_ADDRESS 0xfe4ad248 /* @ECU_Address@SwcOut_HMI_OBJECT[6].Tgt_Vx@ */ /end MEASUREMENT
/begin MEASUREMENT SwcOut_HMI_OBJECT[6].Tgt_Vy "" FLOAT32_IEEE autosar_swc_hmi_CM_single 0 0 -3.4E+38 3.4E+38 ECU_ADDRESS 0xfe4ad24c /* @ECU_Address@SwcOut_HMI_OBJECT[6].Tgt_Vy@ */ /end MEASUREMENT
/begin MEASUREMENT SwcOut_HMI_OBJECT[6].Tgt_Width "" FLOAT32_IEEE autosar_swc_hmi_CM_single 0 0 -3.4E+38 3.4E+38 ECU_ADDRESS 0xfe4ad250 /* @ECU_Address@SwcOut_HMI_OBJECT[6].Tgt_Width@ */ /end MEASUREMENT
/begin MEASUREMENT SwcOut_HMI_OBJECT[6].Tgt_length "" FLOAT32_IEEE autosar_swc_hmi_CM_single 0 0 -3.4E+38 3.4E+38 ECU_ADDRESS 0xfe4ad258 /* @ECU_Address@SwcOut_HMI_OBJECT[6].Tgt_length@ */ /end MEASUREMENT
/begin MEASUREMENT SwcOut_HMI_OBJECT[6].Tgt_light "" UBYTE autosar_swc_hmi_CM_uint8 0 0 0 255 ECU_ADDRESS 0xfe4ad23d /* @ECU_Address@SwcOut_HMI_OBJECT[6].Tgt_light@ */ /end MEASUREMENT
/begin MEASUREMENT SwcOut_HMI_OBJECT[6].Tgt_movingStatus "" UBYTE autosar_swc_hmi_CM_uint8 0 0 0 255 ECU_ADDRESS 0xfe4ad23c /* @ECU_Address@SwcOut_HMI_OBJECT[6].Tgt_movingStatus@ */ /end MEASUREMENT
/begin MEASUREMENT SwcOut_HMI_OBJECT[7].Tgt_Color "" UBYTE autosar_swc_hmi_CM_uint8 0 0 0 255 ECU_ADDRESS 0xfe4ad25e /* @ECU_Address@SwcOut_HMI_OBJECT[7].Tgt_Color@ */ /end MEASUREMENT
/begin MEASUREMENT SwcOut_HMI_OBJECT[7].Tgt_Detn "" UBYTE autosar_swc_hmi_CM_uint8 0 0 0 255 ECU_ADDRESS 0xfe4ad25f /* @ECU_Address@SwcOut_HMI_OBJECT[7].Tgt_Detn@ */ /end MEASUREMENT
/begin MEASUREMENT SwcOut_HMI_OBJECT[7].Tgt_Dx "" FLOAT32_IEEE autosar_swc_hmi_CM_single 0 0 -3.4E+38 3.4E+38 ECU_ADDRESS 0xfe4ad264 /* @ECU_Address@SwcOut_HMI_OBJECT[7].Tgt_Dx@ */ /end MEASUREMENT
/begin MEASUREMENT SwcOut_HMI_OBJECT[7].Tgt_Dy "" FLOAT32_IEEE autosar_swc_hmi_CM_single 0 0 -3.4E+38 3.4E+38 ECU_ADDRESS 0xfe4ad268 /* @ECU_Address@SwcOut_HMI_OBJECT[7].Tgt_Dy@ */ /end MEASUREMENT
/begin MEASUREMENT SwcOut_HMI_OBJECT[7].Tgt_Heading "" SWORD autosar_swc_hmi_CM_int16 0 0 -32768 32767 ECU_ADDRESS 0xfe4ad262 /* @ECU_Address@SwcOut_HMI_OBJECT[7].Tgt_Heading@ */ /end MEASUREMENT
/begin MEASUREMENT SwcOut_HMI_OBJECT[7].Tgt_Height "" FLOAT32_IEEE autosar_swc_hmi_CM_single 0 0 -3.4E+38 3.4E+38 ECU_ADDRESS 0xfe4ad278 /* @ECU_Address@SwcOut_HMI_OBJECT[7].Tgt_Height@ */ /end MEASUREMENT
/begin MEASUREMENT SwcOut_HMI_OBJECT[7].Tgt_ID "" UBYTE autosar_swc_hmi_CM_uint8 0 0 0 255 ECU_ADDRESS 0xfe4ad25c /* @ECU_Address@SwcOut_HMI_OBJECT[7].Tgt_ID@ */ /end MEASUREMENT
/begin MEASUREMENT SwcOut_HMI_OBJECT[7].Tgt_Type "" UBYTE autosar_swc_hmi_CM_uint8 0 0 0 255 ECU_ADDRESS 0xfe4ad25d /* @ECU_Address@SwcOut_HMI_OBJECT[7].Tgt_Type@ */ /end MEASUREMENT
/begin MEASUREMENT SwcOut_HMI_OBJECT[7].Tgt_Vx "" FLOAT32_IEEE autosar_swc_hmi_CM_single 0 0 -3.4E+38 3.4E+38 ECU_ADDRESS 0xfe4ad26c /* @ECU_Address@SwcOut_HMI_OBJECT[7].Tgt_Vx@ */ /end MEASUREMENT
/begin MEASUREMENT SwcOut_HMI_OBJECT[7].Tgt_Vy "" FLOAT32_IEEE autosar_swc_hmi_CM_single 0 0 -3.4E+38 3.4E+38 ECU_ADDRESS 0xfe4ad270 /* @ECU_Address@SwcOut_HMI_OBJECT[7].Tgt_Vy@ */ /end MEASUREMENT
/begin MEASUREMENT SwcOut_HMI_OBJECT[7].Tgt_Width "" FLOAT32_IEEE autosar_swc_hmi_CM_single 0 0 -3.4E+38 3.4E+38 ECU_ADDRESS 0xfe4ad274 /* @ECU_Address@SwcOut_HMI_OBJECT[7].Tgt_Width@ */ /end MEASUREMENT
/begin MEASUREMENT SwcOut_HMI_OBJECT[7].Tgt_length "" FLOAT32_IEEE autosar_swc_hmi_CM_single 0 0 -3.4E+38 3.4E+38 ECU_ADDRESS 0xfe4ad27c /* @ECU_Address@SwcOut_HMI_OBJECT[7].Tgt_length@ */ /end MEASUREMENT
/begin MEASUREMENT SwcOut_HMI_OBJECT[7].Tgt_light "" UBYTE autosar_swc_hmi_CM_uint8 0 0 0 255 ECU_ADDRESS 0xfe4ad261 /* @ECU_Address@SwcOut_HMI_OBJECT[7].Tgt_light@ */ /end MEASUREMENT
/begin MEASUREMENT SwcOut_HMI_OBJECT[7].Tgt_movingStatus "" UBYTE autosar_swc_hmi_CM_uint8 0 0 0 255 ECU_ADDRESS 0xfe4ad260 /* @ECU_Address@SwcOut_HMI_OBJECT[7].Tgt_movingStatus@ */ /end MEASUREMENT
/begin MEASUREMENT SwcOut_HMI_OBJECT[8].Tgt_Color "" UBYTE autosar_swc_hmi_CM_uint8 0 0 0 255 ECU_ADDRESS 0xfe4ad282 /* @ECU_Address@SwcOut_HMI_OBJECT[8].Tgt_Color@ */ /end MEASUREMENT
/begin MEASUREMENT SwcOut_HMI_OBJECT[8].Tgt_Detn "" UBYTE autosar_swc_hmi_CM_uint8 0 0 0 255 ECU_ADDRESS 0xfe4ad283 /* @ECU_Address@SwcOut_HMI_OBJECT[8].Tgt_Detn@ */ /end MEASUREMENT
/begin MEASUREMENT SwcOut_HMI_OBJECT[8].Tgt_Dx "" FLOAT32_IEEE autosar_swc_hmi_CM_single 0 0 -3.4E+38 3.4E+38 ECU_ADDRESS 0xfe4ad288 /* @ECU_Address@SwcOut_HMI_OBJECT[8].Tgt_Dx@ */ /end MEASUREMENT
/begin MEASUREMENT SwcOut_HMI_OBJECT[8].Tgt_Dy "" FLOAT32_IEEE autosar_swc_hmi_CM_single 0 0 -3.4E+38 3.4E+38 ECU_ADDRESS 0xfe4ad28c /* @ECU_Address@SwcOut_HMI_OBJECT[8].Tgt_Dy@ */ /end MEASUREMENT
/begin MEASUREMENT SwcOut_HMI_OBJECT[8].Tgt_Heading "" SWORD autosar_swc_hmi_CM_int16 0 0 -32768 32767 ECU_ADDRESS 0xfe4ad286 /* @ECU_Address@SwcOut_HMI_OBJECT[8].Tgt_Heading@ */ /end MEASUREMENT
/begin MEASUREMENT SwcOut_HMI_OBJECT[8].Tgt_Height "" FLOAT32_IEEE autosar_swc_hmi_CM_single 0 0 -3.4E+38 3.4E+38 ECU_ADDRESS 0xfe4ad29c /* @ECU_Address@SwcOut_HMI_OBJECT[8].Tgt_Height@ */ /end MEASUREMENT
/begin MEASUREMENT SwcOut_HMI_OBJECT[8].Tgt_ID "" UBYTE autosar_swc_hmi_CM_uint8 0 0 0 255 ECU_ADDRESS 0xfe4ad280 /* @ECU_Address@SwcOut_HMI_OBJECT[8].Tgt_ID@ */ /end MEASUREMENT
/begin MEASUREMENT SwcOut_HMI_OBJECT[8].Tgt_Type "" UBYTE autosar_swc_hmi_CM_uint8 0 0 0 255 ECU_ADDRESS 0xfe4ad281 /* @ECU_Address@SwcOut_HMI_OBJECT[8].Tgt_Type@ */ /end MEASUREMENT
/begin MEASUREMENT SwcOut_HMI_OBJECT[8].Tgt_Vx "" FLOAT32_IEEE autosar_swc_hmi_CM_single 0 0 -3.4E+38 3.4E+38 ECU_ADDRESS 0xfe4ad290 /* @ECU_Address@SwcOut_HMI_OBJECT[8].Tgt_Vx@ */ /end MEASUREMENT
/begin MEASUREMENT SwcOut_HMI_OBJECT[8].Tgt_Vy "" FLOAT32_IEEE autosar_swc_hmi_CM_single 0 0 -3.4E+38 3.4E+38 ECU_ADDRESS 0xfe4ad294 /* @ECU_Address@SwcOut_HMI_OBJECT[8].Tgt_Vy@ */ /end MEASUREMENT
/begin MEASUREMENT SwcOut_HMI_OBJECT[8].Tgt_Width "" FLOAT32_IEEE autosar_swc_hmi_CM_single 0 0 -3.4E+38 3.4E+38 ECU_ADDRESS 0xfe4ad298 /* @ECU_Address@SwcOut_HMI_OBJECT[8].Tgt_Width@ */ /end MEASUREMENT
/begin MEASUREMENT SwcOut_HMI_OBJECT[8].Tgt_length "" FLOAT32_IEEE autosar_swc_hmi_CM_single 0 0 -3.4E+38 3.4E+38 ECU_ADDRESS 0xfe4ad2a0 /* @ECU_Address@SwcOut_HMI_OBJECT[8].Tgt_length@ */ /end MEASUREMENT
/begin MEASUREMENT SwcOut_HMI_OBJECT[8].Tgt_light "" UBYTE autosar_swc_hmi_CM_uint8 0 0 0 255 ECU_ADDRESS 0xfe4ad285 /* @ECU_Address@SwcOut_HMI_OBJECT[8].Tgt_light@ */ /end MEASUREMENT
/begin MEASUREMENT SwcOut_HMI_OBJECT[8].Tgt_movingStatus "" UBYTE autosar_swc_hmi_CM_uint8 0 0 0 255 ECU_ADDRESS 0xfe4ad284 /* @ECU_Address@SwcOut_HMI_OBJECT[8].Tgt_movingStatus@ */ /end MEASUREMENT
/begin MEASUREMENT SwcOut_HMI_OBJECT[9].Tgt_Color "" UBYTE autosar_swc_hmi_CM_uint8 0 0 0 255 ECU_ADDRESS 0xfe4ad2a6 /* @ECU_Address@SwcOut_HMI_OBJECT[9].Tgt_Color@ */ /end MEASUREMENT
/begin MEASUREMENT SwcOut_HMI_OBJECT[9].Tgt_Detn "" UBYTE autosar_swc_hmi_CM_uint8 0 0 0 255 ECU_ADDRESS 0xfe4ad2a7 /* @ECU_Address@SwcOut_HMI_OBJECT[9].Tgt_Detn@ */ /end MEASUREMENT
/begin MEASUREMENT SwcOut_HMI_OBJECT[9].Tgt_Dx "" FLOAT32_IEEE autosar_swc_hmi_CM_single 0 0 -3.4E+38 3.4E+38 ECU_ADDRESS 0xfe4ad2ac /* @ECU_Address@SwcOut_HMI_OBJECT[9].Tgt_Dx@ */ /end MEASUREMENT
/begin MEASUREMENT SwcOut_HMI_OBJECT[9].Tgt_Dy "" FLOAT32_IEEE autosar_swc_hmi_CM_single 0 0 -3.4E+38 3.4E+38 ECU_ADDRESS 0xfe4ad2b0 /* @ECU_Address@SwcOut_HMI_OBJECT[9].Tgt_Dy@ */ /end MEASUREMENT
/begin MEASUREMENT SwcOut_HMI_OBJECT[9].Tgt_Heading "" SWORD autosar_swc_hmi_CM_int16 0 0 -32768 32767 ECU_ADDRESS 0xfe4ad2aa /* @ECU_Address@SwcOut_HMI_OBJECT[9].Tgt_Heading@ */ /end MEASUREMENT
/begin MEASUREMENT SwcOut_HMI_OBJECT[9].Tgt_Height "" FLOAT32_IEEE autosar_swc_hmi_CM_single 0 0 -3.4E+38 3.4E+38 ECU_ADDRESS 0xfe4ad2c0 /* @ECU_Address@SwcOut_HMI_OBJECT[9].Tgt_Height@ */ /end MEASUREMENT
/begin MEASUREMENT SwcOut_HMI_OBJECT[9].Tgt_ID "" UBYTE autosar_swc_hmi_CM_uint8 0 0 0 255 ECU_ADDRESS 0xfe4ad2a4 /* @ECU_Address@SwcOut_HMI_OBJECT[9].Tgt_ID@ */ /end MEASUREMENT
/begin MEASUREMENT SwcOut_HMI_OBJECT[9].Tgt_Type "" UBYTE autosar_swc_hmi_CM_uint8 0 0 0 255 ECU_ADDRESS 0xfe4ad2a5 /* @ECU_Address@SwcOut_HMI_OBJECT[9].Tgt_Type@ */ /end MEASUREMENT
/begin MEASUREMENT SwcOut_HMI_OBJECT[9].Tgt_Vx "" FLOAT32_IEEE autosar_swc_hmi_CM_single 0 0 -3.4E+38 3.4E+38 ECU_ADDRESS 0xfe4ad2b4 /* @ECU_Address@SwcOut_HMI_OBJECT[9].Tgt_Vx@ */ /end MEASUREMENT
/begin MEASUREMENT SwcOut_HMI_OBJECT[9].Tgt_Vy "" FLOAT32_IEEE autosar_swc_hmi_CM_single 0 0 -3.4E+38 3.4E+38 ECU_ADDRESS 0xfe4ad2b8 /* @ECU_Address@SwcOut_HMI_OBJECT[9].Tgt_Vy@ */ /end MEASUREMENT
/begin MEASUREMENT SwcOut_HMI_OBJECT[9].Tgt_Width "" FLOAT32_IEEE autosar_swc_hmi_CM_single 0 0 -3.4E+38 3.4E+38 ECU_ADDRESS 0xfe4ad2bc /* @ECU_Address@SwcOut_HMI_OBJECT[9].Tgt_Width@ */ /end MEASUREMENT
/begin MEASUREMENT SwcOut_HMI_OBJECT[9].Tgt_length "" FLOAT32_IEEE autosar_swc_hmi_CM_single 0 0 -3.4E+38 3.4E+38 ECU_ADDRESS 0xfe4ad2c4 /* @ECU_Address@SwcOut_HMI_OBJECT[9].Tgt_length@ */ /end MEASUREMENT
/begin MEASUREMENT SwcOut_HMI_OBJECT[9].Tgt_light "" UBYTE autosar_swc_hmi_CM_uint8 0 0 0 255 ECU_ADDRESS 0xfe4ad2a9 /* @ECU_Address@SwcOut_HMI_OBJECT[9].Tgt_light@ */ /end MEASUREMENT
/begin MEASUREMENT SwcOut_HMI_OBJECT[9].Tgt_movingStatus "" UBYTE autosar_swc_hmi_CM_uint8 0 0 0 255 ECU_ADDRESS 0xfe4ad2a8 /* @ECU_Address@SwcOut_HMI_OBJECT[9].Tgt_movingStatus@ */ /end MEASUREMENT
/begin MEASUREMENT autosar_swc_hmi_rtARID_DEF.Output_DSTATE "" UBYTE autosar_swc_hmi_CM_uint8 0 0 0 255 ECU_ADDRESS 0xfe4ad5e0 /* @ECU_Address@autosar_swc_hmi_rtARID_DEF.Output_DSTATE@ */ /end MEASUREMENT
/begin MEASUREMENT autosar_swc_hmi_rtARID_DEF.Output_DSTATE_b "" UBYTE autosar_swc_hmi_CM_uint8 0 0 0 255 ECU_ADDRESS 0xfe4ad5e1 /* @ECU_Address@autosar_swc_hmi_rtARID_DEF.Output_DSTATE_b@ */ /end MEASUREMENT
/begin MEASUREMENT autosar_swc_hmi_rtARID_DEF.is_active_c99_autosar_swc_hmi "" UBYTE autosar_swc_hmi_CM_uint8 0 0 0 255 ECU_ADDRESS 0xfe4ad60b /* @ECU_Address@autosar_swc_hmi_rtARID_DEF.is_active_c99_autosar_swc_hmi@ */ /end MEASUREMENT
/begin COMPU_METHOD autosar_swc_hmi_CM_SM_MODULE_STATUS "Enumerated data type: SM_MODULE_STATUS" TAB_VERB "%0.6" "" COMPU_TAB_REF VTAB_FOR_autosar_swc_hmi_CM_SM_MODULE_STATUS /end COMPU_METHOD
/begin COMPU_VTAB VTAB_FOR_autosar_swc_hmi_CM_SM_MODULE_STATUS "Enumerated data type: SM_MODULE_STATUS" TAB_VERB 4 0 "STATUS_NORMAL" 1 "STATUS_NOT_CONNECTED" 2 "STATUS_HEARTBEAT_MISSED" 3 "STATUS_ABNORMAL" /end COMPU_VTAB
/begin COMPU_METHOD autosar_swc_hmi_CM_int16 "Q = V" IDENTICAL "%5.0" "" /end COMPU_METHOD
/begin COMPU_METHOD autosar_swc_hmi_CM_single "Q = V" IDENTICAL "%8.6" "" /end COMPU_METHOD
/begin COMPU_METHOD autosar_swc_hmi_CM_uint32 "Q = V" IDENTICAL "%10.0" "" /end COMPU_METHOD
/begin COMPU_METHOD autosar_swc_hmi_CM_uint64 "Q = V" IDENTICAL "%20.0" "" /end COMPU_METHOD
/begin COMPU_METHOD autosar_swc_hmi_CM_uint8 "Q = V" IDENTICAL "%3.0" "" /end COMPU_METHOD
/begin RECORD_LAYOUT Record_BOOLEAN FNC_VALUES 1 UBYTE COLUMN_DIR DIRECT /end RECORD_LAYOUT
/begin RECORD_LAYOUT Record_FLOAT32_IEEE FNC_VALUES 1 FLOAT32_IEEE COLUMN_DIR DIRECT /end RECORD_LAYOUT
/begin RECORD_LAYOUT Record_UBYTE FNC_VALUES 1 UBYTE COLUMN_DIR DIRECT /end RECORD_LAYOUT
/begin RECORD_LAYOUT Record_ULONG FNC_VALUES 1 ULONG COLUMN_DIR DIRECT /end RECORD_LAYOUT
/begin GROUP HMI_ExecTimestamp ""
 /begin REF_MEASUREMENT HMI_ExecTimestamp.timeBaseStatus HMI_ExecTimestamp.nanoseconds HMI_ExecTimestamp.seconds /end REF_MEASUREMENT
/end GROUP
/begin GROUP SwcOut_HMI_GENERAL_INFO ""
 /begin REF_MEASUREMENT SwcOut_HMI_GENERAL_INFO.ACC_Status SwcOut_HMI_GENERAL_INFO.FCW_Status SwcOut_HMI_GENERAL_INFO.AEB_Status SwcOut_HMI_GENERAL_INFO.DW_Status SwcOut_HMI_GENERAL_INFO.LDW_Status SwcOut_HMI_GENERAL_INFO.LDP_Status SwcOut_HMI_GENERAL_INFO.ELK_Status SwcOut_HMI_GENERAL_INFO.ICA_Status SwcOut_HMI_GENERAL_INFO.DAI_Status SwcOut_HMI_GENERAL_INFO.IE_Status SwcOut_HMI_GENERAL_INFO.IHBC_Status SwcOut_HMI_GENERAL_INFO.TSR_Status SwcOut_HMI_GENERAL_INFO.SLA_Status SwcOut_HMI_GENERAL_INFO.ISL_Status SwcOut_HMI_GENERAL_INFO.TLI_Status SwcOut_HMI_GENERAL_INFO.ALC_Status SwcOut_HMI_GENERAL_INFO.Pilot_Status SwcOut_HMI_GENERAL_INFO.ACC_SpdSet SwcOut_HMI_GENERAL_INFO.ACC_TimeGapSet SwcOut_HMI_GENERAL_INFO.SLASpdLim SwcOut_HMI_GENERAL_INFO.SLASpdLimWarn SwcOut_HMI_GENERAL_INFO.TSRSgnGiWay SwcOut_HMI_GENERAL_INFO.TSRSgnForb SwcOut_HMI_GENERAL_INFO.TSRSgnLongStayDisp SwcOut_HMI_GENERAL_INFO.TSRNoParkWarn SwcOut_HMI_GENERAL_INFO.LSSIntervention SwcOut_HMI_GENERAL_INFO.ACC_Text_Info SwcOut_HMI_GENERAL_INFO.TJA_Text_Info SwcOut_HMI_GENERAL_INFO.ALC_Text_Info SwcOut_HMI_GENERAL_INFO.NOA_Text_Info SwcOut_HMI_GENERAL_INFO.AEB_Text_Info SwcOut_HMI_GENERAL_INFO.ADC_Text_Info SwcOut_HMI_GENERAL_INFO.ADC_Text_Warn SwcOut_HMI_GENERAL_INFO.ADC_Voice_Info SwcOut_HMI_GENERAL_INFO.ADC_WarnForm SwcOut_HMI_GENERAL_INFO.TLI_Info SwcOut_HMI_GENERAL_INFO.LaneChange_Display SwcOut_HMI_GENERAL_INFO.LaneChange_dxEnd SwcOut_HMI_GENERAL_INFO.LaneChange_dyEnd /end REF_MEASUREMENT
/end GROUP
/begin GROUP SwcOut_HMI_Herbeat_Info ""
 /begin REF_MEASUREMENT SwcOut_HMI_Herbeat_Info.swc_id SwcOut_HMI_Herbeat_Info.sequence_num SwcOut_HMI_Herbeat_Info.inner_error SwcOut_HMI_Herbeat_Info.module_status /end REF_MEASUREMENT
/end GROUP
/begin GROUP SwcOut_HMI_LANE[0] ""
 /begin REF_MEASUREMENT SwcOut_HMI_LANE[0].Line_ID SwcOut_HMI_LANE[0].Line_Type SwcOut_HMI_LANE[0].Line_Color SwcOut_HMI_LANE[0].Line_dxStart SwcOut_HMI_LANE[0].Line_dxEnd SwcOut_HMI_LANE[0].Line_C0 SwcOut_HMI_LANE[0].Line_C1 SwcOut_HMI_LANE[0].Line_C2 SwcOut_HMI_LANE[0].Line_C3 SwcOut_HMI_LANE[0].Line_MarkingWidth SwcOut_HMI_LANE[0].Line_Confidence /end REF_MEASUREMENT
/end GROUP
/begin GROUP SwcOut_HMI_LANE[1] ""
 /begin REF_MEASUREMENT SwcOut_HMI_LANE[1].Line_ID SwcOut_HMI_LANE[1].Line_Type SwcOut_HMI_LANE[1].Line_Color SwcOut_HMI_LANE[1].Line_dxStart SwcOut_HMI_LANE[1].Line_dxEnd SwcOut_HMI_LANE[1].Line_C0 SwcOut_HMI_LANE[1].Line_C1 SwcOut_HMI_LANE[1].Line_C2 SwcOut_HMI_LANE[1].Line_C3 SwcOut_HMI_LANE[1].Line_MarkingWidth SwcOut_HMI_LANE[1].Line_Confidence /end REF_MEASUREMENT
/end GROUP
/begin GROUP SwcOut_HMI_LANE[2] ""
 /begin REF_MEASUREMENT SwcOut_HMI_LANE[2].Line_ID SwcOut_HMI_LANE[2].Line_Type SwcOut_HMI_LANE[2].Line_Color SwcOut_HMI_LANE[2].Line_dxStart SwcOut_HMI_LANE[2].Line_dxEnd SwcOut_HMI_LANE[2].Line_C0 SwcOut_HMI_LANE[2].Line_C1 SwcOut_HMI_LANE[2].Line_C2 SwcOut_HMI_LANE[2].Line_C3 SwcOut_HMI_LANE[2].Line_MarkingWidth SwcOut_HMI_LANE[2].Line_Confidence /end REF_MEASUREMENT
/end GROUP
/begin GROUP SwcOut_HMI_LANE[3] ""
 /begin REF_MEASUREMENT SwcOut_HMI_LANE[3].Line_ID SwcOut_HMI_LANE[3].Line_Type SwcOut_HMI_LANE[3].Line_Color SwcOut_HMI_LANE[3].Line_dxStart SwcOut_HMI_LANE[3].Line_dxEnd SwcOut_HMI_LANE[3].Line_C0 SwcOut_HMI_LANE[3].Line_C1 SwcOut_HMI_LANE[3].Line_C2 SwcOut_HMI_LANE[3].Line_C3 SwcOut_HMI_LANE[3].Line_MarkingWidth SwcOut_HMI_LANE[3].Line_Confidence /end REF_MEASUREMENT
/end GROUP
/begin GROUP SwcOut_HMI_LANE[4] ""
 /begin REF_MEASUREMENT SwcOut_HMI_LANE[4].Line_ID SwcOut_HMI_LANE[4].Line_Type SwcOut_HMI_LANE[4].Line_Color SwcOut_HMI_LANE[4].Line_dxStart SwcOut_HMI_LANE[4].Line_dxEnd SwcOut_HMI_LANE[4].Line_C0 SwcOut_HMI_LANE[4].Line_C1 SwcOut_HMI_LANE[4].Line_C2 SwcOut_HMI_LANE[4].Line_C3 SwcOut_HMI_LANE[4].Line_MarkingWidth SwcOut_HMI_LANE[4].Line_Confidence /end REF_MEASUREMENT
/end GROUP
/begin GROUP SwcOut_HMI_LANE[5] ""
 /begin REF_MEASUREMENT SwcOut_HMI_LANE[5].Line_ID SwcOut_HMI_LANE[5].Line_Type SwcOut_HMI_LANE[5].Line_Color SwcOut_HMI_LANE[5].Line_dxStart SwcOut_HMI_LANE[5].Line_dxEnd SwcOut_HMI_LANE[5].Line_C0 SwcOut_HMI_LANE[5].Line_C1 SwcOut_HMI_LANE[5].Line_C2 SwcOut_HMI_LANE[5].Line_C3 SwcOut_HMI_LANE[5].Line_MarkingWidth SwcOut_HMI_LANE[5].Line_Confidence /end REF_MEASUREMENT
/end GROUP
/begin GROUP SwcOut_HMI_LANE[6] ""
 /begin REF_MEASUREMENT SwcOut_HMI_LANE[6].Line_ID SwcOut_HMI_LANE[6].Line_Type SwcOut_HMI_LANE[6].Line_Color SwcOut_HMI_LANE[6].Line_dxStart SwcOut_HMI_LANE[6].Line_dxEnd SwcOut_HMI_LANE[6].Line_C0 SwcOut_HMI_LANE[6].Line_C1 SwcOut_HMI_LANE[6].Line_C2 SwcOut_HMI_LANE[6].Line_C3 SwcOut_HMI_LANE[6].Line_MarkingWidth SwcOut_HMI_LANE[6].Line_Confidence /end REF_MEASUREMENT
/end GROUP
/begin GROUP SwcOut_HMI_LANE[7] ""
 /begin REF_MEASUREMENT SwcOut_HMI_LANE[7].Line_ID SwcOut_HMI_LANE[7].Line_Type SwcOut_HMI_LANE[7].Line_Color SwcOut_HMI_LANE[7].Line_dxStart SwcOut_HMI_LANE[7].Line_dxEnd SwcOut_HMI_LANE[7].Line_C0 SwcOut_HMI_LANE[7].Line_C1 SwcOut_HMI_LANE[7].Line_C2 SwcOut_HMI_LANE[7].Line_C3 SwcOut_HMI_LANE[7].Line_MarkingWidth SwcOut_HMI_LANE[7].Line_Confidence /end REF_MEASUREMENT
/end GROUP
/begin GROUP SwcOut_HMI_Light_Req ""
 /begin REF_MEASUREMENT SwcOut_HMI_Light_Req.BrkLiReq SwcOut_HMI_Light_Req.Frntwiprsts SwcOut_HMI_Light_Req.Turnlightind SwcOut_HMI_Light_Req.BeamactiveSts SwcOut_HMI_Light_Req.Beamlightreq SwcOut_HMI_Light_Req.EmeglampReq SwcOut_HMI_Light_Req.IHBC_Status SwcOut_HMI_Light_Req.IHBC_HighBeamReq /end REF_MEASUREMENT
/end GROUP
/begin GROUP SwcOut_HMI_OBJECT[0] ""
 /begin REF_MEASUREMENT SwcOut_HMI_OBJECT[0].Tgt_ID SwcOut_HMI_OBJECT[0].Tgt_Type SwcOut_HMI_OBJECT[0].Tgt_Color SwcOut_HMI_OBJECT[0].Tgt_Detn SwcOut_HMI_OBJECT[0].Tgt_movingStatus SwcOut_HMI_OBJECT[0].Tgt_light SwcOut_HMI_OBJECT[0].Tgt_Heading SwcOut_HMI_OBJECT[0].Tgt_Dx SwcOut_HMI_OBJECT[0].Tgt_Dy SwcOut_HMI_OBJECT[0].Tgt_Vx SwcOut_HMI_OBJECT[0].Tgt_Vy SwcOut_HMI_OBJECT[0].Tgt_Width SwcOut_HMI_OBJECT[0].Tgt_Height SwcOut_HMI_OBJECT[0].Tgt_length /end REF_MEASUREMENT
/end GROUP
/begin GROUP SwcOut_HMI_OBJECT[1] ""
 /begin REF_MEASUREMENT SwcOut_HMI_OBJECT[1].Tgt_ID SwcOut_HMI_OBJECT[1].Tgt_Type SwcOut_HMI_OBJECT[1].Tgt_Color SwcOut_HMI_OBJECT[1].Tgt_Detn SwcOut_HMI_OBJECT[1].Tgt_movingStatus SwcOut_HMI_OBJECT[1].Tgt_light SwcOut_HMI_OBJECT[1].Tgt_Heading SwcOut_HMI_OBJECT[1].Tgt_Dx SwcOut_HMI_OBJECT[1].Tgt_Dy SwcOut_HMI_OBJECT[1].Tgt_Vx SwcOut_HMI_OBJECT[1].Tgt_Vy SwcOut_HMI_OBJECT[1].Tgt_Width SwcOut_HMI_OBJECT[1].Tgt_Height SwcOut_HMI_OBJECT[1].Tgt_length /end REF_MEASUREMENT
/end GROUP
/begin GROUP SwcOut_HMI_OBJECT[2] ""
 /begin REF_MEASUREMENT SwcOut_HMI_OBJECT[2].Tgt_ID SwcOut_HMI_OBJECT[2].Tgt_Type SwcOut_HMI_OBJECT[2].Tgt_Color SwcOut_HMI_OBJECT[2].Tgt_Detn SwcOut_HMI_OBJECT[2].Tgt_movingStatus SwcOut_HMI_OBJECT[2].Tgt_light SwcOut_HMI_OBJECT[2].Tgt_Heading SwcOut_HMI_OBJECT[2].Tgt_Dx SwcOut_HMI_OBJECT[2].Tgt_Dy SwcOut_HMI_OBJECT[2].Tgt_Vx SwcOut_HMI_OBJECT[2].Tgt_Vy SwcOut_HMI_OBJECT[2].Tgt_Width SwcOut_HMI_OBJECT[2].Tgt_Height SwcOut_HMI_OBJECT[2].Tgt_length /end REF_MEASUREMENT
/end GROUP
/begin GROUP SwcOut_HMI_OBJECT[3] ""
 /begin REF_MEASUREMENT SwcOut_HMI_OBJECT[3].Tgt_ID SwcOut_HMI_OBJECT[3].Tgt_Type SwcOut_HMI_OBJECT[3].Tgt_Color SwcOut_HMI_OBJECT[3].Tgt_Detn SwcOut_HMI_OBJECT[3].Tgt_movingStatus SwcOut_HMI_OBJECT[3].Tgt_light SwcOut_HMI_OBJECT[3].Tgt_Heading SwcOut_HMI_OBJECT[3].Tgt_Dx SwcOut_HMI_OBJECT[3].Tgt_Dy SwcOut_HMI_OBJECT[3].Tgt_Vx SwcOut_HMI_OBJECT[3].Tgt_Vy SwcOut_HMI_OBJECT[3].Tgt_Width SwcOut_HMI_OBJECT[3].Tgt_Height SwcOut_HMI_OBJECT[3].Tgt_length /end REF_MEASUREMENT
/end GROUP
/begin GROUP SwcOut_HMI_OBJECT[4] ""
 /begin REF_MEASUREMENT SwcOut_HMI_OBJECT[4].Tgt_ID SwcOut_HMI_OBJECT[4].Tgt_Type SwcOut_HMI_OBJECT[4].Tgt_Color SwcOut_HMI_OBJECT[4].Tgt_Detn SwcOut_HMI_OBJECT[4].Tgt_movingStatus SwcOut_HMI_OBJECT[4].Tgt_light SwcOut_HMI_OBJECT[4].Tgt_Heading SwcOut_HMI_OBJECT[4].Tgt_Dx SwcOut_HMI_OBJECT[4].Tgt_Dy SwcOut_HMI_OBJECT[4].Tgt_Vx SwcOut_HMI_OBJECT[4].Tgt_Vy SwcOut_HMI_OBJECT[4].Tgt_Width SwcOut_HMI_OBJECT[4].Tgt_Height SwcOut_HMI_OBJECT[4].Tgt_length /end REF_MEASUREMENT
/end GROUP
/begin GROUP SwcOut_HMI_OBJECT[5] ""
 /begin REF_MEASUREMENT SwcOut_HMI_OBJECT[5].Tgt_ID SwcOut_HMI_OBJECT[5].Tgt_Type SwcOut_HMI_OBJECT[5].Tgt_Color SwcOut_HMI_OBJECT[5].Tgt_Detn SwcOut_HMI_OBJECT[5].Tgt_movingStatus SwcOut_HMI_OBJECT[5].Tgt_light SwcOut_HMI_OBJECT[5].Tgt_Heading SwcOut_HMI_OBJECT[5].Tgt_Dx SwcOut_HMI_OBJECT[5].Tgt_Dy SwcOut_HMI_OBJECT[5].Tgt_Vx SwcOut_HMI_OBJECT[5].Tgt_Vy SwcOut_HMI_OBJECT[5].Tgt_Width SwcOut_HMI_OBJECT[5].Tgt_Height SwcOut_HMI_OBJECT[5].Tgt_length /end REF_MEASUREMENT
/end GROUP
/begin GROUP SwcOut_HMI_OBJECT[6] ""
 /begin REF_MEASUREMENT SwcOut_HMI_OBJECT[6].Tgt_ID SwcOut_HMI_OBJECT[6].Tgt_Type SwcOut_HMI_OBJECT[6].Tgt_Color SwcOut_HMI_OBJECT[6].Tgt_Detn SwcOut_HMI_OBJECT[6].Tgt_movingStatus SwcOut_HMI_OBJECT[6].Tgt_light SwcOut_HMI_OBJECT[6].Tgt_Heading SwcOut_HMI_OBJECT[6].Tgt_Dx SwcOut_HMI_OBJECT[6].Tgt_Dy SwcOut_HMI_OBJECT[6].Tgt_Vx SwcOut_HMI_OBJECT[6].Tgt_Vy SwcOut_HMI_OBJECT[6].Tgt_Width SwcOut_HMI_OBJECT[6].Tgt_Height SwcOut_HMI_OBJECT[6].Tgt_length /end REF_MEASUREMENT
/end GROUP
/begin GROUP SwcOut_HMI_OBJECT[7] ""
 /begin REF_MEASUREMENT SwcOut_HMI_OBJECT[7].Tgt_ID SwcOut_HMI_OBJECT[7].Tgt_Type SwcOut_HMI_OBJECT[7].Tgt_Color SwcOut_HMI_OBJECT[7].Tgt_Detn SwcOut_HMI_OBJECT[7].Tgt_movingStatus SwcOut_HMI_OBJECT[7].Tgt_light SwcOut_HMI_OBJECT[7].Tgt_Heading SwcOut_HMI_OBJECT[7].Tgt_Dx SwcOut_HMI_OBJECT[7].Tgt_Dy SwcOut_HMI_OBJECT[7].Tgt_Vx SwcOut_HMI_OBJECT[7].Tgt_Vy SwcOut_HMI_OBJECT[7].Tgt_Width SwcOut_HMI_OBJECT[7].Tgt_Height SwcOut_HMI_OBJECT[7].Tgt_length /end REF_MEASUREMENT
/end GROUP
/begin GROUP SwcOut_HMI_OBJECT[8] ""
 /begin REF_MEASUREMENT SwcOut_HMI_OBJECT[8].Tgt_ID SwcOut_HMI_OBJECT[8].Tgt_Type SwcOut_HMI_OBJECT[8].Tgt_Color SwcOut_HMI_OBJECT[8].Tgt_Detn SwcOut_HMI_OBJECT[8].Tgt_movingStatus SwcOut_HMI_OBJECT[8].Tgt_light SwcOut_HMI_OBJECT[8].Tgt_Heading SwcOut_HMI_OBJECT[8].Tgt_Dx SwcOut_HMI_OBJECT[8].Tgt_Dy SwcOut_HMI_OBJECT[8].Tgt_Vx SwcOut_HMI_OBJECT[8].Tgt_Vy SwcOut_HMI_OBJECT[8].Tgt_Width SwcOut_HMI_OBJECT[8].Tgt_Height SwcOut_HMI_OBJECT[8].Tgt_length /end REF_MEASUREMENT
/end GROUP
/begin GROUP SwcOut_HMI_OBJECT[9] ""
 /begin REF_MEASUREMENT SwcOut_HMI_OBJECT[9].Tgt_ID SwcOut_HMI_OBJECT[9].Tgt_Type SwcOut_HMI_OBJECT[9].Tgt_Color SwcOut_HMI_OBJECT[9].Tgt_Detn SwcOut_HMI_OBJECT[9].Tgt_movingStatus SwcOut_HMI_OBJECT[9].Tgt_light SwcOut_HMI_OBJECT[9].Tgt_Heading SwcOut_HMI_OBJECT[9].Tgt_Dx SwcOut_HMI_OBJECT[9].Tgt_Dy SwcOut_HMI_OBJECT[9].Tgt_Vx SwcOut_HMI_OBJECT[9].Tgt_Vy SwcOut_HMI_OBJECT[9].Tgt_Width SwcOut_HMI_OBJECT[9].Tgt_Height SwcOut_HMI_OBJECT[9].Tgt_length /end REF_MEASUREMENT
/end GROUP
/begin GROUP autosar_swc_hmi "autosar_swc_hmi" ROOT /begin SUB_GROUP HMI_ExecTimestamp autosar_swc_hmi_autosar_swc_hmi_Step_sys /end SUB_GROUP /end GROUP
/begin GROUP autosar_swc_hmi_autosar_swc_hmi_Step_sys "autosar_swc_hmi/autosar_swc_hmi_Step_sys"
 /begin SUB_GROUP autosar_swc_hmi_autosar_swc_hmi_Step_sys_Counter_Limited autosar_swc_hmi_autosar_swc_hmi_Step_sys_Counter_Limited1 autosar_swc_hmi_autosar_swc_hmi_Step_sys_GENERAL_INFO_work autosar_swc_hmi_autosar_swc_hmi_Step_sys_HMI_OBJECT_work /end SUB_GROUP
 /begin REF_MEASUREMENT HMI_Version autosar_swc_hmi_rtARID_DEF.is_active_c99_autosar_swc_hmi /end REF_MEASUREMENT
/end GROUP
/begin GROUP autosar_swc_hmi_autosar_swc_hmi_Step_sys_Counter_Limited "autosar_swc_hmi/autosar_swc_hmi_Step_sys/Counter\nLimited"
 /begin SUB_GROUP autosar_swc_hmi_autosar_swc_hmi_Step_sys_Counter_Limited_Increment_Real_World /end SUB_GROUP
 /begin REF_MEASUREMENT HMI_Update autosar_swc_hmi_rtARID_DEF.Output_DSTATE_b /end REF_MEASUREMENT
/end GROUP
/begin GROUP autosar_swc_hmi_autosar_swc_hmi_Step_sys_Counter_Limited1 "autosar_swc_hmi/autosar_swc_hmi_Step_sys/Counter\nLimited1" /begin REF_MEASUREMENT autosar_swc_hmi_rtARID_DEF.Output_DSTATE /end REF_MEASUREMENT /end GROUP
/begin GROUP autosar_swc_hmi_autosar_swc_hmi_Step_sys_Counter_Limited_Increment_Real_World "autosar_swc_hmi/autosar_swc_hmi_Step_sys/Counter\nLimited/Increment\nReal World" /begin REF_MEASUREMENT HMI_Update /end REF_MEASUREMENT /end GROUP
/begin RECORD_LAYOUT Record_BOOLEAN FNC_VALUES 1 UBYTE COLUMN_DIR DIRECT /end RECORD_LAYOUT
/begin RECORD_LAYOUT Record_FLOAT32_IEEE FNC_VALUES 1 FLOAT32_IEEE COLUMN_DIR DIRECT /end RECORD_LAYOUT
/begin RECORD_LAYOUT Record_UBYTE FNC_VALUES 1 UBYTE COLUMN_DIR DIRECT /end RECORD_LAYOUT
/begin RECORD_LAYOUT Record_ULONG FNC_VALUES 1 ULONG COLUMN_DIR DIRECT /end RECORD_LAYOUT
/begin RECORD_LAYOUT Record_UWORD FNC_VALUES 1 UWORD COLUMN_DIR DIRECT /end RECORD_LAYOUT
/begin RECORD_LAYOUT Axis_FLOAT32_IEEE AXIS_PTS_X 1 FLOAT32_IEEE INDEX_INCR DIRECT /end RECORD_LAYOUT
/begin RECORD_LAYOUT Record_BOOLEAN FNC_VALUES 1 UBYTE COLUMN_DIR DIRECT /end RECORD_LAYOUT
/begin RECORD_LAYOUT Record_FLOAT32_IEEE FNC_VALUES 1 FLOAT32_IEEE COLUMN_DIR DIRECT /end RECORD_LAYOUT
/begin RECORD_LAYOUT Record_UBYTE FNC_VALUES 1 UBYTE COLUMN_DIR DIRECT /end RECORD_LAYOUT
/begin RECORD_LAYOUT Record_ULONG FNC_VALUES 1 ULONG COLUMN_DIR DIRECT /end RECORD_LAYOUT
/begin RECORD_LAYOUT Record_UWORD FNC_VALUES 1 UWORD COLUMN_DIR DIRECT /end RECORD_LAYOUT
/begin RECORD_LAYOUT Axis_FLOAT32_IEEE AXIS_PTS_X 1 FLOAT32_IEEE INDEX_INCR DIRECT /end RECORD_LAYOUT
/begin RECORD_LAYOUT Record_BOOLEAN FNC_VALUES 1 UBYTE COLUMN_DIR DIRECT /end RECORD_LAYOUT
/begin RECORD_LAYOUT Record_FLOAT32_IEEE FNC_VALUES 1 FLOAT32_IEEE COLUMN_DIR DIRECT /end RECORD_LAYOUT
/begin RECORD_LAYOUT Record_UBYTE FNC_VALUES 1 UBYTE COLUMN_DIR DIRECT /end RECORD_LAYOUT
/begin RECORD_LAYOUT Record_ULONG FNC_VALUES 1 ULONG COLUMN_DIR DIRECT /end RECORD_LAYOUT
/begin RECORD_LAYOUT Record_UWORD FNC_VALUES 1 UWORD COLUMN_DIR DIRECT /end RECORD_LAYOUT
/begin RECORD_LAYOUT Axis_FLOAT32_IEEE AXIS_PTS_X 1 FLOAT32_IEEE INDEX_INCR DIRECT /end RECORD_LAYOUT
/begin RECORD_LAYOUT Record_BOOLEAN FNC_VALUES 1 UBYTE COLUMN_DIR DIRECT /end RECORD_LAYOUT
/begin RECORD_LAYOUT Record_FLOAT32_IEEE FNC_VALUES 1 FLOAT32_IEEE COLUMN_DIR DIRECT /end RECORD_LAYOUT
/begin RECORD_LAYOUT Record_UBYTE FNC_VALUES 1 UBYTE COLUMN_DIR DIRECT /end RECORD_LAYOUT
/begin RECORD_LAYOUT Record_ULONG FNC_VALUES 1 ULONG COLUMN_DIR DIRECT /end RECORD_LAYOUT
/begin RECORD_LAYOUT Record_UWORD FNC_VALUES 1 UWORD COLUMN_DIR DIRECT /end RECORD_LAYOUT
/begin RECORD_LAYOUT Record_BOOLEAN FNC_VALUES 1 UBYTE COLUMN_DIR DIRECT /end RECORD_LAYOUT
/begin RECORD_LAYOUT Record_FLOAT32_IEEE FNC_VALUES 1 FLOAT32_IEEE COLUMN_DIR DIRECT /end RECORD_LAYOUT
/begin RECORD_LAYOUT Record_UBYTE FNC_VALUES 1 UBYTE COLUMN_DIR DIRECT /end RECORD_LAYOUT
/begin RECORD_LAYOUT Record_ULONG FNC_VALUES 1 ULONG COLUMN_DIR DIRECT /end RECORD_LAYOUT
/begin RECORD_LAYOUT Record_UWORD FNC_VALUES 1 UWORD COLUMN_DIR DIRECT /end RECORD_LAYOUT
/begin RECORD_LAYOUT Axis_FLOAT32_IEEE AXIS_PTS_X 1 FLOAT32_IEEE INDEX_INCR DIRECT /end RECORD_LAYOUT
/begin RECORD_LAYOUT Record_BOOLEAN FNC_VALUES 1 UBYTE COLUMN_DIR DIRECT /end RECORD_LAYOUT
/begin RECORD_LAYOUT Record_FLOAT32_IEEE FNC_VALUES 1 FLOAT32_IEEE COLUMN_DIR DIRECT /end RECORD_LAYOUT
/begin RECORD_LAYOUT Record_UBYTE FNC_VALUES 1 UBYTE COLUMN_DIR DIRECT /end RECORD_LAYOUT
/begin RECORD_LAYOUT Record_ULONG FNC_VALUES 1 ULONG COLUMN_DIR DIRECT /end RECORD_LAYOUT
/begin RECORD_LAYOUT Record_UWORD FNC_VALUES 1 UWORD COLUMN_DIR DIRECT /end RECORD_LAYOUT
/begin RECORD_LAYOUT Axis_FLOAT32_IEEE AXIS_PTS_X 1 FLOAT32_IEEE INDEX_INCR DIRECT /end RECORD_LAYOUT
/begin RECORD_LAYOUT Record_BOOLEAN FNC_VALUES 1 UBYTE COLUMN_DIR DIRECT /end RECORD_LAYOUT
/begin RECORD_LAYOUT Record_FLOAT32_IEEE FNC_VALUES 1 FLOAT32_IEEE COLUMN_DIR DIRECT /end RECORD_LAYOUT
/begin RECORD_LAYOUT Record_UBYTE FNC_VALUES 1 UBYTE COLUMN_DIR DIRECT /end RECORD_LAYOUT
/begin RECORD_LAYOUT Record_ULONG FNC_VALUES 1 ULONG COLUMN_DIR DIRECT /end RECORD_LAYOUT
/begin RECORD_LAYOUT Record_UWORD FNC_VALUES 1 UWORD COLUMN_DIR DIRECT /end RECORD_LAYOUT
/begin RECORD_LAYOUT Axis_FLOAT32_IEEE AXIS_PTS_X 1 FLOAT32_IEEE INDEX_INCR DIRECT /end RECORD_LAYOUT
/begin RECORD_LAYOUT Record_BOOLEAN FNC_VALUES 1 UBYTE COLUMN_DIR DIRECT /end RECORD_LAYOUT
/begin RECORD_LAYOUT Record_FLOAT32_IEEE FNC_VALUES 1 FLOAT32_IEEE COLUMN_DIR DIRECT /end RECORD_LAYOUT
/begin RECORD_LAYOUT Record_UBYTE FNC_VALUES 1 UBYTE COLUMN_DIR DIRECT /end RECORD_LAYOUT
/begin RECORD_LAYOUT Record_ULONG FNC_VALUES 1 ULONG COLUMN_DIR DIRECT /end RECORD_LAYOUT
/begin RECORD_LAYOUT Record_UWORD FNC_VALUES 1 UWORD COLUMN_DIR DIRECT /end RECORD_LAYOUT
/begin RECORD_LAYOUT Axis_FLOAT32_IEEE AXIS_PTS_X 1 FLOAT32_IEEE INDEX_INCR DIRECT /end RECORD_LAYOUT
/end MODULE
/end PROJECT
