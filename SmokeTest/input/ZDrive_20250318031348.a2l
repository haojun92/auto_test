ASAP2_VERSION 1 71
/begin PROJECT ProjectName ""
/begin MODULE ModuleName ""
/begin MOD_COMMON "" BYTE_ORDER MSB_LAST ALIGNMENT_BYTE 1 ALIGNMENT_WORD 1 ALIGNMENT_LONG 1 ALIGNMENT_INT64 1 ALIGNMENT_FLOAT16_IEEE 1 ALIGNMENT_FLOAT32_IEEE 1 ALIGNMENT_FLOAT64_IEEE 1 /end MOD_COMMON
/begin RECORD_LAYOUT __UBYTE_Z FNC_VALUES 1 UBYTE ROW_DIR DIRECT /end RECORD_LAYOUT
/begin CHARACTERISTIC CLTS_ALowrLimInAsyEvlrCritEve_Ca "Lower limit of acceleration output from TA." VALUE 0xfe503cd8 /* @ECU_Address@CLTS_ALowrLimInAsyEvlrCritEve_Ca@ */ Record_FLOAT32_IEEE 0 autosar_swc_aeb_CM_single_m_per_s -50.000000 0.000000 /end CHARACTERISTIC
/begin CHARACTERISTIC CLTS_ANegLgtRqrdThdInAsyEvlrCritEve_Ca "Threshold for detectable required longitudinal acceleration." VALUE 0xfe503cdc /* @ECU_Address@CLTS_ANegLgtRqrdThdInAsyEvlrCritEve_Ca@ */ Record_FLOAT32_IEEE 0 autosar_swc_aeb_CM_single_m_per_s -1.000000 0.000000 /end CHARACTERISTIC
/begin CHARACTERISTIC CLTS_AUpprLimInAsyEvlrCritEve_Ca "Upper limit of acceleration output from TA." VALUE 0xfe503ce0 /* @ECU_Address@CLTS_AUpprLimInAsyEvlrCritEve_Ca@ */ Record_FLOAT32_IEEE 0 autosar_swc_aeb_CM_single_m_per_s 0.000000 50.000000 /end CHARACTERISTIC
/begin CHARACTERISTIC CLTS_DstMaxLatMovmtInAsyEvlrCritEve_Ca "Max lateral distance used by simple lateral acceleration estimator (ASIL B requirement)" VALUE 0xfe503d40 /* @ECU_Address@CLTS_DstMaxLatMovmtInAsyEvlrCritEve_Ca@ */ Record_FLOAT32_IEEE 0 autosar_swc_aeb_CM_single_m 0.000000 5.000000 /end CHARACTERISTIC
/begin CHARACTERISTIC CLTS_DstPredMaxInAsyEvlrCritEve_Ca "Maximum prediction distance for objects." VALUE 0xfe503d44 /* @ECU_Address@CLTS_DstPredMaxInAsyEvlrCritEve_Ca@ */ Record_FLOAT32_IEEE 0 autosar_swc_aeb_CM_single_m 0.000000 200.000000 /end CHARACTERISTIC
/begin CHARACTERISTIC CLTS_DstUpprLimInAsyEvlrCritEve_Ca "Upper limit for distance to objects." VALUE 0xfe503d48 /* @ECU_Address@CLTS_DstUpprLimInAsyEvlrCritEve_Ca@ */ Record_FLOAT32_IEEE 0 autosar_swc_aeb_CM_single_m 10.000000 500.000000 /end CHARACTERISTIC
/begin CHARACTERISTIC CLTS_ObjSpdThdForAgDirVldInAsyEvlrCritEve_Ca "Object maximum speed for evaluating the position confidence." VALUE 0xfe503d70 /* @ECU_Address@CLTS_ObjSpdThdForAgDirVldInAsyEvlrCritEve_Ca@ */ Record_FLOAT32_IEEE 0 autosar_swc_aeb_CM_single_m_per_s 0.000000 50.000000 /end CHARACTERISTIC
/begin CHARACTERISTIC CLTS_ObjSpdThdLatInAsyEvlrCritEve_Ca "Minimum detectable object lateral speed." VALUE 0xfe503d74 /* @ECU_Address@CLTS_ObjSpdThdLatInAsyEvlrCritEve_Ca@ */ Record_FLOAT32_IEEE 0 autosar_swc_aeb_CM_single_m_per_s 0.000000 5.000000 /end CHARACTERISTIC
/begin CHARACTERISTIC CLTS_ObjSpdThdLgtInAsyEvlrCritEve_Ca "Minimum detectable object longitudinal speed." VALUE 0xfe503d7c /* @ECU_Address@CLTS_ObjSpdThdLgtInAsyEvlrCritEve_Ca@ */ Record_FLOAT32_IEEE 0 autosar_swc_aeb_CM_single_m_per_s 0.000000 5.000000 /end CHARACTERISTIC
/begin CHARACTERISTIC CLTS_PosnLatUpprLimInAsyEvlrCritEve_Ca "Upper limit of lateral position output from TA." VALUE 0xfe503da0 /* @ECU_Address@CLTS_PosnLatUpprLimInAsyEvlrCritEve_Ca@ */ Record_FLOAT32_IEEE 0 autosar_swc_aeb_CM_single_m -100.000000 100.000000 /end CHARACTERISTIC
/begin CHARACTERISTIC CLTS_SftyArUpprLimForTiInObjPredInAsyEvlrCritEve_Ca "Maximum prediction time for object position (longitudinal threat assessor)." VALUE 0xfe503da4 /* @ECU_Address@CLTS_SftyArUpprLimForTiInObjPredInAsyEvlrCritEve_Ca@ */ Record_FLOAT32_IEEE 0 autosar_swc_aeb_CM_single_s 0.000000 100.000000 /end CHARACTERISTIC
/begin CHARACTERISTIC CLTS_SpdMaxForQlyChkInAsyEvlrCritEve_Ca "Maximum speed for applying the additional FCW Quality Check based on CMbB Primary Confidence." VALUE 0xfe503db8 /* @ECU_Address@CLTS_SpdMaxForQlyChkInAsyEvlrCritEve_Ca@ */ Record_FLOAT32_IEEE 0 autosar_swc_aeb_CM_single_m_per_s 0.000000 70.000000 /end CHARACTERISTIC
/begin CHARACTERISTIC CLTS_SpdMovgToSelfMaxForIntvInAsyEvlrCritEve_Ca "Maximum speed allowed for an oncoming object for CMbB." VALUE 0xfe503dc0 /* @ECU_Address@CLTS_SpdMovgToSelfMaxForIntvInAsyEvlrCritEve_Ca@ */ Record_FLOAT32_IEEE 0 autosar_swc_aeb_CM_single_m_per_s 0.000000 100.000000 /end CHARACTERISTIC
/begin CHARACTERISTIC CLTS_SpdMovgToSelfMaxForWarnInAsyEvlrCritEve_Ca "Maximum speed allowed for an oncoming object for FCW." VALUE 0xfe503dc4 /* @ECU_Address@CLTS_SpdMovgToSelfMaxForWarnInAsyEvlrCritEve_Ca@ */ Record_FLOAT32_IEEE 0 autosar_swc_aeb_CM_single_m_per_s -70.000000 0.000000 /end CHARACTERISTIC
/begin CHARACTERISTIC CLTS_SpdPredMinInAsyEvlrCritEve_Ca "Minimum speed for predicting vehicles." VALUE 0xfe503dc8 /* @ECU_Address@CLTS_SpdPredMinInAsyEvlrCritEve_Ca@ */ Record_FLOAT32_IEEE 0 autosar_swc_aeb_CM_single_m_per_s 0.000000 5.000000 /end CHARACTERISTIC
/begin CHARACTERISTIC CLTS_TiLowrLimInAsyEvlrCritEve_Ca "Lower time limit for TimeToReach and TimeToPass." VALUE 0xfe503dd4 /* @ECU_Address@CLTS_TiLowrLimInAsyEvlrCritEve_Ca@ */ Record_FLOAT32_IEEE 0 autosar_swc_aeb_CM_single_s -200.000000 -1.000000 /end CHARACTERISTIC
/begin CHARACTERISTIC CLTS_TiToCllsnMaxForQlyChkInAsyEvlrCritEve_Ca "Maximum allowed TTR (time to reach) for using CMbB confidence in evaluation of FCW." VALUE 0xfe503dd8 /* @ECU_Address@CLTS_TiToCllsnMaxForQlyChkInAsyEvlrCritEve_Ca@ */ Record_FLOAT32_IEEE 0 autosar_swc_aeb_CM_single_s 0.000000 10.000000 /end CHARACTERISTIC
/begin CHARACTERISTIC CLTS_TiUpprLimInAsyEvlrCritEve_Ca "Upper time limit for TimeToReach and TimeToPass." VALUE 0xfe503de0 /* @ECU_Address@CLTS_TiUpprLimInAsyEvlrCritEve_Ca@ */ Record_FLOAT32_IEEE 0 autosar_swc_aeb_CM_single_s 1.000000 200.000000 /end CHARACTERISTIC
/begin CHARACTERISTIC CLTS_TruckWidthMaxInAsyEvlrCritEve_Ca "Maximum width of trucks." VALUE 0xfe503de8 /* @ECU_Address@CLTS_TruckWidthMaxInAsyEvlrCritEve_Ca@ */ Record_FLOAT32_IEEE 0 autosar_swc_aeb_CM_single_m 1.000000 5.000000 /end CHARACTERISTIC
/begin CHARACTERISTIC CLTS_UseQlyChkForWarnInAsyEvlrCritEve_Ca "Use CMbB confidence for evaluation of FCW." VALUE 0xfe504193 /* @ECU_Address@CLTS_UseQlyChkForWarnInAsyEvlrCritEve_Ca@ */ Record_BOOLEAN 0 autosar_swc_aeb_CM_logical 0 1 /end CHARACTERISTIC
/begin CHARACTERISTIC CLTS_VLatUpprLimInAsyEvlrCritEve_Ca "Upper limit of lateral velocity output from TA." VALUE 0xfe503dec /* @ECU_Address@CLTS_VLatUpprLimInAsyEvlrCritEve_Ca@ */ Record_FLOAT32_IEEE 0 autosar_swc_aeb_CM_single_m_per_s 0.000000 100.000000 /end CHARACTERISTIC
/begin CHARACTERISTIC CLTS_VLgtUpprLimInAsyEvlrCritEve_Ca "Upper limit of longitudinal velocity output from TA." VALUE 0xfe503df0 /* @ECU_Address@CLTS_VLgtUpprLimInAsyEvlrCritEve_Ca@ */ Record_FLOAT32_IEEE 0 autosar_swc_aeb_CM_single_m_per_s 0.000000 200.000000 /end CHARACTERISTIC
/begin CHARACTERISTIC CLTS_VehOfUkwnClassCfmDlyForWarnInAsyEvlrCritEve_Ca "Confirmation time for vehicles of unknown class" VALUE 0xfe503e00 /* @ECU_Address@CLTS_VehOfUkwnClassCfmDlyForWarnInAsyEvlrCritEve_Ca@ */ Record_FLOAT32_IEEE 0 autosar_swc_aeb_CM_single_s 0.000000 2.000000 /end CHARACTERISTIC
/begin MEASUREMENT autosar_swc_aeb_rtARID_DEF.ALatRqrd_as "" FLOAT32_IEEE autosar_swc_aeb_CM_single 0 0 -3.4E+38 3.4E+38 ECU_ADDRESS 0xfe4ab7c8 /* @ECU_Address@autosar_swc_aeb_rtARID_DEF.ALatRqrd_as@ */ /end MEASUREMENT
/begin MEASUREMENT autosar_swc_aeb_rtARID_DEF.ALatRqrd_l "" FLOAT32_IEEE autosar_swc_aeb_CM_single 0 0 -3.4E+38 3.4E+38 ECU_ADDRESS 0xfe4ab7bc /* @ECU_Address@autosar_swc_aeb_rtARID_DEF.ALatRqrd_l@ */ /end MEASUREMENT
/begin MEASUREMENT autosar_swc_aeb_rtARID_DEF.ALgtRqrd_e "" FLOAT32_IEEE autosar_swc_aeb_CM_single 0 0 -3.4E+38 3.4E+38 ECU_ADDRESS 0xfe4ab7e4 /* @ECU_Address@autosar_swc_aeb_rtARID_DEF.ALgtRqrd_e@ */ /end MEASUREMENT
/begin MEASUREMENT autosar_swc_aeb_rtARID_DEF.ALgtRqrd_j "" FLOAT32_IEEE autosar_swc_aeb_CM_single 0 0 -3.4E+38 3.4E+38 ECU_ADDRESS 0xfe4ab7ac /* @ECU_Address@autosar_swc_aeb_rtARID_DEF.ALgtRqrd_j@ */ /end MEASUREMENT
/begin MEASUREMENT autosar_swc_aeb_rtARID_DEF.Assignment "" FLOAT32_IEEE autosar_swc_aeb_CM_single 0 0 -3.4E+38 3.4E+38 LAYOUT COLUMN_DIR MATRIX_DIM 4 ECU_ADDRESS 0xfe4aa5f0 /* @ECU_Address@autosar_swc_aeb_rtARID_DEF.Assignment@ */ /end MEASUREMENT
/begin MEASUREMENT autosar_swc_aeb_rtARID_DEF.Assignment_k "" SBYTE autosar_swc_aeb_CM_int8 0 0 -128 127 LAYOUT COLUMN_DIR MATRIX_DIM 4 ECU_ADDRESS 0xfe4aba16 /* @ECU_Address@autosar_swc_aeb_rtARID_DEF.Assignment_k@ */ /end MEASUREMENT
/begin MEASUREMENT autosar_swc_aeb_rtARID_DEF.ConfirmationPrimaryTarget "" UBYTE autosar_swc_aeb_CM_uint8 0 0 0 255 ECU_ADDRESS 0xfe4aba56 /* @ECU_Address@autosar_swc_aeb_rtARID_DEF.ConfirmationPrimaryTarget@ */ /end MEASUREMENT
/begin MEASUREMENT autosar_swc_aeb_rtARID_DEF.IfEnabled1_ActiveSubsystem_i "" SBYTE autosar_swc_aeb_CM_int8 0 0 -128 127 ECU_ADDRESS 0xfe4aba21 /* @ECU_Address@autosar_swc_aeb_rtARID_DEF.IfEnabled1_ActiveSubsystem_i@ */ /end MEASUREMENT
/begin MEASUREMENT autosar_swc_aeb_rtARID_DEF.IfEnabled2_ActiveSubsystem "" SBYTE autosar_swc_aeb_CM_int8 0 0 -128 127 ECU_ADDRESS 0xfe4aba22 /* @ECU_Address@autosar_swc_aeb_rtARID_DEF.IfEnabled2_ActiveSubsystem@ */ /end MEASUREMENT
/begin MEASUREMENT autosar_swc_aeb_rtARID_DEF.IfEnabled3_ActiveSubsystem "" SBYTE autosar_swc_aeb_CM_int8 0 0 -128 127 ECU_ADDRESS 0xfe4aba23 /* @ECU_Address@autosar_swc_aeb_rtARID_DEF.IfEnabled3_ActiveSubsystem@ */ /end MEASUREMENT
/begin MEASUREMENT autosar_swc_aeb_rtARID_DEF.IfEnabled5_ActiveSubsystem "" SBYTE autosar_swc_aeb_CM_int8 0 0 -128 127 ECU_ADDRESS 0xfe4aba24 /* @ECU_Address@autosar_swc_aeb_rtARID_DEF.IfEnabled5_ActiveSubsystem@ */ /end MEASUREMENT
/begin MEASUREMENT autosar_swc_aeb_rtARID_DEF.IfEnabled6_ActiveSubsystem "" SBYTE autosar_swc_aeb_CM_int8 0 0 -128 127 ECU_ADDRESS 0xfe4aba25 /* @ECU_Address@autosar_swc_aeb_rtARID_DEF.IfEnabled6_ActiveSubsystem@ */ /end MEASUREMENT
/begin MEASUREMENT autosar_swc_aeb_rtARID_DEF.IfEnabled_ActiveSubsystem_b "" SBYTE autosar_swc_aeb_CM_int8 0 0 -128 127 ECU_ADDRESS 0xfe4aba20 /* @ECU_Address@autosar_swc_aeb_rtARID_DEF.IfEnabled_ActiveSubsystem_b@ */ /end MEASUREMENT
/begin MEASUREMENT autosar_swc_aeb_rtARID_DEF.LastSegment_c "" UBYTE autosar_swc_aeb_CM_uint8 0 0 0 255 ECU_ADDRESS 0xfe4aba58 /* @ECU_Address@autosar_swc_aeb_rtARID_DEF.LastSegment_c@ */ /end MEASUREMENT
/begin MEASUREMENT autosar_swc_aeb_rtARID_DEF.MinALgtRqrd "" FLOAT32_IEEE autosar_swc_aeb_CM_single 0 0 -3.4E+38 3.4E+38 ECU_ADDRESS 0xfe4ab78c /* @ECU_Address@autosar_swc_aeb_rtARID_DEF.MinALgtRqrd@ */ /end MEASUREMENT
/begin MEASUREMENT autosar_swc_aeb_rtARID_DEF.Out "" ULONG autosar_swc_aeb_CM_uint32 0 0 0 4294967295 ECU_ADDRESS 0xfe4ab9e0 /* @ECU_Address@autosar_swc_aeb_rtARID_DEF.Out@ */ /end MEASUREMENT
/begin MEASUREMENT autosar_swc_aeb_rtARID_DEF.PosnLgt "" FLOAT32_IEEE autosar_swc_aeb_CM_single 0 0 -3.4E+38 3.4E+38 ECU_ADDRESS 0xfe4ab790 /* @ECU_Address@autosar_swc_aeb_rtARID_DEF.PosnLgt@ */ /end MEASUREMENT
/begin MEASUREMENT autosar_swc_aeb_rtARID_DEF.PosnLgt_b "" FLOAT32_IEEE autosar_swc_aeb_CM_single 0 0 -3.4E+38 3.4E+38 ECU_ADDRESS 0xfe4ab7b0 /* @ECU_Address@autosar_swc_aeb_rtARID_DEF.PosnLgt_b@ */ /end MEASUREMENT
/begin MEASUREMENT autosar_swc_aeb_rtARID_DEF.PredALatObj_d "" FLOAT32_IEEE autosar_swc_aeb_CM_single 0 0 -3.4E+38 3.4E+38 ECU_ADDRESS 0xfe4ab7e0 /* @ECU_Address@autosar_swc_aeb_rtARID_DEF.PredALatObj_d@ */ /end MEASUREMENT
/begin MEASUREMENT autosar_swc_aeb_rtARID_DEF.PredALgtObj_g "" FLOAT32_IEEE autosar_swc_aeb_CM_single 0 0 -3.4E+38 3.4E+38 ECU_ADDRESS 0xfe4ab7d4 /* @ECU_Address@autosar_swc_aeb_rtARID_DEF.PredALgtObj_g@ */ /end MEASUREMENT
/begin MEASUREMENT autosar_swc_aeb_rtARID_DEF.PredPosnLat_f "" FLOAT32_IEEE autosar_swc_aeb_CM_single 0 0 -3.4E+38 3.4E+38 ECU_ADDRESS 0xfe4ab7d8 /* @ECU_Address@autosar_swc_aeb_rtARID_DEF.PredPosnLat_f@ */ /end MEASUREMENT
/begin MEASUREMENT autosar_swc_aeb_rtARID_DEF.PredPosnLgt_a "" FLOAT32_IEEE autosar_swc_aeb_CM_single 0 0 -3.4E+38 3.4E+38 ECU_ADDRESS 0xfe4ab7cc /* @ECU_Address@autosar_swc_aeb_rtARID_DEF.PredPosnLgt_a@ */ /end MEASUREMENT
/begin MEASUREMENT autosar_swc_aeb_rtARID_DEF.PredVLatObj_c "" FLOAT32_IEEE autosar_swc_aeb_CM_single 0 0 -3.4E+38 3.4E+38 ECU_ADDRESS 0xfe4ab7dc /* @ECU_Address@autosar_swc_aeb_rtARID_DEF.PredVLatObj_c@ */ /end MEASUREMENT
/begin MEASUREMENT autosar_swc_aeb_rtARID_DEF.PredVLgtObj_c "" FLOAT32_IEEE autosar_swc_aeb_CM_single 0 0 -3.4E+38 3.4E+38 ECU_ADDRESS 0xfe4ab7d0 /* @ECU_Address@autosar_swc_aeb_rtARID_DEF.PredVLgtObj_c@ */ /end MEASUREMENT
/begin MEASUREMENT autosar_swc_aeb_rtARID_DEF.ProjectedLengthSideLat "" FLOAT32_IEEE autosar_swc_aeb_CM_single 0 0 -3.4E+38 3.4E+38 ECU_ADDRESS 0xfe4ab7b4 /* @ECU_Address@autosar_swc_aeb_rtARID_DEF.ProjectedLengthSideLat@ */ /end MEASUREMENT
/begin MEASUREMENT autosar_swc_aeb_rtARID_DEF.ProjectedLengthSideLat_c "" FLOAT32_IEEE autosar_swc_aeb_CM_single 0 0 -3.4E+38 3.4E+38 ECU_ADDRESS 0xfe4ab7c0 /* @ECU_Address@autosar_swc_aeb_rtARID_DEF.ProjectedLengthSideLat_c@ */ /end MEASUREMENT
/begin MEASUREMENT autosar_swc_aeb_rtARID_DEF.ProjectedPosnLatRel "" FLOAT32_IEEE autosar_swc_aeb_CM_single 0 0 -3.4E+38 3.4E+38 ECU_ADDRESS 0xfe4ab7b8 /* @ECU_Address@autosar_swc_aeb_rtARID_DEF.ProjectedPosnLatRel@ */ /end MEASUREMENT
/begin MEASUREMENT autosar_swc_aeb_rtARID_DEF.ProjectedPosnLatRel_i "" FLOAT32_IEEE autosar_swc_aeb_CM_single 0 0 -3.4E+38 3.4E+38 ECU_ADDRESS 0xfe4ab7c4 /* @ECU_Address@autosar_swc_aeb_rtARID_DEF.ProjectedPosnLatRel_i@ */ /end MEASUREMENT
/begin MEASUREMENT autosar_swc_aeb_rtARID_DEF.ThreatFoundForWarn "" UBYTE autosar_swc_aeb_CM_logical 0 0 0 1 ECU_ADDRESS 0xfe4abac6 /* @ECU_Address@autosar_swc_aeb_rtARID_DEF.ThreatFoundForWarn@ */ /end MEASUREMENT
/begin COMPU_METHOD autosar_swc_aeb_CM_int8 "Q = V" IDENTICAL "%3.0" "" /end COMPU_METHOD
/begin COMPU_METHOD autosar_swc_aeb_CM_logical "Q = V" IDENTICAL "%1.0" "" /end COMPU_METHOD
/begin COMPU_METHOD autosar_swc_aeb_CM_single "Q = V" IDENTICAL "%8.6" "" /end COMPU_METHOD
/begin COMPU_METHOD autosar_swc_aeb_CM_single_m "Q = V" IDENTICAL "%8.6" "m" /end COMPU_METHOD
/begin COMPU_METHOD autosar_swc_aeb_CM_single_m_per_s "Q = V" IDENTICAL "%8.6" "m/s" /end COMPU_METHOD
/begin COMPU_METHOD autosar_swc_aeb_CM_single_s "Q = V" IDENTICAL "%8.6" "s" /end COMPU_METHOD
/begin COMPU_METHOD autosar_swc_aeb_CM_uint32 "Q = V" IDENTICAL "%10.0" "" /end COMPU_METHOD
/begin COMPU_METHOD autosar_swc_aeb_CM_uint8 "Q = V" IDENTICAL "%3.0" "" /end COMPU_METHOD
/begin RECORD_LAYOUT Record_BOOLEAN FNC_VALUES 1 UBYTE COLUMN_DIR DIRECT /end RECORD_LAYOUT
/begin RECORD_LAYOUT Record_FLOAT32_IEEE FNC_VALUES 1 FLOAT32_IEEE COLUMN_DIR DIRECT /end RECORD_LAYOUT
/begin GROUP autosar_swc_aeb_autosar_swc_aeb_Step_sys_Subsystem_Reference_AEB_Function_Run_AsyEvlrCritEve_Step_Func_Run_AsyEvlrCritEve_Step_Func_TAWrapper_LongitudinalThreatAssessor_LongitudinalThreatOutputSelector_ForIntv_DefaultValues "autosar_swc_aeb/autosar_swc_aeb_Step_sys/Subsystem Reference/AEB Function/Run_AsyEvlrCritEve_Step_Func/Run_AsyEvlrCritEve_Step_Func/TAWrapper/LongitudinalThreatAssessor/LongitudinalThreatOutputSelector/ForIntv/DefaultValues"
 /begin REF_CHARACTERISTIC CLTS_DstUpprLimInAsyEvlrCritEve_Ca CLTS_TiUpprLimInAsyEvlrCritEve_Ca /end REF_CHARACTERISTIC
/end GROUP
/begin GROUP autosar_swc_aeb_autosar_swc_aeb_Step_sys_Subsystem_Reference_AEB_Function_Run_AsyEvlrCritEve_Step_Func_Run_AsyEvlrCritEve_Step_Func_TAWrapper_LongitudinalThreatAssessor_LongitudinalThreatOutputSelector_ForIntv_PrimTarExtractor "autosar_swc_aeb/autosar_swc_aeb_Step_sys/Subsystem Reference/AEB Function/Run_AsyEvlrCritEve_Step_Func/Run_AsyEvlrCritEve_Step_Func/TAWrapper/LongitudinalThreatAssessor/LongitudinalThreatOutputSelector/ForIntv/PrimTarExtractor"
 /begin SUB_GROUP autosar_swc_aeb_autosar_swc_aeb_Step_sys_Subsystem_Reference_AEB_Function_Run_AsyEvlrCritEve_Step_Func_Run_AsyEvlrCritEve_Step_Func_TAWrapper_LongitudinalThreatAssessor_LongitudinalThreatOutputSelector_ForIntv_PrimTarExtractor_ConvertSamplesToTime /end SUB_GROUP
 /begin REF_CHARACTERISTIC CLTS_ALowrLimInAsyEvlrCritEve_Ca CLTS_AUpprLimInAsyEvlrCritEve_Ca CLTS_DstUpprLimInAsyEvlrCritEve_Ca CLTS_PosnLatUpprLimInAsyEvlrCritEve_Ca CLTS_TruckWidthMaxInAsyEvlrCritEve_Ca CLTS_VLatUpprLimInAsyEvlrCritEve_Ca CLTS_VLgtUpprLimInAsyEvlrCritEve_Ca /end REF_CHARACTERISTIC
/end GROUP
/begin GROUP autosar_swc_aeb_autosar_swc_aeb_Step_sys_Subsystem_Reference_AEB_Function_Run_AsyEvlrCritEve_Step_Func_Run_AsyEvlrCritEve_Step_Func_TAWrapper_LongitudinalThreatAssessor_LongitudinalThreatOutputSelector_ForIntv_PrimTarExtractor_ConvertSamplesToTime "autosar_swc_aeb/autosar_swc_aeb_Step_sys/Subsystem Reference/AEB Function/Run_AsyEvlrCritEve_Step_Func/Run_AsyEvlrCritEve_Step_Func/TAWrapper/LongitudinalThreatAssessor/LongitudinalThreatOutputSelector/ForIntv/PrimTarExtractor/ConvertSamplesToTime" /begin REF_MEASUREMENT autosar_swc_aeb_rtARID_DEF.ConfirmationPrimaryTarget /end REF_MEASUREMENT /end GROUP
/begin GROUP autosar_swc_aeb_autosar_swc_aeb_Step_sys_Subsystem_Reference_AEB_Function_Run_AsyEvlrCritEve_Step_Func_Run_AsyEvlrCritEve_Step_Func_TAWrapper_LongitudinalThreatAssessor_LongitudinalThreatOutputSelector_ForWarn "autosar_swc_aeb/autosar_swc_aeb_Step_sys/Subsystem Reference/AEB Function/Run_AsyEvlrCritEve_Step_Func/Run_AsyEvlrCritEve_Step_Func/TAWrapper/LongitudinalThreatAssessor/LongitudinalThreatOutputSelector/ForWarn"
 /begin SUB_GROUP autosar_swc_aeb_autosar_swc_aeb_Step_sys_Subsystem_Reference_AEB_Function_Run_AsyEvlrCritEve_Step_Func_Run_AsyEvlrCritEve_Step_Func_TAWrapper_LongitudinalThreatAssessor_LongitudinalThreatOutputSelector_ForWarn_DefaultValues autosar_swc_aeb_autosar_swc_aeb_Step_sys_Subsystem_Reference_AEB_Function_Run_AsyEvlrCritEve_Step_Func_Run_AsyEvlrCritEve_Step_Func_TAWrapper_LongitudinalThreatAssessor_LongitudinalThreatOutputSelector_ForWarn_PrimTarExtractor /end SUB_GROUP
/end GROUP
/begin GROUP autosar_swc_aeb_autosar_swc_aeb_Step_sys_Subsystem_Reference_AEB_Function_Run_AsyEvlrCritEve_Step_Func_Run_AsyEvlrCritEve_Step_Func_TAWrapper_LongitudinalThreatAssessor_LongitudinalThreatOutputSelector_ForWarn_DefaultValues "autosar_swc_aeb/autosar_swc_aeb_Step_sys/Subsystem Reference/AEB Function/Run_AsyEvlrCritEve_Step_Func/Run_AsyEvlrCritEve_Step_Func/TAWrapper/LongitudinalThreatAssessor/LongitudinalThreatOutputSelector/ForWarn/DefaultValues"
 /begin REF_CHARACTERISTIC CLTS_DstUpprLimInAsyEvlrCritEve_Ca CLTS_TiUpprLimInAsyEvlrCritEve_Ca /end REF_CHARACTERISTIC
/end GROUP
/begin GROUP autosar_swc_aeb_autosar_swc_aeb_Step_sys_Subsystem_Reference_AEB_Function_Run_AsyEvlrCritEve_Step_Func_Run_AsyEvlrCritEve_Step_Func_TAWrapper_LongitudinalThreatAssessor_LongitudinalThreatOutputSelector_ForWarn_PrimTarExtractor "autosar_swc_aeb/autosar_swc_aeb_Step_sys/Subsystem Reference/AEB Function/Run_AsyEvlrCritEve_Step_Func/Run_AsyEvlrCritEve_Step_Func/TAWrapper/LongitudinalThreatAssessor/LongitudinalThreatOutputSelector/ForWarn/PrimTarExtractor"
 /begin REF_CHARACTERISTIC CLTS_ALowrLimInAsyEvlrCritEve_Ca CLTS_AUpprLimInAsyEvlrCritEve_Ca CLTS_DstUpprLimInAsyEvlrCritEve_Ca CLTS_PosnLatUpprLimInAsyEvlrCritEve_Ca CLTS_TruckWidthMaxInAsyEvlrCritEve_Ca CLTS_VLatUpprLimInAsyEvlrCritEve_Ca CLTS_VLgtUpprLimInAsyEvlrCritEve_Ca /end REF_CHARACTERISTIC
/end GROUP
/begin GROUP autosar_swc_aeb_autosar_swc_aeb_Step_sys_Subsystem_Reference_AEB_Function_Run_AsyEvlrCritEve_Step_Func_Run_AsyEvlrCritEve_Step_Func_TAWrapper_LongitudinalThreatAssessor_SingleTargetThreatAssessor "autosar_swc_aeb/autosar_swc_aeb_Step_sys/Subsystem Reference/AEB Function/Run_AsyEvlrCritEve_Step_Func/Run_AsyEvlrCritEve_Step_Func/TAWrapper/LongitudinalThreatAssessor/SingleTargetThreatAssessor"
 /begin SUB_GROUP autosar_swc_aeb_autosar_swc_aeb_Step_sys_Subsystem_Reference_AEB_Function_Run_AsyEvlrCritEve_Step_Func_Run_AsyEvlrCritEve_Step_Func_TAWrapper_LongitudinalThreatAssessor_SingleTargetThreatAssessor_Logging autosar_swc_aeb_autosar_swc_aeb_Step_sys_Subsystem_Reference_AEB_Function_Run_AsyEvlrCritEve_Step_Func_Run_AsyEvlrCritEve_Step_Func_TAWrapper_LongitudinalThreatAssessor_SingleTargetThreatAssessor_ObjectEnabler autosar_swc_aeb_autosar_swc_aeb_Step_sys_Subsystem_Reference_AEB_Function_Run_AsyEvlrCritEve_Step_Func_Run_AsyEvlrCritEve_Step_Func_TAWrapper_LongitudinalThreatAssessor_SingleTargetThreatAssessor_PrimaryTargetForIntv autosar_swc_aeb_autosar_swc_aeb_Step_sys_Subsystem_Reference_AEB_Function_Run_AsyEvlrCritEve_Step_Func_Run_AsyEvlrCritEve_Step_Func_TAWrapper_LongitudinalThreatAssessor_SingleTargetThreatAssessor_PrimaryTargetForWarn /end SUB_GROUP
/end GROUP
/begin GROUP autosar_swc_aeb_autosar_swc_aeb_Step_sys_Subsystem_Reference_AEB_Function_Run_AsyEvlrCritEve_Step_Func_Run_AsyEvlrCritEve_Step_Func_TAWrapper_LongitudinalThreatAssessor_SingleTargetThreatAssessor_Logging "autosar_swc_aeb/autosar_swc_aeb_Step_sys/Subsystem Reference/AEB Function/Run_AsyEvlrCritEve_Step_Func/Run_AsyEvlrCritEve_Step_Func/TAWrapper/LongitudinalThreatAssessor/SingleTargetThreatAssessor/Logging"
 /begin REF_MEASUREMENT autosar_swc_aeb_rtARID_DEF.ALgtRqrd_e autosar_swc_aeb_rtARID_DEF.ALgtRqrd_j /end REF_MEASUREMENT
/end GROUP
/begin GROUP autosar_swc_aeb_autosar_swc_aeb_Step_sys_Subsystem_Reference_AEB_Function_Run_AsyEvlrCritEve_Step_Func_Run_AsyEvlrCritEve_Step_Func_TAWrapper_LongitudinalThreatAssessor_SingleTargetThreatAssessor_ObjectEnabler "autosar_swc_aeb/autosar_swc_aeb_Step_sys/Subsystem Reference/AEB Function/Run_AsyEvlrCritEve_Step_Func/Run_AsyEvlrCritEve_Step_Func/TAWrapper/LongitudinalThreatAssessor/SingleTargetThreatAssessor/ObjectEnabler"
 /begin SUB_GROUP autosar_swc_aeb_autosar_swc_aeb_Step_sys_Subsystem_Reference_AEB_Function_Run_AsyEvlrCritEve_Step_Func_Run_AsyEvlrCritEve_Step_Func_TAWrapper_LongitudinalThreatAssessor_SingleTargetThreatAssessor_ObjectEnabler_ObjectEnablerForIntv autosar_swc_aeb_autosar_swc_aeb_Step_sys_Subsystem_Reference_AEB_Function_Run_AsyEvlrCritEve_Step_Func_Run_AsyEvlrCritEve_Step_Func_TAWrapper_LongitudinalThreatAssessor_SingleTargetThreatAssessor_ObjectEnabler_ObjectEnablerForWarn /end SUB_GROUP
/end GROUP
/begin GROUP autosar_swc_aeb_autosar_swc_aeb_Step_sys_Subsystem_Reference_AEB_Function_Run_AsyEvlrCritEve_Step_Func_Run_AsyEvlrCritEve_Step_Func_TAWrapper_LongitudinalThreatAssessor_SingleTargetThreatAssessor_ObjectEnabler_ObjectEnablerForIntv "autosar_swc_aeb/autosar_swc_aeb_Step_sys/Subsystem Reference/AEB Function/Run_AsyEvlrCritEve_Step_Func/Run_AsyEvlrCritEve_Step_Func/TAWrapper/LongitudinalThreatAssessor/SingleTargetThreatAssessor/ObjectEnabler/ObjectEnablerForIntv"
 /begin SUB_GROUP autosar_swc_aeb_autosar_swc_aeb_Step_sys_Subsystem_Reference_AEB_Function_Run_AsyEvlrCritEve_Step_Func_Run_AsyEvlrCritEve_Step_Func_TAWrapper_LongitudinalThreatAssessor_SingleTargetThreatAssessor_ObjectEnabler_ObjectEnablerForIntv_CheckPrediction autosar_swc_aeb_autosar_swc_aeb_Step_sys_Subsystem_Reference_AEB_Function_Run_AsyEvlrCritEve_Step_Func_Run_AsyEvlrCritEve_Step_Func_TAWrapper_LongitudinalThreatAssessor_SingleTargetThreatAssessor_ObjectEnabler_ObjectEnablerForIntv_CheckSpeed /end SUB_GROUP
/end GROUP
/begin GROUP autosar_swc_aeb_autosar_swc_aeb_Step_sys_Subsystem_Reference_AEB_Function_Run_AsyEvlrCritEve_Step_Func_Run_AsyEvlrCritEve_Step_Func_TAWrapper_LongitudinalThreatAssessor_SingleTargetThreatAssessor_ObjectEnabler_ObjectEnablerForIntv_CheckPrediction "autosar_swc_aeb/autosar_swc_aeb_Step_sys/Subsystem Reference/AEB Function/Run_AsyEvlrCritEve_Step_Func/Run_AsyEvlrCritEve_Step_Func/TAWrapper/LongitudinalThreatAssessor/SingleTargetThreatAssessor/ObjectEnabler/ObjectEnablerForIntv/CheckPrediction" /begin REF_CHARACTERISTIC CLTS_SpdPredMinInAsyEvlrCritEve_Ca /end REF_CHARACTERISTIC /end GROUP
/begin GROUP autosar_swc_aeb_autosar_swc_aeb_Step_sys_Subsystem_Reference_AEB_Function_Run_AsyEvlrCritEve_Step_Func_Run_AsyEvlrCritEve_Step_Func_TAWrapper_LongitudinalThreatAssessor_SingleTargetThreatAssessor_ObjectEnabler_ObjectEnablerForIntv_CheckSpeed "autosar_swc_aeb/autosar_swc_aeb_Step_sys/Subsystem Reference/AEB Function/Run_AsyEvlrCritEve_Step_Func/Run_AsyEvlrCritEve_Step_Func/TAWrapper/LongitudinalThreatAssessor/SingleTargetThreatAssessor/ObjectEnabler/ObjectEnablerForIntv/CheckSpeed" /begin REF_CHARACTERISTIC CLTS_SpdMovgToSelfMaxForIntvInAsyEvlrCritEve_Ca /end REF_CHARACTERISTIC /end GROUP
/begin GROUP autosar_swc_aeb_autosar_swc_aeb_Step_sys_Subsystem_Reference_AEB_Function_Run_AsyEvlrCritEve_Step_Func_Run_AsyEvlrCritEve_Step_Func_TAWrapper_LongitudinalThreatAssessor_SingleTargetThreatAssessor_ObjectEnabler_ObjectEnablerForWarn "autosar_swc_aeb/autosar_swc_aeb_Step_sys/Subsystem Reference/AEB Function/Run_AsyEvlrCritEve_Step_Func/Run_AsyEvlrCritEve_Step_Func/TAWrapper/LongitudinalThreatAssessor/SingleTargetThreatAssessor/ObjectEnabler/ObjectEnablerForWarn"
 /begin SUB_GROUP autosar_swc_aeb_autosar_swc_aeb_Step_sys_Subsystem_Reference_AEB_Function_Run_AsyEvlrCritEve_Step_Func_Run_AsyEvlrCritEve_Step_Func_TAWrapper_LongitudinalThreatAssessor_SingleTargetThreatAssessor_ObjectEnabler_ObjectEnablerForWarn_CheckConfirmationTime autosar_swc_aeb_autosar_swc_aeb_Step_sys_Subsystem_Reference_AEB_Function_Run_AsyEvlrCritEve_Step_Func_Run_AsyEvlrCritEve_Step_Func_TAWrapper_LongitudinalThreatAssessor_SingleTargetThreatAssessor_ObjectEnabler_ObjectEnablerForWarn_CheckOncomingObjectConditions autosar_swc_aeb_autosar_swc_aeb_Step_sys_Subsystem_Reference_AEB_Function_Run_AsyEvlrCritEve_Step_Func_Run_AsyEvlrCritEve_Step_Func_TAWrapper_LongitudinalThreatAssessor_SingleTargetThreatAssessor_ObjectEnabler_ObjectEnablerForWarn_CheckQuality /end SUB_GROUP
/end GROUP
/begin GROUP autosar_swc_aeb_autosar_swc_aeb_Step_sys_Subsystem_Reference_AEB_Function_Run_AsyEvlrCritEve_Step_Func_Run_AsyEvlrCritEve_Step_Func_TAWrapper_LongitudinalThreatAssessor_SingleTargetThreatAssessor_ObjectEnabler_ObjectEnablerForWarn_CheckConfirmationTime "autosar_swc_aeb/autosar_swc_aeb_Step_sys/Subsystem Reference/AEB Function/Run_AsyEvlrCritEve_Step_Func/Run_AsyEvlrCritEve_Step_Func/TAWrapper/LongitudinalThreatAssessor/SingleTargetThreatAssessor/ObjectEnabler/ObjectEnablerForWarn/CheckConfirmationTime" /begin REF_CHARACTERISTIC CLTS_VehOfUkwnClassCfmDlyForWarnInAsyEvlrCritEve_Ca /end REF_CHARACTERISTIC /end GROUP
/begin GROUP autosar_swc_aeb_autosar_swc_aeb_Step_sys_Subsystem_Reference_AEB_Function_Run_AsyEvlrCritEve_Step_Func_Run_AsyEvlrCritEve_Step_Func_TAWrapper_LongitudinalThreatAssessor_SingleTargetThreatAssessor_ObjectEnabler_ObjectEnablerForWarn_CheckOncomingObjectConditions "autosar_swc_aeb/autosar_swc_aeb_Step_sys/Subsystem Reference/AEB Function/Run_AsyEvlrCritEve_Step_Func/Run_AsyEvlrCritEve_Step_Func/TAWrapper/LongitudinalThreatAssessor/SingleTargetThreatAssessor/ObjectEnabler/ObjectEnablerForWarn/CheckOncomingObjectConditions" /begin REF_CHARACTERISTIC CLTS_SpdMovgToSelfMaxForWarnInAsyEvlrCritEve_Ca /end REF_CHARACTERISTIC /end GROUP
/begin GROUP autosar_swc_aeb_autosar_swc_aeb_Step_sys_Subsystem_Reference_AEB_Function_Run_AsyEvlrCritEve_Step_Func_Run_AsyEvlrCritEve_Step_Func_TAWrapper_LongitudinalThreatAssessor_SingleTargetThreatAssessor_ObjectEnabler_ObjectEnablerForWarn_CheckQuality "autosar_swc_aeb/autosar_swc_aeb_Step_sys/Subsystem Reference/AEB Function/Run_AsyEvlrCritEve_Step_Func/Run_AsyEvlrCritEve_Step_Func/TAWrapper/LongitudinalThreatAssessor/SingleTargetThreatAssessor/ObjectEnabler/ObjectEnablerForWarn/CheckQuality"
 /begin REF_CHARACTERISTIC CLTS_SpdMaxForQlyChkInAsyEvlrCritEve_Ca CLTS_TiToCllsnMaxForQlyChkInAsyEvlrCritEve_Ca CLTS_UseQlyChkForWarnInAsyEvlrCritEve_Ca /end REF_CHARACTERISTIC
/end GROUP
/begin GROUP autosar_swc_aeb_autosar_swc_aeb_Step_sys_Subsystem_Reference_AEB_Function_Run_AsyEvlrCritEve_Step_Func_Run_AsyEvlrCritEve_Step_Func_TAWrapper_LongitudinalThreatAssessor_SingleTargetThreatAssessor_PrimaryTargetForIntv "autosar_swc_aeb/autosar_swc_aeb_Step_sys/Subsystem Reference/AEB Function/Run_AsyEvlrCritEve_Step_Func/Run_AsyEvlrCritEve_Step_Func/TAWrapper/LongitudinalThreatAssessor/SingleTargetThreatAssessor/PrimaryTargetForIntv"
 /begin SUB_GROUP autosar_swc_aeb_autosar_swc_aeb_Step_sys_Subsystem_Reference_AEB_Function_Run_AsyEvlrCritEve_Step_Func_Run_AsyEvlrCritEve_Step_Func_TAWrapper_LongitudinalThreatAssessor_SingleTargetThreatAssessor_PrimaryTargetForIntv_DIAG_TA_Short_CurrentIndex autosar_swc_aeb_autosar_swc_aeb_Step_sys_Subsystem_Reference_AEB_Function_Run_AsyEvlrCritEve_Step_Func_Run_AsyEvlrCritEve_Step_Func_TAWrapper_LongitudinalThreatAssessor_SingleTargetThreatAssessor_PrimaryTargetForIntv_FindHighestLateralThreat autosar_swc_aeb_autosar_swc_aeb_Step_sys_Subsystem_Reference_AEB_Function_Run_AsyEvlrCritEve_Step_Func_Run_AsyEvlrCritEve_Step_Func_TAWrapper_LongitudinalThreatAssessor_SingleTargetThreatAssessor_PrimaryTargetForIntv_FindPrimaryTargetForIntv autosar_swc_aeb_autosar_swc_aeb_Step_sys_Subsystem_Reference_AEB_Function_Run_AsyEvlrCritEve_Step_Func_Run_AsyEvlrCritEve_Step_Func_TAWrapper_LongitudinalThreatAssessor_SingleTargetThreatAssessor_PrimaryTargetForIntv_PosnLgtForIntv autosar_swc_aeb_autosar_swc_aeb_Step_sys_Subsystem_Reference_AEB_Function_Run_AsyEvlrCritEve_Step_Func_Run_AsyEvlrCritEve_Step_Func_TAWrapper_LongitudinalThreatAssessor_SingleTargetThreatAssessor_PrimaryTargetForIntv_RequiredLongitudinalAccelerationComputerForIntv autosar_swc_aeb_autosar_swc_aeb_Step_sys_Subsystem_Reference_AEB_Function_Run_AsyEvlrCritEve_Step_Func_Run_AsyEvlrCritEve_Step_Func_TAWrapper_LongitudinalThreatAssessor_SingleTargetThreatAssessor_PrimaryTargetForIntv_SimpleLateralAccelerationEstimatorForIntv autosar_swc_aeb_autosar_swc_aeb_Step_sys_Subsystem_Reference_AEB_Function_Run_AsyEvlrCritEve_Step_Func_Run_AsyEvlrCritEve_Step_Func_TAWrapper_LongitudinalThreatAssessor_SingleTargetThreatAssessor_PrimaryTargetForIntv_SimpleLateralAccelerationEstimatorForIntv1 /end SUB_GROUP
 /begin REF_MEASUREMENT autosar_swc_aeb_rtARID_DEF.IfEnabled1_ActiveSubsystem_i autosar_swc_aeb_rtARID_DEF.IfEnabled2_ActiveSubsystem autosar_swc_aeb_rtARID_DEF.IfEnabled5_ActiveSubsystem autosar_swc_aeb_rtARID_DEF.IfEnabled_ActiveSubsystem_b /end REF_MEASUREMENT
/end GROUP
/begin GROUP autosar_swc_aeb_autosar_swc_aeb_Step_sys_Subsystem_Reference_AEB_Function_Run_AsyEvlrCritEve_Step_Func_Run_AsyEvlrCritEve_Step_Func_TAWrapper_LongitudinalThreatAssessor_SingleTargetThreatAssessor_PrimaryTargetForIntv_DIAG_TA_Short_CurrentIndex "autosar_swc_aeb/autosar_swc_aeb_Step_sys/Subsystem Reference/AEB Function/Run_AsyEvlrCritEve_Step_Func/Run_AsyEvlrCritEve_Step_Func/TAWrapper/LongitudinalThreatAssessor/SingleTargetThreatAssessor/PrimaryTargetForIntv/DIAG_TA_Short_CurrentIndex"
 /begin SUB_GROUP autosar_swc_aeb_autosar_swc_aeb_Step_sys_Subsystem_Reference_AEB_Function_Run_AsyEvlrCritEve_Step_Func_Run_AsyEvlrCritEve_Step_Func_TAWrapper_LongitudinalThreatAssessor_SingleTargetThreatAssessor_PrimaryTargetForIntv_DIAG_TA_Short_CurrentIndex_off /end SUB_GROUP
/end GROUP
/begin GROUP autosar_swc_aeb_autosar_swc_aeb_Step_sys_Subsystem_Reference_AEB_Function_Run_AsyEvlrCritEve_Step_Func_Run_AsyEvlrCritEve_Step_Func_TAWrapper_LongitudinalThreatAssessor_SingleTargetThreatAssessor_PrimaryTargetForIntv_DIAG_TA_Short_CurrentIndex_off "autosar_swc_aeb/autosar_swc_aeb_Step_sys/Subsystem Reference/AEB Function/Run_AsyEvlrCritEve_Step_Func/Run_AsyEvlrCritEve_Step_Func/TAWrapper/LongitudinalThreatAssessor/SingleTargetThreatAssessor/PrimaryTargetForIntv/DIAG_TA_Short_CurrentIndex/off"
 /begin SUB_GROUP autosar_swc_aeb_autosar_swc_aeb_Step_sys_Subsystem_Reference_AEB_Function_Run_AsyEvlrCritEve_Step_Func_Run_AsyEvlrCritEve_Step_Func_TAWrapper_LongitudinalThreatAssessor_SingleTargetThreatAssessor_PrimaryTargetForIntv_DIAG_TA_Short_CurrentIndex_off_ALVTerm /end SUB_GROUP
/end GROUP
/begin GROUP autosar_swc_aeb_autosar_swc_aeb_Step_sys_Subsystem_Reference_AEB_Function_Run_AsyEvlrCritEve_Step_Func_Run_AsyEvlrCritEve_Step_Func_TAWrapper_LongitudinalThreatAssessor_SingleTargetThreatAssessor_PrimaryTargetForIntv_DIAG_TA_Short_CurrentIndex_off_ALVTerm "autosar_swc_aeb/autosar_swc_aeb_Step_sys/Subsystem Reference/AEB Function/Run_AsyEvlrCritEve_Step_Func/Run_AsyEvlrCritEve_Step_Func/TAWrapper/LongitudinalThreatAssessor/SingleTargetThreatAssessor/PrimaryTargetForIntv/DIAG_TA_Short_CurrentIndex/off/ALVTerm" /begin REF_MEASUREMENT autosar_swc_aeb_rtARID_DEF.Out /end REF_MEASUREMENT /end GROUP
/begin GROUP autosar_swc_aeb_autosar_swc_aeb_Step_sys_Subsystem_Reference_AEB_Function_Run_AsyEvlrCritEve_Step_Func_Run_AsyEvlrCritEve_Step_Func_TAWrapper_LongitudinalThreatAssessor_SingleTargetThreatAssessor_PrimaryTargetForIntv_FindHighestLateralThreat "autosar_swc_aeb/autosar_swc_aeb_Step_sys/Subsystem Reference/AEB Function/Run_AsyEvlrCritEve_Step_Func/Run_AsyEvlrCritEve_Step_Func/TAWrapper/LongitudinalThreatAssessor/SingleTargetThreatAssessor/PrimaryTargetForIntv/FindHighestLateralThreat"
 /begin REF_MEASUREMENT autosar_swc_aeb_rtARID_DEF.ALatRqrd_as autosar_swc_aeb_rtARID_DEF.ALatRqrd_l autosar_swc_aeb_rtARID_DEF.ProjectedLengthSideLat autosar_swc_aeb_rtARID_DEF.ProjectedLengthSideLat_c autosar_swc_aeb_rtARID_DEF.ProjectedPosnLatRel autosar_swc_aeb_rtARID_DEF.ProjectedPosnLatRel_i /end REF_MEASUREMENT
/end GROUP
/begin GROUP autosar_swc_aeb_autosar_swc_aeb_Step_sys_Subsystem_Reference_AEB_Function_Run_AsyEvlrCritEve_Step_Func_Run_AsyEvlrCritEve_Step_Func_TAWrapper_LongitudinalThreatAssessor_SingleTargetThreatAssessor_PrimaryTargetForIntv_FindPrimaryTargetForIntv "autosar_swc_aeb/autosar_swc_aeb_Step_sys/Subsystem Reference/AEB Function/Run_AsyEvlrCritEve_Step_Func/Run_AsyEvlrCritEve_Step_Func/TAWrapper/LongitudinalThreatAssessor/SingleTargetThreatAssessor/PrimaryTargetForIntv/FindPrimaryTargetForIntv"
 /begin SUB_GROUP autosar_swc_aeb_autosar_swc_aeb_Step_sys_Subsystem_Reference_AEB_Function_Run_AsyEvlrCritEve_Step_Func_Run_AsyEvlrCritEve_Step_Func_TAWrapper_LongitudinalThreatAssessor_SingleTargetThreatAssessor_PrimaryTargetForIntv_FindPrimaryTargetForIntv_FindPrimaryTargetForIntvLat autosar_swc_aeb_autosar_swc_aeb_Step_sys_Subsystem_Reference_AEB_Function_Run_AsyEvlrCritEve_Step_Func_Run_AsyEvlrCritEve_Step_Func_TAWrapper_LongitudinalThreatAssessor_SingleTargetThreatAssessor_PrimaryTargetForIntv_FindPrimaryTargetForIntv_FindPrimaryTargetForIntvLgt autosar_swc_aeb_autosar_swc_aeb_Step_sys_Subsystem_Reference_AEB_Function_Run_AsyEvlrCritEve_Step_Func_Run_AsyEvlrCritEve_Step_Func_TAWrapper_LongitudinalThreatAssessor_SingleTargetThreatAssessor_PrimaryTargetForIntv_FindPrimaryTargetForIntv_FindPrimaryTargetForIntvPosnLgt autosar_swc_aeb_autosar_swc_aeb_Step_sys_Subsystem_Reference_AEB_Function_Run_AsyEvlrCritEve_Step_Func_Run_AsyEvlrCritEve_Step_Func_TAWrapper_LongitudinalThreatAssessor_SingleTargetThreatAssessor_PrimaryTargetForIntv_FindPrimaryTargetForIntv_PrimTarSelectorForIntv /end SUB_GROUP
/end GROUP
/begin GROUP autosar_swc_aeb_autosar_swc_aeb_Step_sys_Subsystem_Reference_AEB_Function_Run_AsyEvlrCritEve_Step_Func_Run_AsyEvlrCritEve_Step_Func_TAWrapper_LongitudinalThreatAssessor_SingleTargetThreatAssessor_PrimaryTargetForIntv_FindPrimaryTargetForIntv_FindPrimaryTargetForIntvLat "autosar_swc_aeb/autosar_swc_aeb_Step_sys/Subsystem Reference/AEB Function/Run_AsyEvlrCritEve_Step_Func/Run_AsyEvlrCritEve_Step_Func/TAWrapper/LongitudinalThreatAssessor/SingleTargetThreatAssessor/PrimaryTargetForIntv/FindPrimaryTargetForIntv/FindPrimaryTargetForIntvLat"
 /begin SUB_GROUP autosar_swc_aeb_autosar_swc_aeb_Step_sys_Subsystem_Reference_AEB_Function_Run_AsyEvlrCritEve_Step_Func_Run_AsyEvlrCritEve_Step_Func_TAWrapper_LongitudinalThreatAssessor_SingleTargetThreatAssessor_PrimaryTargetForIntv_FindPrimaryTargetForIntv_FindPrimaryTargetForIntvLat_MaxALatSelector autosar_swc_aeb_autosar_swc_aeb_Step_sys_Subsystem_Reference_AEB_Function_Run_AsyEvlrCritEve_Step_Func_Run_AsyEvlrCritEve_Step_Func_TAWrapper_LongitudinalThreatAssessor_SingleTargetThreatAssessor_PrimaryTargetForIntv_FindPrimaryTargetForIntv_FindPrimaryTargetForIntvLat_PrimaryTargetSelector /end SUB_GROUP
/end GROUP
/begin GROUP autosar_swc_aeb_autosar_swc_aeb_Step_sys_Subsystem_Reference_AEB_Function_Run_AsyEvlrCritEve_Step_Func_Run_AsyEvlrCritEve_Step_Func_TAWrapper_LongitudinalThreatAssessor_SingleTargetThreatAssessor_PrimaryTargetForIntv_FindPrimaryTargetForIntv_FindPrimaryTargetForIntvLat_MaxALatSelector "autosar_swc_aeb/autosar_swc_aeb_Step_sys/Subsystem Reference/AEB Function/Run_AsyEvlrCritEve_Step_Func/Run_AsyEvlrCritEve_Step_Func/TAWrapper/LongitudinalThreatAssessor/SingleTargetThreatAssessor/PrimaryTargetForIntv/FindPrimaryTargetForIntv/FindPrimaryTargetForIntvLat/MaxALatSelector" /begin REF_MEASUREMENT autosar_swc_aeb_rtARID_DEF.Assignment /end REF_MEASUREMENT /end GROUP
/begin GROUP autosar_swc_aeb_autosar_swc_aeb_Step_sys_Subsystem_Reference_AEB_Function_Run_AsyEvlrCritEve_Step_Func_Run_AsyEvlrCritEve_Step_Func_TAWrapper_LongitudinalThreatAssessor_SingleTargetThreatAssessor_PrimaryTargetForIntv_FindPrimaryTargetForIntv_FindPrimaryTargetForIntvLat_PrimaryTargetSelector "autosar_swc_aeb/autosar_swc_aeb_Step_sys/Subsystem Reference/AEB Function/Run_AsyEvlrCritEve_Step_Func/Run_AsyEvlrCritEve_Step_Func/TAWrapper/LongitudinalThreatAssessor/SingleTargetThreatAssessor/PrimaryTargetForIntv/FindPrimaryTargetForIntv/FindPrimaryTargetForIntvLat/PrimaryTargetSelector" /begin REF_MEASUREMENT autosar_swc_aeb_rtARID_DEF.Assignment_k /end REF_MEASUREMENT /end GROUP
/begin GROUP autosar_swc_aeb_autosar_swc_aeb_Step_sys_Subsystem_Reference_AEB_Function_Run_AsyEvlrCritEve_Step_Func_Run_AsyEvlrCritEve_Step_Func_TAWrapper_LongitudinalThreatAssessor_SingleTargetThreatAssessor_PrimaryTargetForIntv_FindPrimaryTargetForIntv_FindPrimaryTargetForIntvLgt "autosar_swc_aeb/autosar_swc_aeb_Step_sys/Subsystem Reference/AEB Function/Run_AsyEvlrCritEve_Step_Func/Run_AsyEvlrCritEve_Step_Func/TAWrapper/LongitudinalThreatAssessor/SingleTargetThreatAssessor/PrimaryTargetForIntv/FindPrimaryTargetForIntv/FindPrimaryTargetForIntvLgt"
 /begin SUB_GROUP autosar_swc_aeb_autosar_swc_aeb_Step_sys_Subsystem_Reference_AEB_Function_Run_AsyEvlrCritEve_Step_Func_Run_AsyEvlrCritEve_Step_Func_TAWrapper_LongitudinalThreatAssessor_SingleTargetThreatAssessor_PrimaryTargetForIntv_FindPrimaryTargetForIntv_FindPrimaryTargetForIntvLgt_MaxDecelerationSelector1 /end SUB_GROUP
/end GROUP
/begin GROUP autosar_swc_aeb_autosar_swc_aeb_Step_sys_Subsystem_Reference_AEB_Function_Run_AsyEvlrCritEve_Step_Func_Run_AsyEvlrCritEve_Step_Func_TAWrapper_LongitudinalThreatAssessor_SingleTargetThreatAssessor_PrimaryTargetForIntv_FindPrimaryTargetForIntv_FindPrimaryTargetForIntvLgt_MaxDecelerationSelector1 "autosar_swc_aeb/autosar_swc_aeb_Step_sys/Subsystem Reference/AEB Function/Run_AsyEvlrCritEve_Step_Func/Run_AsyEvlrCritEve_Step_Func/TAWrapper/LongitudinalThreatAssessor/SingleTargetThreatAssessor/PrimaryTargetForIntv/FindPrimaryTargetForIntv/FindPrimaryTargetForIntvLgt/MaxDecelerationSelector1" /begin REF_MEASUREMENT autosar_swc_aeb_rtARID_DEF.ALgtRqrd_e /end REF_MEASUREMENT /end GROUP
/begin GROUP autosar_swc_aeb_autosar_swc_aeb_Step_sys_Subsystem_Reference_AEB_Function_Run_AsyEvlrCritEve_Step_Func_Run_AsyEvlrCritEve_Step_Func_TAWrapper_LongitudinalThreatAssessor_SingleTargetThreatAssessor_PrimaryTargetForIntv_FindPrimaryTargetForIntv_FindPrimaryTargetForIntvPosnLgt "autosar_swc_aeb/autosar_swc_aeb_Step_sys/Subsystem Reference/AEB Function/Run_AsyEvlrCritEve_Step_Func/Run_AsyEvlrCritEve_Step_Func/TAWrapper/LongitudinalThreatAssessor/SingleTargetThreatAssessor/PrimaryTargetForIntv/FindPrimaryTargetForIntv/FindPrimaryTargetForIntvPosnLgt"
 /begin SUB_GROUP autosar_swc_aeb_autosar_swc_aeb_Step_sys_Subsystem_Reference_AEB_Function_Run_AsyEvlrCritEve_Step_Func_Run_AsyEvlrCritEve_Step_Func_TAWrapper_LongitudinalThreatAssessor_SingleTargetThreatAssessor_PrimaryTargetForIntv_FindPrimaryTargetForIntv_FindPrimaryTargetForIntvPosnLgt_MInPosLgtSelector /end SUB_GROUP
/end GROUP
/begin GROUP autosar_swc_aeb_autosar_swc_aeb_Step_sys_Subsystem_Reference_AEB_Function_Run_AsyEvlrCritEve_Step_Func_Run_AsyEvlrCritEve_Step_Func_TAWrapper_LongitudinalThreatAssessor_SingleTargetThreatAssessor_PrimaryTargetForIntv_FindPrimaryTargetForIntv_FindPrimaryTargetForIntvPosnLgt_MInPosLgtSelector "autosar_swc_aeb/autosar_swc_aeb_Step_sys/Subsystem Reference/AEB Function/Run_AsyEvlrCritEve_Step_Func/Run_AsyEvlrCritEve_Step_Func/TAWrapper/LongitudinalThreatAssessor/SingleTargetThreatAssessor/PrimaryTargetForIntv/FindPrimaryTargetForIntv/FindPrimaryTargetForIntvPosnLgt/MInPosLgtSelector" /begin REF_MEASUREMENT autosar_swc_aeb_rtARID_DEF.PosnLgt_b /end REF_MEASUREMENT /end GROUP
/begin GROUP autosar_swc_aeb_autosar_swc_aeb_Step_sys_Subsystem_Reference_AEB_Function_Run_AsyEvlrCritEve_Step_Func_Run_AsyEvlrCritEve_Step_Func_TAWrapper_LongitudinalThreatAssessor_SingleTargetThreatAssessor_PrimaryTargetForIntv_FindPrimaryTargetForIntv_PrimTarSelectorForIntv "autosar_swc_aeb/autosar_swc_aeb_Step_sys/Subsystem Reference/AEB Function/Run_AsyEvlrCritEve_Step_Func/Run_AsyEvlrCritEve_Step_Func/TAWrapper/LongitudinalThreatAssessor/SingleTargetThreatAssessor/PrimaryTargetForIntv/FindPrimaryTargetForIntv/PrimTarSelectorForIntv" /begin REF_CHARACTERISTIC CLTS_ANegLgtRqrdThdInAsyEvlrCritEve_Ca /end REF_CHARACTERISTIC /end GROUP
/begin GROUP autosar_swc_aeb_autosar_swc_aeb_Step_sys_Subsystem_Reference_AEB_Function_Run_AsyEvlrCritEve_Step_Func_Run_AsyEvlrCritEve_Step_Func_TAWrapper_LongitudinalThreatAssessor_SingleTargetThreatAssessor_PrimaryTargetForIntv_PosnLgtForIntv "autosar_swc_aeb/autosar_swc_aeb_Step_sys/Subsystem Reference/AEB Function/Run_AsyEvlrCritEve_Step_Func/Run_AsyEvlrCritEve_Step_Func/TAWrapper/LongitudinalThreatAssessor/SingleTargetThreatAssessor/PrimaryTargetForIntv/PosnLgtForIntv" /begin REF_MEASUREMENT autosar_swc_aeb_rtARID_DEF.PosnLgt_b /end REF_MEASUREMENT /end GROUP
/begin GROUP autosar_swc_aeb_autosar_swc_aeb_Step_sys_Subsystem_Reference_AEB_Function_Run_AsyEvlrCritEve_Step_Func_Run_AsyEvlrCritEve_Step_Func_TAWrapper_LongitudinalThreatAssessor_SingleTargetThreatAssessor_PrimaryTargetForIntv_RequiredLongitudinalAccelerationComputerForIntv "autosar_swc_aeb/autosar_swc_aeb_Step_sys/Subsystem Reference/AEB Function/Run_AsyEvlrCritEve_Step_Func/Run_AsyEvlrCritEve_Step_Func/TAWrapper/LongitudinalThreatAssessor/SingleTargetThreatAssessor/PrimaryTargetForIntv/RequiredLongitudinalAccelerationComputerForIntv"
 /begin SUB_GROUP autosar_swc_aeb_autosar_swc_aeb_Step_sys_Subsystem_Reference_AEB_Function_Run_AsyEvlrCritEve_Step_Func_Run_AsyEvlrCritEve_Step_Func_TAWrapper_LongitudinalThreatAssessor_SingleTargetThreatAssessor_PrimaryTargetForIntv_RequiredLongitudinalAccelerationComputerForIntv_CheckPredictionValidity autosar_swc_aeb_autosar_swc_aeb_Step_sys_Subsystem_Reference_AEB_Function_Run_AsyEvlrCritEve_Step_Func_Run_AsyEvlrCritEve_Step_Func_TAWrapper_LongitudinalThreatAssessor_SingleTargetThreatAssessor_PrimaryTargetForIntv_RequiredLongitudinalAccelerationComputerForIntv_PredictHostPositionAtTime autosar_swc_aeb_autosar_swc_aeb_Step_sys_Subsystem_Reference_AEB_Function_Run_AsyEvlrCritEve_Step_Func_Run_AsyEvlrCritEve_Step_Func_TAWrapper_LongitudinalThreatAssessor_SingleTargetThreatAssessor_PrimaryTargetForIntv_RequiredLongitudinalAccelerationComputerForIntv_PredictObject autosar_swc_aeb_autosar_swc_aeb_Step_sys_Subsystem_Reference_AEB_Function_Run_AsyEvlrCritEve_Step_Func_Run_AsyEvlrCritEve_Step_Func_TAWrapper_LongitudinalThreatAssessor_SingleTargetThreatAssessor_PrimaryTargetForIntv_RequiredLongitudinalAccelerationComputerForIntv_RequiredLongitudinalAccelerationCalculator autosar_swc_aeb_autosar_swc_aeb_Step_sys_Subsystem_Reference_AEB_Function_Run_AsyEvlrCritEve_Step_Func_Run_AsyEvlrCritEve_Step_Func_TAWrapper_LongitudinalThreatAssessor_SingleTargetThreatAssessor_PrimaryTargetForIntv_RequiredLongitudinalAccelerationComputerForIntv_TranslateAndRotateCoordSys /end SUB_GROUP
 /begin REF_MEASUREMENT autosar_swc_aeb_rtARID_DEF.ALgtRqrd_e /end REF_MEASUREMENT
/end GROUP
/begin GROUP autosar_swc_aeb_autosar_swc_aeb_Step_sys_Subsystem_Reference_AEB_Function_Run_AsyEvlrCritEve_Step_Func_Run_AsyEvlrCritEve_Step_Func_TAWrapper_LongitudinalThreatAssessor_SingleTargetThreatAssessor_PrimaryTargetForIntv_RequiredLongitudinalAccelerationComputerForIntv_CheckPredictionValidity "autosar_swc_aeb/autosar_swc_aeb_Step_sys/Subsystem Reference/AEB Function/Run_AsyEvlrCritEve_Step_Func/Run_AsyEvlrCritEve_Step_Func/TAWrapper/LongitudinalThreatAssessor/SingleTargetThreatAssessor/PrimaryTargetForIntv/RequiredLongitudinalAccelerationComputerForIntv/CheckPredictionValidity"
 /begin SUB_GROUP autosar_swc_aeb_autosar_swc_aeb_Step_sys_Subsystem_Reference_AEB_Function_Run_AsyEvlrCritEve_Step_Func_Run_AsyEvlrCritEve_Step_Func_TAWrapper_LongitudinalThreatAssessor_SingleTargetThreatAssessor_PrimaryTargetForIntv_RequiredLongitudinalAccelerationComputerForIntv_CheckPredictionValidity_CheckConfidenceForHeading autosar_swc_aeb_autosar_swc_aeb_Step_sys_Subsystem_Reference_AEB_Function_Run_AsyEvlrCritEve_Step_Func_Run_AsyEvlrCritEve_Step_Func_TAWrapper_LongitudinalThreatAssessor_SingleTargetThreatAssessor_PrimaryTargetForIntv_RequiredLongitudinalAccelerationComputerForIntv_CheckPredictionValidity_CheckPredictionDistanceBelowThreshold autosar_swc_aeb_autosar_swc_aeb_Step_sys_Subsystem_Reference_AEB_Function_Run_AsyEvlrCritEve_Step_Func_Run_AsyEvlrCritEve_Step_Func_TAWrapper_LongitudinalThreatAssessor_SingleTargetThreatAssessor_PrimaryTargetForIntv_RequiredLongitudinalAccelerationComputerForIntv_CheckPredictionValidity_CheckPredictionTimeBelowThreshold autosar_swc_aeb_autosar_swc_aeb_Step_sys_Subsystem_Reference_AEB_Function_Run_AsyEvlrCritEve_Step_Func_Run_AsyEvlrCritEve_Step_Func_TAWrapper_LongitudinalThreatAssessor_SingleTargetThreatAssessor_PrimaryTargetForIntv_RequiredLongitudinalAccelerationComputerForIntv_CheckPredictionValidity_CheckSpeedAboveThreshold /end SUB_GROUP
/end GROUP
/begin GROUP autosar_swc_aeb_autosar_swc_aeb_Step_sys_Subsystem_Reference_AEB_Function_Run_AsyEvlrCritEve_Step_Func_Run_AsyEvlrCritEve_Step_Func_TAWrapper_LongitudinalThreatAssessor_SingleTargetThreatAssessor_PrimaryTargetForIntv_RequiredLongitudinalAccelerationComputerForIntv_CheckPredictionValidity_CheckConfidenceForHeading "autosar_swc_aeb/autosar_swc_aeb_Step_sys/Subsystem Reference/AEB Function/Run_AsyEvlrCritEve_Step_Func/Run_AsyEvlrCritEve_Step_Func/TAWrapper/LongitudinalThreatAssessor/SingleTargetThreatAssessor/PrimaryTargetForIntv/RequiredLongitudinalAccelerationComputerForIntv/CheckPredictionValidity/CheckConfidenceForHeading" /begin REF_CHARACTERISTIC CLTS_ObjSpdThdForAgDirVldInAsyEvlrCritEve_Ca /end REF_CHARACTERISTIC /end GROUP
/begin GROUP autosar_swc_aeb_autosar_swc_aeb_Step_sys_Subsystem_Reference_AEB_Function_Run_AsyEvlrCritEve_Step_Func_Run_AsyEvlrCritEve_Step_Func_TAWrapper_LongitudinalThreatAssessor_SingleTargetThreatAssessor_PrimaryTargetForIntv_RequiredLongitudinalAccelerationComputerForIntv_CheckPredictionValidity_CheckPredictionDistanceBelowThreshold "autosar_swc_aeb/autosar_swc_aeb_Step_sys/Subsystem Reference/AEB Function/Run_AsyEvlrCritEve_Step_Func/Run_AsyEvlrCritEve_Step_Func/TAWrapper/LongitudinalThreatAssessor/SingleTargetThreatAssessor/PrimaryTargetForIntv/RequiredLongitudinalAccelerationComputerForIntv/CheckPredictionValidity/CheckPredictionDistanceBelowThreshold" /begin REF_CHARACTERISTIC CLTS_DstPredMaxInAsyEvlrCritEve_Ca /end REF_CHARACTERISTIC /end GROUP
/begin GROUP autosar_swc_aeb_autosar_swc_aeb_Step_sys_Subsystem_Reference_AEB_Function_Run_AsyEvlrCritEve_Step_Func_Run_AsyEvlrCritEve_Step_Func_TAWrapper_LongitudinalThreatAssessor_SingleTargetThreatAssessor_PrimaryTargetForIntv_RequiredLongitudinalAccelerationComputerForIntv_CheckPredictionValidity_CheckPredictionTimeBelowThreshold "autosar_swc_aeb/autosar_swc_aeb_Step_sys/Subsystem Reference/AEB Function/Run_AsyEvlrCritEve_Step_Func/Run_AsyEvlrCritEve_Step_Func/TAWrapper/LongitudinalThreatAssessor/SingleTargetThreatAssessor/PrimaryTargetForIntv/RequiredLongitudinalAccelerationComputerForIntv/CheckPredictionValidity/CheckPredictionTimeBelowThreshold" /begin REF_CHARACTERISTIC CLTS_SftyArUpprLimForTiInObjPredInAsyEvlrCritEve_Ca /end REF_CHARACTERISTIC /end GROUP
/begin GROUP autosar_swc_aeb_autosar_swc_aeb_Step_sys_Subsystem_Reference_AEB_Function_Run_AsyEvlrCritEve_Step_Func_Run_AsyEvlrCritEve_Step_Func_TAWrapper_LongitudinalThreatAssessor_SingleTargetThreatAssessor_PrimaryTargetForIntv_RequiredLongitudinalAccelerationComputerForIntv_CheckPredictionValidity_CheckSpeedAboveThreshold "autosar_swc_aeb/autosar_swc_aeb_Step_sys/Subsystem Reference/AEB Function/Run_AsyEvlrCritEve_Step_Func/Run_AsyEvlrCritEve_Step_Func/TAWrapper/LongitudinalThreatAssessor/SingleTargetThreatAssessor/PrimaryTargetForIntv/RequiredLongitudinalAccelerationComputerForIntv/CheckPredictionValidity/CheckSpeedAboveThreshold" /begin REF_CHARACTERISTIC CLTS_SpdPredMinInAsyEvlrCritEve_Ca /end REF_CHARACTERISTIC /end GROUP
/begin GROUP autosar_swc_aeb_autosar_swc_aeb_Step_sys_Subsystem_Reference_AEB_Function_Run_AsyEvlrCritEve_Step_Func_Run_AsyEvlrCritEve_Step_Func_TAWrapper_LongitudinalThreatAssessor_SingleTargetThreatAssessor_PrimaryTargetForIntv_RequiredLongitudinalAccelerationComputerForIntv_PredictHostPositionAtTime "autosar_swc_aeb/autosar_swc_aeb_Step_sys/Subsystem Reference/AEB Function/Run_AsyEvlrCritEve_Step_Func/Run_AsyEvlrCritEve_Step_Func/TAWrapper/LongitudinalThreatAssessor/SingleTargetThreatAssessor/PrimaryTargetForIntv/RequiredLongitudinalAccelerationComputerForIntv/PredictHostPositionAtTime"
 /begin SUB_GROUP autosar_swc_aeb_autosar_swc_aeb_Step_sys_Subsystem_Reference_AEB_Function_Run_AsyEvlrCritEve_Step_Func_Run_AsyEvlrCritEve_Step_Func_TAWrapper_LongitudinalThreatAssessor_SingleTargetThreatAssessor_PrimaryTargetForIntv_RequiredLongitudinalAccelerationComputerForIntv_PredictHostPositionAtTime_CalculateHeading autosar_swc_aeb_autosar_swc_aeb_Step_sys_Subsystem_Reference_AEB_Function_Run_AsyEvlrCritEve_Step_Func_Run_AsyEvlrCritEve_Step_Func_TAWrapper_LongitudinalThreatAssessor_SingleTargetThreatAssessor_PrimaryTargetForIntv_RequiredLongitudinalAccelerationComputerForIntv_PredictHostPositionAtTime_SelectSegment /end SUB_GROUP
/end GROUP
/begin GROUP autosar_swc_aeb_autosar_swc_aeb_Step_sys_Subsystem_Reference_AEB_Function_Run_AsyEvlrCritEve_Step_Func_Run_AsyEvlrCritEve_Step_Func_TAWrapper_LongitudinalThreatAssessor_SingleTargetThreatAssessor_PrimaryTargetForIntv_RequiredLongitudinalAccelerationComputerForIntv_PredictHostPositionAtTime_CalculateHeading "autosar_swc_aeb/autosar_swc_aeb_Step_sys/Subsystem Reference/AEB Function/Run_AsyEvlrCritEve_Step_Func/Run_AsyEvlrCritEve_Step_Func/TAWrapper/LongitudinalThreatAssessor/SingleTargetThreatAssessor/PrimaryTargetForIntv/RequiredLongitudinalAccelerationComputerForIntv/PredictHostPositionAtTime/CalculateHeading"
 /begin SUB_GROUP autosar_swc_aeb_autosar_swc_aeb_Step_sys_Subsystem_Reference_AEB_Function_Run_AsyEvlrCritEve_Step_Func_Run_AsyEvlrCritEve_Step_Func_TAWrapper_LongitudinalThreatAssessor_SingleTargetThreatAssessor_PrimaryTargetForIntv_RequiredLongitudinalAccelerationComputerForIntv_PredictHostPositionAtTime_CalculateHeading_CheckSpeed autosar_swc_aeb_autosar_swc_aeb_Step_sys_Subsystem_Reference_AEB_Function_Run_AsyEvlrCritEve_Step_Func_Run_AsyEvlrCritEve_Step_Func_TAWrapper_LongitudinalThreatAssessor_SingleTargetThreatAssessor_PrimaryTargetForIntv_RequiredLongitudinalAccelerationComputerForIntv_PredictHostPositionAtTime_CalculateHeading_ExtractVelocitiesAtStartOfSegments /end SUB_GROUP
/end GROUP
/begin GROUP autosar_swc_aeb_autosar_swc_aeb_Step_sys_Subsystem_Reference_AEB_Function_Run_AsyEvlrCritEve_Step_Func_Run_AsyEvlrCritEve_Step_Func_TAWrapper_LongitudinalThreatAssessor_SingleTargetThreatAssessor_PrimaryTargetForIntv_RequiredLongitudinalAccelerationComputerForIntv_PredictHostPositionAtTime_CalculateHeading_ExtractVelocitiesAtStartOfSegments "autosar_swc_aeb/autosar_swc_aeb_Step_sys/Subsystem Reference/AEB Function/Run_AsyEvlrCritEve_Step_Func/Run_AsyEvlrCritEve_Step_Func/TAWrapper/LongitudinalThreatAssessor/SingleTargetThreatAssessor/PrimaryTargetForIntv/RequiredLongitudinalAccelerationComputerForIntv/PredictHostPositionAtTime/CalculateHeading/ExtractVelocitiesAtStartOfSegments"
 /begin SUB_GROUP autosar_swc_aeb_autosar_swc_aeb_Step_sys_Subsystem_Reference_AEB_Function_Run_AsyEvlrCritEve_Step_Func_Run_AsyEvlrCritEve_Step_Func_TAWrapper_LongitudinalThreatAssessor_SingleTargetThreatAssessor_PrimaryTargetForIntv_RequiredLongitudinalAccelerationComputerForIntv_PredictHostPositionAtTime_CalculateHeading_ExtractVelocitiesAtStartOfSegments_CheckSpeed /end SUB_GROUP
/end GROUP
/begin GROUP autosar_swc_aeb_autosar_swc_aeb_Step_sys_Subsystem_Reference_AEB_Function_Run_AsyEvlrCritEve_Step_Func_Run_AsyEvlrCritEve_Step_Func_TAWrapper_LongitudinalThreatAssessor_SingleTargetThreatAssessor_PrimaryTargetForIntv_RequiredLongitudinalAccelerationComputerForIntv_PredictHostPositionAtTime_SelectSegment "autosar_swc_aeb/autosar_swc_aeb_Step_sys/Subsystem Reference/AEB Function/Run_AsyEvlrCritEve_Step_Func/Run_AsyEvlrCritEve_Step_Func/TAWrapper/LongitudinalThreatAssessor/SingleTargetThreatAssessor/PrimaryTargetForIntv/RequiredLongitudinalAccelerationComputerForIntv/PredictHostPositionAtTime/SelectSegment" /begin REF_MEASUREMENT autosar_swc_aeb_rtARID_DEF.LastSegment_c /end REF_MEASUREMENT /end GROUP
/begin GROUP autosar_swc_aeb_autosar_swc_aeb_Step_sys_Subsystem_Reference_AEB_Function_Run_AsyEvlrCritEve_Step_Func_Run_AsyEvlrCritEve_Step_Func_TAWrapper_LongitudinalThreatAssessor_SingleTargetThreatAssessor_PrimaryTargetForIntv_RequiredLongitudinalAccelerationComputerForIntv_PredictObject "autosar_swc_aeb/autosar_swc_aeb_Step_sys/Subsystem Reference/AEB Function/Run_AsyEvlrCritEve_Step_Func/Run_AsyEvlrCritEve_Step_Func/TAWrapper/LongitudinalThreatAssessor/SingleTargetThreatAssessor/PrimaryTargetForIntv/RequiredLongitudinalAccelerationComputerForIntv/PredictObject"
 /begin SUB_GROUP autosar_swc_aeb_autosar_swc_aeb_Step_sys_Subsystem_Reference_AEB_Function_Run_AsyEvlrCritEve_Step_Func_Run_AsyEvlrCritEve_Step_Func_TAWrapper_LongitudinalThreatAssessor_SingleTargetThreatAssessor_PrimaryTargetForIntv_RequiredLongitudinalAccelerationComputerForIntv_PredictObject_CircularPrediction autosar_swc_aeb_autosar_swc_aeb_Step_sys_Subsystem_Reference_AEB_Function_Run_AsyEvlrCritEve_Step_Func_Run_AsyEvlrCritEve_Step_Func_TAWrapper_LongitudinalThreatAssessor_SingleTargetThreatAssessor_PrimaryTargetForIntv_RequiredLongitudinalAccelerationComputerForIntv_PredictObject_LinearPrediction /end SUB_GROUP
/end GROUP
/begin GROUP autosar_swc_aeb_autosar_swc_aeb_Step_sys_Subsystem_Reference_AEB_Function_Run_AsyEvlrCritEve_Step_Func_Run_AsyEvlrCritEve_Step_Func_TAWrapper_LongitudinalThreatAssessor_SingleTargetThreatAssessor_PrimaryTargetForIntv_RequiredLongitudinalAccelerationComputerForIntv_PredictObject_CircularPrediction "autosar_swc_aeb/autosar_swc_aeb_Step_sys/Subsystem Reference/AEB Function/Run_AsyEvlrCritEve_Step_Func/Run_AsyEvlrCritEve_Step_Func/TAWrapper/LongitudinalThreatAssessor/SingleTargetThreatAssessor/PrimaryTargetForIntv/RequiredLongitudinalAccelerationComputerForIntv/PredictObject/CircularPrediction"
 /begin SUB_GROUP autosar_swc_aeb_autosar_swc_aeb_Step_sys_Subsystem_Reference_AEB_Function_Run_AsyEvlrCritEve_Step_Func_Run_AsyEvlrCritEve_Step_Func_TAWrapper_LongitudinalThreatAssessor_SingleTargetThreatAssessor_PrimaryTargetForIntv_RequiredLongitudinalAccelerationComputerForIntv_PredictObject_CircularPrediction_PredictedCartesianMovement autosar_swc_aeb_autosar_swc_aeb_Step_sys_Subsystem_Reference_AEB_Function_Run_AsyEvlrCritEve_Step_Func_Run_AsyEvlrCritEve_Step_Func_TAWrapper_LongitudinalThreatAssessor_SingleTargetThreatAssessor_PrimaryTargetForIntv_RequiredLongitudinalAccelerationComputerForIntv_PredictObject_CircularPrediction_PredictedPositionAtTimeHeadingAngleAndCurvatureBased /end SUB_GROUP
/end GROUP
/begin GROUP autosar_swc_aeb_autosar_swc_aeb_Step_sys_Subsystem_Reference_AEB_Function_Run_AsyEvlrCritEve_Step_Func_Run_AsyEvlrCritEve_Step_Func_TAWrapper_LongitudinalThreatAssessor_SingleTargetThreatAssessor_PrimaryTargetForIntv_RequiredLongitudinalAccelerationComputerForIntv_PredictObject_CircularPrediction_PredictedCartesianMovement "autosar_swc_aeb/autosar_swc_aeb_Step_sys/Subsystem Reference/AEB Function/Run_AsyEvlrCritEve_Step_Func/Run_AsyEvlrCritEve_Step_Func/TAWrapper/LongitudinalThreatAssessor/SingleTargetThreatAssessor/PrimaryTargetForIntv/RequiredLongitudinalAccelerationComputerForIntv/PredictObject/CircularPrediction/PredictedCartesianMovement"
 /begin SUB_GROUP autosar_swc_aeb_autosar_swc_aeb_Step_sys_Subsystem_Reference_AEB_Function_Run_AsyEvlrCritEve_Step_Func_Run_AsyEvlrCritEve_Step_Func_TAWrapper_LongitudinalThreatAssessor_SingleTargetThreatAssessor_PrimaryTargetForIntv_RequiredLongitudinalAccelerationComputerForIntv_PredictObject_CircularPrediction_PredictedCartesianMovement_ComputeCartesianMovement /end SUB_GROUP
/end GROUP
/begin GROUP autosar_swc_aeb_autosar_swc_aeb_Step_sys_Subsystem_Reference_AEB_Function_Run_AsyEvlrCritEve_Step_Func_Run_AsyEvlrCritEve_Step_Func_TAWrapper_LongitudinalThreatAssessor_SingleTargetThreatAssessor_PrimaryTargetForIntv_RequiredLongitudinalAccelerationComputerForIntv_PredictObject_CircularPrediction_PredictedCartesianMovement_ComputeCartesianMovement "autosar_swc_aeb/autosar_swc_aeb_Step_sys/Subsystem Reference/AEB Function/Run_AsyEvlrCritEve_Step_Func/Run_AsyEvlrCritEve_Step_Func/TAWrapper/LongitudinalThreatAssessor/SingleTargetThreatAssessor/PrimaryTargetForIntv/RequiredLongitudinalAccelerationComputerForIntv/PredictObject/CircularPrediction/PredictedCartesianMovement/ComputeCartesianMovement"
 /begin REF_MEASUREMENT autosar_swc_aeb_rtARID_DEF.PredALatObj_d autosar_swc_aeb_rtARID_DEF.PredALgtObj_g autosar_swc_aeb_rtARID_DEF.PredVLatObj_c autosar_swc_aeb_rtARID_DEF.PredVLgtObj_c /end REF_MEASUREMENT
/end GROUP
/begin GROUP autosar_swc_aeb_autosar_swc_aeb_Step_sys_Subsystem_Reference_AEB_Function_Run_AsyEvlrCritEve_Step_Func_Run_AsyEvlrCritEve_Step_Func_TAWrapper_LongitudinalThreatAssessor_SingleTargetThreatAssessor_PrimaryTargetForIntv_RequiredLongitudinalAccelerationComputerForIntv_PredictObject_CircularPrediction_PredictedPositionAtTimeHeadingAngleAndCurvatureBased "autosar_swc_aeb/autosar_swc_aeb_Step_sys/Subsystem Reference/AEB Function/Run_AsyEvlrCritEve_Step_Func/Run_AsyEvlrCritEve_Step_Func/TAWrapper/LongitudinalThreatAssessor/SingleTargetThreatAssessor/PrimaryTargetForIntv/RequiredLongitudinalAccelerationComputerForIntv/PredictObject/CircularPrediction/PredictedPositionAtTimeHeadingAngleAndCurvatureBased"
 /begin REF_MEASUREMENT autosar_swc_aeb_rtARID_DEF.PredPosnLat_f autosar_swc_aeb_rtARID_DEF.PredPosnLgt_a /end REF_MEASUREMENT
/end GROUP
/begin GROUP autosar_swc_aeb_autosar_swc_aeb_Step_sys_Subsystem_Reference_AEB_Function_Run_AsyEvlrCritEve_Step_Func_Run_AsyEvlrCritEve_Step_Func_TAWrapper_LongitudinalThreatAssessor_SingleTargetThreatAssessor_PrimaryTargetForIntv_RequiredLongitudinalAccelerationComputerForIntv_PredictObject_LinearPrediction "autosar_swc_aeb/autosar_swc_aeb_Step_sys/Subsystem Reference/AEB Function/Run_AsyEvlrCritEve_Step_Func/Run_AsyEvlrCritEve_Step_Func/TAWrapper/LongitudinalThreatAssessor/SingleTargetThreatAssessor/PrimaryTargetForIntv/RequiredLongitudinalAccelerationComputerForIntv/PredictObject/LinearPrediction"
 /begin SUB_GROUP autosar_swc_aeb_autosar_swc_aeb_Step_sys_Subsystem_Reference_AEB_Function_Run_AsyEvlrCritEve_Step_Func_Run_AsyEvlrCritEve_Step_Func_TAWrapper_LongitudinalThreatAssessor_SingleTargetThreatAssessor_PrimaryTargetForIntv_RequiredLongitudinalAccelerationComputerForIntv_PredictObject_LinearPrediction_LinearMovementPredictorWithStopObjLongitudinal autosar_swc_aeb_autosar_swc_aeb_Step_sys_Subsystem_Reference_AEB_Function_Run_AsyEvlrCritEve_Step_Func_Run_AsyEvlrCritEve_Step_Func_TAWrapper_LongitudinalThreatAssessor_SingleTargetThreatAssessor_PrimaryTargetForIntv_RequiredLongitudinalAccelerationComputerForIntv_PredictObject_LinearPrediction_LinearPredictorLateralMovement autosar_swc_aeb_autosar_swc_aeb_Step_sys_Subsystem_Reference_AEB_Function_Run_AsyEvlrCritEve_Step_Func_Run_AsyEvlrCritEve_Step_Func_TAWrapper_LongitudinalThreatAssessor_SingleTargetThreatAssessor_PrimaryTargetForIntv_RequiredLongitudinalAccelerationComputerForIntv_PredictObject_LinearPrediction_NoOperation autosar_swc_aeb_autosar_swc_aeb_Step_sys_Subsystem_Reference_AEB_Function_Run_AsyEvlrCritEve_Step_Func_Run_AsyEvlrCritEve_Step_Func_TAWrapper_LongitudinalThreatAssessor_SingleTargetThreatAssessor_PrimaryTargetForIntv_RequiredLongitudinalAccelerationComputerForIntv_PredictObject_LinearPrediction_NoOperation1 autosar_swc_aeb_autosar_swc_aeb_Step_sys_Subsystem_Reference_AEB_Function_Run_AsyEvlrCritEve_Step_Func_Run_AsyEvlrCritEve_Step_Func_TAWrapper_LongitudinalThreatAssessor_SingleTargetThreatAssessor_PrimaryTargetForIntv_RequiredLongitudinalAccelerationComputerForIntv_PredictObject_LinearPrediction_NoOperation2 /end SUB_GROUP
/end GROUP
/begin GROUP autosar_swc_aeb_autosar_swc_aeb_Step_sys_Subsystem_Reference_AEB_Function_Run_AsyEvlrCritEve_Step_Func_Run_AsyEvlrCritEve_Step_Func_TAWrapper_LongitudinalThreatAssessor_SingleTargetThreatAssessor_PrimaryTargetForIntv_RequiredLongitudinalAccelerationComputerForIntv_PredictObject_LinearPrediction_LinearMovementPredictorWithStopObjLongitudinal "autosar_swc_aeb/autosar_swc_aeb_Step_sys/Subsystem Reference/AEB Function/Run_AsyEvlrCritEve_Step_Func/Run_AsyEvlrCritEve_Step_Func/TAWrapper/LongitudinalThreatAssessor/SingleTargetThreatAssessor/PrimaryTargetForIntv/RequiredLongitudinalAccelerationComputerForIntv/PredictObject/LinearPrediction/LinearMovementPredictorWithStopObjLongitudinal"
 /begin SUB_GROUP autosar_swc_aeb_autosar_swc_aeb_Step_sys_Subsystem_Reference_AEB_Function_Run_AsyEvlrCritEve_Step_Func_Run_AsyEvlrCritEve_Step_Func_TAWrapper_LongitudinalThreatAssessor_SingleTargetThreatAssessor_PrimaryTargetForIntv_RequiredLongitudinalAccelerationComputerForIntv_PredictObject_LinearPrediction_LinearMovementPredictorWithStopObjLongitudinal_LinearMovementPredictor /end SUB_GROUP
 /begin REF_MEASUREMENT autosar_swc_aeb_rtARID_DEF.PredALgtObj_g /end REF_MEASUREMENT
/end GROUP
/begin GROUP autosar_swc_aeb_autosar_swc_aeb_Step_sys_Subsystem_Reference_AEB_Function_Run_AsyEvlrCritEve_Step_Func_Run_AsyEvlrCritEve_Step_Func_TAWrapper_LongitudinalThreatAssessor_SingleTargetThreatAssessor_PrimaryTargetForIntv_RequiredLongitudinalAccelerationComputerForIntv_PredictObject_LinearPrediction_LinearMovementPredictorWithStopObjLongitudinal_LinearMovementPredictor "autosar_swc_aeb/autosar_swc_aeb_Step_sys/Subsystem Reference/AEB Function/Run_AsyEvlrCritEve_Step_Func/Run_AsyEvlrCritEve_Step_Func/TAWrapper/LongitudinalThreatAssessor/SingleTargetThreatAssessor/PrimaryTargetForIntv/RequiredLongitudinalAccelerationComputerForIntv/PredictObject/LinearPrediction/LinearMovementPredictorWithStopObjLongitudinal/LinearMovementPredictor" /begin REF_MEASUREMENT autosar_swc_aeb_rtARID_DEF.PredPosnLgt_a /end REF_MEASUREMENT /end GROUP
/begin GROUP autosar_swc_aeb_autosar_swc_aeb_Step_sys_Subsystem_Reference_AEB_Function_Run_AsyEvlrCritEve_Step_Func_Run_AsyEvlrCritEve_Step_Func_TAWrapper_LongitudinalThreatAssessor_SingleTargetThreatAssessor_PrimaryTargetForIntv_RequiredLongitudinalAccelerationComputerForIntv_PredictObject_LinearPrediction_LinearPredictorLateralMovement "autosar_swc_aeb/autosar_swc_aeb_Step_sys/Subsystem Reference/AEB Function/Run_AsyEvlrCritEve_Step_Func/Run_AsyEvlrCritEve_Step_Func/TAWrapper/LongitudinalThreatAssessor/SingleTargetThreatAssessor/PrimaryTargetForIntv/RequiredLongitudinalAccelerationComputerForIntv/PredictObject/LinearPrediction/LinearPredictorLateralMovement" /begin REF_MEASUREMENT autosar_swc_aeb_rtARID_DEF.PredPosnLat_f /end REF_MEASUREMENT /end GROUP
/begin GROUP autosar_swc_aeb_autosar_swc_aeb_Step_sys_Subsystem_Reference_AEB_Function_Run_AsyEvlrCritEve_Step_Func_Run_AsyEvlrCritEve_Step_Func_TAWrapper_LongitudinalThreatAssessor_SingleTargetThreatAssessor_PrimaryTargetForIntv_RequiredLongitudinalAccelerationComputerForIntv_PredictObject_LinearPrediction_NoOperation "autosar_swc_aeb/autosar_swc_aeb_Step_sys/Subsystem Reference/AEB Function/Run_AsyEvlrCritEve_Step_Func/Run_AsyEvlrCritEve_Step_Func/TAWrapper/LongitudinalThreatAssessor/SingleTargetThreatAssessor/PrimaryTargetForIntv/RequiredLongitudinalAccelerationComputerForIntv/PredictObject/LinearPrediction/NoOperation" /begin REF_MEASUREMENT autosar_swc_aeb_rtARID_DEF.PredVLgtObj_c /end REF_MEASUREMENT /end GROUP
/begin GROUP autosar_swc_aeb_autosar_swc_aeb_Step_sys_Subsystem_Reference_AEB_Function_Run_AsyEvlrCritEve_Step_Func_Run_AsyEvlrCritEve_Step_Func_TAWrapper_LongitudinalThreatAssessor_SingleTargetThreatAssessor_PrimaryTargetForIntv_RequiredLongitudinalAccelerationComputerForIntv_PredictObject_LinearPrediction_NoOperation1 "autosar_swc_aeb/autosar_swc_aeb_Step_sys/Subsystem Reference/AEB Function/Run_AsyEvlrCritEve_Step_Func/Run_AsyEvlrCritEve_Step_Func/TAWrapper/LongitudinalThreatAssessor/SingleTargetThreatAssessor/PrimaryTargetForIntv/RequiredLongitudinalAccelerationComputerForIntv/PredictObject/LinearPrediction/NoOperation1" /begin REF_MEASUREMENT autosar_swc_aeb_rtARID_DEF.PredVLatObj_c /end REF_MEASUREMENT /end GROUP
/begin GROUP autosar_swc_aeb_autosar_swc_aeb_Step_sys_Subsystem_Reference_AEB_Function_Run_AsyEvlrCritEve_Step_Func_Run_AsyEvlrCritEve_Step_Func_TAWrapper_LongitudinalThreatAssessor_SingleTargetThreatAssessor_PrimaryTargetForIntv_RequiredLongitudinalAccelerationComputerForIntv_PredictObject_LinearPrediction_NoOperation2 "autosar_swc_aeb/autosar_swc_aeb_Step_sys/Subsystem Reference/AEB Function/Run_AsyEvlrCritEve_Step_Func/Run_AsyEvlrCritEve_Step_Func/TAWrapper/LongitudinalThreatAssessor/SingleTargetThreatAssessor/PrimaryTargetForIntv/RequiredLongitudinalAccelerationComputerForIntv/PredictObject/LinearPrediction/NoOperation2" /begin REF_MEASUREMENT autosar_swc_aeb_rtARID_DEF.PredALatObj_d /end REF_MEASUREMENT /end GROUP
/begin GROUP autosar_swc_aeb_autosar_swc_aeb_Step_sys_Subsystem_Reference_AEB_Function_Run_AsyEvlrCritEve_Step_Func_Run_AsyEvlrCritEve_Step_Func_TAWrapper_LongitudinalThreatAssessor_SingleTargetThreatAssessor_PrimaryTargetForIntv_RequiredLongitudinalAccelerationComputerForIntv_RequiredLongitudinalAccelerationCalculator "autosar_swc_aeb/autosar_swc_aeb_Step_sys/Subsystem Reference/AEB Function/Run_AsyEvlrCritEve_Step_Func/Run_AsyEvlrCritEve_Step_Func/TAWrapper/LongitudinalThreatAssessor/SingleTargetThreatAssessor/PrimaryTargetForIntv/RequiredLongitudinalAccelerationComputerForIntv/RequiredLongitudinalAccelerationCalculator"
 /begin SUB_GROUP autosar_swc_aeb_autosar_swc_aeb_Step_sys_Subsystem_Reference_AEB_Function_Run_AsyEvlrCritEve_Step_Func_Run_AsyEvlrCritEve_Step_Func_TAWrapper_LongitudinalThreatAssessor_SingleTargetThreatAssessor_PrimaryTargetForIntv_RequiredLongitudinalAccelerationComputerForIntv_RequiredLongitudinalAccelerationCalculator_CalculateLateralTTRandTTP autosar_swc_aeb_autosar_swc_aeb_Step_sys_Subsystem_Reference_AEB_Function_Run_AsyEvlrCritEve_Step_Func_Run_AsyEvlrCritEve_Step_Func_TAWrapper_LongitudinalThreatAssessor_SingleTargetThreatAssessor_PrimaryTargetForIntv_RequiredLongitudinalAccelerationComputerForIntv_RequiredLongitudinalAccelerationCalculator_CalculateRequiredAcceleration /end SUB_GROUP
/end GROUP
/begin GROUP autosar_swc_aeb_autosar_swc_aeb_Step_sys_Subsystem_Reference_AEB_Function_Run_AsyEvlrCritEve_Step_Func_Run_AsyEvlrCritEve_Step_Func_TAWrapper_LongitudinalThreatAssessor_SingleTargetThreatAssessor_PrimaryTargetForIntv_RequiredLongitudinalAccelerationComputerForIntv_RequiredLongitudinalAccelerationCalculator_CalculateLateralTTRandTTP "autosar_swc_aeb/autosar_swc_aeb_Step_sys/Subsystem Reference/AEB Function/Run_AsyEvlrCritEve_Step_Func/Run_AsyEvlrCritEve_Step_Func/TAWrapper/LongitudinalThreatAssessor/SingleTargetThreatAssessor/PrimaryTargetForIntv/RequiredLongitudinalAccelerationComputerForIntv/RequiredLongitudinalAccelerationCalculator/CalculateLateralTTRandTTP"
 /begin SUB_GROUP autosar_swc_aeb_autosar_swc_aeb_Step_sys_Subsystem_Reference_AEB_Function_Run_AsyEvlrCritEve_Step_Func_Run_AsyEvlrCritEve_Step_Func_TAWrapper_LongitudinalThreatAssessor_SingleTargetThreatAssessor_PrimaryTargetForIntv_RequiredLongitudinalAccelerationComputerForIntv_RequiredLongitudinalAccelerationCalculator_CalculateLateralTTRandTTP_LateralTTPComputer autosar_swc_aeb_autosar_swc_aeb_Step_sys_Subsystem_Reference_AEB_Function_Run_AsyEvlrCritEve_Step_Func_Run_AsyEvlrCritEve_Step_Func_TAWrapper_LongitudinalThreatAssessor_SingleTargetThreatAssessor_PrimaryTargetForIntv_RequiredLongitudinalAccelerationComputerForIntv_RequiredLongitudinalAccelerationCalculator_CalculateLateralTTRandTTP_LateralTTRComputer autosar_swc_aeb_autosar_swc_aeb_Step_sys_Subsystem_Reference_AEB_Function_Run_AsyEvlrCritEve_Step_Func_Run_AsyEvlrCritEve_Step_Func_TAWrapper_LongitudinalThreatAssessor_SingleTargetThreatAssessor_PrimaryTargetForIntv_RequiredLongitudinalAccelerationComputerForIntv_RequiredLongitudinalAccelerationCalculator_CalculateLateralTTRandTTP_ModifyTTPAtSameSpeedAndAcceleration autosar_swc_aeb_autosar_swc_aeb_Step_sys_Subsystem_Reference_AEB_Function_Run_AsyEvlrCritEve_Step_Func_Run_AsyEvlrCritEve_Step_Func_TAWrapper_LongitudinalThreatAssessor_SingleTargetThreatAssessor_PrimaryTargetForIntv_RequiredLongitudinalAccelerationComputerForIntv_RequiredLongitudinalAccelerationCalculator_CalculateLateralTTRandTTP_ModifyTTRAtSameSpeedAndAcceleration /end SUB_GROUP
/end GROUP
/begin GROUP autosar_swc_aeb_autosar_swc_aeb_Step_sys_Subsystem_Reference_AEB_Function_Run_AsyEvlrCritEve_Step_Func_Run_AsyEvlrCritEve_Step_Func_TAWrapper_LongitudinalThreatAssessor_SingleTargetThreatAssessor_PrimaryTargetForIntv_RequiredLongitudinalAccelerationComputerForIntv_RequiredLongitudinalAccelerationCalculator_CalculateLateralTTRandTTP_LateralTTPComputer "autosar_swc_aeb/autosar_swc_aeb_Step_sys/Subsystem Reference/AEB Function/Run_AsyEvlrCritEve_Step_Func/Run_AsyEvlrCritEve_Step_Func/TAWrapper/LongitudinalThreatAssessor/SingleTargetThreatAssessor/PrimaryTargetForIntv/RequiredLongitudinalAccelerationComputerForIntv/RequiredLongitudinalAccelerationCalculator/CalculateLateralTTRandTTP/LateralTTPComputer"
 /begin SUB_GROUP autosar_swc_aeb_autosar_swc_aeb_Step_sys_Subsystem_Reference_AEB_Function_Run_AsyEvlrCritEve_Step_Func_Run_AsyEvlrCritEve_Step_Func_TAWrapper_LongitudinalThreatAssessor_SingleTargetThreatAssessor_PrimaryTargetForIntv_RequiredLongitudinalAccelerationComputerForIntv_RequiredLongitudinalAccelerationCalculator_CalculateLateralTTRandTTP_LateralTTPComputer_LeftClosest autosar_swc_aeb_autosar_swc_aeb_Step_sys_Subsystem_Reference_AEB_Function_Run_AsyEvlrCritEve_Step_Func_Run_AsyEvlrCritEve_Step_Func_TAWrapper_LongitudinalThreatAssessor_SingleTargetThreatAssessor_PrimaryTargetForIntv_RequiredLongitudinalAccelerationComputerForIntv_RequiredLongitudinalAccelerationCalculator_CalculateLateralTTRandTTP_LateralTTPComputer_RightClosest /end SUB_GROUP
/end GROUP
/begin GROUP autosar_swc_aeb_autosar_swc_aeb_Step_sys_Subsystem_Reference_AEB_Function_Run_AsyEvlrCritEve_Step_Func_Run_AsyEvlrCritEve_Step_Func_TAWrapper_LongitudinalThreatAssessor_SingleTargetThreatAssessor_PrimaryTargetForIntv_RequiredLongitudinalAccelerationComputerForIntv_RequiredLongitudinalAccelerationCalculator_CalculateLateralTTRandTTP_LateralTTPComputer_LeftClosest "autosar_swc_aeb/autosar_swc_aeb_Step_sys/Subsystem Reference/AEB Function/Run_AsyEvlrCritEve_Step_Func/Run_AsyEvlrCritEve_Step_Func/TAWrapper/LongitudinalThreatAssessor/SingleTargetThreatAssessor/PrimaryTargetForIntv/RequiredLongitudinalAccelerationComputerForIntv/RequiredLongitudinalAccelerationCalculator/CalculateLateralTTRandTTP/LateralTTPComputer/LeftClosest"
 /begin SUB_GROUP autosar_swc_aeb_autosar_swc_aeb_Step_sys_Subsystem_Reference_AEB_Function_Run_AsyEvlrCritEve_Step_Func_Run_AsyEvlrCritEve_Step_Func_TAWrapper_LongitudinalThreatAssessor_SingleTargetThreatAssessor_PrimaryTargetForIntv_RequiredLongitudinalAccelerationComputerForIntv_RequiredLongitudinalAccelerationCalculator_CalculateLateralTTRandTTP_LateralTTPComputer_LeftClosest_TimeToIntersectionComputer /end SUB_GROUP
 /begin REF_CHARACTERISTIC CLTS_TiUpprLimInAsyEvlrCritEve_Ca /end REF_CHARACTERISTIC
/end GROUP
/begin GROUP autosar_swc_aeb_autosar_swc_aeb_Step_sys_Subsystem_Reference_AEB_Function_Run_AsyEvlrCritEve_Step_Func_Run_AsyEvlrCritEve_Step_Func_TAWrapper_LongitudinalThreatAssessor_SingleTargetThreatAssessor_PrimaryTargetForIntv_RequiredLongitudinalAccelerationComputerForIntv_RequiredLongitudinalAccelerationCalculator_CalculateLateralTTRandTTP_LateralTTPComputer_LeftClosest_TimeToIntersectionComputer "autosar_swc_aeb/autosar_swc_aeb_Step_sys/Subsystem Reference/AEB Function/Run_AsyEvlrCritEve_Step_Func/Run_AsyEvlrCritEve_Step_Func/TAWrapper/LongitudinalThreatAssessor/SingleTargetThreatAssessor/PrimaryTargetForIntv/RequiredLongitudinalAccelerationComputerForIntv/RequiredLongitudinalAccelerationCalculator/CalculateLateralTTRandTTP/LateralTTPComputer/LeftClosest/TimeToIntersectionComputer"
 /begin REF_CHARACTERISTIC CLTS_TiLowrLimInAsyEvlrCritEve_Ca CLTS_TiUpprLimInAsyEvlrCritEve_Ca /end REF_CHARACTERISTIC
/end GROUP
/begin GROUP autosar_swc_aeb_autosar_swc_aeb_Step_sys_Subsystem_Reference_AEB_Function_Run_AsyEvlrCritEve_Step_Func_Run_AsyEvlrCritEve_Step_Func_TAWrapper_LongitudinalThreatAssessor_SingleTargetThreatAssessor_PrimaryTargetForIntv_RequiredLongitudinalAccelerationComputerForIntv_RequiredLongitudinalAccelerationCalculator_CalculateLateralTTRandTTP_LateralTTPComputer_RightClosest "autosar_swc_aeb/autosar_swc_aeb_Step_sys/Subsystem Reference/AEB Function/Run_AsyEvlrCritEve_Step_Func/Run_AsyEvlrCritEve_Step_Func/TAWrapper/LongitudinalThreatAssessor/SingleTargetThreatAssessor/PrimaryTargetForIntv/RequiredLongitudinalAccelerationComputerForIntv/RequiredLongitudinalAccelerationCalculator/CalculateLateralTTRandTTP/LateralTTPComputer/RightClosest"
 /begin SUB_GROUP autosar_swc_aeb_autosar_swc_aeb_Step_sys_Subsystem_Reference_AEB_Function_Run_AsyEvlrCritEve_Step_Func_Run_AsyEvlrCritEve_Step_Func_TAWrapper_LongitudinalThreatAssessor_SingleTargetThreatAssessor_PrimaryTargetForIntv_RequiredLongitudinalAccelerationComputerForIntv_RequiredLongitudinalAccelerationCalculator_CalculateLateralTTRandTTP_LateralTTPComputer_RightClosest_TimeToIntersectionComputer /end SUB_GROUP
 /begin REF_CHARACTERISTIC CLTS_TiUpprLimInAsyEvlrCritEve_Ca /end REF_CHARACTERISTIC
/end GROUP
/begin GROUP autosar_swc_aeb_autosar_swc_aeb_Step_sys_Subsystem_Reference_AEB_Function_Run_AsyEvlrCritEve_Step_Func_Run_AsyEvlrCritEve_Step_Func_TAWrapper_LongitudinalThreatAssessor_SingleTargetThreatAssessor_PrimaryTargetForIntv_RequiredLongitudinalAccelerationComputerForIntv_RequiredLongitudinalAccelerationCalculator_CalculateLateralTTRandTTP_LateralTTPComputer_RightClosest_TimeToIntersectionComputer "autosar_swc_aeb/autosar_swc_aeb_Step_sys/Subsystem Reference/AEB Function/Run_AsyEvlrCritEve_Step_Func/Run_AsyEvlrCritEve_Step_Func/TAWrapper/LongitudinalThreatAssessor/SingleTargetThreatAssessor/PrimaryTargetForIntv/RequiredLongitudinalAccelerationComputerForIntv/RequiredLongitudinalAccelerationCalculator/CalculateLateralTTRandTTP/LateralTTPComputer/RightClosest/TimeToIntersectionComputer"
 /begin REF_CHARACTERISTIC CLTS_TiLowrLimInAsyEvlrCritEve_Ca CLTS_TiUpprLimInAsyEvlrCritEve_Ca /end REF_CHARACTERISTIC
/end GROUP
/begin GROUP autosar_swc_aeb_autosar_swc_aeb_Step_sys_Subsystem_Reference_AEB_Function_Run_AsyEvlrCritEve_Step_Func_Run_AsyEvlrCritEve_Step_Func_TAWrapper_LongitudinalThreatAssessor_SingleTargetThreatAssessor_PrimaryTargetForIntv_RequiredLongitudinalAccelerationComputerForIntv_RequiredLongitudinalAccelerationCalculator_CalculateLateralTTRandTTP_LateralTTRComputer "autosar_swc_aeb/autosar_swc_aeb_Step_sys/Subsystem Reference/AEB Function/Run_AsyEvlrCritEve_Step_Func/Run_AsyEvlrCritEve_Step_Func/TAWrapper/LongitudinalThreatAssessor/SingleTargetThreatAssessor/PrimaryTargetForIntv/RequiredLongitudinalAccelerationComputerForIntv/RequiredLongitudinalAccelerationCalculator/CalculateLateralTTRandTTP/LateralTTRComputer"
 /begin SUB_GROUP autosar_swc_aeb_autosar_swc_aeb_Step_sys_Subsystem_Reference_AEB_Function_Run_AsyEvlrCritEve_Step_Func_Run_AsyEvlrCritEve_Step_Func_TAWrapper_LongitudinalThreatAssessor_SingleTargetThreatAssessor_PrimaryTargetForIntv_RequiredLongitudinalAccelerationComputerForIntv_RequiredLongitudinalAccelerationCalculator_CalculateLateralTTRandTTP_LateralTTRComputer_LeftClosest autosar_swc_aeb_autosar_swc_aeb_Step_sys_Subsystem_Reference_AEB_Function_Run_AsyEvlrCritEve_Step_Func_Run_AsyEvlrCritEve_Step_Func_TAWrapper_LongitudinalThreatAssessor_SingleTargetThreatAssessor_PrimaryTargetForIntv_RequiredLongitudinalAccelerationComputerForIntv_RequiredLongitudinalAccelerationCalculator_CalculateLateralTTRandTTP_LateralTTRComputer_RightClosest /end SUB_GROUP
/end GROUP
/begin GROUP autosar_swc_aeb_autosar_swc_aeb_Step_sys_Subsystem_Reference_AEB_Function_Run_AsyEvlrCritEve_Step_Func_Run_AsyEvlrCritEve_Step_Func_TAWrapper_LongitudinalThreatAssessor_SingleTargetThreatAssessor_PrimaryTargetForIntv_RequiredLongitudinalAccelerationComputerForIntv_RequiredLongitudinalAccelerationCalculator_CalculateLateralTTRandTTP_LateralTTRComputer_LeftClosest "autosar_swc_aeb/autosar_swc_aeb_Step_sys/Subsystem Reference/AEB Function/Run_AsyEvlrCritEve_Step_Func/Run_AsyEvlrCritEve_Step_Func/TAWrapper/LongitudinalThreatAssessor/SingleTargetThreatAssessor/PrimaryTargetForIntv/RequiredLongitudinalAccelerationComputerForIntv/RequiredLongitudinalAccelerationCalculator/CalculateLateralTTRandTTP/LateralTTRComputer/LeftClosest"
 /begin SUB_GROUP autosar_swc_aeb_autosar_swc_aeb_Step_sys_Subsystem_Reference_AEB_Function_Run_AsyEvlrCritEve_Step_Func_Run_AsyEvlrCritEve_Step_Func_TAWrapper_LongitudinalThreatAssessor_SingleTargetThreatAssessor_PrimaryTargetForIntv_RequiredLongitudinalAccelerationComputerForIntv_RequiredLongitudinalAccelerationCalculator_CalculateLateralTTRandTTP_LateralTTRComputer_LeftClosest_TimeToIntersectionComputer /end SUB_GROUP
 /begin REF_CHARACTERISTIC CLTS_TiUpprLimInAsyEvlrCritEve_Ca /end REF_CHARACTERISTIC
/end GROUP
/begin GROUP autosar_swc_aeb_autosar_swc_aeb_Step_sys_Subsystem_Reference_AEB_Function_Run_AsyEvlrCritEve_Step_Func_Run_AsyEvlrCritEve_Step_Func_TAWrapper_LongitudinalThreatAssessor_SingleTargetThreatAssessor_PrimaryTargetForIntv_RequiredLongitudinalAccelerationComputerForIntv_RequiredLongitudinalAccelerationCalculator_CalculateLateralTTRandTTP_LateralTTRComputer_LeftClosest_TimeToIntersectionComputer "autosar_swc_aeb/autosar_swc_aeb_Step_sys/Subsystem Reference/AEB Function/Run_AsyEvlrCritEve_Step_Func/Run_AsyEvlrCritEve_Step_Func/TAWrapper/LongitudinalThreatAssessor/SingleTargetThreatAssessor/PrimaryTargetForIntv/RequiredLongitudinalAccelerationComputerForIntv/RequiredLongitudinalAccelerationCalculator/CalculateLateralTTRandTTP/LateralTTRComputer/LeftClosest/TimeToIntersectionComputer"
 /begin REF_CHARACTERISTIC CLTS_TiLowrLimInAsyEvlrCritEve_Ca CLTS_TiUpprLimInAsyEvlrCritEve_Ca /end REF_CHARACTERISTIC
/end GROUP
/begin GROUP autosar_swc_aeb_autosar_swc_aeb_Step_sys_Subsystem_Reference_AEB_Function_Run_AsyEvlrCritEve_Step_Func_Run_AsyEvlrCritEve_Step_Func_TAWrapper_LongitudinalThreatAssessor_SingleTargetThreatAssessor_PrimaryTargetForIntv_RequiredLongitudinalAccelerationComputerForIntv_RequiredLongitudinalAccelerationCalculator_CalculateLateralTTRandTTP_LateralTTRComputer_RightClosest "autosar_swc_aeb/autosar_swc_aeb_Step_sys/Subsystem Reference/AEB Function/Run_AsyEvlrCritEve_Step_Func/Run_AsyEvlrCritEve_Step_Func/TAWrapper/LongitudinalThreatAssessor/SingleTargetThreatAssessor/PrimaryTargetForIntv/RequiredLongitudinalAccelerationComputerForIntv/RequiredLongitudinalAccelerationCalculator/CalculateLateralTTRandTTP/LateralTTRComputer/RightClosest"
 /begin SUB_GROUP autosar_swc_aeb_autosar_swc_aeb_Step_sys_Subsystem_Reference_AEB_Function_Run_AsyEvlrCritEve_Step_Func_Run_AsyEvlrCritEve_Step_Func_TAWrapper_LongitudinalThreatAssessor_SingleTargetThreatAssessor_PrimaryTargetForIntv_RequiredLongitudinalAccelerationComputerForIntv_RequiredLongitudinalAccelerationCalculator_CalculateLateralTTRandTTP_LateralTTRComputer_RightClosest_TimeToIntersectionComputer /end SUB_GROUP
 /begin REF_CHARACTERISTIC CLTS_TiUpprLimInAsyEvlrCritEve_Ca /end REF_CHARACTERISTIC
/end GROUP
/begin GROUP autosar_swc_aeb_autosar_swc_aeb_Step_sys_Subsystem_Reference_AEB_Function_Run_AsyEvlrCritEve_Step_Func_Run_AsyEvlrCritEve_Step_Func_TAWrapper_LongitudinalThreatAssessor_SingleTargetThreatAssessor_PrimaryTargetForIntv_RequiredLongitudinalAccelerationComputerForIntv_RequiredLongitudinalAccelerationCalculator_CalculateLateralTTRandTTP_LateralTTRComputer_RightClosest_TimeToIntersectionComputer "autosar_swc_aeb/autosar_swc_aeb_Step_sys/Subsystem Reference/AEB Function/Run_AsyEvlrCritEve_Step_Func/Run_AsyEvlrCritEve_Step_Func/TAWrapper/LongitudinalThreatAssessor/SingleTargetThreatAssessor/PrimaryTargetForIntv/RequiredLongitudinalAccelerationComputerForIntv/RequiredLongitudinalAccelerationCalculator/CalculateLateralTTRandTTP/LateralTTRComputer/RightClosest/TimeToIntersectionComputer"
 /begin REF_CHARACTERISTIC CLTS_TiLowrLimInAsyEvlrCritEve_Ca CLTS_TiUpprLimInAsyEvlrCritEve_Ca /end REF_CHARACTERISTIC
/end GROUP
/begin GROUP autosar_swc_aeb_autosar_swc_aeb_Step_sys_Subsystem_Reference_AEB_Function_Run_AsyEvlrCritEve_Step_Func_Run_AsyEvlrCritEve_Step_Func_TAWrapper_LongitudinalThreatAssessor_SingleTargetThreatAssessor_PrimaryTargetForIntv_RequiredLongitudinalAccelerationComputerForIntv_RequiredLongitudinalAccelerationCalculator_CalculateLateralTTRandTTP_ModifyTTPAtSameSpeedAndAcceleration "autosar_swc_aeb/autosar_swc_aeb_Step_sys/Subsystem Reference/AEB Function/Run_AsyEvlrCritEve_Step_Func/Run_AsyEvlrCritEve_Step_Func/TAWrapper/LongitudinalThreatAssessor/SingleTargetThreatAssessor/PrimaryTargetForIntv/RequiredLongitudinalAccelerationComputerForIntv/RequiredLongitudinalAccelerationCalculator/CalculateLateralTTRandTTP/ModifyTTPAtSameSpeedAndAcceleration" /begin REF_CHARACTERISTIC CLTS_TiUpprLimInAsyEvlrCritEve_Ca /end REF_CHARACTERISTIC /end GROUP
/begin GROUP autosar_swc_aeb_autosar_swc_aeb_Step_sys_Subsystem_Reference_AEB_Function_Run_AsyEvlrCritEve_Step_Func_Run_AsyEvlrCritEve_Step_Func_TAWrapper_LongitudinalThreatAssessor_SingleTargetThreatAssessor_PrimaryTargetForIntv_RequiredLongitudinalAccelerationComputerForIntv_RequiredLongitudinalAccelerationCalculator_CalculateLateralTTRandTTP_ModifyTTRAtSameSpeedAndAcceleration "autosar_swc_aeb/autosar_swc_aeb_Step_sys/Subsystem Reference/AEB Function/Run_AsyEvlrCritEve_Step_Func/Run_AsyEvlrCritEve_Step_Func/TAWrapper/LongitudinalThreatAssessor/SingleTargetThreatAssessor/PrimaryTargetForIntv/RequiredLongitudinalAccelerationComputerForIntv/RequiredLongitudinalAccelerationCalculator/CalculateLateralTTRandTTP/ModifyTTRAtSameSpeedAndAcceleration"
 /begin REF_CHARACTERISTIC CLTS_TiLowrLimInAsyEvlrCritEve_Ca CLTS_TiUpprLimInAsyEvlrCritEve_Ca /end REF_CHARACTERISTIC
/end GROUP
/begin GROUP autosar_swc_aeb_autosar_swc_aeb_Step_sys_Subsystem_Reference_AEB_Function_Run_AsyEvlrCritEve_Step_Func_Run_AsyEvlrCritEve_Step_Func_TAWrapper_LongitudinalThreatAssessor_SingleTargetThreatAssessor_PrimaryTargetForIntv_RequiredLongitudinalAccelerationComputerForIntv_RequiredLongitudinalAccelerationCalculator_CalculateRequiredAcceleration "autosar_swc_aeb/autosar_swc_aeb_Step_sys/Subsystem Reference/AEB Function/Run_AsyEvlrCritEve_Step_Func/Run_AsyEvlrCritEve_Step_Func/TAWrapper/LongitudinalThreatAssessor/SingleTargetThreatAssessor/PrimaryTargetForIntv/RequiredLongitudinalAccelerationComputerForIntv/RequiredLongitudinalAccelerationCalculator/CalculateRequiredAcceleration"
 /begin SUB_GROUP autosar_swc_aeb_autosar_swc_aeb_Step_sys_Subsystem_Reference_AEB_Function_Run_AsyEvlrCritEve_Step_Func_Run_AsyEvlrCritEve_Step_Func_TAWrapper_LongitudinalThreatAssessor_SingleTargetThreatAssessor_PrimaryTargetForIntv_RequiredLongitudinalAccelerationComputerForIntv_RequiredLongitudinalAccelerationCalculator_CalculateRequiredAcceleration_AlgorithmChooser autosar_swc_aeb_autosar_swc_aeb_Step_sys_Subsystem_Reference_AEB_Function_Run_AsyEvlrCritEve_Step_Func_Run_AsyEvlrCritEve_Step_Func_TAWrapper_LongitudinalThreatAssessor_SingleTargetThreatAssessor_PrimaryTargetForIntv_RequiredLongitudinalAccelerationComputerForIntv_RequiredLongitudinalAccelerationCalculator_CalculateRequiredAcceleration_RequiredAccelerationForInPathObject /end SUB_GROUP
/end GROUP
/begin GROUP autosar_swc_aeb_autosar_swc_aeb_Step_sys_Subsystem_Reference_AEB_Function_Run_AsyEvlrCritEve_Step_Func_Run_AsyEvlrCritEve_Step_Func_TAWrapper_LongitudinalThreatAssessor_SingleTargetThreatAssessor_PrimaryTargetForIntv_RequiredLongitudinalAccelerationComputerForIntv_RequiredLongitudinalAccelerationCalculator_CalculateRequiredAcceleration_AlgorithmChooser "autosar_swc_aeb/autosar_swc_aeb_Step_sys/Subsystem Reference/AEB Function/Run_AsyEvlrCritEve_Step_Func/Run_AsyEvlrCritEve_Step_Func/TAWrapper/LongitudinalThreatAssessor/SingleTargetThreatAssessor/PrimaryTargetForIntv/RequiredLongitudinalAccelerationComputerForIntv/RequiredLongitudinalAccelerationCalculator/CalculateRequiredAcceleration/AlgorithmChooser"
 /begin SUB_GROUP autosar_swc_aeb_autosar_swc_aeb_Step_sys_Subsystem_Reference_AEB_Function_Run_AsyEvlrCritEve_Step_Func_Run_AsyEvlrCritEve_Step_Func_TAWrapper_LongitudinalThreatAssessor_SingleTargetThreatAssessor_PrimaryTargetForIntv_RequiredLongitudinalAccelerationComputerForIntv_RequiredLongitudinalAccelerationCalculator_CalculateRequiredAcceleration_AlgorithmChooser_CheckIfObjectWillEnterPath /end SUB_GROUP
 /begin REF_CHARACTERISTIC CLTS_TiUpprLimInAsyEvlrCritEve_Ca /end REF_CHARACTERISTIC
 /begin REF_MEASUREMENT autosar_swc_aeb_rtARID_DEF.ALgtRqrd_e /end REF_MEASUREMENT
/end GROUP
/begin GROUP autosar_swc_aeb_autosar_swc_aeb_Step_sys_Subsystem_Reference_AEB_Function_Run_AsyEvlrCritEve_Step_Func_Run_AsyEvlrCritEve_Step_Func_TAWrapper_LongitudinalThreatAssessor_SingleTargetThreatAssessor_PrimaryTargetForIntv_RequiredLongitudinalAccelerationComputerForIntv_RequiredLongitudinalAccelerationCalculator_CalculateRequiredAcceleration_AlgorithmChooser_CheckIfObjectWillEnterPath "autosar_swc_aeb/autosar_swc_aeb_Step_sys/Subsystem Reference/AEB Function/Run_AsyEvlrCritEve_Step_Func/Run_AsyEvlrCritEve_Step_Func/TAWrapper/LongitudinalThreatAssessor/SingleTargetThreatAssessor/PrimaryTargetForIntv/RequiredLongitudinalAccelerationComputerForIntv/RequiredLongitudinalAccelerationCalculator/CalculateRequiredAcceleration/AlgorithmChooser/CheckIfObjectWillEnterPath" /begin REF_CHARACTERISTIC CLTS_TiUpprLimInAsyEvlrCritEve_Ca /end REF_CHARACTERISTIC /end GROUP
/begin GROUP autosar_swc_aeb_autosar_swc_aeb_Step_sys_Subsystem_Reference_AEB_Function_Run_AsyEvlrCritEve_Step_Func_Run_AsyEvlrCritEve_Step_Func_TAWrapper_LongitudinalThreatAssessor_SingleTargetThreatAssessor_PrimaryTargetForIntv_RequiredLongitudinalAccelerationComputerForIntv_RequiredLongitudinalAccelerationCalculator_CalculateRequiredAcceleration_RequiredAccelerationForInPathObject "autosar_swc_aeb/autosar_swc_aeb_Step_sys/Subsystem Reference/AEB Function/Run_AsyEvlrCritEve_Step_Func/Run_AsyEvlrCritEve_Step_Func/TAWrapper/LongitudinalThreatAssessor/SingleTargetThreatAssessor/PrimaryTargetForIntv/RequiredLongitudinalAccelerationComputerForIntv/RequiredLongitudinalAccelerationCalculator/CalculateRequiredAcceleration/RequiredAccelerationForInPathObject"
 /begin SUB_GROUP autosar_swc_aeb_autosar_swc_aeb_Step_sys_Subsystem_Reference_AEB_Function_Run_AsyEvlrCritEve_Step_Func_Run_AsyEvlrCritEve_Step_Func_TAWrapper_LongitudinalThreatAssessor_SingleTargetThreatAssessor_PrimaryTargetForIntv_RequiredLongitudinalAccelerationComputerForIntv_RequiredLongitudinalAccelerationCalculator_CalculateRequiredAcceleration_RequiredAccelerationForInPathObject_ObjectIsBraking /end SUB_GROUP
/end GROUP
/begin GROUP autosar_swc_aeb_autosar_swc_aeb_Step_sys_Subsystem_Reference_AEB_Function_Run_AsyEvlrCritEve_Step_Func_Run_AsyEvlrCritEve_Step_Func_TAWrapper_LongitudinalThreatAssessor_SingleTargetThreatAssessor_PrimaryTargetForIntv_RequiredLongitudinalAccelerationComputerForIntv_RequiredLongitudinalAccelerationCalculator_CalculateRequiredAcceleration_RequiredAccelerationForInPathObject_ObjectIsBraking "autosar_swc_aeb/autosar_swc_aeb_Step_sys/Subsystem Reference/AEB Function/Run_AsyEvlrCritEve_Step_Func/Run_AsyEvlrCritEve_Step_Func/TAWrapper/LongitudinalThreatAssessor/SingleTargetThreatAssessor/PrimaryTargetForIntv/RequiredLongitudinalAccelerationComputerForIntv/RequiredLongitudinalAccelerationCalculator/CalculateRequiredAcceleration/RequiredAccelerationForInPathObject/ObjectIsBraking"
 /begin SUB_GROUP autosar_swc_aeb_autosar_swc_aeb_Step_sys_Subsystem_Reference_AEB_Function_Run_AsyEvlrCritEve_Step_Func_Run_AsyEvlrCritEve_Step_Func_TAWrapper_LongitudinalThreatAssessor_SingleTargetThreatAssessor_PrimaryTargetForIntv_RequiredLongitudinalAccelerationComputerForIntv_RequiredLongitudinalAccelerationCalculator_CalculateRequiredAcceleration_RequiredAccelerationForInPathObject_ObjectIsBraking_ObjectStopsBeforeCollision /end SUB_GROUP
/end GROUP
/begin GROUP autosar_swc_aeb_autosar_swc_aeb_Step_sys_Subsystem_Reference_AEB_Function_Run_AsyEvlrCritEve_Step_Func_Run_AsyEvlrCritEve_Step_Func_TAWrapper_LongitudinalThreatAssessor_SingleTargetThreatAssessor_PrimaryTargetForIntv_RequiredLongitudinalAccelerationComputerForIntv_RequiredLongitudinalAccelerationCalculator_CalculateRequiredAcceleration_RequiredAccelerationForInPathObject_ObjectIsBraking_ObjectStopsBeforeCollision "autosar_swc_aeb/autosar_swc_aeb_Step_sys/Subsystem Reference/AEB Function/Run_AsyEvlrCritEve_Step_Func/Run_AsyEvlrCritEve_Step_Func/TAWrapper/LongitudinalThreatAssessor/SingleTargetThreatAssessor/PrimaryTargetForIntv/RequiredLongitudinalAccelerationComputerForIntv/RequiredLongitudinalAccelerationCalculator/CalculateRequiredAcceleration/RequiredAccelerationForInPathObject/ObjectIsBraking/ObjectStopsBeforeCollision"
 /begin SUB_GROUP autosar_swc_aeb_autosar_swc_aeb_Step_sys_Subsystem_Reference_AEB_Function_Run_AsyEvlrCritEve_Step_Func_Run_AsyEvlrCritEve_Step_Func_TAWrapper_LongitudinalThreatAssessor_SingleTargetThreatAssessor_PrimaryTargetForIntv_RequiredLongitudinalAccelerationComputerForIntv_RequiredLongitudinalAccelerationCalculator_CalculateRequiredAcceleration_RequiredAccelerationForInPathObject_ObjectIsBraking_ObjectStopsBeforeCollision_ObjectNotStoppingBeforeTTR /end SUB_GROUP
/end GROUP
/begin GROUP autosar_swc_aeb_autosar_swc_aeb_Step_sys_Subsystem_Reference_AEB_Function_Run_AsyEvlrCritEve_Step_Func_Run_AsyEvlrCritEve_Step_Func_TAWrapper_LongitudinalThreatAssessor_SingleTargetThreatAssessor_PrimaryTargetForIntv_RequiredLongitudinalAccelerationComputerForIntv_RequiredLongitudinalAccelerationCalculator_CalculateRequiredAcceleration_RequiredAccelerationForInPathObject_ObjectIsBraking_ObjectStopsBeforeCollision_ObjectNotStoppingBeforeTTR "autosar_swc_aeb/autosar_swc_aeb_Step_sys/Subsystem Reference/AEB Function/Run_AsyEvlrCritEve_Step_Func/Run_AsyEvlrCritEve_Step_Func/TAWrapper/LongitudinalThreatAssessor/SingleTargetThreatAssessor/PrimaryTargetForIntv/RequiredLongitudinalAccelerationComputerForIntv/RequiredLongitudinalAccelerationCalculator/CalculateRequiredAcceleration/RequiredAccelerationForInPathObject/ObjectIsBraking/ObjectStopsBeforeCollision/ObjectNotStoppingBeforeTTR" /begin REF_CHARACTERISTIC CLTS_ALowrLimInAsyEvlrCritEve_Ca /end REF_CHARACTERISTIC /end GROUP
/begin GROUP autosar_swc_aeb_autosar_swc_aeb_Step_sys_Subsystem_Reference_AEB_Function_Run_AsyEvlrCritEve_Step_Func_Run_AsyEvlrCritEve_Step_Func_TAWrapper_LongitudinalThreatAssessor_SingleTargetThreatAssessor_PrimaryTargetForIntv_RequiredLongitudinalAccelerationComputerForIntv_TranslateAndRotateCoordSys "autosar_swc_aeb/autosar_swc_aeb_Step_sys/Subsystem Reference/AEB Function/Run_AsyEvlrCritEve_Step_Func/Run_AsyEvlrCritEve_Step_Func/TAWrapper/LongitudinalThreatAssessor/SingleTargetThreatAssessor/PrimaryTargetForIntv/RequiredLongitudinalAccelerationComputerForIntv/TranslateAndRotateCoordSys"
 /begin REF_CHARACTERISTIC CLTS_ObjSpdThdLatInAsyEvlrCritEve_Ca CLTS_ObjSpdThdLgtInAsyEvlrCritEve_Ca /end REF_CHARACTERISTIC
 /begin REF_MEASUREMENT autosar_swc_aeb_rtARID_DEF.PredALatObj_d autosar_swc_aeb_rtARID_DEF.PredALgtObj_g autosar_swc_aeb_rtARID_DEF.PredPosnLat_f autosar_swc_aeb_rtARID_DEF.PredPosnLgt_a autosar_swc_aeb_rtARID_DEF.PredVLatObj_c autosar_swc_aeb_rtARID_DEF.PredVLgtObj_c /end REF_MEASUREMENT
/end GROUP
/begin GROUP autosar_swc_aeb_autosar_swc_aeb_Step_sys_Subsystem_Reference_AEB_Function_Run_AsyEvlrCritEve_Step_Func_Run_AsyEvlrCritEve_Step_Func_TAWrapper_LongitudinalThreatAssessor_SingleTargetThreatAssessor_PrimaryTargetForIntv_SimpleLateralAccelerationEstimatorForIntv "autosar_swc_aeb/autosar_swc_aeb_Step_sys/Subsystem Reference/AEB Function/Run_AsyEvlrCritEve_Step_Func/Run_AsyEvlrCritEve_Step_Func/TAWrapper/LongitudinalThreatAssessor/SingleTargetThreatAssessor/PrimaryTargetForIntv/SimpleLateralAccelerationEstimatorForIntv"
 /begin SUB_GROUP autosar_swc_aeb_autosar_swc_aeb_Step_sys_Subsystem_Reference_AEB_Function_Run_AsyEvlrCritEve_Step_Func_Run_AsyEvlrCritEve_Step_Func_TAWrapper_LongitudinalThreatAssessor_SingleTargetThreatAssessor_PrimaryTargetForIntv_SimpleLateralAccelerationEstimatorForIntv_CalculateRequiredALat autosar_swc_aeb_autosar_swc_aeb_Step_sys_Subsystem_Reference_AEB_Function_Run_AsyEvlrCritEve_Step_Func_Run_AsyEvlrCritEve_Step_Func_TAWrapper_LongitudinalThreatAssessor_SingleTargetThreatAssessor_PrimaryTargetForIntv_SimpleLateralAccelerationEstimatorForIntv_NoOperation autosar_swc_aeb_autosar_swc_aeb_Step_sys_Subsystem_Reference_AEB_Function_Run_AsyEvlrCritEve_Step_Func_Run_AsyEvlrCritEve_Step_Func_TAWrapper_LongitudinalThreatAssessor_SingleTargetThreatAssessor_PrimaryTargetForIntv_SimpleLateralAccelerationEstimatorForIntv_ProjectionAdaptation /end SUB_GROUP
 /begin REF_MEASUREMENT autosar_swc_aeb_rtARID_DEF.ALatRqrd_as autosar_swc_aeb_rtARID_DEF.Out autosar_swc_aeb_rtARID_DEF.ProjectedLengthSideLat_c autosar_swc_aeb_rtARID_DEF.ProjectedPosnLatRel_i /end REF_MEASUREMENT
/end GROUP
/begin GROUP autosar_swc_aeb_autosar_swc_aeb_Step_sys_Subsystem_Reference_AEB_Function_Run_AsyEvlrCritEve_Step_Func_Run_AsyEvlrCritEve_Step_Func_TAWrapper_LongitudinalThreatAssessor_SingleTargetThreatAssessor_PrimaryTargetForIntv_SimpleLateralAccelerationEstimatorForIntv1 "autosar_swc_aeb/autosar_swc_aeb_Step_sys/Subsystem Reference/AEB Function/Run_AsyEvlrCritEve_Step_Func/Run_AsyEvlrCritEve_Step_Func/TAWrapper/LongitudinalThreatAssessor/SingleTargetThreatAssessor/PrimaryTargetForIntv/SimpleLateralAccelerationEstimatorForIntv1"
 /begin SUB_GROUP autosar_swc_aeb_autosar_swc_aeb_Step_sys_Subsystem_Reference_AEB_Function_Run_AsyEvlrCritEve_Step_Func_Run_AsyEvlrCritEve_Step_Func_TAWrapper_LongitudinalThreatAssessor_SingleTargetThreatAssessor_PrimaryTargetForIntv_SimpleLateralAccelerationEstimatorForIntv1_CalculateRequiredALat autosar_swc_aeb_autosar_swc_aeb_Step_sys_Subsystem_Reference_AEB_Function_Run_AsyEvlrCritEve_Step_Func_Run_AsyEvlrCritEve_Step_Func_TAWrapper_LongitudinalThreatAssessor_SingleTargetThreatAssessor_PrimaryTargetForIntv_SimpleLateralAccelerationEstimatorForIntv1_ProjectionAdaptation /end SUB_GROUP
 /begin REF_MEASUREMENT autosar_swc_aeb_rtARID_DEF.ALatRqrd_l autosar_swc_aeb_rtARID_DEF.ProjectedLengthSideLat autosar_swc_aeb_rtARID_DEF.ProjectedPosnLatRel /end REF_MEASUREMENT
/end GROUP
/begin GROUP autosar_swc_aeb_autosar_swc_aeb_Step_sys_Subsystem_Reference_AEB_Function_Run_AsyEvlrCritEve_Step_Func_Run_AsyEvlrCritEve_Step_Func_TAWrapper_LongitudinalThreatAssessor_SingleTargetThreatAssessor_PrimaryTargetForIntv_SimpleLateralAccelerationEstimatorForIntv1_CalculateRequiredALat "autosar_swc_aeb/autosar_swc_aeb_Step_sys/Subsystem Reference/AEB Function/Run_AsyEvlrCritEve_Step_Func/Run_AsyEvlrCritEve_Step_Func/TAWrapper/LongitudinalThreatAssessor/SingleTargetThreatAssessor/PrimaryTargetForIntv/SimpleLateralAccelerationEstimatorForIntv1/CalculateRequiredALat" /begin REF_CHARACTERISTIC CLTS_DstMaxLatMovmtInAsyEvlrCritEve_Ca /end REF_CHARACTERISTIC
 /begin REF_MEASUREMENT autosar_swc_aeb_rtARID_DEF.ALatRqrd_l autosar_swc_aeb_rtARID_DEF.ProjectedPosnLatRel /end REF_MEASUREMENT
/end GROUP
/begin GROUP autosar_swc_aeb_autosar_swc_aeb_Step_sys_Subsystem_Reference_AEB_Function_Run_AsyEvlrCritEve_Step_Func_Run_AsyEvlrCritEve_Step_Func_TAWrapper_LongitudinalThreatAssessor_SingleTargetThreatAssessor_PrimaryTargetForIntv_SimpleLateralAccelerationEstimatorForIntv1_ProjectionAdaptation "autosar_swc_aeb/autosar_swc_aeb_Step_sys/Subsystem Reference/AEB Function/Run_AsyEvlrCritEve_Step_Func/Run_AsyEvlrCritEve_Step_Func/TAWrapper/LongitudinalThreatAssessor/SingleTargetThreatAssessor/PrimaryTargetForIntv/SimpleLateralAccelerationEstimatorForIntv1/ProjectionAdaptation"
 /begin REF_MEASUREMENT autosar_swc_aeb_rtARID_DEF.ProjectedLengthSideLat autosar_swc_aeb_rtARID_DEF.ProjectedPosnLatRel /end REF_MEASUREMENT
/end GROUP
/begin GROUP autosar_swc_aeb_autosar_swc_aeb_Step_sys_Subsystem_Reference_AEB_Function_Run_AsyEvlrCritEve_Step_Func_Run_AsyEvlrCritEve_Step_Func_TAWrapper_LongitudinalThreatAssessor_SingleTargetThreatAssessor_PrimaryTargetForIntv_SimpleLateralAccelerationEstimatorForIntv_CalculateRequiredALat "autosar_swc_aeb/autosar_swc_aeb_Step_sys/Subsystem Reference/AEB Function/Run_AsyEvlrCritEve_Step_Func/Run_AsyEvlrCritEve_Step_Func/TAWrapper/LongitudinalThreatAssessor/SingleTargetThreatAssessor/PrimaryTargetForIntv/SimpleLateralAccelerationEstimatorForIntv/CalculateRequiredALat" /begin REF_CHARACTERISTIC CLTS_DstMaxLatMovmtInAsyEvlrCritEve_Ca /end REF_CHARACTERISTIC
 /begin REF_MEASUREMENT autosar_swc_aeb_rtARID_DEF.ALatRqrd_as autosar_swc_aeb_rtARID_DEF.ProjectedPosnLatRel_i /end REF_MEASUREMENT
/end GROUP
/begin GROUP autosar_swc_aeb_autosar_swc_aeb_Step_sys_Subsystem_Reference_AEB_Function_Run_AsyEvlrCritEve_Step_Func_Run_AsyEvlrCritEve_Step_Func_TAWrapper_LongitudinalThreatAssessor_SingleTargetThreatAssessor_PrimaryTargetForIntv_SimpleLateralAccelerationEstimatorForIntv_NoOperation "autosar_swc_aeb/autosar_swc_aeb_Step_sys/Subsystem Reference/AEB Function/Run_AsyEvlrCritEve_Step_Func/Run_AsyEvlrCritEve_Step_Func/TAWrapper/LongitudinalThreatAssessor/SingleTargetThreatAssessor/PrimaryTargetForIntv/SimpleLateralAccelerationEstimatorForIntv/NoOperation" /begin REF_MEASUREMENT autosar_swc_aeb_rtARID_DEF.Out /end REF_MEASUREMENT /end GROUP
/begin GROUP autosar_swc_aeb_autosar_swc_aeb_Step_sys_Subsystem_Reference_AEB_Function_Run_AsyEvlrCritEve_Step_Func_Run_AsyEvlrCritEve_Step_Func_TAWrapper_LongitudinalThreatAssessor_SingleTargetThreatAssessor_PrimaryTargetForIntv_SimpleLateralAccelerationEstimatorForIntv_ProjectionAdaptation "autosar_swc_aeb/autosar_swc_aeb_Step_sys/Subsystem Reference/AEB Function/Run_AsyEvlrCritEve_Step_Func/Run_AsyEvlrCritEve_Step_Func/TAWrapper/LongitudinalThreatAssessor/SingleTargetThreatAssessor/PrimaryTargetForIntv/SimpleLateralAccelerationEstimatorForIntv/ProjectionAdaptation"
 /begin REF_MEASUREMENT autosar_swc_aeb_rtARID_DEF.ProjectedLengthSideLat_c autosar_swc_aeb_rtARID_DEF.ProjectedPosnLatRel_i /end REF_MEASUREMENT
/end GROUP
/begin GROUP autosar_swc_aeb_autosar_swc_aeb_Step_sys_Subsystem_Reference_AEB_Function_Run_AsyEvlrCritEve_Step_Func_Run_AsyEvlrCritEve_Step_Func_TAWrapper_LongitudinalThreatAssessor_SingleTargetThreatAssessor_PrimaryTargetForWarn "autosar_swc_aeb/autosar_swc_aeb_Step_sys/Subsystem Reference/AEB Function/Run_AsyEvlrCritEve_Step_Func/Run_AsyEvlrCritEve_Step_Func/TAWrapper/LongitudinalThreatAssessor/SingleTargetThreatAssessor/PrimaryTargetForWarn"
 /begin SUB_GROUP autosar_swc_aeb_autosar_swc_aeb_Step_sys_Subsystem_Reference_AEB_Function_Run_AsyEvlrCritEve_Step_Func_Run_AsyEvlrCritEve_Step_Func_TAWrapper_LongitudinalThreatAssessor_SingleTargetThreatAssessor_PrimaryTargetForWarn_FindPrimaryTargetForWarn autosar_swc_aeb_autosar_swc_aeb_Step_sys_Subsystem_Reference_AEB_Function_Run_AsyEvlrCritEve_Step_Func_Run_AsyEvlrCritEve_Step_Func_TAWrapper_LongitudinalThreatAssessor_SingleTargetThreatAssessor_PrimaryTargetForWarn_PosnLgtForWarn autosar_swc_aeb_autosar_swc_aeb_Step_sys_Subsystem_Reference_AEB_Function_Run_AsyEvlrCritEve_Step_Func_Run_AsyEvlrCritEve_Step_Func_TAWrapper_LongitudinalThreatAssessor_SingleTargetThreatAssessor_PrimaryTargetForWarn_RequiredLongitudinalAccelerationComputerForWarn /end SUB_GROUP
 /begin REF_MEASUREMENT autosar_swc_aeb_rtARID_DEF.IfEnabled3_ActiveSubsystem autosar_swc_aeb_rtARID_DEF.IfEnabled6_ActiveSubsystem /end REF_MEASUREMENT
/end GROUP
/begin GROUP autosar_swc_aeb_autosar_swc_aeb_Step_sys_Subsystem_Reference_AEB_Function_Run_AsyEvlrCritEve_Step_Func_Run_AsyEvlrCritEve_Step_Func_TAWrapper_LongitudinalThreatAssessor_SingleTargetThreatAssessor_PrimaryTargetForWarn_FindPrimaryTargetForWarn "autosar_swc_aeb/autosar_swc_aeb_Step_sys/Subsystem Reference/AEB Function/Run_AsyEvlrCritEve_Step_Func/Run_AsyEvlrCritEve_Step_Func/TAWrapper/LongitudinalThreatAssessor/SingleTargetThreatAssessor/PrimaryTargetForWarn/FindPrimaryTargetForWarn"
 /begin SUB_GROUP autosar_swc_aeb_autosar_swc_aeb_Step_sys_Subsystem_Reference_AEB_Function_Run_AsyEvlrCritEve_Step_Func_Run_AsyEvlrCritEve_Step_Func_TAWrapper_LongitudinalThreatAssessor_SingleTargetThreatAssessor_PrimaryTargetForWarn_FindPrimaryTargetForWarn_FindPrimaryTargetForWarnALgt autosar_swc_aeb_autosar_swc_aeb_Step_sys_Subsystem_Reference_AEB_Function_Run_AsyEvlrCritEve_Step_Func_Run_AsyEvlrCritEve_Step_Func_TAWrapper_LongitudinalThreatAssessor_SingleTargetThreatAssessor_PrimaryTargetForWarn_FindPrimaryTargetForWarn_FindPrimaryTargetForWarnPosnLgt autosar_swc_aeb_autosar_swc_aeb_Step_sys_Subsystem_Reference_AEB_Function_Run_AsyEvlrCritEve_Step_Func_Run_AsyEvlrCritEve_Step_Func_TAWrapper_LongitudinalThreatAssessor_SingleTargetThreatAssessor_PrimaryTargetForWarn_FindPrimaryTargetForWarn_PrimTarSelectorForWarn /end SUB_GROUP
/end GROUP
/begin GROUP autosar_swc_aeb_autosar_swc_aeb_Step_sys_Subsystem_Reference_AEB_Function_Run_AsyEvlrCritEve_Step_Func_Run_AsyEvlrCritEve_Step_Func_TAWrapper_LongitudinalThreatAssessor_SingleTargetThreatAssessor_PrimaryTargetForWarn_FindPrimaryTargetForWarn_FindPrimaryTargetForWarnALgt "autosar_swc_aeb/autosar_swc_aeb_Step_sys/Subsystem Reference/AEB Function/Run_AsyEvlrCritEve_Step_Func/Run_AsyEvlrCritEve_Step_Func/TAWrapper/LongitudinalThreatAssessor/SingleTargetThreatAssessor/PrimaryTargetForWarn/FindPrimaryTargetForWarn/FindPrimaryTargetForWarnALgt"
 /begin SUB_GROUP autosar_swc_aeb_autosar_swc_aeb_Step_sys_Subsystem_Reference_AEB_Function_Run_AsyEvlrCritEve_Step_Func_Run_AsyEvlrCritEve_Step_Func_TAWrapper_LongitudinalThreatAssessor_SingleTargetThreatAssessor_PrimaryTargetForWarn_FindPrimaryTargetForWarn_FindPrimaryTargetForWarnALgt_MaxDecelerationSelector /end SUB_GROUP
/end GROUP
/begin GROUP autosar_swc_aeb_autosar_swc_aeb_Step_sys_Subsystem_Reference_AEB_Function_Run_AsyEvlrCritEve_Step_Func_Run_AsyEvlrCritEve_Step_Func_TAWrapper_LongitudinalThreatAssessor_SingleTargetThreatAssessor_PrimaryTargetForWarn_FindPrimaryTargetForWarn_FindPrimaryTargetForWarnALgt_MaxDecelerationSelector "autosar_swc_aeb/autosar_swc_aeb_Step_sys/Subsystem Reference/AEB Function/Run_AsyEvlrCritEve_Step_Func/Run_AsyEvlrCritEve_Step_Func/TAWrapper/LongitudinalThreatAssessor/SingleTargetThreatAssessor/PrimaryTargetForWarn/FindPrimaryTargetForWarn/FindPrimaryTargetForWarnALgt/MaxDecelerationSelector"
 /begin REF_MEASUREMENT autosar_swc_aeb_rtARID_DEF.ALgtRqrd_j autosar_swc_aeb_rtARID_DEF.MinALgtRqrd /end REF_MEASUREMENT
/end GROUP
/begin GROUP autosar_swc_aeb_autosar_swc_aeb_Step_sys_Subsystem_Reference_AEB_Function_Run_AsyEvlrCritEve_Step_Func_Run_AsyEvlrCritEve_Step_Func_TAWrapper_LongitudinalThreatAssessor_SingleTargetThreatAssessor_PrimaryTargetForWarn_FindPrimaryTargetForWarn_FindPrimaryTargetForWarnPosnLgt "autosar_swc_aeb/autosar_swc_aeb_Step_sys/Subsystem Reference/AEB Function/Run_AsyEvlrCritEve_Step_Func/Run_AsyEvlrCritEve_Step_Func/TAWrapper/LongitudinalThreatAssessor/SingleTargetThreatAssessor/PrimaryTargetForWarn/FindPrimaryTargetForWarn/FindPrimaryTargetForWarnPosnLgt"
 /begin SUB_GROUP autosar_swc_aeb_autosar_swc_aeb_Step_sys_Subsystem_Reference_AEB_Function_Run_AsyEvlrCritEve_Step_Func_Run_AsyEvlrCritEve_Step_Func_TAWrapper_LongitudinalThreatAssessor_SingleTargetThreatAssessor_PrimaryTargetForWarn_FindPrimaryTargetForWarn_FindPrimaryTargetForWarnPosnLgt_MInPosLgtSelector /end SUB_GROUP
/end GROUP
/begin GROUP autosar_swc_aeb_autosar_swc_aeb_Step_sys_Subsystem_Reference_AEB_Function_Run_AsyEvlrCritEve_Step_Func_Run_AsyEvlrCritEve_Step_Func_TAWrapper_LongitudinalThreatAssessor_SingleTargetThreatAssessor_PrimaryTargetForWarn_FindPrimaryTargetForWarn_FindPrimaryTargetForWarnPosnLgt_MInPosLgtSelector "autosar_swc_aeb/autosar_swc_aeb_Step_sys/Subsystem Reference/AEB Function/Run_AsyEvlrCritEve_Step_Func/Run_AsyEvlrCritEve_Step_Func/TAWrapper/LongitudinalThreatAssessor/SingleTargetThreatAssessor/PrimaryTargetForWarn/FindPrimaryTargetForWarn/FindPrimaryTargetForWarnPosnLgt/MInPosLgtSelector" /begin REF_MEASUREMENT autosar_swc_aeb_rtARID_DEF.PosnLgt /end REF_MEASUREMENT /end GROUP
/begin GROUP autosar_swc_aeb_autosar_swc_aeb_Step_sys_Subsystem_Reference_AEB_Function_Run_AsyEvlrCritEve_Step_Func_Run_AsyEvlrCritEve_Step_Func_TAWrapper_LongitudinalThreatAssessor_SingleTargetThreatAssessor_PrimaryTargetForWarn_FindPrimaryTargetForWarn_PrimTarSelectorForWarn "autosar_swc_aeb/autosar_swc_aeb_Step_sys/Subsystem Reference/AEB Function/Run_AsyEvlrCritEve_Step_Func/Run_AsyEvlrCritEve_Step_Func/TAWrapper/LongitudinalThreatAssessor/SingleTargetThreatAssessor/PrimaryTargetForWarn/FindPrimaryTargetForWarn/PrimTarSelectorForWarn"
 /begin REF_MEASUREMENT autosar_swc_aeb_rtARID_DEF.MinALgtRqrd autosar_swc_aeb_rtARID_DEF.ThreatFoundForWarn /end REF_MEASUREMENT
/end GROUP
/begin GROUP autosar_swc_aeb_autosar_swc_aeb_Step_sys_Subsystem_Reference_AEB_Function_Run_AsyEvlrCritEve_Step_Func_Run_AsyEvlrCritEve_Step_Func_TAWrapper_LongitudinalThreatAssessor_SingleTargetThreatAssessor_PrimaryTargetForWarn_PosnLgtForWarn "autosar_swc_aeb/autosar_swc_aeb_Step_sys/Subsystem Reference/AEB Function/Run_AsyEvlrCritEve_Step_Func/Run_AsyEvlrCritEve_Step_Func/TAWrapper/LongitudinalThreatAssessor/SingleTargetThreatAssessor/PrimaryTargetForWarn/PosnLgtForWarn" /begin REF_MEASUREMENT autosar_swc_aeb_rtARID_DEF.PosnLgt /end REF_MEASUREMENT /end GROUP
/begin GROUP autosar_swc_aeb_autosar_swc_aeb_Step_sys_Subsystem_Reference_AEB_Function_Run_AsyEvlrCritEve_Step_Func_Run_AsyEvlrCritEve_Step_Func_TAWrapper_LongitudinalThreatAssessor_SingleTargetThreatAssessor_PrimaryTargetForWarn_RequiredLongitudinalAccelerationComputerForWarn "autosar_swc_aeb/autosar_swc_aeb_Step_sys/Subsystem Reference/AEB Function/Run_AsyEvlrCritEve_Step_Func/Run_AsyEvlrCritEve_Step_Func/TAWrapper/LongitudinalThreatAssessor/SingleTargetThreatAssessor/PrimaryTargetForWarn/RequiredLongitudinalAccelerationComputerForWarn"
 /begin SUB_GROUP autosar_swc_aeb_autosar_swc_aeb_Step_sys_Subsystem_Reference_AEB_Function_Run_AsyEvlrCritEve_Step_Func_Run_AsyEvlrCritEve_Step_Func_TAWrapper_LongitudinalThreatAssessor_SingleTargetThreatAssessor_PrimaryTargetForWarn_RequiredLongitudinalAccelerationComputerForWarn_CheckPredictionValidity autosar_swc_aeb_autosar_swc_aeb_Step_sys_Subsystem_Reference_AEB_Function_Run_AsyEvlrCritEve_Step_Func_Run_AsyEvlrCritEve_Step_Func_TAWrapper_LongitudinalThreatAssessor_SingleTargetThreatAssessor_PrimaryTargetForWarn_RequiredLongitudinalAccelerationComputerForWarn_PredictHostPositionAtTime autosar_swc_aeb_autosar_swc_aeb_Step_sys_Subsystem_Reference_AEB_Function_Run_AsyEvlrCritEve_Step_Func_Run_AsyEvlrCritEve_Step_Func_TAWrapper_LongitudinalThreatAssessor_SingleTargetThreatAssessor_PrimaryTargetForWarn_RequiredLongitudinalAccelerationComputerForWarn_PredictObject autosar_swc_aeb_autosar_swc_aeb_Step_sys_Subsystem_Reference_AEB_Function_Run_AsyEvlrCritEve_Step_Func_Run_AsyEvlrCritEve_Step_Func_TAWrapper_LongitudinalThreatAssessor_SingleTargetThreatAssessor_PrimaryTargetForWarn_RequiredLongitudinalAccelerationComputerForWarn_RequiredLongitudinalAccelerationCalculator autosar_swc_aeb_autosar_swc_aeb_Step_sys_Subsystem_Reference_AEB_Function_Run_AsyEvlrCritEve_Step_Func_Run_AsyEvlrCritEve_Step_Func_TAWrapper_LongitudinalThreatAssessor_SingleTargetThreatAssessor_PrimaryTargetForWarn_RequiredLongitudinalAccelerationComputerForWarn_TranslateAndRotateCoordSys /end SUB_GROUP
 /begin REF_MEASUREMENT autosar_swc_aeb_rtARID_DEF.ALgtRqrd_j /end REF_MEASUREMENT
/end GROUP
/begin GROUP autosar_swc_aeb_autosar_swc_aeb_Step_sys_Subsystem_Reference_AEB_Function_Run_AsyEvlrCritEve_Step_Func_Run_AsyEvlrCritEve_Step_Func_TAWrapper_LongitudinalThreatAssessor_SingleTargetThreatAssessor_PrimaryTargetForWarn_RequiredLongitudinalAccelerationComputerForWarn_CheckPredictionValidity "autosar_swc_aeb/autosar_swc_aeb_Step_sys/Subsystem Reference/AEB Function/Run_AsyEvlrCritEve_Step_Func/Run_AsyEvlrCritEve_Step_Func/TAWrapper/LongitudinalThreatAssessor/SingleTargetThreatAssessor/PrimaryTargetForWarn/RequiredLongitudinalAccelerationComputerForWarn/CheckPredictionValidity"
 /begin SUB_GROUP autosar_swc_aeb_autosar_swc_aeb_Step_sys_Subsystem_Reference_AEB_Function_Run_AsyEvlrCritEve_Step_Func_Run_AsyEvlrCritEve_Step_Func_TAWrapper_LongitudinalThreatAssessor_SingleTargetThreatAssessor_PrimaryTargetForWarn_RequiredLongitudinalAccelerationComputerForWarn_CheckPredictionValidity_CheckConfidenceForHeading autosar_swc_aeb_autosar_swc_aeb_Step_sys_Subsystem_Reference_AEB_Function_Run_AsyEvlrCritEve_Step_Func_Run_AsyEvlrCritEve_Step_Func_TAWrapper_LongitudinalThreatAssessor_SingleTargetThreatAssessor_PrimaryTargetForWarn_RequiredLongitudinalAccelerationComputerForWarn_CheckPredictionValidity_CheckPredictionDistanceBelowThreshold autosar_swc_aeb_autosar_swc_aeb_Step_sys_Subsystem_Reference_AEB_Function_Run_AsyEvlrCritEve_Step_Func_Run_AsyEvlrCritEve_Step_Func_TAWrapper_LongitudinalThreatAssessor_SingleTargetThreatAssessor_PrimaryTargetForWarn_RequiredLongitudinalAccelerationComputerForWarn_CheckPredictionValidity_CheckPredictionTimeBelowThreshold autosar_swc_aeb_autosar_swc_aeb_Step_sys_Subsystem_Reference_AEB_Function_Run_AsyEvlrCritEve_Step_Func_Run_AsyEvlrCritEve_Step_Func_TAWrapper_LongitudinalThreatAssessor_SingleTargetThreatAssessor_PrimaryTargetForWarn_RequiredLongitudinalAccelerationComputerForWarn_CheckPredictionValidity_CheckSpeedAboveThreshold /end SUB_GROUP
/end GROUP
/begin GROUP autosar_swc_aeb_autosar_swc_aeb_Step_sys_Subsystem_Reference_AEB_Function_Run_AsyEvlrCritEve_Step_Func_Run_AsyEvlrCritEve_Step_Func_TAWrapper_LongitudinalThreatAssessor_SingleTargetThreatAssessor_PrimaryTargetForWarn_RequiredLongitudinalAccelerationComputerForWarn_CheckPredictionValidity_CheckConfidenceForHeading "autosar_swc_aeb/autosar_swc_aeb_Step_sys/Subsystem Reference/AEB Function/Run_AsyEvlrCritEve_Step_Func/Run_AsyEvlrCritEve_Step_Func/TAWrapper/LongitudinalThreatAssessor/SingleTargetThreatAssessor/PrimaryTargetForWarn/RequiredLongitudinalAccelerationComputerForWarn/CheckPredictionValidity/CheckConfidenceForHeading" /begin REF_CHARACTERISTIC CLTS_ObjSpdThdForAgDirVldInAsyEvlrCritEve_Ca /end REF_CHARACTERISTIC /end GROUP
/begin GROUP autosar_swc_aeb_autosar_swc_aeb_Step_sys_Subsystem_Reference_AEB_Function_Run_AsyEvlrCritEve_Step_Func_Run_AsyEvlrCritEve_Step_Func_TAWrapper_LongitudinalThreatAssessor_SingleTargetThreatAssessor_PrimaryTargetForWarn_RequiredLongitudinalAccelerationComputerForWarn_CheckPredictionValidity_CheckPredictionDistanceBelowThreshold "autosar_swc_aeb/autosar_swc_aeb_Step_sys/Subsystem Reference/AEB Function/Run_AsyEvlrCritEve_Step_Func/Run_AsyEvlrCritEve_Step_Func/TAWrapper/LongitudinalThreatAssessor/SingleTargetThreatAssessor/PrimaryTargetForWarn/RequiredLongitudinalAccelerationComputerForWarn/CheckPredictionValidity/CheckPredictionDistanceBelowThreshold" /begin REF_CHARACTERISTIC CLTS_DstPredMaxInAsyEvlrCritEve_Ca /end REF_CHARACTERISTIC /end GROUP
/begin GROUP autosar_swc_aeb_autosar_swc_aeb_Step_sys_Subsystem_Reference_AEB_Function_Run_AsyEvlrCritEve_Step_Func_Run_AsyEvlrCritEve_Step_Func_TAWrapper_LongitudinalThreatAssessor_SingleTargetThreatAssessor_PrimaryTargetForWarn_RequiredLongitudinalAccelerationComputerForWarn_CheckPredictionValidity_CheckPredictionTimeBelowThreshold "autosar_swc_aeb/autosar_swc_aeb_Step_sys/Subsystem Reference/AEB Function/Run_AsyEvlrCritEve_Step_Func/Run_AsyEvlrCritEve_Step_Func/TAWrapper/LongitudinalThreatAssessor/SingleTargetThreatAssessor/PrimaryTargetForWarn/RequiredLongitudinalAccelerationComputerForWarn/CheckPredictionValidity/CheckPredictionTimeBelowThreshold" /begin REF_CHARACTERISTIC CLTS_SftyArUpprLimForTiInObjPredInAsyEvlrCritEve_Ca /end REF_CHARACTERISTIC /end GROUP
/begin GROUP autosar_swc_aeb_autosar_swc_aeb_Step_sys_Subsystem_Reference_AEB_Function_Run_AsyEvlrCritEve_Step_Func_Run_AsyEvlrCritEve_Step_Func_TAWrapper_LongitudinalThreatAssessor_SingleTargetThreatAssessor_PrimaryTargetForWarn_RequiredLongitudinalAccelerationComputerForWarn_CheckPredictionValidity_CheckSpeedAboveThreshold "autosar_swc_aeb/autosar_swc_aeb_Step_sys/Subsystem Reference/AEB Function/Run_AsyEvlrCritEve_Step_Func/Run_AsyEvlrCritEve_Step_Func/TAWrapper/LongitudinalThreatAssessor/SingleTargetThreatAssessor/PrimaryTargetForWarn/RequiredLongitudinalAccelerationComputerForWarn/CheckPredictionValidity/CheckSpeedAboveThreshold" /begin REF_CHARACTERISTIC CLTS_SpdPredMinInAsyEvlrCritEve_Ca /end REF_CHARACTERISTIC /end GROUP
/begin GROUP autosar_swc_aeb_autosar_swc_aeb_Step_sys_Subsystem_Reference_AEB_Function_Run_AsyEvlrCritEve_Step_Func_Run_AsyEvlrCritEve_Step_Func_TAWrapper_LongitudinalThreatAssessor_SingleTargetThreatAssessor_PrimaryTargetForWarn_RequiredLongitudinalAccelerationComputerForWarn_RequiredLongitudinalAccelerationCalculator_CalculateLateralTTRandTTP_LateralTTPComputer_LeftClosest "autosar_swc_aeb/autosar_swc_aeb_Step_sys/Subsystem Reference/AEB Function/Run_AsyEvlrCritEve_Step_Func/Run_AsyEvlrCritEve_Step_Func/TAWrapper/LongitudinalThreatAssessor/SingleTargetThreatAssessor/PrimaryTargetForWarn/RequiredLongitudinalAccelerationComputerForWarn/RequiredLongitudinalAccelerationCalculator/CalculateLateralTTRandTTP/LateralTTPComputer/LeftClosest" /begin REF_CHARACTERISTIC CLTS_TiUpprLimInAsyEvlrCritEve_Ca /end REF_CHARACTERISTIC /end GROUP
/begin GROUP autosar_swc_aeb_autosar_swc_aeb_Step_sys_Subsystem_Reference_AEB_Function_Run_AsyEvlrCritEve_Step_Func_Run_AsyEvlrCritEve_Step_Func_TAWrapper_LongitudinalThreatAssessor_SingleTargetThreatAssessor_PrimaryTargetForWarn_RequiredLongitudinalAccelerationComputerForWarn_RequiredLongitudinalAccelerationCalculator_CalculateLateralTTRandTTP_LateralTTPComputer_LeftClosest_TimeToIntersectionComputer "autosar_swc_aeb/autosar_swc_aeb_Step_sys/Subsystem Reference/AEB Function/Run_AsyEvlrCritEve_Step_Func/Run_AsyEvlrCritEve_Step_Func/TAWrapper/LongitudinalThreatAssessor/SingleTargetThreatAssessor/PrimaryTargetForWarn/RequiredLongitudinalAccelerationComputerForWarn/RequiredLongitudinalAccelerationCalculator/CalculateLateralTTRandTTP/LateralTTPComputer/LeftClosest/TimeToIntersectionComputer"
 /begin REF_CHARACTERISTIC CLTS_TiLowrLimInAsyEvlrCritEve_Ca CLTS_TiUpprLimInAsyEvlrCritEve_Ca /end REF_CHARACTERISTIC
/end GROUP
/begin GROUP autosar_swc_aeb_autosar_swc_aeb_Step_sys_Subsystem_Reference_AEB_Function_Run_AsyEvlrCritEve_Step_Func_Run_AsyEvlrCritEve_Step_Func_TAWrapper_LongitudinalThreatAssessor_SingleTargetThreatAssessor_PrimaryTargetForWarn_RequiredLongitudinalAccelerationComputerForWarn_RequiredLongitudinalAccelerationCalculator_CalculateLateralTTRandTTP_LateralTTPComputer_RightClosest "autosar_swc_aeb/autosar_swc_aeb_Step_sys/Subsystem Reference/AEB Function/Run_AsyEvlrCritEve_Step_Func/Run_AsyEvlrCritEve_Step_Func/TAWrapper/LongitudinalThreatAssessor/SingleTargetThreatAssessor/PrimaryTargetForWarn/RequiredLongitudinalAccelerationComputerForWarn/RequiredLongitudinalAccelerationCalculator/CalculateLateralTTRandTTP/LateralTTPComputer/RightClosest" /begin REF_CHARACTERISTIC CLTS_TiUpprLimInAsyEvlrCritEve_Ca /end REF_CHARACTERISTIC /end GROUP
/begin GROUP autosar_swc_aeb_autosar_swc_aeb_Step_sys_Subsystem_Reference_AEB_Function_Run_AsyEvlrCritEve_Step_Func_Run_AsyEvlrCritEve_Step_Func_TAWrapper_LongitudinalThreatAssessor_SingleTargetThreatAssessor_PrimaryTargetForWarn_RequiredLongitudinalAccelerationComputerForWarn_RequiredLongitudinalAccelerationCalculator_CalculateLateralTTRandTTP_LateralTTPComputer_RightClosest_TimeToIntersectionComputer "autosar_swc_aeb/autosar_swc_aeb_Step_sys/Subsystem Reference/AEB Function/Run_AsyEvlrCritEve_Step_Func/Run_AsyEvlrCritEve_Step_Func/TAWrapper/LongitudinalThreatAssessor/SingleTargetThreatAssessor/PrimaryTargetForWarn/RequiredLongitudinalAccelerationComputerForWarn/RequiredLongitudinalAccelerationCalculator/CalculateLateralTTRandTTP/LateralTTPComputer/RightClosest/TimeToIntersectionComputer"
 /begin REF_CHARACTERISTIC CLTS_TiLowrLimInAsyEvlrCritEve_Ca CLTS_TiUpprLimInAsyEvlrCritEve_Ca /end REF_CHARACTERISTIC
/end GROUP
/begin GROUP autosar_swc_aeb_autosar_swc_aeb_Step_sys_Subsystem_Reference_AEB_Function_Run_AsyEvlrCritEve_Step_Func_Run_AsyEvlrCritEve_Step_Func_TAWrapper_LongitudinalThreatAssessor_SingleTargetThreatAssessor_PrimaryTargetForWarn_RequiredLongitudinalAccelerationComputerForWarn_RequiredLongitudinalAccelerationCalculator_CalculateLateralTTRandTTP_LateralTTRComputer_LeftClosest "autosar_swc_aeb/autosar_swc_aeb_Step_sys/Subsystem Reference/AEB Function/Run_AsyEvlrCritEve_Step_Func/Run_AsyEvlrCritEve_Step_Func/TAWrapper/LongitudinalThreatAssessor/SingleTargetThreatAssessor/PrimaryTargetForWarn/RequiredLongitudinalAccelerationComputerForWarn/RequiredLongitudinalAccelerationCalculator/CalculateLateralTTRandTTP/LateralTTRComputer/LeftClosest" /begin REF_CHARACTERISTIC CLTS_TiUpprLimInAsyEvlrCritEve_Ca /end REF_CHARACTERISTIC /end GROUP
/begin GROUP autosar_swc_aeb_autosar_swc_aeb_Step_sys_Subsystem_Reference_AEB_Function_Run_AsyEvlrCritEve_Step_Func_Run_AsyEvlrCritEve_Step_Func_TAWrapper_LongitudinalThreatAssessor_SingleTargetThreatAssessor_PrimaryTargetForWarn_RequiredLongitudinalAccelerationComputerForWarn_RequiredLongitudinalAccelerationCalculator_CalculateLateralTTRandTTP_LateralTTRComputer_LeftClosest_TimeToIntersectionComputer "autosar_swc_aeb/autosar_swc_aeb_Step_sys/Subsystem Reference/AEB Function/Run_AsyEvlrCritEve_Step_Func/Run_AsyEvlrCritEve_Step_Func/TAWrapper/LongitudinalThreatAssessor/SingleTargetThreatAssessor/PrimaryTargetForWarn/RequiredLongitudinalAccelerationComputerForWarn/RequiredLongitudinalAccelerationCalculator/CalculateLateralTTRandTTP/LateralTTRComputer/LeftClosest/TimeToIntersectionComputer"
 /begin REF_CHARACTERISTIC CLTS_TiLowrLimInAsyEvlrCritEve_Ca CLTS_TiUpprLimInAsyEvlrCritEve_Ca /end REF_CHARACTERISTIC
/end GROUP
/begin GROUP autosar_swc_aeb_autosar_swc_aeb_Step_sys_Subsystem_Reference_AEB_Function_Run_AsyEvlrCritEve_Step_Func_Run_AsyEvlrCritEve_Step_Func_TAWrapper_LongitudinalThreatAssessor_SingleTargetThreatAssessor_PrimaryTargetForWarn_RequiredLongitudinalAccelerationComputerForWarn_RequiredLongitudinalAccelerationCalculator_CalculateLateralTTRandTTP_LateralTTRComputer_RightClosest "autosar_swc_aeb/autosar_swc_aeb_Step_sys/Subsystem Reference/AEB Function/Run_AsyEvlrCritEve_Step_Func/Run_AsyEvlrCritEve_Step_Func/TAWrapper/LongitudinalThreatAssessor/SingleTargetThreatAssessor/PrimaryTargetForWarn/RequiredLongitudinalAccelerationComputerForWarn/RequiredLongitudinalAccelerationCalculator/CalculateLateralTTRandTTP/LateralTTRComputer/RightClosest" /begin REF_CHARACTERISTIC CLTS_TiUpprLimInAsyEvlrCritEve_Ca /end REF_CHARACTERISTIC /end GROUP
/begin GROUP autosar_swc_aeb_autosar_swc_aeb_Step_sys_Subsystem_Reference_AEB_Function_Run_AsyEvlrCritEve_Step_Func_Run_AsyEvlrCritEve_Step_Func_TAWrapper_LongitudinalThreatAssessor_SingleTargetThreatAssessor_PrimaryTargetForWarn_RequiredLongitudinalAccelerationComputerForWarn_RequiredLongitudinalAccelerationCalculator_CalculateLateralTTRandTTP_LateralTTRComputer_RightClosest_TimeToIntersectionComputer "autosar_swc_aeb/autosar_swc_aeb_Step_sys/Subsystem Reference/AEB Function/Run_AsyEvlrCritEve_Step_Func/Run_AsyEvlrCritEve_Step_Func/TAWrapper/LongitudinalThreatAssessor/SingleTargetThreatAssessor/PrimaryTargetForWarn/RequiredLongitudinalAccelerationComputerForWarn/RequiredLongitudinalAccelerationCalculator/CalculateLateralTTRandTTP/LateralTTRComputer/RightClosest/TimeToIntersectionComputer"
 /begin REF_CHARACTERISTIC CLTS_TiLowrLimInAsyEvlrCritEve_Ca CLTS_TiUpprLimInAsyEvlrCritEve_Ca /end REF_CHARACTERISTIC
/end GROUP
/begin GROUP autosar_swc_aeb_autosar_swc_aeb_Step_sys_Subsystem_Reference_AEB_Function_Run_AsyEvlrCritEve_Step_Func_Run_AsyEvlrCritEve_Step_Func_TAWrapper_LongitudinalThreatAssessor_SingleTargetThreatAssessor_PrimaryTargetForWarn_RequiredLongitudinalAccelerationComputerForWarn_RequiredLongitudinalAccelerationCalculator_CalculateLateralTTRandTTP_ModifyTTPAtSameSpeedAndAcceleration "autosar_swc_aeb/autosar_swc_aeb_Step_sys/Subsystem Reference/AEB Function/Run_AsyEvlrCritEve_Step_Func/Run_AsyEvlrCritEve_Step_Func/TAWrapper/LongitudinalThreatAssessor/SingleTargetThreatAssessor/PrimaryTargetForWarn/RequiredLongitudinalAccelerationComputerForWarn/RequiredLongitudinalAccelerationCalculator/CalculateLateralTTRandTTP/ModifyTTPAtSameSpeedAndAcceleration" /begin REF_CHARACTERISTIC CLTS_TiUpprLimInAsyEvlrCritEve_Ca /end REF_CHARACTERISTIC /end GROUP
/begin GROUP autosar_swc_aeb_autosar_swc_aeb_Step_sys_Subsystem_Reference_AEB_Function_Run_AsyEvlrCritEve_Step_Func_Run_AsyEvlrCritEve_Step_Func_TAWrapper_LongitudinalThreatAssessor_SingleTargetThreatAssessor_PrimaryTargetForWarn_RequiredLongitudinalAccelerationComputerForWarn_RequiredLongitudinalAccelerationCalculator_CalculateLateralTTRandTTP_ModifyTTRAtSameSpeedAndAcceleration "autosar_swc_aeb/autosar_swc_aeb_Step_sys/Subsystem Reference/AEB Function/Run_AsyEvlrCritEve_Step_Func/Run_AsyEvlrCritEve_Step_Func/TAWrapper/LongitudinalThreatAssessor/SingleTargetThreatAssessor/PrimaryTargetForWarn/RequiredLongitudinalAccelerationComputerForWarn/RequiredLongitudinalAccelerationCalculator/CalculateLateralTTRandTTP/ModifyTTRAtSameSpeedAndAcceleration"
 /begin REF_CHARACTERISTIC CLTS_TiLowrLimInAsyEvlrCritEve_Ca CLTS_TiUpprLimInAsyEvlrCritEve_Ca /end REF_CHARACTERISTIC
/end GROUP
/begin GROUP autosar_swc_aeb_autosar_swc_aeb_Step_sys_Subsystem_Reference_AEB_Function_Run_AsyEvlrCritEve_Step_Func_Run_AsyEvlrCritEve_Step_Func_TAWrapper_LongitudinalThreatAssessor_SingleTargetThreatAssessor_PrimaryTargetForWarn_RequiredLongitudinalAccelerationComputerForWarn_RequiredLongitudinalAccelerationCalculator_CalculateRequiredAcceleration_AlgorithmChooser "autosar_swc_aeb/autosar_swc_aeb_Step_sys/Subsystem Reference/AEB Function/Run_AsyEvlrCritEve_Step_Func/Run_AsyEvlrCritEve_Step_Func/TAWrapper/LongitudinalThreatAssessor/SingleTargetThreatAssessor/PrimaryTargetForWarn/RequiredLongitudinalAccelerationComputerForWarn/RequiredLongitudinalAccelerationCalculator/CalculateRequiredAcceleration/AlgorithmChooser" /begin REF_CHARACTERISTIC CLTS_TiUpprLimInAsyEvlrCritEve_Ca /end REF_CHARACTERISTIC /begin REF_MEASUREMENT autosar_swc_aeb_rtARID_DEF.ALgtRqrd_j /end REF_MEASUREMENT /end GROUP
/begin GROUP autosar_swc_aeb_autosar_swc_aeb_Step_sys_Subsystem_Reference_AEB_Function_Run_AsyEvlrCritEve_Step_Func_Run_AsyEvlrCritEve_Step_Func_TAWrapper_LongitudinalThreatAssessor_SingleTargetThreatAssessor_PrimaryTargetForWarn_RequiredLongitudinalAccelerationComputerForWarn_RequiredLongitudinalAccelerationCalculator_CalculateRequiredAcceleration_AlgorithmChooser_CheckIfObjectWillEnterPath "autosar_swc_aeb/autosar_swc_aeb_Step_sys/Subsystem Reference/AEB Function/Run_AsyEvlrCritEve_Step_Func/Run_AsyEvlrCritEve_Step_Func/TAWrapper/LongitudinalThreatAssessor/SingleTargetThreatAssessor/PrimaryTargetForWarn/RequiredLongitudinalAccelerationComputerForWarn/RequiredLongitudinalAccelerationCalculator/CalculateRequiredAcceleration/AlgorithmChooser/CheckIfObjectWillEnterPath" /begin REF_CHARACTERISTIC CLTS_TiUpprLimInAsyEvlrCritEve_Ca /end REF_CHARACTERISTIC /end GROUP
/begin GROUP autosar_swc_aeb_autosar_swc_aeb_Step_sys_Subsystem_Reference_AEB_Function_Run_AsyEvlrCritEve_Step_Func_Run_AsyEvlrCritEve_Step_Func_TAWrapper_LongitudinalThreatAssessor_SingleTargetThreatAssessor_PrimaryTargetForWarn_RequiredLongitudinalAccelerationComputerForWarn_RequiredLongitudinalAccelerationCalculator_CalculateRequiredAcceleration_RequiredAccelerationForInPathObject_ObjectIsBraking_ObjectStopsBeforeCollision_ObjectNotStoppingBeforeTTR "autosar_swc_aeb/autosar_swc_aeb_Step_sys/Subsystem Reference/AEB Function/Run_AsyEvlrCritEve_Step_Func/Run_AsyEvlrCritEve_Step_Func/TAWrapper/LongitudinalThreatAssessor/SingleTargetThreatAssessor/PrimaryTargetForWarn/RequiredLongitudinalAccelerationComputerForWarn/RequiredLongitudinalAccelerationCalculator/CalculateRequiredAcceleration/RequiredAccelerationForInPathObject/ObjectIsBraking/ObjectStopsBeforeCollision/ObjectNotStoppingBeforeTTR" /begin REF_CHARACTERISTIC CLTS_ALowrLimInAsyEvlrCritEve_Ca /end REF_CHARACTERISTIC /end GROUP
/begin GROUP autosar_swc_aeb_autosar_swc_aeb_Step_sys_Subsystem_Reference_AEB_Function_Run_AsyEvlrCritEve_Step_Func_Run_AsyEvlrCritEve_Step_Func_TAWrapper_LongitudinalThreatAssessor_SingleTargetThreatAssessor_PrimaryTargetForWarn_RequiredLongitudinalAccelerationComputerForWarn_TranslateAndRotateCoordSys "autosar_swc_aeb/autosar_swc_aeb_Step_sys/Subsystem Reference/AEB Function/Run_AsyEvlrCritEve_Step_Func/Run_AsyEvlrCritEve_Step_Func/TAWrapper/LongitudinalThreatAssessor/SingleTargetThreatAssessor/PrimaryTargetForWarn/RequiredLongitudinalAccelerationComputerForWarn/TranslateAndRotateCoordSys"
 /begin REF_CHARACTERISTIC CLTS_ObjSpdThdLatInAsyEvlrCritEve_Ca CLTS_ObjSpdThdLgtInAsyEvlrCritEve_Ca /end REF_CHARACTERISTIC
/end GROUP
/begin GROUP autosar_swc_aeb_autosar_swc_aeb_Step_sys_Subsystem_Reference_AEB_Function_Run_AsyEvlrCritEve_Step_Func_Run_AsyEvlrCritEve_Step_Func_TAWrapper_LongitudinalThreatAssessor_ThreatAssessorForIntv_ThreatAssessor_CreateMtnRqrdIntv "autosar_swc_aeb/autosar_swc_aeb_Step_sys/Subsystem Reference/AEB Function/Run_AsyEvlrCritEve_Step_Func/Run_AsyEvlrCritEve_Step_Func/TAWrapper/LongitudinalThreatAssessor/ThreatAssessorForIntv/ThreatAssessor/CreateMtnRqrdIntv"
 /begin REF_CHARACTERISTIC CLTS_ALowrLimInAsyEvlrCritEve_Ca CLTS_AUpprLimInAsyEvlrCritEve_Ca /end REF_CHARACTERISTIC
/end GROUP
/begin GROUP autosar_swc_aeb_autosar_swc_aeb_Step_sys_Subsystem_Reference_AEB_Function_Run_AsyEvlrCritEve_Step_Func_Run_AsyEvlrCritEve_Step_Func_TAWrapper_LongitudinalThreatAssessor_ThreatAssessorForIntv_ThreatAssessor_DefaultValues "autosar_swc_aeb/autosar_swc_aeb_Step_sys/Subsystem Reference/AEB Function/Run_AsyEvlrCritEve_Step_Func/Run_AsyEvlrCritEve_Step_Func/TAWrapper/LongitudinalThreatAssessor/ThreatAssessorForIntv/ThreatAssessor/DefaultValues" /begin REF_CHARACTERISTIC CLTS_AUpprLimInAsyEvlrCritEve_Ca /end REF_CHARACTERISTIC /end GROUP
/begin GROUP autosar_swc_aeb_autosar_swc_aeb_Step_sys_Subsystem_Reference_AEB_Function_Run_AsyEvlrCritEve_Step_Func_Run_AsyEvlrCritEve_Step_Func_TAWrapper_LongitudinalThreatAssessor_ThreatAssessorForIntv_ThreatAssessor_FindHighestThreat_SimpleLateralAccelerationEstimator1_CalculateRequiredALat "autosar_swc_aeb/autosar_swc_aeb_Step_sys/Subsystem Reference/AEB Function/Run_AsyEvlrCritEve_Step_Func/Run_AsyEvlrCritEve_Step_Func/TAWrapper/LongitudinalThreatAssessor/ThreatAssessorForIntv/ThreatAssessor/FindHighestThreat/SimpleLateralAccelerationEstimator1/CalculateRequiredALat" /begin REF_CHARACTERISTIC CLTS_DstMaxLatMovmtInAsyEvlrCritEve_Ca /end REF_CHARACTERISTIC /end GROUP
/begin GROUP autosar_swc_aeb_autosar_swc_aeb_Step_sys_Subsystem_Reference_AEB_Function_Run_AsyEvlrCritEve_Step_Func_Run_AsyEvlrCritEve_Step_Func_TAWrapper_LongitudinalThreatAssessor_ThreatAssessorForIntv_ThreatAssessor_FindHighestThreat_SimpleLateralAccelerationEstimator_CalculateRequiredALat "autosar_swc_aeb/autosar_swc_aeb_Step_sys/Subsystem Reference/AEB Function/Run_AsyEvlrCritEve_Step_Func/Run_AsyEvlrCritEve_Step_Func/TAWrapper/LongitudinalThreatAssessor/ThreatAssessorForIntv/ThreatAssessor/FindHighestThreat/SimpleLateralAccelerationEstimator/CalculateRequiredALat" /begin REF_CHARACTERISTIC CLTS_DstMaxLatMovmtInAsyEvlrCritEve_Ca /end REF_CHARACTERISTIC /end GROUP
/begin GROUP autosar_swc_aeb_autosar_swc_aeb_Step_sys_Subsystem_Reference_AEB_Function_Run_AsyEvlrCritEve_Step_Func_Run_AsyEvlrCritEve_Step_Func_TAWrapper_LongitudinalThreatAssessor_ThreatAssessorForIntv_ThreatAssessor_LTAPAssessor_CreateHostAndObjectData_TransformObject_TransformLinearObject "autosar_swc_aeb/autosar_swc_aeb_Step_sys/Subsystem Reference/AEB Function/Run_AsyEvlrCritEve_Step_Func/Run_AsyEvlrCritEve_Step_Func/TAWrapper/LongitudinalThreatAssessor/ThreatAssessorForIntv/ThreatAssessor/LTAPAssessor/CreateHostAndObjectData/TransformObject/TransformLinearObject"
 /begin REF_CHARACTERISTIC CLTS_ObjSpdThdLatInAsyEvlrCritEve_Ca CLTS_ObjSpdThdLgtInAsyEvlrCritEve_Ca /end REF_CHARACTERISTIC
/end GROUP
/begin GROUP autosar_swc_aeb_autosar_swc_aeb_Step_sys_Subsystem_Reference_AEB_Function_Run_AsyEvlrCritEve_Step_Func_Run_AsyEvlrCritEve_Step_Func_TAWrapper_LongitudinalThreatAssessor_ThreatAssessorForIntv_ThreatAssessor_LTAPAssessor_ThreatAssessment_EstimateObjectLongPosInPath "autosar_swc_aeb/autosar_swc_aeb_Step_sys/Subsystem Reference/AEB Function/Run_AsyEvlrCritEve_Step_Func/Run_AsyEvlrCritEve_Step_Func/TAWrapper/LongitudinalThreatAssessor/ThreatAssessorForIntv/ThreatAssessor/LTAPAssessor/ThreatAssessment/EstimateObjectLongPosInPath" /begin REF_CHARACTERISTIC CLTS_DstUpprLimInAsyEvlrCritEve_Ca /end REF_CHARACTERISTIC /end GROUP
/begin GROUP autosar_swc_aeb_autosar_swc_aeb_Step_sys_Subsystem_Reference_AEB_Function_Run_AsyEvlrCritEve_Step_Func_Run_AsyEvlrCritEve_Step_Func_TAWrapper_LongitudinalThreatAssessor_ThreatAssessorForWarn_ThreatAssessor "autosar_swc_aeb/autosar_swc_aeb_Step_sys/Subsystem Reference/AEB Function/Run_AsyEvlrCritEve_Step_Func/Run_AsyEvlrCritEve_Step_Func/TAWrapper/LongitudinalThreatAssessor/ThreatAssessorForWarn/ThreatAssessor"
 /begin REF_CHARACTERISTIC CLTS_ALowrLimInAsyEvlrCritEve_Ca CLTS_AUpprLimInAsyEvlrCritEve_Ca /end REF_CHARACTERISTIC
 /begin REF_MEASUREMENT autosar_swc_aeb_rtARID_DEF.MinALgtRqrd /end REF_MEASUREMENT
/end GROUP
/begin GROUP autosar_swc_aeb_autosar_swc_aeb_Step_sys_Subsystem_Reference_AEB_Function_Run_AsyEvlrCritEve_Step_Func_Run_AsyEvlrCritEve_Step_Func_TAWrapper_LongitudinalThreatAssessor_ThreatAssessorForWarn_ThreatAssessor_RequiredLongitudinalAccelerationForIntv_CheckPredictionValidity_CheckConfidenceForHeading "autosar_swc_aeb/autosar_swc_aeb_Step_sys/Subsystem Reference/AEB Function/Run_AsyEvlrCritEve_Step_Func/Run_AsyEvlrCritEve_Step_Func/TAWrapper/LongitudinalThreatAssessor/ThreatAssessorForWarn/ThreatAssessor/RequiredLongitudinalAccelerationForIntv/CheckPredictionValidity/CheckConfidenceForHeading" /begin REF_CHARACTERISTIC CLTS_ObjSpdThdForAgDirVldInAsyEvlrCritEve_Ca /end REF_CHARACTERISTIC /end GROUP
/begin GROUP autosar_swc_aeb_autosar_swc_aeb_Step_sys_Subsystem_Reference_AEB_Function_Run_AsyEvlrCritEve_Step_Func_Run_AsyEvlrCritEve_Step_Func_TAWrapper_LongitudinalThreatAssessor_ThreatAssessorForWarn_ThreatAssessor_RequiredLongitudinalAccelerationForIntv_CheckPredictionValidity_CheckPredictionDistanceBelowThreshold "autosar_swc_aeb/autosar_swc_aeb_Step_sys/Subsystem Reference/AEB Function/Run_AsyEvlrCritEve_Step_Func/Run_AsyEvlrCritEve_Step_Func/TAWrapper/LongitudinalThreatAssessor/ThreatAssessorForWarn/ThreatAssessor/RequiredLongitudinalAccelerationForIntv/CheckPredictionValidity/CheckPredictionDistanceBelowThreshold" /begin REF_CHARACTERISTIC CLTS_DstPredMaxInAsyEvlrCritEve_Ca /end REF_CHARACTERISTIC /end GROUP
/begin GROUP autosar_swc_aeb_autosar_swc_aeb_Step_sys_Subsystem_Reference_AEB_Function_Run_AsyEvlrCritEve_Step_Func_Run_AsyEvlrCritEve_Step_Func_TAWrapper_LongitudinalThreatAssessor_ThreatAssessorForWarn_ThreatAssessor_RequiredLongitudinalAccelerationForIntv_CheckPredictionValidity_CheckPredictionTimeBelowThreshold "autosar_swc_aeb/autosar_swc_aeb_Step_sys/Subsystem Reference/AEB Function/Run_AsyEvlrCritEve_Step_Func/Run_AsyEvlrCritEve_Step_Func/TAWrapper/LongitudinalThreatAssessor/ThreatAssessorForWarn/ThreatAssessor/RequiredLongitudinalAccelerationForIntv/CheckPredictionValidity/CheckPredictionTimeBelowThreshold" /begin REF_CHARACTERISTIC CLTS_SftyArUpprLimForTiInObjPredInAsyEvlrCritEve_Ca /end REF_CHARACTERISTIC /end GROUP
/begin GROUP autosar_swc_aeb_autosar_swc_aeb_Step_sys_Subsystem_Reference_AEB_Function_Run_AsyEvlrCritEve_Step_Func_Run_AsyEvlrCritEve_Step_Func_TAWrapper_LongitudinalThreatAssessor_ThreatAssessorForWarn_ThreatAssessor_RequiredLongitudinalAccelerationForIntv_CheckPredictionValidity_CheckSpeedAboveThreshold "autosar_swc_aeb/autosar_swc_aeb_Step_sys/Subsystem Reference/AEB Function/Run_AsyEvlrCritEve_Step_Func/Run_AsyEvlrCritEve_Step_Func/TAWrapper/LongitudinalThreatAssessor/ThreatAssessorForWarn/ThreatAssessor/RequiredLongitudinalAccelerationForIntv/CheckPredictionValidity/CheckSpeedAboveThreshold" /begin REF_CHARACTERISTIC CLTS_SpdPredMinInAsyEvlrCritEve_Ca /end REF_CHARACTERISTIC /end GROUP
/begin GROUP autosar_swc_aeb_autosar_swc_aeb_Step_sys_Subsystem_Reference_AEB_Function_Run_AsyEvlrCritEve_Step_Func_Run_AsyEvlrCritEve_Step_Func_TAWrapper_LongitudinalThreatAssessor_ThreatAssessorForWarn_ThreatAssessor_RequiredLongitudinalAccelerationForIntv_RequiredLongitudinalAccelerationCalculator_CalculateLateralTTRandTTP_LateralTTPComputer_LeftClosest "autosar_swc_aeb/autosar_swc_aeb_Step_sys/Subsystem Reference/AEB Function/Run_AsyEvlrCritEve_Step_Func/Run_AsyEvlrCritEve_Step_Func/TAWrapper/LongitudinalThreatAssessor/ThreatAssessorForWarn/ThreatAssessor/RequiredLongitudinalAccelerationForIntv/RequiredLongitudinalAccelerationCalculator/CalculateLateralTTRandTTP/LateralTTPComputer/LeftClosest" /begin REF_CHARACTERISTIC CLTS_TiUpprLimInAsyEvlrCritEve_Ca /end REF_CHARACTERISTIC /end GROUP
/begin GROUP autosar_swc_aeb_autosar_swc_aeb_Step_sys_Subsystem_Reference_AEB_Function_Run_AsyEvlrCritEve_Step_Func_Run_AsyEvlrCritEve_Step_Func_TAWrapper_LongitudinalThreatAssessor_ThreatAssessorForWarn_ThreatAssessor_RequiredLongitudinalAccelerationForIntv_RequiredLongitudinalAccelerationCalculator_CalculateLateralTTRandTTP_LateralTTPComputer_LeftClosest_TimeToIntersectionComputer "autosar_swc_aeb/autosar_swc_aeb_Step_sys/Subsystem Reference/AEB Function/Run_AsyEvlrCritEve_Step_Func/Run_AsyEvlrCritEve_Step_Func/TAWrapper/LongitudinalThreatAssessor/ThreatAssessorForWarn/ThreatAssessor/RequiredLongitudinalAccelerationForIntv/RequiredLongitudinalAccelerationCalculator/CalculateLateralTTRandTTP/LateralTTPComputer/LeftClosest/TimeToIntersectionComputer"
 /begin REF_CHARACTERISTIC CLTS_TiLowrLimInAsyEvlrCritEve_Ca CLTS_TiUpprLimInAsyEvlrCritEve_Ca /end REF_CHARACTERISTIC
/end GROUP
/begin GROUP autosar_swc_aeb_autosar_swc_aeb_Step_sys_Subsystem_Reference_AEB_Function_Run_AsyEvlrCritEve_Step_Func_Run_AsyEvlrCritEve_Step_Func_TAWrapper_LongitudinalThreatAssessor_ThreatAssessorForWarn_ThreatAssessor_RequiredLongitudinalAccelerationForIntv_RequiredLongitudinalAccelerationCalculator_CalculateLateralTTRandTTP_LateralTTPComputer_RightClosest "autosar_swc_aeb/autosar_swc_aeb_Step_sys/Subsystem Reference/AEB Function/Run_AsyEvlrCritEve_Step_Func/Run_AsyEvlrCritEve_Step_Func/TAWrapper/LongitudinalThreatAssessor/ThreatAssessorForWarn/ThreatAssessor/RequiredLongitudinalAccelerationForIntv/RequiredLongitudinalAccelerationCalculator/CalculateLateralTTRandTTP/LateralTTPComputer/RightClosest" /begin REF_CHARACTERISTIC CLTS_TiUpprLimInAsyEvlrCritEve_Ca /end REF_CHARACTERISTIC /end GROUP
/begin GROUP autosar_swc_aeb_autosar_swc_aeb_Step_sys_Subsystem_Reference_AEB_Function_Run_AsyEvlrCritEve_Step_Func_Run_AsyEvlrCritEve_Step_Func_TAWrapper_LongitudinalThreatAssessor_ThreatAssessorForWarn_ThreatAssessor_RequiredLongitudinalAccelerationForIntv_RequiredLongitudinalAccelerationCalculator_CalculateLateralTTRandTTP_LateralTTPComputer_RightClosest_TimeToIntersectionComputer "autosar_swc_aeb/autosar_swc_aeb_Step_sys/Subsystem Reference/AEB Function/Run_AsyEvlrCritEve_Step_Func/Run_AsyEvlrCritEve_Step_Func/TAWrapper/LongitudinalThreatAssessor/ThreatAssessorForWarn/ThreatAssessor/RequiredLongitudinalAccelerationForIntv/RequiredLongitudinalAccelerationCalculator/CalculateLateralTTRandTTP/LateralTTPComputer/RightClosest/TimeToIntersectionComputer"
 /begin REF_CHARACTERISTIC CLTS_TiLowrLimInAsyEvlrCritEve_Ca CLTS_TiUpprLimInAsyEvlrCritEve_Ca /end REF_CHARACTERISTIC
/end GROUP
/begin GROUP autosar_swc_aeb_autosar_swc_aeb_Step_sys_Subsystem_Reference_AEB_Function_Run_AsyEvlrCritEve_Step_Func_Run_AsyEvlrCritEve_Step_Func_TAWrapper_LongitudinalThreatAssessor_ThreatAssessorForWarn_ThreatAssessor_RequiredLongitudinalAccelerationForIntv_RequiredLongitudinalAccelerationCalculator_CalculateLateralTTRandTTP_LateralTTRComputer_LeftClosest "autosar_swc_aeb/autosar_swc_aeb_Step_sys/Subsystem Reference/AEB Function/Run_AsyEvlrCritEve_Step_Func/Run_AsyEvlrCritEve_Step_Func/TAWrapper/LongitudinalThreatAssessor/ThreatAssessorForWarn/ThreatAssessor/RequiredLongitudinalAccelerationForIntv/RequiredLongitudinalAccelerationCalculator/CalculateLateralTTRandTTP/LateralTTRComputer/LeftClosest" /begin REF_CHARACTERISTIC CLTS_TiUpprLimInAsyEvlrCritEve_Ca /end REF_CHARACTERISTIC /end GROUP
/begin GROUP autosar_swc_aeb_autosar_swc_aeb_Step_sys_Subsystem_Reference_AEB_Function_Run_AsyEvlrCritEve_Step_Func_Run_AsyEvlrCritEve_Step_Func_TAWrapper_LongitudinalThreatAssessor_ThreatAssessorForWarn_ThreatAssessor_RequiredLongitudinalAccelerationForIntv_RequiredLongitudinalAccelerationCalculator_CalculateLateralTTRandTTP_LateralTTRComputer_LeftClosest_TimeToIntersectionComputer "autosar_swc_aeb/autosar_swc_aeb_Step_sys/Subsystem Reference/AEB Function/Run_AsyEvlrCritEve_Step_Func/Run_AsyEvlrCritEve_Step_Func/TAWrapper/LongitudinalThreatAssessor/ThreatAssessorForWarn/ThreatAssessor/RequiredLongitudinalAccelerationForIntv/RequiredLongitudinalAccelerationCalculator/CalculateLateralTTRandTTP/LateralTTRComputer/LeftClosest/TimeToIntersectionComputer"
 /begin REF_CHARACTERISTIC CLTS_TiLowrLimInAsyEvlrCritEve_Ca CLTS_TiUpprLimInAsyEvlrCritEve_Ca /end REF_CHARACTERISTIC
/end GROUP
/begin GROUP autosar_swc_aeb_autosar_swc_aeb_Step_sys_Subsystem_Reference_AEB_Function_Run_AsyEvlrCritEve_Step_Func_Run_AsyEvlrCritEve_Step_Func_TAWrapper_LongitudinalThreatAssessor_ThreatAssessorForWarn_ThreatAssessor_RequiredLongitudinalAccelerationForIntv_RequiredLongitudinalAccelerationCalculator_CalculateLateralTTRandTTP_LateralTTRComputer_RightClosest "autosar_swc_aeb/autosar_swc_aeb_Step_sys/Subsystem Reference/AEB Function/Run_AsyEvlrCritEve_Step_Func/Run_AsyEvlrCritEve_Step_Func/TAWrapper/LongitudinalThreatAssessor/ThreatAssessorForWarn/ThreatAssessor/RequiredLongitudinalAccelerationForIntv/RequiredLongitudinalAccelerationCalculator/CalculateLateralTTRandTTP/LateralTTRComputer/RightClosest" /begin REF_CHARACTERISTIC CLTS_TiUpprLimInAsyEvlrCritEve_Ca /end REF_CHARACTERISTIC /end GROUP
/begin GROUP autosar_swc_aeb_autosar_swc_aeb_Step_sys_Subsystem_Reference_AEB_Function_Run_AsyEvlrCritEve_Step_Func_Run_AsyEvlrCritEve_Step_Func_TAWrapper_LongitudinalThreatAssessor_ThreatAssessorForWarn_ThreatAssessor_RequiredLongitudinalAccelerationForIntv_RequiredLongitudinalAccelerationCalculator_CalculateLateralTTRandTTP_LateralTTRComputer_RightClosest_TimeToIntersectionComputer "autosar_swc_aeb/autosar_swc_aeb_Step_sys/Subsystem Reference/AEB Function/Run_AsyEvlrCritEve_Step_Func/Run_AsyEvlrCritEve_Step_Func/TAWrapper/LongitudinalThreatAssessor/ThreatAssessorForWarn/ThreatAssessor/RequiredLongitudinalAccelerationForIntv/RequiredLongitudinalAccelerationCalculator/CalculateLateralTTRandTTP/LateralTTRComputer/RightClosest/TimeToIntersectionComputer"
 /begin REF_CHARACTERISTIC CLTS_TiLowrLimInAsyEvlrCritEve_Ca CLTS_TiUpprLimInAsyEvlrCritEve_Ca /end REF_CHARACTERISTIC
/end GROUP
/begin GROUP autosar_swc_aeb_autosar_swc_aeb_Step_sys_Subsystem_Reference_AEB_Function_Run_AsyEvlrCritEve_Step_Func_Run_AsyEvlrCritEve_Step_Func_TAWrapper_LongitudinalThreatAssessor_ThreatAssessorForWarn_ThreatAssessor_RequiredLongitudinalAccelerationForIntv_RequiredLongitudinalAccelerationCalculator_CalculateLateralTTRandTTP_ModifyTTPAtSameSpeedAndAcceleration "autosar_swc_aeb/autosar_swc_aeb_Step_sys/Subsystem Reference/AEB Function/Run_AsyEvlrCritEve_Step_Func/Run_AsyEvlrCritEve_Step_Func/TAWrapper/LongitudinalThreatAssessor/ThreatAssessorForWarn/ThreatAssessor/RequiredLongitudinalAccelerationForIntv/RequiredLongitudinalAccelerationCalculator/CalculateLateralTTRandTTP/ModifyTTPAtSameSpeedAndAcceleration" /begin REF_CHARACTERISTIC CLTS_TiUpprLimInAsyEvlrCritEve_Ca /end REF_CHARACTERISTIC /end GROUP
/begin GROUP autosar_swc_aeb_autosar_swc_aeb_Step_sys_Subsystem_Reference_AEB_Function_Run_AsyEvlrCritEve_Step_Func_Run_AsyEvlrCritEve_Step_Func_TAWrapper_LongitudinalThreatAssessor_ThreatAssessorForWarn_ThreatAssessor_RequiredLongitudinalAccelerationForIntv_RequiredLongitudinalAccelerationCalculator_CalculateLateralTTRandTTP_ModifyTTRAtSameSpeedAndAcceleration "autosar_swc_aeb/autosar_swc_aeb_Step_sys/Subsystem Reference/AEB Function/Run_AsyEvlrCritEve_Step_Func/Run_AsyEvlrCritEve_Step_Func/TAWrapper/LongitudinalThreatAssessor/ThreatAssessorForWarn/ThreatAssessor/RequiredLongitudinalAccelerationForIntv/RequiredLongitudinalAccelerationCalculator/CalculateLateralTTRandTTP/ModifyTTRAtSameSpeedAndAcceleration"
 /begin REF_CHARACTERISTIC CLTS_TiLowrLimInAsyEvlrCritEve_Ca CLTS_TiUpprLimInAsyEvlrCritEve_Ca /end REF_CHARACTERISTIC
/end GROUP
/begin GROUP autosar_swc_aeb_autosar_swc_aeb_Step_sys_Subsystem_Reference_AEB_Function_Run_AsyEvlrCritEve_Step_Func_Run_AsyEvlrCritEve_Step_Func_TAWrapper_LongitudinalThreatAssessor_ThreatAssessorForWarn_ThreatAssessor_RequiredLongitudinalAccelerationForIntv_RequiredLongitudinalAccelerationCalculator_CalculateRequiredAcceleration_AlgorithmChooser "autosar_swc_aeb/autosar_swc_aeb_Step_sys/Subsystem Reference/AEB Function/Run_AsyEvlrCritEve_Step_Func/Run_AsyEvlrCritEve_Step_Func/TAWrapper/LongitudinalThreatAssessor/ThreatAssessorForWarn/ThreatAssessor/RequiredLongitudinalAccelerationForIntv/RequiredLongitudinalAccelerationCalculator/CalculateRequiredAcceleration/AlgorithmChooser" /begin REF_CHARACTERISTIC CLTS_TiUpprLimInAsyEvlrCritEve_Ca /end REF_CHARACTERISTIC /end GROUP
/begin GROUP autosar_swc_aeb_autosar_swc_aeb_Step_sys_Subsystem_Reference_AEB_Function_Run_AsyEvlrCritEve_Step_Func_Run_AsyEvlrCritEve_Step_Func_TAWrapper_LongitudinalThreatAssessor_ThreatAssessorForWarn_ThreatAssessor_RequiredLongitudinalAccelerationForIntv_RequiredLongitudinalAccelerationCalculator_CalculateRequiredAcceleration_AlgorithmChooser_CheckIfObjectWillEnterPath "autosar_swc_aeb/autosar_swc_aeb_Step_sys/Subsystem Reference/AEB Function/Run_AsyEvlrCritEve_Step_Func/Run_AsyEvlrCritEve_Step_Func/TAWrapper/LongitudinalThreatAssessor/ThreatAssessorForWarn/ThreatAssessor/RequiredLongitudinalAccelerationForIntv/RequiredLongitudinalAccelerationCalculator/CalculateRequiredAcceleration/AlgorithmChooser/CheckIfObjectWillEnterPath" /begin REF_CHARACTERISTIC CLTS_TiUpprLimInAsyEvlrCritEve_Ca /end REF_CHARACTERISTIC /end GROUP
/begin GROUP autosar_swc_aeb_autosar_swc_aeb_Step_sys_Subsystem_Reference_AEB_Function_Run_AsyEvlrCritEve_Step_Func_Run_AsyEvlrCritEve_Step_Func_TAWrapper_LongitudinalThreatAssessor_ThreatAssessorForWarn_ThreatAssessor_RequiredLongitudinalAccelerationForIntv_RequiredLongitudinalAccelerationCalculator_CalculateRequiredAcceleration_RequiredAccelerationForInPathObject_ObjectIsBraking_ObjectStopsBeforeCollision_ObjectNotStoppingBeforeTTR "autosar_swc_aeb/autosar_swc_aeb_Step_sys/Subsystem Reference/AEB Function/Run_AsyEvlrCritEve_Step_Func/Run_AsyEvlrCritEve_Step_Func/TAWrapper/LongitudinalThreatAssessor/ThreatAssessorForWarn/ThreatAssessor/RequiredLongitudinalAccelerationForIntv/RequiredLongitudinalAccelerationCalculator/CalculateRequiredAcceleration/RequiredAccelerationForInPathObject/ObjectIsBraking/ObjectStopsBeforeCollision/ObjectNotStoppingBeforeTTR" /begin REF_CHARACTERISTIC CLTS_ALowrLimInAsyEvlrCritEve_Ca /end REF_CHARACTERISTIC /end GROUP
/begin GROUP autosar_swc_aeb_autosar_swc_aeb_Step_sys_Subsystem_Reference_AEB_Function_Run_AsyEvlrCritEve_Step_Func_Run_AsyEvlrCritEve_Step_Func_TAWrapper_LongitudinalThreatAssessor_ThreatAssessorForWarn_ThreatAssessor_RequiredLongitudinalAccelerationForIntv_TranslateAndRotateCoordSys "autosar_swc_aeb/autosar_swc_aeb_Step_sys/Subsystem Reference/AEB Function/Run_AsyEvlrCritEve_Step_Func/Run_AsyEvlrCritEve_Step_Func/TAWrapper/LongitudinalThreatAssessor/ThreatAssessorForWarn/ThreatAssessor/RequiredLongitudinalAccelerationForIntv/TranslateAndRotateCoordSys"
 /begin REF_CHARACTERISTIC CLTS_ObjSpdThdLatInAsyEvlrCritEve_Ca CLTS_ObjSpdThdLgtInAsyEvlrCritEve_Ca /end REF_CHARACTERISTIC
/end GROUP
/begin GROUP autosar_swc_aeb_autosar_swc_aeb_Step_sys_Subsystem_Reference_AEB_Function_Run_AsyEvlrCritEve_Step_Func_Run_AsyEvlrCritEve_Step_Func_TAWrapper_LongitudinalThreatAssessor_ThreatAssessorForWarn_ThreatAssessor_SimpleLateralAccelerationEstimator_CalculateRequiredALat "autosar_swc_aeb/autosar_swc_aeb_Step_sys/Subsystem Reference/AEB Function/Run_AsyEvlrCritEve_Step_Func/Run_AsyEvlrCritEve_Step_Func/TAWrapper/LongitudinalThreatAssessor/ThreatAssessorForWarn/ThreatAssessor/SimpleLateralAccelerationEstimator/CalculateRequiredALat" /begin REF_CHARACTERISTIC CLTS_DstMaxLatMovmtInAsyEvlrCritEve_Ca /end REF_CHARACTERISTIC /end GROUP
/begin GROUP autosar_swc_aeb_autosar_swc_aeb_Step_sys_Subsystem_Reference_AEB_Function_Run_AsyEvlrCritEve_Step_Func_Run_AsyEvlrCritEve_Step_Func_TAWrapper_LongitudinalThreatAssessor_ThreatAssessorForWarn_ThreatFoundAndValidObj "autosar_swc_aeb/autosar_swc_aeb_Step_sys/Subsystem Reference/AEB Function/Run_AsyEvlrCritEve_Step_Func/Run_AsyEvlrCritEve_Step_Func/TAWrapper/LongitudinalThreatAssessor/ThreatAssessorForWarn/ThreatFoundAndValidObj" /begin REF_MEASUREMENT autosar_swc_aeb_rtARID_DEF.ThreatFoundForWarn /end REF_MEASUREMENT /end GROUP
/begin GROUP autosar_swc_aeb_autosar_swc_aeb_Step_sys_Subsystem_Reference_AEB_Function_Run_AsyEvlrCritEve_Step_Func_Run_AsyEvlrCritEve_Step_Func_TAWrapper_PreProcessor_ObjectPreProcessor_ObjectPreProcessorLoop_InvalidObject_DefaultObjData "autosar_swc_aeb/autosar_swc_aeb_Step_sys/Subsystem Reference/AEB Function/Run_AsyEvlrCritEve_Step_Func/Run_AsyEvlrCritEve_Step_Func/TAWrapper/PreProcessor/ObjectPreProcessor/ObjectPreProcessorLoop/InvalidObject/DefaultObjData" /begin REF_CHARACTERISTIC CLTS_TiUpprLimInAsyEvlrCritEve_Ca /end REF_CHARACTERISTIC /end GROUP
/begin GROUP autosar_swc_aeb_autosar_swc_aeb_Step_sys_Subsystem_Reference_AEB_Function_Run_AsyEvlrCritEve_Step_Func_Run_AsyEvlrCritEve_Step_Func_TAWrapper_PreProcessor_ObjectPreProcessor_ObjectPreProcessorLoop_ValidObject_CalculateTTRAndTTM "autosar_swc_aeb/autosar_swc_aeb_Step_sys/Subsystem Reference/AEB Function/Run_AsyEvlrCritEve_Step_Func/Run_AsyEvlrCritEve_Step_Func/TAWrapper/PreProcessor/ObjectPreProcessor/ObjectPreProcessorLoop/ValidObject/CalculateTTRAndTTM"
 /begin REF_CHARACTERISTIC CLTS_TiLowrLimInAsyEvlrCritEve_Ca CLTS_TiUpprLimInAsyEvlrCritEve_Ca /end REF_CHARACTERISTIC
/end GROUP
/begin GROUP autosar_swc_aeb_autosar_swc_aeb_Step_sys_Subsystem_Reference_AEB_Function_Run_AsyEvlrCritEve_Step_Func_Run_AsyEvlrCritEve_Step_Func_TAWrapper_PreProcessor_ObjectPreProcessor_ObjectPreProcessorLoop_ValidObject_CalculateTTRAndTTM_LongitudinalTTMComputer_CalculateTTI_HostAndObjectMoving "autosar_swc_aeb/autosar_swc_aeb_Step_sys/Subsystem Reference/AEB Function/Run_AsyEvlrCritEve_Step_Func/Run_AsyEvlrCritEve_Step_Func/TAWrapper/PreProcessor/ObjectPreProcessor/ObjectPreProcessorLoop/ValidObject/CalculateTTRAndTTM/LongitudinalTTMComputer/CalculateTTI/HostAndObjectMoving" /begin REF_CHARACTERISTIC CLTS_TiUpprLimInAsyEvlrCritEve_Ca /end REF_CHARACTERISTIC /end GROUP
/begin GROUP autosar_swc_aeb_autosar_swc_aeb_Step_sys_Subsystem_Reference_AEB_Function_Run_AsyEvlrCritEve_Step_Func_Run_AsyEvlrCritEve_Step_Func_TAWrapper_PreProcessor_ObjectPreProcessor_ObjectPreProcessorLoop_ValidObject_CalculateTTRAndTTM_LongitudinalTTMComputer_CalculateTTI_HostAndObjectMoving_TimeToIntersectionComputer "autosar_swc_aeb/autosar_swc_aeb_Step_sys/Subsystem Reference/AEB Function/Run_AsyEvlrCritEve_Step_Func/Run_AsyEvlrCritEve_Step_Func/TAWrapper/PreProcessor/ObjectPreProcessor/ObjectPreProcessorLoop/ValidObject/CalculateTTRAndTTM/LongitudinalTTMComputer/CalculateTTI/HostAndObjectMoving/TimeToIntersectionComputer"
 /begin REF_CHARACTERISTIC CLTS_TiLowrLimInAsyEvlrCritEve_Ca CLTS_TiUpprLimInAsyEvlrCritEve_Ca /end REF_CHARACTERISTIC
/end GROUP
/begin GROUP autosar_swc_aeb_autosar_swc_aeb_Step_sys_Subsystem_Reference_AEB_Function_Run_AsyEvlrCritEve_Step_Func_Run_AsyEvlrCritEve_Step_Func_TAWrapper_PreProcessor_ObjectPreProcessor_ObjectPreProcessorLoop_ValidObject_CalculateTTRAndTTM_LongitudinalTTMComputer_CalculateTTI_StationaryHost "autosar_swc_aeb/autosar_swc_aeb_Step_sys/Subsystem Reference/AEB Function/Run_AsyEvlrCritEve_Step_Func/Run_AsyEvlrCritEve_Step_Func/TAWrapper/PreProcessor/ObjectPreProcessor/ObjectPreProcessorLoop/ValidObject/CalculateTTRAndTTM/LongitudinalTTMComputer/CalculateTTI/StationaryHost" /begin REF_CHARACTERISTIC CLTS_TiUpprLimInAsyEvlrCritEve_Ca /end REF_CHARACTERISTIC /end GROUP
/begin GROUP autosar_swc_aeb_autosar_swc_aeb_Step_sys_Subsystem_Reference_AEB_Function_Run_AsyEvlrCritEve_Step_Func_Run_AsyEvlrCritEve_Step_Func_TAWrapper_PreProcessor_ObjectPreProcessor_ObjectPreProcessorLoop_ValidObject_CalculateTTRAndTTM_LongitudinalTTMComputer_CalculateTTI_StationaryHost_TimeToIntersectionComputer "autosar_swc_aeb/autosar_swc_aeb_Step_sys/Subsystem Reference/AEB Function/Run_AsyEvlrCritEve_Step_Func/Run_AsyEvlrCritEve_Step_Func/TAWrapper/PreProcessor/ObjectPreProcessor/ObjectPreProcessorLoop/ValidObject/CalculateTTRAndTTM/LongitudinalTTMComputer/CalculateTTI/StationaryHost/TimeToIntersectionComputer"
 /begin REF_CHARACTERISTIC CLTS_TiLowrLimInAsyEvlrCritEve_Ca CLTS_TiUpprLimInAsyEvlrCritEve_Ca /end REF_CHARACTERISTIC
/end GROUP
/begin GROUP autosar_swc_aeb_autosar_swc_aeb_Step_sys_Subsystem_Reference_AEB_Function_Run_AsyEvlrCritEve_Step_Func_Run_AsyEvlrCritEve_Step_Func_TAWrapper_PreProcessor_ObjectPreProcessor_ObjectPreProcessorLoop_ValidObject_CalculateTTRAndTTM_LongitudinalTTMComputer_CalculateTTI_StationaryObject "autosar_swc_aeb/autosar_swc_aeb_Step_sys/Subsystem Reference/AEB Function/Run_AsyEvlrCritEve_Step_Func/Run_AsyEvlrCritEve_Step_Func/TAWrapper/PreProcessor/ObjectPreProcessor/ObjectPreProcessorLoop/ValidObject/CalculateTTRAndTTM/LongitudinalTTMComputer/CalculateTTI/StationaryObject" /begin REF_CHARACTERISTIC CLTS_TiUpprLimInAsyEvlrCritEve_Ca /end REF_CHARACTERISTIC /end GROUP
/begin GROUP autosar_swc_aeb_autosar_swc_aeb_Step_sys_Subsystem_Reference_AEB_Function_Run_AsyEvlrCritEve_Step_Func_Run_AsyEvlrCritEve_Step_Func_TAWrapper_PreProcessor_ObjectPreProcessor_ObjectPreProcessorLoop_ValidObject_CalculateTTRAndTTM_LongitudinalTTMComputer_CalculateTTI_StationaryObject_TimeToIntersectionComputer "autosar_swc_aeb/autosar_swc_aeb_Step_sys/Subsystem Reference/AEB Function/Run_AsyEvlrCritEve_Step_Func/Run_AsyEvlrCritEve_Step_Func/TAWrapper/PreProcessor/ObjectPreProcessor/ObjectPreProcessorLoop/ValidObject/CalculateTTRAndTTM/LongitudinalTTMComputer/CalculateTTI/StationaryObject/TimeToIntersectionComputer"
 /begin REF_CHARACTERISTIC CLTS_TiLowrLimInAsyEvlrCritEve_Ca CLTS_TiUpprLimInAsyEvlrCritEve_Ca /end REF_CHARACTERISTIC
/end GROUP
/begin GROUP autosar_swc_aeb_autosar_swc_aeb_Step_sys_Subsystem_Reference_AEB_Function_Run_AsyEvlrCritEve_Step_Func_Run_AsyEvlrCritEve_Step_Func_TAWrapper_PreProcessor_ObjectPreProcessor_ObjectPreProcessorLoop_ValidObject_CalculateTTRAndTTM_LongitudinalTTMComputer_SelectTTI_CheckIfVehicleStops "autosar_swc_aeb/autosar_swc_aeb_Step_sys/Subsystem Reference/AEB Function/Run_AsyEvlrCritEve_Step_Func/Run_AsyEvlrCritEve_Step_Func/TAWrapper/PreProcessor/ObjectPreProcessor/ObjectPreProcessorLoop/ValidObject/CalculateTTRAndTTM/LongitudinalTTMComputer/SelectTTI/CheckIfVehicleStops" /begin REF_CHARACTERISTIC CLTS_SftyArUpprLimForTiInObjPredInAsyEvlrCritEve_Ca /end REF_CHARACTERISTIC /end GROUP
/begin GROUP autosar_swc_aeb_autosar_swc_aeb_Step_sys_Subsystem_Reference_AEB_Function_Run_AsyEvlrCritEve_Step_Func_Run_AsyEvlrCritEve_Step_Func_TAWrapper_PreProcessor_ObjectPreProcessor_ObjectPreProcessorLoop_ValidObject_CalculateTTRAndTTM_LongitudinalTTMComputer_SelectTTI_CheckIfVehicleStops1 "autosar_swc_aeb/autosar_swc_aeb_Step_sys/Subsystem Reference/AEB Function/Run_AsyEvlrCritEve_Step_Func/Run_AsyEvlrCritEve_Step_Func/TAWrapper/PreProcessor/ObjectPreProcessor/ObjectPreProcessorLoop/ValidObject/CalculateTTRAndTTM/LongitudinalTTMComputer/SelectTTI/CheckIfVehicleStops1" /begin REF_CHARACTERISTIC CLTS_SftyArUpprLimForTiInObjPredInAsyEvlrCritEve_Ca /end REF_CHARACTERISTIC /end GROUP
/begin GROUP autosar_swc_aeb_autosar_swc_aeb_Step_sys_Subsystem_Reference_AEB_Function_Run_AsyEvlrCritEve_Step_Func_Run_AsyEvlrCritEve_Step_Func_TAWrapper_PreProcessor_ObjectPreProcessor_ObjectPreProcessorLoop_ValidObject_CalculateTTRAndTTM_LongitudinalTTRComputer_CalculateTTI_HostAndObjectMoving "autosar_swc_aeb/autosar_swc_aeb_Step_sys/Subsystem Reference/AEB Function/Run_AsyEvlrCritEve_Step_Func/Run_AsyEvlrCritEve_Step_Func/TAWrapper/PreProcessor/ObjectPreProcessor/ObjectPreProcessorLoop/ValidObject/CalculateTTRAndTTM/LongitudinalTTRComputer/CalculateTTI/HostAndObjectMoving" /begin REF_CHARACTERISTIC CLTS_TiUpprLimInAsyEvlrCritEve_Ca /end REF_CHARACTERISTIC /end GROUP
/begin GROUP autosar_swc_aeb_autosar_swc_aeb_Step_sys_Subsystem_Reference_AEB_Function_Run_AsyEvlrCritEve_Step_Func_Run_AsyEvlrCritEve_Step_Func_TAWrapper_PreProcessor_ObjectPreProcessor_ObjectPreProcessorLoop_ValidObject_CalculateTTRAndTTM_LongitudinalTTRComputer_CalculateTTI_HostAndObjectMoving_TimeToIntersectionComputer "autosar_swc_aeb/autosar_swc_aeb_Step_sys/Subsystem Reference/AEB Function/Run_AsyEvlrCritEve_Step_Func/Run_AsyEvlrCritEve_Step_Func/TAWrapper/PreProcessor/ObjectPreProcessor/ObjectPreProcessorLoop/ValidObject/CalculateTTRAndTTM/LongitudinalTTRComputer/CalculateTTI/HostAndObjectMoving/TimeToIntersectionComputer"
 /begin REF_CHARACTERISTIC CLTS_TiLowrLimInAsyEvlrCritEve_Ca CLTS_TiUpprLimInAsyEvlrCritEve_Ca /end REF_CHARACTERISTIC
/end GROUP
/begin GROUP autosar_swc_aeb_autosar_swc_aeb_Step_sys_Subsystem_Reference_AEB_Function_Run_AsyEvlrCritEve_Step_Func_Run_AsyEvlrCritEve_Step_Func_TAWrapper_PreProcessor_ObjectPreProcessor_ObjectPreProcessorLoop_ValidObject_CalculateTTRAndTTM_LongitudinalTTRComputer_CalculateTTI_StationaryHost "autosar_swc_aeb/autosar_swc_aeb_Step_sys/Subsystem Reference/AEB Function/Run_AsyEvlrCritEve_Step_Func/Run_AsyEvlrCritEve_Step_Func/TAWrapper/PreProcessor/ObjectPreProcessor/ObjectPreProcessorLoop/ValidObject/CalculateTTRAndTTM/LongitudinalTTRComputer/CalculateTTI/StationaryHost" /begin REF_CHARACTERISTIC CLTS_TiUpprLimInAsyEvlrCritEve_Ca /end REF_CHARACTERISTIC /end GROUP
/begin GROUP autosar_swc_aeb_autosar_swc_aeb_Step_sys_Subsystem_Reference_AEB_Function_Run_AsyEvlrCritEve_Step_Func_Run_AsyEvlrCritEve_Step_Func_TAWrapper_PreProcessor_ObjectPreProcessor_ObjectPreProcessorLoop_ValidObject_CalculateTTRAndTTM_LongitudinalTTRComputer_CalculateTTI_StationaryHost_TimeToIntersectionComputer "autosar_swc_aeb/autosar_swc_aeb_Step_sys/Subsystem Reference/AEB Function/Run_AsyEvlrCritEve_Step_Func/Run_AsyEvlrCritEve_Step_Func/TAWrapper/PreProcessor/ObjectPreProcessor/ObjectPreProcessorLoop/ValidObject/CalculateTTRAndTTM/LongitudinalTTRComputer/CalculateTTI/StationaryHost/TimeToIntersectionComputer"
 /begin REF_CHARACTERISTIC CLTS_TiLowrLimInAsyEvlrCritEve_Ca CLTS_TiUpprLimInAsyEvlrCritEve_Ca /end REF_CHARACTERISTIC
/end GROUP
/begin GROUP autosar_swc_aeb_autosar_swc_aeb_Step_sys_Subsystem_Reference_AEB_Function_Run_AsyEvlrCritEve_Step_Func_Run_AsyEvlrCritEve_Step_Func_TAWrapper_PreProcessor_ObjectPreProcessor_ObjectPreProcessorLoop_ValidObject_CalculateTTRAndTTM_LongitudinalTTRComputer_CalculateTTI_StationaryObject "autosar_swc_aeb/autosar_swc_aeb_Step_sys/Subsystem Reference/AEB Function/Run_AsyEvlrCritEve_Step_Func/Run_AsyEvlrCritEve_Step_Func/TAWrapper/PreProcessor/ObjectPreProcessor/ObjectPreProcessorLoop/ValidObject/CalculateTTRAndTTM/LongitudinalTTRComputer/CalculateTTI/StationaryObject" /begin REF_CHARACTERISTIC CLTS_TiUpprLimInAsyEvlrCritEve_Ca /end REF_CHARACTERISTIC /end GROUP
/begin GROUP autosar_swc_aeb_autosar_swc_aeb_Step_sys_Subsystem_Reference_AEB_Function_Run_AsyEvlrCritEve_Step_Func_Run_AsyEvlrCritEve_Step_Func_TAWrapper_PreProcessor_ObjectPreProcessor_ObjectPreProcessorLoop_ValidObject_CalculateTTRAndTTM_LongitudinalTTRComputer_CalculateTTI_StationaryObject_TimeToIntersectionComputer "autosar_swc_aeb/autosar_swc_aeb_Step_sys/Subsystem Reference/AEB Function/Run_AsyEvlrCritEve_Step_Func/Run_AsyEvlrCritEve_Step_Func/TAWrapper/PreProcessor/ObjectPreProcessor/ObjectPreProcessorLoop/ValidObject/CalculateTTRAndTTM/LongitudinalTTRComputer/CalculateTTI/StationaryObject/TimeToIntersectionComputer"
 /begin REF_CHARACTERISTIC CLTS_TiLowrLimInAsyEvlrCritEve_Ca CLTS_TiUpprLimInAsyEvlrCritEve_Ca /end REF_CHARACTERISTIC
/end GROUP
/begin GROUP autosar_swc_aeb_autosar_swc_aeb_Step_sys_Subsystem_Reference_AEB_Function_Run_AsyEvlrCritEve_Step_Func_Run_AsyEvlrCritEve_Step_Func_TAWrapper_PreProcessor_ObjectPreProcessor_ObjectPreProcessorLoop_ValidObject_CalculateTTRAndTTM_LongitudinalTTRComputer_SelectTTI_CheckIfVehicleStops "autosar_swc_aeb/autosar_swc_aeb_Step_sys/Subsystem Reference/AEB Function/Run_AsyEvlrCritEve_Step_Func/Run_AsyEvlrCritEve_Step_Func/TAWrapper/PreProcessor/ObjectPreProcessor/ObjectPreProcessorLoop/ValidObject/CalculateTTRAndTTM/LongitudinalTTRComputer/SelectTTI/CheckIfVehicleStops" /begin REF_CHARACTERISTIC CLTS_SftyArUpprLimForTiInObjPredInAsyEvlrCritEve_Ca /end REF_CHARACTERISTIC /end GROUP
/begin GROUP autosar_swc_aeb_autosar_swc_aeb_Step_sys_Subsystem_Reference_AEB_Function_Run_AsyEvlrCritEve_Step_Func_Run_AsyEvlrCritEve_Step_Func_TAWrapper_PreProcessor_ObjectPreProcessor_ObjectPreProcessorLoop_ValidObject_CalculateTTRAndTTM_LongitudinalTTRComputer_SelectTTI_CheckIfVehicleStops1 "autosar_swc_aeb/autosar_swc_aeb_Step_sys/Subsystem Reference/AEB Function/Run_AsyEvlrCritEve_Step_Func/Run_AsyEvlrCritEve_Step_Func/TAWrapper/PreProcessor/ObjectPreProcessor/ObjectPreProcessorLoop/ValidObject/CalculateTTRAndTTM/LongitudinalTTRComputer/SelectTTI/CheckIfVehicleStops1" /begin REF_CHARACTERISTIC CLTS_SftyArUpprLimForTiInObjPredInAsyEvlrCritEve_Ca /end REF_CHARACTERISTIC /end GROUP
/begin GROUP autosar_swc_aeb_autosar_swc_aeb_Step_sys_Subsystem_Reference_AEB_Function_Run_AsyEvlrCritEve_Step_Func_Run_AsyEvlrCritEve_Step_Func_TAWrapper_PreProcessor_ObjectPreProcessor_ObjectPreProcessorLoop_ValidObject_CalculateTTRAndTTM_ModifyTTMAtSameSpeedAndAcceleration "autosar_swc_aeb/autosar_swc_aeb_Step_sys/Subsystem Reference/AEB Function/Run_AsyEvlrCritEve_Step_Func/Run_AsyEvlrCritEve_Step_Func/TAWrapper/PreProcessor/ObjectPreProcessor/ObjectPreProcessorLoop/ValidObject/CalculateTTRAndTTM/ModifyTTMAtSameSpeedAndAcceleration" /begin REF_CHARACTERISTIC CLTS_TiUpprLimInAsyEvlrCritEve_Ca /end REF_CHARACTERISTIC /end GROUP
/begin GROUP autosar_swc_aeb_autosar_swc_aeb_Step_sys_Subsystem_Reference_AEB_Function_Run_AsyEvlrCritEve_Step_Func_Run_AsyEvlrCritEve_Step_Func_TAWrapper_PreProcessor_ObjectPreProcessor_ObjectPreProcessorLoop_ValidObject_CalculateTTRAndTTM_ModifyTTRAtSameSpeedAndAcceleration "autosar_swc_aeb/autosar_swc_aeb_Step_sys/Subsystem Reference/AEB Function/Run_AsyEvlrCritEve_Step_Func/Run_AsyEvlrCritEve_Step_Func/TAWrapper/PreProcessor/ObjectPreProcessor/ObjectPreProcessorLoop/ValidObject/CalculateTTRAndTTM/ModifyTTRAtSameSpeedAndAcceleration"
 /begin REF_CHARACTERISTIC CLTS_TiLowrLimInAsyEvlrCritEve_Ca CLTS_TiUpprLimInAsyEvlrCritEve_Ca /end REF_CHARACTERISTIC
/end GROUP
/begin GROUP autosar_swc_aeb_autosar_swc_aeb_Step_sys_Subsystem_Reference_AEB_Function_Run_AsyEvlrCritEve_Step_Func_Run_AsyEvlrCritEve_Step_Func_TAWrapper_PreProcessor_ObjectPreProcessor_ObjectPreProcessorLoop_ValidObject_CalculateTTRAndTTM_SetCorrectSign1 "autosar_swc_aeb/autosar_swc_aeb_Step_sys/Subsystem Reference/AEB Function/Run_AsyEvlrCritEve_Step_Func/Run_AsyEvlrCritEve_Step_Func/TAWrapper/PreProcessor/ObjectPreProcessor/ObjectPreProcessorLoop/ValidObject/CalculateTTRAndTTM/SetCorrectSign1"
 /begin REF_CHARACTERISTIC CLTS_TiLowrLimInAsyEvlrCritEve_Ca CLTS_TiUpprLimInAsyEvlrCritEve_Ca /end REF_CHARACTERISTIC
/end GROUP
/begin GROUP autosar_swc_aeb_autosar_swc_aeb_Step_sys_Subsystem_Reference_AEB_Function_Run_AsyEvlrCritEve_Step_Func_Run_AsyEvlrCritEve_Step_Func_TAWrapper_PreProcessor_ObjectPreProcessor_ObjectPreProcessorLoop_ValidObject_CalculateTTRAndTTM_SetCorrectSign2 "autosar_swc_aeb/autosar_swc_aeb_Step_sys/Subsystem Reference/AEB Function/Run_AsyEvlrCritEve_Step_Func/Run_AsyEvlrCritEve_Step_Func/TAWrapper/PreProcessor/ObjectPreProcessor/ObjectPreProcessorLoop/ValidObject/CalculateTTRAndTTM/SetCorrectSign2"
 /begin REF_CHARACTERISTIC CLTS_TiLowrLimInAsyEvlrCritEve_Ca CLTS_TiUpprLimInAsyEvlrCritEve_Ca /end REF_CHARACTERISTIC
/end GROUP
/begin GROUP autosar_swc_aeb_autosar_swc_aeb_Step_sys_Subsystem_Reference_AEB_Function_Run_AsyEvlrCritEve_Step_Func_Run_AsyEvlrCritEve_Step_Func_TAWrapper_PreProcessor_ObjectPreProcessor_ObjectPreProcessorLoop_ValidObject_DetermineMotionType "autosar_swc_aeb/autosar_swc_aeb_Step_sys/Subsystem Reference/AEB Function/Run_AsyEvlrCritEve_Step_Func/Run_AsyEvlrCritEve_Step_Func/TAWrapper/PreProcessor/ObjectPreProcessor/ObjectPreProcessorLoop/ValidObject/DetermineMotionType" /begin REF_CHARACTERISTIC CLTS_ObjSpdThdLgtInAsyEvlrCritEve_Ca /end REF_CHARACTERISTIC /end GROUP
/begin GROUP autosar_swc_aeb_autosar_swc_aeb_Step_sys_Subsystem_Reference_AEB_Function_Run_AsyEvlrCritEve_Step_Func_Run_AsyEvlrCritEve_Step_Func_TAWrapper_PreProcessor_ObjectPreProcessor_ObjectPreProcessorLoop_ValidObject_SafetyMarginFrontObjects_CheckPredictionValidity_CheckPredictionValidityForTTM_CheckConfidenceForHeading "autosar_swc_aeb/autosar_swc_aeb_Step_sys/Subsystem Reference/AEB Function/Run_AsyEvlrCritEve_Step_Func/Run_AsyEvlrCritEve_Step_Func/TAWrapper/PreProcessor/ObjectPreProcessor/ObjectPreProcessorLoop/ValidObject/SafetyMarginFrontObjects/CheckPredictionValidity/CheckPredictionValidityForTTM/CheckConfidenceForHeading" /begin REF_CHARACTERISTIC CLTS_ObjSpdThdForAgDirVldInAsyEvlrCritEve_Ca /end REF_CHARACTERISTIC /end GROUP
/begin GROUP autosar_swc_aeb_autosar_swc_aeb_Step_sys_Subsystem_Reference_AEB_Function_Run_AsyEvlrCritEve_Step_Func_Run_AsyEvlrCritEve_Step_Func_TAWrapper_PreProcessor_ObjectPreProcessor_ObjectPreProcessorLoop_ValidObject_SafetyMarginFrontObjects_CheckPredictionValidity_CheckPredictionValidityForTTM_CheckPredictionDistanceBelowThreshold "autosar_swc_aeb/autosar_swc_aeb_Step_sys/Subsystem Reference/AEB Function/Run_AsyEvlrCritEve_Step_Func/Run_AsyEvlrCritEve_Step_Func/TAWrapper/PreProcessor/ObjectPreProcessor/ObjectPreProcessorLoop/ValidObject/SafetyMarginFrontObjects/CheckPredictionValidity/CheckPredictionValidityForTTM/CheckPredictionDistanceBelowThreshold" /begin REF_CHARACTERISTIC CLTS_DstPredMaxInAsyEvlrCritEve_Ca /end REF_CHARACTERISTIC /end GROUP
/begin GROUP autosar_swc_aeb_autosar_swc_aeb_Step_sys_Subsystem_Reference_AEB_Function_Run_AsyEvlrCritEve_Step_Func_Run_AsyEvlrCritEve_Step_Func_TAWrapper_PreProcessor_ObjectPreProcessor_ObjectPreProcessorLoop_ValidObject_SafetyMarginFrontObjects_CheckPredictionValidity_CheckPredictionValidityForTTM_CheckPredictionTimeBelowThreshold "autosar_swc_aeb/autosar_swc_aeb_Step_sys/Subsystem Reference/AEB Function/Run_AsyEvlrCritEve_Step_Func/Run_AsyEvlrCritEve_Step_Func/TAWrapper/PreProcessor/ObjectPreProcessor/ObjectPreProcessorLoop/ValidObject/SafetyMarginFrontObjects/CheckPredictionValidity/CheckPredictionValidityForTTM/CheckPredictionTimeBelowThreshold" /begin REF_CHARACTERISTIC CLTS_SftyArUpprLimForTiInObjPredInAsyEvlrCritEve_Ca /end REF_CHARACTERISTIC /end GROUP
/begin GROUP autosar_swc_aeb_autosar_swc_aeb_Step_sys_Subsystem_Reference_AEB_Function_Run_AsyEvlrCritEve_Step_Func_Run_AsyEvlrCritEve_Step_Func_TAWrapper_PreProcessor_ObjectPreProcessor_ObjectPreProcessorLoop_ValidObject_SafetyMarginFrontObjects_CheckPredictionValidity_CheckPredictionValidityForTTM_CheckSpeedAboveThreshold "autosar_swc_aeb/autosar_swc_aeb_Step_sys/Subsystem Reference/AEB Function/Run_AsyEvlrCritEve_Step_Func/Run_AsyEvlrCritEve_Step_Func/TAWrapper/PreProcessor/ObjectPreProcessor/ObjectPreProcessorLoop/ValidObject/SafetyMarginFrontObjects/CheckPredictionValidity/CheckPredictionValidityForTTM/CheckSpeedAboveThreshold" /begin REF_CHARACTERISTIC CLTS_SpdPredMinInAsyEvlrCritEve_Ca /end REF_CHARACTERISTIC /end GROUP
/begin GROUP autosar_swc_aeb_autosar_swc_aeb_Step_sys_Subsystem_Reference_AEB_Function_Run_AsyEvlrCritEve_Step_Func_Run_AsyEvlrCritEve_Step_Func_TAWrapper_PreProcessor_ObjectPreProcessor_ObjectPreProcessorLoop_ValidObject_SafetyMarginFrontObjects_CheckPredictionValidity_CheckPredictionValidityForTTR_CheckConfidenceForHeading "autosar_swc_aeb/autosar_swc_aeb_Step_sys/Subsystem Reference/AEB Function/Run_AsyEvlrCritEve_Step_Func/Run_AsyEvlrCritEve_Step_Func/TAWrapper/PreProcessor/ObjectPreProcessor/ObjectPreProcessorLoop/ValidObject/SafetyMarginFrontObjects/CheckPredictionValidity/CheckPredictionValidityForTTR/CheckConfidenceForHeading" /begin REF_CHARACTERISTIC CLTS_ObjSpdThdForAgDirVldInAsyEvlrCritEve_Ca /end REF_CHARACTERISTIC /end GROUP
/begin GROUP autosar_swc_aeb_autosar_swc_aeb_Step_sys_Subsystem_Reference_AEB_Function_Run_AsyEvlrCritEve_Step_Func_Run_AsyEvlrCritEve_Step_Func_TAWrapper_PreProcessor_ObjectPreProcessor_ObjectPreProcessorLoop_ValidObject_SafetyMarginFrontObjects_CheckPredictionValidity_CheckPredictionValidityForTTR_CheckPredictionDistanceBelowThreshold "autosar_swc_aeb/autosar_swc_aeb_Step_sys/Subsystem Reference/AEB Function/Run_AsyEvlrCritEve_Step_Func/Run_AsyEvlrCritEve_Step_Func/TAWrapper/PreProcessor/ObjectPreProcessor/ObjectPreProcessorLoop/ValidObject/SafetyMarginFrontObjects/CheckPredictionValidity/CheckPredictionValidityForTTR/CheckPredictionDistanceBelowThreshold" /begin REF_CHARACTERISTIC CLTS_DstPredMaxInAsyEvlrCritEve_Ca /end REF_CHARACTERISTIC /end GROUP
/begin GROUP autosar_swc_aeb_autosar_swc_aeb_Step_sys_Subsystem_Reference_AEB_Function_Run_AsyEvlrCritEve_Step_Func_Run_AsyEvlrCritEve_Step_Func_TAWrapper_PreProcessor_ObjectPreProcessor_ObjectPreProcessorLoop_ValidObject_SafetyMarginFrontObjects_CheckPredictionValidity_CheckPredictionValidityForTTR_CheckPredictionTimeBelowThreshold "autosar_swc_aeb/autosar_swc_aeb_Step_sys/Subsystem Reference/AEB Function/Run_AsyEvlrCritEve_Step_Func/Run_AsyEvlrCritEve_Step_Func/TAWrapper/PreProcessor/ObjectPreProcessor/ObjectPreProcessorLoop/ValidObject/SafetyMarginFrontObjects/CheckPredictionValidity/CheckPredictionValidityForTTR/CheckPredictionTimeBelowThreshold" /begin REF_CHARACTERISTIC CLTS_SftyArUpprLimForTiInObjPredInAsyEvlrCritEve_Ca /end REF_CHARACTERISTIC /end GROUP
/begin GROUP autosar_swc_aeb_autosar_swc_aeb_Step_sys_Subsystem_Reference_AEB_Function_Run_AsyEvlrCritEve_Step_Func_Run_AsyEvlrCritEve_Step_Func_TAWrapper_PreProcessor_ObjectPreProcessor_ObjectPreProcessorLoop_ValidObject_SafetyMarginFrontObjects_CheckPredictionValidity_CheckPredictionValidityForTTR_CheckSpeedAboveThreshold "autosar_swc_aeb/autosar_swc_aeb_Step_sys/Subsystem Reference/AEB Function/Run_AsyEvlrCritEve_Step_Func/Run_AsyEvlrCritEve_Step_Func/TAWrapper/PreProcessor/ObjectPreProcessor/ObjectPreProcessorLoop/ValidObject/SafetyMarginFrontObjects/CheckPredictionValidity/CheckPredictionValidityForTTR/CheckSpeedAboveThreshold" /begin REF_CHARACTERISTIC CLTS_SpdPredMinInAsyEvlrCritEve_Ca /end REF_CHARACTERISTIC /end GROUP
/begin GROUP autosar_swc_aeb_autosar_swc_aeb_Step_sys_Subsystem_Reference_AEB_Function_Run_AsyEvlrCritEve_Step_Func_Run_AsyEvlrCritEve_Step_Func_TAWrapper_PreProcessor_ObjectPreProcessor_ObjectPreProcessorLoop_ValidObject_SafetyMarginFrontObjects_DetermineOffsets_LateralInPathOffset_CalcAdditionalFarEdgeOffset "autosar_swc_aeb/autosar_swc_aeb_Step_sys/Subsystem Reference/AEB Function/Run_AsyEvlrCritEve_Step_Func/Run_AsyEvlrCritEve_Step_Func/TAWrapper/PreProcessor/ObjectPreProcessor/ObjectPreProcessorLoop/ValidObject/SafetyMarginFrontObjects/DetermineOffsets/LateralInPathOffset/CalcAdditionalFarEdgeOffset" /begin REF_CHARACTERISTIC CLTS_ObjSpdThdLatInAsyEvlrCritEve_Ca /end REF_CHARACTERISTIC /end GROUP
/begin GROUP autosar_swc_aeb_autosar_swc_aeb_Step_sys_Subsystem_Reference_AEB_Function_Run_AsyEvlrCritEve_Step_Func_Run_AsyEvlrCritEve_Step_Func_TAWrapper_PreProcessor_ObjectPreProcessor_ObjectPreProcessorLoop_ValidObject_SafetyMarginFrontObjects_InPathCalculationWithCurrentObjPositions_CheckSteeringOutOfPath_CheckPredictionTimeBelowThreshold "autosar_swc_aeb/autosar_swc_aeb_Step_sys/Subsystem Reference/AEB Function/Run_AsyEvlrCritEve_Step_Func/Run_AsyEvlrCritEve_Step_Func/TAWrapper/PreProcessor/ObjectPreProcessor/ObjectPreProcessorLoop/ValidObject/SafetyMarginFrontObjects/InPathCalculationWithCurrentObjPositions/CheckSteeringOutOfPath/CheckPredictionTimeBelowThreshold" /begin REF_CHARACTERISTIC CLTS_SftyArUpprLimForTiInObjPredInAsyEvlrCritEve_Ca /end REF_CHARACTERISTIC /end GROUP
/begin GROUP autosar_swc_aeb_autosar_swc_aeb_Step_sys_Subsystem_Reference_AEB_Function_Run_AsyEvlrCritEve_Step_Func_Run_AsyEvlrCritEve_Step_Func_TAWrapper_PreProcessor_ObjectPreProcessor_ObjectPreProcessorLoop_ValidObject_Subsystem_CalculateTTRAndTTM "autosar_swc_aeb/autosar_swc_aeb_Step_sys/Subsystem Reference/AEB Function/Run_AsyEvlrCritEve_Step_Func/Run_AsyEvlrCritEve_Step_Func/TAWrapper/PreProcessor/ObjectPreProcessor/ObjectPreProcessorLoop/ValidObject/Subsystem/CalculateTTRAndTTM"
 /begin REF_CHARACTERISTIC CLTS_TiLowrLimInAsyEvlrCritEve_Ca CLTS_TiUpprLimInAsyEvlrCritEve_Ca /end REF_CHARACTERISTIC
/end GROUP
/begin GROUP autosar_swc_aeb_autosar_swc_aeb_Step_sys_Subsystem_Reference_AEB_Function_Run_AsyEvlrCritEve_Step_Func_Run_AsyEvlrCritEve_Step_Func_TAWrapper_PreProcessor_ObjectPreProcessor_ObjectPreProcessorLoop_ValidObject_Subsystem_CalculateTTRAndTTM_LongitudinalTTMComputer_CalculateTTI_HostAndObjectMoving "autosar_swc_aeb/autosar_swc_aeb_Step_sys/Subsystem Reference/AEB Function/Run_AsyEvlrCritEve_Step_Func/Run_AsyEvlrCritEve_Step_Func/TAWrapper/PreProcessor/ObjectPreProcessor/ObjectPreProcessorLoop/ValidObject/Subsystem/CalculateTTRAndTTM/LongitudinalTTMComputer/CalculateTTI/HostAndObjectMoving" /begin REF_CHARACTERISTIC CLTS_TiUpprLimInAsyEvlrCritEve_Ca /end REF_CHARACTERISTIC /end GROUP
/begin GROUP autosar_swc_aeb_autosar_swc_aeb_Step_sys_Subsystem_Reference_AEB_Function_Run_AsyEvlrCritEve_Step_Func_Run_AsyEvlrCritEve_Step_Func_TAWrapper_PreProcessor_ObjectPreProcessor_ObjectPreProcessorLoop_ValidObject_Subsystem_CalculateTTRAndTTM_LongitudinalTTMComputer_CalculateTTI_HostAndObjectMoving_TimeToIntersectionComputer "autosar_swc_aeb/autosar_swc_aeb_Step_sys/Subsystem Reference/AEB Function/Run_AsyEvlrCritEve_Step_Func/Run_AsyEvlrCritEve_Step_Func/TAWrapper/PreProcessor/ObjectPreProcessor/ObjectPreProcessorLoop/ValidObject/Subsystem/CalculateTTRAndTTM/LongitudinalTTMComputer/CalculateTTI/HostAndObjectMoving/TimeToIntersectionComputer"
 /begin REF_CHARACTERISTIC CLTS_TiLowrLimInAsyEvlrCritEve_Ca CLTS_TiUpprLimInAsyEvlrCritEve_Ca /end REF_CHARACTERISTIC
/end GROUP
/begin GROUP autosar_swc_aeb_autosar_swc_aeb_Step_sys_Subsystem_Reference_AEB_Function_Run_AsyEvlrCritEve_Step_Func_Run_AsyEvlrCritEve_Step_Func_TAWrapper_PreProcessor_ObjectPreProcessor_ObjectPreProcessorLoop_ValidObject_Subsystem_CalculateTTRAndTTM_LongitudinalTTMComputer_CalculateTTI_StationaryHost "autosar_swc_aeb/autosar_swc_aeb_Step_sys/Subsystem Reference/AEB Function/Run_AsyEvlrCritEve_Step_Func/Run_AsyEvlrCritEve_Step_Func/TAWrapper/PreProcessor/ObjectPreProcessor/ObjectPreProcessorLoop/ValidObject/Subsystem/CalculateTTRAndTTM/LongitudinalTTMComputer/CalculateTTI/StationaryHost" /begin REF_CHARACTERISTIC CLTS_TiUpprLimInAsyEvlrCritEve_Ca /end REF_CHARACTERISTIC /end GROUP
/begin GROUP autosar_swc_aeb_autosar_swc_aeb_Step_sys_Subsystem_Reference_AEB_Function_Run_AsyEvlrCritEve_Step_Func_Run_AsyEvlrCritEve_Step_Func_TAWrapper_PreProcessor_ObjectPreProcessor_ObjectPreProcessorLoop_ValidObject_Subsystem_CalculateTTRAndTTM_LongitudinalTTMComputer_CalculateTTI_StationaryHost_TimeToIntersectionComputer "autosar_swc_aeb/autosar_swc_aeb_Step_sys/Subsystem Reference/AEB Function/Run_AsyEvlrCritEve_Step_Func/Run_AsyEvlrCritEve_Step_Func/TAWrapper/PreProcessor/ObjectPreProcessor/ObjectPreProcessorLoop/ValidObject/Subsystem/CalculateTTRAndTTM/LongitudinalTTMComputer/CalculateTTI/StationaryHost/TimeToIntersectionComputer"
 /begin REF_CHARACTERISTIC CLTS_TiLowrLimInAsyEvlrCritEve_Ca CLTS_TiUpprLimInAsyEvlrCritEve_Ca /end REF_CHARACTERISTIC
/end GROUP
/begin GROUP autosar_swc_aeb_autosar_swc_aeb_Step_sys_Subsystem_Reference_AEB_Function_Run_AsyEvlrCritEve_Step_Func_Run_AsyEvlrCritEve_Step_Func_TAWrapper_PreProcessor_ObjectPreProcessor_ObjectPreProcessorLoop_ValidObject_Subsystem_CalculateTTRAndTTM_LongitudinalTTMComputer_CalculateTTI_StationaryObject "autosar_swc_aeb/autosar_swc_aeb_Step_sys/Subsystem Reference/AEB Function/Run_AsyEvlrCritEve_Step_Func/Run_AsyEvlrCritEve_Step_Func/TAWrapper/PreProcessor/ObjectPreProcessor/ObjectPreProcessorLoop/ValidObject/Subsystem/CalculateTTRAndTTM/LongitudinalTTMComputer/CalculateTTI/StationaryObject" /begin REF_CHARACTERISTIC CLTS_TiUpprLimInAsyEvlrCritEve_Ca /end REF_CHARACTERISTIC /end GROUP
/begin GROUP autosar_swc_aeb_autosar_swc_aeb_Step_sys_Subsystem_Reference_AEB_Function_Run_AsyEvlrCritEve_Step_Func_Run_AsyEvlrCritEve_Step_Func_TAWrapper_PreProcessor_ObjectPreProcessor_ObjectPreProcessorLoop_ValidObject_Subsystem_CalculateTTRAndTTM_LongitudinalTTMComputer_CalculateTTI_StationaryObject_TimeToIntersectionComputer "autosar_swc_aeb/autosar_swc_aeb_Step_sys/Subsystem Reference/AEB Function/Run_AsyEvlrCritEve_Step_Func/Run_AsyEvlrCritEve_Step_Func/TAWrapper/PreProcessor/ObjectPreProcessor/ObjectPreProcessorLoop/ValidObject/Subsystem/CalculateTTRAndTTM/LongitudinalTTMComputer/CalculateTTI/StationaryObject/TimeToIntersectionComputer"
 /begin REF_CHARACTERISTIC CLTS_TiLowrLimInAsyEvlrCritEve_Ca CLTS_TiUpprLimInAsyEvlrCritEve_Ca /end REF_CHARACTERISTIC
/end GROUP
/begin GROUP autosar_swc_aeb_autosar_swc_aeb_Step_sys_Subsystem_Reference_AEB_Function_Run_AsyEvlrCritEve_Step_Func_Run_AsyEvlrCritEve_Step_Func_TAWrapper_PreProcessor_ObjectPreProcessor_ObjectPreProcessorLoop_ValidObject_Subsystem_CalculateTTRAndTTM_LongitudinalTTMComputer_SelectTTI_CheckIfVehicleStops "autosar_swc_aeb/autosar_swc_aeb_Step_sys/Subsystem Reference/AEB Function/Run_AsyEvlrCritEve_Step_Func/Run_AsyEvlrCritEve_Step_Func/TAWrapper/PreProcessor/ObjectPreProcessor/ObjectPreProcessorLoop/ValidObject/Subsystem/CalculateTTRAndTTM/LongitudinalTTMComputer/SelectTTI/CheckIfVehicleStops" /begin REF_CHARACTERISTIC CLTS_SftyArUpprLimForTiInObjPredInAsyEvlrCritEve_Ca /end REF_CHARACTERISTIC /end GROUP
/begin GROUP autosar_swc_aeb_autosar_swc_aeb_Step_sys_Subsystem_Reference_AEB_Function_Run_AsyEvlrCritEve_Step_Func_Run_AsyEvlrCritEve_Step_Func_TAWrapper_PreProcessor_ObjectPreProcessor_ObjectPreProcessorLoop_ValidObject_Subsystem_CalculateTTRAndTTM_LongitudinalTTMComputer_SelectTTI_CheckIfVehicleStops1 "autosar_swc_aeb/autosar_swc_aeb_Step_sys/Subsystem Reference/AEB Function/Run_AsyEvlrCritEve_Step_Func/Run_AsyEvlrCritEve_Step_Func/TAWrapper/PreProcessor/ObjectPreProcessor/ObjectPreProcessorLoop/ValidObject/Subsystem/CalculateTTRAndTTM/LongitudinalTTMComputer/SelectTTI/CheckIfVehicleStops1" /begin REF_CHARACTERISTIC CLTS_SftyArUpprLimForTiInObjPredInAsyEvlrCritEve_Ca /end REF_CHARACTERISTIC /end GROUP
/begin GROUP autosar_swc_aeb_autosar_swc_aeb_Step_sys_Subsystem_Reference_AEB_Function_Run_AsyEvlrCritEve_Step_Func_Run_AsyEvlrCritEve_Step_Func_TAWrapper_PreProcessor_ObjectPreProcessor_ObjectPreProcessorLoop_ValidObject_Subsystem_CalculateTTRAndTTM_LongitudinalTTRComputer_CalculateTTI_HostAndObjectMoving "autosar_swc_aeb/autosar_swc_aeb_Step_sys/Subsystem Reference/AEB Function/Run_AsyEvlrCritEve_Step_Func/Run_AsyEvlrCritEve_Step_Func/TAWrapper/PreProcessor/ObjectPreProcessor/ObjectPreProcessorLoop/ValidObject/Subsystem/CalculateTTRAndTTM/LongitudinalTTRComputer/CalculateTTI/HostAndObjectMoving" /begin REF_CHARACTERISTIC CLTS_TiUpprLimInAsyEvlrCritEve_Ca /end REF_CHARACTERISTIC /end GROUP
/begin GROUP autosar_swc_aeb_autosar_swc_aeb_Step_sys_Subsystem_Reference_AEB_Function_Run_AsyEvlrCritEve_Step_Func_Run_AsyEvlrCritEve_Step_Func_TAWrapper_PreProcessor_ObjectPreProcessor_ObjectPreProcessorLoop_ValidObject_Subsystem_CalculateTTRAndTTM_LongitudinalTTRComputer_CalculateTTI_HostAndObjectMoving_TimeToIntersectionComputer "autosar_swc_aeb/autosar_swc_aeb_Step_sys/Subsystem Reference/AEB Function/Run_AsyEvlrCritEve_Step_Func/Run_AsyEvlrCritEve_Step_Func/TAWrapper/PreProcessor/ObjectPreProcessor/ObjectPreProcessorLoop/ValidObject/Subsystem/CalculateTTRAndTTM/LongitudinalTTRComputer/CalculateTTI/HostAndObjectMoving/TimeToIntersectionComputer"
 /begin REF_CHARACTERISTIC CLTS_TiLowrLimInAsyEvlrCritEve_Ca CLTS_TiUpprLimInAsyEvlrCritEve_Ca /end REF_CHARACTERISTIC
/end GROUP
/begin GROUP autosar_swc_aeb_autosar_swc_aeb_Step_sys_Subsystem_Reference_AEB_Function_Run_AsyEvlrCritEve_Step_Func_Run_AsyEvlrCritEve_Step_Func_TAWrapper_PreProcessor_ObjectPreProcessor_ObjectPreProcessorLoop_ValidObject_Subsystem_CalculateTTRAndTTM_LongitudinalTTRComputer_CalculateTTI_StationaryHost "autosar_swc_aeb/autosar_swc_aeb_Step_sys/Subsystem Reference/AEB Function/Run_AsyEvlrCritEve_Step_Func/Run_AsyEvlrCritEve_Step_Func/TAWrapper/PreProcessor/ObjectPreProcessor/ObjectPreProcessorLoop/ValidObject/Subsystem/CalculateTTRAndTTM/LongitudinalTTRComputer/CalculateTTI/StationaryHost" /begin REF_CHARACTERISTIC CLTS_TiUpprLimInAsyEvlrCritEve_Ca /end REF_CHARACTERISTIC /end GROUP
/begin GROUP autosar_swc_aeb_autosar_swc_aeb_Step_sys_Subsystem_Reference_AEB_Function_Run_AsyEvlrCritEve_Step_Func_Run_AsyEvlrCritEve_Step_Func_TAWrapper_PreProcessor_ObjectPreProcessor_ObjectPreProcessorLoop_ValidObject_Subsystem_CalculateTTRAndTTM_LongitudinalTTRComputer_CalculateTTI_StationaryHost_TimeToIntersectionComputer "autosar_swc_aeb/autosar_swc_aeb_Step_sys/Subsystem Reference/AEB Function/Run_AsyEvlrCritEve_Step_Func/Run_AsyEvlrCritEve_Step_Func/TAWrapper/PreProcessor/ObjectPreProcessor/ObjectPreProcessorLoop/ValidObject/Subsystem/CalculateTTRAndTTM/LongitudinalTTRComputer/CalculateTTI/StationaryHost/TimeToIntersectionComputer"
 /begin REF_CHARACTERISTIC CLTS_TiLowrLimInAsyEvlrCritEve_Ca CLTS_TiUpprLimInAsyEvlrCritEve_Ca /end REF_CHARACTERISTIC
/end GROUP
/begin GROUP autosar_swc_aeb_autosar_swc_aeb_Step_sys_Subsystem_Reference_AEB_Function_Run_AsyEvlrCritEve_Step_Func_Run_AsyEvlrCritEve_Step_Func_TAWrapper_PreProcessor_ObjectPreProcessor_ObjectPreProcessorLoop_ValidObject_Subsystem_CalculateTTRAndTTM_LongitudinalTTRComputer_CalculateTTI_StationaryObject "autosar_swc_aeb/autosar_swc_aeb_Step_sys/Subsystem Reference/AEB Function/Run_AsyEvlrCritEve_Step_Func/Run_AsyEvlrCritEve_Step_Func/TAWrapper/PreProcessor/ObjectPreProcessor/ObjectPreProcessorLoop/ValidObject/Subsystem/CalculateTTRAndTTM/LongitudinalTTRComputer/CalculateTTI/StationaryObject" /begin REF_CHARACTERISTIC CLTS_TiUpprLimInAsyEvlrCritEve_Ca /end REF_CHARACTERISTIC /end GROUP
/begin GROUP autosar_swc_aeb_autosar_swc_aeb_Step_sys_Subsystem_Reference_AEB_Function_Run_AsyEvlrCritEve_Step_Func_Run_AsyEvlrCritEve_Step_Func_TAWrapper_PreProcessor_ObjectPreProcessor_ObjectPreProcessorLoop_ValidObject_Subsystem_CalculateTTRAndTTM_LongitudinalTTRComputer_CalculateTTI_StationaryObject_TimeToIntersectionComputer "autosar_swc_aeb/autosar_swc_aeb_Step_sys/Subsystem Reference/AEB Function/Run_AsyEvlrCritEve_Step_Func/Run_AsyEvlrCritEve_Step_Func/TAWrapper/PreProcessor/ObjectPreProcessor/ObjectPreProcessorLoop/ValidObject/Subsystem/CalculateTTRAndTTM/LongitudinalTTRComputer/CalculateTTI/StationaryObject/TimeToIntersectionComputer"
 /begin REF_CHARACTERISTIC CLTS_TiLowrLimInAsyEvlrCritEve_Ca CLTS_TiUpprLimInAsyEvlrCritEve_Ca /end REF_CHARACTERISTIC
/end GROUP
/begin GROUP autosar_swc_aeb_autosar_swc_aeb_Step_sys_Subsystem_Reference_AEB_Function_Run_AsyEvlrCritEve_Step_Func_Run_AsyEvlrCritEve_Step_Func_TAWrapper_PreProcessor_ObjectPreProcessor_ObjectPreProcessorLoop_ValidObject_Subsystem_CalculateTTRAndTTM_LongitudinalTTRComputer_SelectTTI_CheckIfVehicleStops "autosar_swc_aeb/autosar_swc_aeb_Step_sys/Subsystem Reference/AEB Function/Run_AsyEvlrCritEve_Step_Func/Run_AsyEvlrCritEve_Step_Func/TAWrapper/PreProcessor/ObjectPreProcessor/ObjectPreProcessorLoop/ValidObject/Subsystem/CalculateTTRAndTTM/LongitudinalTTRComputer/SelectTTI/CheckIfVehicleStops" /begin REF_CHARACTERISTIC CLTS_SftyArUpprLimForTiInObjPredInAsyEvlrCritEve_Ca /end REF_CHARACTERISTIC /end GROUP
/begin GROUP autosar_swc_aeb_autosar_swc_aeb_Step_sys_Subsystem_Reference_AEB_Function_Run_AsyEvlrCritEve_Step_Func_Run_AsyEvlrCritEve_Step_Func_TAWrapper_PreProcessor_ObjectPreProcessor_ObjectPreProcessorLoop_ValidObject_Subsystem_CalculateTTRAndTTM_LongitudinalTTRComputer_SelectTTI_CheckIfVehicleStops1 "autosar_swc_aeb/autosar_swc_aeb_Step_sys/Subsystem Reference/AEB Function/Run_AsyEvlrCritEve_Step_Func/Run_AsyEvlrCritEve_Step_Func/TAWrapper/PreProcessor/ObjectPreProcessor/ObjectPreProcessorLoop/ValidObject/Subsystem/CalculateTTRAndTTM/LongitudinalTTRComputer/SelectTTI/CheckIfVehicleStops1" /begin REF_CHARACTERISTIC CLTS_SftyArUpprLimForTiInObjPredInAsyEvlrCritEve_Ca /end REF_CHARACTERISTIC /end GROUP
/begin GROUP autosar_swc_aeb_autosar_swc_aeb_Step_sys_Subsystem_Reference_AEB_Function_Run_AsyEvlrCritEve_Step_Func_Run_AsyEvlrCritEve_Step_Func_TAWrapper_PreProcessor_ObjectPreProcessor_ObjectPreProcessorLoop_ValidObject_Subsystem_CalculateTTRAndTTM_ModifyTTMAtSameSpeedAndAcceleration "autosar_swc_aeb/autosar_swc_aeb_Step_sys/Subsystem Reference/AEB Function/Run_AsyEvlrCritEve_Step_Func/Run_AsyEvlrCritEve_Step_Func/TAWrapper/PreProcessor/ObjectPreProcessor/ObjectPreProcessorLoop/ValidObject/Subsystem/CalculateTTRAndTTM/ModifyTTMAtSameSpeedAndAcceleration" /begin REF_CHARACTERISTIC CLTS_TiUpprLimInAsyEvlrCritEve_Ca /end REF_CHARACTERISTIC /end GROUP
/begin GROUP autosar_swc_aeb_autosar_swc_aeb_Step_sys_Subsystem_Reference_AEB_Function_Run_AsyEvlrCritEve_Step_Func_Run_AsyEvlrCritEve_Step_Func_TAWrapper_PreProcessor_ObjectPreProcessor_ObjectPreProcessorLoop_ValidObject_Subsystem_CalculateTTRAndTTM_ModifyTTRAtSameSpeedAndAcceleration "autosar_swc_aeb/autosar_swc_aeb_Step_sys/Subsystem Reference/AEB Function/Run_AsyEvlrCritEve_Step_Func/Run_AsyEvlrCritEve_Step_Func/TAWrapper/PreProcessor/ObjectPreProcessor/ObjectPreProcessorLoop/ValidObject/Subsystem/CalculateTTRAndTTM/ModifyTTRAtSameSpeedAndAcceleration"
 /begin REF_CHARACTERISTIC CLTS_TiLowrLimInAsyEvlrCritEve_Ca CLTS_TiUpprLimInAsyEvlrCritEve_Ca /end REF_CHARACTERISTIC
/end GROUP
/begin GROUP autosar_swc_aeb_autosar_swc_aeb_Step_sys_Subsystem_Reference_AEB_Function_Run_AsyEvlrCritEve_Step_Func_Run_AsyEvlrCritEve_Step_Func_TAWrapper_PreProcessor_ObjectPreProcessor_ObjectPreProcessorLoop_ValidObject_Subsystem_CalculateTTRAndTTM_SetCorrectSign1 "autosar_swc_aeb/autosar_swc_aeb_Step_sys/Subsystem Reference/AEB Function/Run_AsyEvlrCritEve_Step_Func/Run_AsyEvlrCritEve_Step_Func/TAWrapper/PreProcessor/ObjectPreProcessor/ObjectPreProcessorLoop/ValidObject/Subsystem/CalculateTTRAndTTM/SetCorrectSign1"
 /begin REF_CHARACTERISTIC CLTS_TiLowrLimInAsyEvlrCritEve_Ca CLTS_TiUpprLimInAsyEvlrCritEve_Ca /end REF_CHARACTERISTIC
/end GROUP
/begin GROUP autosar_swc_aeb_autosar_swc_aeb_Step_sys_Subsystem_Reference_AEB_Function_Run_AsyEvlrCritEve_Step_Func_Run_AsyEvlrCritEve_Step_Func_TAWrapper_PreProcessor_ObjectPreProcessor_ObjectPreProcessorLoop_ValidObject_Subsystem_CalculateTTRAndTTM_SetCorrectSign2 "autosar_swc_aeb/autosar_swc_aeb_Step_sys/Subsystem Reference/AEB Function/Run_AsyEvlrCritEve_Step_Func/Run_AsyEvlrCritEve_Step_Func/TAWrapper/PreProcessor/ObjectPreProcessor/ObjectPreProcessorLoop/ValidObject/Subsystem/CalculateTTRAndTTM/SetCorrectSign2"
 /begin REF_CHARACTERISTIC CLTS_TiLowrLimInAsyEvlrCritEve_Ca CLTS_TiUpprLimInAsyEvlrCritEve_Ca /end REF_CHARACTERISTIC
/end GROUP
/begin RECORD_LAYOUT Record_BOOLEAN FNC_VALUES 1 UBYTE COLUMN_DIR DIRECT /end RECORD_LAYOUT
/begin RECORD_LAYOUT Record_FLOAT32_IEEE FNC_VALUES 1 FLOAT32_IEEE COLUMN_DIR DIRECT /end RECORD_LAYOUT
/begin RECORD_LAYOUT Record_BOOLEAN FNC_VALUES 1 UBYTE COLUMN_DIR DIRECT /end RECORD_LAYOUT
/begin RECORD_LAYOUT Record_FLOAT32_IEEE FNC_VALUES 1 FLOAT32_IEEE COLUMN_DIR DIRECT /end RECORD_LAYOUT
/begin RECORD_LAYOUT Record_BOOLEAN FNC_VALUES 1 UBYTE COLUMN_DIR DIRECT /end RECORD_LAYOUT
/begin RECORD_LAYOUT Record_FLOAT32_IEEE FNC_VALUES 1 FLOAT32_IEEE COLUMN_DIR DIRECT /end RECORD_LAYOUT
/begin RECORD_LAYOUT Record_BOOLEAN FNC_VALUES 1 UBYTE COLUMN_DIR DIRECT /end RECORD_LAYOUT
/begin RECORD_LAYOUT Record_FLOAT32_IEEE FNC_VALUES 1 FLOAT32_IEEE COLUMN_DIR DIRECT /end RECORD_LAYOUT
/begin RECORD_LAYOUT Record_BOOLEAN FNC_VALUES 1 UBYTE COLUMN_DIR DIRECT /end RECORD_LAYOUT
/begin RECORD_LAYOUT Record_FLOAT32_IEEE FNC_VALUES 1 FLOAT32_IEEE COLUMN_DIR DIRECT /end RECORD_LAYOUT
/begin RECORD_LAYOUT Record_BOOLEAN FNC_VALUES 1 UBYTE COLUMN_DIR DIRECT /end RECORD_LAYOUT
/begin RECORD_LAYOUT Record_FLOAT32_IEEE FNC_VALUES 1 FLOAT32_IEEE COLUMN_DIR DIRECT /end RECORD_LAYOUT
/begin RECORD_LAYOUT Record_BOOLEAN FNC_VALUES 1 UBYTE COLUMN_DIR DIRECT /end RECORD_LAYOUT
/begin RECORD_LAYOUT Record_FLOAT32_IEEE FNC_VALUES 1 FLOAT32_IEEE COLUMN_DIR DIRECT /end RECORD_LAYOUT
/begin RECORD_LAYOUT Record_BOOLEAN FNC_VALUES 1 UBYTE COLUMN_DIR DIRECT /end RECORD_LAYOUT
/begin RECORD_LAYOUT Record_FLOAT32_IEEE FNC_VALUES 1 FLOAT32_IEEE COLUMN_DIR DIRECT /end RECORD_LAYOUT
/begin RECORD_LAYOUT Record_BOOLEAN FNC_VALUES 1 UBYTE COLUMN_DIR DIRECT /end RECORD_LAYOUT
/begin RECORD_LAYOUT Record_FLOAT32_IEEE FNC_VALUES 1 FLOAT32_IEEE COLUMN_DIR DIRECT /end RECORD_LAYOUT
/begin RECORD_LAYOUT Record_BOOLEAN FNC_VALUES 1 UBYTE COLUMN_DIR DIRECT /end RECORD_LAYOUT
/begin RECORD_LAYOUT Record_FLOAT32_IEEE FNC_VALUES 1 FLOAT32_IEEE COLUMN_DIR DIRECT /end RECORD_LAYOUT
/end MODULE
/end PROJECT
