ASAP2_VERSION 1 71
/begin PROJECT ProjectName ""
/begin MODULE ModuleName ""
/begin MOD_COMMON "" BYTE_ORDER MSB_LAST ALIGNMENT_BYTE 1 ALIGNMENT_WORD 1 ALIGNMENT_LONG 1 ALIGNMENT_INT64 1 ALIGNMENT_FLOAT16_IEEE 1 ALIGNMENT_FLOAT32_IEEE 1 ALIGNMENT_FLOAT64_IEEE 1 /end MOD_COMMON
/begin RECORD_LAYOUT Scalar_BYTE FNC_VALUES 1 SBYTE COLUMN_DIR DIRECT /end RECORD_LAYOUT
/begin RECORD_LAYOUT Scalar_UWORD FNC_VALUES 1 UWORD COLUMN_DIR DIRECT /end RECORD_LAYOUT
/begin RECORD_LAYOUT Record_FLOAT32_IEEE FNC_VALUES 1 FLOAT32_IEEE COLUMN_DIR DIRECT /end RECORD_LAYOUT
/begin RECORD_LAYOUT Record_FLOAT32_IEEE FNC_VALUES 1 FLOAT32_IEEE COLUMN_DIR DIRECT /end RECORD_LAYOUT
/begin RECORD_LAYOUT Record_FLOAT32_IEEE FNC_VALUES 1 FLOAT32_IEEE COLUMN_DIR DIRECT /end RECORD_LAYOUT
/begin RECORD_LAYOUT Record_FLOAT32_IEEE FNC_VALUES 1 FLOAT32_IEEE COLUMN_DIR DIRECT /end RECORD_LAYOUT
/begin RECORD_LAYOUT Record_FLOAT32_IEEE FNC_VALUES 1 FLOAT32_IEEE COLUMN_DIR DIRECT /end RECORD_LAYOUT
/begin RECORD_LAYOUT Record_FLOAT32_IEEE FNC_VALUES 1 FLOAT32_IEEE COLUMN_DIR DIRECT /end RECORD_LAYOUT
/begin RECORD_LAYOUT Record_FLOAT32_IEEE FNC_VALUES 1 FLOAT32_IEEE COLUMN_DIR DIRECT /end RECORD_LAYOUT
/begin RECORD_LAYOUT Record_FLOAT32_IEEE FNC_VALUES 1 FLOAT32_IEEE COLUMN_DIR DIRECT /end RECORD_LAYOUT
/begin RECORD_LAYOUT Record_FLOAT32_IEEE FNC_VALUES 1 FLOAT32_IEEE COLUMN_DIR DIRECT /end RECORD_LAYOUT
/begin CHARACTERISTIC P_LONP_WaitTime "" VALUE 0xfe82942c /* @ECU_Address@P_LONP_WaitTime@ */ Record_FLOAT32_IEEE 0 autosar_swc_vmp_CM_single_s 0.000000 10.000000 /end CHARACTERISTIC
/begin CHARACTERISTIC P_LONP_hightHazardMinTor "" VALUE 0xfe82945c /* @ECU_Address@P_LONP_hightHazardMinTor@ */ Record_FLOAT32_IEEE 0 autosar_swc_vmp_CM_single_m -1.000000 10.000000 /end CHARACTERISTIC
/begin MEASUREMENT autosar_swc_vmp_rtARID_DEF.BusAssignment.Object_Hight "" FLOAT32_IEEE autosar_swc_vmp_CM_single 0 0 -3.4E+38 3.4E+38 ECU_ADDRESS 0xfe4ce38c /* @ECU_Address@autosar_swc_vmp_rtARID_DEF.BusAssignment.Object_Hight@ */ /end MEASUREMENT
/begin MEASUREMENT autosar_swc_vmp_rtARID_DEF.BusAssignment.Object_Length "" FLOAT32_IEEE autosar_swc_vmp_CM_single 0 0 -3.4E+38 3.4E+38 ECU_ADDRESS 0xfe4ce384 /* @ECU_Address@autosar_swc_vmp_rtARID_DEF.BusAssignment.Object_Length@ */ /end MEASUREMENT
/begin MEASUREMENT autosar_swc_vmp_rtARID_DEF.BusAssignment.Object_Width "" FLOAT32_IEEE autosar_swc_vmp_CM_single 0 0 -3.4E+38 3.4E+38 ECU_ADDRESS 0xfe4ce388 /* @ECU_Address@autosar_swc_vmp_rtARID_DEF.BusAssignment.Object_Width@ */ /end MEASUREMENT
/begin MEASUREMENT autosar_swc_vmp_rtARID_DEF.BusAssignment.age "" A_UINT64 autosar_swc_vmp_CM_uint64 0 0 0 18446744073709551615 ECU_ADDRESS 0xfe4ce398 /* @ECU_Address@autosar_swc_vmp_rtARID_DEF.BusAssignment.age@ */ /end MEASUREMENT
/begin MEASUREMENT autosar_swc_vmp_rtARID_DEF.BusAssignment.axAbs "" FLOAT32_IEEE autosar_swc_vmp_CM_single 0 0 -3.4E+38 3.4E+38 ECU_ADDRESS 0xfe4ce370 /* @ECU_Address@autosar_swc_vmp_rtARID_DEF.BusAssignment.axAbs@ */ /end MEASUREMENT
/begin MEASUREMENT autosar_swc_vmp_rtARID_DEF.BusAssignment.ayAbs "" FLOAT32_IEEE autosar_swc_vmp_CM_single 0 0 -3.4E+38 3.4E+38 ECU_ADDRESS 0xfe4ce374 /* @ECU_Address@autosar_swc_vmp_rtARID_DEF.BusAssignment.ayAbs@ */ /end MEASUREMENT
/begin MEASUREMENT autosar_swc_vmp_rtARID_DEF.BusAssignment.brakeIntention "" UBYTE autosar_swc_vmp_CM_logical 0 0 0 1 ECU_ADDRESS 0xfe4ce352 /* @ECU_Address@autosar_swc_vmp_rtARID_DEF.BusAssignment.brakeIntention@ */ /end MEASUREMENT
/begin MEASUREMENT autosar_swc_vmp_rtARID_DEF.BusAssignment.cutInflg "" UBYTE autosar_swc_vmp_CM_logical 0 0 0 1 ECU_ADDRESS 0xfe4ce351 /* @ECU_Address@autosar_swc_vmp_rtARID_DEF.BusAssignment.cutInflg@ */ /end MEASUREMENT
/begin MEASUREMENT autosar_swc_vmp_rtARID_DEF.BusAssignment.dx "" FLOAT32_IEEE autosar_swc_vmp_CM_single 0 0 -3.4E+38 3.4E+38 ECU_ADDRESS 0xfe4ce358 /* @ECU_Address@autosar_swc_vmp_rtARID_DEF.BusAssignment.dx@ */ /end MEASUREMENT
/begin MEASUREMENT autosar_swc_vmp_rtARID_DEF.BusAssignment.dy "" FLOAT32_IEEE autosar_swc_vmp_CM_single 0 0 -3.4E+38 3.4E+38 ECU_ADDRESS 0xfe4ce35c /* @ECU_Address@autosar_swc_vmp_rtARID_DEF.BusAssignment.dy@ */ /end MEASUREMENT
/begin MEASUREMENT autosar_swc_vmp_rtARID_DEF.BusAssignment.fu_type "" UWORD autosar_swc_vmp_CM_uint16 0 0 0 65535 ECU_ADDRESS 0xfe4ce356 /* @ECU_Address@autosar_swc_vmp_rtARID_DEF.BusAssignment.fu_type@ */ /end MEASUREMENT
/begin MEASUREMENT autosar_swc_vmp_rtARID_DEF.BusAssignment.headingAngle "" FLOAT32_IEEE autosar_swc_vmp_CM_single 0 0 -3.4E+38 3.4E+38 ECU_ADDRESS 0xfe4ce380 /* @ECU_Address@autosar_swc_vmp_rtARID_DEF.BusAssignment.headingAngle@ */ /end MEASUREMENT
/begin MEASUREMENT autosar_swc_vmp_rtARID_DEF.BusAssignment.id "" ULONG autosar_swc_vmp_CM_uint32 0 0 0 4294967295 ECU_ADDRESS 0xfe4ce390 /* @ECU_Address@autosar_swc_vmp_rtARID_DEF.BusAssignment.id@ */ /end MEASUREMENT
/begin MEASUREMENT autosar_swc_vmp_rtARID_DEF.BusAssignment.movingState "" UBYTE autosar_swc_vmp_CM_uint8 0 0 0 255 ECU_ADDRESS 0xfe4ce353 /* @ECU_Address@autosar_swc_vmp_rtARID_DEF.BusAssignment.movingState@ */ /end MEASUREMENT
/begin MEASUREMENT autosar_swc_vmp_rtARID_DEF.BusAssignment.objExist "" FLOAT32_IEEE autosar_swc_vmp_CM_single 0 0 -3.4E+38 3.4E+38 ECU_ADDRESS 0xfe4ce37c /* @ECU_Address@autosar_swc_vmp_rtARID_DEF.BusAssignment.objExist@ */ /end MEASUREMENT
/begin MEASUREMENT autosar_swc_vmp_rtARID_DEF.BusAssignment.orientation "" UBYTE autosar_swc_vmp_CM_uint8 0 0 0 255 ECU_ADDRESS 0xfe4ce354 /* @ECU_Address@autosar_swc_vmp_rtARID_DEF.BusAssignment.orientation@ */ /end MEASUREMENT
/begin MEASUREMENT autosar_swc_vmp_rtARID_DEF.BusAssignment.range "" FLOAT32_IEEE autosar_swc_vmp_CM_single 0 0 -3.4E+38 3.4E+38 ECU_ADDRESS 0xfe4ce378 /* @ECU_Address@autosar_swc_vmp_rtARID_DEF.BusAssignment.range@ */ /end MEASUREMENT
/begin MEASUREMENT autosar_swc_vmp_rtARID_DEF.BusAssignment.targetExist "" UBYTE autosar_swc_vmp_CM_logical 0 0 0 1 ECU_ADDRESS 0xfe4ce350 /* @ECU_Address@autosar_swc_vmp_rtARID_DEF.BusAssignment.targetExist@ */ /end MEASUREMENT
/begin MEASUREMENT autosar_swc_vmp_rtARID_DEF.BusAssignment.type "" UBYTE autosar_swc_vmp_CM_uint8 0 0 0 255 ECU_ADDRESS 0xfe4ce355 /* @ECU_Address@autosar_swc_vmp_rtARID_DEF.BusAssignment.type@ */ /end MEASUREMENT
/begin MEASUREMENT autosar_swc_vmp_rtARID_DEF.BusAssignment.vxAbs "" FLOAT32_IEEE autosar_swc_vmp_CM_single 0 0 -3.4E+38 3.4E+38 ECU_ADDRESS 0xfe4ce368 /* @ECU_Address@autosar_swc_vmp_rtARID_DEF.BusAssignment.vxAbs@ */ /end MEASUREMENT
/begin MEASUREMENT autosar_swc_vmp_rtARID_DEF.BusAssignment.vxRel "" FLOAT32_IEEE autosar_swc_vmp_CM_single 0 0 -3.4E+38 3.4E+38 ECU_ADDRESS 0xfe4ce360 /* @ECU_Address@autosar_swc_vmp_rtARID_DEF.BusAssignment.vxRel@ */ /end MEASUREMENT
/begin MEASUREMENT autosar_swc_vmp_rtARID_DEF.BusAssignment.vyAbs "" FLOAT32_IEEE autosar_swc_vmp_CM_single 0 0 -3.4E+38 3.4E+38 ECU_ADDRESS 0xfe4ce36c /* @ECU_Address@autosar_swc_vmp_rtARID_DEF.BusAssignment.vyAbs@ */ /end MEASUREMENT
/begin MEASUREMENT autosar_swc_vmp_rtARID_DEF.BusAssignment.vyRel "" FLOAT32_IEEE autosar_swc_vmp_CM_single 0 0 -3.4E+38 3.4E+38 ECU_ADDRESS 0xfe4ce364 /* @ECU_Address@autosar_swc_vmp_rtARID_DEF.BusAssignment.vyRel@ */ /end MEASUREMENT
/begin MEASUREMENT autosar_swc_vmp_rtARID_DEF.BusAssignment_f.Object_Hight "" FLOAT32_IEEE autosar_swc_vmp_CM_single 0 0 -3.4E+38 3.4E+38 ECU_ADDRESS 0xfe4ce42c /* @ECU_Address@autosar_swc_vmp_rtARID_DEF.BusAssignment_f.Object_Hight@ */ /end MEASUREMENT
/begin MEASUREMENT autosar_swc_vmp_rtARID_DEF.BusAssignment_f.Object_Length "" FLOAT32_IEEE autosar_swc_vmp_CM_single 0 0 -3.4E+38 3.4E+38 ECU_ADDRESS 0xfe4ce424 /* @ECU_Address@autosar_swc_vmp_rtARID_DEF.BusAssignment_f.Object_Length@ */ /end MEASUREMENT
/begin MEASUREMENT autosar_swc_vmp_rtARID_DEF.BusAssignment_f.Object_Width "" FLOAT32_IEEE autosar_swc_vmp_CM_single 0 0 -3.4E+38 3.4E+38 ECU_ADDRESS 0xfe4ce428 /* @ECU_Address@autosar_swc_vmp_rtARID_DEF.BusAssignment_f.Object_Width@ */ /end MEASUREMENT
/begin MEASUREMENT autosar_swc_vmp_rtARID_DEF.BusAssignment_f.age "" A_UINT64 autosar_swc_vmp_CM_uint64 0 0 0 18446744073709551615 ECU_ADDRESS 0xfe4ce438 /* @ECU_Address@autosar_swc_vmp_rtARID_DEF.BusAssignment_f.age@ */ /end MEASUREMENT
/begin MEASUREMENT autosar_swc_vmp_rtARID_DEF.BusAssignment_f.axAbs "" FLOAT32_IEEE autosar_swc_vmp_CM_single 0 0 -3.4E+38 3.4E+38 ECU_ADDRESS 0xfe4ce410 /* @ECU_Address@autosar_swc_vmp_rtARID_DEF.BusAssignment_f.axAbs@ */ /end MEASUREMENT
/begin MEASUREMENT autosar_swc_vmp_rtARID_DEF.BusAssignment_f.ayAbs "" FLOAT32_IEEE autosar_swc_vmp_CM_single 0 0 -3.4E+38 3.4E+38 ECU_ADDRESS 0xfe4ce414 /* @ECU_Address@autosar_swc_vmp_rtARID_DEF.BusAssignment_f.ayAbs@ */ /end MEASUREMENT
/begin MEASUREMENT autosar_swc_vmp_rtARID_DEF.BusAssignment_f.brakeIntention "" UBYTE autosar_swc_vmp_CM_logical 0 0 0 1 ECU_ADDRESS 0xfe4ce3f2 /* @ECU_Address@autosar_swc_vmp_rtARID_DEF.BusAssignment_f.brakeIntention@ */ /end MEASUREMENT
/begin MEASUREMENT autosar_swc_vmp_rtARID_DEF.BusAssignment_f.cutInflg "" UBYTE autosar_swc_vmp_CM_logical 0 0 0 1 ECU_ADDRESS 0xfe4ce3f1 /* @ECU_Address@autosar_swc_vmp_rtARID_DEF.BusAssignment_f.cutInflg@ */ /end MEASUREMENT
/begin MEASUREMENT autosar_swc_vmp_rtARID_DEF.BusAssignment_f.dx "" FLOAT32_IEEE autosar_swc_vmp_CM_single 0 0 -3.4E+38 3.4E+38 ECU_ADDRESS 0xfe4ce3f8 /* @ECU_Address@autosar_swc_vmp_rtARID_DEF.BusAssignment_f.dx@ */ /end MEASUREMENT
/begin MEASUREMENT autosar_swc_vmp_rtARID_DEF.BusAssignment_f.dy "" FLOAT32_IEEE autosar_swc_vmp_CM_single 0 0 -3.4E+38 3.4E+38 ECU_ADDRESS 0xfe4ce3fc /* @ECU_Address@autosar_swc_vmp_rtARID_DEF.BusAssignment_f.dy@ */ /end MEASUREMENT
/begin MEASUREMENT autosar_swc_vmp_rtARID_DEF.BusAssignment_f.fu_type "" UWORD autosar_swc_vmp_CM_uint16 0 0 0 65535 ECU_ADDRESS 0xfe4ce3f6 /* @ECU_Address@autosar_swc_vmp_rtARID_DEF.BusAssignment_f.fu_type@ */ /end MEASUREMENT
/begin MEASUREMENT autosar_swc_vmp_rtARID_DEF.BusAssignment_f.headingAngle "" FLOAT32_IEEE autosar_swc_vmp_CM_single 0 0 -3.4E+38 3.4E+38 ECU_ADDRESS 0xfe4ce420 /* @ECU_Address@autosar_swc_vmp_rtARID_DEF.BusAssignment_f.headingAngle@ */ /end MEASUREMENT
/begin MEASUREMENT autosar_swc_vmp_rtARID_DEF.BusAssignment_f.id "" ULONG autosar_swc_vmp_CM_uint32 0 0 0 4294967295 ECU_ADDRESS 0xfe4ce430 /* @ECU_Address@autosar_swc_vmp_rtARID_DEF.BusAssignment_f.id@ */ /end MEASUREMENT
/begin MEASUREMENT autosar_swc_vmp_rtARID_DEF.BusAssignment_f.movingState "" UBYTE autosar_swc_vmp_CM_uint8 0 0 0 255 ECU_ADDRESS 0xfe4ce3f3 /* @ECU_Address@autosar_swc_vmp_rtARID_DEF.BusAssignment_f.movingState@ */ /end MEASUREMENT
/begin MEASUREMENT autosar_swc_vmp_rtARID_DEF.BusAssignment_f.objExist "" FLOAT32_IEEE autosar_swc_vmp_CM_single 0 0 -3.4E+38 3.4E+38 ECU_ADDRESS 0xfe4ce41c /* @ECU_Address@autosar_swc_vmp_rtARID_DEF.BusAssignment_f.objExist@ */ /end MEASUREMENT
/begin MEASUREMENT autosar_swc_vmp_rtARID_DEF.BusAssignment_f.orientation "" UBYTE autosar_swc_vmp_CM_uint8 0 0 0 255 ECU_ADDRESS 0xfe4ce3f4 /* @ECU_Address@autosar_swc_vmp_rtARID_DEF.BusAssignment_f.orientation@ */ /end MEASUREMENT
/begin MEASUREMENT autosar_swc_vmp_rtARID_DEF.BusAssignment_f.range "" FLOAT32_IEEE autosar_swc_vmp_CM_single 0 0 -3.4E+38 3.4E+38 ECU_ADDRESS 0xfe4ce418 /* @ECU_Address@autosar_swc_vmp_rtARID_DEF.BusAssignment_f.range@ */ /end MEASUREMENT
/begin MEASUREMENT autosar_swc_vmp_rtARID_DEF.BusAssignment_f.targetExist "" UBYTE autosar_swc_vmp_CM_logical 0 0 0 1 ECU_ADDRESS 0xfe4ce3f0 /* @ECU_Address@autosar_swc_vmp_rtARID_DEF.BusAssignment_f.targetExist@ */ /end MEASUREMENT
/begin MEASUREMENT autosar_swc_vmp_rtARID_DEF.BusAssignment_f.type "" UBYTE autosar_swc_vmp_CM_uint8 0 0 0 255 ECU_ADDRESS 0xfe4ce3f5 /* @ECU_Address@autosar_swc_vmp_rtARID_DEF.BusAssignment_f.type@ */ /end MEASUREMENT
/begin MEASUREMENT autosar_swc_vmp_rtARID_DEF.BusAssignment_f.vxAbs "" FLOAT32_IEEE autosar_swc_vmp_CM_single 0 0 -3.4E+38 3.4E+38 ECU_ADDRESS 0xfe4ce408 /* @ECU_Address@autosar_swc_vmp_rtARID_DEF.BusAssignment_f.vxAbs@ */ /end MEASUREMENT
/begin MEASUREMENT autosar_swc_vmp_rtARID_DEF.BusAssignment_f.vxRel "" FLOAT32_IEEE autosar_swc_vmp_CM_single 0 0 -3.4E+38 3.4E+38 ECU_ADDRESS 0xfe4ce400 /* @ECU_Address@autosar_swc_vmp_rtARID_DEF.BusAssignment_f.vxRel@ */ /end MEASUREMENT
/begin MEASUREMENT autosar_swc_vmp_rtARID_DEF.BusAssignment_f.vyAbs "" FLOAT32_IEEE autosar_swc_vmp_CM_single 0 0 -3.4E+38 3.4E+38 ECU_ADDRESS 0xfe4ce40c /* @ECU_Address@autosar_swc_vmp_rtARID_DEF.BusAssignment_f.vyAbs@ */ /end MEASUREMENT
/begin MEASUREMENT autosar_swc_vmp_rtARID_DEF.BusAssignment_f.vyRel "" FLOAT32_IEEE autosar_swc_vmp_CM_single 0 0 -3.4E+38 3.4E+38 ECU_ADDRESS 0xfe4ce404 /* @ECU_Address@autosar_swc_vmp_rtARID_DEF.BusAssignment_f.vyRel@ */ /end MEASUREMENT
/begin MEASUREMENT autosar_swc_vmp_rtARID_DEF.BusAssignment_f5.Object_Hight "" FLOAT32_IEEE autosar_swc_vmp_CM_single 0 0 -3.4E+38 3.4E+38 ECU_ADDRESS 0xfe4ce47c /* @ECU_Address@autosar_swc_vmp_rtARID_DEF.BusAssignment_f5.Object_Hight@ */ /end MEASUREMENT
/begin MEASUREMENT autosar_swc_vmp_rtARID_DEF.BusAssignment_f5.Object_Length "" FLOAT32_IEEE autosar_swc_vmp_CM_single 0 0 -3.4E+38 3.4E+38 ECU_ADDRESS 0xfe4ce474 /* @ECU_Address@autosar_swc_vmp_rtARID_DEF.BusAssignment_f5.Object_Length@ */ /end MEASUREMENT
/begin MEASUREMENT autosar_swc_vmp_rtARID_DEF.BusAssignment_f5.Object_Width "" FLOAT32_IEEE autosar_swc_vmp_CM_single 0 0 -3.4E+38 3.4E+38 ECU_ADDRESS 0xfe4ce478 /* @ECU_Address@autosar_swc_vmp_rtARID_DEF.BusAssignment_f5.Object_Width@ */ /end MEASUREMENT
/begin MEASUREMENT autosar_swc_vmp_rtARID_DEF.BusAssignment_f5.age "" A_UINT64 autosar_swc_vmp_CM_uint64 0 0 0 18446744073709551615 ECU_ADDRESS 0xfe4ce488 /* @ECU_Address@autosar_swc_vmp_rtARID_DEF.BusAssignment_f5.age@ */ /end MEASUREMENT
/begin MEASUREMENT autosar_swc_vmp_rtARID_DEF.BusAssignment_f5.axAbs "" FLOAT32_IEEE autosar_swc_vmp_CM_single 0 0 -3.4E+38 3.4E+38 ECU_ADDRESS 0xfe4ce460 /* @ECU_Address@autosar_swc_vmp_rtARID_DEF.BusAssignment_f5.axAbs@ */ /end MEASUREMENT
/begin MEASUREMENT autosar_swc_vmp_rtARID_DEF.BusAssignment_f5.ayAbs "" FLOAT32_IEEE autosar_swc_vmp_CM_single 0 0 -3.4E+38 3.4E+38 ECU_ADDRESS 0xfe4ce464 /* @ECU_Address@autosar_swc_vmp_rtARID_DEF.BusAssignment_f5.ayAbs@ */ /end MEASUREMENT
/begin MEASUREMENT autosar_swc_vmp_rtARID_DEF.BusAssignment_f5.brakeIntention "" UBYTE autosar_swc_vmp_CM_logical 0 0 0 1 ECU_ADDRESS 0xfe4ce442 /* @ECU_Address@autosar_swc_vmp_rtARID_DEF.BusAssignment_f5.brakeIntention@ */ /end MEASUREMENT
/begin MEASUREMENT autosar_swc_vmp_rtARID_DEF.BusAssignment_f5.cutInflg "" UBYTE autosar_swc_vmp_CM_logical 0 0 0 1 ECU_ADDRESS 0xfe4ce441 /* @ECU_Address@autosar_swc_vmp_rtARID_DEF.BusAssignment_f5.cutInflg@ */ /end MEASUREMENT
/begin MEASUREMENT autosar_swc_vmp_rtARID_DEF.BusAssignment_f5.dx "" FLOAT32_IEEE autosar_swc_vmp_CM_single 0 0 -3.4E+38 3.4E+38 ECU_ADDRESS 0xfe4ce448 /* @ECU_Address@autosar_swc_vmp_rtARID_DEF.BusAssignment_f5.dx@ */ /end MEASUREMENT
/begin MEASUREMENT autosar_swc_vmp_rtARID_DEF.BusAssignment_f5.dy "" FLOAT32_IEEE autosar_swc_vmp_CM_single 0 0 -3.4E+38 3.4E+38 ECU_ADDRESS 0xfe4ce44c /* @ECU_Address@autosar_swc_vmp_rtARID_DEF.BusAssignment_f5.dy@ */ /end MEASUREMENT
/begin MEASUREMENT autosar_swc_vmp_rtARID_DEF.BusAssignment_f5.fu_type "" UWORD autosar_swc_vmp_CM_uint16 0 0 0 65535 ECU_ADDRESS 0xfe4ce446 /* @ECU_Address@autosar_swc_vmp_rtARID_DEF.BusAssignment_f5.fu_type@ */ /end MEASUREMENT
/begin MEASUREMENT autosar_swc_vmp_rtARID_DEF.BusAssignment_f5.headingAngle "" FLOAT32_IEEE autosar_swc_vmp_CM_single 0 0 -3.4E+38 3.4E+38 ECU_ADDRESS 0xfe4ce470 /* @ECU_Address@autosar_swc_vmp_rtARID_DEF.BusAssignment_f5.headingAngle@ */ /end MEASUREMENT
/begin MEASUREMENT autosar_swc_vmp_rtARID_DEF.BusAssignment_f5.id "" ULONG autosar_swc_vmp_CM_uint32 0 0 0 4294967295 ECU_ADDRESS 0xfe4ce480 /* @ECU_Address@autosar_swc_vmp_rtARID_DEF.BusAssignment_f5.id@ */ /end MEASUREMENT
/begin MEASUREMENT autosar_swc_vmp_rtARID_DEF.BusAssignment_f5.movingState "" UBYTE autosar_swc_vmp_CM_uint8 0 0 0 255 ECU_ADDRESS 0xfe4ce443 /* @ECU_Address@autosar_swc_vmp_rtARID_DEF.BusAssignment_f5.movingState@ */ /end MEASUREMENT
/begin MEASUREMENT autosar_swc_vmp_rtARID_DEF.BusAssignment_f5.objExist "" FLOAT32_IEEE autosar_swc_vmp_CM_single 0 0 -3.4E+38 3.4E+38 ECU_ADDRESS 0xfe4ce46c /* @ECU_Address@autosar_swc_vmp_rtARID_DEF.BusAssignment_f5.objExist@ */ /end MEASUREMENT
/begin MEASUREMENT autosar_swc_vmp_rtARID_DEF.BusAssignment_f5.orientation "" UBYTE autosar_swc_vmp_CM_uint8 0 0 0 255 ECU_ADDRESS 0xfe4ce444 /* @ECU_Address@autosar_swc_vmp_rtARID_DEF.BusAssignment_f5.orientation@ */ /end MEASUREMENT
/begin MEASUREMENT autosar_swc_vmp_rtARID_DEF.BusAssignment_f5.range "" FLOAT32_IEEE autosar_swc_vmp_CM_single 0 0 -3.4E+38 3.4E+38 ECU_ADDRESS 0xfe4ce468 /* @ECU_Address@autosar_swc_vmp_rtARID_DEF.BusAssignment_f5.range@ */ /end MEASUREMENT
/begin MEASUREMENT autosar_swc_vmp_rtARID_DEF.BusAssignment_f5.targetExist "" UBYTE autosar_swc_vmp_CM_logical 0 0 0 1 ECU_ADDRESS 0xfe4ce440 /* @ECU_Address@autosar_swc_vmp_rtARID_DEF.BusAssignment_f5.targetExist@ */ /end MEASUREMENT
/begin MEASUREMENT autosar_swc_vmp_rtARID_DEF.BusAssignment_f5.type "" UBYTE autosar_swc_vmp_CM_uint8 0 0 0 255 ECU_ADDRESS 0xfe4ce445 /* @ECU_Address@autosar_swc_vmp_rtARID_DEF.BusAssignment_f5.type@ */ /end MEASUREMENT
/begin MEASUREMENT autosar_swc_vmp_rtARID_DEF.BusAssignment_f5.vxAbs "" FLOAT32_IEEE autosar_swc_vmp_CM_single 0 0 -3.4E+38 3.4E+38 ECU_ADDRESS 0xfe4ce458 /* @ECU_Address@autosar_swc_vmp_rtARID_DEF.BusAssignment_f5.vxAbs@ */ /end MEASUREMENT
/begin MEASUREMENT autosar_swc_vmp_rtARID_DEF.BusAssignment_f5.vxRel "" FLOAT32_IEEE autosar_swc_vmp_CM_single 0 0 -3.4E+38 3.4E+38 ECU_ADDRESS 0xfe4ce450 /* @ECU_Address@autosar_swc_vmp_rtARID_DEF.BusAssignment_f5.vxRel@ */ /end MEASUREMENT
/begin MEASUREMENT autosar_swc_vmp_rtARID_DEF.BusAssignment_f5.vyAbs "" FLOAT32_IEEE autosar_swc_vmp_CM_single 0 0 -3.4E+38 3.4E+38 ECU_ADDRESS 0xfe4ce45c /* @ECU_Address@autosar_swc_vmp_rtARID_DEF.BusAssignment_f5.vyAbs@ */ /end MEASUREMENT
/begin MEASUREMENT autosar_swc_vmp_rtARID_DEF.BusAssignment_f5.vyRel "" FLOAT32_IEEE autosar_swc_vmp_CM_single 0 0 -3.4E+38 3.4E+38 ECU_ADDRESS 0xfe4ce454 /* @ECU_Address@autosar_swc_vmp_rtARID_DEF.BusAssignment_f5.vyRel@ */ /end MEASUREMENT
/begin MEASUREMENT autosar_swc_vmp_rtARID_DEF.Cnt "" FLOAT64_IEEE autosar_swc_vmp_CM_double 0 0 -1.7E+308 1.7E+308 ECU_ADDRESS 0xfe4ce5e0 /* @ECU_Address@autosar_swc_vmp_rtARID_DEF.Cnt@ */ /end MEASUREMENT
/begin MEASUREMENT autosar_swc_vmp_rtARID_DEF.Cnt_g "" UBYTE autosar_swc_vmp_CM_uint8 0 0 0 255 ECU_ADDRESS 0xfe4d4246 /* @ECU_Address@autosar_swc_vmp_rtARID_DEF.Cnt_g@ */ /end MEASUREMENT
/begin MEASUREMENT autosar_swc_vmp_rtARID_DEF.Cnt_h "" FLOAT64_IEEE autosar_swc_vmp_CM_double 0 0 -1.7E+308 1.7E+308 ECU_ADDRESS 0xfe4ce5e8 /* @ECU_Address@autosar_swc_vmp_rtARID_DEF.Cnt_h@ */ /end MEASUREMENT
/begin MEASUREMENT autosar_swc_vmp_rtARID_DEF.ICAS_STATEOut.acc_exit_reason "" ULONG autosar_swc_vmp_CM_uint32 0 0 0 4294967295 ECU_ADDRESS 0xfe4ce548 /* @ECU_Address@autosar_swc_vmp_rtARID_DEF.ICAS_STATEOut.acc_exit_reason@ */ /end MEASUREMENT
/begin MEASUREMENT autosar_swc_vmp_rtARID_DEF.ICAS_STATEOut.acc_manual_act_faile_reason "" ULONG autosar_swc_vmp_CM_uint32 0 0 0 4294967295 ECU_ADDRESS 0xfe4ce544 /* @ECU_Address@autosar_swc_vmp_rtARID_DEF.ICAS_STATEOut.acc_manual_act_faile_reason@ */ /end MEASUREMENT
/begin MEASUREMENT autosar_swc_vmp_rtARID_DEF.ICAS_STATEOut.acc_sts "" UBYTE autosar_swc_vmp_CM_uint8 0 0 0 255 ECU_ADDRESS 0xfe4ce53c /* @ECU_Address@autosar_swc_vmp_rtARID_DEF.ICAS_STATEOut.acc_sts@ */ /end MEASUREMENT
/begin MEASUREMENT autosar_swc_vmp_rtARID_DEF.ICAS_STATEOut.alc_sts "" UBYTE autosar_swc_vmp_CM_uint8 0 0 0 255 ECU_ADDRESS 0xfe4ce53f /* @ECU_Address@autosar_swc_vmp_rtARID_DEF.ICAS_STATEOut.alc_sts@ */ /end MEASUREMENT
/begin MEASUREMENT autosar_swc_vmp_rtARID_DEF.ICAS_STATEOut.lc_req_sync_id "" UBYTE autosar_swc_vmp_CM_uint8 0 0 0 255 ECU_ADDRESS 0xfe4ce541 /* @ECU_Address@autosar_swc_vmp_rtARID_DEF.ICAS_STATEOut.lc_req_sync_id@ */ /end MEASUREMENT
/begin MEASUREMENT autosar_swc_vmp_rtARID_DEF.ICAS_STATEOut.lcc_auto_act_faile_reason "" ULONG autosar_swc_vmp_CM_uint32 0 0 0 4294967295 ECU_ADDRESS 0xfe4ce550 /* @ECU_Address@autosar_swc_vmp_rtARID_DEF.ICAS_STATEOut.lcc_auto_act_faile_reason@ */ /end MEASUREMENT
/begin MEASUREMENT autosar_swc_vmp_rtARID_DEF.ICAS_STATEOut.lcc_exit_to_idle_reason "" ULONG autosar_swc_vmp_CM_uint32 0 0 0 4294967295 ECU_ADDRESS 0xfe4ce554 /* @ECU_Address@autosar_swc_vmp_rtARID_DEF.ICAS_STATEOut.lcc_exit_to_idle_reason@ */ /end MEASUREMENT
/begin MEASUREMENT autosar_swc_vmp_rtARID_DEF.ICAS_STATEOut.lcc_exit_to_mrc_reason "" ULONG autosar_swc_vmp_CM_uint32 0 0 0 4294967295 ECU_ADDRESS 0xfe4ce55c /* @ECU_Address@autosar_swc_vmp_rtARID_DEF.ICAS_STATEOut.lcc_exit_to_mrc_reason@ */ /end MEASUREMENT
/begin MEASUREMENT autosar_swc_vmp_rtARID_DEF.ICAS_STATEOut.lcc_exit_to_wait_reason "" ULONG autosar_swc_vmp_CM_uint32 0 0 0 4294967295 ECU_ADDRESS 0xfe4ce558 /* @ECU_Address@autosar_swc_vmp_rtARID_DEF.ICAS_STATEOut.lcc_exit_to_wait_reason@ */ /end MEASUREMENT
/begin MEASUREMENT autosar_swc_vmp_rtARID_DEF.ICAS_STATEOut.lcc_manual_act_faile_reason "" ULONG autosar_swc_vmp_CM_uint32 0 0 0 4294967295 ECU_ADDRESS 0xfe4ce54c /* @ECU_Address@autosar_swc_vmp_rtARID_DEF.ICAS_STATEOut.lcc_manual_act_faile_reason@ */ /end MEASUREMENT
/begin MEASUREMENT autosar_swc_vmp_rtARID_DEF.ICAS_STATEOut.lcc_mrc_exit_reason "" ULONG autosar_swc_vmp_CM_uint32 0 0 0 4294967295 ECU_ADDRESS 0xfe4ce560 /* @ECU_Address@autosar_swc_vmp_rtARID_DEF.ICAS_STATEOut.lcc_mrc_exit_reason@ */ /end MEASUREMENT
/begin MEASUREMENT autosar_swc_vmp_rtARID_DEF.ICAS_STATEOut.lcc_sts "" UBYTE autosar_swc_vmp_CM_uint8 0 0 0 255 ECU_ADDRESS 0xfe4ce53d /* @ECU_Address@autosar_swc_vmp_rtARID_DEF.ICAS_STATEOut.lcc_sts@ */ /end MEASUREMENT
/begin MEASUREMENT autosar_swc_vmp_rtARID_DEF.ICAS_STATEOut.noa_auto_act_faile_reason "" ULONG autosar_swc_vmp_CM_uint32 0 0 0 4294967295 ECU_ADDRESS 0xfe4ce564 /* @ECU_Address@autosar_swc_vmp_rtARID_DEF.ICAS_STATEOut.noa_auto_act_faile_reason@ */ /end MEASUREMENT
/begin MEASUREMENT autosar_swc_vmp_rtARID_DEF.ICAS_STATEOut.noa_exit_reason "" ULONG autosar_swc_vmp_CM_uint32 0 0 0 4294967295 ECU_ADDRESS 0xfe4ce568 /* @ECU_Address@autosar_swc_vmp_rtARID_DEF.ICAS_STATEOut.noa_exit_reason@ */ /end MEASUREMENT
/begin MEASUREMENT autosar_swc_vmp_rtARID_DEF.ICAS_STATEOut.noa_sts "" UBYTE autosar_swc_vmp_CM_uint8 0 0 0 255 ECU_ADDRESS 0xfe4ce540 /* @ECU_Address@autosar_swc_vmp_rtARID_DEF.ICAS_STATEOut.noa_sts@ */ /end MEASUREMENT
/begin MEASUREMENT autosar_swc_vmp_rtARID_DEF.ICAS_STATEOut.nudge_sts "" UBYTE autosar_swc_vmp_CM_uint8 0 0 0 255 ECU_ADDRESS 0xfe4ce53e /* @ECU_Address@autosar_swc_vmp_rtARID_DEF.ICAS_STATEOut.nudge_sts@ */ /end MEASUREMENT
/begin MEASUREMENT autosar_swc_vmp_rtARID_DEF.Switch.Object_Hight "" FLOAT32_IEEE autosar_swc_vmp_CM_single 0 0 -3.4E+38 3.4E+38 ECU_ADDRESS 0xfe4ce3dc /* @ECU_Address@autosar_swc_vmp_rtARID_DEF.Switch.Object_Hight@ */ /end MEASUREMENT
/begin MEASUREMENT autosar_swc_vmp_rtARID_DEF.Switch.Object_Length "" FLOAT32_IEEE autosar_swc_vmp_CM_single 0 0 -3.4E+38 3.4E+38 ECU_ADDRESS 0xfe4ce3d4 /* @ECU_Address@autosar_swc_vmp_rtARID_DEF.Switch.Object_Length@ */ /end MEASUREMENT
/begin MEASUREMENT autosar_swc_vmp_rtARID_DEF.Switch.Object_Width "" FLOAT32_IEEE autosar_swc_vmp_CM_single 0 0 -3.4E+38 3.4E+38 ECU_ADDRESS 0xfe4ce3d8 /* @ECU_Address@autosar_swc_vmp_rtARID_DEF.Switch.Object_Width@ */ /end MEASUREMENT
/begin MEASUREMENT autosar_swc_vmp_rtARID_DEF.Switch.age "" A_UINT64 autosar_swc_vmp_CM_uint64 0 0 0 18446744073709551615 ECU_ADDRESS 0xfe4ce3e8 /* @ECU_Address@autosar_swc_vmp_rtARID_DEF.Switch.age@ */ /end MEASUREMENT
/begin MEASUREMENT autosar_swc_vmp_rtARID_DEF.Switch.axAbs "" FLOAT32_IEEE autosar_swc_vmp_CM_single 0 0 -3.4E+38 3.4E+38 ECU_ADDRESS 0xfe4ce3c0 /* @ECU_Address@autosar_swc_vmp_rtARID_DEF.Switch.axAbs@ */ /end MEASUREMENT
/begin MEASUREMENT autosar_swc_vmp_rtARID_DEF.Switch.ayAbs "" FLOAT32_IEEE autosar_swc_vmp_CM_single 0 0 -3.4E+38 3.4E+38 ECU_ADDRESS 0xfe4ce3c4 /* @ECU_Address@autosar_swc_vmp_rtARID_DEF.Switch.ayAbs@ */ /end MEASUREMENT
/begin MEASUREMENT autosar_swc_vmp_rtARID_DEF.Switch.brakeIntention "" UBYTE autosar_swc_vmp_CM_logical 0 0 0 1 ECU_ADDRESS 0xfe4ce3a2 /* @ECU_Address@autosar_swc_vmp_rtARID_DEF.Switch.brakeIntention@ */ /end MEASUREMENT
/begin MEASUREMENT autosar_swc_vmp_rtARID_DEF.Switch.cutInflg "" UBYTE autosar_swc_vmp_CM_logical 0 0 0 1 ECU_ADDRESS 0xfe4ce3a1 /* @ECU_Address@autosar_swc_vmp_rtARID_DEF.Switch.cutInflg@ */ /end MEASUREMENT
/begin MEASUREMENT autosar_swc_vmp_rtARID_DEF.Switch.dx "" FLOAT32_IEEE autosar_swc_vmp_CM_single 0 0 -3.4E+38 3.4E+38 ECU_ADDRESS 0xfe4ce3a8 /* @ECU_Address@autosar_swc_vmp_rtARID_DEF.Switch.dx@ */ /end MEASUREMENT
/begin MEASUREMENT autosar_swc_vmp_rtARID_DEF.Switch.dy "" FLOAT32_IEEE autosar_swc_vmp_CM_single 0 0 -3.4E+38 3.4E+38 ECU_ADDRESS 0xfe4ce3ac /* @ECU_Address@autosar_swc_vmp_rtARID_DEF.Switch.dy@ */ /end MEASUREMENT
/begin MEASUREMENT autosar_swc_vmp_rtARID_DEF.Switch.fu_type "" UWORD autosar_swc_vmp_CM_uint16 0 0 0 65535 ECU_ADDRESS 0xfe4ce3a6 /* @ECU_Address@autosar_swc_vmp_rtARID_DEF.Switch.fu_type@ */ /end MEASUREMENT
/begin MEASUREMENT autosar_swc_vmp_rtARID_DEF.Switch.headingAngle "" FLOAT32_IEEE autosar_swc_vmp_CM_single 0 0 -3.4E+38 3.4E+38 ECU_ADDRESS 0xfe4ce3d0 /* @ECU_Address@autosar_swc_vmp_rtARID_DEF.Switch.headingAngle@ */ /end MEASUREMENT
/begin MEASUREMENT autosar_swc_vmp_rtARID_DEF.Switch.id "" ULONG autosar_swc_vmp_CM_uint32 0 0 0 4294967295 ECU_ADDRESS 0xfe4ce3e0 /* @ECU_Address@autosar_swc_vmp_rtARID_DEF.Switch.id@ */ /end MEASUREMENT
/begin MEASUREMENT autosar_swc_vmp_rtARID_DEF.Switch.movingState "" UBYTE autosar_swc_vmp_CM_uint8 0 0 0 255 ECU_ADDRESS 0xfe4ce3a3 /* @ECU_Address@autosar_swc_vmp_rtARID_DEF.Switch.movingState@ */ /end MEASUREMENT
/begin MEASUREMENT autosar_swc_vmp_rtARID_DEF.Switch.objExist "" FLOAT32_IEEE autosar_swc_vmp_CM_single 0 0 -3.4E+38 3.4E+38 ECU_ADDRESS 0xfe4ce3cc /* @ECU_Address@autosar_swc_vmp_rtARID_DEF.Switch.objExist@ */ /end MEASUREMENT
/begin MEASUREMENT autosar_swc_vmp_rtARID_DEF.Switch.orientation "" UBYTE autosar_swc_vmp_CM_uint8 0 0 0 255 ECU_ADDRESS 0xfe4ce3a4 /* @ECU_Address@autosar_swc_vmp_rtARID_DEF.Switch.orientation@ */ /end MEASUREMENT
/begin MEASUREMENT autosar_swc_vmp_rtARID_DEF.Switch.range "" FLOAT32_IEEE autosar_swc_vmp_CM_single 0 0 -3.4E+38 3.4E+38 ECU_ADDRESS 0xfe4ce3c8 /* @ECU_Address@autosar_swc_vmp_rtARID_DEF.Switch.range@ */ /end MEASUREMENT
/begin MEASUREMENT autosar_swc_vmp_rtARID_DEF.Switch.targetExist "" UBYTE autosar_swc_vmp_CM_logical 0 0 0 1 ECU_ADDRESS 0xfe4ce3a0 /* @ECU_Address@autosar_swc_vmp_rtARID_DEF.Switch.targetExist@ */ /end MEASUREMENT
/begin MEASUREMENT autosar_swc_vmp_rtARID_DEF.Switch.type "" UBYTE autosar_swc_vmp_CM_uint8 0 0 0 255 ECU_ADDRESS 0xfe4ce3a5 /* @ECU_Address@autosar_swc_vmp_rtARID_DEF.Switch.type@ */ /end MEASUREMENT
/begin MEASUREMENT autosar_swc_vmp_rtARID_DEF.Switch.vxAbs "" FLOAT32_IEEE autosar_swc_vmp_CM_single 0 0 -3.4E+38 3.4E+38 ECU_ADDRESS 0xfe4ce3b8 /* @ECU_Address@autosar_swc_vmp_rtARID_DEF.Switch.vxAbs@ */ /end MEASUREMENT
/begin MEASUREMENT autosar_swc_vmp_rtARID_DEF.Switch.vxRel "" FLOAT32_IEEE autosar_swc_vmp_CM_single 0 0 -3.4E+38 3.4E+38 ECU_ADDRESS 0xfe4ce3b0 /* @ECU_Address@autosar_swc_vmp_rtARID_DEF.Switch.vxRel@ */ /end MEASUREMENT
/begin MEASUREMENT autosar_swc_vmp_rtARID_DEF.Switch.vyAbs "" FLOAT32_IEEE autosar_swc_vmp_CM_single 0 0 -3.4E+38 3.4E+38 ECU_ADDRESS 0xfe4ce3bc /* @ECU_Address@autosar_swc_vmp_rtARID_DEF.Switch.vyAbs@ */ /end MEASUREMENT
/begin MEASUREMENT autosar_swc_vmp_rtARID_DEF.Switch.vyRel "" FLOAT32_IEEE autosar_swc_vmp_CM_single 0 0 -3.4E+38 3.4E+38 ECU_ADDRESS 0xfe4ce3b4 /* @ECU_Address@autosar_swc_vmp_rtARID_DEF.Switch.vyRel@ */ /end MEASUREMENT
/begin MEASUREMENT autosar_swc_vmp_rtARID_DEF.TappedDelay1_X "" FLOAT32_IEEE autosar_swc_vmp_CM_single 0 0 -3.4E+38 3.4E+38 LAYOUT COLUMN_DIR MATRIX_DIM 19 ECU_ADDRESS 0xfe4ce750 /* @ECU_Address@autosar_swc_vmp_rtARID_DEF.TappedDelay1_X@ */ /end MEASUREMENT
/begin MEASUREMENT autosar_swc_vmp_rtARID_DEF.TappedDelay_X_n "" UBYTE autosar_swc_vmp_CM_uint8 0 0 0 255 ECU_ADDRESS 0xfe4d423b /* @ECU_Address@autosar_swc_vmp_rtARID_DEF.TappedDelay_X_n@ */ /end MEASUREMENT
/begin MEASUREMENT autosar_swc_vmp_rtARID_DEF.TmpSignalConversionAtCSM_CTRLOutport1.CruiseSpdCtrlLevel "" UBYTE autosar_swc_vmp_CM_uint8 0 0 0 255 ECU_ADDRESS 0xfe4ce5c1 /* @ECU_Address@autosar_swc_vmp_rtARID_DEF.TmpSignalConversionAtCSM_CTRLOutport1.CruiseSpdCtrlLevel@ */ /end MEASUREMENT
/begin MEASUREMENT autosar_swc_vmp_rtARID_DEF.TmpSignalConversionAtCSM_CTRLOutport1.CruiseSpdKmh "" FLOAT32_IEEE autosar_swc_vmp_CM_single 0 0 -3.4E+38 3.4E+38 ECU_ADDRESS 0xfe4ce5c4 /* @ECU_Address@autosar_swc_vmp_rtARID_DEF.TmpSignalConversionAtCSM_CTRLOutport1.CruiseSpdKmh@ */ /end MEASUREMENT
/begin MEASUREMENT autosar_swc_vmp_rtARID_DEF.TmpSignalConversionAtCSM_CTRLOutport1.ISL_APSpdLimDist "" FLOAT32_IEEE autosar_swc_vmp_CM_single 0 0 -3.4E+38 3.4E+38 ECU_ADDRESS 0xfe4ce5cc /* @ECU_Address@autosar_swc_vmp_rtARID_DEF.TmpSignalConversionAtCSM_CTRLOutport1.ISL_APSpdLimDist@ */ /end MEASUREMENT
/begin MEASUREMENT autosar_swc_vmp_rtARID_DEF.TmpSignalConversionAtCSM_CTRLOutport1.ISL_APSpdLimSPL "" FLOAT32_IEEE autosar_swc_vmp_CM_single 0 0 -3.4E+38 3.4E+38 ECU_ADDRESS 0xfe4ce5c8 /* @ECU_Address@autosar_swc_vmp_rtARID_DEF.TmpSignalConversionAtCSM_CTRLOutport1.ISL_APSpdLimSPL@ */ /end MEASUREMENT
/begin MEASUREMENT autosar_swc_vmp_rtARID_DEF.TmpSignalConversionAtCSM_CTRLOutport1.TimeGapLevel "" UBYTE autosar_swc_vmp_CM_uint8 0 0 0 255 ECU_ADDRESS 0xfe4ce5c2 /* @ECU_Address@autosar_swc_vmp_rtARID_DEF.TmpSignalConversionAtCSM_CTRLOutport1.TimeGapLevel@ */ /end MEASUREMENT
/begin MEASUREMENT autosar_swc_vmp_rtARID_DEF.TmpSignalConversionAtCSM_CTRLOutport1.VsetBelowMin "" UBYTE autosar_swc_vmp_CM_logical 0 0 0 1 ECU_ADDRESS 0xfe4ce5c0 /* @ECU_Address@autosar_swc_vmp_rtARID_DEF.TmpSignalConversionAtCSM_CTRLOutport1.VsetBelowMin@ */ /end MEASUREMENT
/begin MEASUREMENT autosar_swc_vmp_rtARID_DEF.TmpSignalConversionAtEVM_CIPVOutport1[0].accel_gnd.mod "" FLOAT32_IEEE autosar_swc_vmp_CM_single 0 0 -3.4E+38 3.4E+38 ECU_ADDRESS 0xfe4cdc94 /* @ECU_Address@autosar_swc_vmp_rtARID_DEF.TmpSignalConversionAtEVM_CIPVOutport1[0].accel_gnd.mod@ */ /end MEASUREMENT
/begin MEASUREMENT autosar_swc_vmp_rtARID_DEF.TmpSignalConversionAtEVM_CIPVOutport1[0].accel_gnd.x "" FLOAT32_IEEE autosar_swc_vmp_CM_single 0 0 -3.4E+38 3.4E+38 ECU_ADDRESS 0xfe4cdc8c /* @ECU_Address@autosar_swc_vmp_rtARID_DEF.TmpSignalConversionAtEVM_CIPVOutport1[0].accel_gnd.x@ */ /end MEASUREMENT
/begin MEASUREMENT autosar_swc_vmp_rtARID_DEF.TmpSignalConversionAtEVM_CIPVOutport1[0].accel_gnd.y "" FLOAT32_IEEE autosar_swc_vmp_CM_single 0 0 -3.4E+38 3.4E+38 ECU_ADDRESS 0xfe4cdc90 /* @ECU_Address@autosar_swc_vmp_rtARID_DEF.TmpSignalConversionAtEVM_CIPVOutport1[0].accel_gnd.y@ */ /end MEASUREMENT
/begin MEASUREMENT autosar_swc_vmp_rtARID_DEF.TmpSignalConversionAtEVM_CIPVOutport1[0].accel_gnd_sl.mod "" FLOAT32_IEEE autosar_swc_vmp_CM_single 0 0 -3.4E+38 3.4E+38 ECU_ADDRESS 0xfe4cdcac /* @ECU_Address@autosar_swc_vmp_rtARID_DEF.TmpSignalConversionAtEVM_CIPVOutport1[0].accel_gnd_sl.mod@ */ /end MEASUREMENT
/begin MEASUREMENT autosar_swc_vmp_rtARID_DEF.TmpSignalConversionAtEVM_CIPVOutport1[0].accel_gnd_sl.x "" FLOAT32_IEEE autosar_swc_vmp_CM_single 0 0 -3.4E+38 3.4E+38 ECU_ADDRESS 0xfe4cdca4 /* @ECU_Address@autosar_swc_vmp_rtARID_DEF.TmpSignalConversionAtEVM_CIPVOutport1[0].accel_gnd_sl.x@ */ /end MEASUREMENT
/begin MEASUREMENT autosar_swc_vmp_rtARID_DEF.TmpSignalConversionAtEVM_CIPVOutport1[0].accel_gnd_sl.y "" FLOAT32_IEEE autosar_swc_vmp_CM_single 0 0 -3.4E+38 3.4E+38 ECU_ADDRESS 0xfe4cdca8 /* @ECU_Address@autosar_swc_vmp_rtARID_DEF.TmpSignalConversionAtEVM_CIPVOutport1[0].accel_gnd_sl.y@ */ /end MEASUREMENT
/begin MEASUREMENT autosar_swc_vmp_rtARID_DEF.TmpSignalConversionAtEVM_CIPVOutport1[0].box.corner_x_vec "" FLOAT32_IEEE autosar_swc_vmp_CM_single 0 0 -3.4E+38 3.4E+38 LAYOUT COLUMN_DIR MATRIX_DIM 4 ECU_ADDRESS 0xfe4cdc3c /* @ECU_Address@autosar_swc_vmp_rtARID_DEF.TmpSignalConversionAtEVM_CIPVOutport1[0].box.corner_x_vec@ */ /end MEASUREMENT
/begin MEASUREMENT autosar_swc_vmp_rtARID_DEF.TmpSignalConversionAtEVM_CIPVOutport1[0].box.corner_y_vec "" FLOAT32_IEEE autosar_swc_vmp_CM_single 0 0 -3.4E+38 3.4E+38 LAYOUT COLUMN_DIR MATRIX_DIM 4 ECU_ADDRESS 0xfe4cdc4c /* @ECU_Address@autosar_swc_vmp_rtARID_DEF.TmpSignalConversionAtEVM_CIPVOutport1[0].box.corner_y_vec@ */ /end MEASUREMENT
/begin MEASUREMENT autosar_swc_vmp_rtARID_DEF.TmpSignalConversionAtEVM_CIPVOutport1[0].class_type "" UBYTE autosar_swc_vmp_CM_uint8 0 0 0 255 ECU_ADDRESS 0xfe4cdc32 /* @ECU_Address@autosar_swc_vmp_rtARID_DEF.TmpSignalConversionAtEVM_CIPVOutport1[0].class_type@ */ /end MEASUREMENT
/begin MEASUREMENT autosar_swc_vmp_rtARID_DEF.TmpSignalConversionAtEVM_CIPVOutport1[0].cut_type "" UBYTE autosar_swc_vmp_CM_uint8 0 0 0 255 ECU_ADDRESS 0xfe4cdc33 /* @ECU_Address@autosar_swc_vmp_rtARID_DEF.TmpSignalConversionAtEVM_CIPVOutport1[0].cut_type@ */ /end MEASUREMENT
/begin MEASUREMENT autosar_swc_vmp_rtARID_DEF.TmpSignalConversionAtEVM_CIPVOutport1[0].fus_type "" UBYTE autosar_swc_vmp_CM_uint8 0 0 0 255 ECU_ADDRESS 0xfe4cdc31 /* @ECU_Address@autosar_swc_vmp_rtARID_DEF.TmpSignalConversionAtEVM_CIPVOutport1[0].fus_type@ */ /end MEASUREMENT
/begin MEASUREMENT autosar_swc_vmp_rtARID_DEF.TmpSignalConversionAtEVM_CIPVOutport1[0].id "" ULONG autosar_swc_vmp_CM_uint32 0 0 0 4294967295 ECU_ADDRESS 0xfe4cdc38 /* @ECU_Address@autosar_swc_vmp_rtARID_DEF.TmpSignalConversionAtEVM_CIPVOutport1[0].id@ */ /end MEASUREMENT
/begin MEASUREMENT autosar_swc_vmp_rtARID_DEF.TmpSignalConversionAtEVM_CIPVOutport1[0].meas_state "" UBYTE autosar_swc_vmp_CM_uint8 0 0 0 255 ECU_ADDRESS 0xfe4cdc30 /* @ECU_Address@autosar_swc_vmp_rtARID_DEF.TmpSignalConversionAtEVM_CIPVOutport1[0].meas_state@ */ /end MEASUREMENT
/begin MEASUREMENT autosar_swc_vmp_rtARID_DEF.TmpSignalConversionAtEVM_CIPVOutport1[0].position.heading_angle "" FLOAT32_IEEE autosar_swc_vmp_CM_single 0 0 -3.4E+38 3.4E+38 ECU_ADDRESS 0xfe4cdc64 /* @ECU_Address@autosar_swc_vmp_rtARID_DEF.TmpSignalConversionAtEVM_CIPVOutport1[0].position.heading_angle@ */ /end MEASUREMENT
/begin MEASUREMENT autosar_swc_vmp_rtARID_DEF.TmpSignalConversionAtEVM_CIPVOutport1[0].position.x "" FLOAT32_IEEE autosar_swc_vmp_CM_single 0 0 -3.4E+38 3.4E+38 ECU_ADDRESS 0xfe4cdc5c /* @ECU_Address@autosar_swc_vmp_rtARID_DEF.TmpSignalConversionAtEVM_CIPVOutport1[0].position.x@ */ /end MEASUREMENT
/begin MEASUREMENT autosar_swc_vmp_rtARID_DEF.TmpSignalConversionAtEVM_CIPVOutport1[0].position.y "" FLOAT32_IEEE autosar_swc_vmp_CM_single 0 0 -3.4E+38 3.4E+38 ECU_ADDRESS 0xfe4cdc60 /* @ECU_Address@autosar_swc_vmp_rtARID_DEF.TmpSignalConversionAtEVM_CIPVOutport1[0].position.y@ */ /end MEASUREMENT
/begin MEASUREMENT autosar_swc_vmp_rtARID_DEF.TmpSignalConversionAtEVM_CIPVOutport1[0].position_sl.heading_angle "" FLOAT32_IEEE autosar_swc_vmp_CM_single 0 0 -3.4E+38 3.4E+38 ECU_ADDRESS 0xfe4cdc70 /* @ECU_Address@autosar_swc_vmp_rtARID_DEF.TmpSignalConversionAtEVM_CIPVOutport1[0].position_sl.heading_angle@ */ /end MEASUREMENT
/begin MEASUREMENT autosar_swc_vmp_rtARID_DEF.TmpSignalConversionAtEVM_CIPVOutport1[0].position_sl.x "" FLOAT32_IEEE autosar_swc_vmp_CM_single 0 0 -3.4E+38 3.4E+38 ECU_ADDRESS 0xfe4cdc68 /* @ECU_Address@autosar_swc_vmp_rtARID_DEF.TmpSignalConversionAtEVM_CIPVOutport1[0].position_sl.x@ */ /end MEASUREMENT
/begin MEASUREMENT autosar_swc_vmp_rtARID_DEF.TmpSignalConversionAtEVM_CIPVOutport1[0].position_sl.y "" FLOAT32_IEEE autosar_swc_vmp_CM_single 0 0 -3.4E+38 3.4E+38 ECU_ADDRESS 0xfe4cdc6c /* @ECU_Address@autosar_swc_vmp_rtARID_DEF.TmpSignalConversionAtEVM_CIPVOutport1[0].position_sl.y@ */ /end MEASUREMENT
/begin MEASUREMENT autosar_swc_vmp_rtARID_DEF.TmpSignalConversionAtEVM_CIPVOutport1[0].ref_lane_id "" UBYTE autosar_swc_vmp_CM_uint8 0 0 0 255 ECU_ADDRESS 0xfe4cdc34 /* @ECU_Address@autosar_swc_vmp_rtARID_DEF.TmpSignalConversionAtEVM_CIPVOutport1[0].ref_lane_id@ */ /end MEASUREMENT
/begin MEASUREMENT autosar_swc_vmp_rtARID_DEF.TmpSignalConversionAtEVM_CIPVOutport1[0].size.higth "" FLOAT32_IEEE autosar_swc_vmp_CM_single 0 0 -3.4E+38 3.4E+38 ECU_ADDRESS 0xfe4cdc7c /* @ECU_Address@autosar_swc_vmp_rtARID_DEF.TmpSignalConversionAtEVM_CIPVOutport1[0].size.higth@ */ /end MEASUREMENT
/begin MEASUREMENT autosar_swc_vmp_rtARID_DEF.TmpSignalConversionAtEVM_CIPVOutport1[0].size.length "" FLOAT32_IEEE autosar_swc_vmp_CM_single 0 0 -3.4E+38 3.4E+38 ECU_ADDRESS 0xfe4cdc74 /* @ECU_Address@autosar_swc_vmp_rtARID_DEF.TmpSignalConversionAtEVM_CIPVOutport1[0].size.length@ */ /end MEASUREMENT
/begin MEASUREMENT autosar_swc_vmp_rtARID_DEF.TmpSignalConversionAtEVM_CIPVOutport1[0].size.width "" FLOAT32_IEEE autosar_swc_vmp_CM_single 0 0 -3.4E+38 3.4E+38 ECU_ADDRESS 0xfe4cdc78 /* @ECU_Address@autosar_swc_vmp_rtARID_DEF.TmpSignalConversionAtEVM_CIPVOutport1[0].size.width@ */ /end MEASUREMENT
/begin MEASUREMENT autosar_swc_vmp_rtARID_DEF.TmpSignalConversionAtEVM_CIPVOutport1[0].velocity_gnd.mod "" FLOAT32_IEEE autosar_swc_vmp_CM_single 0 0 -3.4E+38 3.4E+38 ECU_ADDRESS 0xfe4cdc88 /* @ECU_Address@autosar_swc_vmp_rtARID_DEF.TmpSignalConversionAtEVM_CIPVOutport1[0].velocity_gnd.mod@ */ /end MEASUREMENT
/begin MEASUREMENT autosar_swc_vmp_rtARID_DEF.TmpSignalConversionAtEVM_CIPVOutport1[0].velocity_gnd.x "" FLOAT32_IEEE autosar_swc_vmp_CM_single 0 0 -3.4E+38 3.4E+38 ECU_ADDRESS 0xfe4cdc80 /* @ECU_Address@autosar_swc_vmp_rtARID_DEF.TmpSignalConversionAtEVM_CIPVOutport1[0].velocity_gnd.x@ */ /end MEASUREMENT
/begin MEASUREMENT autosar_swc_vmp_rtARID_DEF.TmpSignalConversionAtEVM_CIPVOutport1[0].velocity_gnd.y "" FLOAT32_IEEE autosar_swc_vmp_CM_single 0 0 -3.4E+38 3.4E+38 ECU_ADDRESS 0xfe4cdc84 /* @ECU_Address@autosar_swc_vmp_rtARID_DEF.TmpSignalConversionAtEVM_CIPVOutport1[0].velocity_gnd.y@ */ /end MEASUREMENT
/begin MEASUREMENT autosar_swc_vmp_rtARID_DEF.TmpSignalConversionAtEVM_CIPVOutport1[0].velocity_gnd_sl.mod "" FLOAT32_IEEE autosar_swc_vmp_CM_single 0 0 -3.4E+38 3.4E+38 ECU_ADDRESS 0xfe4cdca0 /* @ECU_Address@autosar_swc_vmp_rtARID_DEF.TmpSignalConversionAtEVM_CIPVOutport1[0].velocity_gnd_sl.mod@ */ /end MEASUREMENT
/begin MEASUREMENT autosar_swc_vmp_rtARID_DEF.TmpSignalConversionAtEVM_CIPVOutport1[0].velocity_gnd_sl.x "" FLOAT32_IEEE autosar_swc_vmp_CM_single 0 0 -3.4E+38 3.4E+38 ECU_ADDRESS 0xfe4cdc98 /* @ECU_Address@autosar_swc_vmp_rtARID_DEF.TmpSignalConversionAtEVM_CIPVOutport1[0].velocity_gnd_sl.x@ */ /end MEASUREMENT
/begin MEASUREMENT autosar_swc_vmp_rtARID_DEF.TmpSignalConversionAtEVM_CIPVOutport1[0].velocity_gnd_sl.y "" FLOAT32_IEEE autosar_swc_vmp_CM_single 0 0 -3.4E+38 3.4E+38 ECU_ADDRESS 0xfe4cdc9c /* @ECU_Address@autosar_swc_vmp_rtARID_DEF.TmpSignalConversionAtEVM_CIPVOutport1[0].velocity_gnd_sl.y@ */ /end MEASUREMENT
/begin MEASUREMENT autosar_swc_vmp_rtARID_DEF.TmpSignalConversionAtEVM_CIPVOutport1[1].accel_gnd.mod "" FLOAT32_IEEE autosar_swc_vmp_CM_single 0 0 -3.4E+38 3.4E+38 ECU_ADDRESS 0xfe4cdd14 /* @ECU_Address@autosar_swc_vmp_rtARID_DEF.TmpSignalConversionAtEVM_CIPVOutport1[1].accel_gnd.mod@ */ /end MEASUREMENT
/begin MEASUREMENT autosar_swc_vmp_rtARID_DEF.TmpSignalConversionAtEVM_CIPVOutport1[1].accel_gnd.x "" FLOAT32_IEEE autosar_swc_vmp_CM_single 0 0 -3.4E+38 3.4E+38 ECU_ADDRESS 0xfe4cdd0c /* @ECU_Address@autosar_swc_vmp_rtARID_DEF.TmpSignalConversionAtEVM_CIPVOutport1[1].accel_gnd.x@ */ /end MEASUREMENT
/begin MEASUREMENT autosar_swc_vmp_rtARID_DEF.TmpSignalConversionAtEVM_CIPVOutport1[1].accel_gnd.y "" FLOAT32_IEEE autosar_swc_vmp_CM_single 0 0 -3.4E+38 3.4E+38 ECU_ADDRESS 0xfe4cdd10 /* @ECU_Address@autosar_swc_vmp_rtARID_DEF.TmpSignalConversionAtEVM_CIPVOutport1[1].accel_gnd.y@ */ /end MEASUREMENT
/begin MEASUREMENT autosar_swc_vmp_rtARID_DEF.TmpSignalConversionAtEVM_CIPVOutport1[1].accel_gnd_sl.mod "" FLOAT32_IEEE autosar_swc_vmp_CM_single 0 0 -3.4E+38 3.4E+38 ECU_ADDRESS 0xfe4cdd2c /* @ECU_Address@autosar_swc_vmp_rtARID_DEF.TmpSignalConversionAtEVM_CIPVOutport1[1].accel_gnd_sl.mod@ */ /end MEASUREMENT
/begin MEASUREMENT autosar_swc_vmp_rtARID_DEF.TmpSignalConversionAtEVM_CIPVOutport1[1].accel_gnd_sl.x "" FLOAT32_IEEE autosar_swc_vmp_CM_single 0 0 -3.4E+38 3.4E+38 ECU_ADDRESS 0xfe4cdd24 /* @ECU_Address@autosar_swc_vmp_rtARID_DEF.TmpSignalConversionAtEVM_CIPVOutport1[1].accel_gnd_sl.x@ */ /end MEASUREMENT
/begin MEASUREMENT autosar_swc_vmp_rtARID_DEF.TmpSignalConversionAtEVM_CIPVOutport1[1].accel_gnd_sl.y "" FLOAT32_IEEE autosar_swc_vmp_CM_single 0 0 -3.4E+38 3.4E+38 ECU_ADDRESS 0xfe4cdd28 /* @ECU_Address@autosar_swc_vmp_rtARID_DEF.TmpSignalConversionAtEVM_CIPVOutport1[1].accel_gnd_sl.y@ */ /end MEASUREMENT
/begin MEASUREMENT autosar_swc_vmp_rtARID_DEF.TmpSignalConversionAtEVM_CIPVOutport1[1].box.corner_x_vec "" FLOAT32_IEEE autosar_swc_vmp_CM_single 0 0 -3.4E+38 3.4E+38 LAYOUT COLUMN_DIR MATRIX_DIM 4 ECU_ADDRESS 0xfe4cdcbc /* @ECU_Address@autosar_swc_vmp_rtARID_DEF.TmpSignalConversionAtEVM_CIPVOutport1[1].box.corner_x_vec@ */ /end MEASUREMENT
/begin MEASUREMENT autosar_swc_vmp_rtARID_DEF.TmpSignalConversionAtEVM_CIPVOutport1[1].box.corner_y_vec "" FLOAT32_IEEE autosar_swc_vmp_CM_single 0 0 -3.4E+38 3.4E+38 LAYOUT COLUMN_DIR MATRIX_DIM 4 ECU_ADDRESS 0xfe4cdccc /* @ECU_Address@autosar_swc_vmp_rtARID_DEF.TmpSignalConversionAtEVM_CIPVOutport1[1].box.corner_y_vec@ */ /end MEASUREMENT
/begin MEASUREMENT autosar_swc_vmp_rtARID_DEF.TmpSignalConversionAtEVM_CIPVOutport1[1].class_type "" UBYTE autosar_swc_vmp_CM_uint8 0 0 0 255 ECU_ADDRESS 0xfe4cdcb2 /* @ECU_Address@autosar_swc_vmp_rtARID_DEF.TmpSignalConversionAtEVM_CIPVOutport1[1].class_type@ */ /end MEASUREMENT
/begin MEASUREMENT autosar_swc_vmp_rtARID_DEF.TmpSignalConversionAtEVM_CIPVOutport1[1].cut_type "" UBYTE autosar_swc_vmp_CM_uint8 0 0 0 255 ECU_ADDRESS 0xfe4cdcb3 /* @ECU_Address@autosar_swc_vmp_rtARID_DEF.TmpSignalConversionAtEVM_CIPVOutport1[1].cut_type@ */ /end MEASUREMENT
/begin MEASUREMENT autosar_swc_vmp_rtARID_DEF.TmpSignalConversionAtEVM_CIPVOutport1[1].fus_type "" UBYTE autosar_swc_vmp_CM_uint8 0 0 0 255 ECU_ADDRESS 0xfe4cdcb1 /* @ECU_Address@autosar_swc_vmp_rtARID_DEF.TmpSignalConversionAtEVM_CIPVOutport1[1].fus_type@ */ /end MEASUREMENT
/begin MEASUREMENT autosar_swc_vmp_rtARID_DEF.TmpSignalConversionAtEVM_CIPVOutport1[1].id "" ULONG autosar_swc_vmp_CM_uint32 0 0 0 4294967295 ECU_ADDRESS 0xfe4cdcb8 /* @ECU_Address@autosar_swc_vmp_rtARID_DEF.TmpSignalConversionAtEVM_CIPVOutport1[1].id@ */ /end MEASUREMENT
/begin MEASUREMENT autosar_swc_vmp_rtARID_DEF.TmpSignalConversionAtEVM_CIPVOutport1[1].meas_state "" UBYTE autosar_swc_vmp_CM_uint8 0 0 0 255 ECU_ADDRESS 0xfe4cdcb0 /* @ECU_Address@autosar_swc_vmp_rtARID_DEF.TmpSignalConversionAtEVM_CIPVOutport1[1].meas_state@ */ /end MEASUREMENT
/begin MEASUREMENT autosar_swc_vmp_rtARID_DEF.TmpSignalConversionAtEVM_CIPVOutport1[1].position.heading_angle "" FLOAT32_IEEE autosar_swc_vmp_CM_single 0 0 -3.4E+38 3.4E+38 ECU_ADDRESS 0xfe4cdce4 /* @ECU_Address@autosar_swc_vmp_rtARID_DEF.TmpSignalConversionAtEVM_CIPVOutport1[1].position.heading_angle@ */ /end MEASUREMENT
/begin MEASUREMENT autosar_swc_vmp_rtARID_DEF.TmpSignalConversionAtEVM_CIPVOutport1[1].position.x "" FLOAT32_IEEE autosar_swc_vmp_CM_single 0 0 -3.4E+38 3.4E+38 ECU_ADDRESS 0xfe4cdcdc /* @ECU_Address@autosar_swc_vmp_rtARID_DEF.TmpSignalConversionAtEVM_CIPVOutport1[1].position.x@ */ /end MEASUREMENT
/begin MEASUREMENT autosar_swc_vmp_rtARID_DEF.TmpSignalConversionAtEVM_CIPVOutport1[1].position.y "" FLOAT32_IEEE autosar_swc_vmp_CM_single 0 0 -3.4E+38 3.4E+38 ECU_ADDRESS 0xfe4cdce0 /* @ECU_Address@autosar_swc_vmp_rtARID_DEF.TmpSignalConversionAtEVM_CIPVOutport1[1].position.y@ */ /end MEASUREMENT
/begin MEASUREMENT autosar_swc_vmp_rtARID_DEF.TmpSignalConversionAtEVM_CIPVOutport1[1].position_sl.heading_angle "" FLOAT32_IEEE autosar_swc_vmp_CM_single 0 0 -3.4E+38 3.4E+38 ECU_ADDRESS 0xfe4cdcf0 /* @ECU_Address@autosar_swc_vmp_rtARID_DEF.TmpSignalConversionAtEVM_CIPVOutport1[1].position_sl.heading_angle@ */ /end MEASUREMENT
/begin MEASUREMENT autosar_swc_vmp_rtARID_DEF.TmpSignalConversionAtEVM_CIPVOutport1[1].position_sl.x "" FLOAT32_IEEE autosar_swc_vmp_CM_single 0 0 -3.4E+38 3.4E+38 ECU_ADDRESS 0xfe4cdce8 /* @ECU_Address@autosar_swc_vmp_rtARID_DEF.TmpSignalConversionAtEVM_CIPVOutport1[1].position_sl.x@ */ /end MEASUREMENT
/begin MEASUREMENT autosar_swc_vmp_rtARID_DEF.TmpSignalConversionAtEVM_CIPVOutport1[1].position_sl.y "" FLOAT32_IEEE autosar_swc_vmp_CM_single 0 0 -3.4E+38 3.4E+38 ECU_ADDRESS 0xfe4cdcec /* @ECU_Address@autosar_swc_vmp_rtARID_DEF.TmpSignalConversionAtEVM_CIPVOutport1[1].position_sl.y@ */ /end MEASUREMENT
/begin MEASUREMENT autosar_swc_vmp_rtARID_DEF.TmpSignalConversionAtEVM_CIPVOutport1[1].ref_lane_id "" UBYTE autosar_swc_vmp_CM_uint8 0 0 0 255 ECU_ADDRESS 0xfe4cdcb4 /* @ECU_Address@autosar_swc_vmp_rtARID_DEF.TmpSignalConversionAtEVM_CIPVOutport1[1].ref_lane_id@ */ /end MEASUREMENT
/begin MEASUREMENT autosar_swc_vmp_rtARID_DEF.TmpSignalConversionAtEVM_CIPVOutport1[1].size.higth "" FLOAT32_IEEE autosar_swc_vmp_CM_single 0 0 -3.4E+38 3.4E+38 ECU_ADDRESS 0xfe4cdcfc /* @ECU_Address@autosar_swc_vmp_rtARID_DEF.TmpSignalConversionAtEVM_CIPVOutport1[1].size.higth@ */ /end MEASUREMENT
/begin MEASUREMENT autosar_swc_vmp_rtARID_DEF.TmpSignalConversionAtEVM_CIPVOutport1[1].size.length "" FLOAT32_IEEE autosar_swc_vmp_CM_single 0 0 -3.4E+38 3.4E+38 ECU_ADDRESS 0xfe4cdcf4 /* @ECU_Address@autosar_swc_vmp_rtARID_DEF.TmpSignalConversionAtEVM_CIPVOutport1[1].size.length@ */ /end MEASUREMENT
/begin MEASUREMENT autosar_swc_vmp_rtARID_DEF.TmpSignalConversionAtEVM_CIPVOutport1[1].size.width "" FLOAT32_IEEE autosar_swc_vmp_CM_single 0 0 -3.4E+38 3.4E+38 ECU_ADDRESS 0xfe4cdcf8 /* @ECU_Address@autosar_swc_vmp_rtARID_DEF.TmpSignalConversionAtEVM_CIPVOutport1[1].size.width@ */ /end MEASUREMENT
/begin MEASUREMENT autosar_swc_vmp_rtARID_DEF.TmpSignalConversionAtEVM_CIPVOutport1[1].velocity_gnd.mod "" FLOAT32_IEEE autosar_swc_vmp_CM_single 0 0 -3.4E+38 3.4E+38 ECU_ADDRESS 0xfe4cdd08 /* @ECU_Address@autosar_swc_vmp_rtARID_DEF.TmpSignalConversionAtEVM_CIPVOutport1[1].velocity_gnd.mod@ */ /end MEASUREMENT
/begin MEASUREMENT autosar_swc_vmp_rtARID_DEF.TmpSignalConversionAtEVM_CIPVOutport1[1].velocity_gnd.x "" FLOAT32_IEEE autosar_swc_vmp_CM_single 0 0 -3.4E+38 3.4E+38 ECU_ADDRESS 0xfe4cdd00 /* @ECU_Address@autosar_swc_vmp_rtARID_DEF.TmpSignalConversionAtEVM_CIPVOutport1[1].velocity_gnd.x@ */ /end MEASUREMENT
/begin MEASUREMENT autosar_swc_vmp_rtARID_DEF.TmpSignalConversionAtEVM_CIPVOutport1[1].velocity_gnd.y "" FLOAT32_IEEE autosar_swc_vmp_CM_single 0 0 -3.4E+38 3.4E+38 ECU_ADDRESS 0xfe4cdd04 /* @ECU_Address@autosar_swc_vmp_rtARID_DEF.TmpSignalConversionAtEVM_CIPVOutport1[1].velocity_gnd.y@ */ /end MEASUREMENT
/begin MEASUREMENT autosar_swc_vmp_rtARID_DEF.TmpSignalConversionAtEVM_CIPVOutport1[1].velocity_gnd_sl.mod "" FLOAT32_IEEE autosar_swc_vmp_CM_single 0 0 -3.4E+38 3.4E+38 ECU_ADDRESS 0xfe4cdd20 /* @ECU_Address@autosar_swc_vmp_rtARID_DEF.TmpSignalConversionAtEVM_CIPVOutport1[1].velocity_gnd_sl.mod@ */ /end MEASUREMENT
/begin MEASUREMENT autosar_swc_vmp_rtARID_DEF.TmpSignalConversionAtEVM_CIPVOutport1[1].velocity_gnd_sl.x "" FLOAT32_IEEE autosar_swc_vmp_CM_single 0 0 -3.4E+38 3.4E+38 ECU_ADDRESS 0xfe4cdd18 /* @ECU_Address@autosar_swc_vmp_rtARID_DEF.TmpSignalConversionAtEVM_CIPVOutport1[1].velocity_gnd_sl.x@ */ /end MEASUREMENT
/begin MEASUREMENT autosar_swc_vmp_rtARID_DEF.TmpSignalConversionAtEVM_CIPVOutport1[1].velocity_gnd_sl.y "" FLOAT32_IEEE autosar_swc_vmp_CM_single 0 0 -3.4E+38 3.4E+38 ECU_ADDRESS 0xfe4cdd1c /* @ECU_Address@autosar_swc_vmp_rtARID_DEF.TmpSignalConversionAtEVM_CIPVOutport1[1].velocity_gnd_sl.y@ */ /end MEASUREMENT
/begin MEASUREMENT autosar_swc_vmp_rtARID_DEF.TmpSignalConversionAtEVM_CIPVOutport1[2].accel_gnd.mod "" FLOAT32_IEEE autosar_swc_vmp_CM_single 0 0 -3.4E+38 3.4E+38 ECU_ADDRESS 0xfe4cdd94 /* @ECU_Address@autosar_swc_vmp_rtARID_DEF.TmpSignalConversionAtEVM_CIPVOutport1[2].accel_gnd.mod@ */ /end MEASUREMENT
/begin MEASUREMENT autosar_swc_vmp_rtARID_DEF.TmpSignalConversionAtEVM_CIPVOutport1[2].accel_gnd.x "" FLOAT32_IEEE autosar_swc_vmp_CM_single 0 0 -3.4E+38 3.4E+38 ECU_ADDRESS 0xfe4cdd8c /* @ECU_Address@autosar_swc_vmp_rtARID_DEF.TmpSignalConversionAtEVM_CIPVOutport1[2].accel_gnd.x@ */ /end MEASUREMENT
/begin MEASUREMENT autosar_swc_vmp_rtARID_DEF.TmpSignalConversionAtEVM_CIPVOutport1[2].accel_gnd.y "" FLOAT32_IEEE autosar_swc_vmp_CM_single 0 0 -3.4E+38 3.4E+38 ECU_ADDRESS 0xfe4cdd90 /* @ECU_Address@autosar_swc_vmp_rtARID_DEF.TmpSignalConversionAtEVM_CIPVOutport1[2].accel_gnd.y@ */ /end MEASUREMENT
/begin MEASUREMENT autosar_swc_vmp_rtARID_DEF.TmpSignalConversionAtEVM_CIPVOutport1[2].accel_gnd_sl.mod "" FLOAT32_IEEE autosar_swc_vmp_CM_single 0 0 -3.4E+38 3.4E+38 ECU_ADDRESS 0xfe4cddac /* @ECU_Address@autosar_swc_vmp_rtARID_DEF.TmpSignalConversionAtEVM_CIPVOutport1[2].accel_gnd_sl.mod@ */ /end MEASUREMENT
/begin MEASUREMENT autosar_swc_vmp_rtARID_DEF.TmpSignalConversionAtEVM_CIPVOutport1[2].accel_gnd_sl.x "" FLOAT32_IEEE autosar_swc_vmp_CM_single 0 0 -3.4E+38 3.4E+38 ECU_ADDRESS 0xfe4cdda4 /* @ECU_Address@autosar_swc_vmp_rtARID_DEF.TmpSignalConversionAtEVM_CIPVOutport1[2].accel_gnd_sl.x@ */ /end MEASUREMENT
/begin MEASUREMENT autosar_swc_vmp_rtARID_DEF.TmpSignalConversionAtEVM_CIPVOutport1[2].accel_gnd_sl.y "" FLOAT32_IEEE autosar_swc_vmp_CM_single 0 0 -3.4E+38 3.4E+38 ECU_ADDRESS 0xfe4cdda8 /* @ECU_Address@autosar_swc_vmp_rtARID_DEF.TmpSignalConversionAtEVM_CIPVOutport1[2].accel_gnd_sl.y@ */ /end MEASUREMENT
/begin MEASUREMENT autosar_swc_vmp_rtARID_DEF.TmpSignalConversionAtEVM_CIPVOutport1[2].box.corner_x_vec "" FLOAT32_IEEE autosar_swc_vmp_CM_single 0 0 -3.4E+38 3.4E+38 LAYOUT COLUMN_DIR MATRIX_DIM 4 ECU_ADDRESS 0xfe4cdd3c /* @ECU_Address@autosar_swc_vmp_rtARID_DEF.TmpSignalConversionAtEVM_CIPVOutport1[2].box.corner_x_vec@ */ /end MEASUREMENT
/begin MEASUREMENT autosar_swc_vmp_rtARID_DEF.TmpSignalConversionAtEVM_CIPVOutport1[2].box.corner_y_vec "" FLOAT32_IEEE autosar_swc_vmp_CM_single 0 0 -3.4E+38 3.4E+38 LAYOUT COLUMN_DIR MATRIX_DIM 4 ECU_ADDRESS 0xfe4cdd4c /* @ECU_Address@autosar_swc_vmp_rtARID_DEF.TmpSignalConversionAtEVM_CIPVOutport1[2].box.corner_y_vec@ */ /end MEASUREMENT
/begin MEASUREMENT autosar_swc_vmp_rtARID_DEF.TmpSignalConversionAtEVM_CIPVOutport1[2].class_type "" UBYTE autosar_swc_vmp_CM_uint8 0 0 0 255 ECU_ADDRESS 0xfe4cdd32 /* @ECU_Address@autosar_swc_vmp_rtARID_DEF.TmpSignalConversionAtEVM_CIPVOutport1[2].class_type@ */ /end MEASUREMENT
/begin MEASUREMENT autosar_swc_vmp_rtARID_DEF.TmpSignalConversionAtEVM_CIPVOutport1[2].cut_type "" UBYTE autosar_swc_vmp_CM_uint8 0 0 0 255 ECU_ADDRESS 0xfe4cdd33 /* @ECU_Address@autosar_swc_vmp_rtARID_DEF.TmpSignalConversionAtEVM_CIPVOutport1[2].cut_type@ */ /end MEASUREMENT
/begin MEASUREMENT autosar_swc_vmp_rtARID_DEF.TmpSignalConversionAtEVM_CIPVOutport1[2].fus_type "" UBYTE autosar_swc_vmp_CM_uint8 0 0 0 255 ECU_ADDRESS 0xfe4cdd31 /* @ECU_Address@autosar_swc_vmp_rtARID_DEF.TmpSignalConversionAtEVM_CIPVOutport1[2].fus_type@ */ /end MEASUREMENT
/begin MEASUREMENT autosar_swc_vmp_rtARID_DEF.TmpSignalConversionAtEVM_CIPVOutport1[2].id "" ULONG autosar_swc_vmp_CM_uint32 0 0 0 4294967295 ECU_ADDRESS 0xfe4cdd38 /* @ECU_Address@autosar_swc_vmp_rtARID_DEF.TmpSignalConversionAtEVM_CIPVOutport1[2].id@ */ /end MEASUREMENT
/begin MEASUREMENT autosar_swc_vmp_rtARID_DEF.TmpSignalConversionAtEVM_CIPVOutport1[2].meas_state "" UBYTE autosar_swc_vmp_CM_uint8 0 0 0 255 ECU_ADDRESS 0xfe4cdd30 /* @ECU_Address@autosar_swc_vmp_rtARID_DEF.TmpSignalConversionAtEVM_CIPVOutport1[2].meas_state@ */ /end MEASUREMENT
/begin MEASUREMENT autosar_swc_vmp_rtARID_DEF.TmpSignalConversionAtEVM_CIPVOutport1[2].position.heading_angle "" FLOAT32_IEEE autosar_swc_vmp_CM_single 0 0 -3.4E+38 3.4E+38 ECU_ADDRESS 0xfe4cdd64 /* @ECU_Address@autosar_swc_vmp_rtARID_DEF.TmpSignalConversionAtEVM_CIPVOutport1[2].position.heading_angle@ */ /end MEASUREMENT
/begin MEASUREMENT autosar_swc_vmp_rtARID_DEF.TmpSignalConversionAtEVM_CIPVOutport1[2].position.x "" FLOAT32_IEEE autosar_swc_vmp_CM_single 0 0 -3.4E+38 3.4E+38 ECU_ADDRESS 0xfe4cdd5c /* @ECU_Address@autosar_swc_vmp_rtARID_DEF.TmpSignalConversionAtEVM_CIPVOutport1[2].position.x@ */ /end MEASUREMENT
/begin MEASUREMENT autosar_swc_vmp_rtARID_DEF.TmpSignalConversionAtEVM_CIPVOutport1[2].position.y "" FLOAT32_IEEE autosar_swc_vmp_CM_single 0 0 -3.4E+38 3.4E+38 ECU_ADDRESS 0xfe4cdd60 /* @ECU_Address@autosar_swc_vmp_rtARID_DEF.TmpSignalConversionAtEVM_CIPVOutport1[2].position.y@ */ /end MEASUREMENT
/begin MEASUREMENT autosar_swc_vmp_rtARID_DEF.TmpSignalConversionAtEVM_CIPVOutport1[2].position_sl.heading_angle "" FLOAT32_IEEE autosar_swc_vmp_CM_single 0 0 -3.4E+38 3.4E+38 ECU_ADDRESS 0xfe4cdd70 /* @ECU_Address@autosar_swc_vmp_rtARID_DEF.TmpSignalConversionAtEVM_CIPVOutport1[2].position_sl.heading_angle@ */ /end MEASUREMENT
/begin MEASUREMENT autosar_swc_vmp_rtARID_DEF.TmpSignalConversionAtEVM_CIPVOutport1[2].position_sl.x "" FLOAT32_IEEE autosar_swc_vmp_CM_single 0 0 -3.4E+38 3.4E+38 ECU_ADDRESS 0xfe4cdd68 /* @ECU_Address@autosar_swc_vmp_rtARID_DEF.TmpSignalConversionAtEVM_CIPVOutport1[2].position_sl.x@ */ /end MEASUREMENT
/begin MEASUREMENT autosar_swc_vmp_rtARID_DEF.TmpSignalConversionAtEVM_CIPVOutport1[2].position_sl.y "" FLOAT32_IEEE autosar_swc_vmp_CM_single 0 0 -3.4E+38 3.4E+38 ECU_ADDRESS 0xfe4cdd6c /* @ECU_Address@autosar_swc_vmp_rtARID_DEF.TmpSignalConversionAtEVM_CIPVOutport1[2].position_sl.y@ */ /end MEASUREMENT
/begin MEASUREMENT autosar_swc_vmp_rtARID_DEF.TmpSignalConversionAtEVM_CIPVOutport1[2].ref_lane_id "" UBYTE autosar_swc_vmp_CM_uint8 0 0 0 255 ECU_ADDRESS 0xfe4cdd34 /* @ECU_Address@autosar_swc_vmp_rtARID_DEF.TmpSignalConversionAtEVM_CIPVOutport1[2].ref_lane_id@ */ /end MEASUREMENT
/begin MEASUREMENT autosar_swc_vmp_rtARID_DEF.TmpSignalConversionAtEVM_CIPVOutport1[2].size.higth "" FLOAT32_IEEE autosar_swc_vmp_CM_single 0 0 -3.4E+38 3.4E+38 ECU_ADDRESS 0xfe4cdd7c /* @ECU_Address@autosar_swc_vmp_rtARID_DEF.TmpSignalConversionAtEVM_CIPVOutport1[2].size.higth@ */ /end MEASUREMENT
/begin MEASUREMENT autosar_swc_vmp_rtARID_DEF.TmpSignalConversionAtEVM_CIPVOutport1[2].size.length "" FLOAT32_IEEE autosar_swc_vmp_CM_single 0 0 -3.4E+38 3.4E+38 ECU_ADDRESS 0xfe4cdd74 /* @ECU_Address@autosar_swc_vmp_rtARID_DEF.TmpSignalConversionAtEVM_CIPVOutport1[2].size.length@ */ /end MEASUREMENT
/begin MEASUREMENT autosar_swc_vmp_rtARID_DEF.TmpSignalConversionAtEVM_CIPVOutport1[2].size.width "" FLOAT32_IEEE autosar_swc_vmp_CM_single 0 0 -3.4E+38 3.4E+38 ECU_ADDRESS 0xfe4cdd78 /* @ECU_Address@autosar_swc_vmp_rtARID_DEF.TmpSignalConversionAtEVM_CIPVOutport1[2].size.width@ */ /end MEASUREMENT
/begin MEASUREMENT autosar_swc_vmp_rtARID_DEF.TmpSignalConversionAtEVM_CIPVOutport1[2].velocity_gnd.mod "" FLOAT32_IEEE autosar_swc_vmp_CM_single 0 0 -3.4E+38 3.4E+38 ECU_ADDRESS 0xfe4cdd88 /* @ECU_Address@autosar_swc_vmp_rtARID_DEF.TmpSignalConversionAtEVM_CIPVOutport1[2].velocity_gnd.mod@ */ /end MEASUREMENT
/begin MEASUREMENT autosar_swc_vmp_rtARID_DEF.TmpSignalConversionAtEVM_CIPVOutport1[2].velocity_gnd.x "" FLOAT32_IEEE autosar_swc_vmp_CM_single 0 0 -3.4E+38 3.4E+38 ECU_ADDRESS 0xfe4cdd80 /* @ECU_Address@autosar_swc_vmp_rtARID_DEF.TmpSignalConversionAtEVM_CIPVOutport1[2].velocity_gnd.x@ */ /end MEASUREMENT
/begin MEASUREMENT autosar_swc_vmp_rtARID_DEF.TmpSignalConversionAtEVM_CIPVOutport1[2].velocity_gnd.y "" FLOAT32_IEEE autosar_swc_vmp_CM_single 0 0 -3.4E+38 3.4E+38 ECU_ADDRESS 0xfe4cdd84 /* @ECU_Address@autosar_swc_vmp_rtARID_DEF.TmpSignalConversionAtEVM_CIPVOutport1[2].velocity_gnd.y@ */ /end MEASUREMENT
/begin MEASUREMENT autosar_swc_vmp_rtARID_DEF.TmpSignalConversionAtEVM_CIPVOutport1[2].velocity_gnd_sl.mod "" FLOAT32_IEEE autosar_swc_vmp_CM_single 0 0 -3.4E+38 3.4E+38 ECU_ADDRESS 0xfe4cdda0 /* @ECU_Address@autosar_swc_vmp_rtARID_DEF.TmpSignalConversionAtEVM_CIPVOutport1[2].velocity_gnd_sl.mod@ */ /end MEASUREMENT
/begin MEASUREMENT autosar_swc_vmp_rtARID_DEF.TmpSignalConversionAtEVM_CIPVOutport1[2].velocity_gnd_sl.x "" FLOAT32_IEEE autosar_swc_vmp_CM_single 0 0 -3.4E+38 3.4E+38 ECU_ADDRESS 0xfe4cdd98 /* @ECU_Address@autosar_swc_vmp_rtARID_DEF.TmpSignalConversionAtEVM_CIPVOutport1[2].velocity_gnd_sl.x@ */ /end MEASUREMENT
/begin MEASUREMENT autosar_swc_vmp_rtARID_DEF.TmpSignalConversionAtEVM_CIPVOutport1[2].velocity_gnd_sl.y "" FLOAT32_IEEE autosar_swc_vmp_CM_single 0 0 -3.4E+38 3.4E+38 ECU_ADDRESS 0xfe4cdd9c /* @ECU_Address@autosar_swc_vmp_rtARID_DEF.TmpSignalConversionAtEVM_CIPVOutport1[2].velocity_gnd_sl.y@ */ /end MEASUREMENT
/begin MEASUREMENT autosar_swc_vmp_rtARID_DEF.TmpSignalConversionAtEVM_CIPVOutport1[3].accel_gnd.mod "" FLOAT32_IEEE autosar_swc_vmp_CM_single 0 0 -3.4E+38 3.4E+38 ECU_ADDRESS 0xfe4cde14 /* @ECU_Address@autosar_swc_vmp_rtARID_DEF.TmpSignalConversionAtEVM_CIPVOutport1[3].accel_gnd.mod@ */ /end MEASUREMENT
/begin MEASUREMENT autosar_swc_vmp_rtARID_DEF.TmpSignalConversionAtEVM_CIPVOutport1[3].accel_gnd.x "" FLOAT32_IEEE autosar_swc_vmp_CM_single 0 0 -3.4E+38 3.4E+38 ECU_ADDRESS 0xfe4cde0c /* @ECU_Address@autosar_swc_vmp_rtARID_DEF.TmpSignalConversionAtEVM_CIPVOutport1[3].accel_gnd.x@ */ /end MEASUREMENT
/begin MEASUREMENT autosar_swc_vmp_rtARID_DEF.TmpSignalConversionAtEVM_CIPVOutport1[3].accel_gnd.y "" FLOAT32_IEEE autosar_swc_vmp_CM_single 0 0 -3.4E+38 3.4E+38 ECU_ADDRESS 0xfe4cde10 /* @ECU_Address@autosar_swc_vmp_rtARID_DEF.TmpSignalConversionAtEVM_CIPVOutport1[3].accel_gnd.y@ */ /end MEASUREMENT
/begin MEASUREMENT autosar_swc_vmp_rtARID_DEF.TmpSignalConversionAtEVM_CIPVOutport1[3].accel_gnd_sl.mod "" FLOAT32_IEEE autosar_swc_vmp_CM_single 0 0 -3.4E+38 3.4E+38 ECU_ADDRESS 0xfe4cde2c /* @ECU_Address@autosar_swc_vmp_rtARID_DEF.TmpSignalConversionAtEVM_CIPVOutport1[3].accel_gnd_sl.mod@ */ /end MEASUREMENT
/begin MEASUREMENT autosar_swc_vmp_rtARID_DEF.TmpSignalConversionAtEVM_CIPVOutport1[3].accel_gnd_sl.x "" FLOAT32_IEEE autosar_swc_vmp_CM_single 0 0 -3.4E+38 3.4E+38 ECU_ADDRESS 0xfe4cde24 /* @ECU_Address@autosar_swc_vmp_rtARID_DEF.TmpSignalConversionAtEVM_CIPVOutport1[3].accel_gnd_sl.x@ */ /end MEASUREMENT
/begin MEASUREMENT autosar_swc_vmp_rtARID_DEF.TmpSignalConversionAtEVM_CIPVOutport1[3].accel_gnd_sl.y "" FLOAT32_IEEE autosar_swc_vmp_CM_single 0 0 -3.4E+38 3.4E+38 ECU_ADDRESS 0xfe4cde28 /* @ECU_Address@autosar_swc_vmp_rtARID_DEF.TmpSignalConversionAtEVM_CIPVOutport1[3].accel_gnd_sl.y@ */ /end MEASUREMENT
/begin MEASUREMENT autosar_swc_vmp_rtARID_DEF.TmpSignalConversionAtEVM_CIPVOutport1[3].box.corner_x_vec "" FLOAT32_IEEE autosar_swc_vmp_CM_single 0 0 -3.4E+38 3.4E+38 LAYOUT COLUMN_DIR MATRIX_DIM 4 ECU_ADDRESS 0xfe4cddbc /* @ECU_Address@autosar_swc_vmp_rtARID_DEF.TmpSignalConversionAtEVM_CIPVOutport1[3].box.corner_x_vec@ */ /end MEASUREMENT
/begin MEASUREMENT autosar_swc_vmp_rtARID_DEF.TmpSignalConversionAtEVM_CIPVOutport1[3].box.corner_y_vec "" FLOAT32_IEEE autosar_swc_vmp_CM_single 0 0 -3.4E+38 3.4E+38 LAYOUT COLUMN_DIR MATRIX_DIM 4 ECU_ADDRESS 0xfe4cddcc /* @ECU_Address@autosar_swc_vmp_rtARID_DEF.TmpSignalConversionAtEVM_CIPVOutport1[3].box.corner_y_vec@ */ /end MEASUREMENT
/begin MEASUREMENT autosar_swc_vmp_rtARID_DEF.TmpSignalConversionAtEVM_CIPVOutport1[3].class_type "" UBYTE autosar_swc_vmp_CM_uint8 0 0 0 255 ECU_ADDRESS 0xfe4cddb2 /* @ECU_Address@autosar_swc_vmp_rtARID_DEF.TmpSignalConversionAtEVM_CIPVOutport1[3].class_type@ */ /end MEASUREMENT
/begin MEASUREMENT autosar_swc_vmp_rtARID_DEF.TmpSignalConversionAtEVM_CIPVOutport1[3].cut_type "" UBYTE autosar_swc_vmp_CM_uint8 0 0 0 255 ECU_ADDRESS 0xfe4cddb3 /* @ECU_Address@autosar_swc_vmp_rtARID_DEF.TmpSignalConversionAtEVM_CIPVOutport1[3].cut_type@ */ /end MEASUREMENT
/begin MEASUREMENT autosar_swc_vmp_rtARID_DEF.TmpSignalConversionAtEVM_CIPVOutport1[3].fus_type "" UBYTE autosar_swc_vmp_CM_uint8 0 0 0 255 ECU_ADDRESS 0xfe4cddb1 /* @ECU_Address@autosar_swc_vmp_rtARID_DEF.TmpSignalConversionAtEVM_CIPVOutport1[3].fus_type@ */ /end MEASUREMENT
/begin MEASUREMENT autosar_swc_vmp_rtARID_DEF.TmpSignalConversionAtEVM_CIPVOutport1[3].id "" ULONG autosar_swc_vmp_CM_uint32 0 0 0 4294967295 ECU_ADDRESS 0xfe4cddb8 /* @ECU_Address@autosar_swc_vmp_rtARID_DEF.TmpSignalConversionAtEVM_CIPVOutport1[3].id@ */ /end MEASUREMENT
/begin MEASUREMENT autosar_swc_vmp_rtARID_DEF.TmpSignalConversionAtEVM_CIPVOutport1[3].meas_state "" UBYTE autosar_swc_vmp_CM_uint8 0 0 0 255 ECU_ADDRESS 0xfe4cddb0 /* @ECU_Address@autosar_swc_vmp_rtARID_DEF.TmpSignalConversionAtEVM_CIPVOutport1[3].meas_state@ */ /end MEASUREMENT
/begin MEASUREMENT autosar_swc_vmp_rtARID_DEF.TmpSignalConversionAtEVM_CIPVOutport1[3].position.heading_angle "" FLOAT32_IEEE autosar_swc_vmp_CM_single 0 0 -3.4E+38 3.4E+38 ECU_ADDRESS 0xfe4cdde4 /* @ECU_Address@autosar_swc_vmp_rtARID_DEF.TmpSignalConversionAtEVM_CIPVOutport1[3].position.heading_angle@ */ /end MEASUREMENT
/begin MEASUREMENT autosar_swc_vmp_rtARID_DEF.TmpSignalConversionAtEVM_CIPVOutport1[3].position.x "" FLOAT32_IEEE autosar_swc_vmp_CM_single 0 0 -3.4E+38 3.4E+38 ECU_ADDRESS 0xfe4cdddc /* @ECU_Address@autosar_swc_vmp_rtARID_DEF.TmpSignalConversionAtEVM_CIPVOutport1[3].position.x@ */ /end MEASUREMENT
/begin MEASUREMENT autosar_swc_vmp_rtARID_DEF.TmpSignalConversionAtEVM_CIPVOutport1[3].position.y "" FLOAT32_IEEE autosar_swc_vmp_CM_single 0 0 -3.4E+38 3.4E+38 ECU_ADDRESS 0xfe4cdde0 /* @ECU_Address@autosar_swc_vmp_rtARID_DEF.TmpSignalConversionAtEVM_CIPVOutport1[3].position.y@ */ /end MEASUREMENT
/begin MEASUREMENT autosar_swc_vmp_rtARID_DEF.TmpSignalConversionAtEVM_CIPVOutport1[3].position_sl.heading_angle "" FLOAT32_IEEE autosar_swc_vmp_CM_single 0 0 -3.4E+38 3.4E+38 ECU_ADDRESS 0xfe4cddf0 /* @ECU_Address@autosar_swc_vmp_rtARID_DEF.TmpSignalConversionAtEVM_CIPVOutport1[3].position_sl.heading_angle@ */ /end MEASUREMENT
/begin MEASUREMENT autosar_swc_vmp_rtARID_DEF.TmpSignalConversionAtEVM_CIPVOutport1[3].position_sl.x "" FLOAT32_IEEE autosar_swc_vmp_CM_single 0 0 -3.4E+38 3.4E+38 ECU_ADDRESS 0xfe4cdde8 /* @ECU_Address@autosar_swc_vmp_rtARID_DEF.TmpSignalConversionAtEVM_CIPVOutport1[3].position_sl.x@ */ /end MEASUREMENT
/begin MEASUREMENT autosar_swc_vmp_rtARID_DEF.TmpSignalConversionAtEVM_CIPVOutport1[3].position_sl.y "" FLOAT32_IEEE autosar_swc_vmp_CM_single 0 0 -3.4E+38 3.4E+38 ECU_ADDRESS 0xfe4cddec /* @ECU_Address@autosar_swc_vmp_rtARID_DEF.TmpSignalConversionAtEVM_CIPVOutport1[3].position_sl.y@ */ /end MEASUREMENT
/begin MEASUREMENT autosar_swc_vmp_rtARID_DEF.TmpSignalConversionAtEVM_CIPVOutport1[3].ref_lane_id "" UBYTE autosar_swc_vmp_CM_uint8 0 0 0 255 ECU_ADDRESS 0xfe4cddb4 /* @ECU_Address@autosar_swc_vmp_rtARID_DEF.TmpSignalConversionAtEVM_CIPVOutport1[3].ref_lane_id@ */ /end MEASUREMENT
/begin MEASUREMENT autosar_swc_vmp_rtARID_DEF.TmpSignalConversionAtEVM_CIPVOutport1[3].size.higth "" FLOAT32_IEEE autosar_swc_vmp_CM_single 0 0 -3.4E+38 3.4E+38 ECU_ADDRESS 0xfe4cddfc /* @ECU_Address@autosar_swc_vmp_rtARID_DEF.TmpSignalConversionAtEVM_CIPVOutport1[3].size.higth@ */ /end MEASUREMENT
/begin MEASUREMENT autosar_swc_vmp_rtARID_DEF.TmpSignalConversionAtEVM_CIPVOutport1[3].size.length "" FLOAT32_IEEE autosar_swc_vmp_CM_single 0 0 -3.4E+38 3.4E+38 ECU_ADDRESS 0xfe4cddf4 /* @ECU_Address@autosar_swc_vmp_rtARID_DEF.TmpSignalConversionAtEVM_CIPVOutport1[3].size.length@ */ /end MEASUREMENT
/begin MEASUREMENT autosar_swc_vmp_rtARID_DEF.TmpSignalConversionAtEVM_CIPVOutport1[3].size.width "" FLOAT32_IEEE autosar_swc_vmp_CM_single 0 0 -3.4E+38 3.4E+38 ECU_ADDRESS 0xfe4cddf8 /* @ECU_Address@autosar_swc_vmp_rtARID_DEF.TmpSignalConversionAtEVM_CIPVOutport1[3].size.width@ */ /end MEASUREMENT
/begin MEASUREMENT autosar_swc_vmp_rtARID_DEF.TmpSignalConversionAtEVM_CIPVOutport1[3].velocity_gnd.mod "" FLOAT32_IEEE autosar_swc_vmp_CM_single 0 0 -3.4E+38 3.4E+38 ECU_ADDRESS 0xfe4cde08 /* @ECU_Address@autosar_swc_vmp_rtARID_DEF.TmpSignalConversionAtEVM_CIPVOutport1[3].velocity_gnd.mod@ */ /end MEASUREMENT
/begin MEASUREMENT autosar_swc_vmp_rtARID_DEF.TmpSignalConversionAtEVM_CIPVOutport1[3].velocity_gnd.x "" FLOAT32_IEEE autosar_swc_vmp_CM_single 0 0 -3.4E+38 3.4E+38 ECU_ADDRESS 0xfe4cde00 /* @ECU_Address@autosar_swc_vmp_rtARID_DEF.TmpSignalConversionAtEVM_CIPVOutport1[3].velocity_gnd.x@ */ /end MEASUREMENT
/begin MEASUREMENT autosar_swc_vmp_rtARID_DEF.TmpSignalConversionAtEVM_CIPVOutport1[3].velocity_gnd.y "" FLOAT32_IEEE autosar_swc_vmp_CM_single 0 0 -3.4E+38 3.4E+38 ECU_ADDRESS 0xfe4cde04 /* @ECU_Address@autosar_swc_vmp_rtARID_DEF.TmpSignalConversionAtEVM_CIPVOutport1[3].velocity_gnd.y@ */ /end MEASUREMENT
/begin MEASUREMENT autosar_swc_vmp_rtARID_DEF.TmpSignalConversionAtEVM_CIPVOutport1[3].velocity_gnd_sl.mod "" FLOAT32_IEEE autosar_swc_vmp_CM_single 0 0 -3.4E+38 3.4E+38 ECU_ADDRESS 0xfe4cde20 /* @ECU_Address@autosar_swc_vmp_rtARID_DEF.TmpSignalConversionAtEVM_CIPVOutport1[3].velocity_gnd_sl.mod@ */ /end MEASUREMENT
/begin MEASUREMENT autosar_swc_vmp_rtARID_DEF.TmpSignalConversionAtEVM_CIPVOutport1[3].velocity_gnd_sl.x "" FLOAT32_IEEE autosar_swc_vmp_CM_single 0 0 -3.4E+38 3.4E+38 ECU_ADDRESS 0xfe4cde18 /* @ECU_Address@autosar_swc_vmp_rtARID_DEF.TmpSignalConversionAtEVM_CIPVOutport1[3].velocity_gnd_sl.x@ */ /end MEASUREMENT
/begin MEASUREMENT autosar_swc_vmp_rtARID_DEF.TmpSignalConversionAtEVM_CIPVOutport1[3].velocity_gnd_sl.y "" FLOAT32_IEEE autosar_swc_vmp_CM_single 0 0 -3.4E+38 3.4E+38 ECU_ADDRESS 0xfe4cde1c /* @ECU_Address@autosar_swc_vmp_rtARID_DEF.TmpSignalConversionAtEVM_CIPVOutport1[3].velocity_gnd_sl.y@ */ /end MEASUREMENT
/begin MEASUREMENT autosar_swc_vmp_rtARID_DEF.TmpSignalConversionAtEVM_CIPVOutport1[4].accel_gnd.mod "" FLOAT32_IEEE autosar_swc_vmp_CM_single 0 0 -3.4E+38 3.4E+38 ECU_ADDRESS 0xfe4cde94 /* @ECU_Address@autosar_swc_vmp_rtARID_DEF.TmpSignalConversionAtEVM_CIPVOutport1[4].accel_gnd.mod@ */ /end MEASUREMENT
/begin MEASUREMENT autosar_swc_vmp_rtARID_DEF.TmpSignalConversionAtEVM_CIPVOutport1[4].accel_gnd.x "" FLOAT32_IEEE autosar_swc_vmp_CM_single 0 0 -3.4E+38 3.4E+38 ECU_ADDRESS 0xfe4cde8c /* @ECU_Address@autosar_swc_vmp_rtARID_DEF.TmpSignalConversionAtEVM_CIPVOutport1[4].accel_gnd.x@ */ /end MEASUREMENT
/begin MEASUREMENT autosar_swc_vmp_rtARID_DEF.TmpSignalConversionAtEVM_CIPVOutport1[4].accel_gnd.y "" FLOAT32_IEEE autosar_swc_vmp_CM_single 0 0 -3.4E+38 3.4E+38 ECU_ADDRESS 0xfe4cde90 /* @ECU_Address@autosar_swc_vmp_rtARID_DEF.TmpSignalConversionAtEVM_CIPVOutport1[4].accel_gnd.y@ */ /end MEASUREMENT
/begin MEASUREMENT autosar_swc_vmp_rtARID_DEF.TmpSignalConversionAtEVM_CIPVOutport1[4].accel_gnd_sl.mod "" FLOAT32_IEEE autosar_swc_vmp_CM_single 0 0 -3.4E+38 3.4E+38 ECU_ADDRESS 0xfe4cdeac /* @ECU_Address@autosar_swc_vmp_rtARID_DEF.TmpSignalConversionAtEVM_CIPVOutport1[4].accel_gnd_sl.mod@ */ /end MEASUREMENT
/begin MEASUREMENT autosar_swc_vmp_rtARID_DEF.TmpSignalConversionAtEVM_CIPVOutport1[4].accel_gnd_sl.x "" FLOAT32_IEEE autosar_swc_vmp_CM_single 0 0 -3.4E+38 3.4E+38 ECU_ADDRESS 0xfe4cdea4 /* @ECU_Address@autosar_swc_vmp_rtARID_DEF.TmpSignalConversionAtEVM_CIPVOutport1[4].accel_gnd_sl.x@ */ /end MEASUREMENT
/begin MEASUREMENT autosar_swc_vmp_rtARID_DEF.TmpSignalConversionAtEVM_CIPVOutport1[4].accel_gnd_sl.y "" FLOAT32_IEEE autosar_swc_vmp_CM_single 0 0 -3.4E+38 3.4E+38 ECU_ADDRESS 0xfe4cdea8 /* @ECU_Address@autosar_swc_vmp_rtARID_DEF.TmpSignalConversionAtEVM_CIPVOutport1[4].accel_gnd_sl.y@ */ /end MEASUREMENT
/begin MEASUREMENT autosar_swc_vmp_rtARID_DEF.TmpSignalConversionAtEVM_CIPVOutport1[4].box.corner_x_vec "" FLOAT32_IEEE autosar_swc_vmp_CM_single 0 0 -3.4E+38 3.4E+38 LAYOUT COLUMN_DIR MATRIX_DIM 4 ECU_ADDRESS 0xfe4cde3c /* @ECU_Address@autosar_swc_vmp_rtARID_DEF.TmpSignalConversionAtEVM_CIPVOutport1[4].box.corner_x_vec@ */ /end MEASUREMENT
/begin MEASUREMENT autosar_swc_vmp_rtARID_DEF.TmpSignalConversionAtEVM_CIPVOutport1[4].box.corner_y_vec "" FLOAT32_IEEE autosar_swc_vmp_CM_single 0 0 -3.4E+38 3.4E+38 LAYOUT COLUMN_DIR MATRIX_DIM 4 ECU_ADDRESS 0xfe4cde4c /* @ECU_Address@autosar_swc_vmp_rtARID_DEF.TmpSignalConversionAtEVM_CIPVOutport1[4].box.corner_y_vec@ */ /end MEASUREMENT
/begin MEASUREMENT autosar_swc_vmp_rtARID_DEF.TmpSignalConversionAtEVM_CIPVOutport1[4].class_type "" UBYTE autosar_swc_vmp_CM_uint8 0 0 0 255 ECU_ADDRESS 0xfe4cde32 /* @ECU_Address@autosar_swc_vmp_rtARID_DEF.TmpSignalConversionAtEVM_CIPVOutport1[4].class_type@ */ /end MEASUREMENT
/begin MEASUREMENT autosar_swc_vmp_rtARID_DEF.TmpSignalConversionAtEVM_CIPVOutport1[4].cut_type "" UBYTE autosar_swc_vmp_CM_uint8 0 0 0 255 ECU_ADDRESS 0xfe4cde33 /* @ECU_Address@autosar_swc_vmp_rtARID_DEF.TmpSignalConversionAtEVM_CIPVOutport1[4].cut_type@ */ /end MEASUREMENT
/begin MEASUREMENT autosar_swc_vmp_rtARID_DEF.TmpSignalConversionAtEVM_CIPVOutport1[4].fus_type "" UBYTE autosar_swc_vmp_CM_uint8 0 0 0 255 ECU_ADDRESS 0xfe4cde31 /* @ECU_Address@autosar_swc_vmp_rtARID_DEF.TmpSignalConversionAtEVM_CIPVOutport1[4].fus_type@ */ /end MEASUREMENT
/begin MEASUREMENT autosar_swc_vmp_rtARID_DEF.TmpSignalConversionAtEVM_CIPVOutport1[4].id "" ULONG autosar_swc_vmp_CM_uint32 0 0 0 4294967295 ECU_ADDRESS 0xfe4cde38 /* @ECU_Address@autosar_swc_vmp_rtARID_DEF.TmpSignalConversionAtEVM_CIPVOutport1[4].id@ */ /end MEASUREMENT
/begin MEASUREMENT autosar_swc_vmp_rtARID_DEF.TmpSignalConversionAtEVM_CIPVOutport1[4].meas_state "" UBYTE autosar_swc_vmp_CM_uint8 0 0 0 255 ECU_ADDRESS 0xfe4cde30 /* @ECU_Address@autosar_swc_vmp_rtARID_DEF.TmpSignalConversionAtEVM_CIPVOutport1[4].meas_state@ */ /end MEASUREMENT
/begin MEASUREMENT autosar_swc_vmp_rtARID_DEF.TmpSignalConversionAtEVM_CIPVOutport1[4].position.heading_angle "" FLOAT32_IEEE autosar_swc_vmp_CM_single 0 0 -3.4E+38 3.4E+38 ECU_ADDRESS 0xfe4cde64 /* @ECU_Address@autosar_swc_vmp_rtARID_DEF.TmpSignalConversionAtEVM_CIPVOutport1[4].position.heading_angle@ */ /end MEASUREMENT
/begin MEASUREMENT autosar_swc_vmp_rtARID_DEF.TmpSignalConversionAtEVM_CIPVOutport1[4].position.x "" FLOAT32_IEEE autosar_swc_vmp_CM_single 0 0 -3.4E+38 3.4E+38 ECU_ADDRESS 0xfe4cde5c /* @ECU_Address@autosar_swc_vmp_rtARID_DEF.TmpSignalConversionAtEVM_CIPVOutport1[4].position.x@ */ /end MEASUREMENT
/begin MEASUREMENT autosar_swc_vmp_rtARID_DEF.TmpSignalConversionAtEVM_CIPVOutport1[4].position.y "" FLOAT32_IEEE autosar_swc_vmp_CM_single 0 0 -3.4E+38 3.4E+38 ECU_ADDRESS 0xfe4cde60 /* @ECU_Address@autosar_swc_vmp_rtARID_DEF.TmpSignalConversionAtEVM_CIPVOutport1[4].position.y@ */ /end MEASUREMENT
/begin MEASUREMENT autosar_swc_vmp_rtARID_DEF.TmpSignalConversionAtEVM_CIPVOutport1[4].position_sl.heading_angle "" FLOAT32_IEEE autosar_swc_vmp_CM_single 0 0 -3.4E+38 3.4E+38 ECU_ADDRESS 0xfe4cde70 /* @ECU_Address@autosar_swc_vmp_rtARID_DEF.TmpSignalConversionAtEVM_CIPVOutport1[4].position_sl.heading_angle@ */ /end MEASUREMENT
/begin MEASUREMENT autosar_swc_vmp_rtARID_DEF.TmpSignalConversionAtEVM_CIPVOutport1[4].position_sl.x "" FLOAT32_IEEE autosar_swc_vmp_CM_single 0 0 -3.4E+38 3.4E+38 ECU_ADDRESS 0xfe4cde68 /* @ECU_Address@autosar_swc_vmp_rtARID_DEF.TmpSignalConversionAtEVM_CIPVOutport1[4].position_sl.x@ */ /end MEASUREMENT
/begin MEASUREMENT autosar_swc_vmp_rtARID_DEF.TmpSignalConversionAtEVM_CIPVOutport1[4].position_sl.y "" FLOAT32_IEEE autosar_swc_vmp_CM_single 0 0 -3.4E+38 3.4E+38 ECU_ADDRESS 0xfe4cde6c /* @ECU_Address@autosar_swc_vmp_rtARID_DEF.TmpSignalConversionAtEVM_CIPVOutport1[4].position_sl.y@ */ /end MEASUREMENT
/begin MEASUREMENT autosar_swc_vmp_rtARID_DEF.TmpSignalConversionAtEVM_CIPVOutport1[4].ref_lane_id "" UBYTE autosar_swc_vmp_CM_uint8 0 0 0 255 ECU_ADDRESS 0xfe4cde34 /* @ECU_Address@autosar_swc_vmp_rtARID_DEF.TmpSignalConversionAtEVM_CIPVOutport1[4].ref_lane_id@ */ /end MEASUREMENT
/begin MEASUREMENT autosar_swc_vmp_rtARID_DEF.TmpSignalConversionAtEVM_CIPVOutport1[4].size.higth "" FLOAT32_IEEE autosar_swc_vmp_CM_single 0 0 -3.4E+38 3.4E+38 ECU_ADDRESS 0xfe4cde7c /* @ECU_Address@autosar_swc_vmp_rtARID_DEF.TmpSignalConversionAtEVM_CIPVOutport1[4].size.higth@ */ /end MEASUREMENT
/begin MEASUREMENT autosar_swc_vmp_rtARID_DEF.TmpSignalConversionAtEVM_CIPVOutport1[4].size.length "" FLOAT32_IEEE autosar_swc_vmp_CM_single 0 0 -3.4E+38 3.4E+38 ECU_ADDRESS 0xfe4cde74 /* @ECU_Address@autosar_swc_vmp_rtARID_DEF.TmpSignalConversionAtEVM_CIPVOutport1[4].size.length@ */ /end MEASUREMENT
/begin MEASUREMENT autosar_swc_vmp_rtARID_DEF.TmpSignalConversionAtEVM_CIPVOutport1[4].size.width "" FLOAT32_IEEE autosar_swc_vmp_CM_single 0 0 -3.4E+38 3.4E+38 ECU_ADDRESS 0xfe4cde78 /* @ECU_Address@autosar_swc_vmp_rtARID_DEF.TmpSignalConversionAtEVM_CIPVOutport1[4].size.width@ */ /end MEASUREMENT
/begin MEASUREMENT autosar_swc_vmp_rtARID_DEF.TmpSignalConversionAtEVM_CIPVOutport1[4].velocity_gnd.mod "" FLOAT32_IEEE autosar_swc_vmp_CM_single 0 0 -3.4E+38 3.4E+38 ECU_ADDRESS 0xfe4cde88 /* @ECU_Address@autosar_swc_vmp_rtARID_DEF.TmpSignalConversionAtEVM_CIPVOutport1[4].velocity_gnd.mod@ */ /end MEASUREMENT
/begin MEASUREMENT autosar_swc_vmp_rtARID_DEF.TmpSignalConversionAtEVM_CIPVOutport1[4].velocity_gnd.x "" FLOAT32_IEEE autosar_swc_vmp_CM_single 0 0 -3.4E+38 3.4E+38 ECU_ADDRESS 0xfe4cde80 /* @ECU_Address@autosar_swc_vmp_rtARID_DEF.TmpSignalConversionAtEVM_CIPVOutport1[4].velocity_gnd.x@ */ /end MEASUREMENT
/begin MEASUREMENT autosar_swc_vmp_rtARID_DEF.TmpSignalConversionAtEVM_CIPVOutport1[4].velocity_gnd.y "" FLOAT32_IEEE autosar_swc_vmp_CM_single 0 0 -3.4E+38 3.4E+38 ECU_ADDRESS 0xfe4cde84 /* @ECU_Address@autosar_swc_vmp_rtARID_DEF.TmpSignalConversionAtEVM_CIPVOutport1[4].velocity_gnd.y@ */ /end MEASUREMENT
/begin MEASUREMENT autosar_swc_vmp_rtARID_DEF.TmpSignalConversionAtEVM_CIPVOutport1[4].velocity_gnd_sl.mod "" FLOAT32_IEEE autosar_swc_vmp_CM_single 0 0 -3.4E+38 3.4E+38 ECU_ADDRESS 0xfe4cdea0 /* @ECU_Address@autosar_swc_vmp_rtARID_DEF.TmpSignalConversionAtEVM_CIPVOutport1[4].velocity_gnd_sl.mod@ */ /end MEASUREMENT
/begin MEASUREMENT autosar_swc_vmp_rtARID_DEF.TmpSignalConversionAtEVM_CIPVOutport1[4].velocity_gnd_sl.x "" FLOAT32_IEEE autosar_swc_vmp_CM_single 0 0 -3.4E+38 3.4E+38 ECU_ADDRESS 0xfe4cde98 /* @ECU_Address@autosar_swc_vmp_rtARID_DEF.TmpSignalConversionAtEVM_CIPVOutport1[4].velocity_gnd_sl.x@ */ /end MEASUREMENT
/begin MEASUREMENT autosar_swc_vmp_rtARID_DEF.TmpSignalConversionAtEVM_CIPVOutport1[4].velocity_gnd_sl.y "" FLOAT32_IEEE autosar_swc_vmp_CM_single 0 0 -3.4E+38 3.4E+38 ECU_ADDRESS 0xfe4cde9c /* @ECU_Address@autosar_swc_vmp_rtARID_DEF.TmpSignalConversionAtEVM_CIPVOutport1[4].velocity_gnd_sl.y@ */ /end MEASUREMENT
/begin MEASUREMENT autosar_swc_vmp_rtARID_DEF.TmpSignalConversionAtEVM_CIPVOutport1[5].accel_gnd.mod "" FLOAT32_IEEE autosar_swc_vmp_CM_single 0 0 -3.4E+38 3.4E+38 ECU_ADDRESS 0xfe4cdf14 /* @ECU_Address@autosar_swc_vmp_rtARID_DEF.TmpSignalConversionAtEVM_CIPVOutport1[5].accel_gnd.mod@ */ /end MEASUREMENT
/begin MEASUREMENT autosar_swc_vmp_rtARID_DEF.TmpSignalConversionAtEVM_CIPVOutport1[5].accel_gnd.x "" FLOAT32_IEEE autosar_swc_vmp_CM_single 0 0 -3.4E+38 3.4E+38 ECU_ADDRESS 0xfe4cdf0c /* @ECU_Address@autosar_swc_vmp_rtARID_DEF.TmpSignalConversionAtEVM_CIPVOutport1[5].accel_gnd.x@ */ /end MEASUREMENT
/begin MEASUREMENT autosar_swc_vmp_rtARID_DEF.TmpSignalConversionAtEVM_CIPVOutport1[5].accel_gnd.y "" FLOAT32_IEEE autosar_swc_vmp_CM_single 0 0 -3.4E+38 3.4E+38 ECU_ADDRESS 0xfe4cdf10 /* @ECU_Address@autosar_swc_vmp_rtARID_DEF.TmpSignalConversionAtEVM_CIPVOutport1[5].accel_gnd.y@ */ /end MEASUREMENT
/begin MEASUREMENT autosar_swc_vmp_rtARID_DEF.TmpSignalConversionAtEVM_CIPVOutport1[5].accel_gnd_sl.mod "" FLOAT32_IEEE autosar_swc_vmp_CM_single 0 0 -3.4E+38 3.4E+38 ECU_ADDRESS 0xfe4cdf2c /* @ECU_Address@autosar_swc_vmp_rtARID_DEF.TmpSignalConversionAtEVM_CIPVOutport1[5].accel_gnd_sl.mod@ */ /end MEASUREMENT
/begin MEASUREMENT autosar_swc_vmp_rtARID_DEF.TmpSignalConversionAtEVM_CIPVOutport1[5].accel_gnd_sl.x "" FLOAT32_IEEE autosar_swc_vmp_CM_single 0 0 -3.4E+38 3.4E+38 ECU_ADDRESS 0xfe4cdf24 /* @ECU_Address@autosar_swc_vmp_rtARID_DEF.TmpSignalConversionAtEVM_CIPVOutport1[5].accel_gnd_sl.x@ */ /end MEASUREMENT
/begin MEASUREMENT autosar_swc_vmp_rtARID_DEF.TmpSignalConversionAtEVM_CIPVOutport1[5].accel_gnd_sl.y "" FLOAT32_IEEE autosar_swc_vmp_CM_single 0 0 -3.4E+38 3.4E+38 ECU_ADDRESS 0xfe4cdf28 /* @ECU_Address@autosar_swc_vmp_rtARID_DEF.TmpSignalConversionAtEVM_CIPVOutport1[5].accel_gnd_sl.y@ */ /end MEASUREMENT
/begin MEASUREMENT autosar_swc_vmp_rtARID_DEF.TmpSignalConversionAtEVM_CIPVOutport1[5].box.corner_x_vec "" FLOAT32_IEEE autosar_swc_vmp_CM_single 0 0 -3.4E+38 3.4E+38 LAYOUT COLUMN_DIR MATRIX_DIM 4 ECU_ADDRESS 0xfe4cdebc /* @ECU_Address@autosar_swc_vmp_rtARID_DEF.TmpSignalConversionAtEVM_CIPVOutport1[5].box.corner_x_vec@ */ /end MEASUREMENT
/begin MEASUREMENT autosar_swc_vmp_rtARID_DEF.TmpSignalConversionAtEVM_CIPVOutport1[5].box.corner_y_vec "" FLOAT32_IEEE autosar_swc_vmp_CM_single 0 0 -3.4E+38 3.4E+38 LAYOUT COLUMN_DIR MATRIX_DIM 4 ECU_ADDRESS 0xfe4cdecc /* @ECU_Address@autosar_swc_vmp_rtARID_DEF.TmpSignalConversionAtEVM_CIPVOutport1[5].box.corner_y_vec@ */ /end MEASUREMENT
/begin MEASUREMENT autosar_swc_vmp_rtARID_DEF.TmpSignalConversionAtEVM_CIPVOutport1[5].class_type "" UBYTE autosar_swc_vmp_CM_uint8 0 0 0 255 ECU_ADDRESS 0xfe4cdeb2 /* @ECU_Address@autosar_swc_vmp_rtARID_DEF.TmpSignalConversionAtEVM_CIPVOutport1[5].class_type@ */ /end MEASUREMENT
/begin MEASUREMENT autosar_swc_vmp_rtARID_DEF.TmpSignalConversionAtEVM_CIPVOutport1[5].cut_type "" UBYTE autosar_swc_vmp_CM_uint8 0 0 0 255 ECU_ADDRESS 0xfe4cdeb3 /* @ECU_Address@autosar_swc_vmp_rtARID_DEF.TmpSignalConversionAtEVM_CIPVOutport1[5].cut_type@ */ /end MEASUREMENT
/begin MEASUREMENT autosar_swc_vmp_rtARID_DEF.TmpSignalConversionAtEVM_CIPVOutport1[5].fus_type "" UBYTE autosar_swc_vmp_CM_uint8 0 0 0 255 ECU_ADDRESS 0xfe4cdeb1 /* @ECU_Address@autosar_swc_vmp_rtARID_DEF.TmpSignalConversionAtEVM_CIPVOutport1[5].fus_type@ */ /end MEASUREMENT
/begin MEASUREMENT autosar_swc_vmp_rtARID_DEF.TmpSignalConversionAtEVM_CIPVOutport1[5].id "" ULONG autosar_swc_vmp_CM_uint32 0 0 0 4294967295 ECU_ADDRESS 0xfe4cdeb8 /* @ECU_Address@autosar_swc_vmp_rtARID_DEF.TmpSignalConversionAtEVM_CIPVOutport1[5].id@ */ /end MEASUREMENT
/begin MEASUREMENT autosar_swc_vmp_rtARID_DEF.TmpSignalConversionAtEVM_CIPVOutport1[5].meas_state "" UBYTE autosar_swc_vmp_CM_uint8 0 0 0 255 ECU_ADDRESS 0xfe4cdeb0 /* @ECU_Address@autosar_swc_vmp_rtARID_DEF.TmpSignalConversionAtEVM_CIPVOutport1[5].meas_state@ */ /end MEASUREMENT
/begin MEASUREMENT autosar_swc_vmp_rtARID_DEF.TmpSignalConversionAtEVM_CIPVOutport1[5].position.heading_angle "" FLOAT32_IEEE autosar_swc_vmp_CM_single 0 0 -3.4E+38 3.4E+38 ECU_ADDRESS 0xfe4cdee4 /* @ECU_Address@autosar_swc_vmp_rtARID_DEF.TmpSignalConversionAtEVM_CIPVOutport1[5].position.heading_angle@ */ /end MEASUREMENT
/begin MEASUREMENT autosar_swc_vmp_rtARID_DEF.TmpSignalConversionAtEVM_CIPVOutport1[5].position.x "" FLOAT32_IEEE autosar_swc_vmp_CM_single 0 0 -3.4E+38 3.4E+38 ECU_ADDRESS 0xfe4cdedc /* @ECU_Address@autosar_swc_vmp_rtARID_DEF.TmpSignalConversionAtEVM_CIPVOutport1[5].position.x@ */ /end MEASUREMENT
/begin MEASUREMENT autosar_swc_vmp_rtARID_DEF.TmpSignalConversionAtEVM_CIPVOutport1[5].position.y "" FLOAT32_IEEE autosar_swc_vmp_CM_single 0 0 -3.4E+38 3.4E+38 ECU_ADDRESS 0xfe4cdee0 /* @ECU_Address@autosar_swc_vmp_rtARID_DEF.TmpSignalConversionAtEVM_CIPVOutport1[5].position.y@ */ /end MEASUREMENT
/begin MEASUREMENT autosar_swc_vmp_rtARID_DEF.TmpSignalConversionAtEVM_CIPVOutport1[5].position_sl.heading_angle "" FLOAT32_IEEE autosar_swc_vmp_CM_single 0 0 -3.4E+38 3.4E+38 ECU_ADDRESS 0xfe4cdef0 /* @ECU_Address@autosar_swc_vmp_rtARID_DEF.TmpSignalConversionAtEVM_CIPVOutport1[5].position_sl.heading_angle@ */ /end MEASUREMENT
/begin MEASUREMENT autosar_swc_vmp_rtARID_DEF.TmpSignalConversionAtEVM_CIPVOutport1[5].position_sl.x "" FLOAT32_IEEE autosar_swc_vmp_CM_single 0 0 -3.4E+38 3.4E+38 ECU_ADDRESS 0xfe4cdee8 /* @ECU_Address@autosar_swc_vmp_rtARID_DEF.TmpSignalConversionAtEVM_CIPVOutport1[5].position_sl.x@ */ /end MEASUREMENT
/begin MEASUREMENT autosar_swc_vmp_rtARID_DEF.TmpSignalConversionAtEVM_CIPVOutport1[5].position_sl.y "" FLOAT32_IEEE autosar_swc_vmp_CM_single 0 0 -3.4E+38 3.4E+38 ECU_ADDRESS 0xfe4cdeec /* @ECU_Address@autosar_swc_vmp_rtARID_DEF.TmpSignalConversionAtEVM_CIPVOutport1[5].position_sl.y@ */ /end MEASUREMENT
/begin MEASUREMENT autosar_swc_vmp_rtARID_DEF.TmpSignalConversionAtEVM_CIPVOutport1[5].ref_lane_id "" UBYTE autosar_swc_vmp_CM_uint8 0 0 0 255 ECU_ADDRESS 0xfe4cdeb4 /* @ECU_Address@autosar_swc_vmp_rtARID_DEF.TmpSignalConversionAtEVM_CIPVOutport1[5].ref_lane_id@ */ /end MEASUREMENT
/begin MEASUREMENT autosar_swc_vmp_rtARID_DEF.TmpSignalConversionAtEVM_CIPVOutport1[5].size.higth "" FLOAT32_IEEE autosar_swc_vmp_CM_single 0 0 -3.4E+38 3.4E+38 ECU_ADDRESS 0xfe4cdefc /* @ECU_Address@autosar_swc_vmp_rtARID_DEF.TmpSignalConversionAtEVM_CIPVOutport1[5].size.higth@ */ /end MEASUREMENT
/begin MEASUREMENT autosar_swc_vmp_rtARID_DEF.TmpSignalConversionAtEVM_CIPVOutport1[5].size.length "" FLOAT32_IEEE autosar_swc_vmp_CM_single 0 0 -3.4E+38 3.4E+38 ECU_ADDRESS 0xfe4cdef4 /* @ECU_Address@autosar_swc_vmp_rtARID_DEF.TmpSignalConversionAtEVM_CIPVOutport1[5].size.length@ */ /end MEASUREMENT
/begin MEASUREMENT autosar_swc_vmp_rtARID_DEF.TmpSignalConversionAtEVM_CIPVOutport1[5].size.width "" FLOAT32_IEEE autosar_swc_vmp_CM_single 0 0 -3.4E+38 3.4E+38 ECU_ADDRESS 0xfe4cdef8 /* @ECU_Address@autosar_swc_vmp_rtARID_DEF.TmpSignalConversionAtEVM_CIPVOutport1[5].size.width@ */ /end MEASUREMENT
/begin MEASUREMENT autosar_swc_vmp_rtARID_DEF.TmpSignalConversionAtEVM_CIPVOutport1[5].velocity_gnd.mod "" FLOAT32_IEEE autosar_swc_vmp_CM_single 0 0 -3.4E+38 3.4E+38 ECU_ADDRESS 0xfe4cdf08 /* @ECU_Address@autosar_swc_vmp_rtARID_DEF.TmpSignalConversionAtEVM_CIPVOutport1[5].velocity_gnd.mod@ */ /end MEASUREMENT
/begin MEASUREMENT autosar_swc_vmp_rtARID_DEF.TmpSignalConversionAtEVM_CIPVOutport1[5].velocity_gnd.x "" FLOAT32_IEEE autosar_swc_vmp_CM_single 0 0 -3.4E+38 3.4E+38 ECU_ADDRESS 0xfe4cdf00 /* @ECU_Address@autosar_swc_vmp_rtARID_DEF.TmpSignalConversionAtEVM_CIPVOutport1[5].velocity_gnd.x@ */ /end MEASUREMENT
/begin MEASUREMENT autosar_swc_vmp_rtARID_DEF.TmpSignalConversionAtEVM_CIPVOutport1[5].velocity_gnd.y "" FLOAT32_IEEE autosar_swc_vmp_CM_single 0 0 -3.4E+38 3.4E+38 ECU_ADDRESS 0xfe4cdf04 /* @ECU_Address@autosar_swc_vmp_rtARID_DEF.TmpSignalConversionAtEVM_CIPVOutport1[5].velocity_gnd.y@ */ /end MEASUREMENT
/begin MEASUREMENT autosar_swc_vmp_rtARID_DEF.TmpSignalConversionAtEVM_CIPVOutport1[5].velocity_gnd_sl.mod "" FLOAT32_IEEE autosar_swc_vmp_CM_single 0 0 -3.4E+38 3.4E+38 ECU_ADDRESS 0xfe4cdf20 /* @ECU_Address@autosar_swc_vmp_rtARID_DEF.TmpSignalConversionAtEVM_CIPVOutport1[5].velocity_gnd_sl.mod@ */ /end MEASUREMENT
/begin MEASUREMENT autosar_swc_vmp_rtARID_DEF.TmpSignalConversionAtEVM_CIPVOutport1[5].velocity_gnd_sl.x "" FLOAT32_IEEE autosar_swc_vmp_CM_single 0 0 -3.4E+38 3.4E+38 ECU_ADDRESS 0xfe4cdf18 /* @ECU_Address@autosar_swc_vmp_rtARID_DEF.TmpSignalConversionAtEVM_CIPVOutport1[5].velocity_gnd_sl.x@ */ /end MEASUREMENT
/begin MEASUREMENT autosar_swc_vmp_rtARID_DEF.TmpSignalConversionAtEVM_CIPVOutport1[5].velocity_gnd_sl.y "" FLOAT32_IEEE autosar_swc_vmp_CM_single 0 0 -3.4E+38 3.4E+38 ECU_ADDRESS 0xfe4cdf1c /* @ECU_Address@autosar_swc_vmp_rtARID_DEF.TmpSignalConversionAtEVM_CIPVOutport1[5].velocity_gnd_sl.y@ */ /end MEASUREMENT
/begin MEASUREMENT autosar_swc_vmp_rtARID_DEF.TmpSignalConversionAtEVM_CIPVOutport1[6].accel_gnd.mod "" FLOAT32_IEEE autosar_swc_vmp_CM_single 0 0 -3.4E+38 3.4E+38 ECU_ADDRESS 0xfe4cdf94 /* @ECU_Address@autosar_swc_vmp_rtARID_DEF.TmpSignalConversionAtEVM_CIPVOutport1[6].accel_gnd.mod@ */ /end MEASUREMENT
/begin MEASUREMENT autosar_swc_vmp_rtARID_DEF.TmpSignalConversionAtEVM_CIPVOutport1[6].accel_gnd.x "" FLOAT32_IEEE autosar_swc_vmp_CM_single 0 0 -3.4E+38 3.4E+38 ECU_ADDRESS 0xfe4cdf8c /* @ECU_Address@autosar_swc_vmp_rtARID_DEF.TmpSignalConversionAtEVM_CIPVOutport1[6].accel_gnd.x@ */ /end MEASUREMENT
/begin MEASUREMENT autosar_swc_vmp_rtARID_DEF.TmpSignalConversionAtEVM_CIPVOutport1[6].accel_gnd.y "" FLOAT32_IEEE autosar_swc_vmp_CM_single 0 0 -3.4E+38 3.4E+38 ECU_ADDRESS 0xfe4cdf90 /* @ECU_Address@autosar_swc_vmp_rtARID_DEF.TmpSignalConversionAtEVM_CIPVOutport1[6].accel_gnd.y@ */ /end MEASUREMENT
/begin MEASUREMENT autosar_swc_vmp_rtARID_DEF.TmpSignalConversionAtEVM_CIPVOutport1[6].accel_gnd_sl.mod "" FLOAT32_IEEE autosar_swc_vmp_CM_single 0 0 -3.4E+38 3.4E+38 ECU_ADDRESS 0xfe4cdfac /* @ECU_Address@autosar_swc_vmp_rtARID_DEF.TmpSignalConversionAtEVM_CIPVOutport1[6].accel_gnd_sl.mod@ */ /end MEASUREMENT
/begin MEASUREMENT autosar_swc_vmp_rtARID_DEF.TmpSignalConversionAtEVM_CIPVOutport1[6].accel_gnd_sl.x "" FLOAT32_IEEE autosar_swc_vmp_CM_single 0 0 -3.4E+38 3.4E+38 ECU_ADDRESS 0xfe4cdfa4 /* @ECU_Address@autosar_swc_vmp_rtARID_DEF.TmpSignalConversionAtEVM_CIPVOutport1[6].accel_gnd_sl.x@ */ /end MEASUREMENT
/begin MEASUREMENT autosar_swc_vmp_rtARID_DEF.TmpSignalConversionAtEVM_CIPVOutport1[6].accel_gnd_sl.y "" FLOAT32_IEEE autosar_swc_vmp_CM_single 0 0 -3.4E+38 3.4E+38 ECU_ADDRESS 0xfe4cdfa8 /* @ECU_Address@autosar_swc_vmp_rtARID_DEF.TmpSignalConversionAtEVM_CIPVOutport1[6].accel_gnd_sl.y@ */ /end MEASUREMENT
/begin MEASUREMENT autosar_swc_vmp_rtARID_DEF.TmpSignalConversionAtEVM_CIPVOutport1[6].box.corner_x_vec "" FLOAT32_IEEE autosar_swc_vmp_CM_single 0 0 -3.4E+38 3.4E+38 LAYOUT COLUMN_DIR MATRIX_DIM 4 ECU_ADDRESS 0xfe4cdf3c /* @ECU_Address@autosar_swc_vmp_rtARID_DEF.TmpSignalConversionAtEVM_CIPVOutport1[6].box.corner_x_vec@ */ /end MEASUREMENT
/begin MEASUREMENT autosar_swc_vmp_rtARID_DEF.TmpSignalConversionAtEVM_CIPVOutport1[6].box.corner_y_vec "" FLOAT32_IEEE autosar_swc_vmp_CM_single 0 0 -3.4E+38 3.4E+38 LAYOUT COLUMN_DIR MATRIX_DIM 4 ECU_ADDRESS 0xfe4cdf4c /* @ECU_Address@autosar_swc_vmp_rtARID_DEF.TmpSignalConversionAtEVM_CIPVOutport1[6].box.corner_y_vec@ */ /end MEASUREMENT
/begin MEASUREMENT autosar_swc_vmp_rtARID_DEF.TmpSignalConversionAtEVM_CIPVOutport1[6].class_type "" UBYTE autosar_swc_vmp_CM_uint8 0 0 0 255 ECU_ADDRESS 0xfe4cdf32 /* @ECU_Address@autosar_swc_vmp_rtARID_DEF.TmpSignalConversionAtEVM_CIPVOutport1[6].class_type@ */ /end MEASUREMENT
/begin MEASUREMENT autosar_swc_vmp_rtARID_DEF.TmpSignalConversionAtEVM_CIPVOutport1[6].cut_type "" UBYTE autosar_swc_vmp_CM_uint8 0 0 0 255 ECU_ADDRESS 0xfe4cdf33 /* @ECU_Address@autosar_swc_vmp_rtARID_DEF.TmpSignalConversionAtEVM_CIPVOutport1[6].cut_type@ */ /end MEASUREMENT
/begin MEASUREMENT autosar_swc_vmp_rtARID_DEF.TmpSignalConversionAtEVM_CIPVOutport1[6].fus_type "" UBYTE autosar_swc_vmp_CM_uint8 0 0 0 255 ECU_ADDRESS 0xfe4cdf31 /* @ECU_Address@autosar_swc_vmp_rtARID_DEF.TmpSignalConversionAtEVM_CIPVOutport1[6].fus_type@ */ /end MEASUREMENT
/begin MEASUREMENT autosar_swc_vmp_rtARID_DEF.TmpSignalConversionAtEVM_CIPVOutport1[6].id "" ULONG autosar_swc_vmp_CM_uint32 0 0 0 4294967295 ECU_ADDRESS 0xfe4cdf38 /* @ECU_Address@autosar_swc_vmp_rtARID_DEF.TmpSignalConversionAtEVM_CIPVOutport1[6].id@ */ /end MEASUREMENT
/begin MEASUREMENT autosar_swc_vmp_rtARID_DEF.TmpSignalConversionAtEVM_CIPVOutport1[6].meas_state "" UBYTE autosar_swc_vmp_CM_uint8 0 0 0 255 ECU_ADDRESS 0xfe4cdf30 /* @ECU_Address@autosar_swc_vmp_rtARID_DEF.TmpSignalConversionAtEVM_CIPVOutport1[6].meas_state@ */ /end MEASUREMENT
/begin MEASUREMENT autosar_swc_vmp_rtARID_DEF.TmpSignalConversionAtEVM_CIPVOutport1[6].position.heading_angle "" FLOAT32_IEEE autosar_swc_vmp_CM_single 0 0 -3.4E+38 3.4E+38 ECU_ADDRESS 0xfe4cdf64 /* @ECU_Address@autosar_swc_vmp_rtARID_DEF.TmpSignalConversionAtEVM_CIPVOutport1[6].position.heading_angle@ */ /end MEASUREMENT
/begin MEASUREMENT autosar_swc_vmp_rtARID_DEF.TmpSignalConversionAtEVM_CIPVOutport1[6].position.x "" FLOAT32_IEEE autosar_swc_vmp_CM_single 0 0 -3.4E+38 3.4E+38 ECU_ADDRESS 0xfe4cdf5c /* @ECU_Address@autosar_swc_vmp_rtARID_DEF.TmpSignalConversionAtEVM_CIPVOutport1[6].position.x@ */ /end MEASUREMENT
/begin MEASUREMENT autosar_swc_vmp_rtARID_DEF.TmpSignalConversionAtEVM_CIPVOutport1[6].position.y "" FLOAT32_IEEE autosar_swc_vmp_CM_single 0 0 -3.4E+38 3.4E+38 ECU_ADDRESS 0xfe4cdf60 /* @ECU_Address@autosar_swc_vmp_rtARID_DEF.TmpSignalConversionAtEVM_CIPVOutport1[6].position.y@ */ /end MEASUREMENT
/begin MEASUREMENT autosar_swc_vmp_rtARID_DEF.TmpSignalConversionAtEVM_CIPVOutport1[6].position_sl.heading_angle "" FLOAT32_IEEE autosar_swc_vmp_CM_single 0 0 -3.4E+38 3.4E+38 ECU_ADDRESS 0xfe4cdf70 /* @ECU_Address@autosar_swc_vmp_rtARID_DEF.TmpSignalConversionAtEVM_CIPVOutport1[6].position_sl.heading_angle@ */ /end MEASUREMENT
/begin MEASUREMENT autosar_swc_vmp_rtARID_DEF.TmpSignalConversionAtEVM_CIPVOutport1[6].position_sl.x "" FLOAT32_IEEE autosar_swc_vmp_CM_single 0 0 -3.4E+38 3.4E+38 ECU_ADDRESS 0xfe4cdf68 /* @ECU_Address@autosar_swc_vmp_rtARID_DEF.TmpSignalConversionAtEVM_CIPVOutport1[6].position_sl.x@ */ /end MEASUREMENT
/begin MEASUREMENT autosar_swc_vmp_rtARID_DEF.TmpSignalConversionAtEVM_CIPVOutport1[6].position_sl.y "" FLOAT32_IEEE autosar_swc_vmp_CM_single 0 0 -3.4E+38 3.4E+38 ECU_ADDRESS 0xfe4cdf6c /* @ECU_Address@autosar_swc_vmp_rtARID_DEF.TmpSignalConversionAtEVM_CIPVOutport1[6].position_sl.y@ */ /end MEASUREMENT
/begin MEASUREMENT autosar_swc_vmp_rtARID_DEF.TmpSignalConversionAtEVM_CIPVOutport1[6].ref_lane_id "" UBYTE autosar_swc_vmp_CM_uint8 0 0 0 255 ECU_ADDRESS 0xfe4cdf34 /* @ECU_Address@autosar_swc_vmp_rtARID_DEF.TmpSignalConversionAtEVM_CIPVOutport1[6].ref_lane_id@ */ /end MEASUREMENT
/begin MEASUREMENT autosar_swc_vmp_rtARID_DEF.TmpSignalConversionAtEVM_CIPVOutport1[6].size.higth "" FLOAT32_IEEE autosar_swc_vmp_CM_single 0 0 -3.4E+38 3.4E+38 ECU_ADDRESS 0xfe4cdf7c /* @ECU_Address@autosar_swc_vmp_rtARID_DEF.TmpSignalConversionAtEVM_CIPVOutport1[6].size.higth@ */ /end MEASUREMENT
/begin MEASUREMENT autosar_swc_vmp_rtARID_DEF.TmpSignalConversionAtEVM_CIPVOutport1[6].size.length "" FLOAT32_IEEE autosar_swc_vmp_CM_single 0 0 -3.4E+38 3.4E+38 ECU_ADDRESS 0xfe4cdf74 /* @ECU_Address@autosar_swc_vmp_rtARID_DEF.TmpSignalConversionAtEVM_CIPVOutport1[6].size.length@ */ /end MEASUREMENT
/begin MEASUREMENT autosar_swc_vmp_rtARID_DEF.TmpSignalConversionAtEVM_CIPVOutport1[6].size.width "" FLOAT32_IEEE autosar_swc_vmp_CM_single 0 0 -3.4E+38 3.4E+38 ECU_ADDRESS 0xfe4cdf78 /* @ECU_Address@autosar_swc_vmp_rtARID_DEF.TmpSignalConversionAtEVM_CIPVOutport1[6].size.width@ */ /end MEASUREMENT
/begin MEASUREMENT autosar_swc_vmp_rtARID_DEF.TmpSignalConversionAtEVM_CIPVOutport1[6].velocity_gnd.mod "" FLOAT32_IEEE autosar_swc_vmp_CM_single 0 0 -3.4E+38 3.4E+38 ECU_ADDRESS 0xfe4cdf88 /* @ECU_Address@autosar_swc_vmp_rtARID_DEF.TmpSignalConversionAtEVM_CIPVOutport1[6].velocity_gnd.mod@ */ /end MEASUREMENT
/begin MEASUREMENT autosar_swc_vmp_rtARID_DEF.TmpSignalConversionAtEVM_CIPVOutport1[6].velocity_gnd.x "" FLOAT32_IEEE autosar_swc_vmp_CM_single 0 0 -3.4E+38 3.4E+38 ECU_ADDRESS 0xfe4cdf80 /* @ECU_Address@autosar_swc_vmp_rtARID_DEF.TmpSignalConversionAtEVM_CIPVOutport1[6].velocity_gnd.x@ */ /end MEASUREMENT
/begin MEASUREMENT autosar_swc_vmp_rtARID_DEF.TmpSignalConversionAtEVM_CIPVOutport1[6].velocity_gnd.y "" FLOAT32_IEEE autosar_swc_vmp_CM_single 0 0 -3.4E+38 3.4E+38 ECU_ADDRESS 0xfe4cdf84 /* @ECU_Address@autosar_swc_vmp_rtARID_DEF.TmpSignalConversionAtEVM_CIPVOutport1[6].velocity_gnd.y@ */ /end MEASUREMENT
/begin MEASUREMENT autosar_swc_vmp_rtARID_DEF.TmpSignalConversionAtEVM_CIPVOutport1[6].velocity_gnd_sl.mod "" FLOAT32_IEEE autosar_swc_vmp_CM_single 0 0 -3.4E+38 3.4E+38 ECU_ADDRESS 0xfe4cdfa0 /* @ECU_Address@autosar_swc_vmp_rtARID_DEF.TmpSignalConversionAtEVM_CIPVOutport1[6].velocity_gnd_sl.mod@ */ /end MEASUREMENT
/begin MEASUREMENT autosar_swc_vmp_rtARID_DEF.TmpSignalConversionAtEVM_CIPVOutport1[6].velocity_gnd_sl.x "" FLOAT32_IEEE autosar_swc_vmp_CM_single 0 0 -3.4E+38 3.4E+38 ECU_ADDRESS 0xfe4cdf98 /* @ECU_Address@autosar_swc_vmp_rtARID_DEF.TmpSignalConversionAtEVM_CIPVOutport1[6].velocity_gnd_sl.x@ */ /end MEASUREMENT
/begin MEASUREMENT autosar_swc_vmp_rtARID_DEF.TmpSignalConversionAtEVM_CIPVOutport1[6].velocity_gnd_sl.y "" FLOAT32_IEEE autosar_swc_vmp_CM_single 0 0 -3.4E+38 3.4E+38 ECU_ADDRESS 0xfe4cdf9c /* @ECU_Address@autosar_swc_vmp_rtARID_DEF.TmpSignalConversionAtEVM_CIPVOutport1[6].velocity_gnd_sl.y@ */ /end MEASUREMENT
/begin MEASUREMENT autosar_swc_vmp_rtARID_DEF.TmpSignalConversionAtEVM_CIPVOutport1[7].accel_gnd.mod "" FLOAT32_IEEE autosar_swc_vmp_CM_single 0 0 -3.4E+38 3.4E+38 ECU_ADDRESS 0xfe4ce014 /* @ECU_Address@autosar_swc_vmp_rtARID_DEF.TmpSignalConversionAtEVM_CIPVOutport1[7].accel_gnd.mod@ */ /end MEASUREMENT
/begin MEASUREMENT autosar_swc_vmp_rtARID_DEF.TmpSignalConversionAtEVM_CIPVOutport1[7].accel_gnd.x "" FLOAT32_IEEE autosar_swc_vmp_CM_single 0 0 -3.4E+38 3.4E+38 ECU_ADDRESS 0xfe4ce00c /* @ECU_Address@autosar_swc_vmp_rtARID_DEF.TmpSignalConversionAtEVM_CIPVOutport1[7].accel_gnd.x@ */ /end MEASUREMENT
/begin MEASUREMENT autosar_swc_vmp_rtARID_DEF.TmpSignalConversionAtEVM_CIPVOutport1[7].accel_gnd.y "" FLOAT32_IEEE autosar_swc_vmp_CM_single 0 0 -3.4E+38 3.4E+38 ECU_ADDRESS 0xfe4ce010 /* @ECU_Address@autosar_swc_vmp_rtARID_DEF.TmpSignalConversionAtEVM_CIPVOutport1[7].accel_gnd.y@ */ /end MEASUREMENT
/begin MEASUREMENT autosar_swc_vmp_rtARID_DEF.TmpSignalConversionAtEVM_CIPVOutport1[7].accel_gnd_sl.mod "" FLOAT32_IEEE autosar_swc_vmp_CM_single 0 0 -3.4E+38 3.4E+38 ECU_ADDRESS 0xfe4ce02c /* @ECU_Address@autosar_swc_vmp_rtARID_DEF.TmpSignalConversionAtEVM_CIPVOutport1[7].accel_gnd_sl.mod@ */ /end MEASUREMENT
/begin MEASUREMENT autosar_swc_vmp_rtARID_DEF.TmpSignalConversionAtEVM_CIPVOutport1[7].accel_gnd_sl.x "" FLOAT32_IEEE autosar_swc_vmp_CM_single 0 0 -3.4E+38 3.4E+38 ECU_ADDRESS 0xfe4ce024 /* @ECU_Address@autosar_swc_vmp_rtARID_DEF.TmpSignalConversionAtEVM_CIPVOutport1[7].accel_gnd_sl.x@ */ /end MEASUREMENT
/begin MEASUREMENT autosar_swc_vmp_rtARID_DEF.TmpSignalConversionAtEVM_CIPVOutport1[7].accel_gnd_sl.y "" FLOAT32_IEEE autosar_swc_vmp_CM_single 0 0 -3.4E+38 3.4E+38 ECU_ADDRESS 0xfe4ce028 /* @ECU_Address@autosar_swc_vmp_rtARID_DEF.TmpSignalConversionAtEVM_CIPVOutport1[7].accel_gnd_sl.y@ */ /end MEASUREMENT
/begin MEASUREMENT autosar_swc_vmp_rtARID_DEF.TmpSignalConversionAtEVM_CIPVOutport1[7].box.corner_x_vec "" FLOAT32_IEEE autosar_swc_vmp_CM_single 0 0 -3.4E+38 3.4E+38 LAYOUT COLUMN_DIR MATRIX_DIM 4 ECU_ADDRESS 0xfe4cdfbc /* @ECU_Address@autosar_swc_vmp_rtARID_DEF.TmpSignalConversionAtEVM_CIPVOutport1[7].box.corner_x_vec@ */ /end MEASUREMENT
/begin MEASUREMENT autosar_swc_vmp_rtARID_DEF.TmpSignalConversionAtEVM_CIPVOutport1[7].box.corner_y_vec "" FLOAT32_IEEE autosar_swc_vmp_CM_single 0 0 -3.4E+38 3.4E+38 LAYOUT COLUMN_DIR MATRIX_DIM 4 ECU_ADDRESS 0xfe4cdfcc /* @ECU_Address@autosar_swc_vmp_rtARID_DEF.TmpSignalConversionAtEVM_CIPVOutport1[7].box.corner_y_vec@ */ /end MEASUREMENT
/begin MEASUREMENT autosar_swc_vmp_rtARID_DEF.TmpSignalConversionAtEVM_CIPVOutport1[7].class_type "" UBYTE autosar_swc_vmp_CM_uint8 0 0 0 255 ECU_ADDRESS 0xfe4cdfb2 /* @ECU_Address@autosar_swc_vmp_rtARID_DEF.TmpSignalConversionAtEVM_CIPVOutport1[7].class_type@ */ /end MEASUREMENT
/begin MEASUREMENT autosar_swc_vmp_rtARID_DEF.TmpSignalConversionAtEVM_CIPVOutport1[7].cut_type "" UBYTE autosar_swc_vmp_CM_uint8 0 0 0 255 ECU_ADDRESS 0xfe4cdfb3 /* @ECU_Address@autosar_swc_vmp_rtARID_DEF.TmpSignalConversionAtEVM_CIPVOutport1[7].cut_type@ */ /end MEASUREMENT
/begin MEASUREMENT autosar_swc_vmp_rtARID_DEF.TmpSignalConversionAtEVM_CIPVOutport1[7].fus_type "" UBYTE autosar_swc_vmp_CM_uint8 0 0 0 255 ECU_ADDRESS 0xfe4cdfb1 /* @ECU_Address@autosar_swc_vmp_rtARID_DEF.TmpSignalConversionAtEVM_CIPVOutport1[7].fus_type@ */ /end MEASUREMENT
/begin MEASUREMENT autosar_swc_vmp_rtARID_DEF.TmpSignalConversionAtEVM_CIPVOutport1[7].id "" ULONG autosar_swc_vmp_CM_uint32 0 0 0 4294967295 ECU_ADDRESS 0xfe4cdfb8 /* @ECU_Address@autosar_swc_vmp_rtARID_DEF.TmpSignalConversionAtEVM_CIPVOutport1[7].id@ */ /end MEASUREMENT
/begin MEASUREMENT autosar_swc_vmp_rtARID_DEF.TmpSignalConversionAtEVM_CIPVOutport1[7].meas_state "" UBYTE autosar_swc_vmp_CM_uint8 0 0 0 255 ECU_ADDRESS 0xfe4cdfb0 /* @ECU_Address@autosar_swc_vmp_rtARID_DEF.TmpSignalConversionAtEVM_CIPVOutport1[7].meas_state@ */ /end MEASUREMENT
/begin MEASUREMENT autosar_swc_vmp_rtARID_DEF.TmpSignalConversionAtEVM_CIPVOutport1[7].position.heading_angle "" FLOAT32_IEEE autosar_swc_vmp_CM_single 0 0 -3.4E+38 3.4E+38 ECU_ADDRESS 0xfe4cdfe4 /* @ECU_Address@autosar_swc_vmp_rtARID_DEF.TmpSignalConversionAtEVM_CIPVOutport1[7].position.heading_angle@ */ /end MEASUREMENT
/begin MEASUREMENT autosar_swc_vmp_rtARID_DEF.TmpSignalConversionAtEVM_CIPVOutport1[7].position.x "" FLOAT32_IEEE autosar_swc_vmp_CM_single 0 0 -3.4E+38 3.4E+38 ECU_ADDRESS 0xfe4cdfdc /* @ECU_Address@autosar_swc_vmp_rtARID_DEF.TmpSignalConversionAtEVM_CIPVOutport1[7].position.x@ */ /end MEASUREMENT
/begin MEASUREMENT autosar_swc_vmp_rtARID_DEF.TmpSignalConversionAtEVM_CIPVOutport1[7].position.y "" FLOAT32_IEEE autosar_swc_vmp_CM_single 0 0 -3.4E+38 3.4E+38 ECU_ADDRESS 0xfe4cdfe0 /* @ECU_Address@autosar_swc_vmp_rtARID_DEF.TmpSignalConversionAtEVM_CIPVOutport1[7].position.y@ */ /end MEASUREMENT
/begin MEASUREMENT autosar_swc_vmp_rtARID_DEF.TmpSignalConversionAtEVM_CIPVOutport1[7].position_sl.heading_angle "" FLOAT32_IEEE autosar_swc_vmp_CM_single 0 0 -3.4E+38 3.4E+38 ECU_ADDRESS 0xfe4cdff0 /* @ECU_Address@autosar_swc_vmp_rtARID_DEF.TmpSignalConversionAtEVM_CIPVOutport1[7].position_sl.heading_angle@ */ /end MEASUREMENT
/begin MEASUREMENT autosar_swc_vmp_rtARID_DEF.TmpSignalConversionAtEVM_CIPVOutport1[7].position_sl.x "" FLOAT32_IEEE autosar_swc_vmp_CM_single 0 0 -3.4E+38 3.4E+38 ECU_ADDRESS 0xfe4cdfe8 /* @ECU_Address@autosar_swc_vmp_rtARID_DEF.TmpSignalConversionAtEVM_CIPVOutport1[7].position_sl.x@ */ /end MEASUREMENT
/begin MEASUREMENT autosar_swc_vmp_rtARID_DEF.TmpSignalConversionAtEVM_CIPVOutport1[7].position_sl.y "" FLOAT32_IEEE autosar_swc_vmp_CM_single 0 0 -3.4E+38 3.4E+38 ECU_ADDRESS 0xfe4cdfec /* @ECU_Address@autosar_swc_vmp_rtARID_DEF.TmpSignalConversionAtEVM_CIPVOutport1[7].position_sl.y@ */ /end MEASUREMENT
/begin MEASUREMENT autosar_swc_vmp_rtARID_DEF.TmpSignalConversionAtEVM_CIPVOutport1[7].ref_lane_id "" UBYTE autosar_swc_vmp_CM_uint8 0 0 0 255 ECU_ADDRESS 0xfe4cdfb4 /* @ECU_Address@autosar_swc_vmp_rtARID_DEF.TmpSignalConversionAtEVM_CIPVOutport1[7].ref_lane_id@ */ /end MEASUREMENT
/begin MEASUREMENT autosar_swc_vmp_rtARID_DEF.TmpSignalConversionAtEVM_CIPVOutport1[7].size.higth "" FLOAT32_IEEE autosar_swc_vmp_CM_single 0 0 -3.4E+38 3.4E+38 ECU_ADDRESS 0xfe4cdffc /* @ECU_Address@autosar_swc_vmp_rtARID_DEF.TmpSignalConversionAtEVM_CIPVOutport1[7].size.higth@ */ /end MEASUREMENT
/begin MEASUREMENT autosar_swc_vmp_rtARID_DEF.TmpSignalConversionAtEVM_CIPVOutport1[7].size.length "" FLOAT32_IEEE autosar_swc_vmp_CM_single 0 0 -3.4E+38 3.4E+38 ECU_ADDRESS 0xfe4cdff4 /* @ECU_Address@autosar_swc_vmp_rtARID_DEF.TmpSignalConversionAtEVM_CIPVOutport1[7].size.length@ */ /end MEASUREMENT
/begin MEASUREMENT autosar_swc_vmp_rtARID_DEF.TmpSignalConversionAtEVM_CIPVOutport1[7].size.width "" FLOAT32_IEEE autosar_swc_vmp_CM_single 0 0 -3.4E+38 3.4E+38 ECU_ADDRESS 0xfe4cdff8 /* @ECU_Address@autosar_swc_vmp_rtARID_DEF.TmpSignalConversionAtEVM_CIPVOutport1[7].size.width@ */ /end MEASUREMENT
/begin MEASUREMENT autosar_swc_vmp_rtARID_DEF.TmpSignalConversionAtEVM_CIPVOutport1[7].velocity_gnd.mod "" FLOAT32_IEEE autosar_swc_vmp_CM_single 0 0 -3.4E+38 3.4E+38 ECU_ADDRESS 0xfe4ce008 /* @ECU_Address@autosar_swc_vmp_rtARID_DEF.TmpSignalConversionAtEVM_CIPVOutport1[7].velocity_gnd.mod@ */ /end MEASUREMENT
/begin MEASUREMENT autosar_swc_vmp_rtARID_DEF.TmpSignalConversionAtEVM_CIPVOutport1[7].velocity_gnd.x "" FLOAT32_IEEE autosar_swc_vmp_CM_single 0 0 -3.4E+38 3.4E+38 ECU_ADDRESS 0xfe4ce000 /* @ECU_Address@autosar_swc_vmp_rtARID_DEF.TmpSignalConversionAtEVM_CIPVOutport1[7].velocity_gnd.x@ */ /end MEASUREMENT
/begin MEASUREMENT autosar_swc_vmp_rtARID_DEF.TmpSignalConversionAtEVM_CIPVOutport1[7].velocity_gnd.y "" FLOAT32_IEEE autosar_swc_vmp_CM_single 0 0 -3.4E+38 3.4E+38 ECU_ADDRESS 0xfe4ce004 /* @ECU_Address@autosar_swc_vmp_rtARID_DEF.TmpSignalConversionAtEVM_CIPVOutport1[7].velocity_gnd.y@ */ /end MEASUREMENT
/begin MEASUREMENT autosar_swc_vmp_rtARID_DEF.TmpSignalConversionAtEVM_CIPVOutport1[7].velocity_gnd_sl.mod "" FLOAT32_IEEE autosar_swc_vmp_CM_single 0 0 -3.4E+38 3.4E+38 ECU_ADDRESS 0xfe4ce020 /* @ECU_Address@autosar_swc_vmp_rtARID_DEF.TmpSignalConversionAtEVM_CIPVOutport1[7].velocity_gnd_sl.mod@ */ /end MEASUREMENT
/begin MEASUREMENT autosar_swc_vmp_rtARID_DEF.TmpSignalConversionAtEVM_CIPVOutport1[7].velocity_gnd_sl.x "" FLOAT32_IEEE autosar_swc_vmp_CM_single 0 0 -3.4E+38 3.4E+38 ECU_ADDRESS 0xfe4ce018 /* @ECU_Address@autosar_swc_vmp_rtARID_DEF.TmpSignalConversionAtEVM_CIPVOutport1[7].velocity_gnd_sl.x@ */ /end MEASUREMENT
/begin MEASUREMENT autosar_swc_vmp_rtARID_DEF.TmpSignalConversionAtEVM_CIPVOutport1[7].velocity_gnd_sl.y "" FLOAT32_IEEE autosar_swc_vmp_CM_single 0 0 -3.4E+38 3.4E+38 ECU_ADDRESS 0xfe4ce01c /* @ECU_Address@autosar_swc_vmp_rtARID_DEF.TmpSignalConversionAtEVM_CIPVOutport1[7].velocity_gnd_sl.y@ */ /end MEASUREMENT
/begin MEASUREMENT autosar_swc_vmp_rtARID_DEF.TmpSignalConversionAtEVM_CIPVOutport1[8].accel_gnd.mod "" FLOAT32_IEEE autosar_swc_vmp_CM_single 0 0 -3.4E+38 3.4E+38 ECU_ADDRESS 0xfe4ce094 /* @ECU_Address@autosar_swc_vmp_rtARID_DEF.TmpSignalConversionAtEVM_CIPVOutport1[8].accel_gnd.mod@ */ /end MEASUREMENT
/begin MEASUREMENT autosar_swc_vmp_rtARID_DEF.TmpSignalConversionAtEVM_CIPVOutport1[8].accel_gnd.x "" FLOAT32_IEEE autosar_swc_vmp_CM_single 0 0 -3.4E+38 3.4E+38 ECU_ADDRESS 0xfe4ce08c /* @ECU_Address@autosar_swc_vmp_rtARID_DEF.TmpSignalConversionAtEVM_CIPVOutport1[8].accel_gnd.x@ */ /end MEASUREMENT
/begin MEASUREMENT autosar_swc_vmp_rtARID_DEF.TmpSignalConversionAtEVM_CIPVOutport1[8].accel_gnd.y "" FLOAT32_IEEE autosar_swc_vmp_CM_single 0 0 -3.4E+38 3.4E+38 ECU_ADDRESS 0xfe4ce090 /* @ECU_Address@autosar_swc_vmp_rtARID_DEF.TmpSignalConversionAtEVM_CIPVOutport1[8].accel_gnd.y@ */ /end MEASUREMENT
/begin MEASUREMENT autosar_swc_vmp_rtARID_DEF.TmpSignalConversionAtEVM_CIPVOutport1[8].accel_gnd_sl.mod "" FLOAT32_IEEE autosar_swc_vmp_CM_single 0 0 -3.4E+38 3.4E+38 ECU_ADDRESS 0xfe4ce0ac /* @ECU_Address@autosar_swc_vmp_rtARID_DEF.TmpSignalConversionAtEVM_CIPVOutport1[8].accel_gnd_sl.mod@ */ /end MEASUREMENT
/begin MEASUREMENT autosar_swc_vmp_rtARID_DEF.TmpSignalConversionAtEVM_CIPVOutport1[8].accel_gnd_sl.x "" FLOAT32_IEEE autosar_swc_vmp_CM_single 0 0 -3.4E+38 3.4E+38 ECU_ADDRESS 0xfe4ce0a4 /* @ECU_Address@autosar_swc_vmp_rtARID_DEF.TmpSignalConversionAtEVM_CIPVOutport1[8].accel_gnd_sl.x@ */ /end MEASUREMENT
/begin MEASUREMENT autosar_swc_vmp_rtARID_DEF.TmpSignalConversionAtEVM_CIPVOutport1[8].accel_gnd_sl.y "" FLOAT32_IEEE autosar_swc_vmp_CM_single 0 0 -3.4E+38 3.4E+38 ECU_ADDRESS 0xfe4ce0a8 /* @ECU_Address@autosar_swc_vmp_rtARID_DEF.TmpSignalConversionAtEVM_CIPVOutport1[8].accel_gnd_sl.y@ */ /end MEASUREMENT
/begin MEASUREMENT autosar_swc_vmp_rtARID_DEF.TmpSignalConversionAtEVM_CIPVOutport1[8].box.corner_x_vec "" FLOAT32_IEEE autosar_swc_vmp_CM_single 0 0 -3.4E+38 3.4E+38 LAYOUT COLUMN_DIR MATRIX_DIM 4 ECU_ADDRESS 0xfe4ce03c /* @ECU_Address@autosar_swc_vmp_rtARID_DEF.TmpSignalConversionAtEVM_CIPVOutport1[8].box.corner_x_vec@ */ /end MEASUREMENT
/begin MEASUREMENT autosar_swc_vmp_rtARID_DEF.TmpSignalConversionAtEVM_CIPVOutport1[8].box.corner_y_vec "" FLOAT32_IEEE autosar_swc_vmp_CM_single 0 0 -3.4E+38 3.4E+38 LAYOUT COLUMN_DIR MATRIX_DIM 4 ECU_ADDRESS 0xfe4ce04c /* @ECU_Address@autosar_swc_vmp_rtARID_DEF.TmpSignalConversionAtEVM_CIPVOutport1[8].box.corner_y_vec@ */ /end MEASUREMENT
/begin MEASUREMENT autosar_swc_vmp_rtARID_DEF.TmpSignalConversionAtEVM_CIPVOutport1[8].class_type "" UBYTE autosar_swc_vmp_CM_uint8 0 0 0 255 ECU_ADDRESS 0xfe4ce032 /* @ECU_Address@autosar_swc_vmp_rtARID_DEF.TmpSignalConversionAtEVM_CIPVOutport1[8].class_type@ */ /end MEASUREMENT
/begin MEASUREMENT autosar_swc_vmp_rtARID_DEF.TmpSignalConversionAtEVM_CIPVOutport1[8].cut_type "" UBYTE autosar_swc_vmp_CM_uint8 0 0 0 255 ECU_ADDRESS 0xfe4ce033 /* @ECU_Address@autosar_swc_vmp_rtARID_DEF.TmpSignalConversionAtEVM_CIPVOutport1[8].cut_type@ */ /end MEASUREMENT
/begin MEASUREMENT autosar_swc_vmp_rtARID_DEF.TmpSignalConversionAtEVM_CIPVOutport1[8].fus_type "" UBYTE autosar_swc_vmp_CM_uint8 0 0 0 255 ECU_ADDRESS 0xfe4ce031 /* @ECU_Address@autosar_swc_vmp_rtARID_DEF.TmpSignalConversionAtEVM_CIPVOutport1[8].fus_type@ */ /end MEASUREMENT
/begin MEASUREMENT autosar_swc_vmp_rtARID_DEF.TmpSignalConversionAtEVM_CIPVOutport1[8].id "" ULONG autosar_swc_vmp_CM_uint32 0 0 0 4294967295 ECU_ADDRESS 0xfe4ce038 /* @ECU_Address@autosar_swc_vmp_rtARID_DEF.TmpSignalConversionAtEVM_CIPVOutport1[8].id@ */ /end MEASUREMENT
/begin MEASUREMENT autosar_swc_vmp_rtARID_DEF.TmpSignalConversionAtEVM_CIPVOutport1[8].meas_state "" UBYTE autosar_swc_vmp_CM_uint8 0 0 0 255 ECU_ADDRESS 0xfe4ce030 /* @ECU_Address@autosar_swc_vmp_rtARID_DEF.TmpSignalConversionAtEVM_CIPVOutport1[8].meas_state@ */ /end MEASUREMENT
/begin MEASUREMENT autosar_swc_vmp_rtARID_DEF.TmpSignalConversionAtEVM_CIPVOutport1[8].position.heading_angle "" FLOAT32_IEEE autosar_swc_vmp_CM_single 0 0 -3.4E+38 3.4E+38 ECU_ADDRESS 0xfe4ce064 /* @ECU_Address@autosar_swc_vmp_rtARID_DEF.TmpSignalConversionAtEVM_CIPVOutport1[8].position.heading_angle@ */ /end MEASUREMENT
/begin MEASUREMENT autosar_swc_vmp_rtARID_DEF.TmpSignalConversionAtEVM_CIPVOutport1[8].position.x "" FLOAT32_IEEE autosar_swc_vmp_CM_single 0 0 -3.4E+38 3.4E+38 ECU_ADDRESS 0xfe4ce05c /* @ECU_Address@autosar_swc_vmp_rtARID_DEF.TmpSignalConversionAtEVM_CIPVOutport1[8].position.x@ */ /end MEASUREMENT
/begin MEASUREMENT autosar_swc_vmp_rtARID_DEF.TmpSignalConversionAtEVM_CIPVOutport1[8].position.y "" FLOAT32_IEEE autosar_swc_vmp_CM_single 0 0 -3.4E+38 3.4E+38 ECU_ADDRESS 0xfe4ce060 /* @ECU_Address@autosar_swc_vmp_rtARID_DEF.TmpSignalConversionAtEVM_CIPVOutport1[8].position.y@ */ /end MEASUREMENT
/begin MEASUREMENT autosar_swc_vmp_rtARID_DEF.TmpSignalConversionAtEVM_CIPVOutport1[8].position_sl.heading_angle "" FLOAT32_IEEE autosar_swc_vmp_CM_single 0 0 -3.4E+38 3.4E+38 ECU_ADDRESS 0xfe4ce070 /* @ECU_Address@autosar_swc_vmp_rtARID_DEF.TmpSignalConversionAtEVM_CIPVOutport1[8].position_sl.heading_angle@ */ /end MEASUREMENT
/begin MEASUREMENT autosar_swc_vmp_rtARID_DEF.TmpSignalConversionAtEVM_CIPVOutport1[8].position_sl.x "" FLOAT32_IEEE autosar_swc_vmp_CM_single 0 0 -3.4E+38 3.4E+38 ECU_ADDRESS 0xfe4ce068 /* @ECU_Address@autosar_swc_vmp_rtARID_DEF.TmpSignalConversionAtEVM_CIPVOutport1[8].position_sl.x@ */ /end MEASUREMENT
/begin MEASUREMENT autosar_swc_vmp_rtARID_DEF.TmpSignalConversionAtEVM_CIPVOutport1[8].position_sl.y "" FLOAT32_IEEE autosar_swc_vmp_CM_single 0 0 -3.4E+38 3.4E+38 ECU_ADDRESS 0xfe4ce06c /* @ECU_Address@autosar_swc_vmp_rtARID_DEF.TmpSignalConversionAtEVM_CIPVOutport1[8].position_sl.y@ */ /end MEASUREMENT
/begin MEASUREMENT autosar_swc_vmp_rtARID_DEF.TmpSignalConversionAtEVM_CIPVOutport1[8].ref_lane_id "" UBYTE autosar_swc_vmp_CM_uint8 0 0 0 255 ECU_ADDRESS 0xfe4ce034 /* @ECU_Address@autosar_swc_vmp_rtARID_DEF.TmpSignalConversionAtEVM_CIPVOutport1[8].ref_lane_id@ */ /end MEASUREMENT
/begin MEASUREMENT autosar_swc_vmp_rtARID_DEF.TmpSignalConversionAtEVM_CIPVOutport1[8].size.higth "" FLOAT32_IEEE autosar_swc_vmp_CM_single 0 0 -3.4E+38 3.4E+38 ECU_ADDRESS 0xfe4ce07c /* @ECU_Address@autosar_swc_vmp_rtARID_DEF.TmpSignalConversionAtEVM_CIPVOutport1[8].size.higth@ */ /end MEASUREMENT
/begin MEASUREMENT autosar_swc_vmp_rtARID_DEF.TmpSignalConversionAtEVM_CIPVOutport1[8].size.length "" FLOAT32_IEEE autosar_swc_vmp_CM_single 0 0 -3.4E+38 3.4E+38 ECU_ADDRESS 0xfe4ce074 /* @ECU_Address@autosar_swc_vmp_rtARID_DEF.TmpSignalConversionAtEVM_CIPVOutport1[8].size.length@ */ /end MEASUREMENT
/begin MEASUREMENT autosar_swc_vmp_rtARID_DEF.TmpSignalConversionAtEVM_CIPVOutport1[8].size.width "" FLOAT32_IEEE autosar_swc_vmp_CM_single 0 0 -3.4E+38 3.4E+38 ECU_ADDRESS 0xfe4ce078 /* @ECU_Address@autosar_swc_vmp_rtARID_DEF.TmpSignalConversionAtEVM_CIPVOutport1[8].size.width@ */ /end MEASUREMENT
/begin MEASUREMENT autosar_swc_vmp_rtARID_DEF.TmpSignalConversionAtEVM_CIPVOutport1[8].velocity_gnd.mod "" FLOAT32_IEEE autosar_swc_vmp_CM_single 0 0 -3.4E+38 3.4E+38 ECU_ADDRESS 0xfe4ce088 /* @ECU_Address@autosar_swc_vmp_rtARID_DEF.TmpSignalConversionAtEVM_CIPVOutport1[8].velocity_gnd.mod@ */ /end MEASUREMENT
/begin MEASUREMENT autosar_swc_vmp_rtARID_DEF.TmpSignalConversionAtEVM_CIPVOutport1[8].velocity_gnd.x "" FLOAT32_IEEE autosar_swc_vmp_CM_single 0 0 -3.4E+38 3.4E+38 ECU_ADDRESS 0xfe4ce080 /* @ECU_Address@autosar_swc_vmp_rtARID_DEF.TmpSignalConversionAtEVM_CIPVOutport1[8].velocity_gnd.x@ */ /end MEASUREMENT
/begin MEASUREMENT autosar_swc_vmp_rtARID_DEF.TmpSignalConversionAtEVM_CIPVOutport1[8].velocity_gnd.y "" FLOAT32_IEEE autosar_swc_vmp_CM_single 0 0 -3.4E+38 3.4E+38 ECU_ADDRESS 0xfe4ce084 /* @ECU_Address@autosar_swc_vmp_rtARID_DEF.TmpSignalConversionAtEVM_CIPVOutport1[8].velocity_gnd.y@ */ /end MEASUREMENT
/begin MEASUREMENT autosar_swc_vmp_rtARID_DEF.TmpSignalConversionAtEVM_CIPVOutport1[8].velocity_gnd_sl.mod "" FLOAT32_IEEE autosar_swc_vmp_CM_single 0 0 -3.4E+38 3.4E+38 ECU_ADDRESS 0xfe4ce0a0 /* @ECU_Address@autosar_swc_vmp_rtARID_DEF.TmpSignalConversionAtEVM_CIPVOutport1[8].velocity_gnd_sl.mod@ */ /end MEASUREMENT
/begin MEASUREMENT autosar_swc_vmp_rtARID_DEF.TmpSignalConversionAtEVM_CIPVOutport1[8].velocity_gnd_sl.x "" FLOAT32_IEEE autosar_swc_vmp_CM_single 0 0 -3.4E+38 3.4E+38 ECU_ADDRESS 0xfe4ce098 /* @ECU_Address@autosar_swc_vmp_rtARID_DEF.TmpSignalConversionAtEVM_CIPVOutport1[8].velocity_gnd_sl.x@ */ /end MEASUREMENT
/begin MEASUREMENT autosar_swc_vmp_rtARID_DEF.TmpSignalConversionAtEVM_CIPVOutport1[8].velocity_gnd_sl.y "" FLOAT32_IEEE autosar_swc_vmp_CM_single 0 0 -3.4E+38 3.4E+38 ECU_ADDRESS 0xfe4ce09c /* @ECU_Address@autosar_swc_vmp_rtARID_DEF.TmpSignalConversionAtEVM_CIPVOutport1[8].velocity_gnd_sl.y@ */ /end MEASUREMENT
/begin MEASUREMENT autosar_swc_vmp_rtARID_DEF.TmpSignalConversionAtEVM_CIPVOutport1[9].accel_gnd.mod "" FLOAT32_IEEE autosar_swc_vmp_CM_single 0 0 -3.4E+38 3.4E+38 ECU_ADDRESS 0xfe4ce114 /* @ECU_Address@autosar_swc_vmp_rtARID_DEF.TmpSignalConversionAtEVM_CIPVOutport1[9].accel_gnd.mod@ */ /end MEASUREMENT
/begin MEASUREMENT autosar_swc_vmp_rtARID_DEF.TmpSignalConversionAtEVM_CIPVOutport1[9].accel_gnd.x "" FLOAT32_IEEE autosar_swc_vmp_CM_single 0 0 -3.4E+38 3.4E+38 ECU_ADDRESS 0xfe4ce10c /* @ECU_Address@autosar_swc_vmp_rtARID_DEF.TmpSignalConversionAtEVM_CIPVOutport1[9].accel_gnd.x@ */ /end MEASUREMENT
/begin MEASUREMENT autosar_swc_vmp_rtARID_DEF.TmpSignalConversionAtEVM_CIPVOutport1[9].accel_gnd.y "" FLOAT32_IEEE autosar_swc_vmp_CM_single 0 0 -3.4E+38 3.4E+38 ECU_ADDRESS 0xfe4ce110 /* @ECU_Address@autosar_swc_vmp_rtARID_DEF.TmpSignalConversionAtEVM_CIPVOutport1[9].accel_gnd.y@ */ /end MEASUREMENT
/begin MEASUREMENT autosar_swc_vmp_rtARID_DEF.TmpSignalConversionAtEVM_CIPVOutport1[9].accel_gnd_sl.mod "" FLOAT32_IEEE autosar_swc_vmp_CM_single 0 0 -3.4E+38 3.4E+38 ECU_ADDRESS 0xfe4ce12c /* @ECU_Address@autosar_swc_vmp_rtARID_DEF.TmpSignalConversionAtEVM_CIPVOutport1[9].accel_gnd_sl.mod@ */ /end MEASUREMENT
/begin MEASUREMENT autosar_swc_vmp_rtARID_DEF.TmpSignalConversionAtEVM_CIPVOutport1[9].accel_gnd_sl.x "" FLOAT32_IEEE autosar_swc_vmp_CM_single 0 0 -3.4E+38 3.4E+38 ECU_ADDRESS 0xfe4ce124 /* @ECU_Address@autosar_swc_vmp_rtARID_DEF.TmpSignalConversionAtEVM_CIPVOutport1[9].accel_gnd_sl.x@ */ /end MEASUREMENT
/begin MEASUREMENT autosar_swc_vmp_rtARID_DEF.TmpSignalConversionAtEVM_CIPVOutport1[9].accel_gnd_sl.y "" FLOAT32_IEEE autosar_swc_vmp_CM_single 0 0 -3.4E+38 3.4E+38 ECU_ADDRESS 0xfe4ce128 /* @ECU_Address@autosar_swc_vmp_rtARID_DEF.TmpSignalConversionAtEVM_CIPVOutport1[9].accel_gnd_sl.y@ */ /end MEASUREMENT
/begin MEASUREMENT autosar_swc_vmp_rtARID_DEF.TmpSignalConversionAtEVM_CIPVOutport1[9].box.corner_x_vec "" FLOAT32_IEEE autosar_swc_vmp_CM_single 0 0 -3.4E+38 3.4E+38 LAYOUT COLUMN_DIR MATRIX_DIM 4 ECU_ADDRESS 0xfe4ce0bc /* @ECU_Address@autosar_swc_vmp_rtARID_DEF.TmpSignalConversionAtEVM_CIPVOutport1[9].box.corner_x_vec@ */ /end MEASUREMENT
/begin MEASUREMENT autosar_swc_vmp_rtARID_DEF.TmpSignalConversionAtEVM_CIPVOutport1[9].box.corner_y_vec "" FLOAT32_IEEE autosar_swc_vmp_CM_single 0 0 -3.4E+38 3.4E+38 LAYOUT COLUMN_DIR MATRIX_DIM 4 ECU_ADDRESS 0xfe4ce0cc /* @ECU_Address@autosar_swc_vmp_rtARID_DEF.TmpSignalConversionAtEVM_CIPVOutport1[9].box.corner_y_vec@ */ /end MEASUREMENT
/begin MEASUREMENT autosar_swc_vmp_rtARID_DEF.TmpSignalConversionAtEVM_CIPVOutport1[9].class_type "" UBYTE autosar_swc_vmp_CM_uint8 0 0 0 255 ECU_ADDRESS 0xfe4ce0b2 /* @ECU_Address@autosar_swc_vmp_rtARID_DEF.TmpSignalConversionAtEVM_CIPVOutport1[9].class_type@ */ /end MEASUREMENT
/begin MEASUREMENT autosar_swc_vmp_rtARID_DEF.TmpSignalConversionAtEVM_CIPVOutport1[9].cut_type "" UBYTE autosar_swc_vmp_CM_uint8 0 0 0 255 ECU_ADDRESS 0xfe4ce0b3 /* @ECU_Address@autosar_swc_vmp_rtARID_DEF.TmpSignalConversionAtEVM_CIPVOutport1[9].cut_type@ */ /end MEASUREMENT
/begin MEASUREMENT autosar_swc_vmp_rtARID_DEF.TmpSignalConversionAtEVM_CIPVOutport1[9].fus_type "" UBYTE autosar_swc_vmp_CM_uint8 0 0 0 255 ECU_ADDRESS 0xfe4ce0b1 /* @ECU_Address@autosar_swc_vmp_rtARID_DEF.TmpSignalConversionAtEVM_CIPVOutport1[9].fus_type@ */ /end MEASUREMENT
/begin MEASUREMENT autosar_swc_vmp_rtARID_DEF.TmpSignalConversionAtEVM_CIPVOutport1[9].id "" ULONG autosar_swc_vmp_CM_uint32 0 0 0 4294967295 ECU_ADDRESS 0xfe4ce0b8 /* @ECU_Address@autosar_swc_vmp_rtARID_DEF.TmpSignalConversionAtEVM_CIPVOutport1[9].id@ */ /end MEASUREMENT
/begin MEASUREMENT autosar_swc_vmp_rtARID_DEF.TmpSignalConversionAtEVM_CIPVOutport1[9].meas_state "" UBYTE autosar_swc_vmp_CM_uint8 0 0 0 255 ECU_ADDRESS 0xfe4ce0b0 /* @ECU_Address@autosar_swc_vmp_rtARID_DEF.TmpSignalConversionAtEVM_CIPVOutport1[9].meas_state@ */ /end MEASUREMENT
/begin MEASUREMENT autosar_swc_vmp_rtARID_DEF.TmpSignalConversionAtEVM_CIPVOutport1[9].position.heading_angle "" FLOAT32_IEEE autosar_swc_vmp_CM_single 0 0 -3.4E+38 3.4E+38 ECU_ADDRESS 0xfe4ce0e4 /* @ECU_Address@autosar_swc_vmp_rtARID_DEF.TmpSignalConversionAtEVM_CIPVOutport1[9].position.heading_angle@ */ /end MEASUREMENT
/begin MEASUREMENT autosar_swc_vmp_rtARID_DEF.TmpSignalConversionAtEVM_CIPVOutport1[9].position.x "" FLOAT32_IEEE autosar_swc_vmp_CM_single 0 0 -3.4E+38 3.4E+38 ECU_ADDRESS 0xfe4ce0dc /* @ECU_Address@autosar_swc_vmp_rtARID_DEF.TmpSignalConversionAtEVM_CIPVOutport1[9].position.x@ */ /end MEASUREMENT
/begin MEASUREMENT autosar_swc_vmp_rtARID_DEF.TmpSignalConversionAtEVM_CIPVOutport1[9].position.y "" FLOAT32_IEEE autosar_swc_vmp_CM_single 0 0 -3.4E+38 3.4E+38 ECU_ADDRESS 0xfe4ce0e0 /* @ECU_Address@autosar_swc_vmp_rtARID_DEF.TmpSignalConversionAtEVM_CIPVOutport1[9].position.y@ */ /end MEASUREMENT
/begin MEASUREMENT autosar_swc_vmp_rtARID_DEF.TmpSignalConversionAtEVM_CIPVOutport1[9].position_sl.heading_angle "" FLOAT32_IEEE autosar_swc_vmp_CM_single 0 0 -3.4E+38 3.4E+38 ECU_ADDRESS 0xfe4ce0f0 /* @ECU_Address@autosar_swc_vmp_rtARID_DEF.TmpSignalConversionAtEVM_CIPVOutport1[9].position_sl.heading_angle@ */ /end MEASUREMENT
/begin MEASUREMENT autosar_swc_vmp_rtARID_DEF.TmpSignalConversionAtEVM_CIPVOutport1[9].position_sl.x "" FLOAT32_IEEE autosar_swc_vmp_CM_single 0 0 -3.4E+38 3.4E+38 ECU_ADDRESS 0xfe4ce0e8 /* @ECU_Address@autosar_swc_vmp_rtARID_DEF.TmpSignalConversionAtEVM_CIPVOutport1[9].position_sl.x@ */ /end MEASUREMENT
/begin MEASUREMENT autosar_swc_vmp_rtARID_DEF.TmpSignalConversionAtEVM_CIPVOutport1[9].position_sl.y "" FLOAT32_IEEE autosar_swc_vmp_CM_single 0 0 -3.4E+38 3.4E+38 ECU_ADDRESS 0xfe4ce0ec /* @ECU_Address@autosar_swc_vmp_rtARID_DEF.TmpSignalConversionAtEVM_CIPVOutport1[9].position_sl.y@ */ /end MEASUREMENT
/begin MEASUREMENT autosar_swc_vmp_rtARID_DEF.TmpSignalConversionAtEVM_CIPVOutport1[9].ref_lane_id "" UBYTE autosar_swc_vmp_CM_uint8 0 0 0 255 ECU_ADDRESS 0xfe4ce0b4 /* @ECU_Address@autosar_swc_vmp_rtARID_DEF.TmpSignalConversionAtEVM_CIPVOutport1[9].ref_lane_id@ */ /end MEASUREMENT
/begin MEASUREMENT autosar_swc_vmp_rtARID_DEF.TmpSignalConversionAtEVM_CIPVOutport1[9].size.higth "" FLOAT32_IEEE autosar_swc_vmp_CM_single 0 0 -3.4E+38 3.4E+38 ECU_ADDRESS 0xfe4ce0fc /* @ECU_Address@autosar_swc_vmp_rtARID_DEF.TmpSignalConversionAtEVM_CIPVOutport1[9].size.higth@ */ /end MEASUREMENT
/begin MEASUREMENT autosar_swc_vmp_rtARID_DEF.TmpSignalConversionAtEVM_CIPVOutport1[9].size.length "" FLOAT32_IEEE autosar_swc_vmp_CM_single 0 0 -3.4E+38 3.4E+38 ECU_ADDRESS 0xfe4ce0f4 /* @ECU_Address@autosar_swc_vmp_rtARID_DEF.TmpSignalConversionAtEVM_CIPVOutport1[9].size.length@ */ /end MEASUREMENT
/begin MEASUREMENT autosar_swc_vmp_rtARID_DEF.TmpSignalConversionAtEVM_CIPVOutport1[9].size.width "" FLOAT32_IEEE autosar_swc_vmp_CM_single 0 0 -3.4E+38 3.4E+38 ECU_ADDRESS 0xfe4ce0f8 /* @ECU_Address@autosar_swc_vmp_rtARID_DEF.TmpSignalConversionAtEVM_CIPVOutport1[9].size.width@ */ /end MEASUREMENT
/begin MEASUREMENT autosar_swc_vmp_rtARID_DEF.TmpSignalConversionAtEVM_CIPVOutport1[9].velocity_gnd.mod "" FLOAT32_IEEE autosar_swc_vmp_CM_single 0 0 -3.4E+38 3.4E+38 ECU_ADDRESS 0xfe4ce108 /* @ECU_Address@autosar_swc_vmp_rtARID_DEF.TmpSignalConversionAtEVM_CIPVOutport1[9].velocity_gnd.mod@ */ /end MEASUREMENT
/begin MEASUREMENT autosar_swc_vmp_rtARID_DEF.TmpSignalConversionAtEVM_CIPVOutport1[9].velocity_gnd.x "" FLOAT32_IEEE autosar_swc_vmp_CM_single 0 0 -3.4E+38 3.4E+38 ECU_ADDRESS 0xfe4ce100 /* @ECU_Address@autosar_swc_vmp_rtARID_DEF.TmpSignalConversionAtEVM_CIPVOutport1[9].velocity_gnd.x@ */ /end MEASUREMENT
/begin MEASUREMENT autosar_swc_vmp_rtARID_DEF.TmpSignalConversionAtEVM_CIPVOutport1[9].velocity_gnd.y "" FLOAT32_IEEE autosar_swc_vmp_CM_single 0 0 -3.4E+38 3.4E+38 ECU_ADDRESS 0xfe4ce104 /* @ECU_Address@autosar_swc_vmp_rtARID_DEF.TmpSignalConversionAtEVM_CIPVOutport1[9].velocity_gnd.y@ */ /end MEASUREMENT
/begin MEASUREMENT autosar_swc_vmp_rtARID_DEF.TmpSignalConversionAtEVM_CIPVOutport1[9].velocity_gnd_sl.mod "" FLOAT32_IEEE autosar_swc_vmp_CM_single 0 0 -3.4E+38 3.4E+38 ECU_ADDRESS 0xfe4ce120 /* @ECU_Address@autosar_swc_vmp_rtARID_DEF.TmpSignalConversionAtEVM_CIPVOutport1[9].velocity_gnd_sl.mod@ */ /end MEASUREMENT
/begin MEASUREMENT autosar_swc_vmp_rtARID_DEF.TmpSignalConversionAtEVM_CIPVOutport1[9].velocity_gnd_sl.x "" FLOAT32_IEEE autosar_swc_vmp_CM_single 0 0 -3.4E+38 3.4E+38 ECU_ADDRESS 0xfe4ce118 /* @ECU_Address@autosar_swc_vmp_rtARID_DEF.TmpSignalConversionAtEVM_CIPVOutport1[9].velocity_gnd_sl.x@ */ /end MEASUREMENT
/begin MEASUREMENT autosar_swc_vmp_rtARID_DEF.TmpSignalConversionAtEVM_CIPVOutport1[9].velocity_gnd_sl.y "" FLOAT32_IEEE autosar_swc_vmp_CM_single 0 0 -3.4E+38 3.4E+38 ECU_ADDRESS 0xfe4ce11c /* @ECU_Address@autosar_swc_vmp_rtARID_DEF.TmpSignalConversionAtEVM_CIPVOutport1[9].velocity_gnd_sl.y@ */ /end MEASUREMENT
/begin MEASUREMENT autosar_swc_vmp_rtARID_DEF.TmpSignalConversionAtEVM_DECSOutport1.host_lane_idx "" UBYTE autosar_swc_vmp_CM_uint8 0 0 0 255 ECU_ADDRESS 0xfe4ce50c /* @ECU_Address@autosar_swc_vmp_rtARID_DEF.TmpSignalConversionAtEVM_DECSOutport1.host_lane_idx@ */ /end MEASUREMENT
/begin MEASUREMENT autosar_swc_vmp_rtARID_DEF.TmpSignalConversionAtEVM_DECSOutport1.lc_level "" UBYTE autosar_swc_vmp_CM_uint8 0 0 0 255 ECU_ADDRESS 0xfe4ce510 /* @ECU_Address@autosar_swc_vmp_rtARID_DEF.TmpSignalConversionAtEVM_DECSOutport1.lc_level@ */ /end MEASUREMENT
/begin MEASUREMENT autosar_swc_vmp_rtARID_DEF.TmpSignalConversionAtEVM_DECSOutport1.lc_lntention_conds "" ULONG autosar_swc_vmp_CM_uint32 0 0 0 4294967295 LAYOUT COLUMN_DIR MATRIX_DIM 10 ECU_ADDRESS 0xfe4ce514 /* @ECU_Address@autosar_swc_vmp_rtARID_DEF.TmpSignalConversionAtEVM_DECSOutport1.lc_lntention_conds@ */ /end MEASUREMENT
/begin MEASUREMENT autosar_swc_vmp_rtARID_DEF.TmpSignalConversionAtEVM_DECSOutport1.lc_req "" UBYTE autosar_swc_vmp_CM_uint8 0 0 0 255 ECU_ADDRESS 0xfe4ce50e /* @ECU_Address@autosar_swc_vmp_rtARID_DEF.TmpSignalConversionAtEVM_DECSOutport1.lc_req@ */ /end MEASUREMENT
/begin MEASUREMENT autosar_swc_vmp_rtARID_DEF.TmpSignalConversionAtEVM_DECSOutport1.lc_req_reason "" UBYTE autosar_swc_vmp_CM_uint8 0 0 0 255 ECU_ADDRESS 0xfe4ce511 /* @ECU_Address@autosar_swc_vmp_rtARID_DEF.TmpSignalConversionAtEVM_DECSOutport1.lc_req_reason@ */ /end MEASUREMENT
/begin MEASUREMENT autosar_swc_vmp_rtARID_DEF.TmpSignalConversionAtEVM_DECSOutport1.lc_req_sync_id "" UBYTE autosar_swc_vmp_CM_uint8 0 0 0 255 ECU_ADDRESS 0xfe4ce50f /* @ECU_Address@autosar_swc_vmp_rtARID_DEF.TmpSignalConversionAtEVM_DECSOutport1.lc_req_sync_id@ */ /end MEASUREMENT
/begin MEASUREMENT autosar_swc_vmp_rtARID_DEF.TmpSignalConversionAtEVM_DECSOutport1.target_lane_idx "" UBYTE autosar_swc_vmp_CM_uint8 0 0 0 255 ECU_ADDRESS 0xfe4ce50d /* @ECU_Address@autosar_swc_vmp_rtARID_DEF.TmpSignalConversionAtEVM_DECSOutport1.target_lane_idx@ */ /end MEASUREMENT
/begin MEASUREMENT autosar_swc_vmp_rtARID_DEF.UnitDelay1_DSTATE.ACC_AccelerateJerk "" FLOAT32_IEEE autosar_swc_vmp_CM_single 0 0 -3.4E+38 3.4E+38 ECU_ADDRESS 0xfe4ce5b8 /* @ECU_Address@autosar_swc_vmp_rtARID_DEF.UnitDelay1_DSTATE.ACC_AccelerateJerk@ */ /end MEASUREMENT
/begin MEASUREMENT autosar_swc_vmp_rtARID_DEF.UnitDelay1_DSTATE.ACC_BrakePrefer "" UBYTE autosar_swc_vmp_CM_logical 0 0 0 1 ECU_ADDRESS 0xfe4ce5a4 /* @ECU_Address@autosar_swc_vmp_rtARID_DEF.UnitDelay1_DSTATE.ACC_BrakePrefer@ */ /end MEASUREMENT
/begin MEASUREMENT autosar_swc_vmp_rtARID_DEF.UnitDelay1_DSTATE.ACC_DecelerateJerk "" FLOAT32_IEEE autosar_swc_vmp_CM_single 0 0 -3.4E+38 3.4E+38 ECU_ADDRESS 0xfe4ce5b4 /* @ECU_Address@autosar_swc_vmp_rtARID_DEF.UnitDelay1_DSTATE.ACC_DecelerateJerk@ */ /end MEASUREMENT
/begin MEASUREMENT autosar_swc_vmp_rtARID_DEF.UnitDelay1_DSTATE.ACC_axvCvAim "" FLOAT32_IEEE autosar_swc_vmp_CM_single 0 0 -3.4E+38 3.4E+38 ECU_ADDRESS 0xfe4ce5a8 /* @ECU_Address@autosar_swc_vmp_rtARID_DEF.UnitDelay1_DSTATE.ACC_axvCvAim@ */ /end MEASUREMENT
/begin MEASUREMENT autosar_swc_vmp_rtARID_DEF.UnitDelay1_DSTATE.ACC_axv_ComfortBandLowerValue "" FLOAT32_IEEE autosar_swc_vmp_CM_single 0 0 -3.4E+38 3.4E+38 ECU_ADDRESS 0xfe4ce5ac /* @ECU_Address@autosar_swc_vmp_rtARID_DEF.UnitDelay1_DSTATE.ACC_axv_ComfortBandLowerValue@ */ /end MEASUREMENT
/begin MEASUREMENT autosar_swc_vmp_rtARID_DEF.UnitDelay1_DSTATE.ACC_axv_ComfortBandUpperValue "" FLOAT32_IEEE autosar_swc_vmp_CM_single 0 0 -3.4E+38 3.4E+38 ECU_ADDRESS 0xfe4ce5b0 /* @ECU_Address@autosar_swc_vmp_rtARID_DEF.UnitDelay1_DSTATE.ACC_axv_ComfortBandUpperValue@ */ /end MEASUREMENT
/begin MEASUREMENT autosar_swc_vmp_rtARID_DEF.UnitDelay1_DSTATE.CurvSpdLim "" FLOAT32_IEEE autosar_swc_vmp_CM_single 0 0 -3.4E+38 3.4E+38 ECU_ADDRESS 0xfe4ce5bc /* @ECU_Address@autosar_swc_vmp_rtARID_DEF.UnitDelay1_DSTATE.CurvSpdLim@ */ /end MEASUREMENT
/begin MEASUREMENT autosar_swc_vmp_rtARID_DEF.UnitDelay_DSTATE_fp "" ULONG autosar_swc_vmp_CM_uint32 0 0 0 4294967295 ECU_ADDRESS 0xfe4d41cc /* @ECU_Address@autosar_swc_vmp_rtARID_DEF.UnitDelay_DSTATE_fp@ */ /end MEASUREMENT
/begin MEASUREMENT autosar_swc_vmp_rtARID_DEF.is_active_c18_autosar_swc_vmp "" UBYTE autosar_swc_vmp_CM_uint8 0 0 0 255 ECU_ADDRESS 0xfe4d4244 /* @ECU_Address@autosar_swc_vmp_rtARID_DEF.is_active_c18_autosar_swc_vmp@ */ /end MEASUREMENT
/begin MEASUREMENT autosar_swc_vmp_rtARID_DEF.is_active_c41_autosar_swc_vmp "" UBYTE autosar_swc_vmp_CM_uint8 0 0 0 255 ECU_ADDRESS 0xfe4d4249 /* @ECU_Address@autosar_swc_vmp_rtARID_DEF.is_active_c41_autosar_swc_vmp@ */ /end MEASUREMENT
/begin MEASUREMENT autosar_swc_vmp_rtARID_DEF.is_active_c42_autosar_swc_vmp "" UBYTE autosar_swc_vmp_CM_uint8 0 0 0 255 ECU_ADDRESS 0xfe4d4247 /* @ECU_Address@autosar_swc_vmp_rtARID_DEF.is_active_c42_autosar_swc_vmp@ */ /end MEASUREMENT
/begin MEASUREMENT autosar_swc_vmp_rtARID_DEF.is_c18_autosar_swc_vmp "" UBYTE autosar_swc_vmp_CM_uint8 0 0 0 255 ECU_ADDRESS 0xfe4d4245 /* @ECU_Address@autosar_swc_vmp_rtARID_DEF.is_c18_autosar_swc_vmp@ */ /end MEASUREMENT
/begin MEASUREMENT autosar_swc_vmp_rtARID_DEF.is_c41_autosar_swc_vmp "" UBYTE autosar_swc_vmp_CM_uint8 0 0 0 255 ECU_ADDRESS 0xfe4d424a /* @ECU_Address@autosar_swc_vmp_rtARID_DEF.is_c41_autosar_swc_vmp@ */ /end MEASUREMENT
/begin MEASUREMENT autosar_swc_vmp_rtARID_DEF.is_c42_autosar_swc_vmp "" UBYTE autosar_swc_vmp_CM_uint8 0 0 0 255 ECU_ADDRESS 0xfe4d4248 /* @ECU_Address@autosar_swc_vmp_rtARID_DEF.is_c42_autosar_swc_vmp@ */ /end MEASUREMENT
/begin MEASUREMENT autosar_swc_vmp_rtARID_DEF.tNoneActive2Active "" FLOAT32_IEEE autosar_swc_vmp_CM_single 0 0 -3.4E+38 3.4E+38 ECU_ADDRESS 0xfe4d4124 /* @ECU_Address@autosar_swc_vmp_rtARID_DEF.tNoneActive2Active@ */ /end MEASUREMENT
/begin COMPU_METHOD autosar_swc_vmp_CM_double "Q = V" IDENTICAL "%15.10" "" /end COMPU_METHOD
/begin COMPU_METHOD autosar_swc_vmp_CM_logical "Q = V" IDENTICAL "%1.0" "" /end COMPU_METHOD
/begin COMPU_METHOD autosar_swc_vmp_CM_single "Q = V" IDENTICAL "%8.6" "" /end COMPU_METHOD
/begin COMPU_METHOD autosar_swc_vmp_CM_single_m "Q = V" IDENTICAL "%8.6" "m" /end COMPU_METHOD
/begin COMPU_METHOD autosar_swc_vmp_CM_single_s "Q = V" IDENTICAL "%8.6" "s" /end COMPU_METHOD
/begin COMPU_METHOD autosar_swc_vmp_CM_uint16 "Q = V" IDENTICAL "%5.0" "" /end COMPU_METHOD
/begin COMPU_METHOD autosar_swc_vmp_CM_uint32 "Q = V" IDENTICAL "%10.0" "" /end COMPU_METHOD
/begin COMPU_METHOD autosar_swc_vmp_CM_uint64 "Q = V" IDENTICAL "%20.0" "" /end COMPU_METHOD
/begin COMPU_METHOD autosar_swc_vmp_CM_uint8 "Q = V" IDENTICAL "%3.0" "" /end COMPU_METHOD
/begin RECORD_LAYOUT Record_FLOAT32_IEEE FNC_VALUES 1 FLOAT32_IEEE COLUMN_DIR DIRECT /end RECORD_LAYOUT
/begin GROUP autosar_swc_vmp_autosar_swc_vmp_Step_sys_lgt_pln_lonap_grp_stateJudge_lonap_takeOver_ttc_2_5_If_Action_Subsystem_Subsystem1 "autosar_swc_vmp/autosar_swc_vmp_Step_sys/lgt_pln/lonap_grp_stateJudge/lonap_takeOver ttc<2.5/If Action\nSubsystem/Subsystem1" /begin REF_CHARACTERISTIC P_LONP_WaitTime /end REF_CHARACTERISTIC
 /begin REF_MEASUREMENT autosar_swc_vmp_rtARID_DEF.Cnt_g autosar_swc_vmp_rtARID_DEF.Cnt_h autosar_swc_vmp_rtARID_DEF.UnitDelay_DSTATE_fp autosar_swc_vmp_rtARID_DEF.is_active_c41_autosar_swc_vmp autosar_swc_vmp_rtARID_DEF.is_active_c42_autosar_swc_vmp autosar_swc_vmp_rtARID_DEF.is_c41_autosar_swc_vmp autosar_swc_vmp_rtARID_DEF.is_c42_autosar_swc_vmp /end REF_MEASUREMENT
/end GROUP
/begin GROUP autosar_swc_vmp_autosar_swc_vmp_Step_sys_lgt_pln_lonap_grp_stateJudge_lonap_takeOver_ttc_2_5_Subsystem "autosar_swc_vmp/autosar_swc_vmp_Step_sys/lgt_pln/lonap_grp_stateJudge/lonap_takeOver ttc<2.5/Subsystem"
 /begin SUB_GROUP autosar_swc_vmp_autosar_swc_vmp_Step_sys_lgt_pln_lonap_grp_stateJudge_lonap_takeOver_ttc_2_5_Subsystem_Subsystem /end SUB_GROUP
/end GROUP
/begin GROUP autosar_swc_vmp_autosar_swc_vmp_Step_sys_lgt_pln_lonap_grp_stateJudge_lonap_takeOver_ttc_2_5_Subsystem_Subsystem "autosar_swc_vmp/autosar_swc_vmp_Step_sys/lgt_pln/lonap_grp_stateJudge/lonap_takeOver ttc<2.5/Subsystem/Subsystem"
 /begin SUB_GROUP autosar_swc_vmp_autosar_swc_vmp_Step_sys_lgt_pln_lonap_grp_stateJudge_lonap_takeOver_ttc_2_5_Subsystem_Subsystem_Compare_To_Constant /end SUB_GROUP
/end GROUP
/begin GROUP autosar_swc_vmp_autosar_swc_vmp_Step_sys_lgt_pln_lonap_grp_stateJudge_lonap_takeOver_ttc_2_5_Subsystem_Subsystem_Compare_To_Constant "autosar_swc_vmp/autosar_swc_vmp_Step_sys/lgt_pln/lonap_grp_stateJudge/lonap_takeOver ttc<2.5/Subsystem/Subsystem/Compare\nTo Constant" /begin REF_CHARACTERISTIC P_LONP_hightHazardMinTor /end REF_CHARACTERISTIC /end GROUP
/begin GROUP autosar_swc_vmp_autosar_swc_vmp_Step_sys_lgt_pln_lonap_grp_stateJudge_ttc_3 "autosar_swc_vmp/autosar_swc_vmp_Step_sys/lgt_pln/lonap_grp_stateJudge/ttc<3"
 /begin SUB_GROUP autosar_swc_vmp_autosar_swc_vmp_Step_sys_lgt_pln_lonap_grp_stateJudge_ttc_3_If_Action_Subsystem autosar_swc_vmp_autosar_swc_vmp_Step_sys_lgt_pln_lonap_grp_stateJudge_ttc_3_Subsystem /end SUB_GROUP
/end GROUP
/begin GROUP autosar_swc_vmp_autosar_swc_vmp_Step_sys_lgt_pln_lonap_grp_stateJudge_ttc_3_If_Action_Subsystem "autosar_swc_vmp/autosar_swc_vmp_Step_sys/lgt_pln/lonap_grp_stateJudge/ttc<3/If Action\nSubsystem"
 /begin SUB_GROUP autosar_swc_vmp_autosar_swc_vmp_Step_sys_lgt_pln_lonap_grp_stateJudge_ttc_3_If_Action_Subsystem_ActiveTORThrd autosar_swc_vmp_autosar_swc_vmp_Step_sys_lgt_pln_lonap_grp_stateJudge_ttc_3_If_Action_Subsystem_Gap autosar_swc_vmp_autosar_swc_vmp_Step_sys_lgt_pln_lonap_grp_stateJudge_ttc_3_If_Action_Subsystem_Subsystem /end SUB_GROUP
/end GROUP
/begin GROUP autosar_swc_vmp_autosar_swc_vmp_Step_sys_lgt_pln_lonap_grp_stateJudge_ttc_3_If_Action_Subsystem_Subsystem "autosar_swc_vmp/autosar_swc_vmp_Step_sys/lgt_pln/lonap_grp_stateJudge/ttc<3/If Action\nSubsystem/Subsystem" /begin REF_CHARACTERISTIC P_LONP_WaitTime /end REF_CHARACTERISTIC
 /begin REF_MEASUREMENT autosar_swc_vmp_rtARID_DEF.Cnt autosar_swc_vmp_rtARID_DEF.is_active_c18_autosar_swc_vmp autosar_swc_vmp_rtARID_DEF.is_c18_autosar_swc_vmp /end REF_MEASUREMENT
/end GROUP
/begin GROUP autosar_swc_vmp_autosar_swc_vmp_Step_sys_lgt_pln_lonap_grp_stateJudge_ttc_3_Subsystem "autosar_swc_vmp/autosar_swc_vmp_Step_sys/lgt_pln/lonap_grp_stateJudge/ttc<3/Subsystem"
 /begin SUB_GROUP autosar_swc_vmp_autosar_swc_vmp_Step_sys_lgt_pln_lonap_grp_stateJudge_ttc_3_Subsystem_Subsystem /end SUB_GROUP
/end GROUP
/begin GROUP autosar_swc_vmp_autosar_swc_vmp_Step_sys_lgt_pln_lonap_grp_stateJudge_ttc_3_Subsystem_Subsystem "autosar_swc_vmp/autosar_swc_vmp_Step_sys/lgt_pln/lonap_grp_stateJudge/ttc<3/Subsystem/Subsystem"
 /begin SUB_GROUP autosar_swc_vmp_autosar_swc_vmp_Step_sys_lgt_pln_lonap_grp_stateJudge_ttc_3_Subsystem_Subsystem_Compare_To_Constant /end SUB_GROUP
/end GROUP
/begin GROUP autosar_swc_vmp_autosar_swc_vmp_Step_sys_lgt_pln_lonap_grp_stateJudge_ttc_3_Subsystem_Subsystem_Compare_To_Constant "autosar_swc_vmp/autosar_swc_vmp_Step_sys/lgt_pln/lonap_grp_stateJudge/ttc<3/Subsystem/Subsystem/Compare\nTo Constant" /begin REF_CHARACTERISTIC P_LONP_hightHazardMinTor /end REF_CHARACTERISTIC /end GROUP
/begin GROUP autosar_swc_vmp_autosar_swc_vmp_Step_sys_lgt_pln_lonap_vlcInternalAccCalc "autosar_swc_vmp/autosar_swc_vmp_Step_sys/lgt_pln/lonap_vlcInternalAccCalc"
 /begin REF_MEASUREMENT autosar_swc_vmp_rtARID_DEF.TappedDelay1_X autosar_swc_vmp_rtARID_DEF.TappedDelay_X_n autosar_swc_vmp_rtARID_DEF.tNoneActive2Active /end REF_MEASUREMENT
/end GROUP
/begin GROUP autosar_swc_vmp_rtARID_DEF.BusAssignment ""
 /begin REF_MEASUREMENT autosar_swc_vmp_rtARID_DEF.BusAssignment.targetExist autosar_swc_vmp_rtARID_DEF.BusAssignment.cutInflg autosar_swc_vmp_rtARID_DEF.BusAssignment.brakeIntention autosar_swc_vmp_rtARID_DEF.BusAssignment.movingState autosar_swc_vmp_rtARID_DEF.BusAssignment.orientation autosar_swc_vmp_rtARID_DEF.BusAssignment.type autosar_swc_vmp_rtARID_DEF.BusAssignment.fu_type autosar_swc_vmp_rtARID_DEF.BusAssignment.dx autosar_swc_vmp_rtARID_DEF.BusAssignment.dy autosar_swc_vmp_rtARID_DEF.BusAssignment.vxRel autosar_swc_vmp_rtARID_DEF.BusAssignment.vyRel autosar_swc_vmp_rtARID_DEF.BusAssignment.vxAbs autosar_swc_vmp_rtARID_DEF.BusAssignment.vyAbs autosar_swc_vmp_rtARID_DEF.BusAssignment.axAbs autosar_swc_vmp_rtARID_DEF.BusAssignment.ayAbs autosar_swc_vmp_rtARID_DEF.BusAssignment.range autosar_swc_vmp_rtARID_DEF.BusAssignment.objExist autosar_swc_vmp_rtARID_DEF.BusAssignment.headingAngle autosar_swc_vmp_rtARID_DEF.BusAssignment.Object_Length autosar_swc_vmp_rtARID_DEF.BusAssignment.Object_Width autosar_swc_vmp_rtARID_DEF.BusAssignment.Object_Hight autosar_swc_vmp_rtARID_DEF.BusAssignment.id autosar_swc_vmp_rtARID_DEF.BusAssignment.age /end REF_MEASUREMENT
/end GROUP
/begin GROUP autosar_swc_vmp_rtARID_DEF.BusAssignment_f ""
 /begin REF_MEASUREMENT autosar_swc_vmp_rtARID_DEF.BusAssignment_f.targetExist autosar_swc_vmp_rtARID_DEF.BusAssignment_f.cutInflg autosar_swc_vmp_rtARID_DEF.BusAssignment_f.brakeIntention autosar_swc_vmp_rtARID_DEF.BusAssignment_f.movingState autosar_swc_vmp_rtARID_DEF.BusAssignment_f.orientation autosar_swc_vmp_rtARID_DEF.BusAssignment_f.type autosar_swc_vmp_rtARID_DEF.BusAssignment_f.fu_type autosar_swc_vmp_rtARID_DEF.BusAssignment_f.dx autosar_swc_vmp_rtARID_DEF.BusAssignment_f.dy autosar_swc_vmp_rtARID_DEF.BusAssignment_f.vxRel autosar_swc_vmp_rtARID_DEF.BusAssignment_f.vyRel autosar_swc_vmp_rtARID_DEF.BusAssignment_f.vxAbs autosar_swc_vmp_rtARID_DEF.BusAssignment_f.vyAbs autosar_swc_vmp_rtARID_DEF.BusAssignment_f.axAbs autosar_swc_vmp_rtARID_DEF.BusAssignment_f.ayAbs autosar_swc_vmp_rtARID_DEF.BusAssignment_f.range autosar_swc_vmp_rtARID_DEF.BusAssignment_f.objExist autosar_swc_vmp_rtARID_DEF.BusAssignment_f.headingAngle autosar_swc_vmp_rtARID_DEF.BusAssignment_f.Object_Length autosar_swc_vmp_rtARID_DEF.BusAssignment_f.Object_Width autosar_swc_vmp_rtARID_DEF.BusAssignment_f.Object_Hight autosar_swc_vmp_rtARID_DEF.BusAssignment_f.id autosar_swc_vmp_rtARID_DEF.BusAssignment_f.age /end REF_MEASUREMENT
/end GROUP
/begin GROUP autosar_swc_vmp_rtARID_DEF.BusAssignment_f5 ""
 /begin REF_MEASUREMENT autosar_swc_vmp_rtARID_DEF.BusAssignment_f5.targetExist autosar_swc_vmp_rtARID_DEF.BusAssignment_f5.cutInflg autosar_swc_vmp_rtARID_DEF.BusAssignment_f5.brakeIntention autosar_swc_vmp_rtARID_DEF.BusAssignment_f5.movingState autosar_swc_vmp_rtARID_DEF.BusAssignment_f5.orientation autosar_swc_vmp_rtARID_DEF.BusAssignment_f5.type autosar_swc_vmp_rtARID_DEF.BusAssignment_f5.fu_type autosar_swc_vmp_rtARID_DEF.BusAssignment_f5.dx autosar_swc_vmp_rtARID_DEF.BusAssignment_f5.dy autosar_swc_vmp_rtARID_DEF.BusAssignment_f5.vxRel autosar_swc_vmp_rtARID_DEF.BusAssignment_f5.vyRel autosar_swc_vmp_rtARID_DEF.BusAssignment_f5.vxAbs autosar_swc_vmp_rtARID_DEF.BusAssignment_f5.vyAbs autosar_swc_vmp_rtARID_DEF.BusAssignment_f5.axAbs autosar_swc_vmp_rtARID_DEF.BusAssignment_f5.ayAbs autosar_swc_vmp_rtARID_DEF.BusAssignment_f5.range autosar_swc_vmp_rtARID_DEF.BusAssignment_f5.objExist autosar_swc_vmp_rtARID_DEF.BusAssignment_f5.headingAngle autosar_swc_vmp_rtARID_DEF.BusAssignment_f5.Object_Length autosar_swc_vmp_rtARID_DEF.BusAssignment_f5.Object_Width autosar_swc_vmp_rtARID_DEF.BusAssignment_f5.Object_Hight autosar_swc_vmp_rtARID_DEF.BusAssignment_f5.id autosar_swc_vmp_rtARID_DEF.BusAssignment_f5.age /end REF_MEASUREMENT
/end GROUP
/begin GROUP autosar_swc_vmp_rtARID_DEF.ICAS_STATEOut ""
 /begin REF_MEASUREMENT autosar_swc_vmp_rtARID_DEF.ICAS_STATEOut.acc_sts autosar_swc_vmp_rtARID_DEF.ICAS_STATEOut.lcc_sts autosar_swc_vmp_rtARID_DEF.ICAS_STATEOut.nudge_sts autosar_swc_vmp_rtARID_DEF.ICAS_STATEOut.alc_sts autosar_swc_vmp_rtARID_DEF.ICAS_STATEOut.noa_sts autosar_swc_vmp_rtARID_DEF.ICAS_STATEOut.lc_req_sync_id autosar_swc_vmp_rtARID_DEF.ICAS_STATEOut.acc_manual_act_faile_reason autosar_swc_vmp_rtARID_DEF.ICAS_STATEOut.acc_exit_reason autosar_swc_vmp_rtARID_DEF.ICAS_STATEOut.lcc_manual_act_faile_reason autosar_swc_vmp_rtARID_DEF.ICAS_STATEOut.lcc_auto_act_faile_reason autosar_swc_vmp_rtARID_DEF.ICAS_STATEOut.lcc_exit_to_idle_reason autosar_swc_vmp_rtARID_DEF.ICAS_STATEOut.lcc_exit_to_wait_reason autosar_swc_vmp_rtARID_DEF.ICAS_STATEOut.lcc_exit_to_mrc_reason autosar_swc_vmp_rtARID_DEF.ICAS_STATEOut.lcc_mrc_exit_reason autosar_swc_vmp_rtARID_DEF.ICAS_STATEOut.noa_auto_act_faile_reason autosar_swc_vmp_rtARID_DEF.ICAS_STATEOut.noa_exit_reason /end REF_MEASUREMENT
/end GROUP
/begin GROUP autosar_swc_vmp_rtARID_DEF.Switch ""
 /begin REF_MEASUREMENT autosar_swc_vmp_rtARID_DEF.Switch.targetExist autosar_swc_vmp_rtARID_DEF.Switch.cutInflg autosar_swc_vmp_rtARID_DEF.Switch.brakeIntention autosar_swc_vmp_rtARID_DEF.Switch.movingState autosar_swc_vmp_rtARID_DEF.Switch.orientation autosar_swc_vmp_rtARID_DEF.Switch.type autosar_swc_vmp_rtARID_DEF.Switch.fu_type autosar_swc_vmp_rtARID_DEF.Switch.dx autosar_swc_vmp_rtARID_DEF.Switch.dy autosar_swc_vmp_rtARID_DEF.Switch.vxRel autosar_swc_vmp_rtARID_DEF.Switch.vyRel autosar_swc_vmp_rtARID_DEF.Switch.vxAbs autosar_swc_vmp_rtARID_DEF.Switch.vyAbs autosar_swc_vmp_rtARID_DEF.Switch.axAbs autosar_swc_vmp_rtARID_DEF.Switch.ayAbs autosar_swc_vmp_rtARID_DEF.Switch.range autosar_swc_vmp_rtARID_DEF.Switch.objExist autosar_swc_vmp_rtARID_DEF.Switch.headingAngle autosar_swc_vmp_rtARID_DEF.Switch.Object_Length autosar_swc_vmp_rtARID_DEF.Switch.Object_Width autosar_swc_vmp_rtARID_DEF.Switch.Object_Hight autosar_swc_vmp_rtARID_DEF.Switch.id autosar_swc_vmp_rtARID_DEF.Switch.age /end REF_MEASUREMENT
/end GROUP
/begin GROUP autosar_swc_vmp_rtARID_DEF.TmpSignalConversionAtCSM_CTRLOutport1 ""
 /begin REF_MEASUREMENT autosar_swc_vmp_rtARID_DEF.TmpSignalConversionAtCSM_CTRLOutport1.VsetBelowMin autosar_swc_vmp_rtARID_DEF.TmpSignalConversionAtCSM_CTRLOutport1.CruiseSpdCtrlLevel autosar_swc_vmp_rtARID_DEF.TmpSignalConversionAtCSM_CTRLOutport1.TimeGapLevel autosar_swc_vmp_rtARID_DEF.TmpSignalConversionAtCSM_CTRLOutport1.CruiseSpdKmh autosar_swc_vmp_rtARID_DEF.TmpSignalConversionAtCSM_CTRLOutport1.ISL_APSpdLimSPL autosar_swc_vmp_rtARID_DEF.TmpSignalConversionAtCSM_CTRLOutport1.ISL_APSpdLimDist /end REF_MEASUREMENT
/end GROUP
/begin GROUP autosar_swc_vmp_rtARID_DEF.TmpSignalConversionAtEVM_CIPVOutport1[0] ""
 /begin SUB_GROUP autosar_swc_vmp_rtARID_DEF.TmpSignalConversionAtEVM_CIPVOutport1[0].box autosar_swc_vmp_rtARID_DEF.TmpSignalConversionAtEVM_CIPVOutport1[0].position autosar_swc_vmp_rtARID_DEF.TmpSignalConversionAtEVM_CIPVOutport1[0].position_sl autosar_swc_vmp_rtARID_DEF.TmpSignalConversionAtEVM_CIPVOutport1[0].size autosar_swc_vmp_rtARID_DEF.TmpSignalConversionAtEVM_CIPVOutport1[0].velocity_gnd autosar_swc_vmp_rtARID_DEF.TmpSignalConversionAtEVM_CIPVOutport1[0].accel_gnd autosar_swc_vmp_rtARID_DEF.TmpSignalConversionAtEVM_CIPVOutport1[0].velocity_gnd_sl autosar_swc_vmp_rtARID_DEF.TmpSignalConversionAtEVM_CIPVOutport1[0].accel_gnd_sl /end SUB_GROUP
 /begin REF_MEASUREMENT autosar_swc_vmp_rtARID_DEF.TmpSignalConversionAtEVM_CIPVOutport1[0].meas_state autosar_swc_vmp_rtARID_DEF.TmpSignalConversionAtEVM_CIPVOutport1[0].fus_type autosar_swc_vmp_rtARID_DEF.TmpSignalConversionAtEVM_CIPVOutport1[0].class_type autosar_swc_vmp_rtARID_DEF.TmpSignalConversionAtEVM_CIPVOutport1[0].cut_type autosar_swc_vmp_rtARID_DEF.TmpSignalConversionAtEVM_CIPVOutport1[0].ref_lane_id autosar_swc_vmp_rtARID_DEF.TmpSignalConversionAtEVM_CIPVOutport1[0].id /end REF_MEASUREMENT
/end GROUP
/begin GROUP autosar_swc_vmp_rtARID_DEF.TmpSignalConversionAtEVM_CIPVOutport1[0].accel_gnd ""
 /begin REF_MEASUREMENT autosar_swc_vmp_rtARID_DEF.TmpSignalConversionAtEVM_CIPVOutport1[0].accel_gnd.x autosar_swc_vmp_rtARID_DEF.TmpSignalConversionAtEVM_CIPVOutport1[0].accel_gnd.y autosar_swc_vmp_rtARID_DEF.TmpSignalConversionAtEVM_CIPVOutport1[0].accel_gnd.mod /end REF_MEASUREMENT
/end GROUP
/begin GROUP autosar_swc_vmp_rtARID_DEF.TmpSignalConversionAtEVM_CIPVOutport1[0].accel_gnd_sl ""
 /begin REF_MEASUREMENT autosar_swc_vmp_rtARID_DEF.TmpSignalConversionAtEVM_CIPVOutport1[0].accel_gnd_sl.x autosar_swc_vmp_rtARID_DEF.TmpSignalConversionAtEVM_CIPVOutport1[0].accel_gnd_sl.y autosar_swc_vmp_rtARID_DEF.TmpSignalConversionAtEVM_CIPVOutport1[0].accel_gnd_sl.mod /end REF_MEASUREMENT
/end GROUP
/begin GROUP autosar_swc_vmp_rtARID_DEF.TmpSignalConversionAtEVM_CIPVOutport1[0].box ""
 /begin REF_MEASUREMENT autosar_swc_vmp_rtARID_DEF.TmpSignalConversionAtEVM_CIPVOutport1[0].box.corner_x_vec autosar_swc_vmp_rtARID_DEF.TmpSignalConversionAtEVM_CIPVOutport1[0].box.corner_y_vec /end REF_MEASUREMENT
/end GROUP
/begin GROUP autosar_swc_vmp_rtARID_DEF.TmpSignalConversionAtEVM_CIPVOutport1[0].position ""
 /begin REF_MEASUREMENT autosar_swc_vmp_rtARID_DEF.TmpSignalConversionAtEVM_CIPVOutport1[0].position.x autosar_swc_vmp_rtARID_DEF.TmpSignalConversionAtEVM_CIPVOutport1[0].position.y autosar_swc_vmp_rtARID_DEF.TmpSignalConversionAtEVM_CIPVOutport1[0].position.heading_angle /end REF_MEASUREMENT
/end GROUP
/begin GROUP autosar_swc_vmp_rtARID_DEF.TmpSignalConversionAtEVM_CIPVOutport1[0].position_sl ""
 /begin REF_MEASUREMENT autosar_swc_vmp_rtARID_DEF.TmpSignalConversionAtEVM_CIPVOutport1[0].position_sl.x autosar_swc_vmp_rtARID_DEF.TmpSignalConversionAtEVM_CIPVOutport1[0].position_sl.y autosar_swc_vmp_rtARID_DEF.TmpSignalConversionAtEVM_CIPVOutport1[0].position_sl.heading_angle /end REF_MEASUREMENT
/end GROUP
/begin GROUP autosar_swc_vmp_rtARID_DEF.TmpSignalConversionAtEVM_CIPVOutport1[0].size ""
 /begin REF_MEASUREMENT autosar_swc_vmp_rtARID_DEF.TmpSignalConversionAtEVM_CIPVOutport1[0].size.length autosar_swc_vmp_rtARID_DEF.TmpSignalConversionAtEVM_CIPVOutport1[0].size.width autosar_swc_vmp_rtARID_DEF.TmpSignalConversionAtEVM_CIPVOutport1[0].size.higth /end REF_MEASUREMENT
/end GROUP
/begin GROUP autosar_swc_vmp_rtARID_DEF.TmpSignalConversionAtEVM_CIPVOutport1[0].velocity_gnd ""
 /begin REF_MEASUREMENT autosar_swc_vmp_rtARID_DEF.TmpSignalConversionAtEVM_CIPVOutport1[0].velocity_gnd.x autosar_swc_vmp_rtARID_DEF.TmpSignalConversionAtEVM_CIPVOutport1[0].velocity_gnd.y autosar_swc_vmp_rtARID_DEF.TmpSignalConversionAtEVM_CIPVOutport1[0].velocity_gnd.mod /end REF_MEASUREMENT
/end GROUP
/begin GROUP autosar_swc_vmp_rtARID_DEF.TmpSignalConversionAtEVM_CIPVOutport1[0].velocity_gnd_sl ""
 /begin REF_MEASUREMENT autosar_swc_vmp_rtARID_DEF.TmpSignalConversionAtEVM_CIPVOutport1[0].velocity_gnd_sl.x autosar_swc_vmp_rtARID_DEF.TmpSignalConversionAtEVM_CIPVOutport1[0].velocity_gnd_sl.y autosar_swc_vmp_rtARID_DEF.TmpSignalConversionAtEVM_CIPVOutport1[0].velocity_gnd_sl.mod /end REF_MEASUREMENT
/end GROUP
/begin GROUP autosar_swc_vmp_rtARID_DEF.TmpSignalConversionAtEVM_CIPVOutport1[1] ""
 /begin SUB_GROUP autosar_swc_vmp_rtARID_DEF.TmpSignalConversionAtEVM_CIPVOutport1[1].box autosar_swc_vmp_rtARID_DEF.TmpSignalConversionAtEVM_CIPVOutport1[1].position autosar_swc_vmp_rtARID_DEF.TmpSignalConversionAtEVM_CIPVOutport1[1].position_sl autosar_swc_vmp_rtARID_DEF.TmpSignalConversionAtEVM_CIPVOutport1[1].size autosar_swc_vmp_rtARID_DEF.TmpSignalConversionAtEVM_CIPVOutport1[1].velocity_gnd autosar_swc_vmp_rtARID_DEF.TmpSignalConversionAtEVM_CIPVOutport1[1].accel_gnd autosar_swc_vmp_rtARID_DEF.TmpSignalConversionAtEVM_CIPVOutport1[1].velocity_gnd_sl autosar_swc_vmp_rtARID_DEF.TmpSignalConversionAtEVM_CIPVOutport1[1].accel_gnd_sl /end SUB_GROUP
 /begin REF_MEASUREMENT autosar_swc_vmp_rtARID_DEF.TmpSignalConversionAtEVM_CIPVOutport1[1].meas_state autosar_swc_vmp_rtARID_DEF.TmpSignalConversionAtEVM_CIPVOutport1[1].fus_type autosar_swc_vmp_rtARID_DEF.TmpSignalConversionAtEVM_CIPVOutport1[1].class_type autosar_swc_vmp_rtARID_DEF.TmpSignalConversionAtEVM_CIPVOutport1[1].cut_type autosar_swc_vmp_rtARID_DEF.TmpSignalConversionAtEVM_CIPVOutport1[1].ref_lane_id autosar_swc_vmp_rtARID_DEF.TmpSignalConversionAtEVM_CIPVOutport1[1].id /end REF_MEASUREMENT
/end GROUP
/begin GROUP autosar_swc_vmp_rtARID_DEF.TmpSignalConversionAtEVM_CIPVOutport1[1].accel_gnd ""
 /begin REF_MEASUREMENT autosar_swc_vmp_rtARID_DEF.TmpSignalConversionAtEVM_CIPVOutport1[1].accel_gnd.x autosar_swc_vmp_rtARID_DEF.TmpSignalConversionAtEVM_CIPVOutport1[1].accel_gnd.y autosar_swc_vmp_rtARID_DEF.TmpSignalConversionAtEVM_CIPVOutport1[1].accel_gnd.mod /end REF_MEASUREMENT
/end GROUP
/begin GROUP autosar_swc_vmp_rtARID_DEF.TmpSignalConversionAtEVM_CIPVOutport1[1].accel_gnd_sl ""
 /begin REF_MEASUREMENT autosar_swc_vmp_rtARID_DEF.TmpSignalConversionAtEVM_CIPVOutport1[1].accel_gnd_sl.x autosar_swc_vmp_rtARID_DEF.TmpSignalConversionAtEVM_CIPVOutport1[1].accel_gnd_sl.y autosar_swc_vmp_rtARID_DEF.TmpSignalConversionAtEVM_CIPVOutport1[1].accel_gnd_sl.mod /end REF_MEASUREMENT
/end GROUP
/begin GROUP autosar_swc_vmp_rtARID_DEF.TmpSignalConversionAtEVM_CIPVOutport1[1].box ""
 /begin REF_MEASUREMENT autosar_swc_vmp_rtARID_DEF.TmpSignalConversionAtEVM_CIPVOutport1[1].box.corner_x_vec autosar_swc_vmp_rtARID_DEF.TmpSignalConversionAtEVM_CIPVOutport1[1].box.corner_y_vec /end REF_MEASUREMENT
/end GROUP
/begin GROUP autosar_swc_vmp_rtARID_DEF.TmpSignalConversionAtEVM_CIPVOutport1[1].position ""
 /begin REF_MEASUREMENT autosar_swc_vmp_rtARID_DEF.TmpSignalConversionAtEVM_CIPVOutport1[1].position.x autosar_swc_vmp_rtARID_DEF.TmpSignalConversionAtEVM_CIPVOutport1[1].position.y autosar_swc_vmp_rtARID_DEF.TmpSignalConversionAtEVM_CIPVOutport1[1].position.heading_angle /end REF_MEASUREMENT
/end GROUP
/begin GROUP autosar_swc_vmp_rtARID_DEF.TmpSignalConversionAtEVM_CIPVOutport1[1].position_sl ""
 /begin REF_MEASUREMENT autosar_swc_vmp_rtARID_DEF.TmpSignalConversionAtEVM_CIPVOutport1[1].position_sl.x autosar_swc_vmp_rtARID_DEF.TmpSignalConversionAtEVM_CIPVOutport1[1].position_sl.y autosar_swc_vmp_rtARID_DEF.TmpSignalConversionAtEVM_CIPVOutport1[1].position_sl.heading_angle /end REF_MEASUREMENT
/end GROUP
/begin GROUP autosar_swc_vmp_rtARID_DEF.TmpSignalConversionAtEVM_CIPVOutport1[1].size ""
 /begin REF_MEASUREMENT autosar_swc_vmp_rtARID_DEF.TmpSignalConversionAtEVM_CIPVOutport1[1].size.length autosar_swc_vmp_rtARID_DEF.TmpSignalConversionAtEVM_CIPVOutport1[1].size.width autosar_swc_vmp_rtARID_DEF.TmpSignalConversionAtEVM_CIPVOutport1[1].size.higth /end REF_MEASUREMENT
/end GROUP
/begin GROUP autosar_swc_vmp_rtARID_DEF.TmpSignalConversionAtEVM_CIPVOutport1[1].velocity_gnd ""
 /begin REF_MEASUREMENT autosar_swc_vmp_rtARID_DEF.TmpSignalConversionAtEVM_CIPVOutport1[1].velocity_gnd.x autosar_swc_vmp_rtARID_DEF.TmpSignalConversionAtEVM_CIPVOutport1[1].velocity_gnd.y autosar_swc_vmp_rtARID_DEF.TmpSignalConversionAtEVM_CIPVOutport1[1].velocity_gnd.mod /end REF_MEASUREMENT
/end GROUP
/begin GROUP autosar_swc_vmp_rtARID_DEF.TmpSignalConversionAtEVM_CIPVOutport1[1].velocity_gnd_sl ""
 /begin REF_MEASUREMENT autosar_swc_vmp_rtARID_DEF.TmpSignalConversionAtEVM_CIPVOutport1[1].velocity_gnd_sl.x autosar_swc_vmp_rtARID_DEF.TmpSignalConversionAtEVM_CIPVOutport1[1].velocity_gnd_sl.y autosar_swc_vmp_rtARID_DEF.TmpSignalConversionAtEVM_CIPVOutport1[1].velocity_gnd_sl.mod /end REF_MEASUREMENT
/end GROUP
/begin GROUP autosar_swc_vmp_rtARID_DEF.TmpSignalConversionAtEVM_CIPVOutport1[2] ""
 /begin SUB_GROUP autosar_swc_vmp_rtARID_DEF.TmpSignalConversionAtEVM_CIPVOutport1[2].box autosar_swc_vmp_rtARID_DEF.TmpSignalConversionAtEVM_CIPVOutport1[2].position autosar_swc_vmp_rtARID_DEF.TmpSignalConversionAtEVM_CIPVOutport1[2].position_sl autosar_swc_vmp_rtARID_DEF.TmpSignalConversionAtEVM_CIPVOutport1[2].size autosar_swc_vmp_rtARID_DEF.TmpSignalConversionAtEVM_CIPVOutport1[2].velocity_gnd autosar_swc_vmp_rtARID_DEF.TmpSignalConversionAtEVM_CIPVOutport1[2].accel_gnd autosar_swc_vmp_rtARID_DEF.TmpSignalConversionAtEVM_CIPVOutport1[2].velocity_gnd_sl autosar_swc_vmp_rtARID_DEF.TmpSignalConversionAtEVM_CIPVOutport1[2].accel_gnd_sl /end SUB_GROUP
 /begin REF_MEASUREMENT autosar_swc_vmp_rtARID_DEF.TmpSignalConversionAtEVM_CIPVOutport1[2].meas_state autosar_swc_vmp_rtARID_DEF.TmpSignalConversionAtEVM_CIPVOutport1[2].fus_type autosar_swc_vmp_rtARID_DEF.TmpSignalConversionAtEVM_CIPVOutport1[2].class_type autosar_swc_vmp_rtARID_DEF.TmpSignalConversionAtEVM_CIPVOutport1[2].cut_type autosar_swc_vmp_rtARID_DEF.TmpSignalConversionAtEVM_CIPVOutport1[2].ref_lane_id autosar_swc_vmp_rtARID_DEF.TmpSignalConversionAtEVM_CIPVOutport1[2].id /end REF_MEASUREMENT
/end GROUP
/begin GROUP autosar_swc_vmp_rtARID_DEF.TmpSignalConversionAtEVM_CIPVOutport1[2].accel_gnd ""
 /begin REF_MEASUREMENT autosar_swc_vmp_rtARID_DEF.TmpSignalConversionAtEVM_CIPVOutport1[2].accel_gnd.x autosar_swc_vmp_rtARID_DEF.TmpSignalConversionAtEVM_CIPVOutport1[2].accel_gnd.y autosar_swc_vmp_rtARID_DEF.TmpSignalConversionAtEVM_CIPVOutport1[2].accel_gnd.mod /end REF_MEASUREMENT
/end GROUP
/begin GROUP autosar_swc_vmp_rtARID_DEF.TmpSignalConversionAtEVM_CIPVOutport1[2].accel_gnd_sl ""
 /begin REF_MEASUREMENT autosar_swc_vmp_rtARID_DEF.TmpSignalConversionAtEVM_CIPVOutport1[2].accel_gnd_sl.x autosar_swc_vmp_rtARID_DEF.TmpSignalConversionAtEVM_CIPVOutport1[2].accel_gnd_sl.y autosar_swc_vmp_rtARID_DEF.TmpSignalConversionAtEVM_CIPVOutport1[2].accel_gnd_sl.mod /end REF_MEASUREMENT
/end GROUP
/begin GROUP autosar_swc_vmp_rtARID_DEF.TmpSignalConversionAtEVM_CIPVOutport1[2].box ""
 /begin REF_MEASUREMENT autosar_swc_vmp_rtARID_DEF.TmpSignalConversionAtEVM_CIPVOutport1[2].box.corner_x_vec autosar_swc_vmp_rtARID_DEF.TmpSignalConversionAtEVM_CIPVOutport1[2].box.corner_y_vec /end REF_MEASUREMENT
/end GROUP
/begin GROUP autosar_swc_vmp_rtARID_DEF.TmpSignalConversionAtEVM_CIPVOutport1[2].position ""
 /begin REF_MEASUREMENT autosar_swc_vmp_rtARID_DEF.TmpSignalConversionAtEVM_CIPVOutport1[2].position.x autosar_swc_vmp_rtARID_DEF.TmpSignalConversionAtEVM_CIPVOutport1[2].position.y autosar_swc_vmp_rtARID_DEF.TmpSignalConversionAtEVM_CIPVOutport1[2].position.heading_angle /end REF_MEASUREMENT
/end GROUP
/begin GROUP autosar_swc_vmp_rtARID_DEF.TmpSignalConversionAtEVM_CIPVOutport1[2].position_sl ""
 /begin REF_MEASUREMENT autosar_swc_vmp_rtARID_DEF.TmpSignalConversionAtEVM_CIPVOutport1[2].position_sl.x autosar_swc_vmp_rtARID_DEF.TmpSignalConversionAtEVM_CIPVOutport1[2].position_sl.y autosar_swc_vmp_rtARID_DEF.TmpSignalConversionAtEVM_CIPVOutport1[2].position_sl.heading_angle /end REF_MEASUREMENT
/end GROUP
/begin GROUP autosar_swc_vmp_rtARID_DEF.TmpSignalConversionAtEVM_CIPVOutport1[2].size ""
 /begin REF_MEASUREMENT autosar_swc_vmp_rtARID_DEF.TmpSignalConversionAtEVM_CIPVOutport1[2].size.length autosar_swc_vmp_rtARID_DEF.TmpSignalConversionAtEVM_CIPVOutport1[2].size.width autosar_swc_vmp_rtARID_DEF.TmpSignalConversionAtEVM_CIPVOutport1[2].size.higth /end REF_MEASUREMENT
/end GROUP
/begin GROUP autosar_swc_vmp_rtARID_DEF.TmpSignalConversionAtEVM_CIPVOutport1[2].velocity_gnd ""
 /begin REF_MEASUREMENT autosar_swc_vmp_rtARID_DEF.TmpSignalConversionAtEVM_CIPVOutport1[2].velocity_gnd.x autosar_swc_vmp_rtARID_DEF.TmpSignalConversionAtEVM_CIPVOutport1[2].velocity_gnd.y autosar_swc_vmp_rtARID_DEF.TmpSignalConversionAtEVM_CIPVOutport1[2].velocity_gnd.mod /end REF_MEASUREMENT
/end GROUP
/begin GROUP autosar_swc_vmp_rtARID_DEF.TmpSignalConversionAtEVM_CIPVOutport1[2].velocity_gnd_sl ""
 /begin REF_MEASUREMENT autosar_swc_vmp_rtARID_DEF.TmpSignalConversionAtEVM_CIPVOutport1[2].velocity_gnd_sl.x autosar_swc_vmp_rtARID_DEF.TmpSignalConversionAtEVM_CIPVOutport1[2].velocity_gnd_sl.y autosar_swc_vmp_rtARID_DEF.TmpSignalConversionAtEVM_CIPVOutport1[2].velocity_gnd_sl.mod /end REF_MEASUREMENT
/end GROUP
/begin GROUP autosar_swc_vmp_rtARID_DEF.TmpSignalConversionAtEVM_CIPVOutport1[3] ""
 /begin SUB_GROUP autosar_swc_vmp_rtARID_DEF.TmpSignalConversionAtEVM_CIPVOutport1[3].box autosar_swc_vmp_rtARID_DEF.TmpSignalConversionAtEVM_CIPVOutport1[3].position autosar_swc_vmp_rtARID_DEF.TmpSignalConversionAtEVM_CIPVOutport1[3].position_sl autosar_swc_vmp_rtARID_DEF.TmpSignalConversionAtEVM_CIPVOutport1[3].size autosar_swc_vmp_rtARID_DEF.TmpSignalConversionAtEVM_CIPVOutport1[3].velocity_gnd autosar_swc_vmp_rtARID_DEF.TmpSignalConversionAtEVM_CIPVOutport1[3].accel_gnd autosar_swc_vmp_rtARID_DEF.TmpSignalConversionAtEVM_CIPVOutport1[3].velocity_gnd_sl autosar_swc_vmp_rtARID_DEF.TmpSignalConversionAtEVM_CIPVOutport1[3].accel_gnd_sl /end SUB_GROUP
 /begin REF_MEASUREMENT autosar_swc_vmp_rtARID_DEF.TmpSignalConversionAtEVM_CIPVOutport1[3].meas_state autosar_swc_vmp_rtARID_DEF.TmpSignalConversionAtEVM_CIPVOutport1[3].fus_type autosar_swc_vmp_rtARID_DEF.TmpSignalConversionAtEVM_CIPVOutport1[3].class_type autosar_swc_vmp_rtARID_DEF.TmpSignalConversionAtEVM_CIPVOutport1[3].cut_type autosar_swc_vmp_rtARID_DEF.TmpSignalConversionAtEVM_CIPVOutport1[3].ref_lane_id autosar_swc_vmp_rtARID_DEF.TmpSignalConversionAtEVM_CIPVOutport1[3].id /end REF_MEASUREMENT
/end GROUP
/begin GROUP autosar_swc_vmp_rtARID_DEF.TmpSignalConversionAtEVM_CIPVOutport1[3].accel_gnd ""
 /begin REF_MEASUREMENT autosar_swc_vmp_rtARID_DEF.TmpSignalConversionAtEVM_CIPVOutport1[3].accel_gnd.x autosar_swc_vmp_rtARID_DEF.TmpSignalConversionAtEVM_CIPVOutport1[3].accel_gnd.y autosar_swc_vmp_rtARID_DEF.TmpSignalConversionAtEVM_CIPVOutport1[3].accel_gnd.mod /end REF_MEASUREMENT
/end GROUP
/begin GROUP autosar_swc_vmp_rtARID_DEF.TmpSignalConversionAtEVM_CIPVOutport1[3].accel_gnd_sl ""
 /begin REF_MEASUREMENT autosar_swc_vmp_rtARID_DEF.TmpSignalConversionAtEVM_CIPVOutport1[3].accel_gnd_sl.x autosar_swc_vmp_rtARID_DEF.TmpSignalConversionAtEVM_CIPVOutport1[3].accel_gnd_sl.y autosar_swc_vmp_rtARID_DEF.TmpSignalConversionAtEVM_CIPVOutport1[3].accel_gnd_sl.mod /end REF_MEASUREMENT
/end GROUP
/begin GROUP autosar_swc_vmp_rtARID_DEF.TmpSignalConversionAtEVM_CIPVOutport1[3].box ""
 /begin REF_MEASUREMENT autosar_swc_vmp_rtARID_DEF.TmpSignalConversionAtEVM_CIPVOutport1[3].box.corner_x_vec autosar_swc_vmp_rtARID_DEF.TmpSignalConversionAtEVM_CIPVOutport1[3].box.corner_y_vec /end REF_MEASUREMENT
/end GROUP
/begin GROUP autosar_swc_vmp_rtARID_DEF.TmpSignalConversionAtEVM_CIPVOutport1[3].position ""
 /begin REF_MEASUREMENT autosar_swc_vmp_rtARID_DEF.TmpSignalConversionAtEVM_CIPVOutport1[3].position.x autosar_swc_vmp_rtARID_DEF.TmpSignalConversionAtEVM_CIPVOutport1[3].position.y autosar_swc_vmp_rtARID_DEF.TmpSignalConversionAtEVM_CIPVOutport1[3].position.heading_angle /end REF_MEASUREMENT
/end GROUP
/begin GROUP autosar_swc_vmp_rtARID_DEF.TmpSignalConversionAtEVM_CIPVOutport1[3].position_sl ""
 /begin REF_MEASUREMENT autosar_swc_vmp_rtARID_DEF.TmpSignalConversionAtEVM_CIPVOutport1[3].position_sl.x autosar_swc_vmp_rtARID_DEF.TmpSignalConversionAtEVM_CIPVOutport1[3].position_sl.y autosar_swc_vmp_rtARID_DEF.TmpSignalConversionAtEVM_CIPVOutport1[3].position_sl.heading_angle /end REF_MEASUREMENT
/end GROUP
/begin GROUP autosar_swc_vmp_rtARID_DEF.TmpSignalConversionAtEVM_CIPVOutport1[3].size ""
 /begin REF_MEASUREMENT autosar_swc_vmp_rtARID_DEF.TmpSignalConversionAtEVM_CIPVOutport1[3].size.length autosar_swc_vmp_rtARID_DEF.TmpSignalConversionAtEVM_CIPVOutport1[3].size.width autosar_swc_vmp_rtARID_DEF.TmpSignalConversionAtEVM_CIPVOutport1[3].size.higth /end REF_MEASUREMENT
/end GROUP
/begin GROUP autosar_swc_vmp_rtARID_DEF.TmpSignalConversionAtEVM_CIPVOutport1[3].velocity_gnd ""
 /begin REF_MEASUREMENT autosar_swc_vmp_rtARID_DEF.TmpSignalConversionAtEVM_CIPVOutport1[3].velocity_gnd.x autosar_swc_vmp_rtARID_DEF.TmpSignalConversionAtEVM_CIPVOutport1[3].velocity_gnd.y autosar_swc_vmp_rtARID_DEF.TmpSignalConversionAtEVM_CIPVOutport1[3].velocity_gnd.mod /end REF_MEASUREMENT
/end GROUP
/begin GROUP autosar_swc_vmp_rtARID_DEF.TmpSignalConversionAtEVM_CIPVOutport1[3].velocity_gnd_sl ""
 /begin REF_MEASUREMENT autosar_swc_vmp_rtARID_DEF.TmpSignalConversionAtEVM_CIPVOutport1[3].velocity_gnd_sl.x autosar_swc_vmp_rtARID_DEF.TmpSignalConversionAtEVM_CIPVOutport1[3].velocity_gnd_sl.y autosar_swc_vmp_rtARID_DEF.TmpSignalConversionAtEVM_CIPVOutport1[3].velocity_gnd_sl.mod /end REF_MEASUREMENT
/end GROUP
/begin GROUP autosar_swc_vmp_rtARID_DEF.TmpSignalConversionAtEVM_CIPVOutport1[4] ""
 /begin SUB_GROUP autosar_swc_vmp_rtARID_DEF.TmpSignalConversionAtEVM_CIPVOutport1[4].box autosar_swc_vmp_rtARID_DEF.TmpSignalConversionAtEVM_CIPVOutport1[4].position autosar_swc_vmp_rtARID_DEF.TmpSignalConversionAtEVM_CIPVOutport1[4].position_sl autosar_swc_vmp_rtARID_DEF.TmpSignalConversionAtEVM_CIPVOutport1[4].size autosar_swc_vmp_rtARID_DEF.TmpSignalConversionAtEVM_CIPVOutport1[4].velocity_gnd autosar_swc_vmp_rtARID_DEF.TmpSignalConversionAtEVM_CIPVOutport1[4].accel_gnd autosar_swc_vmp_rtARID_DEF.TmpSignalConversionAtEVM_CIPVOutport1[4].velocity_gnd_sl autosar_swc_vmp_rtARID_DEF.TmpSignalConversionAtEVM_CIPVOutport1[4].accel_gnd_sl /end SUB_GROUP
 /begin REF_MEASUREMENT autosar_swc_vmp_rtARID_DEF.TmpSignalConversionAtEVM_CIPVOutport1[4].meas_state autosar_swc_vmp_rtARID_DEF.TmpSignalConversionAtEVM_CIPVOutport1[4].fus_type autosar_swc_vmp_rtARID_DEF.TmpSignalConversionAtEVM_CIPVOutport1[4].class_type autosar_swc_vmp_rtARID_DEF.TmpSignalConversionAtEVM_CIPVOutport1[4].cut_type autosar_swc_vmp_rtARID_DEF.TmpSignalConversionAtEVM_CIPVOutport1[4].ref_lane_id autosar_swc_vmp_rtARID_DEF.TmpSignalConversionAtEVM_CIPVOutport1[4].id /end REF_MEASUREMENT
/end GROUP
/begin GROUP autosar_swc_vmp_rtARID_DEF.TmpSignalConversionAtEVM_CIPVOutport1[4].accel_gnd ""
 /begin REF_MEASUREMENT autosar_swc_vmp_rtARID_DEF.TmpSignalConversionAtEVM_CIPVOutport1[4].accel_gnd.x autosar_swc_vmp_rtARID_DEF.TmpSignalConversionAtEVM_CIPVOutport1[4].accel_gnd.y autosar_swc_vmp_rtARID_DEF.TmpSignalConversionAtEVM_CIPVOutport1[4].accel_gnd.mod /end REF_MEASUREMENT
/end GROUP
/begin GROUP autosar_swc_vmp_rtARID_DEF.TmpSignalConversionAtEVM_CIPVOutport1[4].accel_gnd_sl ""
 /begin REF_MEASUREMENT autosar_swc_vmp_rtARID_DEF.TmpSignalConversionAtEVM_CIPVOutport1[4].accel_gnd_sl.x autosar_swc_vmp_rtARID_DEF.TmpSignalConversionAtEVM_CIPVOutport1[4].accel_gnd_sl.y autosar_swc_vmp_rtARID_DEF.TmpSignalConversionAtEVM_CIPVOutport1[4].accel_gnd_sl.mod /end REF_MEASUREMENT
/end GROUP
/begin GROUP autosar_swc_vmp_rtARID_DEF.TmpSignalConversionAtEVM_CIPVOutport1[4].box ""
 /begin REF_MEASUREMENT autosar_swc_vmp_rtARID_DEF.TmpSignalConversionAtEVM_CIPVOutport1[4].box.corner_x_vec autosar_swc_vmp_rtARID_DEF.TmpSignalConversionAtEVM_CIPVOutport1[4].box.corner_y_vec /end REF_MEASUREMENT
/end GROUP
/begin GROUP autosar_swc_vmp_rtARID_DEF.TmpSignalConversionAtEVM_CIPVOutport1[4].position ""
 /begin REF_MEASUREMENT autosar_swc_vmp_rtARID_DEF.TmpSignalConversionAtEVM_CIPVOutport1[4].position.x autosar_swc_vmp_rtARID_DEF.TmpSignalConversionAtEVM_CIPVOutport1[4].position.y autosar_swc_vmp_rtARID_DEF.TmpSignalConversionAtEVM_CIPVOutport1[4].position.heading_angle /end REF_MEASUREMENT
/end GROUP
/begin GROUP autosar_swc_vmp_rtARID_DEF.TmpSignalConversionAtEVM_CIPVOutport1[4].position_sl ""
 /begin REF_MEASUREMENT autosar_swc_vmp_rtARID_DEF.TmpSignalConversionAtEVM_CIPVOutport1[4].position_sl.x autosar_swc_vmp_rtARID_DEF.TmpSignalConversionAtEVM_CIPVOutport1[4].position_sl.y autosar_swc_vmp_rtARID_DEF.TmpSignalConversionAtEVM_CIPVOutport1[4].position_sl.heading_angle /end REF_MEASUREMENT
/end GROUP
/begin GROUP autosar_swc_vmp_rtARID_DEF.TmpSignalConversionAtEVM_CIPVOutport1[4].size ""
 /begin REF_MEASUREMENT autosar_swc_vmp_rtARID_DEF.TmpSignalConversionAtEVM_CIPVOutport1[4].size.length autosar_swc_vmp_rtARID_DEF.TmpSignalConversionAtEVM_CIPVOutport1[4].size.width autosar_swc_vmp_rtARID_DEF.TmpSignalConversionAtEVM_CIPVOutport1[4].size.higth /end REF_MEASUREMENT
/end GROUP
/begin GROUP autosar_swc_vmp_rtARID_DEF.TmpSignalConversionAtEVM_CIPVOutport1[4].velocity_gnd ""
 /begin REF_MEASUREMENT autosar_swc_vmp_rtARID_DEF.TmpSignalConversionAtEVM_CIPVOutport1[4].velocity_gnd.x autosar_swc_vmp_rtARID_DEF.TmpSignalConversionAtEVM_CIPVOutport1[4].velocity_gnd.y autosar_swc_vmp_rtARID_DEF.TmpSignalConversionAtEVM_CIPVOutport1[4].velocity_gnd.mod /end REF_MEASUREMENT
/end GROUP
/begin GROUP autosar_swc_vmp_rtARID_DEF.TmpSignalConversionAtEVM_CIPVOutport1[4].velocity_gnd_sl ""
 /begin REF_MEASUREMENT autosar_swc_vmp_rtARID_DEF.TmpSignalConversionAtEVM_CIPVOutport1[4].velocity_gnd_sl.x autosar_swc_vmp_rtARID_DEF.TmpSignalConversionAtEVM_CIPVOutport1[4].velocity_gnd_sl.y autosar_swc_vmp_rtARID_DEF.TmpSignalConversionAtEVM_CIPVOutport1[4].velocity_gnd_sl.mod /end REF_MEASUREMENT
/end GROUP
/begin GROUP autosar_swc_vmp_rtARID_DEF.TmpSignalConversionAtEVM_CIPVOutport1[5] ""
 /begin SUB_GROUP autosar_swc_vmp_rtARID_DEF.TmpSignalConversionAtEVM_CIPVOutport1[5].box autosar_swc_vmp_rtARID_DEF.TmpSignalConversionAtEVM_CIPVOutport1[5].position autosar_swc_vmp_rtARID_DEF.TmpSignalConversionAtEVM_CIPVOutport1[5].position_sl autosar_swc_vmp_rtARID_DEF.TmpSignalConversionAtEVM_CIPVOutport1[5].size autosar_swc_vmp_rtARID_DEF.TmpSignalConversionAtEVM_CIPVOutport1[5].velocity_gnd autosar_swc_vmp_rtARID_DEF.TmpSignalConversionAtEVM_CIPVOutport1[5].accel_gnd autosar_swc_vmp_rtARID_DEF.TmpSignalConversionAtEVM_CIPVOutport1[5].velocity_gnd_sl autosar_swc_vmp_rtARID_DEF.TmpSignalConversionAtEVM_CIPVOutport1[5].accel_gnd_sl /end SUB_GROUP
 /begin REF_MEASUREMENT autosar_swc_vmp_rtARID_DEF.TmpSignalConversionAtEVM_CIPVOutport1[5].meas_state autosar_swc_vmp_rtARID_DEF.TmpSignalConversionAtEVM_CIPVOutport1[5].fus_type autosar_swc_vmp_rtARID_DEF.TmpSignalConversionAtEVM_CIPVOutport1[5].class_type autosar_swc_vmp_rtARID_DEF.TmpSignalConversionAtEVM_CIPVOutport1[5].cut_type autosar_swc_vmp_rtARID_DEF.TmpSignalConversionAtEVM_CIPVOutport1[5].ref_lane_id autosar_swc_vmp_rtARID_DEF.TmpSignalConversionAtEVM_CIPVOutport1[5].id /end REF_MEASUREMENT
/end GROUP
/begin GROUP autosar_swc_vmp_rtARID_DEF.TmpSignalConversionAtEVM_CIPVOutport1[5].accel_gnd ""
 /begin REF_MEASUREMENT autosar_swc_vmp_rtARID_DEF.TmpSignalConversionAtEVM_CIPVOutport1[5].accel_gnd.x autosar_swc_vmp_rtARID_DEF.TmpSignalConversionAtEVM_CIPVOutport1[5].accel_gnd.y autosar_swc_vmp_rtARID_DEF.TmpSignalConversionAtEVM_CIPVOutport1[5].accel_gnd.mod /end REF_MEASUREMENT
/end GROUP
/begin GROUP autosar_swc_vmp_rtARID_DEF.TmpSignalConversionAtEVM_CIPVOutport1[5].accel_gnd_sl ""
 /begin REF_MEASUREMENT autosar_swc_vmp_rtARID_DEF.TmpSignalConversionAtEVM_CIPVOutport1[5].accel_gnd_sl.x autosar_swc_vmp_rtARID_DEF.TmpSignalConversionAtEVM_CIPVOutport1[5].accel_gnd_sl.y autosar_swc_vmp_rtARID_DEF.TmpSignalConversionAtEVM_CIPVOutport1[5].accel_gnd_sl.mod /end REF_MEASUREMENT
/end GROUP
/begin GROUP autosar_swc_vmp_rtARID_DEF.TmpSignalConversionAtEVM_CIPVOutport1[5].box ""
 /begin REF_MEASUREMENT autosar_swc_vmp_rtARID_DEF.TmpSignalConversionAtEVM_CIPVOutport1[5].box.corner_x_vec autosar_swc_vmp_rtARID_DEF.TmpSignalConversionAtEVM_CIPVOutport1[5].box.corner_y_vec /end REF_MEASUREMENT
/end GROUP
/begin GROUP autosar_swc_vmp_rtARID_DEF.TmpSignalConversionAtEVM_CIPVOutport1[5].position ""
 /begin REF_MEASUREMENT autosar_swc_vmp_rtARID_DEF.TmpSignalConversionAtEVM_CIPVOutport1[5].position.x autosar_swc_vmp_rtARID_DEF.TmpSignalConversionAtEVM_CIPVOutport1[5].position.y autosar_swc_vmp_rtARID_DEF.TmpSignalConversionAtEVM_CIPVOutport1[5].position.heading_angle /end REF_MEASUREMENT
/end GROUP
/begin GROUP autosar_swc_vmp_rtARID_DEF.TmpSignalConversionAtEVM_CIPVOutport1[5].position_sl ""
 /begin REF_MEASUREMENT autosar_swc_vmp_rtARID_DEF.TmpSignalConversionAtEVM_CIPVOutport1[5].position_sl.x autosar_swc_vmp_rtARID_DEF.TmpSignalConversionAtEVM_CIPVOutport1[5].position_sl.y autosar_swc_vmp_rtARID_DEF.TmpSignalConversionAtEVM_CIPVOutport1[5].position_sl.heading_angle /end REF_MEASUREMENT
/end GROUP
/begin GROUP autosar_swc_vmp_rtARID_DEF.TmpSignalConversionAtEVM_CIPVOutport1[5].size ""
 /begin REF_MEASUREMENT autosar_swc_vmp_rtARID_DEF.TmpSignalConversionAtEVM_CIPVOutport1[5].size.length autosar_swc_vmp_rtARID_DEF.TmpSignalConversionAtEVM_CIPVOutport1[5].size.width autosar_swc_vmp_rtARID_DEF.TmpSignalConversionAtEVM_CIPVOutport1[5].size.higth /end REF_MEASUREMENT
/end GROUP
/begin GROUP autosar_swc_vmp_rtARID_DEF.TmpSignalConversionAtEVM_CIPVOutport1[5].velocity_gnd ""
 /begin REF_MEASUREMENT autosar_swc_vmp_rtARID_DEF.TmpSignalConversionAtEVM_CIPVOutport1[5].velocity_gnd.x autosar_swc_vmp_rtARID_DEF.TmpSignalConversionAtEVM_CIPVOutport1[5].velocity_gnd.y autosar_swc_vmp_rtARID_DEF.TmpSignalConversionAtEVM_CIPVOutport1[5].velocity_gnd.mod /end REF_MEASUREMENT
/end GROUP
/begin GROUP autosar_swc_vmp_rtARID_DEF.TmpSignalConversionAtEVM_CIPVOutport1[5].velocity_gnd_sl ""
 /begin REF_MEASUREMENT autosar_swc_vmp_rtARID_DEF.TmpSignalConversionAtEVM_CIPVOutport1[5].velocity_gnd_sl.x autosar_swc_vmp_rtARID_DEF.TmpSignalConversionAtEVM_CIPVOutport1[5].velocity_gnd_sl.y autosar_swc_vmp_rtARID_DEF.TmpSignalConversionAtEVM_CIPVOutport1[5].velocity_gnd_sl.mod /end REF_MEASUREMENT
/end GROUP
/begin GROUP autosar_swc_vmp_rtARID_DEF.TmpSignalConversionAtEVM_CIPVOutport1[6] ""
 /begin SUB_GROUP autosar_swc_vmp_rtARID_DEF.TmpSignalConversionAtEVM_CIPVOutport1[6].box autosar_swc_vmp_rtARID_DEF.TmpSignalConversionAtEVM_CIPVOutport1[6].position autosar_swc_vmp_rtARID_DEF.TmpSignalConversionAtEVM_CIPVOutport1[6].position_sl autosar_swc_vmp_rtARID_DEF.TmpSignalConversionAtEVM_CIPVOutport1[6].size autosar_swc_vmp_rtARID_DEF.TmpSignalConversionAtEVM_CIPVOutport1[6].velocity_gnd autosar_swc_vmp_rtARID_DEF.TmpSignalConversionAtEVM_CIPVOutport1[6].accel_gnd autosar_swc_vmp_rtARID_DEF.TmpSignalConversionAtEVM_CIPVOutport1[6].velocity_gnd_sl autosar_swc_vmp_rtARID_DEF.TmpSignalConversionAtEVM_CIPVOutport1[6].accel_gnd_sl /end SUB_GROUP
 /begin REF_MEASUREMENT autosar_swc_vmp_rtARID_DEF.TmpSignalConversionAtEVM_CIPVOutport1[6].meas_state autosar_swc_vmp_rtARID_DEF.TmpSignalConversionAtEVM_CIPVOutport1[6].fus_type autosar_swc_vmp_rtARID_DEF.TmpSignalConversionAtEVM_CIPVOutport1[6].class_type autosar_swc_vmp_rtARID_DEF.TmpSignalConversionAtEVM_CIPVOutport1[6].cut_type autosar_swc_vmp_rtARID_DEF.TmpSignalConversionAtEVM_CIPVOutport1[6].ref_lane_id autosar_swc_vmp_rtARID_DEF.TmpSignalConversionAtEVM_CIPVOutport1[6].id /end REF_MEASUREMENT
/end GROUP
/begin GROUP autosar_swc_vmp_rtARID_DEF.TmpSignalConversionAtEVM_CIPVOutport1[6].accel_gnd ""
 /begin REF_MEASUREMENT autosar_swc_vmp_rtARID_DEF.TmpSignalConversionAtEVM_CIPVOutport1[6].accel_gnd.x autosar_swc_vmp_rtARID_DEF.TmpSignalConversionAtEVM_CIPVOutport1[6].accel_gnd.y autosar_swc_vmp_rtARID_DEF.TmpSignalConversionAtEVM_CIPVOutport1[6].accel_gnd.mod /end REF_MEASUREMENT
/end GROUP
/begin GROUP autosar_swc_vmp_rtARID_DEF.TmpSignalConversionAtEVM_CIPVOutport1[6].accel_gnd_sl ""
 /begin REF_MEASUREMENT autosar_swc_vmp_rtARID_DEF.TmpSignalConversionAtEVM_CIPVOutport1[6].accel_gnd_sl.x autosar_swc_vmp_rtARID_DEF.TmpSignalConversionAtEVM_CIPVOutport1[6].accel_gnd_sl.y autosar_swc_vmp_rtARID_DEF.TmpSignalConversionAtEVM_CIPVOutport1[6].accel_gnd_sl.mod /end REF_MEASUREMENT
/end GROUP
/begin GROUP autosar_swc_vmp_rtARID_DEF.TmpSignalConversionAtEVM_CIPVOutport1[6].box ""
 /begin REF_MEASUREMENT autosar_swc_vmp_rtARID_DEF.TmpSignalConversionAtEVM_CIPVOutport1[6].box.corner_x_vec autosar_swc_vmp_rtARID_DEF.TmpSignalConversionAtEVM_CIPVOutport1[6].box.corner_y_vec /end REF_MEASUREMENT
/end GROUP
/begin GROUP autosar_swc_vmp_rtARID_DEF.TmpSignalConversionAtEVM_CIPVOutport1[6].position ""
 /begin REF_MEASUREMENT autosar_swc_vmp_rtARID_DEF.TmpSignalConversionAtEVM_CIPVOutport1[6].position.x autosar_swc_vmp_rtARID_DEF.TmpSignalConversionAtEVM_CIPVOutport1[6].position.y autosar_swc_vmp_rtARID_DEF.TmpSignalConversionAtEVM_CIPVOutport1[6].position.heading_angle /end REF_MEASUREMENT
/end GROUP
/begin GROUP autosar_swc_vmp_rtARID_DEF.TmpSignalConversionAtEVM_CIPVOutport1[6].position_sl ""
 /begin REF_MEASUREMENT autosar_swc_vmp_rtARID_DEF.TmpSignalConversionAtEVM_CIPVOutport1[6].position_sl.x autosar_swc_vmp_rtARID_DEF.TmpSignalConversionAtEVM_CIPVOutport1[6].position_sl.y autosar_swc_vmp_rtARID_DEF.TmpSignalConversionAtEVM_CIPVOutport1[6].position_sl.heading_angle /end REF_MEASUREMENT
/end GROUP
/begin GROUP autosar_swc_vmp_rtARID_DEF.TmpSignalConversionAtEVM_CIPVOutport1[6].size ""
 /begin REF_MEASUREMENT autosar_swc_vmp_rtARID_DEF.TmpSignalConversionAtEVM_CIPVOutport1[6].size.length autosar_swc_vmp_rtARID_DEF.TmpSignalConversionAtEVM_CIPVOutport1[6].size.width autosar_swc_vmp_rtARID_DEF.TmpSignalConversionAtEVM_CIPVOutport1[6].size.higth /end REF_MEASUREMENT
/end GROUP
/begin GROUP autosar_swc_vmp_rtARID_DEF.TmpSignalConversionAtEVM_CIPVOutport1[6].velocity_gnd ""
 /begin REF_MEASUREMENT autosar_swc_vmp_rtARID_DEF.TmpSignalConversionAtEVM_CIPVOutport1[6].velocity_gnd.x autosar_swc_vmp_rtARID_DEF.TmpSignalConversionAtEVM_CIPVOutport1[6].velocity_gnd.y autosar_swc_vmp_rtARID_DEF.TmpSignalConversionAtEVM_CIPVOutport1[6].velocity_gnd.mod /end REF_MEASUREMENT
/end GROUP
/begin GROUP autosar_swc_vmp_rtARID_DEF.TmpSignalConversionAtEVM_CIPVOutport1[6].velocity_gnd_sl ""
 /begin REF_MEASUREMENT autosar_swc_vmp_rtARID_DEF.TmpSignalConversionAtEVM_CIPVOutport1[6].velocity_gnd_sl.x autosar_swc_vmp_rtARID_DEF.TmpSignalConversionAtEVM_CIPVOutport1[6].velocity_gnd_sl.y autosar_swc_vmp_rtARID_DEF.TmpSignalConversionAtEVM_CIPVOutport1[6].velocity_gnd_sl.mod /end REF_MEASUREMENT
/end GROUP
/begin GROUP autosar_swc_vmp_rtARID_DEF.TmpSignalConversionAtEVM_CIPVOutport1[7] ""
 /begin SUB_GROUP autosar_swc_vmp_rtARID_DEF.TmpSignalConversionAtEVM_CIPVOutport1[7].box autosar_swc_vmp_rtARID_DEF.TmpSignalConversionAtEVM_CIPVOutport1[7].position autosar_swc_vmp_rtARID_DEF.TmpSignalConversionAtEVM_CIPVOutport1[7].position_sl autosar_swc_vmp_rtARID_DEF.TmpSignalConversionAtEVM_CIPVOutport1[7].size autosar_swc_vmp_rtARID_DEF.TmpSignalConversionAtEVM_CIPVOutport1[7].velocity_gnd autosar_swc_vmp_rtARID_DEF.TmpSignalConversionAtEVM_CIPVOutport1[7].accel_gnd autosar_swc_vmp_rtARID_DEF.TmpSignalConversionAtEVM_CIPVOutport1[7].velocity_gnd_sl autosar_swc_vmp_rtARID_DEF.TmpSignalConversionAtEVM_CIPVOutport1[7].accel_gnd_sl /end SUB_GROUP
 /begin REF_MEASUREMENT autosar_swc_vmp_rtARID_DEF.TmpSignalConversionAtEVM_CIPVOutport1[7].meas_state autosar_swc_vmp_rtARID_DEF.TmpSignalConversionAtEVM_CIPVOutport1[7].fus_type autosar_swc_vmp_rtARID_DEF.TmpSignalConversionAtEVM_CIPVOutport1[7].class_type autosar_swc_vmp_rtARID_DEF.TmpSignalConversionAtEVM_CIPVOutport1[7].cut_type autosar_swc_vmp_rtARID_DEF.TmpSignalConversionAtEVM_CIPVOutport1[7].ref_lane_id autosar_swc_vmp_rtARID_DEF.TmpSignalConversionAtEVM_CIPVOutport1[7].id /end REF_MEASUREMENT
/end GROUP
/begin GROUP autosar_swc_vmp_rtARID_DEF.TmpSignalConversionAtEVM_CIPVOutport1[7].accel_gnd ""
 /begin REF_MEASUREMENT autosar_swc_vmp_rtARID_DEF.TmpSignalConversionAtEVM_CIPVOutport1[7].accel_gnd.x autosar_swc_vmp_rtARID_DEF.TmpSignalConversionAtEVM_CIPVOutport1[7].accel_gnd.y autosar_swc_vmp_rtARID_DEF.TmpSignalConversionAtEVM_CIPVOutport1[7].accel_gnd.mod /end REF_MEASUREMENT
/end GROUP
/begin GROUP autosar_swc_vmp_rtARID_DEF.TmpSignalConversionAtEVM_CIPVOutport1[7].accel_gnd_sl ""
 /begin REF_MEASUREMENT autosar_swc_vmp_rtARID_DEF.TmpSignalConversionAtEVM_CIPVOutport1[7].accel_gnd_sl.x autosar_swc_vmp_rtARID_DEF.TmpSignalConversionAtEVM_CIPVOutport1[7].accel_gnd_sl.y autosar_swc_vmp_rtARID_DEF.TmpSignalConversionAtEVM_CIPVOutport1[7].accel_gnd_sl.mod /end REF_MEASUREMENT
/end GROUP
/begin GROUP autosar_swc_vmp_rtARID_DEF.TmpSignalConversionAtEVM_CIPVOutport1[7].box ""
 /begin REF_MEASUREMENT autosar_swc_vmp_rtARID_DEF.TmpSignalConversionAtEVM_CIPVOutport1[7].box.corner_x_vec autosar_swc_vmp_rtARID_DEF.TmpSignalConversionAtEVM_CIPVOutport1[7].box.corner_y_vec /end REF_MEASUREMENT
/end GROUP
/begin GROUP autosar_swc_vmp_rtARID_DEF.TmpSignalConversionAtEVM_CIPVOutport1[7].position ""
 /begin REF_MEASUREMENT autosar_swc_vmp_rtARID_DEF.TmpSignalConversionAtEVM_CIPVOutport1[7].position.x autosar_swc_vmp_rtARID_DEF.TmpSignalConversionAtEVM_CIPVOutport1[7].position.y autosar_swc_vmp_rtARID_DEF.TmpSignalConversionAtEVM_CIPVOutport1[7].position.heading_angle /end REF_MEASUREMENT
/end GROUP
/begin GROUP autosar_swc_vmp_rtARID_DEF.TmpSignalConversionAtEVM_CIPVOutport1[7].position_sl ""
 /begin REF_MEASUREMENT autosar_swc_vmp_rtARID_DEF.TmpSignalConversionAtEVM_CIPVOutport1[7].position_sl.x autosar_swc_vmp_rtARID_DEF.TmpSignalConversionAtEVM_CIPVOutport1[7].position_sl.y autosar_swc_vmp_rtARID_DEF.TmpSignalConversionAtEVM_CIPVOutport1[7].position_sl.heading_angle /end REF_MEASUREMENT
/end GROUP
/begin GROUP autosar_swc_vmp_rtARID_DEF.TmpSignalConversionAtEVM_CIPVOutport1[7].size ""
 /begin REF_MEASUREMENT autosar_swc_vmp_rtARID_DEF.TmpSignalConversionAtEVM_CIPVOutport1[7].size.length autosar_swc_vmp_rtARID_DEF.TmpSignalConversionAtEVM_CIPVOutport1[7].size.width autosar_swc_vmp_rtARID_DEF.TmpSignalConversionAtEVM_CIPVOutport1[7].size.higth /end REF_MEASUREMENT
/end GROUP
/begin GROUP autosar_swc_vmp_rtARID_DEF.TmpSignalConversionAtEVM_CIPVOutport1[7].velocity_gnd ""
 /begin REF_MEASUREMENT autosar_swc_vmp_rtARID_DEF.TmpSignalConversionAtEVM_CIPVOutport1[7].velocity_gnd.x autosar_swc_vmp_rtARID_DEF.TmpSignalConversionAtEVM_CIPVOutport1[7].velocity_gnd.y autosar_swc_vmp_rtARID_DEF.TmpSignalConversionAtEVM_CIPVOutport1[7].velocity_gnd.mod /end REF_MEASUREMENT
/end GROUP
/begin GROUP autosar_swc_vmp_rtARID_DEF.TmpSignalConversionAtEVM_CIPVOutport1[7].velocity_gnd_sl ""
 /begin REF_MEASUREMENT autosar_swc_vmp_rtARID_DEF.TmpSignalConversionAtEVM_CIPVOutport1[7].velocity_gnd_sl.x autosar_swc_vmp_rtARID_DEF.TmpSignalConversionAtEVM_CIPVOutport1[7].velocity_gnd_sl.y autosar_swc_vmp_rtARID_DEF.TmpSignalConversionAtEVM_CIPVOutport1[7].velocity_gnd_sl.mod /end REF_MEASUREMENT
/end GROUP
/begin GROUP autosar_swc_vmp_rtARID_DEF.TmpSignalConversionAtEVM_CIPVOutport1[8] ""
 /begin SUB_GROUP autosar_swc_vmp_rtARID_DEF.TmpSignalConversionAtEVM_CIPVOutport1[8].box autosar_swc_vmp_rtARID_DEF.TmpSignalConversionAtEVM_CIPVOutport1[8].position autosar_swc_vmp_rtARID_DEF.TmpSignalConversionAtEVM_CIPVOutport1[8].position_sl autosar_swc_vmp_rtARID_DEF.TmpSignalConversionAtEVM_CIPVOutport1[8].size autosar_swc_vmp_rtARID_DEF.TmpSignalConversionAtEVM_CIPVOutport1[8].velocity_gnd autosar_swc_vmp_rtARID_DEF.TmpSignalConversionAtEVM_CIPVOutport1[8].accel_gnd autosar_swc_vmp_rtARID_DEF.TmpSignalConversionAtEVM_CIPVOutport1[8].velocity_gnd_sl autosar_swc_vmp_rtARID_DEF.TmpSignalConversionAtEVM_CIPVOutport1[8].accel_gnd_sl /end SUB_GROUP
 /begin REF_MEASUREMENT autosar_swc_vmp_rtARID_DEF.TmpSignalConversionAtEVM_CIPVOutport1[8].meas_state autosar_swc_vmp_rtARID_DEF.TmpSignalConversionAtEVM_CIPVOutport1[8].fus_type autosar_swc_vmp_rtARID_DEF.TmpSignalConversionAtEVM_CIPVOutport1[8].class_type autosar_swc_vmp_rtARID_DEF.TmpSignalConversionAtEVM_CIPVOutport1[8].cut_type autosar_swc_vmp_rtARID_DEF.TmpSignalConversionAtEVM_CIPVOutport1[8].ref_lane_id autosar_swc_vmp_rtARID_DEF.TmpSignalConversionAtEVM_CIPVOutport1[8].id /end REF_MEASUREMENT
/end GROUP
/begin GROUP autosar_swc_vmp_rtARID_DEF.TmpSignalConversionAtEVM_CIPVOutport1[8].accel_gnd ""
 /begin REF_MEASUREMENT autosar_swc_vmp_rtARID_DEF.TmpSignalConversionAtEVM_CIPVOutport1[8].accel_gnd.x autosar_swc_vmp_rtARID_DEF.TmpSignalConversionAtEVM_CIPVOutport1[8].accel_gnd.y autosar_swc_vmp_rtARID_DEF.TmpSignalConversionAtEVM_CIPVOutport1[8].accel_gnd.mod /end REF_MEASUREMENT
/end GROUP
/begin GROUP autosar_swc_vmp_rtARID_DEF.TmpSignalConversionAtEVM_CIPVOutport1[8].accel_gnd_sl ""
 /begin REF_MEASUREMENT autosar_swc_vmp_rtARID_DEF.TmpSignalConversionAtEVM_CIPVOutport1[8].accel_gnd_sl.x autosar_swc_vmp_rtARID_DEF.TmpSignalConversionAtEVM_CIPVOutport1[8].accel_gnd_sl.y autosar_swc_vmp_rtARID_DEF.TmpSignalConversionAtEVM_CIPVOutport1[8].accel_gnd_sl.mod /end REF_MEASUREMENT
/end GROUP
/begin GROUP autosar_swc_vmp_rtARID_DEF.TmpSignalConversionAtEVM_CIPVOutport1[8].box ""
 /begin REF_MEASUREMENT autosar_swc_vmp_rtARID_DEF.TmpSignalConversionAtEVM_CIPVOutport1[8].box.corner_x_vec autosar_swc_vmp_rtARID_DEF.TmpSignalConversionAtEVM_CIPVOutport1[8].box.corner_y_vec /end REF_MEASUREMENT
/end GROUP
/begin GROUP autosar_swc_vmp_rtARID_DEF.TmpSignalConversionAtEVM_CIPVOutport1[8].position ""
 /begin REF_MEASUREMENT autosar_swc_vmp_rtARID_DEF.TmpSignalConversionAtEVM_CIPVOutport1[8].position.x autosar_swc_vmp_rtARID_DEF.TmpSignalConversionAtEVM_CIPVOutport1[8].position.y autosar_swc_vmp_rtARID_DEF.TmpSignalConversionAtEVM_CIPVOutport1[8].position.heading_angle /end REF_MEASUREMENT
/end GROUP
/begin GROUP autosar_swc_vmp_rtARID_DEF.TmpSignalConversionAtEVM_CIPVOutport1[8].position_sl ""
 /begin REF_MEASUREMENT autosar_swc_vmp_rtARID_DEF.TmpSignalConversionAtEVM_CIPVOutport1[8].position_sl.x autosar_swc_vmp_rtARID_DEF.TmpSignalConversionAtEVM_CIPVOutport1[8].position_sl.y autosar_swc_vmp_rtARID_DEF.TmpSignalConversionAtEVM_CIPVOutport1[8].position_sl.heading_angle /end REF_MEASUREMENT
/end GROUP
/begin GROUP autosar_swc_vmp_rtARID_DEF.TmpSignalConversionAtEVM_CIPVOutport1[8].size ""
 /begin REF_MEASUREMENT autosar_swc_vmp_rtARID_DEF.TmpSignalConversionAtEVM_CIPVOutport1[8].size.length autosar_swc_vmp_rtARID_DEF.TmpSignalConversionAtEVM_CIPVOutport1[8].size.width autosar_swc_vmp_rtARID_DEF.TmpSignalConversionAtEVM_CIPVOutport1[8].size.higth /end REF_MEASUREMENT
/end GROUP
/begin GROUP autosar_swc_vmp_rtARID_DEF.TmpSignalConversionAtEVM_CIPVOutport1[8].velocity_gnd ""
 /begin REF_MEASUREMENT autosar_swc_vmp_rtARID_DEF.TmpSignalConversionAtEVM_CIPVOutport1[8].velocity_gnd.x autosar_swc_vmp_rtARID_DEF.TmpSignalConversionAtEVM_CIPVOutport1[8].velocity_gnd.y autosar_swc_vmp_rtARID_DEF.TmpSignalConversionAtEVM_CIPVOutport1[8].velocity_gnd.mod /end REF_MEASUREMENT
/end GROUP
/begin GROUP autosar_swc_vmp_rtARID_DEF.TmpSignalConversionAtEVM_CIPVOutport1[8].velocity_gnd_sl ""
 /begin REF_MEASUREMENT autosar_swc_vmp_rtARID_DEF.TmpSignalConversionAtEVM_CIPVOutport1[8].velocity_gnd_sl.x autosar_swc_vmp_rtARID_DEF.TmpSignalConversionAtEVM_CIPVOutport1[8].velocity_gnd_sl.y autosar_swc_vmp_rtARID_DEF.TmpSignalConversionAtEVM_CIPVOutport1[8].velocity_gnd_sl.mod /end REF_MEASUREMENT
/end GROUP
/begin GROUP autosar_swc_vmp_rtARID_DEF.TmpSignalConversionAtEVM_CIPVOutport1[9] ""
 /begin SUB_GROUP autosar_swc_vmp_rtARID_DEF.TmpSignalConversionAtEVM_CIPVOutport1[9].box autosar_swc_vmp_rtARID_DEF.TmpSignalConversionAtEVM_CIPVOutport1[9].position autosar_swc_vmp_rtARID_DEF.TmpSignalConversionAtEVM_CIPVOutport1[9].position_sl autosar_swc_vmp_rtARID_DEF.TmpSignalConversionAtEVM_CIPVOutport1[9].size autosar_swc_vmp_rtARID_DEF.TmpSignalConversionAtEVM_CIPVOutport1[9].velocity_gnd autosar_swc_vmp_rtARID_DEF.TmpSignalConversionAtEVM_CIPVOutport1[9].accel_gnd autosar_swc_vmp_rtARID_DEF.TmpSignalConversionAtEVM_CIPVOutport1[9].velocity_gnd_sl autosar_swc_vmp_rtARID_DEF.TmpSignalConversionAtEVM_CIPVOutport1[9].accel_gnd_sl /end SUB_GROUP
 /begin REF_MEASUREMENT autosar_swc_vmp_rtARID_DEF.TmpSignalConversionAtEVM_CIPVOutport1[9].meas_state autosar_swc_vmp_rtARID_DEF.TmpSignalConversionAtEVM_CIPVOutport1[9].fus_type autosar_swc_vmp_rtARID_DEF.TmpSignalConversionAtEVM_CIPVOutport1[9].class_type autosar_swc_vmp_rtARID_DEF.TmpSignalConversionAtEVM_CIPVOutport1[9].cut_type autosar_swc_vmp_rtARID_DEF.TmpSignalConversionAtEVM_CIPVOutport1[9].ref_lane_id autosar_swc_vmp_rtARID_DEF.TmpSignalConversionAtEVM_CIPVOutport1[9].id /end REF_MEASUREMENT
/end GROUP
/begin GROUP autosar_swc_vmp_rtARID_DEF.TmpSignalConversionAtEVM_CIPVOutport1[9].accel_gnd ""
 /begin REF_MEASUREMENT autosar_swc_vmp_rtARID_DEF.TmpSignalConversionAtEVM_CIPVOutport1[9].accel_gnd.x autosar_swc_vmp_rtARID_DEF.TmpSignalConversionAtEVM_CIPVOutport1[9].accel_gnd.y autosar_swc_vmp_rtARID_DEF.TmpSignalConversionAtEVM_CIPVOutport1[9].accel_gnd.mod /end REF_MEASUREMENT
/end GROUP
/begin GROUP autosar_swc_vmp_rtARID_DEF.TmpSignalConversionAtEVM_CIPVOutport1[9].accel_gnd_sl ""
 /begin REF_MEASUREMENT autosar_swc_vmp_rtARID_DEF.TmpSignalConversionAtEVM_CIPVOutport1[9].accel_gnd_sl.x autosar_swc_vmp_rtARID_DEF.TmpSignalConversionAtEVM_CIPVOutport1[9].accel_gnd_sl.y autosar_swc_vmp_rtARID_DEF.TmpSignalConversionAtEVM_CIPVOutport1[9].accel_gnd_sl.mod /end REF_MEASUREMENT
/end GROUP
/begin GROUP autosar_swc_vmp_rtARID_DEF.TmpSignalConversionAtEVM_CIPVOutport1[9].box ""
 /begin REF_MEASUREMENT autosar_swc_vmp_rtARID_DEF.TmpSignalConversionAtEVM_CIPVOutport1[9].box.corner_x_vec autosar_swc_vmp_rtARID_DEF.TmpSignalConversionAtEVM_CIPVOutport1[9].box.corner_y_vec /end REF_MEASUREMENT
/end GROUP
/begin GROUP autosar_swc_vmp_rtARID_DEF.TmpSignalConversionAtEVM_CIPVOutport1[9].position ""
 /begin REF_MEASUREMENT autosar_swc_vmp_rtARID_DEF.TmpSignalConversionAtEVM_CIPVOutport1[9].position.x autosar_swc_vmp_rtARID_DEF.TmpSignalConversionAtEVM_CIPVOutport1[9].position.y autosar_swc_vmp_rtARID_DEF.TmpSignalConversionAtEVM_CIPVOutport1[9].position.heading_angle /end REF_MEASUREMENT
/end GROUP
/begin GROUP autosar_swc_vmp_rtARID_DEF.TmpSignalConversionAtEVM_CIPVOutport1[9].position_sl ""
 /begin REF_MEASUREMENT autosar_swc_vmp_rtARID_DEF.TmpSignalConversionAtEVM_CIPVOutport1[9].position_sl.x autosar_swc_vmp_rtARID_DEF.TmpSignalConversionAtEVM_CIPVOutport1[9].position_sl.y autosar_swc_vmp_rtARID_DEF.TmpSignalConversionAtEVM_CIPVOutport1[9].position_sl.heading_angle /end REF_MEASUREMENT
/end GROUP
/begin GROUP autosar_swc_vmp_rtARID_DEF.TmpSignalConversionAtEVM_CIPVOutport1[9].size ""
 /begin REF_MEASUREMENT autosar_swc_vmp_rtARID_DEF.TmpSignalConversionAtEVM_CIPVOutport1[9].size.length autosar_swc_vmp_rtARID_DEF.TmpSignalConversionAtEVM_CIPVOutport1[9].size.width autosar_swc_vmp_rtARID_DEF.TmpSignalConversionAtEVM_CIPVOutport1[9].size.higth /end REF_MEASUREMENT
/end GROUP
/begin GROUP autosar_swc_vmp_rtARID_DEF.TmpSignalConversionAtEVM_CIPVOutport1[9].velocity_gnd ""
 /begin REF_MEASUREMENT autosar_swc_vmp_rtARID_DEF.TmpSignalConversionAtEVM_CIPVOutport1[9].velocity_gnd.x autosar_swc_vmp_rtARID_DEF.TmpSignalConversionAtEVM_CIPVOutport1[9].velocity_gnd.y autosar_swc_vmp_rtARID_DEF.TmpSignalConversionAtEVM_CIPVOutport1[9].velocity_gnd.mod /end REF_MEASUREMENT
/end GROUP
/begin GROUP autosar_swc_vmp_rtARID_DEF.TmpSignalConversionAtEVM_CIPVOutport1[9].velocity_gnd_sl ""
 /begin REF_MEASUREMENT autosar_swc_vmp_rtARID_DEF.TmpSignalConversionAtEVM_CIPVOutport1[9].velocity_gnd_sl.x autosar_swc_vmp_rtARID_DEF.TmpSignalConversionAtEVM_CIPVOutport1[9].velocity_gnd_sl.y autosar_swc_vmp_rtARID_DEF.TmpSignalConversionAtEVM_CIPVOutport1[9].velocity_gnd_sl.mod /end REF_MEASUREMENT
/end GROUP
/begin GROUP autosar_swc_vmp_rtARID_DEF.TmpSignalConversionAtEVM_DECSOutport1 ""
 /begin REF_MEASUREMENT autosar_swc_vmp_rtARID_DEF.TmpSignalConversionAtEVM_DECSOutport1.host_lane_idx autosar_swc_vmp_rtARID_DEF.TmpSignalConversionAtEVM_DECSOutport1.target_lane_idx autosar_swc_vmp_rtARID_DEF.TmpSignalConversionAtEVM_DECSOutport1.lc_req autosar_swc_vmp_rtARID_DEF.TmpSignalConversionAtEVM_DECSOutport1.lc_req_sync_id autosar_swc_vmp_rtARID_DEF.TmpSignalConversionAtEVM_DECSOutport1.lc_level autosar_swc_vmp_rtARID_DEF.TmpSignalConversionAtEVM_DECSOutport1.lc_req_reason autosar_swc_vmp_rtARID_DEF.TmpSignalConversionAtEVM_DECSOutport1.lc_lntention_conds /end REF_MEASUREMENT
/end GROUP
/begin GROUP autosar_swc_vmp_rtARID_DEF.UnitDelay1_DSTATE ""
 /begin REF_MEASUREMENT autosar_swc_vmp_rtARID_DEF.UnitDelay1_DSTATE.ACC_BrakePrefer autosar_swc_vmp_rtARID_DEF.UnitDelay1_DSTATE.ACC_axvCvAim autosar_swc_vmp_rtARID_DEF.UnitDelay1_DSTATE.ACC_axv_ComfortBandLowerValue autosar_swc_vmp_rtARID_DEF.UnitDelay1_DSTATE.ACC_axv_ComfortBandUpperValue autosar_swc_vmp_rtARID_DEF.UnitDelay1_DSTATE.ACC_DecelerateJerk autosar_swc_vmp_rtARID_DEF.UnitDelay1_DSTATE.ACC_AccelerateJerk autosar_swc_vmp_rtARID_DEF.UnitDelay1_DSTATE.CurvSpdLim /end REF_MEASUREMENT
/end GROUP
/begin MEASUREMENT SwcIn_ACU_1.ACU_1_CRC1 "" UBYTE autosar_swc_val_CM_ACU_1_CRC1_1180_dt 0 0 0 255 ECU_ADDRESS 0xfe4ccd6e /* @ECU_Address@SwcIn_ACU_1.ACU_1_CRC1@ */ /end MEASUREMENT
/begin MEASUREMENT SwcIn_ACU_1.ACU_1_PsngrSeatBeltWarning "" UBYTE autosar_swc_val_CM_ACU_1_PsngrSeatBeltWarning_1180_dt 0 0 0 255 ECU_ADDRESS 0xfe4ccd71 /* @ECU_Address@SwcIn_ACU_1.ACU_1_PsngrSeatBeltWarning@ */ /end MEASUREMENT
/begin MEASUREMENT SwcIn_ACU_1.ACU_1_PsngrSeatOccupiedSts "" UBYTE autosar_swc_val_CM_ACU_1_PsngrSeatOccupiedSts_1180_dt 0 0 0 255 ECU_ADDRESS 0xfe4ccd72 /* @ECU_Address@SwcIn_ACU_1.ACU_1_PsngrSeatOccupiedSts@ */ /end MEASUREMENT
/begin MEASUREMENT SwcIn_ACU_1.ACU_1_Resd1 "" UBYTE autosar_swc_val_CM_ACU_1_Resd1_1180_dt 0 0 0 255 ECU_ADDRESS 0xfe4ccd70 /* @ECU_Address@SwcIn_ACU_1.ACU_1_Resd1@ */ /end MEASUREMENT
/begin MEASUREMENT SwcIn_ACU_1.ACU_1_RollgCntr1 "" UBYTE autosar_swc_val_CM_ACU_1_RollgCntr1_1180_dt 0 0 0 255 ECU_ADDRESS 0xfe4ccd6f /* @ECU_Address@SwcIn_ACU_1.ACU_1_RollgCntr1@ */ /end MEASUREMENT
/begin MEASUREMENT SwcIn_ACU_2.ACU_2_CRC1 "" UBYTE autosar_swc_val_CM_ACU_2_CRC1_49_dt 0 0 0 255 ECU_ADDRESS 0xfe4ca458 /* @ECU_Address@SwcIn_ACU_2.ACU_2_CRC1@ */ /end MEASUREMENT
/begin MEASUREMENT SwcIn_ACU_2.ACU_2_LateralAcceleration "" FLOAT32_IEEE autosar_swc_val_CM_ACU_2_LateralAcceleration_49_dt 0 0 -3.4E+38 3.4E+38 ECU_ADDRESS 0xfe4ca45c /* @ECU_Address@SwcIn_ACU_2.ACU_2_LateralAcceleration@ */ /end MEASUREMENT
/begin MEASUREMENT SwcIn_ACU_2.ACU_2_LateralAccelerationSigVD "" UBYTE autosar_swc_val_CM_ACU_2_LateralAccelerationSigVD_49_dt 0 0 0 255 ECU_ADDRESS 0xfe4ca466 /* @ECU_Address@SwcIn_ACU_2.ACU_2_LateralAccelerationSigVD@ */ /end MEASUREMENT
/begin MEASUREMENT SwcIn_ACU_2.ACU_2_Resd1 "" UBYTE autosar_swc_val_CM_ACU_2_Resd1_49_dt 0 0 0 255 ECU_ADDRESS 0xfe4ca45a /* @ECU_Address@SwcIn_ACU_2.ACU_2_Resd1@ */ /end MEASUREMENT
/begin MEASUREMENT SwcIn_ACU_2.ACU_2_RollgCntr1 "" UBYTE autosar_swc_val_CM_ACU_2_RollgCntr1_49_dt 0 0 0 255 ECU_ADDRESS 0xfe4ca459 /* @ECU_Address@SwcIn_ACU_2.ACU_2_RollgCntr1@ */ /end MEASUREMENT
/begin MEASUREMENT SwcIn_ACU_2.ACU_2_YASCalibrationSts "" UBYTE autosar_swc_val_CM_ACU_2_YASCalibrationSts_49_dt 0 0 0 255 ECU_ADDRESS 0xfe4ca464 /* @ECU_Address@SwcIn_ACU_2.ACU_2_YASCalibrationSts@ */ /end MEASUREMENT
/begin MEASUREMENT SwcIn_ACU_2.ACU_2_YawRate "" FLOAT32_IEEE autosar_swc_val_CM_ACU_2_YawRate_49_dt 0 0 -3.4E+38 3.4E+38 ECU_ADDRESS 0xfe4ca460 /* @ECU_Address@SwcIn_ACU_2.ACU_2_YawRate@ */ /end MEASUREMENT
/begin MEASUREMENT SwcIn_ACU_2.ACU_2_YawrateSigValidData "" UBYTE autosar_swc_val_CM_ACU_2_YawrateSigValidData_49_dt 0 0 0 255 ECU_ADDRESS 0xfe4ca465 /* @ECU_Address@SwcIn_ACU_2.ACU_2_YawrateSigValidData@ */ /end MEASUREMENT
/begin MEASUREMENT SwcIn_ACU_3.ACU_3_CRC1 "" UBYTE autosar_swc_val_CM_ACU_3_CRC1_33_dt 0 0 0 255 ECU_ADDRESS 0xfe4cc880 /* @ECU_Address@SwcIn_ACU_3.ACU_3_CRC1@ */ /end MEASUREMENT
/begin MEASUREMENT SwcIn_ACU_3.ACU_3_CrashOutputSts "" UBYTE autosar_swc_val_CM_ACU_3_CrashOutputSts_33_dt 0 0 0 255 ECU_ADDRESS 0xfe4cc889 /* @ECU_Address@SwcIn_ACU_3.ACU_3_CrashOutputSts@ */ /end MEASUREMENT
/begin MEASUREMENT SwcIn_ACU_3.ACU_3_LongitudinalAcceleration "" FLOAT32_IEEE autosar_swc_val_CM_ACU_3_LongitudinalAcceleration_33_dt 0 0 -3.4E+38 3.4E+38 ECU_ADDRESS 0xfe4cc884 /* @ECU_Address@SwcIn_ACU_3.ACU_3_LongitudinalAcceleration@ */ /end MEASUREMENT
/begin MEASUREMENT SwcIn_ACU_3.ACU_3_LongitudinalAccelerationVD "" UBYTE autosar_swc_val_CM_ACU_3_LongitudinalAccelerationVD_33_dt 0 0 0 255 ECU_ADDRESS 0xfe4cc888 /* @ECU_Address@SwcIn_ACU_3.ACU_3_LongitudinalAccelerationVD@ */ /end MEASUREMENT
/begin MEASUREMENT SwcIn_ACU_3.ACU_3_Resd1 "" UBYTE autosar_swc_val_CM_ACU_3_Resd1_33_dt 0 0 0 255 ECU_ADDRESS 0xfe4cc882 /* @ECU_Address@SwcIn_ACU_3.ACU_3_Resd1@ */ /end MEASUREMENT
/begin MEASUREMENT SwcIn_ACU_3.ACU_3_RollgCntr1 "" UBYTE autosar_swc_val_CM_ACU_3_RollgCntr1_33_dt 0 0 0 255 ECU_ADDRESS 0xfe4cc881 /* @ECU_Address@SwcIn_ACU_3.ACU_3_RollgCntr1@ */ /end MEASUREMENT
/begin MEASUREMENT SwcIn_ACU_3.ACU_3_SCMRequest "" UBYTE autosar_swc_val_CM_ACU_3_SCMRequest_33_dt 0 0 0 255 ECU_ADDRESS 0xfe4cc88a /* @ECU_Address@SwcIn_ACU_3.ACU_3_SCMRequest@ */ /end MEASUREMENT
/begin COMPU_METHOD autosar_swc_val_CM_ACU_1_CRC1_1180_dt "Q = V" IDENTICAL "%0.6" "" /end COMPU_METHOD
/begin COMPU_METHOD autosar_swc_val_CM_ACU_1_PsngrSeatBeltWarning_1180_dt "Q = V" IDENTICAL "%0.6" "" /end COMPU_METHOD
/begin COMPU_METHOD autosar_swc_val_CM_ACU_1_PsngrSeatOccupiedSts_1180_dt "Q = V" IDENTICAL "%0.6" "" /end COMPU_METHOD
/begin COMPU_METHOD autosar_swc_val_CM_ACU_1_Resd1_1180_dt "Q = V" IDENTICAL "%0.6" "" /end COMPU_METHOD
/begin COMPU_METHOD autosar_swc_val_CM_ACU_1_RollgCntr1_1180_dt "Q = V" IDENTICAL "%0.6" "" /end COMPU_METHOD
/begin COMPU_METHOD autosar_swc_val_CM_ACU_2_CRC1_49_dt "Q = V" IDENTICAL "%0.6" "" /end COMPU_METHOD
/begin COMPU_METHOD autosar_swc_val_CM_ACU_2_LateralAccelerationSigVD_49_dt "Q = V" IDENTICAL "%0.6" "" /end COMPU_METHOD
/begin COMPU_METHOD autosar_swc_val_CM_ACU_2_LateralAcceleration_49_dt "Q = V" IDENTICAL "%8.6" "" /end COMPU_METHOD
/begin COMPU_METHOD autosar_swc_val_CM_ACU_2_Resd1_49_dt "Q = V" IDENTICAL "%0.6" "" /end COMPU_METHOD
/begin COMPU_METHOD autosar_swc_val_CM_ACU_2_RollgCntr1_49_dt "Q = V" IDENTICAL "%0.6" "" /end COMPU_METHOD
/begin COMPU_METHOD autosar_swc_val_CM_ACU_2_YASCalibrationSts_49_dt "Q = V" IDENTICAL "%0.6" "" /end COMPU_METHOD
/begin COMPU_METHOD autosar_swc_val_CM_ACU_2_YawRate_49_dt "Q = V" IDENTICAL "%8.6" "" /end COMPU_METHOD
/begin COMPU_METHOD autosar_swc_val_CM_ACU_2_YawrateSigValidData_49_dt "Q = V" IDENTICAL "%0.6" "" /end COMPU_METHOD
/begin COMPU_METHOD autosar_swc_val_CM_ACU_3_CRC1_33_dt "Q = V" IDENTICAL "%0.6" "" /end COMPU_METHOD
/begin COMPU_METHOD autosar_swc_val_CM_ACU_3_CrashOutputSts_33_dt "Q = V" IDENTICAL "%0.6" "" /end COMPU_METHOD
/begin COMPU_METHOD autosar_swc_val_CM_ACU_3_LongitudinalAccelerationVD_33_dt "Q = V" IDENTICAL "%0.6" "" /end COMPU_METHOD
/begin COMPU_METHOD autosar_swc_val_CM_ACU_3_LongitudinalAcceleration_33_dt "Q = V" IDENTICAL "%8.6" "" /end COMPU_METHOD
/begin COMPU_METHOD autosar_swc_val_CM_ACU_3_Resd1_33_dt "Q = V" IDENTICAL "%0.6" "" /end COMPU_METHOD
/begin COMPU_METHOD autosar_swc_val_CM_ACU_3_RollgCntr1_33_dt "Q = V" IDENTICAL "%0.6" "" /end COMPU_METHOD
/begin COMPU_METHOD autosar_swc_val_CM_ACU_3_SCMRequest_33_dt "Q = V" IDENTICAL "%0.6" "" /end COMPU_METHOD
/begin RECORD_LAYOUT Record_FLOAT32_IEEE FNC_VALUES 1 FLOAT32_IEEE COLUMN_DIR DIRECT /end RECORD_LAYOUT
/begin GROUP SwcIn_ACU_1 ""
 /begin REF_MEASUREMENT SwcIn_ACU_1.ACU_1_CRC1 SwcIn_ACU_1.ACU_1_RollgCntr1 SwcIn_ACU_1.ACU_1_Resd1 SwcIn_ACU_1.ACU_1_PsngrSeatBeltWarning SwcIn_ACU_1.ACU_1_PsngrSeatOccupiedSts /end REF_MEASUREMENT
/end GROUP
/begin GROUP SwcIn_ACU_2 ""
 /begin REF_MEASUREMENT SwcIn_ACU_2.ACU_2_CRC1 SwcIn_ACU_2.ACU_2_RollgCntr1 SwcIn_ACU_2.ACU_2_Resd1 SwcIn_ACU_2.ACU_2_LateralAcceleration SwcIn_ACU_2.ACU_2_YawRate SwcIn_ACU_2.ACU_2_YASCalibrationSts SwcIn_ACU_2.ACU_2_YawrateSigValidData SwcIn_ACU_2.ACU_2_LateralAccelerationSigVD /end REF_MEASUREMENT
/end GROUP
/begin GROUP SwcIn_ACU_3 ""
 /begin REF_MEASUREMENT SwcIn_ACU_3.ACU_3_CRC1 SwcIn_ACU_3.ACU_3_RollgCntr1 SwcIn_ACU_3.ACU_3_Resd1 SwcIn_ACU_3.ACU_3_LongitudinalAcceleration SwcIn_ACU_3.ACU_3_LongitudinalAccelerationVD SwcIn_ACU_3.ACU_3_CrashOutputSts SwcIn_ACU_3.ACU_3_SCMRequest /end REF_MEASUREMENT
/end GROUP
/end MODULE
/end PROJECT
