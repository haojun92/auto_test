ASAP2_VERSION 1 71
/begin PROJECT ProjectName ""
/begin MODULE ModuleName ""
/begin MOD_COMMON "" BYTE_ORDER MSB_LAST ALIGNMENT_BYTE 1 ALIGNMENT_WORD 1 ALIGNMENT_LONG 1 ALIGNMENT_INT64 1 ALIGNMENT_FLOAT16_IEEE 1 ALIGNMENT_FLOAT32_IEEE 1 ALIGNMENT_FLOAT64_IEEE 1 /end MOD_COMMON
/begin RECORD_LAYOUT __FLOAT32_IEEE_S FNC_VALUES 1 FLOAT32_IEEE COLUMN_DIR DIRECT /end RECORD_LAYOUT
/begin RECORD_LAYOUT __FLOAT64_IEEE_S FNC_VALUES 1 FLOAT64_IEEE COLUMN_DIR DIRECT /end RECORD_LAYOUT
/begin RECORD_LAYOUT Record_BOOLEAN FNC_VALUES 1 UBYTE COLUMN_DIR DIRECT /end RECORD_LAYOUT
/begin RECORD_LAYOUT Record_FLOAT32_IEEE FNC_VALUES 1 FLOAT32_IEEE COLUMN_DIR DIRECT /end RECORD_LAYOUT
/begin RECORD_LAYOUT Record_UBYTE FNC_VALUES 1 UBYTE COLUMN_DIR DIRECT /end RECORD_LAYOUT
/begin RECORD_LAYOUT Record_ULONG FNC_VALUES 1 ULONG COLUMN_DIR DIRECT /end RECORD_LAYOUT
/begin RECORD_LAYOUT Record_UWORD FNC_VALUES 1 UWORD COLUMN_DIR DIRECT /end RECORD_LAYOUT
/begin RECORD_LAYOUT Axis_FLOAT32_IEEE AXIS_PTS_X 1 FLOAT32_IEEE INDEX_INCR DIRECT /end RECORD_LAYOUT
/begin RECORD_LAYOUT Record_BOOLEAN FNC_VALUES 1 UBYTE COLUMN_DIR DIRECT /end RECORD_LAYOUT
/begin RECORD_LAYOUT Record_FLOAT32_IEEE FNC_VALUES 1 FLOAT32_IEEE COLUMN_DIR DIRECT /end RECORD_LAYOUT
/begin RECORD_LAYOUT Record_UBYTE FNC_VALUES 1 UBYTE COLUMN_DIR DIRECT /end RECORD_LAYOUT
/begin RECORD_LAYOUT Record_ULONG FNC_VALUES 1 ULONG COLUMN_DIR DIRECT /end RECORD_LAYOUT
/begin RECORD_LAYOUT Record_UWORD FNC_VALUES 1 UWORD COLUMN_DIR DIRECT /end RECORD_LAYOUT
/begin RECORD_LAYOUT Axis_FLOAT32_IEEE AXIS_PTS_X 1 FLOAT32_IEEE INDEX_INCR DIRECT /end RECORD_LAYOUT
/begin RECORD_LAYOUT Record_BOOLEAN FNC_VALUES 1 UBYTE COLUMN_DIR DIRECT /end RECORD_LAYOUT
/begin RECORD_LAYOUT Record_FLOAT32_IEEE FNC_VALUES 1 FLOAT32_IEEE COLUMN_DIR DIRECT /end RECORD_LAYOUT
/begin RECORD_LAYOUT Record_UBYTE FNC_VALUES 1 UBYTE COLUMN_DIR DIRECT /end RECORD_LAYOUT
/begin RECORD_LAYOUT Record_ULONG FNC_VALUES 1 ULONG COLUMN_DIR DIRECT /end RECORD_LAYOUT
/begin CHARACTERISTIC P_ACC_AccelTimeOut "" VALUE 0xfe820e48 /* @ECU_Address@P_ACC_AccelTimeOut@ */ Record_FLOAT32_IEEE 0 autosar_swc_icas_CM_single -3.4E+38 3.4E+38 /end CHARACTERISTIC
/begin CHARACTERISTIC P_ACC_BrkOverhearTimeOut "" VALUE 0xfe820e4c /* @ECU_Address@P_ACC_BrkOverhearTimeOut@ */ Record_FLOAT32_IEEE 0 autosar_swc_icas_CM_single -3.4E+38 3.4E+38 /end CHARACTERISTIC
/begin CHARACTERISTIC P_ACC_BrkOverheatTimeIn "" VALUE 0xfe820e50 /* @ECU_Address@P_ACC_BrkOverheatTimeIn@ */ Record_FLOAT32_IEEE 0 autosar_swc_icas_CM_single -3.4E+38 3.4E+38 /end CHARACTERISTIC
/begin CHARACTERISTIC P_ACC_DecelHazLmpDecelThld "" VALUE 0xfe820e58 /* @ECU_Address@P_ACC_DecelHazLmpDecelThld@ */ Record_FLOAT32_IEEE 0 autosar_swc_icas_CM_single -3.4E+38 3.4E+38 /end CHARACTERISTIC
/begin CHARACTERISTIC P_ACC_DecelHazLmpSpdThld "" VALUE 0xfe820f0c /* @ECU_Address@P_ACC_DecelHazLmpSpdThld@ */ Record_UBYTE 0 autosar_swc_icas_CM_uint8 0 255 /end CHARACTERISTIC
/begin CHARACTERISTIC P_ACC_DriverBrakeOut "" VALUE 0xfe820e60 /* @ECU_Address@P_ACC_DriverBrakeOut@ */ Record_FLOAT32_IEEE 0 autosar_swc_icas_CM_single -3.4E+38 3.4E+38 /end CHARACTERISTIC
/begin CHARACTERISTIC P_ACC_DriverSeatbeltOut "" VALUE 0xfe820e68 /* @ECU_Address@P_ACC_DriverSeatbeltOut@ */ Record_FLOAT32_IEEE 0 autosar_swc_icas_CM_single -3.4E+38 3.4E+38 /end CHARACTERISTIC
/begin CHARACTERISTIC P_ACC_TirePressureTimeOut "" VALUE 0xfe820e70 /* @ECU_Address@P_ACC_TirePressureTimeOut@ */ Record_FLOAT32_IEEE 0 autosar_swc_icas_CM_single -3.4E+38 3.4E+38 /end CHARACTERISTIC
/begin CHARACTERISTIC P_ACC_VDCOut "" VALUE 0xfe820e74 /* @ECU_Address@P_ACC_VDCOut@ */ Record_FLOAT32_IEEE 0 autosar_swc_icas_CM_single -3.4E+38 3.4E+38 /end CHARACTERISTIC
/begin CHARACTERISTIC P_ACC_VehSysRespOut "" VALUE 0xfe820e78 /* @ECU_Address@P_ACC_VehSysRespOut@ */ Record_FLOAT32_IEEE 0 autosar_swc_icas_CM_single -3.4E+38 3.4E+38 /end CHARACTERISTIC
/begin CHARACTERISTIC P_CRUISE_TJALCK_EPSTqVerifyTimeDiff_s "" VALUE 0xfe820e7c /* @ECU_Address@P_CRUISE_TJALCK_EPSTqVerifyTimeDiff_s@ */ Record_FLOAT32_IEEE 0 autosar_swc_icas_CM_single -3.4E+38 3.4E+38 /end CHARACTERISTIC
/begin CHARACTERISTIC P_CRUISE_TJALCK_EPSTqVerifyTimeSame_s "" VALUE 0xfe820e80 /* @ECU_Address@P_CRUISE_TJALCK_EPSTqVerifyTimeSame_s@ */ Record_FLOAT32_IEEE 0 autosar_swc_icas_CM_single -3.4E+38 3.4E+38 /end CHARACTERISTIC
/begin CHARACTERISTIC P_CRUISE_TJALCK_LcEPSTqVerifyTimeDiff_s "" VALUE 0xfe820e84 /* @ECU_Address@P_CRUISE_TJALCK_LcEPSTqVerifyTimeDiff_s@ */ Record_FLOAT32_IEEE 0 autosar_swc_icas_CM_single -3.4E+38 3.4E+38 /end CHARACTERISTIC
/begin CHARACTERISTIC P_CRUISE_TJALCK_LcEPSTqVerifyTimeSame_s "" VALUE 0xfe820e88 /* @ECU_Address@P_CRUISE_TJALCK_LcEPSTqVerifyTimeSame_s@ */ Record_FLOAT32_IEEE 0 autosar_swc_icas_CM_single -3.4E+38 3.4E+38 /end CHARACTERISTIC
/begin CHARACTERISTIC P_CRUISE_TJALCK_OverrideDiffTrq "" CURVE 0xfe820f48 /* @ECU_Address@P_CRUISE_TJALCK_OverrideDiffTrq@ */ Record_FLOAT32_IEEE 0 autosar_swc_icas_CM_single -3.4E+38 3.4E+38
 /begin AXIS_DESCR COM_AXIS NO_INPUT_QUANTITY autosar_swc_icas_CM_single 9 -3.4E+38 3.4E+38 AXIS_PTS_REF P_CRUISE_TJALCK_OverideSPd_kmh /end AXIS_DESCR
/end CHARACTERISTIC
/begin CHARACTERISTIC P_CRUISE_TJALCK_OverrideSameTrq "" CURVE 0xfe820f6c /* @ECU_Address@P_CRUISE_TJALCK_OverrideSameTrq@ */ Record_FLOAT32_IEEE 0 autosar_swc_icas_CM_single -3.4E+38 3.4E+38
 /begin AXIS_DESCR COM_AXIS NO_INPUT_QUANTITY autosar_swc_icas_CM_single 9 -3.4E+38 3.4E+38 AXIS_PTS_REF P_CRUISE_TJALCK_OverideSPd_kmh /end AXIS_DESCR
/end CHARACTERISTIC
/begin CHARACTERISTIC P_CRUISE_TJA_HandsOffLev1TimeCnt_NOA "" VALUE 0xfe820ef4 /* @ECU_Address@P_CRUISE_TJA_HandsOffLev1TimeCnt_NOA@ */ Record_UWORD 0 autosar_swc_icas_CM_uint16 0 65535 /end CHARACTERISTIC
/begin CHARACTERISTIC P_CRUISE_TJA_HandsOffLev2TimeCnt_NOA "" VALUE 0xfe820ef6 /* @ECU_Address@P_CRUISE_TJA_HandsOffLev2TimeCnt_NOA@ */ Record_UWORD 0 autosar_swc_icas_CM_uint16 0 65535 /end CHARACTERISTIC
/begin CHARACTERISTIC P_CRUISE_TJA_HandsOffLev3TimeCnt_NOA "" VALUE 0xfe820ef8 /* @ECU_Address@P_CRUISE_TJA_HandsOffLev3TimeCnt_NOA@ */ Record_UWORD 0 autosar_swc_icas_CM_uint16 0 65535 /end CHARACTERISTIC
/begin CHARACTERISTIC P_ICAS_ACCOverrideToActiveThld "" VALUE 0xfe820ea0 /* @ECU_Address@P_ICAS_ACCOverrideToActiveThld@ */ Record_FLOAT32_IEEE 0 autosar_swc_icas_CM_single -3.4E+38 3.4E+38 /end CHARACTERISTIC
/begin CHARACTERISTIC P_ICAS_ACCStandActive2WaitPedWaitTime "" VALUE 0xfe820ea8 /* @ECU_Address@P_ICAS_ACCStandActive2WaitPedWaitTime@ */ Record_FLOAT32_IEEE 0 autosar_swc_icas_CM_single -3.4E+38 3.4E+38 /end CHARACTERISTIC
/begin CHARACTERISTIC P_ICAS_ACCStandActive2WaitTime "" VALUE 0xfe820f08 /* @ECU_Address@P_ICAS_ACCStandActive2WaitTime@ */ Record_UWORD 0 autosar_swc_icas_CM_uint16 0 65535 /end CHARACTERISTIC
/begin CHARACTERISTIC P_ICAS_ACCStandwait2ActivePedalPos "" VALUE 0xfe820f18 /* @ECU_Address@P_ICAS_ACCStandwait2ActivePedalPos@ */ Record_UBYTE 0 autosar_swc_icas_CM_uint8 0 255 /end CHARACTERISTIC
/begin CHARACTERISTIC P_ICAS_AccPedalRateInhibit "" VALUE 0xfe820eac /* @ECU_Address@P_ICAS_AccPedalRateInhibit@ */ Record_FLOAT32_IEEE 0 autosar_swc_icas_CM_single -3.4E+38 3.4E+38 /end CHARACTERISTIC
/begin CHARACTERISTIC P_ICAS_AccPedalRateThreshold "" VALUE 0xfe820f19 /* @ECU_Address@P_ICAS_AccPedalRateThreshold@ */ Record_UBYTE 0 autosar_swc_icas_CM_uint8 0 255 /end CHARACTERISTIC
/begin CHARACTERISTIC P_ICAS_BrakeOnly2ComfortExitTTC "" VALUE 0xfe820eb0 /* @ECU_Address@P_ICAS_BrakeOnly2ComfortExitTTC@ */ Record_FLOAT32_IEEE 0 autosar_swc_icas_CM_single -3.4E+38 3.4E+38 /end CHARACTERISTIC
/begin CHARACTERISTIC P_ICAS_CoPilotDrvTrqEntry_0to30 "" VALUE 0xfe820eb4 /* @ECU_Address@P_ICAS_CoPilotDrvTrqEntry_0to30@ */ Record_FLOAT32_IEEE 0 autosar_swc_icas_CM_single -3.4E+38 3.4E+38 /end CHARACTERISTIC
/begin CHARACTERISTIC P_ICAS_CoPilotDrvTrqEntry_120to150 "" VALUE 0xfe820eb8 /* @ECU_Address@P_ICAS_CoPilotDrvTrqEntry_120to150@ */ Record_FLOAT32_IEEE 0 autosar_swc_icas_CM_single -3.4E+38 3.4E+38 /end CHARACTERISTIC
/begin CHARACTERISTIC P_ICAS_CoPilotDrvTrqEntry_30to60 "" VALUE 0xfe820ebc /* @ECU_Address@P_ICAS_CoPilotDrvTrqEntry_30to60@ */ Record_FLOAT32_IEEE 0 autosar_swc_icas_CM_single -3.4E+38 3.4E+38 /end CHARACTERISTIC
/begin CHARACTERISTIC P_ICAS_CoPilotDrvTrqEntry_60to90 "" VALUE 0xfe820ec0 /* @ECU_Address@P_ICAS_CoPilotDrvTrqEntry_60to90@ */ Record_FLOAT32_IEEE 0 autosar_swc_icas_CM_single -3.4E+38 3.4E+38 /end CHARACTERISTIC
/begin CHARACTERISTIC P_ICAS_CoPilotDrvTrqEntry_90to120 "" VALUE 0xfe820ec4 /* @ECU_Address@P_ICAS_CoPilotDrvTrqEntry_90to120@ */ Record_FLOAT32_IEEE 0 autosar_swc_icas_CM_single -3.4E+38 3.4E+38 /end CHARACTERISTIC
/begin CHARACTERISTIC P_ICAS_CoPilotDrvTrqExit_0to60 "" VALUE 0xfe820ec8 /* @ECU_Address@P_ICAS_CoPilotDrvTrqExit_0to60@ */ Record_FLOAT32_IEEE 0 autosar_swc_icas_CM_single -3.4E+38 3.4E+38 /end CHARACTERISTIC
/begin CHARACTERISTIC P_ICAS_CoPilotDrvTrqExit_120to150 "" VALUE 0xfe820ecc /* @ECU_Address@P_ICAS_CoPilotDrvTrqExit_120to150@ */ Record_FLOAT32_IEEE 0 autosar_swc_icas_CM_single -3.4E+38 3.4E+38 /end CHARACTERISTIC
/begin CHARACTERISTIC P_ICAS_CoPilotDrvTrqExit_60to90 "" VALUE 0xfe820ed0 /* @ECU_Address@P_ICAS_CoPilotDrvTrqExit_60to90@ */ Record_FLOAT32_IEEE 0 autosar_swc_icas_CM_single -3.4E+38 3.4E+38 /end CHARACTERISTIC
/begin CHARACTERISTIC P_ICAS_CoPilotDrvTrqExit_90to120 "" VALUE 0xfe820ed4 /* @ECU_Address@P_ICAS_CoPilotDrvTrqExit_90to120@ */ Record_FLOAT32_IEEE 0 autosar_swc_icas_CM_single -3.4E+38 3.4E+38 /end CHARACTERISTIC
/begin CHARACTERISTIC P_ICAS_CoPilotEntryDebouceTime "" VALUE 0xfe820f1a /* @ECU_Address@P_ICAS_CoPilotEntryDebouceTime@ */ Record_UBYTE 0 autosar_swc_icas_CM_uint8 0 255 /end CHARACTERISTIC
/begin CHARACTERISTIC P_ICAS_CoPilotExitDebouceTime "" VALUE 0xfe820f1b /* @ECU_Address@P_ICAS_CoPilotExitDebouceTime@ */ Record_UBYTE 0 autosar_swc_icas_CM_uint8 0 255 /end CHARACTERISTIC
/begin CHARACTERISTIC P_ICAS_DAI_P0ActiveDis "" VALUE 0xfe820ed8 /* @ECU_Address@P_ICAS_DAI_P0ActiveDis@ */ Record_FLOAT32_IEEE 0 autosar_swc_icas_CM_single -3.4E+38 3.4E+38 /end CHARACTERISTIC
/begin CHARACTERISTIC P_ICAS_DAI_P0DriveOffSpd "" VALUE 0xfe820edc /* @ECU_Address@P_ICAS_DAI_P0DriveOffSpd@ */ Record_FLOAT32_IEEE 0 autosar_swc_icas_CM_single -3.4E+38 3.4E+38 /end CHARACTERISTIC
/begin CHARACTERISTIC P_ICAS_DAI_P0StandbyDis "" VALUE 0xfe820ee0 /* @ECU_Address@P_ICAS_DAI_P0StandbyDis@ */ Record_FLOAT32_IEEE 0 autosar_swc_icas_CM_single -3.4E+38 3.4E+38 /end CHARACTERISTIC
/begin CHARACTERISTIC P_ICAS_LCCDriverHandsOffWarning "" VALUE 0xfe820f1d /* @ECU_Address@P_ICAS_LCCDriverHandsOffWarning@ */ Record_BOOLEAN 0 autosar_swc_icas_CM_boolean 0 1 /end CHARACTERISTIC
/begin CHARACTERISTIC P_ICAS_LCCInhibitPedalPosition "" VALUE 0xfe820f1e /* @ECU_Address@P_ICAS_LCCInhibitPedalPosition@ */ Record_UBYTE 0 autosar_swc_icas_CM_uint8 0 255 /end CHARACTERISTIC
/begin CHARACTERISTIC P_ICAS_LCCOverride "" VALUE 0xfe820f1f /* @ECU_Address@P_ICAS_LCCOverride@ */ Record_BOOLEAN 0 autosar_swc_icas_CM_boolean 0 1 /end CHARACTERISTIC
/begin CHARACTERISTIC P_ICAS_LCCOverrideRecoverTime "" VALUE 0xfe820ee4 /* @ECU_Address@P_ICAS_LCCOverrideRecoverTime@ */ Record_FLOAT32_IEEE 0 autosar_swc_icas_CM_single -3.4E+38 3.4E+38 /end CHARACTERISTIC
/begin CHARACTERISTIC P_ICAS_LCCSteerWhlSpdExit "" CURVE 0xfe820fa4 /* @ECU_Address@P_ICAS_LCCSteerWhlSpdExit@ */ Record_FLOAT32_IEEE 0 autosar_swc_icas_CM_single -3.4E+38 3.4E+38
 /begin AXIS_DESCR COM_AXIS autosar_swc_icas_rtARID_DEF.TmpSignalConversionAtVAL_VEHICLE_STATEOutport1 autosar_swc_icas_CM_single 5 -3.4E+38 3.4E+38 AXIS_PTS_REF P_ICAS_LCCSteerWhlSpdExit_Speed /end AXIS_DESCR
/end CHARACTERISTIC
/begin CHARACTERISTIC P_ICAS_LCCSteerWhlSpdExitTime "" VALUE 0xfe820ee8 /* @ECU_Address@P_ICAS_LCCSteerWhlSpdExitTime@ */ Record_FLOAT32_IEEE 0 autosar_swc_icas_CM_single -3.4E+38 3.4E+38 /end CHARACTERISTIC
/begin CHARACTERISTIC P_ICAS_LCCSteerWhlSpdRcvr "" CURVE 0xfe820fcc /* @ECU_Address@P_ICAS_LCCSteerWhlSpdRcvr@ */ Record_FLOAT32_IEEE 0 autosar_swc_icas_CM_single -3.4E+38 3.4E+38
 /begin AXIS_DESCR COM_AXIS autosar_swc_icas_rtARID_DEF.TmpSignalConversionAtVAL_VEHICLE_STATEOutport1 autosar_swc_icas_CM_single 5 -3.4E+38 3.4E+38 AXIS_PTS_REF P_ICAS_LCCSteerWhlSpdRcvr_Speed /end AXIS_DESCR
/end CHARACTERISTIC
/begin CHARACTERISTIC P_ICAS_LCCYawRateExit "" VALUE 0xfe820eec /* @ECU_Address@P_ICAS_LCCYawRateExit@ */ Record_FLOAT32_IEEE 0 autosar_swc_icas_CM_single -3.4E+38 3.4E+38 /end CHARACTERISTIC
/begin CHARACTERISTIC P_ICAS_LcOverrideTrqRatio "" VALUE 0xfe820ef0 /* @ECU_Address@P_ICAS_LcOverrideTrqRatio@ */ Record_FLOAT32_IEEE 0 autosar_swc_icas_CM_single -3.4E+38 3.4E+38 /end CHARACTERISTIC
/begin CHARACTERISTIC P_ICAS_Level3_To_MRM "" VALUE 0xfe820f0a /* @ECU_Address@P_ICAS_Level3_To_MRM@ */ Record_UWORD 0 autosar_swc_icas_CM_uint16 0 65535 /end CHARACTERISTIC
/begin CHARACTERISTIC P_ICAS_TextDebouce "" VALUE 0xfe820f20 /* @ECU_Address@P_ICAS_TextDebouce@ */ Record_UBYTE 0 autosar_swc_icas_CM_uint8 0 255 /end CHARACTERISTIC
/begin MEASUREMENT ICAS_ACC_HazActv "" UBYTE autosar_swc_icas_CM_uint8 0 0 0 255 ECU_ADDRESS 0xfe4adb59 /* @ECU_Address@ICAS_ACC_HazActv@ */ /end MEASUREMENT
/begin MEASUREMENT ICAS_ACC_ModeDisp "" UBYTE autosar_swc_icas_CM_uint8 0 0 0 255 MATRIX_DIM 1 1 ECU_ADDRESS 0xfe4adb5a /* @ECU_Address@ICAS_ACC_ModeDisp@ */ /end MEASUREMENT
/begin MEASUREMENT ICAS_ACC_USS_Drvroffdisp "" UBYTE autosar_swc_icas_CM_uint8 0 0 0 255 MATRIX_DIM 1 1 ECU_ADDRESS 0xfe4adb5c /* @ECU_Address@ICAS_ACC_USS_Drvroffdisp@ */ /end MEASUREMENT
/begin MEASUREMENT ICAS_AEB_HazActv "" UBYTE autosar_swc_icas_CM_uint8 0 0 0 255 MATRIX_DIM 1 1 ECU_ADDRESS 0xfe4adb60 /* @ECU_Address@ICAS_AEB_HazActv@ */ /end MEASUREMENT
/begin MEASUREMENT ICAS_LongHMI_VERSION "" ULONG autosar_swc_icas_CM_uint32 0 0 0 4294967295 MATRIX_DIM 1 1 ECU_ADDRESS 0xfe4ada84 /* @ECU_Address@ICAS_LongHMI_VERSION@ */ /end MEASUREMENT
/begin MEASUREMENT ICAS_TJA_ModeDisp "" UBYTE autosar_swc_icas_CM_uint8 0 0 0 255 MATRIX_DIM 1 1 ECU_ADDRESS 0xfe4adb69 /* @ECU_Address@ICAS_TJA_ModeDisp@ */ /end MEASUREMENT
/begin MEASUREMENT ICAS_longHMI_HazSts "" UBYTE autosar_swc_icas_CM_uint8 0 0 0 255 MATRIX_DIM 1 1 ECU_ADDRESS 0xfe4adb6b /* @ECU_Address@ICAS_longHMI_HazSts@ */ /end MEASUREMENT
/begin MEASUREMENT ICAS_longHMI_HazSwSts "" UBYTE autosar_swc_icas_CM_boolean 0 0 0 1 MATRIX_DIM 1 1 ECU_ADDRESS 0xfe4adb6c /* @ECU_Address@ICAS_longHMI_HazSwSts@ */ /end MEASUREMENT
/begin MEASUREMENT ICAS_reserve03 "" FLOAT32_IEEE autosar_swc_icas_CM_single 0 0 -3.4E+38 3.4E+38 ECU_ADDRESS 0xfe4ada9c /* @ECU_Address@ICAS_reserve03@ */ /end MEASUREMENT
/begin MEASUREMENT autosar_swc_icas_rtARID_DEF.Cnt "" ULONG autosar_swc_icas_CM_uint32 0 0 0 4294967295 ECU_ADDRESS 0xfe4ad848 /* @ECU_Address@autosar_swc_icas_rtARID_DEF.Cnt@ */ /end MEASUREMENT
/begin MEASUREMENT autosar_swc_icas_rtARID_DEF.Cnt2 "" ULONG autosar_swc_icas_CM_uint32 0 0 0 4294967295 ECU_ADDRESS 0xfe4ad84c /* @ECU_Address@autosar_swc_icas_rtARID_DEF.Cnt2@ */ /end MEASUREMENT
/begin MEASUREMENT autosar_swc_icas_rtARID_DEF.Cnt_b "" UBYTE autosar_swc_icas_CM_uint8 0 0 0 255 ECU_ADDRESS 0xfe4ad972 /* @ECU_Address@autosar_swc_icas_rtARID_DEF.Cnt_b@ */ /end MEASUREMENT
/begin MEASUREMENT autosar_swc_icas_rtARID_DEF.Comfort_exitCnt "" UBYTE autosar_swc_icas_CM_uint8 0 0 0 255 ECU_ADDRESS 0xfe4ad98d /* @ECU_Address@autosar_swc_icas_rtARID_DEF.Comfort_exitCnt@ */ /end MEASUREMENT
/begin MEASUREMENT autosar_swc_icas_rtARID_DEF.DelayInput1_DSTATE "" ULONG autosar_swc_icas_CM_uint32 0 0 0 4294967295 ECU_ADDRESS 0xfe4ad820 /* @ECU_Address@autosar_swc_icas_rtARID_DEF.DelayInput1_DSTATE@ */ /end MEASUREMENT
/begin MEASUREMENT autosar_swc_icas_rtARID_DEF.DelayInput1_DSTATE_as "" UBYTE autosar_swc_icas_CM_logical 0 0 0 1 ECU_ADDRESS 0xfe4ada53 /* @ECU_Address@autosar_swc_icas_rtARID_DEF.DelayInput1_DSTATE_as@ */ /end MEASUREMENT
/begin MEASUREMENT autosar_swc_icas_rtARID_DEF.DelayInput1_DSTATE_b "" ULONG autosar_swc_icas_CM_uint32 0 0 0 4294967295 ECU_ADDRESS 0xfe4ad82c /* @ECU_Address@autosar_swc_icas_rtARID_DEF.DelayInput1_DSTATE_b@ */ /end MEASUREMENT
/begin MEASUREMENT autosar_swc_icas_rtARID_DEF.DelayInput1_DSTATE_ba "" UBYTE autosar_swc_icas_CM_logical 0 0 0 1 ECU_ADDRESS 0xfe4ada4a /* @ECU_Address@autosar_swc_icas_rtARID_DEF.DelayInput1_DSTATE_ba@ */ /end MEASUREMENT
/begin MEASUREMENT autosar_swc_icas_rtARID_DEF.DelayInput1_DSTATE_bc "" UBYTE autosar_swc_icas_CM_logical 0 0 0 1 ECU_ADDRESS 0xfe4ada4c /* @ECU_Address@autosar_swc_icas_rtARID_DEF.DelayInput1_DSTATE_bc@ */ /end MEASUREMENT
/begin MEASUREMENT autosar_swc_icas_rtARID_DEF.DelayInput1_DSTATE_bw "" UBYTE autosar_swc_icas_CM_logical 0 0 0 1 ECU_ADDRESS 0xfe4ada35 /* @ECU_Address@autosar_swc_icas_rtARID_DEF.DelayInput1_DSTATE_bw@ */ /end MEASUREMENT
/begin MEASUREMENT autosar_swc_icas_rtARID_DEF.DelayInput1_DSTATE_c "" ULONG autosar_swc_icas_CM_uint32 0 0 0 4294967295 ECU_ADDRESS 0xfe4ad828 /* @ECU_Address@autosar_swc_icas_rtARID_DEF.DelayInput1_DSTATE_c@ */ /end MEASUREMENT
/begin MEASUREMENT autosar_swc_icas_rtARID_DEF.DelayInput1_DSTATE_d "" UBYTE autosar_swc_icas_CM_logical 0 0 0 1 ECU_ADDRESS 0xfe4ada4d /* @ECU_Address@autosar_swc_icas_rtARID_DEF.DelayInput1_DSTATE_d@ */ /end MEASUREMENT
/begin MEASUREMENT autosar_swc_icas_rtARID_DEF.DelayInput1_DSTATE_dx "" UBYTE autosar_swc_icas_CM_logical 0 0 0 1 ECU_ADDRESS 0xfe4ada4f /* @ECU_Address@autosar_swc_icas_rtARID_DEF.DelayInput1_DSTATE_dx@ */ /end MEASUREMENT
/begin MEASUREMENT autosar_swc_icas_rtARID_DEF.DelayInput1_DSTATE_ej "" UBYTE autosar_swc_icas_CM_logical 0 0 0 1 ECU_ADDRESS 0xfe4ad9eb /* @ECU_Address@autosar_swc_icas_rtARID_DEF.DelayInput1_DSTATE_ej@ */ /end MEASUREMENT
/begin MEASUREMENT autosar_swc_icas_rtARID_DEF.DelayInput1_DSTATE_fn "" UBYTE autosar_swc_icas_CM_logical 0 0 0 1 ECU_ADDRESS 0xfe4ada4b /* @ECU_Address@autosar_swc_icas_rtARID_DEF.DelayInput1_DSTATE_fn@ */ /end MEASUREMENT
/begin MEASUREMENT autosar_swc_icas_rtARID_DEF.DelayInput1_DSTATE_g "" ULONG autosar_swc_icas_CM_uint32 0 0 0 4294967295 ECU_ADDRESS 0xfe4ad834 /* @ECU_Address@autosar_swc_icas_rtARID_DEF.DelayInput1_DSTATE_g@ */ /end MEASUREMENT
/begin MEASUREMENT autosar_swc_icas_rtARID_DEF.DelayInput1_DSTATE_h "" UBYTE autosar_swc_icas_CM_logical 0 0 0 1 ECU_ADDRESS 0xfe4ada0c /* @ECU_Address@autosar_swc_icas_rtARID_DEF.DelayInput1_DSTATE_h@ */ /end MEASUREMENT
/begin MEASUREMENT autosar_swc_icas_rtARID_DEF.DelayInput1_DSTATE_i "" UBYTE autosar_swc_icas_CM_logical 0 0 0 1 ECU_ADDRESS 0xfe4ada56 /* @ECU_Address@autosar_swc_icas_rtARID_DEF.DelayInput1_DSTATE_i@ */ /end MEASUREMENT
/begin MEASUREMENT autosar_swc_icas_rtARID_DEF.DelayInput1_DSTATE_j "" ULONG autosar_swc_icas_CM_uint32 0 0 0 4294967295 ECU_ADDRESS 0xfe4ad840 /* @ECU_Address@autosar_swc_icas_rtARID_DEF.DelayInput1_DSTATE_j@ */ /end MEASUREMENT
/begin MEASUREMENT autosar_swc_icas_rtARID_DEF.DelayInput1_DSTATE_jp "" UBYTE autosar_swc_icas_CM_logical 0 0 0 1 ECU_ADDRESS 0xfe4ada59 /* @ECU_Address@autosar_swc_icas_rtARID_DEF.DelayInput1_DSTATE_jp@ */ /end MEASUREMENT
/begin MEASUREMENT autosar_swc_icas_rtARID_DEF.DelayInput1_DSTATE_kb "" UBYTE autosar_swc_icas_CM_logical 0 0 0 1 ECU_ADDRESS 0xfe4ada2a /* @ECU_Address@autosar_swc_icas_rtARID_DEF.DelayInput1_DSTATE_kb@ */ /end MEASUREMENT
/begin MEASUREMENT autosar_swc_icas_rtARID_DEF.DelayInput1_DSTATE_lo "" UBYTE autosar_swc_icas_CM_logical 0 0 0 1 ECU_ADDRESS 0xfe4ada65 /* @ECU_Address@autosar_swc_icas_rtARID_DEF.DelayInput1_DSTATE_lo@ */ /end MEASUREMENT
/begin MEASUREMENT autosar_swc_icas_rtARID_DEF.DelayInput1_DSTATE_lr "" UBYTE autosar_swc_icas_CM_logical 0 0 0 1 ECU_ADDRESS 0xfe4ada66 /* @ECU_Address@autosar_swc_icas_rtARID_DEF.DelayInput1_DSTATE_lr@ */ /end MEASUREMENT
/begin MEASUREMENT autosar_swc_icas_rtARID_DEF.DelayInput1_DSTATE_m "" UBYTE autosar_swc_icas_CM_logical 0 0 0 1 ECU_ADDRESS 0xfe4ada5a /* @ECU_Address@autosar_swc_icas_rtARID_DEF.DelayInput1_DSTATE_m@ */ /end MEASUREMENT
/begin MEASUREMENT autosar_swc_icas_rtARID_DEF.DelayInput1_DSTATE_o "" ULONG autosar_swc_icas_CM_uint32 0 0 0 4294967295 ECU_ADDRESS 0xfe4ad844 /* @ECU_Address@autosar_swc_icas_rtARID_DEF.DelayInput1_DSTATE_o@ */ /end MEASUREMENT
/begin MEASUREMENT autosar_swc_icas_rtARID_DEF.DelayInput1_DSTATE_oi "" UBYTE autosar_swc_icas_CM_logical 0 0 0 1 ECU_ADDRESS 0xfe4ada29 /* @ECU_Address@autosar_swc_icas_rtARID_DEF.DelayInput1_DSTATE_oi@ */ /end MEASUREMENT
/begin MEASUREMENT autosar_swc_icas_rtARID_DEF.DelayInput1_DSTATE_p "" ULONG autosar_swc_icas_CM_uint32 0 0 0 4294967295 ECU_ADDRESS 0xfe4ad838 /* @ECU_Address@autosar_swc_icas_rtARID_DEF.DelayInput1_DSTATE_p@ */ /end MEASUREMENT
/begin MEASUREMENT autosar_swc_icas_rtARID_DEF.DelayInput1_DSTATE_pj "" UBYTE autosar_swc_icas_CM_logical 0 0 0 1 ECU_ADDRESS 0xfe4ada55 /* @ECU_Address@autosar_swc_icas_rtARID_DEF.DelayInput1_DSTATE_pj@ */ /end MEASUREMENT
/begin MEASUREMENT autosar_swc_icas_rtARID_DEF.Delay_DSTATE "" FLOAT32_IEEE autosar_swc_icas_CM_single 0 0 -3.4E+38 3.4E+38 LAYOUT COLUMN_DIR MATRIX_DIM 5 ECU_ADDRESS 0xfe4ad7ec /* @ECU_Address@autosar_swc_icas_rtARID_DEF.Delay_DSTATE@ */ /end MEASUREMENT
/begin MEASUREMENT autosar_swc_icas_rtARID_DEF.HandOn_condition "" UBYTE autosar_swc_icas_CM_logical 0 0 0 1 ECU_ADDRESS 0xfe4ada74 /* @ECU_Address@autosar_swc_icas_rtARID_DEF.HandOn_condition@ */ /end MEASUREMENT
/begin MEASUREMENT autosar_swc_icas_rtARID_DEF.In1 "" UBYTE autosar_swc_icas_CM_logical 0 0 0 1 MATRIX_DIM 1 1 ECU_ADDRESS 0xfe4ad9db /* @ECU_Address@autosar_swc_icas_rtARID_DEF.In1@ */ /end MEASUREMENT
/begin MEASUREMENT autosar_swc_icas_rtARID_DEF.InitCnt "" UBYTE autosar_swc_icas_CM_uint8 0 0 0 255 ECU_ADDRESS 0xfe4ad98f /* @ECU_Address@autosar_swc_icas_rtARID_DEF.InitCnt@ */ /end MEASUREMENT
/begin MEASUREMENT autosar_swc_icas_rtARID_DEF.TmpSignalConversionAtVAL_VEHICLE_STATEOutport1.BlindTemp "" UBYTE autosar_swc_icas_CM_logical 0 0 0 1 ECU_ADDRESS 0xfe4ad6c6 /* @ECU_Address@autosar_swc_icas_rtARID_DEF.TmpSignalConversionAtVAL_VEHICLE_STATEOutport1.BlindTemp@ */ /end MEASUREMENT
/begin MEASUREMENT autosar_swc_icas_rtARID_DEF.TmpSignalConversionAtVAL_VEHICLE_STATEOutport1.CurrentGear "" UBYTE autosar_swc_icas_CM_uint8 0 0 0 255 ECU_ADDRESS 0xfe4ad6c8 /* @ECU_Address@autosar_swc_icas_rtARID_DEF.TmpSignalConversionAtVAL_VEHICLE_STATEOutport1.CurrentGear@ */ /end MEASUREMENT
/begin MEASUREMENT autosar_swc_icas_rtARID_DEF.TmpSignalConversionAtVAL_VEHICLE_STATEOutport1.EngSpd "" FLOAT32_IEEE autosar_swc_icas_CM_single 0 0 -3.4E+38 3.4E+38 ECU_ADDRESS 0xfe4ad710 /* @ECU_Address@autosar_swc_icas_rtARID_DEF.TmpSignalConversionAtVAL_VEHICLE_STATEOutport1.EngSpd@ */ /end MEASUREMENT
/begin MEASUREMENT autosar_swc_icas_rtARID_DEF.TmpSignalConversionAtVAL_VEHICLE_STATEOutport1.EngTrqMinAct "" FLOAT32_IEEE autosar_swc_icas_CM_single 0 0 -3.4E+38 3.4E+38 ECU_ADDRESS 0xfe4ad70c /* @ECU_Address@autosar_swc_icas_rtARID_DEF.TmpSignalConversionAtVAL_VEHICLE_STATEOutport1.EngTrqMinAct@ */ /end MEASUREMENT
/begin MEASUREMENT autosar_swc_icas_rtARID_DEF.TmpSignalConversionAtVAL_VEHICLE_STATEOutport1.EngTrqMinNm "" FLOAT32_IEEE autosar_swc_icas_CM_single 0 0 -3.4E+38 3.4E+38 ECU_ADDRESS 0xfe4ad700 /* @ECU_Address@autosar_swc_icas_rtARID_DEF.TmpSignalConversionAtVAL_VEHICLE_STATEOutport1.EngTrqMinNm@ */ /end MEASUREMENT
/begin MEASUREMENT autosar_swc_icas_rtARID_DEF.TmpSignalConversionAtVAL_VEHICLE_STATEOutport1.EngTrqNm "" FLOAT32_IEEE autosar_swc_icas_CM_single 0 0 -3.4E+38 3.4E+38 ECU_ADDRESS 0xfe4ad6fc /* @ECU_Address@autosar_swc_icas_rtARID_DEF.TmpSignalConversionAtVAL_VEHICLE_STATEOutport1.EngTrqNm@ */ /end MEASUREMENT
/begin MEASUREMENT autosar_swc_icas_rtARID_DEF.TmpSignalConversionAtVAL_VEHICLE_STATEOutport1.EngineOn "" UBYTE autosar_swc_icas_CM_logical 0 0 0 1 ECU_ADDRESS 0xfe4ad6c1 /* @ECU_Address@autosar_swc_icas_rtARID_DEF.TmpSignalConversionAtVAL_VEHICLE_STATEOutport1.EngineOn@ */ /end MEASUREMENT
/begin MEASUREMENT autosar_swc_icas_rtARID_DEF.TmpSignalConversionAtVAL_VEHICLE_STATEOutport1.FAShiftInProgress "" UBYTE autosar_swc_icas_CM_logical 0 0 0 1 ECU_ADDRESS 0xfe4ad6c2 /* @ECU_Address@autosar_swc_icas_rtARID_DEF.TmpSignalConversionAtVAL_VEHICLE_STATEOutport1.FAShiftInProgress@ */ /end MEASUREMENT
/begin MEASUREMENT autosar_swc_icas_rtARID_DEF.TmpSignalConversionAtVAL_VEHICLE_STATEOutport1.FLWheelPulseCounter "" ULONG autosar_swc_icas_CM_uint32 0 0 0 4294967295 ECU_ADDRESS 0xfe4ad738 /* @ECU_Address@autosar_swc_icas_rtARID_DEF.TmpSignalConversionAtVAL_VEHICLE_STATEOutport1.FLWheelPulseCounter@ */ /end MEASUREMENT
/begin MEASUREMENT autosar_swc_icas_rtARID_DEF.TmpSignalConversionAtVAL_VEHICLE_STATEOutport1.FLWheelSpdMps "" FLOAT32_IEEE autosar_swc_icas_CM_single 0 0 -3.4E+38 3.4E+38 ECU_ADDRESS 0xfe4ad714 /* @ECU_Address@autosar_swc_icas_rtARID_DEF.TmpSignalConversionAtVAL_VEHICLE_STATEOutport1.FLWheelSpdMps@ */ /end MEASUREMENT
/begin MEASUREMENT autosar_swc_icas_rtARID_DEF.TmpSignalConversionAtVAL_VEHICLE_STATEOutport1.FRWheelPulseCounter "" ULONG autosar_swc_icas_CM_uint32 0 0 0 4294967295 ECU_ADDRESS 0xfe4ad73c /* @ECU_Address@autosar_swc_icas_rtARID_DEF.TmpSignalConversionAtVAL_VEHICLE_STATEOutport1.FRWheelPulseCounter@ */ /end MEASUREMENT
/begin MEASUREMENT autosar_swc_icas_rtARID_DEF.TmpSignalConversionAtVAL_VEHICLE_STATEOutport1.FRWheelSpdMps "" FLOAT32_IEEE autosar_swc_icas_CM_single 0 0 -3.4E+38 3.4E+38 ECU_ADDRESS 0xfe4ad718 /* @ECU_Address@autosar_swc_icas_rtARID_DEF.TmpSignalConversionAtVAL_VEHICLE_STATEOutport1.FRWheelSpdMps@ */ /end MEASUREMENT
/begin MEASUREMENT autosar_swc_icas_rtARID_DEF.TmpSignalConversionAtVAL_VEHICLE_STATEOutport1.FourWhlsBrkTrq "" UWORD autosar_swc_icas_CM_uint16 0 0 0 65535 ECU_ADDRESS 0xfe4ad6d2 /* @ECU_Address@autosar_swc_icas_rtARID_DEF.TmpSignalConversionAtVAL_VEHICLE_STATEOutport1.FourWhlsBrkTrq@ */ /end MEASUREMENT
/begin MEASUREMENT autosar_swc_icas_rtARID_DEF.TmpSignalConversionAtVAL_VEHICLE_STATEOutport1.GearSts "" UBYTE autosar_swc_icas_CM_uint8 0 0 0 255 ECU_ADDRESS 0xfe4ad6ca /* @ECU_Address@autosar_swc_icas_rtARID_DEF.TmpSignalConversionAtVAL_VEHICLE_STATEOutport1.GearSts@ */ /end MEASUREMENT
/begin MEASUREMENT autosar_swc_icas_rtARID_DEF.TmpSignalConversionAtVAL_VEHICLE_STATEOutport1.IPVehSpdDispKph "" UWORD autosar_swc_icas_CM_uint16 0 0 0 65535 ECU_ADDRESS 0xfe4ad6ce /* @ECU_Address@autosar_swc_icas_rtARID_DEF.TmpSignalConversionAtVAL_VEHICLE_STATEOutport1.IPVehSpdDispKph@ */ /end MEASUREMENT
/begin MEASUREMENT autosar_swc_icas_rtARID_DEF.TmpSignalConversionAtVAL_VEHICLE_STATEOutport1.IPVehSpdDispKphFloat "" FLOAT32_IEEE autosar_swc_icas_CM_single 0 0 -3.4E+38 3.4E+38 ECU_ADDRESS 0xfe4ad6dc /* @ECU_Address@autosar_swc_icas_rtARID_DEF.TmpSignalConversionAtVAL_VEHICLE_STATEOutport1.IPVehSpdDispKphFloat@ */ /end MEASUREMENT
/begin MEASUREMENT autosar_swc_icas_rtARID_DEF.TmpSignalConversionAtVAL_VEHICLE_STATEOutport1.IPVehSpdDispMph "" UWORD autosar_swc_icas_CM_uint16 0 0 0 65535 ECU_ADDRESS 0xfe4ad6d0 /* @ECU_Address@autosar_swc_icas_rtARID_DEF.TmpSignalConversionAtVAL_VEHICLE_STATEOutport1.IPVehSpdDispMph@ */ /end MEASUREMENT
/begin MEASUREMENT autosar_swc_icas_rtARID_DEF.TmpSignalConversionAtVAL_VEHICLE_STATEOutport1.IPVehSpdUnit "" UBYTE autosar_swc_icas_CM_uint8 0 0 0 255 ECU_ADDRESS 0xfe4ad6cc /* @ECU_Address@autosar_swc_icas_rtARID_DEF.TmpSignalConversionAtVAL_VEHICLE_STATEOutport1.IPVehSpdUnit@ */ /end MEASUREMENT
/begin MEASUREMENT autosar_swc_icas_rtARID_DEF.TmpSignalConversionAtVAL_VEHICLE_STATEOutport1.LKACtrDlvdValue "" FLOAT32_IEEE autosar_swc_icas_CM_single 0 0 -3.4E+38 3.4E+38 ECU_ADDRESS 0xfe4ad704 /* @ECU_Address@autosar_swc_icas_rtARID_DEF.TmpSignalConversionAtVAL_VEHICLE_STATEOutport1.LKACtrDlvdValue@ */ /end MEASUREMENT
/begin MEASUREMENT autosar_swc_icas_rtARID_DEF.TmpSignalConversionAtVAL_VEHICLE_STATEOutport1.MasterCylBrkPress "" FLOAT32_IEEE autosar_swc_icas_CM_single 0 0 -3.4E+38 3.4E+38 ECU_ADDRESS 0xfe4ad6ec /* @ECU_Address@autosar_swc_icas_rtARID_DEF.TmpSignalConversionAtVAL_VEHICLE_STATEOutport1.MasterCylBrkPress@ */ /end MEASUREMENT
/begin MEASUREMENT autosar_swc_icas_rtARID_DEF.TmpSignalConversionAtVAL_VEHICLE_STATEOutport1.MaxEngTrqNorm "" UWORD autosar_swc_icas_CM_uint16 0 0 0 65535 ECU_ADDRESS 0xfe4ad6d4 /* @ECU_Address@autosar_swc_icas_rtARID_DEF.TmpSignalConversionAtVAL_VEHICLE_STATEOutport1.MaxEngTrqNorm@ */ /end MEASUREMENT
/begin MEASUREMENT autosar_swc_icas_rtARID_DEF.TmpSignalConversionAtVAL_VEHICLE_STATEOutport1.NetEngTrq "" FLOAT32_IEEE autosar_swc_icas_CM_single 0 0 -3.4E+38 3.4E+38 ECU_ADDRESS 0xfe4ad708 /* @ECU_Address@autosar_swc_icas_rtARID_DEF.TmpSignalConversionAtVAL_VEHICLE_STATEOutport1.NetEngTrq@ */ /end MEASUREMENT
/begin MEASUREMENT autosar_swc_icas_rtARID_DEF.TmpSignalConversionAtVAL_VEHICLE_STATEOutport1.NoBrakeForce "" UBYTE autosar_swc_icas_CM_logical 0 0 0 1 ECU_ADDRESS 0xfe4ad6c4 /* @ECU_Address@autosar_swc_icas_rtARID_DEF.TmpSignalConversionAtVAL_VEHICLE_STATEOutport1.NoBrakeForce@ */ /end MEASUREMENT
/begin MEASUREMENT autosar_swc_icas_rtARID_DEF.TmpSignalConversionAtVAL_VEHICLE_STATEOutport1.RAShiftInProgress "" UBYTE autosar_swc_icas_CM_logical 0 0 0 1 ECU_ADDRESS 0xfe4ad6c3 /* @ECU_Address@autosar_swc_icas_rtARID_DEF.TmpSignalConversionAtVAL_VEHICLE_STATEOutport1.RAShiftInProgress@ */ /end MEASUREMENT
/begin MEASUREMENT autosar_swc_icas_rtARID_DEF.TmpSignalConversionAtVAL_VEHICLE_STATEOutport1.RLWheelPulseCounter "" ULONG autosar_swc_icas_CM_uint32 0 0 0 4294967295 ECU_ADDRESS 0xfe4ad740 /* @ECU_Address@autosar_swc_icas_rtARID_DEF.TmpSignalConversionAtVAL_VEHICLE_STATEOutport1.RLWheelPulseCounter@ */ /end MEASUREMENT
/begin MEASUREMENT autosar_swc_icas_rtARID_DEF.TmpSignalConversionAtVAL_VEHICLE_STATEOutport1.RLWheelSpdMps "" FLOAT32_IEEE autosar_swc_icas_CM_single 0 0 -3.4E+38 3.4E+38 ECU_ADDRESS 0xfe4ad71c /* @ECU_Address@autosar_swc_icas_rtARID_DEF.TmpSignalConversionAtVAL_VEHICLE_STATEOutport1.RLWheelSpdMps@ */ /end MEASUREMENT
/begin MEASUREMENT autosar_swc_icas_rtARID_DEF.TmpSignalConversionAtVAL_VEHICLE_STATEOutport1.RRWheelPulseCounter "" ULONG autosar_swc_icas_CM_uint32 0 0 0 4294967295 ECU_ADDRESS 0xfe4ad744 /* @ECU_Address@autosar_swc_icas_rtARID_DEF.TmpSignalConversionAtVAL_VEHICLE_STATEOutport1.RRWheelPulseCounter@ */ /end MEASUREMENT
/begin MEASUREMENT autosar_swc_icas_rtARID_DEF.TmpSignalConversionAtVAL_VEHICLE_STATEOutport1.RRWheelSpdMps "" FLOAT32_IEEE autosar_swc_icas_CM_single 0 0 -3.4E+38 3.4E+38 ECU_ADDRESS 0xfe4ad720 /* @ECU_Address@autosar_swc_icas_rtARID_DEF.TmpSignalConversionAtVAL_VEHICLE_STATEOutport1.RRWheelSpdMps@ */ /end MEASUREMENT
/begin MEASUREMENT autosar_swc_icas_rtARID_DEF.TmpSignalConversionAtVAL_VEHICLE_STATEOutport1.SensorVehLatAccelMps2 "" FLOAT32_IEEE autosar_swc_icas_CM_single 0 0 -3.4E+38 3.4E+38 ECU_ADDRESS 0xfe4ad72c /* @ECU_Address@autosar_swc_icas_rtARID_DEF.TmpSignalConversionAtVAL_VEHICLE_STATEOutport1.SensorVehLatAccelMps2@ */ /end MEASUREMENT
/begin MEASUREMENT autosar_swc_icas_rtARID_DEF.TmpSignalConversionAtVAL_VEHICLE_STATEOutport1.SensorVehLonAccelMps2 "" FLOAT32_IEEE autosar_swc_icas_CM_single 0 0 -3.4E+38 3.4E+38 ECU_ADDRESS 0xfe4ad728 /* @ECU_Address@autosar_swc_icas_rtARID_DEF.TmpSignalConversionAtVAL_VEHICLE_STATEOutport1.SensorVehLonAccelMps2@ */ /end MEASUREMENT
/begin MEASUREMENT autosar_swc_icas_rtARID_DEF.TmpSignalConversionAtVAL_VEHICLE_STATEOutport1.SensorVehYawRateRadps "" FLOAT32_IEEE autosar_swc_icas_CM_single 0 0 -3.4E+38 3.4E+38 ECU_ADDRESS 0xfe4ad724 /* @ECU_Address@autosar_swc_icas_rtARID_DEF.TmpSignalConversionAtVAL_VEHICLE_STATEOutport1.SensorVehYawRateRadps@ */ /end MEASUREMENT
/begin MEASUREMENT autosar_swc_icas_rtARID_DEF.TmpSignalConversionAtVAL_VEHICLE_STATEOutport1.SteerWheelAngle "" FLOAT32_IEEE autosar_swc_icas_CM_single 0 0 -3.4E+38 3.4E+38 ECU_ADDRESS 0xfe4ad6e0 /* @ECU_Address@autosar_swc_icas_rtARID_DEF.TmpSignalConversionAtVAL_VEHICLE_STATEOutport1.SteerWheelAngle@ */ /end MEASUREMENT
/begin MEASUREMENT autosar_swc_icas_rtARID_DEF.TmpSignalConversionAtVAL_VEHICLE_STATEOutport1.SteerWheelSpd "" FLOAT32_IEEE autosar_swc_icas_CM_single 0 0 -3.4E+38 3.4E+38 ECU_ADDRESS 0xfe4ad6e4 /* @ECU_Address@autosar_swc_icas_rtARID_DEF.TmpSignalConversionAtVAL_VEHICLE_STATEOutport1.SteerWheelSpd@ */ /end MEASUREMENT
/begin MEASUREMENT autosar_swc_icas_rtARID_DEF.TmpSignalConversionAtVAL_VEHICLE_STATEOutport1.SteerWheelTor "" FLOAT32_IEEE autosar_swc_icas_CM_single 0 0 -3.4E+38 3.4E+38 ECU_ADDRESS 0xfe4ad6e8 /* @ECU_Address@autosar_swc_icas_rtARID_DEF.TmpSignalConversionAtVAL_VEHICLE_STATEOutport1.SteerWheelTor@ */ /end MEASUREMENT
/begin MEASUREMENT autosar_swc_icas_rtARID_DEF.TmpSignalConversionAtVAL_VEHICLE_STATEOutport1.SysPowerMod "" UBYTE autosar_swc_icas_CM_uint8 0 0 0 255 ECU_ADDRESS 0xfe4ad6cb /* @ECU_Address@autosar_swc_icas_rtARID_DEF.TmpSignalConversionAtVAL_VEHICLE_STATEOutport1.SysPowerMod@ */ /end MEASUREMENT
/begin MEASUREMENT autosar_swc_icas_rtARID_DEF.TmpSignalConversionAtVAL_VEHICLE_STATEOutport1.TargetGear "" UBYTE autosar_swc_icas_CM_uint8 0 0 0 255 ECU_ADDRESS 0xfe4ad6c9 /* @ECU_Address@autosar_swc_icas_rtARID_DEF.TmpSignalConversionAtVAL_VEHICLE_STATEOutport1.TargetGear@ */ /end MEASUREMENT
/begin MEASUREMENT autosar_swc_icas_rtARID_DEF.TmpSignalConversionAtVAL_VEHICLE_STATEOutport1.TimeStampMs "" A_UINT64 autosar_swc_icas_CM_uint64 0 0 0 18446744073709551615 ECU_ADDRESS 0xfe4ad748 /* @ECU_Address@autosar_swc_icas_rtARID_DEF.TmpSignalConversionAtVAL_VEHICLE_STATEOutport1.TimeStampMs@ */ /end MEASUREMENT
/begin MEASUREMENT autosar_swc_icas_rtARID_DEF.TmpSignalConversionAtVAL_VEHICLE_STATEOutport1.TotalOdometer_km "" ULONG autosar_swc_icas_CM_uint32 0 0 0 4294967295 ECU_ADDRESS 0xfe4ad734 /* @ECU_Address@autosar_swc_icas_rtARID_DEF.TmpSignalConversionAtVAL_VEHICLE_STATEOutport1.TotalOdometer_km@ */ /end MEASUREMENT
/begin MEASUREMENT autosar_swc_icas_rtARID_DEF.TmpSignalConversionAtVAL_VEHICLE_STATEOutport1.VCUTrqNm "" FLOAT32_IEEE autosar_swc_icas_CM_single 0 0 -3.4E+38 3.4E+38 ECU_ADDRESS 0xfe4ad6f8 /* @ECU_Address@autosar_swc_icas_rtARID_DEF.TmpSignalConversionAtVAL_VEHICLE_STATEOutport1.VCUTrqNm@ */ /end MEASUREMENT
/begin MEASUREMENT autosar_swc_icas_rtARID_DEF.TmpSignalConversionAtVAL_VEHICLE_STATEOutport1.VLC_InternalTargetAcceleration "" FLOAT32_IEEE autosar_swc_icas_CM_single 0 0 -3.4E+38 3.4E+38 ECU_ADDRESS 0xfe4ad730 /* @ECU_Address@autosar_swc_icas_rtARID_DEF.TmpSignalConversionAtVAL_VEHICLE_STATEOutport1.VLC_InternalTargetAcceleration@ */ /end MEASUREMENT
/begin MEASUREMENT autosar_swc_icas_rtARID_DEF.TmpSignalConversionAtVAL_VEHICLE_STATEOutport1.VLC_InternalTargetAccelerationValid "" UBYTE autosar_swc_icas_CM_logical 0 0 0 1 ECU_ADDRESS 0xfe4ad6c5 /* @ECU_Address@autosar_swc_icas_rtARID_DEF.TmpSignalConversionAtVAL_VEHICLE_STATEOutport1.VLC_InternalTargetAccelerationValid@ */ /end MEASUREMENT
/begin MEASUREMENT autosar_swc_icas_rtARID_DEF.TmpSignalConversionAtVAL_VEHICLE_STATEOutport1.VehSpdKph "" FLOAT32_IEEE autosar_swc_icas_CM_single 0 0 -3.4E+38 3.4E+38 ECU_ADDRESS 0xfe4ad6d8 /* @ECU_Address@autosar_swc_icas_rtARID_DEF.TmpSignalConversionAtVAL_VEHICLE_STATEOutport1.VehSpdKph@ */ /end MEASUREMENT
/begin MEASUREMENT autosar_swc_icas_rtARID_DEF.TmpSignalConversionAtVAL_VEHICLE_STATEOutport1.VehStandstill "" UBYTE autosar_swc_icas_CM_logical 0 0 0 1 ECU_ADDRESS 0xfe4ad6c0 /* @ECU_Address@autosar_swc_icas_rtARID_DEF.TmpSignalConversionAtVAL_VEHICLE_STATEOutport1.VehStandstill@ */ /end MEASUREMENT
/begin MEASUREMENT autosar_swc_icas_rtARID_DEF.TmpSignalConversionAtVAL_VEHICLE_STATEOutport1.WheelPulseCounterValid "" UBYTE autosar_swc_icas_CM_logical 0 0 0 1 ECU_ADDRESS 0xfe4ad6c7 /* @ECU_Address@autosar_swc_icas_rtARID_DEF.TmpSignalConversionAtVAL_VEHICLE_STATEOutport1.WheelPulseCounterValid@ */ /end MEASUREMENT
/begin MEASUREMENT autosar_swc_icas_rtARID_DEF.TmpSignalConversionAtVAL_VEHICLE_STATEOutport1.WheelTrqMinNm "" FLOAT32_IEEE autosar_swc_icas_CM_single 0 0 -3.4E+38 3.4E+38 ECU_ADDRESS 0xfe4ad6f4 /* @ECU_Address@autosar_swc_icas_rtARID_DEF.TmpSignalConversionAtVAL_VEHICLE_STATEOutport1.WheelTrqMinNm@ */ /end MEASUREMENT
/begin MEASUREMENT autosar_swc_icas_rtARID_DEF.TmpSignalConversionAtVAL_VEHICLE_STATEOutport1.WheelTrqNm "" FLOAT32_IEEE autosar_swc_icas_CM_single 0 0 -3.4E+38 3.4E+38 ECU_ADDRESS 0xfe4ad6f0 /* @ECU_Address@autosar_swc_icas_rtARID_DEF.TmpSignalConversionAtVAL_VEHICLE_STATEOutport1.WheelTrqNm@ */ /end MEASUREMENT
/begin MEASUREMENT autosar_swc_icas_rtARID_DEF.UnitDelay10_DSTATE "" UBYTE autosar_swc_icas_CM_uint8 0 0 0 255 ECU_ADDRESS 0xfe4ad94d /* @ECU_Address@autosar_swc_icas_rtARID_DEF.UnitDelay10_DSTATE@ */ /end MEASUREMENT
/begin MEASUREMENT autosar_swc_icas_rtARID_DEF.UnitDelay11_DSTATE "" UBYTE autosar_swc_icas_CM_uint8 0 0 0 255 ECU_ADDRESS 0xfe4ad944 /* @ECU_Address@autosar_swc_icas_rtARID_DEF.UnitDelay11_DSTATE@ */ /end MEASUREMENT
/begin MEASUREMENT autosar_swc_icas_rtARID_DEF.UnitDelay12_DSTATE "" UBYTE autosar_swc_icas_CM_uint8 0 0 0 255 ECU_ADDRESS 0xfe4ad951 /* @ECU_Address@autosar_swc_icas_rtARID_DEF.UnitDelay12_DSTATE@ */ /end MEASUREMENT
/begin MEASUREMENT autosar_swc_icas_rtARID_DEF.UnitDelay13_DSTATE "" UBYTE autosar_swc_icas_CM_uint8 0 0 0 255 ECU_ADDRESS 0xfe4ad946 /* @ECU_Address@autosar_swc_icas_rtARID_DEF.UnitDelay13_DSTATE@ */ /end MEASUREMENT
/begin MEASUREMENT autosar_swc_icas_rtARID_DEF.UnitDelay14_DSTATE "" UBYTE autosar_swc_icas_CM_logical 0 0 0 1 ECU_ADDRESS 0xfe4ada54 /* @ECU_Address@autosar_swc_icas_rtARID_DEF.UnitDelay14_DSTATE@ */ /end MEASUREMENT
/begin MEASUREMENT autosar_swc_icas_rtARID_DEF.UnitDelay15_DSTATE "" UBYTE autosar_swc_icas_CM_uint8 0 0 0 255 ECU_ADDRESS 0xfe4ad942 /* @ECU_Address@autosar_swc_icas_rtARID_DEF.UnitDelay15_DSTATE@ */ /end MEASUREMENT
/begin MEASUREMENT autosar_swc_icas_rtARID_DEF.UnitDelay16_DSTATE "" UBYTE autosar_swc_icas_CM_uint8 0 0 0 255 ECU_ADDRESS 0xfe4ad943 /* @ECU_Address@autosar_swc_icas_rtARID_DEF.UnitDelay16_DSTATE@ */ /end MEASUREMENT
/begin MEASUREMENT autosar_swc_icas_rtARID_DEF.UnitDelay17_DSTATE "" UBYTE autosar_swc_icas_CM_uint8 0 0 0 255 ECU_ADDRESS 0xfe4ad94f /* @ECU_Address@autosar_swc_icas_rtARID_DEF.UnitDelay17_DSTATE@ */ /end MEASUREMENT
/begin MEASUREMENT autosar_swc_icas_rtARID_DEF.UnitDelay18_DSTATE "" UBYTE autosar_swc_icas_CM_uint8 0 0 0 255 ECU_ADDRESS 0xfe4ad94b /* @ECU_Address@autosar_swc_icas_rtARID_DEF.UnitDelay18_DSTATE@ */ /end MEASUREMENT
/begin MEASUREMENT autosar_swc_icas_rtARID_DEF.UnitDelay19_DSTATE "" UBYTE autosar_swc_icas_CM_logical 0 0 0 1 ECU_ADDRESS 0xfe4ada52 /* @ECU_Address@autosar_swc_icas_rtARID_DEF.UnitDelay19_DSTATE@ */ /end MEASUREMENT
/begin MEASUREMENT autosar_swc_icas_rtARID_DEF.UnitDelay1_DSTATE "" FLOAT32_IEEE autosar_swc_icas_CM_single 0 0 -3.4E+38 3.4E+38 ECU_ADDRESS 0xfe4ad810 /* @ECU_Address@autosar_swc_icas_rtARID_DEF.UnitDelay1_DSTATE@ */ /end MEASUREMENT
/begin MEASUREMENT autosar_swc_icas_rtARID_DEF.UnitDelay1_DSTATE_a "" UWORD autosar_swc_icas_CM_uint16 0 0 0 65535 ECU_ADDRESS 0xfe4ad876 /* @ECU_Address@autosar_swc_icas_rtARID_DEF.UnitDelay1_DSTATE_a@ */ /end MEASUREMENT
/begin MEASUREMENT autosar_swc_icas_rtARID_DEF.UnitDelay1_DSTATE_ao "" UWORD autosar_swc_icas_CM_uint16 0 0 0 65535 ECU_ADDRESS 0xfe4ad890 /* @ECU_Address@autosar_swc_icas_rtARID_DEF.UnitDelay1_DSTATE_ao@ */ /end MEASUREMENT
/begin MEASUREMENT autosar_swc_icas_rtARID_DEF.UnitDelay1_DSTATE_ayl "" UWORD autosar_swc_icas_CM_uint16 0 0 0 65535 ECU_ADDRESS 0xfe4ad8e6 /* @ECU_Address@autosar_swc_icas_rtARID_DEF.UnitDelay1_DSTATE_ayl@ */ /end MEASUREMENT
/begin MEASUREMENT autosar_swc_icas_rtARID_DEF.UnitDelay1_DSTATE_b "" UWORD autosar_swc_icas_CM_uint16 0 0 0 65535 ECU_ADDRESS 0xfe4ad862 /* @ECU_Address@autosar_swc_icas_rtARID_DEF.UnitDelay1_DSTATE_b@ */ /end MEASUREMENT
/begin MEASUREMENT autosar_swc_icas_rtARID_DEF.UnitDelay1_DSTATE_b1 "" UWORD autosar_swc_icas_CM_uint16 0 0 0 65535 ECU_ADDRESS 0xfe4ad8a2 /* @ECU_Address@autosar_swc_icas_rtARID_DEF.UnitDelay1_DSTATE_b1@ */ /end MEASUREMENT
/begin MEASUREMENT autosar_swc_icas_rtARID_DEF.UnitDelay1_DSTATE_b5 "" UWORD autosar_swc_icas_CM_uint16 0 0 0 65535 ECU_ADDRESS 0xfe4ad87e /* @ECU_Address@autosar_swc_icas_rtARID_DEF.UnitDelay1_DSTATE_b5@ */ /end MEASUREMENT
/begin MEASUREMENT autosar_swc_icas_rtARID_DEF.UnitDelay1_DSTATE_bf "" UWORD autosar_swc_icas_CM_uint16 0 0 0 65535 ECU_ADDRESS 0xfe4ad8dc /* @ECU_Address@autosar_swc_icas_rtARID_DEF.UnitDelay1_DSTATE_bf@ */ /end MEASUREMENT
/begin MEASUREMENT autosar_swc_icas_rtARID_DEF.UnitDelay1_DSTATE_bf0 "" UWORD autosar_swc_icas_CM_uint16 0 0 0 65535 ECU_ADDRESS 0xfe4ad8e8 /* @ECU_Address@autosar_swc_icas_rtARID_DEF.UnitDelay1_DSTATE_bf0@ */ /end MEASUREMENT
/begin MEASUREMENT autosar_swc_icas_rtARID_DEF.UnitDelay1_DSTATE_bh "" UWORD autosar_swc_icas_CM_uint16 0 0 0 65535 ECU_ADDRESS 0xfe4ad86a /* @ECU_Address@autosar_swc_icas_rtARID_DEF.UnitDelay1_DSTATE_bh@ */ /end MEASUREMENT
/begin MEASUREMENT autosar_swc_icas_rtARID_DEF.UnitDelay1_DSTATE_bha "" UWORD autosar_swc_icas_CM_uint16 0 0 0 65535 ECU_ADDRESS 0xfe4ad888 /* @ECU_Address@autosar_swc_icas_rtARID_DEF.UnitDelay1_DSTATE_bha@ */ /end MEASUREMENT
/begin MEASUREMENT autosar_swc_icas_rtARID_DEF.UnitDelay1_DSTATE_bj "" UBYTE autosar_swc_icas_CM_logical 0 0 0 1 ECU_ADDRESS 0xfe4ada50 /* @ECU_Address@autosar_swc_icas_rtARID_DEF.UnitDelay1_DSTATE_bj@ */ /end MEASUREMENT
/begin MEASUREMENT autosar_swc_icas_rtARID_DEF.UnitDelay1_DSTATE_bl "" UWORD autosar_swc_icas_CM_uint16 0 0 0 65535 ECU_ADDRESS 0xfe4ad8f2 /* @ECU_Address@autosar_swc_icas_rtARID_DEF.UnitDelay1_DSTATE_bl@ */ /end MEASUREMENT
/begin MEASUREMENT autosar_swc_icas_rtARID_DEF.UnitDelay1_DSTATE_c "" UWORD autosar_swc_icas_CM_uint16 0 0 0 65535 ECU_ADDRESS 0xfe4ad874 /* @ECU_Address@autosar_swc_icas_rtARID_DEF.UnitDelay1_DSTATE_c@ */ /end MEASUREMENT
/begin MEASUREMENT autosar_swc_icas_rtARID_DEF.UnitDelay1_DSTATE_c4 "" UBYTE autosar_swc_icas_CM_logical 0 0 0 1 ECU_ADDRESS 0xfe4ada48 /* @ECU_Address@autosar_swc_icas_rtARID_DEF.UnitDelay1_DSTATE_c4@ */ /end MEASUREMENT
/begin MEASUREMENT autosar_swc_icas_rtARID_DEF.UnitDelay1_DSTATE_cd "" UWORD autosar_swc_icas_CM_uint16 0 0 0 65535 ECU_ADDRESS 0xfe4ad88e /* @ECU_Address@autosar_swc_icas_rtARID_DEF.UnitDelay1_DSTATE_cd@ */ /end MEASUREMENT
/begin MEASUREMENT autosar_swc_icas_rtARID_DEF.UnitDelay1_DSTATE_cdv "" UWORD autosar_swc_icas_CM_uint16 0 0 0 65535 ECU_ADDRESS 0xfe4ad89e /* @ECU_Address@autosar_swc_icas_rtARID_DEF.UnitDelay1_DSTATE_cdv@ */ /end MEASUREMENT
/begin MEASUREMENT autosar_swc_icas_rtARID_DEF.UnitDelay1_DSTATE_ck "" UBYTE autosar_swc_icas_CM_uint8 0 0 0 255 ECU_ADDRESS 0xfe4ad947 /* @ECU_Address@autosar_swc_icas_rtARID_DEF.UnitDelay1_DSTATE_ck@ */ /end MEASUREMENT
/begin MEASUREMENT autosar_swc_icas_rtARID_DEF.UnitDelay1_DSTATE_d "" UWORD autosar_swc_icas_CM_uint16 0 0 0 65535 ECU_ADDRESS 0xfe4ad85c /* @ECU_Address@autosar_swc_icas_rtARID_DEF.UnitDelay1_DSTATE_d@ */ /end MEASUREMENT
/begin MEASUREMENT autosar_swc_icas_rtARID_DEF.UnitDelay1_DSTATE_dg "" UWORD autosar_swc_icas_CM_uint16 0 0 0 65535 ECU_ADDRESS 0xfe4ad866 /* @ECU_Address@autosar_swc_icas_rtARID_DEF.UnitDelay1_DSTATE_dg@ */ /end MEASUREMENT
/begin MEASUREMENT autosar_swc_icas_rtARID_DEF.UnitDelay1_DSTATE_ds "" UWORD autosar_swc_icas_CM_uint16 0 0 0 65535 ECU_ADDRESS 0xfe4ad8a4 /* @ECU_Address@autosar_swc_icas_rtARID_DEF.UnitDelay1_DSTATE_ds@ */ /end MEASUREMENT
/begin MEASUREMENT autosar_swc_icas_rtARID_DEF.UnitDelay1_DSTATE_dy "" UWORD autosar_swc_icas_CM_uint16 0 0 0 65535 ECU_ADDRESS 0xfe4ad8fa /* @ECU_Address@autosar_swc_icas_rtARID_DEF.UnitDelay1_DSTATE_dy@ */ /end MEASUREMENT
/begin MEASUREMENT autosar_swc_icas_rtARID_DEF.UnitDelay1_DSTATE_e "" UWORD autosar_swc_icas_CM_uint16 0 0 0 65535 ECU_ADDRESS 0xfe4ad858 /* @ECU_Address@autosar_swc_icas_rtARID_DEF.UnitDelay1_DSTATE_e@ */ /end MEASUREMENT
/begin MEASUREMENT autosar_swc_icas_rtARID_DEF.UnitDelay1_DSTATE_el "" UWORD autosar_swc_icas_CM_uint16 0 0 0 65535 ECU_ADDRESS 0xfe4ad912 /* @ECU_Address@autosar_swc_icas_rtARID_DEF.UnitDelay1_DSTATE_el@ */ /end MEASUREMENT
/begin MEASUREMENT autosar_swc_icas_rtARID_DEF.UnitDelay1_DSTATE_eo "" UWORD autosar_swc_icas_CM_uint16 0 0 0 65535 ECU_ADDRESS 0xfe4ad85e /* @ECU_Address@autosar_swc_icas_rtARID_DEF.UnitDelay1_DSTATE_eo@ */ /end MEASUREMENT
/begin MEASUREMENT autosar_swc_icas_rtARID_DEF.UnitDelay1_DSTATE_ew "" UWORD autosar_swc_icas_CM_uint16 0 0 0 65535 ECU_ADDRESS 0xfe4ad88a /* @ECU_Address@autosar_swc_icas_rtARID_DEF.UnitDelay1_DSTATE_ew@ */ /end MEASUREMENT
/begin MEASUREMENT autosar_swc_icas_rtARID_DEF.UnitDelay1_DSTATE_ex "" UWORD autosar_swc_icas_CM_uint16 0 0 0 65535 ECU_ADDRESS 0xfe4ad8ee /* @ECU_Address@autosar_swc_icas_rtARID_DEF.UnitDelay1_DSTATE_ex@ */ /end MEASUREMENT
/begin MEASUREMENT autosar_swc_icas_rtARID_DEF.UnitDelay1_DSTATE_ez "" UWORD autosar_swc_icas_CM_uint16 0 0 0 65535 ECU_ADDRESS 0xfe4ad85a /* @ECU_Address@autosar_swc_icas_rtARID_DEF.UnitDelay1_DSTATE_ez@ */ /end MEASUREMENT
/begin MEASUREMENT autosar_swc_icas_rtARID_DEF.UnitDelay1_DSTATE_f "" UWORD autosar_swc_icas_CM_uint16 0 0 0 65535 ECU_ADDRESS 0xfe4ad87a /* @ECU_Address@autosar_swc_icas_rtARID_DEF.UnitDelay1_DSTATE_f@ */ /end MEASUREMENT
/begin MEASUREMENT autosar_swc_icas_rtARID_DEF.UnitDelay1_DSTATE_ft "" UWORD autosar_swc_icas_CM_uint16 0 0 0 65535 ECU_ADDRESS 0xfe4ad87c /* @ECU_Address@autosar_swc_icas_rtARID_DEF.UnitDelay1_DSTATE_ft@ */ /end MEASUREMENT
/begin MEASUREMENT autosar_swc_icas_rtARID_DEF.UnitDelay1_DSTATE_g "" UWORD autosar_swc_icas_CM_uint16 0 0 0 65535 ECU_ADDRESS 0xfe4ad884 /* @ECU_Address@autosar_swc_icas_rtARID_DEF.UnitDelay1_DSTATE_g@ */ /end MEASUREMENT
/begin MEASUREMENT autosar_swc_icas_rtARID_DEF.UnitDelay1_DSTATE_gi "" UWORD autosar_swc_icas_CM_uint16 0 0 0 65535 ECU_ADDRESS 0xfe4ad8de /* @ECU_Address@autosar_swc_icas_rtARID_DEF.UnitDelay1_DSTATE_gi@ */ /end MEASUREMENT
/begin MEASUREMENT autosar_swc_icas_rtARID_DEF.UnitDelay1_DSTATE_gs "" UBYTE autosar_swc_icas_CM_uint8 0 0 0 255 ECU_ADDRESS 0xfe4ad940 /* @ECU_Address@autosar_swc_icas_rtARID_DEF.UnitDelay1_DSTATE_gs@ */ /end MEASUREMENT
/begin MEASUREMENT autosar_swc_icas_rtARID_DEF.UnitDelay1_DSTATE_h "" UWORD autosar_swc_icas_CM_uint16 0 0 0 65535 ECU_ADDRESS 0xfe4ad882 /* @ECU_Address@autosar_swc_icas_rtARID_DEF.UnitDelay1_DSTATE_h@ */ /end MEASUREMENT
/begin MEASUREMENT autosar_swc_icas_rtARID_DEF.UnitDelay1_DSTATE_hn "" UWORD autosar_swc_icas_CM_uint16 0 0 0 65535 ECU_ADDRESS 0xfe4ad8e4 /* @ECU_Address@autosar_swc_icas_rtARID_DEF.UnitDelay1_DSTATE_hn@ */ /end MEASUREMENT
/begin MEASUREMENT autosar_swc_icas_rtARID_DEF.UnitDelay1_DSTATE_hu "" UWORD autosar_swc_icas_CM_uint16 0 0 0 65535 ECU_ADDRESS 0xfe4ad8da /* @ECU_Address@autosar_swc_icas_rtARID_DEF.UnitDelay1_DSTATE_hu@ */ /end MEASUREMENT
/begin MEASUREMENT autosar_swc_icas_rtARID_DEF.UnitDelay1_DSTATE_i "" UWORD autosar_swc_icas_CM_uint16 0 0 0 65535 ECU_ADDRESS 0xfe4ad86c /* @ECU_Address@autosar_swc_icas_rtARID_DEF.UnitDelay1_DSTATE_i@ */ /end MEASUREMENT
/begin MEASUREMENT autosar_swc_icas_rtARID_DEF.UnitDelay1_DSTATE_ic "" UWORD autosar_swc_icas_CM_uint16 0 0 0 65535 ECU_ADDRESS 0xfe4ad8e2 /* @ECU_Address@autosar_swc_icas_rtARID_DEF.UnitDelay1_DSTATE_ic@ */ /end MEASUREMENT
/begin MEASUREMENT autosar_swc_icas_rtARID_DEF.UnitDelay1_DSTATE_ih "" UWORD autosar_swc_icas_CM_uint16 0 0 0 65535 ECU_ADDRESS 0xfe4ad870 /* @ECU_Address@autosar_swc_icas_rtARID_DEF.UnitDelay1_DSTATE_ih@ */ /end MEASUREMENT
/begin MEASUREMENT autosar_swc_icas_rtARID_DEF.UnitDelay1_DSTATE_iq "" UWORD autosar_swc_icas_CM_uint16 0 0 0 65535 ECU_ADDRESS 0xfe4ad8ec /* @ECU_Address@autosar_swc_icas_rtARID_DEF.UnitDelay1_DSTATE_iq@ */ /end MEASUREMENT
/begin MEASUREMENT autosar_swc_icas_rtARID_DEF.UnitDelay1_DSTATE_ir "" UWORD autosar_swc_icas_CM_uint16 0 0 0 65535 ECU_ADDRESS 0xfe4ad8d6 /* @ECU_Address@autosar_swc_icas_rtARID_DEF.UnitDelay1_DSTATE_ir@ */ /end MEASUREMENT
/begin MEASUREMENT autosar_swc_icas_rtARID_DEF.UnitDelay1_DSTATE_ix "" UWORD autosar_swc_icas_CM_uint16 0 0 0 65535 ECU_ADDRESS 0xfe4ad8ce /* @ECU_Address@autosar_swc_icas_rtARID_DEF.UnitDelay1_DSTATE_ix@ */ /end MEASUREMENT
/begin MEASUREMENT autosar_swc_icas_rtARID_DEF.UnitDelay1_DSTATE_j "" UWORD autosar_swc_icas_CM_uint16 0 0 0 65535 ECU_ADDRESS 0xfe4ad868 /* @ECU_Address@autosar_swc_icas_rtARID_DEF.UnitDelay1_DSTATE_j@ */ /end MEASUREMENT
/begin MEASUREMENT autosar_swc_icas_rtARID_DEF.UnitDelay1_DSTATE_k "" UWORD autosar_swc_icas_CM_uint16 0 0 0 65535 ECU_ADDRESS 0xfe4ad852 /* @ECU_Address@autosar_swc_icas_rtARID_DEF.UnitDelay1_DSTATE_k@ */ /end MEASUREMENT
/begin MEASUREMENT autosar_swc_icas_rtARID_DEF.UnitDelay1_DSTATE_ke "" UWORD autosar_swc_icas_CM_uint16 0 0 0 65535 ECU_ADDRESS 0xfe4ad90e /* @ECU_Address@autosar_swc_icas_rtARID_DEF.UnitDelay1_DSTATE_ke@ */ /end MEASUREMENT
/begin MEASUREMENT autosar_swc_icas_rtARID_DEF.UnitDelay1_DSTATE_ks "" UWORD autosar_swc_icas_CM_uint16 0 0 0 65535 ECU_ADDRESS 0xfe4ad860 /* @ECU_Address@autosar_swc_icas_rtARID_DEF.UnitDelay1_DSTATE_ks@ */ /end MEASUREMENT
/begin MEASUREMENT autosar_swc_icas_rtARID_DEF.UnitDelay1_DSTATE_ku "" UWORD autosar_swc_icas_CM_uint16 0 0 0 65535 ECU_ADDRESS 0xfe4ad8d8 /* @ECU_Address@autosar_swc_icas_rtARID_DEF.UnitDelay1_DSTATE_ku@ */ /end MEASUREMENT
/begin MEASUREMENT autosar_swc_icas_rtARID_DEF.UnitDelay1_DSTATE_kv "" UWORD autosar_swc_icas_CM_uint16 0 0 0 65535 ECU_ADDRESS 0xfe4ad8d0 /* @ECU_Address@autosar_swc_icas_rtARID_DEF.UnitDelay1_DSTATE_kv@ */ /end MEASUREMENT
/begin MEASUREMENT autosar_swc_icas_rtARID_DEF.UnitDelay1_DSTATE_kw "" UWORD autosar_swc_icas_CM_uint16 0 0 0 65535 ECU_ADDRESS 0xfe4ad878 /* @ECU_Address@autosar_swc_icas_rtARID_DEF.UnitDelay1_DSTATE_kw@ */ /end MEASUREMENT
/begin MEASUREMENT autosar_swc_icas_rtARID_DEF.UnitDelay1_DSTATE_l5 "" UWORD autosar_swc_icas_CM_uint16 0 0 0 65535 ECU_ADDRESS 0xfe4ad8f6 /* @ECU_Address@autosar_swc_icas_rtARID_DEF.UnitDelay1_DSTATE_l5@ */ /end MEASUREMENT
/begin MEASUREMENT autosar_swc_icas_rtARID_DEF.UnitDelay1_DSTATE_la "" UWORD autosar_swc_icas_CM_uint16 0 0 0 65535 ECU_ADDRESS 0xfe4ad8ea /* @ECU_Address@autosar_swc_icas_rtARID_DEF.UnitDelay1_DSTATE_la@ */ /end MEASUREMENT
/begin MEASUREMENT autosar_swc_icas_rtARID_DEF.UnitDelay1_DSTATE_lg "" UWORD autosar_swc_icas_CM_uint16 0 0 0 65535 ECU_ADDRESS 0xfe4ad8fc /* @ECU_Address@autosar_swc_icas_rtARID_DEF.UnitDelay1_DSTATE_lg@ */ /end MEASUREMENT
/begin MEASUREMENT autosar_swc_icas_rtARID_DEF.UnitDelay1_DSTATE_ln "" UWORD autosar_swc_icas_CM_uint16 0 0 0 65535 ECU_ADDRESS 0xfe4ad8d2 /* @ECU_Address@autosar_swc_icas_rtARID_DEF.UnitDelay1_DSTATE_ln@ */ /end MEASUREMENT
/begin MEASUREMENT autosar_swc_icas_rtARID_DEF.UnitDelay1_DSTATE_m "" UWORD autosar_swc_icas_CM_uint16 0 0 0 65535 ECU_ADDRESS 0xfe4ad854 /* @ECU_Address@autosar_swc_icas_rtARID_DEF.UnitDelay1_DSTATE_m@ */ /end MEASUREMENT
/begin MEASUREMENT autosar_swc_icas_rtARID_DEF.UnitDelay1_DSTATE_ma "" UWORD autosar_swc_icas_CM_uint16 0 0 0 65535 ECU_ADDRESS 0xfe4ad8ca /* @ECU_Address@autosar_swc_icas_rtARID_DEF.UnitDelay1_DSTATE_ma@ */ /end MEASUREMENT
/begin MEASUREMENT autosar_swc_icas_rtARID_DEF.UnitDelay1_DSTATE_mh "" UWORD autosar_swc_icas_CM_uint16 0 0 0 65535 ECU_ADDRESS 0xfe4ad886 /* @ECU_Address@autosar_swc_icas_rtARID_DEF.UnitDelay1_DSTATE_mh@ */ /end MEASUREMENT
/begin MEASUREMENT autosar_swc_icas_rtARID_DEF.UnitDelay1_DSTATE_mha "" UWORD autosar_swc_icas_CM_uint16 0 0 0 65535 ECU_ADDRESS 0xfe4ad8d4 /* @ECU_Address@autosar_swc_icas_rtARID_DEF.UnitDelay1_DSTATE_mha@ */ /end MEASUREMENT
/begin MEASUREMENT autosar_swc_icas_rtARID_DEF.UnitDelay1_DSTATE_mk "" UWORD autosar_swc_icas_CM_uint16 0 0 0 65535 ECU_ADDRESS 0xfe4ad86e /* @ECU_Address@autosar_swc_icas_rtARID_DEF.UnitDelay1_DSTATE_mk@ */ /end MEASUREMENT
/begin MEASUREMENT autosar_swc_icas_rtARID_DEF.UnitDelay1_DSTATE_n "" UWORD autosar_swc_icas_CM_uint16 0 0 0 65535 ECU_ADDRESS 0xfe4ad864 /* @ECU_Address@autosar_swc_icas_rtARID_DEF.UnitDelay1_DSTATE_n@ */ /end MEASUREMENT
/begin MEASUREMENT autosar_swc_icas_rtARID_DEF.UnitDelay1_DSTATE_nk "" UWORD autosar_swc_icas_CM_uint16 0 0 0 65535 ECU_ADDRESS 0xfe4ad910 /* @ECU_Address@autosar_swc_icas_rtARID_DEF.UnitDelay1_DSTATE_nk@ */ /end MEASUREMENT
/begin MEASUREMENT autosar_swc_icas_rtARID_DEF.UnitDelay1_DSTATE_nl "" UWORD autosar_swc_icas_CM_uint16 0 0 0 65535 ECU_ADDRESS 0xfe4ad90a /* @ECU_Address@autosar_swc_icas_rtARID_DEF.UnitDelay1_DSTATE_nl@ */ /end MEASUREMENT
/begin MEASUREMENT autosar_swc_icas_rtARID_DEF.UnitDelay1_DSTATE_nw "" UWORD autosar_swc_icas_CM_uint16 0 0 0 65535 ECU_ADDRESS 0xfe4ad90c /* @ECU_Address@autosar_swc_icas_rtARID_DEF.UnitDelay1_DSTATE_nw@ */ /end MEASUREMENT
/begin MEASUREMENT autosar_swc_icas_rtARID_DEF.UnitDelay1_DSTATE_nx "" UWORD autosar_swc_icas_CM_uint16 0 0 0 65535 ECU_ADDRESS 0xfe4ad8e0 /* @ECU_Address@autosar_swc_icas_rtARID_DEF.UnitDelay1_DSTATE_nx@ */ /end MEASUREMENT
/begin MEASUREMENT autosar_swc_icas_rtARID_DEF.UnitDelay1_DSTATE_o "" UWORD autosar_swc_icas_CM_uint16 0 0 0 65535 ECU_ADDRESS 0xfe4ad856 /* @ECU_Address@autosar_swc_icas_rtARID_DEF.UnitDelay1_DSTATE_o@ */ /end MEASUREMENT
/begin MEASUREMENT autosar_swc_icas_rtARID_DEF.UnitDelay1_DSTATE_ob "" UWORD autosar_swc_icas_CM_uint16 0 0 0 65535 ECU_ADDRESS 0xfe4ad88c /* @ECU_Address@autosar_swc_icas_rtARID_DEF.UnitDelay1_DSTATE_ob@ */ /end MEASUREMENT
/begin MEASUREMENT autosar_swc_icas_rtARID_DEF.UnitDelay1_DSTATE_od "" UWORD autosar_swc_icas_CM_uint16 0 0 0 65535 ECU_ADDRESS 0xfe4ad8f8 /* @ECU_Address@autosar_swc_icas_rtARID_DEF.UnitDelay1_DSTATE_od@ */ /end MEASUREMENT
/begin MEASUREMENT autosar_swc_icas_rtARID_DEF.UnitDelay1_DSTATE_oug "" UWORD autosar_swc_icas_CM_uint16 0 0 0 65535 ECU_ADDRESS 0xfe4ad8f0 /* @ECU_Address@autosar_swc_icas_rtARID_DEF.UnitDelay1_DSTATE_oug@ */ /end MEASUREMENT
/begin MEASUREMENT autosar_swc_icas_rtARID_DEF.UnitDelay1_DSTATE_ov "" UWORD autosar_swc_icas_CM_uint16 0 0 0 65535 ECU_ADDRESS 0xfe4ad872 /* @ECU_Address@autosar_swc_icas_rtARID_DEF.UnitDelay1_DSTATE_ov@ */ /end MEASUREMENT
/begin MEASUREMENT autosar_swc_icas_rtARID_DEF.UnitDelay1_DSTATE_p "" UWORD autosar_swc_icas_CM_uint16 0 0 0 65535 ECU_ADDRESS 0xfe4ad880 /* @ECU_Address@autosar_swc_icas_rtARID_DEF.UnitDelay1_DSTATE_p@ */ /end MEASUREMENT
/begin MEASUREMENT autosar_swc_icas_rtARID_DEF.UnitDelay1_DSTATE_pe "" UWORD autosar_swc_icas_CM_uint16 0 0 0 65535 ECU_ADDRESS 0xfe4ad8f4 /* @ECU_Address@autosar_swc_icas_rtARID_DEF.UnitDelay1_DSTATE_pe@ */ /end MEASUREMENT
/begin MEASUREMENT autosar_swc_icas_rtARID_DEF.UnitDelay1_DSTATE_ph "" UWORD autosar_swc_icas_CM_uint16 0 0 0 65535 ECU_ADDRESS 0xfe4ad8fe /* @ECU_Address@autosar_swc_icas_rtARID_DEF.UnitDelay1_DSTATE_ph@ */ /end MEASUREMENT
/begin MEASUREMENT autosar_swc_icas_rtARID_DEF.UnitDelay1_DSTATE_pi "" UBYTE autosar_swc_icas_CM_uint8 0 0 0 255 ECU_ADDRESS 0xfe4ad955 /* @ECU_Address@autosar_swc_icas_rtARID_DEF.UnitDelay1_DSTATE_pi@ */ /end MEASUREMENT
/begin MEASUREMENT autosar_swc_icas_rtARID_DEF.UnitDelay1_DSTATE_pk "" UWORD autosar_swc_icas_CM_uint16 0 0 0 65535 ECU_ADDRESS 0xfe4ad8cc /* @ECU_Address@autosar_swc_icas_rtARID_DEF.UnitDelay1_DSTATE_pk@ */ /end MEASUREMENT
/begin MEASUREMENT autosar_swc_icas_rtARID_DEF.UnitDelay1_DSTATE_pr "" UWORD autosar_swc_icas_CM_uint16 0 0 0 65535 ECU_ADDRESS 0xfe4ad892 /* @ECU_Address@autosar_swc_icas_rtARID_DEF.UnitDelay1_DSTATE_pr@ */ /end MEASUREMENT
/begin MEASUREMENT autosar_swc_icas_rtARID_DEF.UnitDelay1_DSTATE_py "" UWORD autosar_swc_icas_CM_uint16 0 0 0 65535 ECU_ADDRESS 0xfe4ad8a0 /* @ECU_Address@autosar_swc_icas_rtARID_DEF.UnitDelay1_DSTATE_py@ */ /end MEASUREMENT
/begin MEASUREMENT autosar_swc_icas_rtARID_DEF.UnitDelay20_DSTATE "" UWORD autosar_swc_icas_CM_uint16 0 0 0 65535 ECU_ADDRESS 0xfe4ad900 /* @ECU_Address@autosar_swc_icas_rtARID_DEF.UnitDelay20_DSTATE@ */ /end MEASUREMENT
/begin MEASUREMENT autosar_swc_icas_rtARID_DEF.UnitDelay21_DSTATE "" UBYTE autosar_swc_icas_CM_logical 0 0 0 1 ECU_ADDRESS 0xfe4ada4e /* @ECU_Address@autosar_swc_icas_rtARID_DEF.UnitDelay21_DSTATE@ */ /end MEASUREMENT
/begin MEASUREMENT autosar_swc_icas_rtARID_DEF.UnitDelay22_DSTATE "" UBYTE autosar_swc_icas_CM_uint8 0 0 0 255 ECU_ADDRESS 0xfe4ad949 /* @ECU_Address@autosar_swc_icas_rtARID_DEF.UnitDelay22_DSTATE@ */ /end MEASUREMENT
/begin MEASUREMENT autosar_swc_icas_rtARID_DEF.UnitDelay23_DSTATE "" UBYTE autosar_swc_icas_CM_logical 0 0 0 1 ECU_ADDRESS 0xfe4ada40 /* @ECU_Address@autosar_swc_icas_rtARID_DEF.UnitDelay23_DSTATE@ */ /end MEASUREMENT
/begin MEASUREMENT autosar_swc_icas_rtARID_DEF.UnitDelay2_DSTATE "" FLOAT32_IEEE autosar_swc_icas_CM_single 0 0 -3.4E+38 3.4E+38 ECU_ADDRESS 0xfe4ad804 /* @ECU_Address@autosar_swc_icas_rtARID_DEF.UnitDelay2_DSTATE@ */ /end MEASUREMENT
/begin MEASUREMENT autosar_swc_icas_rtARID_DEF.UnitDelay2_DSTATE_a "" UBYTE autosar_swc_icas_CM_logical 0 0 0 1 ECU_ADDRESS 0xfe4ad9ee /* @ECU_Address@autosar_swc_icas_rtARID_DEF.UnitDelay2_DSTATE_a@ */ /end MEASUREMENT
/begin MEASUREMENT autosar_swc_icas_rtARID_DEF.UnitDelay2_DSTATE_ak "" UBYTE autosar_swc_icas_CM_logical 0 0 0 1 ECU_ADDRESS 0xfe4ad9f8 /* @ECU_Address@autosar_swc_icas_rtARID_DEF.UnitDelay2_DSTATE_ak@ */ /end MEASUREMENT
/begin MEASUREMENT autosar_swc_icas_rtARID_DEF.UnitDelay2_DSTATE_ay "" UBYTE autosar_swc_icas_CM_logical 0 0 0 1 ECU_ADDRESS 0xfe4ad9f1 /* @ECU_Address@autosar_swc_icas_rtARID_DEF.UnitDelay2_DSTATE_ay@ */ /end MEASUREMENT
/begin MEASUREMENT autosar_swc_icas_rtARID_DEF.UnitDelay2_DSTATE_b "" UBYTE autosar_swc_icas_CM_uint8 0 0 0 255 ECU_ADDRESS 0xfe4ad948 /* @ECU_Address@autosar_swc_icas_rtARID_DEF.UnitDelay2_DSTATE_b@ */ /end MEASUREMENT
/begin MEASUREMENT autosar_swc_icas_rtARID_DEF.UnitDelay2_DSTATE_b2 "" UBYTE autosar_swc_icas_CM_logical 0 0 0 1 ECU_ADDRESS 0xfe4ada3e /* @ECU_Address@autosar_swc_icas_rtARID_DEF.UnitDelay2_DSTATE_b2@ */ /end MEASUREMENT
/begin MEASUREMENT autosar_swc_icas_rtARID_DEF.UnitDelay2_DSTATE_bc "" UBYTE autosar_swc_icas_CM_logical 0 0 0 1 ECU_ADDRESS 0xfe4ada16 /* @ECU_Address@autosar_swc_icas_rtARID_DEF.UnitDelay2_DSTATE_bc@ */ /end MEASUREMENT
/begin MEASUREMENT autosar_swc_icas_rtARID_DEF.UnitDelay2_DSTATE_bdx "" UBYTE autosar_swc_icas_CM_logical 0 0 0 1 ECU_ADDRESS 0xfe4ada2c /* @ECU_Address@autosar_swc_icas_rtARID_DEF.UnitDelay2_DSTATE_bdx@ */ /end MEASUREMENT
/begin MEASUREMENT autosar_swc_icas_rtARID_DEF.UnitDelay2_DSTATE_bg "" UBYTE autosar_swc_icas_CM_logical 0 0 0 1 ECU_ADDRESS 0xfe4ad9ed /* @ECU_Address@autosar_swc_icas_rtARID_DEF.UnitDelay2_DSTATE_bg@ */ /end MEASUREMENT
/begin MEASUREMENT autosar_swc_icas_rtARID_DEF.UnitDelay2_DSTATE_bws "" UBYTE autosar_swc_icas_CM_logical 0 0 0 1 ECU_ADDRESS 0xfe4ada60 /* @ECU_Address@autosar_swc_icas_rtARID_DEF.UnitDelay2_DSTATE_bws@ */ /end MEASUREMENT
/begin MEASUREMENT autosar_swc_icas_rtARID_DEF.UnitDelay2_DSTATE_bx "" UBYTE autosar_swc_icas_CM_logical 0 0 0 1 ECU_ADDRESS 0xfe4ad9ef /* @ECU_Address@autosar_swc_icas_rtARID_DEF.UnitDelay2_DSTATE_bx@ */ /end MEASUREMENT
/begin MEASUREMENT autosar_swc_icas_rtARID_DEF.UnitDelay2_DSTATE_c "" ULONG autosar_swc_icas_CM_uint32 0 0 0 4294967295 ECU_ADDRESS 0xfe4ad824 /* @ECU_Address@autosar_swc_icas_rtARID_DEF.UnitDelay2_DSTATE_c@ */ /end MEASUREMENT
/begin MEASUREMENT autosar_swc_icas_rtARID_DEF.UnitDelay2_DSTATE_c1 "" UBYTE autosar_swc_icas_CM_logical 0 0 0 1 ECU_ADDRESS 0xfe4ad9fd /* @ECU_Address@autosar_swc_icas_rtARID_DEF.UnitDelay2_DSTATE_c1@ */ /end MEASUREMENT
/begin MEASUREMENT autosar_swc_icas_rtARID_DEF.UnitDelay2_DSTATE_d "" UBYTE autosar_swc_icas_CM_logical 0 0 0 1 ECU_ADDRESS 0xfe4ada30 /* @ECU_Address@autosar_swc_icas_rtARID_DEF.UnitDelay2_DSTATE_d@ */ /end MEASUREMENT
/begin MEASUREMENT autosar_swc_icas_rtARID_DEF.UnitDelay2_DSTATE_d3 "" UBYTE autosar_swc_icas_CM_logical 0 0 0 1 ECU_ADDRESS 0xfe4ada3f /* @ECU_Address@autosar_swc_icas_rtARID_DEF.UnitDelay2_DSTATE_d3@ */ /end MEASUREMENT
/begin MEASUREMENT autosar_swc_icas_rtARID_DEF.UnitDelay2_DSTATE_e "" ULONG autosar_swc_icas_CM_uint32 0 0 0 4294967295 ECU_ADDRESS 0xfe4ad83c /* @ECU_Address@autosar_swc_icas_rtARID_DEF.UnitDelay2_DSTATE_e@ */ /end MEASUREMENT
/begin MEASUREMENT autosar_swc_icas_rtARID_DEF.UnitDelay2_DSTATE_e3 "" UBYTE autosar_swc_icas_CM_logical 0 0 0 1 ECU_ADDRESS 0xfe4ad9f2 /* @ECU_Address@autosar_swc_icas_rtARID_DEF.UnitDelay2_DSTATE_e3@ */ /end MEASUREMENT
/begin MEASUREMENT autosar_swc_icas_rtARID_DEF.UnitDelay2_DSTATE_e5 "" UBYTE autosar_swc_icas_CM_logical 0 0 0 1 ECU_ADDRESS 0xfe4ada3a /* @ECU_Address@autosar_swc_icas_rtARID_DEF.UnitDelay2_DSTATE_e5@ */ /end MEASUREMENT
/begin MEASUREMENT autosar_swc_icas_rtARID_DEF.UnitDelay2_DSTATE_ef "" UBYTE autosar_swc_icas_CM_logical 0 0 0 1 ECU_ADDRESS 0xfe4ada05 /* @ECU_Address@autosar_swc_icas_rtARID_DEF.UnitDelay2_DSTATE_ef@ */ /end MEASUREMENT
/begin MEASUREMENT autosar_swc_icas_rtARID_DEF.UnitDelay2_DSTATE_eg "" UBYTE autosar_swc_icas_CM_logical 0 0 0 1 ECU_ADDRESS 0xfe4ad9fe /* @ECU_Address@autosar_swc_icas_rtARID_DEF.UnitDelay2_DSTATE_eg@ */ /end MEASUREMENT
/begin MEASUREMENT autosar_swc_icas_rtARID_DEF.UnitDelay2_DSTATE_eh "" UBYTE autosar_swc_icas_CM_logical 0 0 0 1 ECU_ADDRESS 0xfe4ada13 /* @ECU_Address@autosar_swc_icas_rtARID_DEF.UnitDelay2_DSTATE_eh@ */ /end MEASUREMENT
/begin MEASUREMENT autosar_swc_icas_rtARID_DEF.UnitDelay2_DSTATE_ei "" UBYTE autosar_swc_icas_CM_logical 0 0 0 1 ECU_ADDRESS 0xfe4ada63 /* @ECU_Address@autosar_swc_icas_rtARID_DEF.UnitDelay2_DSTATE_ei@ */ /end MEASUREMENT
/begin MEASUREMENT autosar_swc_icas_rtARID_DEF.UnitDelay2_DSTATE_f "" UBYTE autosar_swc_icas_CM_logical 0 0 0 1 ECU_ADDRESS 0xfe4ad9fc /* @ECU_Address@autosar_swc_icas_rtARID_DEF.UnitDelay2_DSTATE_f@ */ /end MEASUREMENT
/begin MEASUREMENT autosar_swc_icas_rtARID_DEF.UnitDelay2_DSTATE_fla "" UBYTE autosar_swc_icas_CM_logical 0 0 0 1 ECU_ADDRESS 0xfe4ada3b /* @ECU_Address@autosar_swc_icas_rtARID_DEF.UnitDelay2_DSTATE_fla@ */ /end MEASUREMENT
/begin MEASUREMENT autosar_swc_icas_rtARID_DEF.UnitDelay2_DSTATE_flg "" UBYTE autosar_swc_icas_CM_logical 0 0 0 1 ECU_ADDRESS 0xfe4ada62 /* @ECU_Address@autosar_swc_icas_rtARID_DEF.UnitDelay2_DSTATE_flg@ */ /end MEASUREMENT
/begin MEASUREMENT autosar_swc_icas_rtARID_DEF.UnitDelay2_DSTATE_fo "" UBYTE autosar_swc_icas_CM_logical 0 0 0 1 ECU_ADDRESS 0xfe4ada3c /* @ECU_Address@autosar_swc_icas_rtARID_DEF.UnitDelay2_DSTATE_fo@ */ /end MEASUREMENT
/begin MEASUREMENT autosar_swc_icas_rtARID_DEF.UnitDelay2_DSTATE_fw "" UBYTE autosar_swc_icas_CM_logical 0 0 0 1 ECU_ADDRESS 0xfe4ada06 /* @ECU_Address@autosar_swc_icas_rtARID_DEF.UnitDelay2_DSTATE_fw@ */ /end MEASUREMENT
/begin MEASUREMENT autosar_swc_icas_rtARID_DEF.UnitDelay2_DSTATE_g "" UBYTE autosar_swc_icas_CM_logical 0 0 0 1 ECU_ADDRESS 0xfe4ad9fb /* @ECU_Address@autosar_swc_icas_rtARID_DEF.UnitDelay2_DSTATE_g@ */ /end MEASUREMENT
/begin MEASUREMENT autosar_swc_icas_rtARID_DEF.UnitDelay2_DSTATE_ge "" UBYTE autosar_swc_icas_CM_logical 0 0 0 1 ECU_ADDRESS 0xfe4ada41 /* @ECU_Address@autosar_swc_icas_rtARID_DEF.UnitDelay2_DSTATE_ge@ */ /end MEASUREMENT
/begin MEASUREMENT autosar_swc_icas_rtARID_DEF.UnitDelay2_DSTATE_h "" UBYTE autosar_swc_icas_CM_uint8 0 0 0 255 ECU_ADDRESS 0xfe4ad93e /* @ECU_Address@autosar_swc_icas_rtARID_DEF.UnitDelay2_DSTATE_h@ */ /end MEASUREMENT
/begin MEASUREMENT autosar_swc_icas_rtARID_DEF.UnitDelay2_DSTATE_he "" UBYTE autosar_swc_icas_CM_logical 0 0 0 1 ECU_ADDRESS 0xfe4ad9ff /* @ECU_Address@autosar_swc_icas_rtARID_DEF.UnitDelay2_DSTATE_he@ */ /end MEASUREMENT
/begin MEASUREMENT autosar_swc_icas_rtARID_DEF.UnitDelay2_DSTATE_hh "" UBYTE autosar_swc_icas_CM_logical 0 0 0 1 ECU_ADDRESS 0xfe4ada36 /* @ECU_Address@autosar_swc_icas_rtARID_DEF.UnitDelay2_DSTATE_hh@ */ /end MEASUREMENT
/begin MEASUREMENT autosar_swc_icas_rtARID_DEF.UnitDelay2_DSTATE_hi "" UBYTE autosar_swc_icas_CM_logical 0 0 0 1 ECU_ADDRESS 0xfe4ada31 /* @ECU_Address@autosar_swc_icas_rtARID_DEF.UnitDelay2_DSTATE_hi@ */ /end MEASUREMENT
/begin MEASUREMENT autosar_swc_icas_rtARID_DEF.UnitDelay2_DSTATE_hi4 "" UBYTE autosar_swc_icas_CM_logical 0 0 0 1 ECU_ADDRESS 0xfe4ada44 /* @ECU_Address@autosar_swc_icas_rtARID_DEF.UnitDelay2_DSTATE_hi4@ */ /end MEASUREMENT
/begin MEASUREMENT autosar_swc_icas_rtARID_DEF.UnitDelay2_DSTATE_ho "" UBYTE autosar_swc_icas_CM_logical 0 0 0 1 ECU_ADDRESS 0xfe4ada32 /* @ECU_Address@autosar_swc_icas_rtARID_DEF.UnitDelay2_DSTATE_ho@ */ /end MEASUREMENT
/begin MEASUREMENT autosar_swc_icas_rtARID_DEF.UnitDelay2_DSTATE_hon "" UBYTE autosar_swc_icas_CM_logical 0 0 0 1 ECU_ADDRESS 0xfe4ada38 /* @ECU_Address@autosar_swc_icas_rtARID_DEF.UnitDelay2_DSTATE_hon@ */ /end MEASUREMENT
/begin MEASUREMENT autosar_swc_icas_rtARID_DEF.UnitDelay2_DSTATE_i "" ULONG autosar_swc_icas_CM_uint32 0 0 0 4294967295 ECU_ADDRESS 0xfe4ad830 /* @ECU_Address@autosar_swc_icas_rtARID_DEF.UnitDelay2_DSTATE_i@ */ /end MEASUREMENT
/begin MEASUREMENT autosar_swc_icas_rtARID_DEF.UnitDelay2_DSTATE_ia "" UBYTE autosar_swc_icas_CM_logical 0 0 0 1 ECU_ADDRESS 0xfe4ada34 /* @ECU_Address@autosar_swc_icas_rtARID_DEF.UnitDelay2_DSTATE_ia@ */ /end MEASUREMENT
/begin MEASUREMENT autosar_swc_icas_rtARID_DEF.UnitDelay2_DSTATE_ib "" UBYTE autosar_swc_icas_CM_logical 0 0 0 1 ECU_ADDRESS 0xfe4ada43 /* @ECU_Address@autosar_swc_icas_rtARID_DEF.UnitDelay2_DSTATE_ib@ */ /end MEASUREMENT
/begin MEASUREMENT autosar_swc_icas_rtARID_DEF.UnitDelay2_DSTATE_if "" UBYTE autosar_swc_icas_CM_logical 0 0 0 1 ECU_ADDRESS 0xfe4ada5d /* @ECU_Address@autosar_swc_icas_rtARID_DEF.UnitDelay2_DSTATE_if@ */ /end MEASUREMENT
/begin MEASUREMENT autosar_swc_icas_rtARID_DEF.UnitDelay2_DSTATE_ik "" UBYTE autosar_swc_icas_CM_logical 0 0 0 1 ECU_ADDRESS 0xfe4ada03 /* @ECU_Address@autosar_swc_icas_rtARID_DEF.UnitDelay2_DSTATE_ik@ */ /end MEASUREMENT
/begin MEASUREMENT autosar_swc_icas_rtARID_DEF.UnitDelay2_DSTATE_il "" UBYTE autosar_swc_icas_CM_logical 0 0 0 1 ECU_ADDRESS 0xfe4ad9ec /* @ECU_Address@autosar_swc_icas_rtARID_DEF.UnitDelay2_DSTATE_il@ */ /end MEASUREMENT
/begin MEASUREMENT autosar_swc_icas_rtARID_DEF.UnitDelay2_DSTATE_iu "" UBYTE autosar_swc_icas_CM_logical 0 0 0 1 ECU_ADDRESS 0xfe4ada61 /* @ECU_Address@autosar_swc_icas_rtARID_DEF.UnitDelay2_DSTATE_iu@ */ /end MEASUREMENT
/begin MEASUREMENT autosar_swc_icas_rtARID_DEF.UnitDelay2_DSTATE_iv "" UBYTE autosar_swc_icas_CM_logical 0 0 0 1 ECU_ADDRESS 0xfe4ad9f9 /* @ECU_Address@autosar_swc_icas_rtARID_DEF.UnitDelay2_DSTATE_iv@ */ /end MEASUREMENT
/begin MEASUREMENT autosar_swc_icas_rtARID_DEF.UnitDelay2_DSTATE_j "" UBYTE autosar_swc_icas_CM_logical 0 0 0 1 ECU_ADDRESS 0xfe4ad9f7 /* @ECU_Address@autosar_swc_icas_rtARID_DEF.UnitDelay2_DSTATE_j@ */ /end MEASUREMENT
/begin MEASUREMENT autosar_swc_icas_rtARID_DEF.UnitDelay2_DSTATE_jn "" UBYTE autosar_swc_icas_CM_logical 0 0 0 1 ECU_ADDRESS 0xfe4ada2f /* @ECU_Address@autosar_swc_icas_rtARID_DEF.UnitDelay2_DSTATE_jn@ */ /end MEASUREMENT
/begin MEASUREMENT autosar_swc_icas_rtARID_DEF.UnitDelay2_DSTATE_jt "" UBYTE autosar_swc_icas_CM_logical 0 0 0 1 ECU_ADDRESS 0xfe4ada14 /* @ECU_Address@autosar_swc_icas_rtARID_DEF.UnitDelay2_DSTATE_jt@ */ /end MEASUREMENT
/begin MEASUREMENT autosar_swc_icas_rtARID_DEF.UnitDelay2_DSTATE_k "" UBYTE autosar_swc_icas_CM_logical 0 0 0 1 ECU_ADDRESS 0xfe4ad9f5 /* @ECU_Address@autosar_swc_icas_rtARID_DEF.UnitDelay2_DSTATE_k@ */ /end MEASUREMENT
/begin MEASUREMENT autosar_swc_icas_rtARID_DEF.UnitDelay2_DSTATE_kb "" UBYTE autosar_swc_icas_CM_logical 0 0 0 1 ECU_ADDRESS 0xfe4ada04 /* @ECU_Address@autosar_swc_icas_rtARID_DEF.UnitDelay2_DSTATE_kb@ */ /end MEASUREMENT
/begin MEASUREMENT autosar_swc_icas_rtARID_DEF.UnitDelay2_DSTATE_ki "" UBYTE autosar_swc_icas_CM_logical 0 0 0 1 ECU_ADDRESS 0xfe4ada46 /* @ECU_Address@autosar_swc_icas_rtARID_DEF.UnitDelay2_DSTATE_ki@ */ /end MEASUREMENT
/begin MEASUREMENT autosar_swc_icas_rtARID_DEF.UnitDelay2_DSTATE_kl "" UBYTE autosar_swc_icas_CM_logical 0 0 0 1 ECU_ADDRESS 0xfe4ada33 /* @ECU_Address@autosar_swc_icas_rtARID_DEF.UnitDelay2_DSTATE_kl@ */ /end MEASUREMENT
/begin MEASUREMENT autosar_swc_icas_rtARID_DEF.UnitDelay2_DSTATE_kq "" UBYTE autosar_swc_icas_CM_logical 0 0 0 1 ECU_ADDRESS 0xfe4ada0a /* @ECU_Address@autosar_swc_icas_rtARID_DEF.UnitDelay2_DSTATE_kq@ */ /end MEASUREMENT
/begin MEASUREMENT autosar_swc_icas_rtARID_DEF.UnitDelay2_DSTATE_kt "" UBYTE autosar_swc_icas_CM_logical 0 0 0 1 ECU_ADDRESS 0xfe4ada64 /* @ECU_Address@autosar_swc_icas_rtARID_DEF.UnitDelay2_DSTATE_kt@ */ /end MEASUREMENT
/begin MEASUREMENT autosar_swc_icas_rtARID_DEF.UnitDelay2_DSTATE_kx "" UBYTE autosar_swc_icas_CM_logical 0 0 0 1 ECU_ADDRESS 0xfe4ada2d /* @ECU_Address@autosar_swc_icas_rtARID_DEF.UnitDelay2_DSTATE_kx@ */ /end MEASUREMENT
/begin MEASUREMENT autosar_swc_icas_rtARID_DEF.UnitDelay2_DSTATE_l "" UBYTE autosar_swc_icas_CM_logical 0 0 0 1 ECU_ADDRESS 0xfe4ad9fa /* @ECU_Address@autosar_swc_icas_rtARID_DEF.UnitDelay2_DSTATE_l@ */ /end MEASUREMENT
/begin MEASUREMENT autosar_swc_icas_rtARID_DEF.UnitDelay2_DSTATE_l2 "" UBYTE autosar_swc_icas_CM_logical 0 0 0 1 ECU_ADDRESS 0xfe4ada47 /* @ECU_Address@autosar_swc_icas_rtARID_DEF.UnitDelay2_DSTATE_l2@ */ /end MEASUREMENT
/begin MEASUREMENT autosar_swc_icas_rtARID_DEF.UnitDelay2_DSTATE_lh "" UBYTE autosar_swc_icas_CM_logical 0 0 0 1 ECU_ADDRESS 0xfe4ada42 /* @ECU_Address@autosar_swc_icas_rtARID_DEF.UnitDelay2_DSTATE_lh@ */ /end MEASUREMENT
/begin MEASUREMENT autosar_swc_icas_rtARID_DEF.UnitDelay2_DSTATE_ll "" UBYTE autosar_swc_icas_CM_logical 0 0 0 1 ECU_ADDRESS 0xfe4ada00 /* @ECU_Address@autosar_swc_icas_rtARID_DEF.UnitDelay2_DSTATE_ll@ */ /end MEASUREMENT
/begin MEASUREMENT autosar_swc_icas_rtARID_DEF.UnitDelay2_DSTATE_lv "" UBYTE autosar_swc_icas_CM_logical 0 0 0 1 ECU_ADDRESS 0xfe4ada15 /* @ECU_Address@autosar_swc_icas_rtARID_DEF.UnitDelay2_DSTATE_lv@ */ /end MEASUREMENT
/begin MEASUREMENT autosar_swc_icas_rtARID_DEF.UnitDelay2_DSTATE_m "" UBYTE autosar_swc_icas_CM_logical 0 0 0 1 ECU_ADDRESS 0xfe4ad9f3 /* @ECU_Address@autosar_swc_icas_rtARID_DEF.UnitDelay2_DSTATE_m@ */ /end MEASUREMENT
/begin MEASUREMENT autosar_swc_icas_rtARID_DEF.UnitDelay2_DSTATE_m0 "" UBYTE autosar_swc_icas_CM_logical 0 0 0 1 ECU_ADDRESS 0xfe4ada37 /* @ECU_Address@autosar_swc_icas_rtARID_DEF.UnitDelay2_DSTATE_m0@ */ /end MEASUREMENT
/begin MEASUREMENT autosar_swc_icas_rtARID_DEF.UnitDelay2_DSTATE_ma "" UBYTE autosar_swc_icas_CM_logical 0 0 0 1 ECU_ADDRESS 0xfe4ada09 /* @ECU_Address@autosar_swc_icas_rtARID_DEF.UnitDelay2_DSTATE_ma@ */ /end MEASUREMENT
/begin MEASUREMENT autosar_swc_icas_rtARID_DEF.UnitDelay2_DSTATE_mw "" UBYTE autosar_swc_icas_CM_logical 0 0 0 1 ECU_ADDRESS 0xfe4ad9f4 /* @ECU_Address@autosar_swc_icas_rtARID_DEF.UnitDelay2_DSTATE_mw@ */ /end MEASUREMENT
/begin MEASUREMENT autosar_swc_icas_rtARID_DEF.UnitDelay2_DSTATE_n "" UBYTE autosar_swc_icas_CM_logical 0 0 0 1 ECU_ADDRESS 0xfe4ad9f6 /* @ECU_Address@autosar_swc_icas_rtARID_DEF.UnitDelay2_DSTATE_n@ */ /end MEASUREMENT
/begin MEASUREMENT autosar_swc_icas_rtARID_DEF.UnitDelay2_DSTATE_n2 "" UBYTE autosar_swc_icas_CM_logical 0 0 0 1 ECU_ADDRESS 0xfe4ada0b /* @ECU_Address@autosar_swc_icas_rtARID_DEF.UnitDelay2_DSTATE_n2@ */ /end MEASUREMENT
/begin MEASUREMENT autosar_swc_icas_rtARID_DEF.UnitDelay2_DSTATE_nh "" UBYTE autosar_swc_icas_CM_logical 0 0 0 1 ECU_ADDRESS 0xfe4ada08 /* @ECU_Address@autosar_swc_icas_rtARID_DEF.UnitDelay2_DSTATE_nh@ */ /end MEASUREMENT
/begin MEASUREMENT autosar_swc_icas_rtARID_DEF.UnitDelay2_DSTATE_nq "" UBYTE autosar_swc_icas_CM_logical 0 0 0 1 ECU_ADDRESS 0xfe4ada0d /* @ECU_Address@autosar_swc_icas_rtARID_DEF.UnitDelay2_DSTATE_nq@ */ /end MEASUREMENT
/begin MEASUREMENT autosar_swc_icas_rtARID_DEF.UnitDelay2_DSTATE_nt "" UBYTE autosar_swc_icas_CM_logical 0 0 0 1 ECU_ADDRESS 0xfe4ada2e /* @ECU_Address@autosar_swc_icas_rtARID_DEF.UnitDelay2_DSTATE_nt@ */ /end MEASUREMENT
/begin MEASUREMENT autosar_swc_icas_rtARID_DEF.UnitDelay2_DSTATE_o "" UBYTE autosar_swc_icas_CM_logical 0 0 0 1 ECU_ADDRESS 0xfe4ad9f0 /* @ECU_Address@autosar_swc_icas_rtARID_DEF.UnitDelay2_DSTATE_o@ */ /end MEASUREMENT
/begin MEASUREMENT autosar_swc_icas_rtARID_DEF.UnitDelay2_DSTATE_oa "" UBYTE autosar_swc_icas_CM_logical 0 0 0 1 ECU_ADDRESS 0xfe4ada39 /* @ECU_Address@autosar_swc_icas_rtARID_DEF.UnitDelay2_DSTATE_oa@ */ /end MEASUREMENT
/begin MEASUREMENT autosar_swc_icas_rtARID_DEF.UnitDelay2_DSTATE_oh "" UBYTE autosar_swc_icas_CM_logical 0 0 0 1 ECU_ADDRESS 0xfe4ada5f /* @ECU_Address@autosar_swc_icas_rtARID_DEF.UnitDelay2_DSTATE_oh@ */ /end MEASUREMENT
/begin MEASUREMENT autosar_swc_icas_rtARID_DEF.UnitDelay2_DSTATE_oj "" UBYTE autosar_swc_icas_CM_logical 0 0 0 1 ECU_ADDRESS 0xfe4ada58 /* @ECU_Address@autosar_swc_icas_rtARID_DEF.UnitDelay2_DSTATE_oj@ */ /end MEASUREMENT
/begin MEASUREMENT autosar_swc_icas_rtARID_DEF.UnitDelay2_DSTATE_or "" UBYTE autosar_swc_icas_CM_logical 0 0 0 1 ECU_ADDRESS 0xfe4ada07 /* @ECU_Address@autosar_swc_icas_rtARID_DEF.UnitDelay2_DSTATE_or@ */ /end MEASUREMENT
/begin MEASUREMENT autosar_swc_icas_rtARID_DEF.UnitDelay2_DSTATE_p2 "" UBYTE autosar_swc_icas_CM_logical 0 0 0 1 ECU_ADDRESS 0xfe4ada02 /* @ECU_Address@autosar_swc_icas_rtARID_DEF.UnitDelay2_DSTATE_p2@ */ /end MEASUREMENT
/begin MEASUREMENT autosar_swc_icas_rtARID_DEF.UnitDelay2_DSTATE_p3 "" UBYTE autosar_swc_icas_CM_logical 0 0 0 1 ECU_ADDRESS 0xfe4ada01 /* @ECU_Address@autosar_swc_icas_rtARID_DEF.UnitDelay2_DSTATE_p3@ */ /end MEASUREMENT
/begin MEASUREMENT autosar_swc_icas_rtARID_DEF.UnitDelay2_DSTATE_pq "" UBYTE autosar_swc_icas_CM_logical 0 0 0 1 ECU_ADDRESS 0xfe4ada3d /* @ECU_Address@autosar_swc_icas_rtARID_DEF.UnitDelay2_DSTATE_pq@ */ /end MEASUREMENT
/begin MEASUREMENT autosar_swc_icas_rtARID_DEF.UnitDelay2_DSTATE_pr "" UBYTE autosar_swc_icas_CM_logical 0 0 0 1 ECU_ADDRESS 0xfe4ada49 /* @ECU_Address@autosar_swc_icas_rtARID_DEF.UnitDelay2_DSTATE_pr@ */ /end MEASUREMENT
/begin MEASUREMENT autosar_swc_icas_rtARID_DEF.UnitDelay2_DSTATE_pw "" UBYTE autosar_swc_icas_CM_logical 0 0 0 1 ECU_ADDRESS 0xfe4ada45 /* @ECU_Address@autosar_swc_icas_rtARID_DEF.UnitDelay2_DSTATE_pw@ */ /end MEASUREMENT
/begin MEASUREMENT autosar_swc_icas_rtARID_DEF.UnitDelay3_DSTATE_b "" UBYTE autosar_swc_icas_CM_logical 0 0 0 1 ECU_ADDRESS 0xfe4ada57 /* @ECU_Address@autosar_swc_icas_rtARID_DEF.UnitDelay3_DSTATE_b@ */ /end MEASUREMENT
/begin MEASUREMENT autosar_swc_icas_rtARID_DEF.UnitDelay3_DSTATE_e "" UBYTE autosar_swc_icas_CM_logical 0 0 0 1 ECU_ADDRESS 0xfe4ada5b /* @ECU_Address@autosar_swc_icas_rtARID_DEF.UnitDelay3_DSTATE_e@ */ /end MEASUREMENT
/begin MEASUREMENT autosar_swc_icas_rtARID_DEF.UnitDelay3_DSTATE_eq "" UBYTE autosar_swc_icas_CM_logical 0 0 0 1 ECU_ADDRESS 0xfe4ada67 /* @ECU_Address@autosar_swc_icas_rtARID_DEF.UnitDelay3_DSTATE_eq@ */ /end MEASUREMENT
/begin MEASUREMENT autosar_swc_icas_rtARID_DEF.UnitDelay3_DSTATE_h "" UBYTE autosar_swc_icas_CM_logical 0 0 0 1 ECU_ADDRESS 0xfe4ada5e /* @ECU_Address@autosar_swc_icas_rtARID_DEF.UnitDelay3_DSTATE_h@ */ /end MEASUREMENT
/begin MEASUREMENT autosar_swc_icas_rtARID_DEF.UnitDelay3_DSTATE_m "" UBYTE autosar_swc_icas_CM_uint8 0 0 0 255 ECU_ADDRESS 0xfe4ad950 /* @ECU_Address@autosar_swc_icas_rtARID_DEF.UnitDelay3_DSTATE_m@ */ /end MEASUREMENT
/begin MEASUREMENT autosar_swc_icas_rtARID_DEF.UnitDelay3_DSTATE_o "" UBYTE autosar_swc_icas_CM_logical 0 0 0 1 ECU_ADDRESS 0xfe4ada5c /* @ECU_Address@autosar_swc_icas_rtARID_DEF.UnitDelay3_DSTATE_o@ */ /end MEASUREMENT
/begin MEASUREMENT autosar_swc_icas_rtARID_DEF.UnitDelay4_DSTATE_b "" UBYTE autosar_swc_icas_CM_uint8 0 0 0 255 ECU_ADDRESS 0xfe4ad94e /* @ECU_Address@autosar_swc_icas_rtARID_DEF.UnitDelay4_DSTATE_b@ */ /end MEASUREMENT
/begin MEASUREMENT autosar_swc_icas_rtARID_DEF.UnitDelay4_DSTATE_g "" UBYTE autosar_swc_icas_CM_uint8 0 0 0 255 ECU_ADDRESS 0xfe4ad953 /* @ECU_Address@autosar_swc_icas_rtARID_DEF.UnitDelay4_DSTATE_g@ */ /end MEASUREMENT
/begin MEASUREMENT autosar_swc_icas_rtARID_DEF.UnitDelay5_DSTATE_f "" UBYTE autosar_swc_icas_CM_uint8 0 0 0 255 ECU_ADDRESS 0xfe4ad945 /* @ECU_Address@autosar_swc_icas_rtARID_DEF.UnitDelay5_DSTATE_f@ */ /end MEASUREMENT
/begin MEASUREMENT autosar_swc_icas_rtARID_DEF.UnitDelay6_DSTATE "" UBYTE autosar_swc_icas_CM_uint8 0 0 0 255 ECU_ADDRESS 0xfe4ad94c /* @ECU_Address@autosar_swc_icas_rtARID_DEF.UnitDelay6_DSTATE@ */ /end MEASUREMENT
/begin MEASUREMENT autosar_swc_icas_rtARID_DEF.UnitDelay7_DSTATE "" UBYTE autosar_swc_icas_CM_uint8 0 0 0 255 ECU_ADDRESS 0xfe4ad94a /* @ECU_Address@autosar_swc_icas_rtARID_DEF.UnitDelay7_DSTATE@ */ /end MEASUREMENT
/begin MEASUREMENT autosar_swc_icas_rtARID_DEF.UnitDelay8_DSTATE "" UBYTE autosar_swc_icas_CM_uint8 0 0 0 255 ECU_ADDRESS 0xfe4ad952 /* @ECU_Address@autosar_swc_icas_rtARID_DEF.UnitDelay8_DSTATE@ */ /end MEASUREMENT
/begin MEASUREMENT autosar_swc_icas_rtARID_DEF.UnitDelay9_DSTATE "" UBYTE autosar_swc_icas_CM_uint8 0 0 0 255 ECU_ADDRESS 0xfe4ad954 /* @ECU_Address@autosar_swc_icas_rtARID_DEF.UnitDelay9_DSTATE@ */ /end MEASUREMENT
/begin MEASUREMENT autosar_swc_icas_rtARID_DEF.UnitDelay_DSTATE "" FLOAT32_IEEE autosar_swc_icas_CM_single 0 0 -3.4E+38 3.4E+38 ECU_ADDRESS 0xfe4ad800 /* @ECU_Address@autosar_swc_icas_rtARID_DEF.UnitDelay_DSTATE@ */ /end MEASUREMENT
/begin MEASUREMENT autosar_swc_icas_rtARID_DEF.UnitDelay_DSTATE_c "" FLOAT32_IEEE autosar_swc_icas_CM_single 0 0 -3.4E+38 3.4E+38 ECU_ADDRESS 0xfe4ad814 /* @ECU_Address@autosar_swc_icas_rtARID_DEF.UnitDelay_DSTATE_c@ */ /end MEASUREMENT
/begin MEASUREMENT autosar_swc_icas_rtARID_DEF.UnitDelay_DSTATE_d "" FLOAT32_IEEE autosar_swc_icas_CM_single 0 0 -3.4E+38 3.4E+38 ECU_ADDRESS 0xfe4ad80c /* @ECU_Address@autosar_swc_icas_rtARID_DEF.UnitDelay_DSTATE_d@ */ /end MEASUREMENT
/begin MEASUREMENT autosar_swc_icas_rtARID_DEF.UnitDelay_DSTATE_dp "" UBYTE autosar_swc_icas_CM_logical 0 0 0 1 ECU_ADDRESS 0xfe4ada51 /* @ECU_Address@autosar_swc_icas_rtARID_DEF.UnitDelay_DSTATE_dp@ */ /end MEASUREMENT
/begin MEASUREMENT autosar_swc_icas_rtARID_DEF.UnitDelay_DSTATE_dt "" UWORD autosar_swc_icas_CM_uint16 0 0 0 65535 ECU_ADDRESS 0xfe4ad908 /* @ECU_Address@autosar_swc_icas_rtARID_DEF.UnitDelay_DSTATE_dt@ */ /end MEASUREMENT
/begin MEASUREMENT autosar_swc_icas_rtARID_DEF.UnitDelay_DSTATE_e "" FLOAT32_IEEE autosar_swc_icas_CM_single 0 0 -3.4E+38 3.4E+38 ECU_ADDRESS 0xfe4ad808 /* @ECU_Address@autosar_swc_icas_rtARID_DEF.UnitDelay_DSTATE_e@ */ /end MEASUREMENT
/begin MEASUREMENT autosar_swc_icas_rtARID_DEF.UnitDelay_DSTATE_eq "" UWORD autosar_swc_icas_CM_uint16 0 0 0 65535 ECU_ADDRESS 0xfe4ad902 /* @ECU_Address@autosar_swc_icas_rtARID_DEF.UnitDelay_DSTATE_eq@ */ /end MEASUREMENT
/begin MEASUREMENT autosar_swc_icas_rtARID_DEF.UnitDelay_DSTATE_g "" UBYTE autosar_swc_icas_CM_logical 0 0 0 1 ECU_ADDRESS 0xfe4ad9ea /* @ECU_Address@autosar_swc_icas_rtARID_DEF.UnitDelay_DSTATE_g@ */ /end MEASUREMENT
/begin MEASUREMENT autosar_swc_icas_rtARID_DEF.UnitDelay_DSTATE_j "" UBYTE autosar_swc_icas_CM_uint8 0 0 0 255 ECU_ADDRESS 0xfe4ad956 /* @ECU_Address@autosar_swc_icas_rtARID_DEF.UnitDelay_DSTATE_j@ */ /end MEASUREMENT
/begin MEASUREMENT autosar_swc_icas_rtARID_DEF.UnitDelay_DSTATE_m "" UWORD autosar_swc_icas_CM_uint16 0 0 0 65535 ECU_ADDRESS 0xfe4ad906 /* @ECU_Address@autosar_swc_icas_rtARID_DEF.UnitDelay_DSTATE_m@ */ /end MEASUREMENT
/begin MEASUREMENT autosar_swc_icas_rtARID_DEF.UnitDelay_DSTATE_mb "" UWORD autosar_swc_icas_CM_uint16 0 0 0 65535 ECU_ADDRESS 0xfe4ad914 /* @ECU_Address@autosar_swc_icas_rtARID_DEF.UnitDelay_DSTATE_mb@ */ /end MEASUREMENT
/begin MEASUREMENT autosar_swc_icas_rtARID_DEF.UnitDelay_DSTATE_mu "" UBYTE autosar_swc_icas_CM_uint8 0 0 0 255 ECU_ADDRESS 0xfe4ad941 /* @ECU_Address@autosar_swc_icas_rtARID_DEF.UnitDelay_DSTATE_mu@ */ /end MEASUREMENT
/begin MEASUREMENT autosar_swc_icas_rtARID_DEF.UnitDelay_DSTATE_p "" UWORD autosar_swc_icas_CM_uint16 0 0 0 65535 ECU_ADDRESS 0xfe4ad904 /* @ECU_Address@autosar_swc_icas_rtARID_DEF.UnitDelay_DSTATE_p@ */ /end MEASUREMENT
/begin MEASUREMENT autosar_swc_icas_rtARID_DEF.brake_onlyCnt "" UBYTE autosar_swc_icas_CM_uint8 0 0 0 255 ECU_ADDRESS 0xfe4ad98e /* @ECU_Address@autosar_swc_icas_rtARID_DEF.brake_onlyCnt@ */ /end MEASUREMENT
/begin MEASUREMENT autosar_swc_icas_rtARID_DEF.buffer "" UBYTE autosar_swc_icas_CM_uint8 0 0 0 255 LAYOUT COLUMN_DIR MATRIX_DIM 3 ECU_ADDRESS 0xfe4ad929 /* @ECU_Address@autosar_swc_icas_rtARID_DEF.buffer@ */ /end MEASUREMENT
/begin MEASUREMENT autosar_swc_icas_rtARID_DEF.cnt_a "" UBYTE autosar_swc_icas_CM_uint8 0 0 0 255 ECU_ADDRESS 0xfe4ad980 /* @ECU_Address@autosar_swc_icas_rtARID_DEF.cnt_a@ */ /end MEASUREMENT
/begin MEASUREMENT autosar_swc_icas_rtARID_DEF.cnt_e "" UBYTE autosar_swc_icas_CM_uint8 0 0 0 255 ECU_ADDRESS 0xfe4ad988 /* @ECU_Address@autosar_swc_icas_rtARID_DEF.cnt_e@ */ /end MEASUREMENT
/begin MEASUREMENT autosar_swc_icas_rtARID_DEF.cnt_k "" UBYTE autosar_swc_icas_CM_uint8 0 0 0 255 ECU_ADDRESS 0xfe4ad983 /* @ECU_Address@autosar_swc_icas_rtARID_DEF.cnt_k@ */ /end MEASUREMENT
/begin MEASUREMENT autosar_swc_icas_rtARID_DEF.cnt_n "" UBYTE autosar_swc_icas_CM_uint8 0 0 0 255 LAYOUT COLUMN_DIR MATRIX_DIM 3 ECU_ADDRESS 0xfe4ad926 /* @ECU_Address@autosar_swc_icas_rtARID_DEF.cnt_n@ */ /end MEASUREMENT
/begin MEASUREMENT autosar_swc_icas_rtARID_DEF.i "" UWORD autosar_swc_icas_CM_uint16 0 0 0 65535 ECU_ADDRESS 0xfe4ad91c /* @ECU_Address@autosar_swc_icas_rtARID_DEF.i@ */ /end MEASUREMENT
/begin MEASUREMENT autosar_swc_icas_rtARID_DEF.i_e "" UBYTE autosar_swc_icas_CM_uint8 0 0 0 255 ECU_ADDRESS 0xfe4ad95f /* @ECU_Address@autosar_swc_icas_rtARID_DEF.i_e@ */ /end MEASUREMENT
/begin MEASUREMENT autosar_swc_icas_rtARID_DEF.i_ej "" UBYTE autosar_swc_icas_CM_uint8 0 0 0 255 ECU_ADDRESS 0xfe4ad96f /* @ECU_Address@autosar_swc_icas_rtARID_DEF.i_ej@ */ /end MEASUREMENT
/begin MEASUREMENT autosar_swc_icas_rtARID_DEF.i_f "" UBYTE autosar_swc_icas_CM_uint8 0 0 0 255 ECU_ADDRESS 0xfe4ad96c /* @ECU_Address@autosar_swc_icas_rtARID_DEF.i_f@ */ /end MEASUREMENT
/begin MEASUREMENT autosar_swc_icas_rtARID_DEF.is_ACC "" UBYTE autosar_swc_icas_CM_uint8 0 0 0 255 ECU_ADDRESS 0xfe4ad991 /* @ECU_Address@autosar_swc_icas_rtARID_DEF.is_ACC@ */ /end MEASUREMENT
/begin MEASUREMENT autosar_swc_icas_rtARID_DEF.is_ACC_Active "" UBYTE autosar_swc_icas_CM_uint8 0 0 0 255 ECU_ADDRESS 0xfe4ad992 /* @ECU_Address@autosar_swc_icas_rtARID_DEF.is_ACC_Active@ */ /end MEASUREMENT
/begin MEASUREMENT autosar_swc_icas_rtARID_DEF.is_ACC_Control "" UBYTE autosar_swc_icas_CM_uint8 0 0 0 255 ECU_ADDRESS 0xfe4ad993 /* @ECU_Address@autosar_swc_icas_rtARID_DEF.is_ACC_Control@ */ /end MEASUREMENT
/begin MEASUREMENT autosar_swc_icas_rtARID_DEF.is_Active "" UBYTE autosar_swc_icas_CM_uint8 0 0 0 255 ECU_ADDRESS 0xfe4ad96b /* @ECU_Address@autosar_swc_icas_rtARID_DEF.is_Active@ */ /end MEASUREMENT
/begin MEASUREMENT autosar_swc_icas_rtARID_DEF.is_Main "" UBYTE autosar_swc_icas_CM_uint8 0 0 0 255 ECU_ADDRESS 0xfe4ad97d /* @ECU_Address@autosar_swc_icas_rtARID_DEF.is_Main@ */ /end MEASUREMENT
/begin MEASUREMENT autosar_swc_icas_rtARID_DEF.is_ON "" UBYTE autosar_swc_icas_CM_uint8 0 0 0 255 ECU_ADDRESS 0xfe4ad994 /* @ECU_Address@autosar_swc_icas_rtARID_DEF.is_ON@ */ /end MEASUREMENT
/begin MEASUREMENT autosar_swc_icas_rtARID_DEF.is_On "" UBYTE autosar_swc_icas_CM_uint8 0 0 0 255 ECU_ADDRESS 0xfe4ad966 /* @ECU_Address@autosar_swc_icas_rtARID_DEF.is_On@ */ /end MEASUREMENT
/begin MEASUREMENT autosar_swc_icas_rtARID_DEF.is_On_d "" UBYTE autosar_swc_icas_CM_uint8 0 0 0 255 ECU_ADDRESS 0xfe4ad96a /* @ECU_Address@autosar_swc_icas_rtARID_DEF.is_On_d@ */ /end MEASUREMENT
/begin MEASUREMENT autosar_swc_icas_rtARID_DEF.is_On_k "" UBYTE autosar_swc_icas_CM_uint8 0 0 0 255 ECU_ADDRESS 0xfe4ad979 /* @ECU_Address@autosar_swc_icas_rtARID_DEF.is_On_k@ */ /end MEASUREMENT
/begin MEASUREMENT autosar_swc_icas_rtARID_DEF.is_Time "" UBYTE autosar_swc_icas_CM_uint8 0 0 0 255 ECU_ADDRESS 0xfe4ad97c /* @ECU_Address@autosar_swc_icas_rtARID_DEF.is_Time@ */ /end MEASUREMENT
/begin MEASUREMENT autosar_swc_icas_rtARID_DEF.is_active_c17_autosar_swc_icas "" UBYTE autosar_swc_icas_CM_uint8 0 0 0 255 ECU_ADDRESS 0xfe4ad964 /* @ECU_Address@autosar_swc_icas_rtARID_DEF.is_active_c17_autosar_swc_icas@ */ /end MEASUREMENT
/begin MEASUREMENT autosar_swc_icas_rtARID_DEF.is_active_c19_autosar_swc_icas "" UBYTE autosar_swc_icas_CM_uint8 0 0 0 255 ECU_ADDRESS 0xfe4ad962 /* @ECU_Address@autosar_swc_icas_rtARID_DEF.is_active_c19_autosar_swc_icas@ */ /end MEASUREMENT
/begin MEASUREMENT autosar_swc_icas_rtARID_DEF.is_active_c24_autosar_swc_icas "" UBYTE autosar_swc_icas_CM_uint8 0 0 0 255 ECU_ADDRESS 0xfe4ad98b /* @ECU_Address@autosar_swc_icas_rtARID_DEF.is_active_c24_autosar_swc_icas@ */ /end MEASUREMENT
/begin MEASUREMENT autosar_swc_icas_rtARID_DEF.is_active_c26_autosar_swc_icas "" UBYTE autosar_swc_icas_CM_uint8 0 0 0 255 ECU_ADDRESS 0xfe4ad986 /* @ECU_Address@autosar_swc_icas_rtARID_DEF.is_active_c26_autosar_swc_icas@ */ /end MEASUREMENT
/begin MEASUREMENT autosar_swc_icas_rtARID_DEF.is_active_c283_autosar_swc_icas "" UBYTE autosar_swc_icas_CM_uint8 0 0 0 255 ECU_ADDRESS 0xfe4ad990 /* @ECU_Address@autosar_swc_icas_rtARID_DEF.is_active_c283_autosar_swc_icas@ */ /end MEASUREMENT
/begin MEASUREMENT autosar_swc_icas_rtARID_DEF.is_active_c303_autosar_swc_icas "" UBYTE autosar_swc_icas_CM_uint8 0 0 0 255 ECU_ADDRESS 0xfe4ad97a /* @ECU_Address@autosar_swc_icas_rtARID_DEF.is_active_c303_autosar_swc_icas@ */ /end MEASUREMENT
/begin MEASUREMENT autosar_swc_icas_rtARID_DEF.is_active_c31_autosar_swc_icas "" UBYTE autosar_swc_icas_CM_uint8 0 0 0 255 ECU_ADDRESS 0xfe4ad975 /* @ECU_Address@autosar_swc_icas_rtARID_DEF.is_active_c31_autosar_swc_icas@ */ /end MEASUREMENT
/begin MEASUREMENT autosar_swc_icas_rtARID_DEF.is_active_c384_autosar_swc_icas "" UBYTE autosar_swc_icas_CM_uint8 0 0 0 255 ECU_ADDRESS 0xfe4ad97e /* @ECU_Address@autosar_swc_icas_rtARID_DEF.is_active_c384_autosar_swc_icas@ */ /end MEASUREMENT
/begin MEASUREMENT autosar_swc_icas_rtARID_DEF.is_active_c41_autosar_swc_icas "" UBYTE autosar_swc_icas_CM_uint8 0 0 0 255 ECU_ADDRESS 0xfe4ad970 /* @ECU_Address@autosar_swc_icas_rtARID_DEF.is_active_c41_autosar_swc_icas@ */ /end MEASUREMENT
/begin MEASUREMENT autosar_swc_icas_rtARID_DEF.is_active_c42_autosar_swc_icas "" UBYTE autosar_swc_icas_CM_uint8 0 0 0 255 ECU_ADDRESS 0xfe4ad96d /* @ECU_Address@autosar_swc_icas_rtARID_DEF.is_active_c42_autosar_swc_icas@ */ /end MEASUREMENT
/begin MEASUREMENT autosar_swc_icas_rtARID_DEF.is_active_c48_autosar_swc_icas "" UBYTE autosar_swc_icas_CM_uint8 0 0 0 255 ECU_ADDRESS 0xfe4ad960 /* @ECU_Address@autosar_swc_icas_rtARID_DEF.is_active_c48_autosar_swc_icas@ */ /end MEASUREMENT
/begin MEASUREMENT autosar_swc_icas_rtARID_DEF.is_active_c52_autosar_swc_icas "" UBYTE autosar_swc_icas_CM_uint8 0 0 0 255 ECU_ADDRESS 0xfe4ad989 /* @ECU_Address@autosar_swc_icas_rtARID_DEF.is_active_c52_autosar_swc_icas@ */ /end MEASUREMENT
/begin MEASUREMENT autosar_swc_icas_rtARID_DEF.is_active_c54_autosar_swc_icas "" UBYTE autosar_swc_icas_CM_uint8 0 0 0 255 ECU_ADDRESS 0xfe4ad984 /* @ECU_Address@autosar_swc_icas_rtARID_DEF.is_active_c54_autosar_swc_icas@ */ /end MEASUREMENT
/begin MEASUREMENT autosar_swc_icas_rtARID_DEF.is_active_c55_autosar_swc_icas "" UBYTE autosar_swc_icas_CM_uint8 0 0 0 255 ECU_ADDRESS 0xfe4ad981 /* @ECU_Address@autosar_swc_icas_rtARID_DEF.is_active_c55_autosar_swc_icas@ */ /end MEASUREMENT
/begin MEASUREMENT autosar_swc_icas_rtARID_DEF.is_active_c56_autosar_swc_icas "" UBYTE autosar_swc_icas_CM_uint8 0 0 0 255 ECU_ADDRESS 0xfe4ad973 /* @ECU_Address@autosar_swc_icas_rtARID_DEF.is_active_c56_autosar_swc_icas@ */ /end MEASUREMENT
/begin MEASUREMENT autosar_swc_icas_rtARID_DEF.is_active_c6_autosar_swc_icas "" UBYTE autosar_swc_icas_CM_uint8 0 0 0 255 ECU_ADDRESS 0xfe4ad977 /* @ECU_Address@autosar_swc_icas_rtARID_DEF.is_active_c6_autosar_swc_icas@ */ /end MEASUREMENT
/begin MEASUREMENT autosar_swc_icas_rtARID_DEF.is_active_c9_autosar_swc_icas "" UBYTE autosar_swc_icas_CM_uint8 0 0 0 255 ECU_ADDRESS 0xfe4ad968 /* @ECU_Address@autosar_swc_icas_rtARID_DEF.is_active_c9_autosar_swc_icas@ */ /end MEASUREMENT
/begin MEASUREMENT autosar_swc_icas_rtARID_DEF.is_c17_autosar_swc_icas "" UBYTE autosar_swc_icas_CM_uint8 0 0 0 255 ECU_ADDRESS 0xfe4ad965 /* @ECU_Address@autosar_swc_icas_rtARID_DEF.is_c17_autosar_swc_icas@ */ /end MEASUREMENT
/begin MEASUREMENT autosar_swc_icas_rtARID_DEF.is_c19_autosar_swc_icas "" UBYTE autosar_swc_icas_CM_uint8 0 0 0 255 ECU_ADDRESS 0xfe4ad963 /* @ECU_Address@autosar_swc_icas_rtARID_DEF.is_c19_autosar_swc_icas@ */ /end MEASUREMENT
/begin MEASUREMENT autosar_swc_icas_rtARID_DEF.is_c24_autosar_swc_icas "" UBYTE autosar_swc_icas_CM_uint8 0 0 0 255 ECU_ADDRESS 0xfe4ad98c /* @ECU_Address@autosar_swc_icas_rtARID_DEF.is_c24_autosar_swc_icas@ */ /end MEASUREMENT
/begin MEASUREMENT autosar_swc_icas_rtARID_DEF.is_c26_autosar_swc_icas "" UBYTE autosar_swc_icas_CM_uint8 0 0 0 255 ECU_ADDRESS 0xfe4ad987 /* @ECU_Address@autosar_swc_icas_rtARID_DEF.is_c26_autosar_swc_icas@ */ /end MEASUREMENT
/begin MEASUREMENT autosar_swc_icas_rtARID_DEF.is_c303_autosar_swc_icas "" UBYTE autosar_swc_icas_CM_uint8 0 0 0 255 ECU_ADDRESS 0xfe4ad97b /* @ECU_Address@autosar_swc_icas_rtARID_DEF.is_c303_autosar_swc_icas@ */ /end MEASUREMENT
/begin MEASUREMENT autosar_swc_icas_rtARID_DEF.is_c31_autosar_swc_icas "" UBYTE autosar_swc_icas_CM_uint8 0 0 0 255 ECU_ADDRESS 0xfe4ad976 /* @ECU_Address@autosar_swc_icas_rtARID_DEF.is_c31_autosar_swc_icas@ */ /end MEASUREMENT
/begin MEASUREMENT autosar_swc_icas_rtARID_DEF.is_c384_autosar_swc_icas "" UBYTE autosar_swc_icas_CM_uint8 0 0 0 255 ECU_ADDRESS 0xfe4ad97f /* @ECU_Address@autosar_swc_icas_rtARID_DEF.is_c384_autosar_swc_icas@ */ /end MEASUREMENT
/begin MEASUREMENT autosar_swc_icas_rtARID_DEF.is_c41_autosar_swc_icas "" UBYTE autosar_swc_icas_CM_uint8 0 0 0 255 ECU_ADDRESS 0xfe4ad971 /* @ECU_Address@autosar_swc_icas_rtARID_DEF.is_c41_autosar_swc_icas@ */ /end MEASUREMENT
/begin MEASUREMENT autosar_swc_icas_rtARID_DEF.is_c42_autosar_swc_icas "" UBYTE autosar_swc_icas_CM_uint8 0 0 0 255 ECU_ADDRESS 0xfe4ad96e /* @ECU_Address@autosar_swc_icas_rtARID_DEF.is_c42_autosar_swc_icas@ */ /end MEASUREMENT
/begin MEASUREMENT autosar_swc_icas_rtARID_DEF.is_c48_autosar_swc_icas "" UBYTE autosar_swc_icas_CM_uint8 0 0 0 255 ECU_ADDRESS 0xfe4ad961 /* @ECU_Address@autosar_swc_icas_rtARID_DEF.is_c48_autosar_swc_icas@ */ /end MEASUREMENT
/begin MEASUREMENT autosar_swc_icas_rtARID_DEF.is_c52_autosar_swc_icas "" UBYTE autosar_swc_icas_CM_uint8 0 0 0 255 ECU_ADDRESS 0xfe4ad98a /* @ECU_Address@autosar_swc_icas_rtARID_DEF.is_c52_autosar_swc_icas@ */ /end MEASUREMENT
/begin MEASUREMENT autosar_swc_icas_rtARID_DEF.is_c54_autosar_swc_icas "" UBYTE autosar_swc_icas_CM_uint8 0 0 0 255 ECU_ADDRESS 0xfe4ad985 /* @ECU_Address@autosar_swc_icas_rtARID_DEF.is_c54_autosar_swc_icas@ */ /end MEASUREMENT
/begin MEASUREMENT autosar_swc_icas_rtARID_DEF.is_c55_autosar_swc_icas "" UBYTE autosar_swc_icas_CM_uint8 0 0 0 255 ECU_ADDRESS 0xfe4ad982 /* @ECU_Address@autosar_swc_icas_rtARID_DEF.is_c55_autosar_swc_icas@ */ /end MEASUREMENT
/begin MEASUREMENT autosar_swc_icas_rtARID_DEF.is_c56_autosar_swc_icas "" UBYTE autosar_swc_icas_CM_uint8 0 0 0 255 ECU_ADDRESS 0xfe4ad974 /* @ECU_Address@autosar_swc_icas_rtARID_DEF.is_c56_autosar_swc_icas@ */ /end MEASUREMENT
/begin MEASUREMENT autosar_swc_icas_rtARID_DEF.is_c6_autosar_swc_icas "" UBYTE autosar_swc_icas_CM_uint8 0 0 0 255 ECU_ADDRESS 0xfe4ad978 /* @ECU_Address@autosar_swc_icas_rtARID_DEF.is_c6_autosar_swc_icas@ */ /end MEASUREMENT
/begin MEASUREMENT autosar_swc_icas_rtARID_DEF.is_c9_autosar_swc_icas "" UBYTE autosar_swc_icas_CM_uint8 0 0 0 255 ECU_ADDRESS 0xfe4ad969 /* @ECU_Address@autosar_swc_icas_rtARID_DEF.is_c9_autosar_swc_icas@ */ /end MEASUREMENT
/begin MEASUREMENT autosar_swc_icas_rtARID_DEF.out "" ULONG autosar_swc_icas_CM_uint32 0 0 0 4294967295 ECU_ADDRESS 0xfe4ad81c /* @ECU_Address@autosar_swc_icas_rtARID_DEF.out@ */ /end MEASUREMENT
/begin MEASUREMENT autosar_swc_icas_rtARID_DEF.out_e "" UBYTE autosar_swc_icas_CM_logical 0 0 0 1 ECU_ADDRESS 0xfe4ad9dd /* @ECU_Address@autosar_swc_icas_rtARID_DEF.out_e@ */ /end MEASUREMENT
/begin MEASUREMENT autosar_swc_icas_rtARID_DEF.out_k "" UBYTE autosar_swc_icas_CM_logical 0 0 0 1 ECU_ADDRESS 0xfe4ad9df /* @ECU_Address@autosar_swc_icas_rtARID_DEF.out_k@ */ /end MEASUREMENT
/begin MEASUREMENT autosar_swc_icas_rtARID_DEF.out_mm "" UBYTE autosar_swc_icas_CM_logical 0 0 0 1 ECU_ADDRESS 0xfe4ad9de /* @ECU_Address@autosar_swc_icas_rtARID_DEF.out_mm@ */ /end MEASUREMENT
/begin MEASUREMENT autosar_swc_icas_rtARID_DEF.out_nm "" UBYTE autosar_swc_icas_CM_logical 0 0 0 1 ECU_ADDRESS 0xfe4ad9dc /* @ECU_Address@autosar_swc_icas_rtARID_DEF.out_nm@ */ /end MEASUREMENT
/begin MEASUREMENT autosar_swc_icas_rtARID_DEF.x "" UBYTE autosar_swc_icas_CM_logical 0 0 0 1 ECU_ADDRESS 0xfe4ada75 /* @ECU_Address@autosar_swc_icas_rtARID_DEF.x@ */ /end MEASUREMENT
/begin AXIS_PTS P_CRUISE_TJALCK_OverideSPd_kmh "" 0xfe820f24 /* @ECU_Address@P_CRUISE_TJALCK_OverideSPd_kmh@ */ NO_INPUT_QUANTITY Axis_FLOAT32_IEEE 0 autosar_swc_icas_CM_single 9 -3.4E+38 3.4E+38 /end AXIS_PTS
/begin AXIS_PTS P_ICAS_LCCSteerWhlSpdExit_Speed "" 0xfe820fb8 /* @ECU_Address@P_ICAS_LCCSteerWhlSpdExit_Speed@ */ NO_INPUT_QUANTITY Axis_FLOAT32_IEEE 0 autosar_swc_icas_CM_single 5 -3.4E+38 3.4E+38 /end AXIS_PTS
/begin AXIS_PTS P_ICAS_LCCSteerWhlSpdRcvr_Speed "" 0xfe820fe0 /* @ECU_Address@P_ICAS_LCCSteerWhlSpdRcvr_Speed@ */ NO_INPUT_QUANTITY Axis_FLOAT32_IEEE 0 autosar_swc_icas_CM_single 5 -3.4E+38 3.4E+38 /end AXIS_PTS
/begin COMPU_METHOD autosar_swc_icas_CM_boolean "Q = V" IDENTICAL "%1.0" "" /end COMPU_METHOD
/begin COMPU_METHOD autosar_swc_icas_CM_logical "Q = V" IDENTICAL "%1.0" "" /end COMPU_METHOD
/begin COMPU_METHOD autosar_swc_icas_CM_single "Q = V" IDENTICAL "%8.6" "" /end COMPU_METHOD
/begin COMPU_METHOD autosar_swc_icas_CM_uint16 "Q = V" IDENTICAL "%5.0" "" /end COMPU_METHOD
/begin COMPU_METHOD autosar_swc_icas_CM_uint32 "Q = V" IDENTICAL "%10.0" "" /end COMPU_METHOD
/begin COMPU_METHOD autosar_swc_icas_CM_uint64 "Q = V" IDENTICAL "%20.0" "" /end COMPU_METHOD
/begin COMPU_METHOD autosar_swc_icas_CM_uint8 "Q = V" IDENTICAL "%3.0" "" /end COMPU_METHOD
/begin RECORD_LAYOUT Record_BOOLEAN FNC_VALUES 1 UBYTE COLUMN_DIR DIRECT /end RECORD_LAYOUT
/begin RECORD_LAYOUT Record_FLOAT32_IEEE FNC_VALUES 1 FLOAT32_IEEE COLUMN_DIR DIRECT /end RECORD_LAYOUT
/begin RECORD_LAYOUT Record_UBYTE FNC_VALUES 1 UBYTE COLUMN_DIR DIRECT /end RECORD_LAYOUT
/begin RECORD_LAYOUT Record_ULONG FNC_VALUES 1 ULONG COLUMN_DIR DIRECT /end RECORD_LAYOUT
/begin RECORD_LAYOUT Record_UWORD FNC_VALUES 1 UWORD COLUMN_DIR DIRECT /end RECORD_LAYOUT
/begin RECORD_LAYOUT Axis_FLOAT32_IEEE AXIS_PTS_X 1 FLOAT32_IEEE INDEX_INCR DIRECT /end RECORD_LAYOUT
/begin GROUP autosar_swc_icas_autosar_swc_icas_Step_sys_ICAS_icas_CRUISE_ACC1_Subsystem1_TrueDurationTime6 "autosar_swc_icas/autosar_swc_icas_Step_sys/ICAS/icas/CRUISE_ACC1/Subsystem1/TrueDurationTime6"
 /begin REF_MEASUREMENT autosar_swc_icas_rtARID_DEF.UnitDelay1_DSTATE_cdv autosar_swc_icas_rtARID_DEF.UnitDelay2_DSTATE_eh /end REF_MEASUREMENT
/end GROUP
/begin GROUP autosar_swc_icas_autosar_swc_icas_Step_sys_ICAS_icas_CRUISE_ACC1_Subsystem1_TrueDurationTime7 "autosar_swc_icas/autosar_swc_icas_Step_sys/ICAS/icas/CRUISE_ACC1/Subsystem1/TrueDurationTime7"
 /begin REF_MEASUREMENT autosar_swc_icas_rtARID_DEF.UnitDelay1_DSTATE_b1 autosar_swc_icas_rtARID_DEF.UnitDelay2_DSTATE_lv /end REF_MEASUREMENT
/end GROUP
/begin GROUP autosar_swc_icas_autosar_swc_icas_Step_sys_ICAS_icas_CRUISE_ACC1_Subsystem1_TrueDurationTime8 "autosar_swc_icas/autosar_swc_icas_Step_sys/ICAS/icas/CRUISE_ACC1/Subsystem1/TrueDurationTime8"
 /begin REF_MEASUREMENT autosar_swc_icas_rtARID_DEF.UnitDelay1_DSTATE_py autosar_swc_icas_rtARID_DEF.UnitDelay2_DSTATE_jt /end REF_MEASUREMENT
/end GROUP
/begin GROUP autosar_swc_icas_autosar_swc_icas_Step_sys_ICAS_icas_CRUISE_ACC1_Subsystem1_TrueDurationTime9 "autosar_swc_icas/autosar_swc_icas_Step_sys/ICAS/icas/CRUISE_ACC1/Subsystem1/TrueDurationTime9"
 /begin REF_MEASUREMENT autosar_swc_icas_rtARID_DEF.UnitDelay1_DSTATE_ds autosar_swc_icas_rtARID_DEF.UnitDelay2_DSTATE_bc /end REF_MEASUREMENT
/end GROUP
/begin GROUP autosar_swc_icas_autosar_swc_icas_Step_sys_ICAS_icas_CRUISE_ACC1_Subsystem2 "autosar_swc_icas/autosar_swc_icas_Step_sys/ICAS/icas/CRUISE_ACC1/Subsystem2"
 /begin REF_MEASUREMENT autosar_swc_icas_rtARID_DEF.Comfort_exitCnt autosar_swc_icas_rtARID_DEF.InitCnt autosar_swc_icas_rtARID_DEF.brake_onlyCnt autosar_swc_icas_rtARID_DEF.is_ACC autosar_swc_icas_rtARID_DEF.is_ACC_Active autosar_swc_icas_rtARID_DEF.is_ACC_Control autosar_swc_icas_rtARID_DEF.is_ON autosar_swc_icas_rtARID_DEF.is_active_c283_autosar_swc_icas /end REF_MEASUREMENT
/end GROUP
/begin GROUP autosar_swc_icas_autosar_swc_icas_Step_sys_ICAS_icas_CRUISE_ACC1_Subsystem3 "autosar_swc_icas/autosar_swc_icas_Step_sys/ICAS/icas/CRUISE_ACC1/Subsystem3"
 /begin REF_MEASUREMENT autosar_swc_icas_rtARID_DEF.UnitDelay1_DSTATE_bj autosar_swc_icas_rtARID_DEF.x /end REF_MEASUREMENT
/end GROUP
/begin GROUP autosar_swc_icas_autosar_swc_icas_Step_sys_ICAS_icas_CRUISE_ACC1_Subsystem_Compare_To_Constant101 "autosar_swc_icas/autosar_swc_icas_Step_sys/ICAS/icas/CRUISE_ACC1/Subsystem/Compare\nTo Constant101" /begin REF_CHARACTERISTIC P_ICAS_ACCStandwait2ActivePedalPos /end REF_CHARACTERISTIC /end GROUP
/begin GROUP autosar_swc_icas_autosar_swc_icas_Step_sys_ICAS_icas_CRUISE_ACC1_Subsystem_Compare_To_Constant12 "autosar_swc_icas/autosar_swc_icas_Step_sys/ICAS/icas/CRUISE_ACC1/Subsystem/Compare\nTo Constant12" /begin REF_CHARACTERISTIC P_ACC_DriverBrakeOut /end REF_CHARACTERISTIC /end GROUP
/begin GROUP autosar_swc_icas_autosar_swc_icas_Step_sys_ICAS_icas_CRUISE_ACC1_Subsystem_Compare_To_Constant122 "autosar_swc_icas/autosar_swc_icas_Step_sys/ICAS/icas/CRUISE_ACC1/Subsystem/Compare\nTo Constant122" /begin REF_CHARACTERISTIC P_ICAS_ACCOverrideToActiveThld /end REF_CHARACTERISTIC /end GROUP
/begin GROUP autosar_swc_icas_autosar_swc_icas_Step_sys_ICAS_icas_CRUISE_ACC1_Subsystem_Compare_To_Constant17 "autosar_swc_icas/autosar_swc_icas_Step_sys/ICAS/icas/CRUISE_ACC1/Subsystem/Compare\nTo Constant17" /begin REF_CHARACTERISTIC P_ACC_VehSysRespOut /end REF_CHARACTERISTIC /end GROUP
/begin GROUP autosar_swc_icas_autosar_swc_icas_Step_sys_ICAS_icas_CRUISE_ACC1_Subsystem_Compare_To_Constant29 "autosar_swc_icas/autosar_swc_icas_Step_sys/ICAS/icas/CRUISE_ACC1/Subsystem/Compare\nTo Constant29" /begin REF_CHARACTERISTIC P_ACC_TirePressureTimeOut /end REF_CHARACTERISTIC /end GROUP
/begin GROUP autosar_swc_icas_autosar_swc_icas_Step_sys_ICAS_icas_CRUISE_ACC1_Subsystem_Compare_To_Constant39 "autosar_swc_icas/autosar_swc_icas_Step_sys/ICAS/icas/CRUISE_ACC1/Subsystem/Compare\nTo Constant39" /begin REF_CHARACTERISTIC P_ACC_BrkOverheatTimeIn /end REF_CHARACTERISTIC /end GROUP
/begin GROUP autosar_swc_icas_autosar_swc_icas_Step_sys_ICAS_icas_CRUISE_ACC1_Subsystem_Compare_To_Constant50 "autosar_swc_icas/autosar_swc_icas_Step_sys/ICAS/icas/CRUISE_ACC1/Subsystem/Compare\nTo Constant50" /begin REF_CHARACTERISTIC P_ACC_VDCOut /end REF_CHARACTERISTIC /end GROUP
/begin GROUP autosar_swc_icas_autosar_swc_icas_Step_sys_ICAS_icas_CRUISE_ACC1_Subsystem_Compare_To_Constant52 "autosar_swc_icas/autosar_swc_icas_Step_sys/ICAS/icas/CRUISE_ACC1/Subsystem/Compare\nTo Constant52" /begin REF_CHARACTERISTIC P_ACC_AccelTimeOut /end REF_CHARACTERISTIC /end GROUP
/begin GROUP autosar_swc_icas_autosar_swc_icas_Step_sys_ICAS_icas_CRUISE_ACC1_Subsystem_Compare_To_Constant57 "autosar_swc_icas/autosar_swc_icas_Step_sys/ICAS/icas/CRUISE_ACC1/Subsystem/Compare\nTo Constant57" /begin REF_CHARACTERISTIC P_ACC_BrkOverhearTimeOut /end REF_CHARACTERISTIC /end GROUP
/begin GROUP autosar_swc_icas_autosar_swc_icas_Step_sys_ICAS_icas_CRUISE_ACC1_Subsystem_Compare_To_Constant75 "autosar_swc_icas/autosar_swc_icas_Step_sys/ICAS/icas/CRUISE_ACC1/Subsystem/Compare\nTo Constant75" /begin REF_CHARACTERISTIC P_ICAS_ACCStandActive2WaitTime /end REF_CHARACTERISTIC /end GROUP
/begin GROUP autosar_swc_icas_autosar_swc_icas_Step_sys_ICAS_icas_CRUISE_ACC1_Subsystem_Compare_To_Constant8 "autosar_swc_icas/autosar_swc_icas_Step_sys/ICAS/icas/CRUISE_ACC1/Subsystem/Compare\nTo Constant8" /begin REF_CHARACTERISTIC P_ACC_DriverSeatbeltOut /end REF_CHARACTERISTIC /end GROUP
/begin GROUP autosar_swc_icas_autosar_swc_icas_Step_sys_ICAS_icas_CRUISE_ACC1_Subsystem_Subsystem "autosar_swc_icas/autosar_swc_icas_Step_sys/ICAS/icas/CRUISE_ACC1/Subsystem/Subsystem"
 /begin SUB_GROUP autosar_swc_icas_autosar_swc_icas_Step_sys_ICAS_icas_CRUISE_ACC1_Subsystem_Subsystem_Compare_To_Constant7 /end SUB_GROUP
/end GROUP
/begin GROUP autosar_swc_icas_autosar_swc_icas_Step_sys_ICAS_icas_CRUISE_ACC1_Subsystem_Subsystem3 "autosar_swc_icas/autosar_swc_icas_Step_sys/ICAS/icas/CRUISE_ACC1/Subsystem/Subsystem3" /begin REF_CHARACTERISTIC P_ICAS_BrakeOnly2ComfortExitTTC /end REF_CHARACTERISTIC /end GROUP
/begin GROUP autosar_swc_icas_autosar_swc_icas_Step_sys_ICAS_icas_CRUISE_ACC1_Subsystem_Subsystem5 "autosar_swc_icas/autosar_swc_icas_Step_sys/ICAS/icas/CRUISE_ACC1/Subsystem/Subsystem5"
 /begin SUB_GROUP autosar_swc_icas_autosar_swc_icas_Step_sys_ICAS_icas_CRUISE_ACC1_Subsystem_Subsystem5_Compare_To_Constant75 autosar_swc_icas_autosar_swc_icas_Step_sys_ICAS_icas_CRUISE_ACC1_Subsystem_Subsystem5_TrueDurationTime32 /end SUB_GROUP
/end GROUP
/begin GROUP autosar_swc_icas_autosar_swc_icas_Step_sys_ICAS_icas_CRUISE_ACC1_Subsystem_Subsystem5_Compare_To_Constant75 "autosar_swc_icas/autosar_swc_icas_Step_sys/ICAS/icas/CRUISE_ACC1/Subsystem/Subsystem5/Compare\nTo Constant75" /begin REF_CHARACTERISTIC P_ICAS_ACCStandActive2WaitPedWaitTime /end REF_CHARACTERISTIC /end GROUP
/begin GROUP autosar_swc_icas_autosar_swc_icas_Step_sys_ICAS_icas_CRUISE_ACC1_Subsystem_Subsystem5_TrueDurationTime32 "autosar_swc_icas/autosar_swc_icas_Step_sys/ICAS/icas/CRUISE_ACC1/Subsystem/Subsystem5/TrueDurationTime32"
 /begin REF_MEASUREMENT autosar_swc_icas_rtARID_DEF.UnitDelay1_DSTATE_ix autosar_swc_icas_rtARID_DEF.UnitDelay2_DSTATE_nt /end REF_MEASUREMENT
/end GROUP
/begin GROUP autosar_swc_icas_autosar_swc_icas_Step_sys_ICAS_icas_CRUISE_ACC1_Subsystem_Subsystem6 "autosar_swc_icas/autosar_swc_icas_Step_sys/ICAS/icas/CRUISE_ACC1/Subsystem/Subsystem6" /begin REF_CHARACTERISTIC P_ICAS_BrakeOnly2ComfortExitTTC /end REF_CHARACTERISTIC /end GROUP
/begin GROUP autosar_swc_icas_autosar_swc_icas_Step_sys_ICAS_icas_CRUISE_ACC1_Subsystem_TrueDurationTime1 "autosar_swc_icas/autosar_swc_icas_Step_sys/ICAS/icas/CRUISE_ACC1/Subsystem/TrueDurationTime1"
 /begin REF_MEASUREMENT autosar_swc_icas_rtARID_DEF.UnitDelay1_DSTATE_mh autosar_swc_icas_rtARID_DEF.UnitDelay2_DSTATE_fw /end REF_MEASUREMENT
/end GROUP
/begin GROUP autosar_swc_icas_autosar_swc_icas_Step_sys_ICAS_icas_CRUISE_ACC1_Subsystem_TrueDurationTime10 "autosar_swc_icas/autosar_swc_icas_Step_sys/ICAS/icas/CRUISE_ACC1/Subsystem/TrueDurationTime10"
 /begin REF_MEASUREMENT autosar_swc_icas_rtARID_DEF.UnitDelay1_DSTATE_n autosar_swc_icas_rtARID_DEF.UnitDelay2_DSTATE_k /end REF_MEASUREMENT
/end GROUP
/begin GROUP autosar_swc_icas_autosar_swc_icas_Step_sys_ICAS_icas_CRUISE_ACC1_Subsystem_TrueDurationTime11 "autosar_swc_icas/autosar_swc_icas_Step_sys/ICAS/icas/CRUISE_ACC1/Subsystem/TrueDurationTime11"
 /begin REF_MEASUREMENT autosar_swc_icas_rtARID_DEF.UnitDelay1_DSTATE_dg autosar_swc_icas_rtARID_DEF.UnitDelay2_DSTATE_n /end REF_MEASUREMENT
/end GROUP
/begin GROUP autosar_swc_icas_autosar_swc_icas_Step_sys_ICAS_icas_CRUISE_ACC1_Subsystem_TrueDurationTime12 "autosar_swc_icas/autosar_swc_icas_Step_sys/ICAS/icas/CRUISE_ACC1/Subsystem/TrueDurationTime12"
 /begin REF_MEASUREMENT autosar_swc_icas_rtARID_DEF.UnitDelay1_DSTATE_j autosar_swc_icas_rtARID_DEF.UnitDelay2_DSTATE_j /end REF_MEASUREMENT
/end GROUP
/begin GROUP autosar_swc_icas_autosar_swc_icas_Step_sys_ICAS_icas_CRUISE_ACC1_Subsystem_TrueDurationTime13 "autosar_swc_icas/autosar_swc_icas_Step_sys/ICAS/icas/CRUISE_ACC1/Subsystem/TrueDurationTime13"
 /begin REF_MEASUREMENT autosar_swc_icas_rtARID_DEF.UnitDelay1_DSTATE_bh autosar_swc_icas_rtARID_DEF.UnitDelay2_DSTATE_ak /end REF_MEASUREMENT
/end GROUP
/begin GROUP autosar_swc_icas_autosar_swc_icas_Step_sys_ICAS_icas_CRUISE_ACC1_Subsystem_TrueDurationTime14 "autosar_swc_icas/autosar_swc_icas_Step_sys/ICAS/icas/CRUISE_ACC1/Subsystem/TrueDurationTime14"
 /begin REF_MEASUREMENT autosar_swc_icas_rtARID_DEF.UnitDelay1_DSTATE_i autosar_swc_icas_rtARID_DEF.UnitDelay2_DSTATE_iv /end REF_MEASUREMENT
/end GROUP
/begin GROUP autosar_swc_icas_autosar_swc_icas_Step_sys_ICAS_icas_CRUISE_ACC1_Subsystem_TrueDurationTime15 "autosar_swc_icas/autosar_swc_icas_Step_sys/ICAS/icas/CRUISE_ACC1/Subsystem/TrueDurationTime15"
 /begin REF_MEASUREMENT autosar_swc_icas_rtARID_DEF.UnitDelay1_DSTATE_mk autosar_swc_icas_rtARID_DEF.UnitDelay2_DSTATE_l /end REF_MEASUREMENT
/end GROUP
/begin GROUP autosar_swc_icas_autosar_swc_icas_Step_sys_ICAS_icas_CRUISE_ACC1_Subsystem_TrueDurationTime16 "autosar_swc_icas/autosar_swc_icas_Step_sys/ICAS/icas/CRUISE_ACC1/Subsystem/TrueDurationTime16"
 /begin REF_MEASUREMENT autosar_swc_icas_rtARID_DEF.UnitDelay1_DSTATE_ih autosar_swc_icas_rtARID_DEF.UnitDelay2_DSTATE_g /end REF_MEASUREMENT
/end GROUP
/begin GROUP autosar_swc_icas_autosar_swc_icas_Step_sys_ICAS_icas_CRUISE_ACC1_Subsystem_TrueDurationTime17 "autosar_swc_icas/autosar_swc_icas_Step_sys/ICAS/icas/CRUISE_ACC1/Subsystem/TrueDurationTime17"
 /begin REF_MEASUREMENT autosar_swc_icas_rtARID_DEF.UnitDelay1_DSTATE_ov autosar_swc_icas_rtARID_DEF.UnitDelay2_DSTATE_f /end REF_MEASUREMENT
/end GROUP
/begin GROUP autosar_swc_icas_autosar_swc_icas_Step_sys_ICAS_icas_CRUISE_ACC1_Subsystem_TrueDurationTime18 "autosar_swc_icas/autosar_swc_icas_Step_sys/ICAS/icas/CRUISE_ACC1/Subsystem/TrueDurationTime18"
 /begin REF_MEASUREMENT autosar_swc_icas_rtARID_DEF.UnitDelay1_DSTATE_kw autosar_swc_icas_rtARID_DEF.UnitDelay2_DSTATE_he /end REF_MEASUREMENT
/end GROUP
/begin GROUP autosar_swc_icas_autosar_swc_icas_Step_sys_ICAS_icas_CRUISE_ACC1_Subsystem_TrueDurationTime19 "autosar_swc_icas/autosar_swc_icas_Step_sys/ICAS/icas/CRUISE_ACC1/Subsystem/TrueDurationTime19"
 /begin REF_MEASUREMENT autosar_swc_icas_rtARID_DEF.UnitDelay1_DSTATE_c autosar_swc_icas_rtARID_DEF.UnitDelay2_DSTATE_c1 /end REF_MEASUREMENT
/end GROUP
/begin GROUP autosar_swc_icas_autosar_swc_icas_Step_sys_ICAS_icas_CRUISE_ACC1_Subsystem_TrueDurationTime2 "autosar_swc_icas/autosar_swc_icas_Step_sys/ICAS/icas/CRUISE_ACC1/Subsystem/TrueDurationTime2"
 /begin REF_MEASUREMENT autosar_swc_icas_rtARID_DEF.UnitDelay1_DSTATE_k autosar_swc_icas_rtARID_DEF.UnitDelay2_DSTATE_il /end REF_MEASUREMENT
/end GROUP
/begin GROUP autosar_swc_icas_autosar_swc_icas_Step_sys_ICAS_icas_CRUISE_ACC1_Subsystem_TrueDurationTime20 "autosar_swc_icas/autosar_swc_icas_Step_sys/ICAS/icas/CRUISE_ACC1/Subsystem/TrueDurationTime20"
 /begin REF_MEASUREMENT autosar_swc_icas_rtARID_DEF.UnitDelay1_DSTATE_f autosar_swc_icas_rtARID_DEF.UnitDelay2_DSTATE_ll /end REF_MEASUREMENT
/end GROUP
/begin GROUP autosar_swc_icas_autosar_swc_icas_Step_sys_ICAS_icas_CRUISE_ACC1_Subsystem_TrueDurationTime21 "autosar_swc_icas/autosar_swc_icas_Step_sys/ICAS/icas/CRUISE_ACC1/Subsystem/TrueDurationTime21"
 /begin REF_MEASUREMENT autosar_swc_icas_rtARID_DEF.UnitDelay1_DSTATE_ft autosar_swc_icas_rtARID_DEF.UnitDelay2_DSTATE_p3 /end REF_MEASUREMENT
/end GROUP
/begin GROUP autosar_swc_icas_autosar_swc_icas_Step_sys_ICAS_icas_CRUISE_ACC1_Subsystem_TrueDurationTime22 "autosar_swc_icas/autosar_swc_icas_Step_sys/ICAS/icas/CRUISE_ACC1/Subsystem/TrueDurationTime22"
 /begin REF_MEASUREMENT autosar_swc_icas_rtARID_DEF.UnitDelay1_DSTATE_b5 autosar_swc_icas_rtARID_DEF.UnitDelay2_DSTATE_p2 /end REF_MEASUREMENT
/end GROUP
/begin GROUP autosar_swc_icas_autosar_swc_icas_Step_sys_ICAS_icas_CRUISE_ACC1_Subsystem_TrueDurationTime23 "autosar_swc_icas/autosar_swc_icas_Step_sys/ICAS/icas/CRUISE_ACC1/Subsystem/TrueDurationTime23"
 /begin REF_MEASUREMENT autosar_swc_icas_rtARID_DEF.UnitDelay1_DSTATE_a autosar_swc_icas_rtARID_DEF.UnitDelay2_DSTATE_eg /end REF_MEASUREMENT
/end GROUP
/begin GROUP autosar_swc_icas_autosar_swc_icas_Step_sys_ICAS_icas_CRUISE_ACC1_Subsystem_TrueDurationTime24 "autosar_swc_icas/autosar_swc_icas_Step_sys/ICAS/icas/CRUISE_ACC1/Subsystem/TrueDurationTime24"
 /begin REF_MEASUREMENT autosar_swc_icas_rtARID_DEF.UnitDelay1_DSTATE_p autosar_swc_icas_rtARID_DEF.UnitDelay2_DSTATE_ik /end REF_MEASUREMENT
/end GROUP
/begin GROUP autosar_swc_icas_autosar_swc_icas_Step_sys_ICAS_icas_CRUISE_ACC1_Subsystem_TrueDurationTime25 "autosar_swc_icas/autosar_swc_icas_Step_sys/ICAS/icas/CRUISE_ACC1/Subsystem/TrueDurationTime25"
 /begin REF_MEASUREMENT autosar_swc_icas_rtARID_DEF.UnitDelay1_DSTATE_h autosar_swc_icas_rtARID_DEF.UnitDelay2_DSTATE_kb /end REF_MEASUREMENT
/end GROUP
/begin GROUP autosar_swc_icas_autosar_swc_icas_Step_sys_ICAS_icas_CRUISE_ACC1_Subsystem_TrueDurationTime26 "autosar_swc_icas/autosar_swc_icas_Step_sys/ICAS/icas/CRUISE_ACC1/Subsystem/TrueDurationTime26"
 /begin REF_MEASUREMENT autosar_swc_icas_rtARID_DEF.UnitDelay1_DSTATE_g autosar_swc_icas_rtARID_DEF.UnitDelay2_DSTATE_ef /end REF_MEASUREMENT
/end GROUP
/begin GROUP autosar_swc_icas_autosar_swc_icas_Step_sys_ICAS_icas_CRUISE_ACC1_Subsystem_TrueDurationTime27 "autosar_swc_icas/autosar_swc_icas_Step_sys/ICAS/icas/CRUISE_ACC1/Subsystem/TrueDurationTime27"
 /begin REF_MEASUREMENT autosar_swc_icas_rtARID_DEF.UnitDelay1_DSTATE_m autosar_swc_icas_rtARID_DEF.UnitDelay2_DSTATE_bg /end REF_MEASUREMENT
/end GROUP
/begin GROUP autosar_swc_icas_autosar_swc_icas_Step_sys_ICAS_icas_CRUISE_ACC1_Subsystem_TrueDurationTime28 "autosar_swc_icas/autosar_swc_icas_Step_sys/ICAS/icas/CRUISE_ACC1/Subsystem/TrueDurationTime28"
 /begin REF_MEASUREMENT autosar_swc_icas_rtARID_DEF.UnitDelay1_DSTATE_ob autosar_swc_icas_rtARID_DEF.UnitDelay2_DSTATE_ma /end REF_MEASUREMENT
/end GROUP
/begin GROUP autosar_swc_icas_autosar_swc_icas_Step_sys_ICAS_icas_CRUISE_ACC1_Subsystem_TrueDurationTime29 "autosar_swc_icas/autosar_swc_icas_Step_sys/ICAS/icas/CRUISE_ACC1/Subsystem/TrueDurationTime29"
 /begin REF_MEASUREMENT autosar_swc_icas_rtARID_DEF.UnitDelay1_DSTATE_ew autosar_swc_icas_rtARID_DEF.UnitDelay2_DSTATE_nh /end REF_MEASUREMENT
/end GROUP
/begin GROUP autosar_swc_icas_autosar_swc_icas_Step_sys_ICAS_icas_CRUISE_ACC1_Subsystem_TrueDurationTime3 "autosar_swc_icas/autosar_swc_icas_Step_sys/ICAS/icas/CRUISE_ACC1/Subsystem/TrueDurationTime3"
 /begin REF_MEASUREMENT autosar_swc_icas_rtARID_DEF.UnitDelay1_DSTATE_o autosar_swc_icas_rtARID_DEF.UnitDelay2_DSTATE_a /end REF_MEASUREMENT
/end GROUP
/begin GROUP autosar_swc_icas_autosar_swc_icas_Step_sys_ICAS_icas_CRUISE_ACC1_Subsystem_TrueDurationTime30 "autosar_swc_icas/autosar_swc_icas_Step_sys/ICAS/icas/CRUISE_ACC1/Subsystem/TrueDurationTime30"
 /begin REF_MEASUREMENT autosar_swc_icas_rtARID_DEF.UnitDelay1_DSTATE_pr autosar_swc_icas_rtARID_DEF.UnitDelay2_DSTATE_nq /end REF_MEASUREMENT
/end GROUP
/begin GROUP autosar_swc_icas_autosar_swc_icas_Step_sys_ICAS_icas_CRUISE_ACC1_Subsystem_TrueDurationTime31 "autosar_swc_icas/autosar_swc_icas_Step_sys/ICAS/icas/CRUISE_ACC1/Subsystem/TrueDurationTime31"
 /begin REF_MEASUREMENT autosar_swc_icas_rtARID_DEF.UnitDelay1_DSTATE_ma autosar_swc_icas_rtARID_DEF.UnitDelay2_DSTATE_bdx /end REF_MEASUREMENT
/end GROUP
/begin GROUP autosar_swc_icas_autosar_swc_icas_Step_sys_ICAS_icas_CRUISE_ACC1_Subsystem_TrueDurationTime32 "autosar_swc_icas/autosar_swc_icas_Step_sys/ICAS/icas/CRUISE_ACC1/Subsystem/TrueDurationTime32"
 /begin REF_MEASUREMENT autosar_swc_icas_rtARID_DEF.UnitDelay1_DSTATE_pk autosar_swc_icas_rtARID_DEF.UnitDelay2_DSTATE_kx /end REF_MEASUREMENT
/end GROUP
/begin GROUP autosar_swc_icas_autosar_swc_icas_Step_sys_ICAS_icas_CRUISE_ACC1_Subsystem_TrueDurationTime33 "autosar_swc_icas/autosar_swc_icas_Step_sys/ICAS/icas/CRUISE_ACC1/Subsystem/TrueDurationTime33"
 /begin REF_MEASUREMENT autosar_swc_icas_rtARID_DEF.UnitDelay1_DSTATE_ln autosar_swc_icas_rtARID_DEF.UnitDelay2_DSTATE_d /end REF_MEASUREMENT
/end GROUP
/begin GROUP autosar_swc_icas_autosar_swc_icas_Step_sys_ICAS_icas_CRUISE_ACC1_Subsystem_TrueDurationTime34 "autosar_swc_icas/autosar_swc_icas_Step_sys/ICAS/icas/CRUISE_ACC1/Subsystem/TrueDurationTime34"
 /begin REF_MEASUREMENT autosar_swc_icas_rtARID_DEF.UnitDelay1_DSTATE_mha autosar_swc_icas_rtARID_DEF.UnitDelay2_DSTATE_hi /end REF_MEASUREMENT
/end GROUP
/begin GROUP autosar_swc_icas_autosar_swc_icas_Step_sys_ICAS_icas_CRUISE_ACC1_Subsystem_TrueDurationTime35 "autosar_swc_icas/autosar_swc_icas_Step_sys/ICAS/icas/CRUISE_ACC1/Subsystem/TrueDurationTime35"
 /begin REF_MEASUREMENT autosar_swc_icas_rtARID_DEF.UnitDelay1_DSTATE_ir autosar_swc_icas_rtARID_DEF.UnitDelay2_DSTATE_ho /end REF_MEASUREMENT
/end GROUP
/begin GROUP autosar_swc_icas_autosar_swc_icas_Step_sys_ICAS_icas_CRUISE_ACC1_Subsystem_TrueDurationTime36 "autosar_swc_icas/autosar_swc_icas_Step_sys/ICAS/icas/CRUISE_ACC1/Subsystem/TrueDurationTime36"
 /begin REF_MEASUREMENT autosar_swc_icas_rtARID_DEF.UnitDelay1_DSTATE_ku autosar_swc_icas_rtARID_DEF.UnitDelay2_DSTATE_kl /end REF_MEASUREMENT
/end GROUP
/begin GROUP autosar_swc_icas_autosar_swc_icas_Step_sys_ICAS_icas_CRUISE_ACC1_Subsystem_TrueDurationTime37 "autosar_swc_icas/autosar_swc_icas_Step_sys/ICAS/icas/CRUISE_ACC1/Subsystem/TrueDurationTime37"
 /begin REF_MEASUREMENT autosar_swc_icas_rtARID_DEF.UnitDelay1_DSTATE_hu autosar_swc_icas_rtARID_DEF.UnitDelay2_DSTATE_ia /end REF_MEASUREMENT
/end GROUP
/begin GROUP autosar_swc_icas_autosar_swc_icas_Step_sys_ICAS_icas_CRUISE_ACC1_Subsystem_TrueDurationTime38 "autosar_swc_icas/autosar_swc_icas_Step_sys/ICAS/icas/CRUISE_ACC1/Subsystem/TrueDurationTime38"
 /begin REF_MEASUREMENT autosar_swc_icas_rtARID_DEF.UnitDelay1_DSTATE_kv autosar_swc_icas_rtARID_DEF.UnitDelay2_DSTATE_jn /end REF_MEASUREMENT
/end GROUP
/begin GROUP autosar_swc_icas_autosar_swc_icas_Step_sys_ICAS_icas_CRUISE_ACC1_Subsystem_TrueDurationTime39 "autosar_swc_icas/autosar_swc_icas_Step_sys/ICAS/icas/CRUISE_ACC1/Subsystem/TrueDurationTime39"
 /begin REF_MEASUREMENT autosar_swc_icas_rtARID_DEF.UnitDelay1_DSTATE_bha autosar_swc_icas_rtARID_DEF.UnitDelay2_DSTATE_or /end REF_MEASUREMENT
/end GROUP
/begin GROUP autosar_swc_icas_autosar_swc_icas_Step_sys_ICAS_icas_CRUISE_ACC1_Subsystem_TrueDurationTime4 "autosar_swc_icas/autosar_swc_icas_Step_sys/ICAS/icas/CRUISE_ACC1/Subsystem/TrueDurationTime4"
 /begin REF_MEASUREMENT autosar_swc_icas_rtARID_DEF.UnitDelay1_DSTATE_e autosar_swc_icas_rtARID_DEF.UnitDelay2_DSTATE_bx /end REF_MEASUREMENT
/end GROUP
/begin GROUP autosar_swc_icas_autosar_swc_icas_Step_sys_ICAS_icas_CRUISE_ACC1_Subsystem_TrueDurationTime40 "autosar_swc_icas/autosar_swc_icas_Step_sys/ICAS/icas/CRUISE_ACC1/Subsystem/TrueDurationTime40"
 /begin REF_MEASUREMENT autosar_swc_icas_rtARID_DEF.UnitDelay1_DSTATE_ao autosar_swc_icas_rtARID_DEF.UnitDelay2_DSTATE_n2 /end REF_MEASUREMENT
/end GROUP
/begin GROUP autosar_swc_icas_autosar_swc_icas_Step_sys_ICAS_icas_CRUISE_ACC1_Subsystem_TrueDurationTime5 "autosar_swc_icas/autosar_swc_icas_Step_sys/ICAS/icas/CRUISE_ACC1/Subsystem/TrueDurationTime5"
 /begin REF_MEASUREMENT autosar_swc_icas_rtARID_DEF.UnitDelay1_DSTATE_ez autosar_swc_icas_rtARID_DEF.UnitDelay2_DSTATE_o /end REF_MEASUREMENT
/end GROUP
/begin GROUP autosar_swc_icas_autosar_swc_icas_Step_sys_ICAS_icas_CRUISE_ACC1_Subsystem_TrueDurationTime6 "autosar_swc_icas/autosar_swc_icas_Step_sys/ICAS/icas/CRUISE_ACC1/Subsystem/TrueDurationTime6"
 /begin REF_MEASUREMENT autosar_swc_icas_rtARID_DEF.UnitDelay1_DSTATE_d autosar_swc_icas_rtARID_DEF.UnitDelay2_DSTATE_ay /end REF_MEASUREMENT
/end GROUP
/begin GROUP autosar_swc_icas_autosar_swc_icas_Step_sys_ICAS_icas_CRUISE_ACC1_Subsystem_TrueDurationTime7 "autosar_swc_icas/autosar_swc_icas_Step_sys/ICAS/icas/CRUISE_ACC1/Subsystem/TrueDurationTime7"
 /begin REF_MEASUREMENT autosar_swc_icas_rtARID_DEF.UnitDelay1_DSTATE_ks autosar_swc_icas_rtARID_DEF.UnitDelay2_DSTATE_m /end REF_MEASUREMENT
/end GROUP
/begin GROUP autosar_swc_icas_autosar_swc_icas_Step_sys_ICAS_icas_CRUISE_ACC1_Subsystem_TrueDurationTime8 "autosar_swc_icas/autosar_swc_icas_Step_sys/ICAS/icas/CRUISE_ACC1/Subsystem/TrueDurationTime8"
 /begin REF_MEASUREMENT autosar_swc_icas_rtARID_DEF.UnitDelay1_DSTATE_eo autosar_swc_icas_rtARID_DEF.UnitDelay2_DSTATE_e3 /end REF_MEASUREMENT
/end GROUP
/begin GROUP autosar_swc_icas_autosar_swc_icas_Step_sys_ICAS_icas_CRUISE_ACC1_Subsystem_TrueDurationTime9 "autosar_swc_icas/autosar_swc_icas_Step_sys/ICAS/icas/CRUISE_ACC1/Subsystem/TrueDurationTime9"
 /begin REF_MEASUREMENT autosar_swc_icas_rtARID_DEF.UnitDelay1_DSTATE_b autosar_swc_icas_rtARID_DEF.UnitDelay2_DSTATE_mw /end REF_MEASUREMENT
/end GROUP
/begin GROUP autosar_swc_icas_autosar_swc_icas_Step_sys_ICAS_icas_CRUISE_ACC1_TrueDurationTime14 "autosar_swc_icas/autosar_swc_icas_Step_sys/ICAS/icas/CRUISE_ACC1/TrueDurationTime14"
 /begin REF_MEASUREMENT autosar_swc_icas_rtARID_DEF.UnitDelay1_DSTATE_cd autosar_swc_icas_rtARID_DEF.UnitDelay2_DSTATE_kq /end REF_MEASUREMENT
/end GROUP
/begin GROUP autosar_swc_icas_autosar_swc_icas_Step_sys_ICAS_icas_CRUISE_LongHMI "autosar_swc_icas/autosar_swc_icas_Step_sys/ICAS/icas/CRUISE_LongHMI"
 /begin SUB_GROUP autosar_swc_icas_autosar_swc_icas_Step_sys_ICAS_icas_CRUISE_LongHMI_Compare_To_Constant1 autosar_swc_icas_autosar_swc_icas_Step_sys_ICAS_icas_CRUISE_LongHMI_Compare_To_Constant10 autosar_swc_icas_autosar_swc_icas_Step_sys_ICAS_icas_CRUISE_LongHMI_Compare_To_Constant102 autosar_swc_icas_autosar_swc_icas_Step_sys_ICAS_icas_CRUISE_LongHMI_Compare_To_Constant104 autosar_swc_icas_autosar_swc_icas_Step_sys_ICAS_icas_CRUISE_LongHMI_Compare_To_Constant105 autosar_swc_icas_autosar_swc_icas_Step_sys_ICAS_icas_CRUISE_LongHMI_Compare_To_Constant113 autosar_swc_icas_autosar_swc_icas_Step_sys_ICAS_icas_CRUISE_LongHMI_Compare_To_Constant12 autosar_swc_icas_autosar_swc_icas_Step_sys_ICAS_icas_CRUISE_LongHMI_Compare_To_Constant140 autosar_swc_icas_autosar_swc_icas_Step_sys_ICAS_icas_CRUISE_LongHMI_Compare_To_Constant149 autosar_swc_icas_autosar_swc_icas_Step_sys_ICAS_icas_CRUISE_LongHMI_Compare_To_Constant16 autosar_swc_icas_autosar_swc_icas_Step_sys_ICAS_icas_CRUISE_LongHMI_Compare_To_Constant170 autosar_swc_icas_autosar_swc_icas_Step_sys_ICAS_icas_CRUISE_LongHMI_Compare_To_Constant18 autosar_swc_icas_autosar_swc_icas_Step_sys_ICAS_icas_CRUISE_LongHMI_Compare_To_Constant19 autosar_swc_icas_autosar_swc_icas_Step_sys_ICAS_icas_CRUISE_LongHMI_Compare_To_Constant20 autosar_swc_icas_autosar_swc_icas_Step_sys_ICAS_icas_CRUISE_LongHMI_Compare_To_Constant3 autosar_swc_icas_autosar_swc_icas_Step_sys_ICAS_icas_CRUISE_LongHMI_Compare_To_Constant33 autosar_swc_icas_autosar_swc_icas_Step_sys_ICAS_icas_CRUISE_LongHMI_Compare_To_Constant40 autosar_swc_icas_autosar_swc_icas_Step_sys_ICAS_icas_CRUISE_LongHMI_Compare_To_Constant45 autosar_swc_icas_autosar_swc_icas_Step_sys_ICAS_icas_CRUISE_LongHMI_Compare_To_Constant52 autosar_swc_icas_autosar_swc_icas_Step_sys_ICAS_icas_CRUISE_LongHMI_Compare_To_Constant6 autosar_swc_icas_autosar_swc_icas_Step_sys_ICAS_icas_CRUISE_LongHMI_Compare_To_Constant68 autosar_swc_icas_autosar_swc_icas_Step_sys_ICAS_icas_CRUISE_LongHMI_Compare_To_Constant69 autosar_swc_icas_autosar_swc_icas_Step_sys_ICAS_icas_CRUISE_LongHMI_Compare_To_Constant9 autosar_swc_icas_autosar_swc_icas_Step_sys_ICAS_icas_CRUISE_LongHMI_Compare_To_Constant96 autosar_swc_icas_autosar_swc_icas_Step_sys_ICAS_icas_CRUISE_LongHMI_Compare_To_Constant98 autosar_swc_icas_autosar_swc_icas_Step_sys_ICAS_icas_CRUISE_LongHMI_Detect_Decrease autosar_swc_icas_autosar_swc_icas_Step_sys_ICAS_icas_CRUISE_LongHMI_Detect_Decrease1 autosar_swc_icas_autosar_swc_icas_Step_sys_ICAS_icas_CRUISE_LongHMI_Detect_Increase autosar_swc_icas_autosar_swc_icas_Step_sys_ICAS_icas_CRUISE_LongHMI_Detect_Increase1 autosar_swc_icas_autosar_swc_icas_Step_sys_ICAS_icas_CRUISE_LongHMI_Detect_Increase2 autosar_swc_icas_autosar_swc_icas_Step_sys_ICAS_icas_CRUISE_LongHMI_Detect_Increase3 autosar_swc_icas_autosar_swc_icas_Step_sys_ICAS_icas_CRUISE_LongHMI_Detect_Increase4 autosar_swc_icas_autosar_swc_icas_Step_sys_ICAS_icas_CRUISE_LongHMI_Detect_Increase5 autosar_swc_icas_autosar_swc_icas_Step_sys_ICAS_icas_CRUISE_LongHMI_Subsystem1 autosar_swc_icas_autosar_swc_icas_Step_sys_ICAS_icas_CRUISE_LongHMI_Subsystem2 /end SUB_GROUP
 /begin REF_CHARACTERISTIC P_ICAS_TextDebouce /end REF_CHARACTERISTIC
 /begin REF_MEASUREMENT ICAS_ACC_HazActv ICAS_ACC_ModeDisp ICAS_ACC_USS_Drvroffdisp ICAS_AEB_HazActv ICAS_TJA_ModeDisp ICAS_longHMI_HazSts ICAS_longHMI_HazSwSts autosar_swc_icas_rtARID_DEF.UnitDelay10_DSTATE autosar_swc_icas_rtARID_DEF.UnitDelay11_DSTATE autosar_swc_icas_rtARID_DEF.UnitDelay12_DSTATE autosar_swc_icas_rtARID_DEF.UnitDelay13_DSTATE autosar_swc_icas_rtARID_DEF.UnitDelay14_DSTATE autosar_swc_icas_rtARID_DEF.UnitDelay15_DSTATE autosar_swc_icas_rtARID_DEF.UnitDelay16_DSTATE autosar_swc_icas_rtARID_DEF.UnitDelay17_DSTATE autosar_swc_icas_rtARID_DEF.UnitDelay18_DSTATE autosar_swc_icas_rtARID_DEF.UnitDelay19_DSTATE autosar_swc_icas_rtARID_DEF.UnitDelay1_DSTATE_ck autosar_swc_icas_rtARID_DEF.UnitDelay20_DSTATE autosar_swc_icas_rtARID_DEF.UnitDelay21_DSTATE autosar_swc_icas_rtARID_DEF.UnitDelay22_DSTATE autosar_swc_icas_rtARID_DEF.UnitDelay23_DSTATE autosar_swc_icas_rtARID_DEF.UnitDelay2_DSTATE_b autosar_swc_icas_rtARID_DEF.UnitDelay3_DSTATE_m autosar_swc_icas_rtARID_DEF.UnitDelay5_DSTATE_f autosar_swc_icas_rtARID_DEF.UnitDelay6_DSTATE autosar_swc_icas_rtARID_DEF.UnitDelay7_DSTATE autosar_swc_icas_rtARID_DEF.UnitDelay8_DSTATE autosar_swc_icas_rtARID_DEF.UnitDelay9_DSTATE autosar_swc_icas_rtARID_DEF.UnitDelay_DSTATE_dp autosar_swc_icas_rtARID_DEF.buffer autosar_swc_icas_rtARID_DEF.cnt_a autosar_swc_icas_rtARID_DEF.cnt_e autosar_swc_icas_rtARID_DEF.cnt_k autosar_swc_icas_rtARID_DEF.cnt_n autosar_swc_icas_rtARID_DEF.is_active_c24_autosar_swc_icas autosar_swc_icas_rtARID_DEF.is_active_c26_autosar_swc_icas autosar_swc_icas_rtARID_DEF.is_active_c384_autosar_swc_icas autosar_swc_icas_rtARID_DEF.is_active_c52_autosar_swc_icas autosar_swc_icas_rtARID_DEF.is_active_c54_autosar_swc_icas autosar_swc_icas_rtARID_DEF.is_active_c55_autosar_swc_icas autosar_swc_icas_rtARID_DEF.is_c24_autosar_swc_icas autosar_swc_icas_rtARID_DEF.is_c26_autosar_swc_icas autosar_swc_icas_rtARID_DEF.is_c384_autosar_swc_icas autosar_swc_icas_rtARID_DEF.is_c52_autosar_swc_icas autosar_swc_icas_rtARID_DEF.is_c54_autosar_swc_icas autosar_swc_icas_rtARID_DEF.is_c55_autosar_swc_icas /end REF_MEASUREMENT
/end GROUP
/begin GROUP autosar_swc_icas_autosar_swc_icas_Step_sys_ICAS_icas_CRUISE_LongHMI_Compare_To_Constant12 "autosar_swc_icas/autosar_swc_icas_Step_sys/ICAS/icas/CRUISE_LongHMI/Compare\nTo Constant12" /begin REF_MEASUREMENT ICAS_longHMI_HazSwSts /end REF_MEASUREMENT /end GROUP
/begin GROUP autosar_swc_icas_autosar_swc_icas_Step_sys_ICAS_icas_CRUISE_LongHMI_Compare_To_Constant52 "autosar_swc_icas/autosar_swc_icas_Step_sys/ICAS/icas/CRUISE_LongHMI/Compare\nTo Constant52" /begin REF_CHARACTERISTIC P_ACC_DecelHazLmpDecelThld /end REF_CHARACTERISTIC /end GROUP
/begin GROUP autosar_swc_icas_autosar_swc_icas_Step_sys_ICAS_icas_CRUISE_LongHMI_Compare_To_Constant98 "autosar_swc_icas/autosar_swc_icas_Step_sys/ICAS/icas/CRUISE_LongHMI/Compare\nTo Constant98" /begin REF_CHARACTERISTIC P_ACC_DecelHazLmpSpdThld /end REF_CHARACTERISTIC /end GROUP
/begin GROUP autosar_swc_icas_autosar_swc_icas_Step_sys_ICAS_icas_CRUISE_LongHMI_Detect_Decrease "autosar_swc_icas/autosar_swc_icas_Step_sys/ICAS/icas/CRUISE_LongHMI/Detect\nDecrease" /begin REF_MEASUREMENT autosar_swc_icas_rtARID_DEF.DelayInput1_DSTATE_as /end REF_MEASUREMENT /end GROUP
/begin GROUP autosar_swc_icas_autosar_swc_icas_Step_sys_ICAS_icas_CRUISE_LongHMI_Detect_Decrease1 "autosar_swc_icas/autosar_swc_icas_Step_sys/ICAS/icas/CRUISE_LongHMI/Detect\nDecrease1" /begin REF_MEASUREMENT autosar_swc_icas_rtARID_DEF.DelayInput1_DSTATE_dx /end REF_MEASUREMENT /end GROUP
/begin GROUP autosar_swc_icas_autosar_swc_icas_Step_sys_ICAS_icas_CRUISE_LongHMI_Detect_Increase "autosar_swc_icas/autosar_swc_icas_Step_sys/ICAS/icas/CRUISE_LongHMI/Detect\nIncrease"
 /begin REF_MEASUREMENT ICAS_longHMI_HazSwSts autosar_swc_icas_rtARID_DEF.DelayInput1_DSTATE_fn /end REF_MEASUREMENT
/end GROUP
/begin GROUP autosar_swc_icas_autosar_swc_icas_Step_sys_ICAS_icas_CRUISE_LongHMI_Detect_Increase1 "autosar_swc_icas/autosar_swc_icas_Step_sys/ICAS/icas/CRUISE_LongHMI/Detect\nIncrease1" /begin REF_MEASUREMENT autosar_swc_icas_rtARID_DEF.DelayInput1_DSTATE_pj /end REF_MEASUREMENT /end GROUP
/begin GROUP autosar_swc_icas_autosar_swc_icas_Step_sys_ICAS_icas_CRUISE_LongHMI_Detect_Increase2 "autosar_swc_icas/autosar_swc_icas_Step_sys/ICAS/icas/CRUISE_LongHMI/Detect\nIncrease2" /begin REF_MEASUREMENT autosar_swc_icas_rtARID_DEF.DelayInput1_DSTATE_i /end REF_MEASUREMENT /end GROUP
/begin GROUP autosar_swc_icas_autosar_swc_icas_Step_sys_ICAS_icas_CRUISE_LongHMI_Detect_Increase3 "autosar_swc_icas/autosar_swc_icas_Step_sys/ICAS/icas/CRUISE_LongHMI/Detect\nIncrease3" /begin REF_MEASUREMENT autosar_swc_icas_rtARID_DEF.DelayInput1_DSTATE_bc /end REF_MEASUREMENT /end GROUP
/begin GROUP autosar_swc_icas_autosar_swc_icas_Step_sys_ICAS_icas_CRUISE_LongHMI_Detect_Increase4 "autosar_swc_icas/autosar_swc_icas_Step_sys/ICAS/icas/CRUISE_LongHMI/Detect\nIncrease4" /begin REF_MEASUREMENT autosar_swc_icas_rtARID_DEF.DelayInput1_DSTATE_d /end REF_MEASUREMENT /end GROUP
/begin GROUP autosar_swc_icas_autosar_swc_icas_Step_sys_ICAS_icas_CRUISE_LongHMI_Detect_Increase5 "autosar_swc_icas/autosar_swc_icas_Step_sys/ICAS/icas/CRUISE_LongHMI/Detect\nIncrease5" /begin REF_MEASUREMENT autosar_swc_icas_rtARID_DEF.DelayInput1_DSTATE_ba /end REF_MEASUREMENT /end GROUP
/begin GROUP autosar_swc_icas_autosar_swc_icas_Step_sys_ICAS_icas_CRUISE_LongHMI_Subsystem1 "autosar_swc_icas/autosar_swc_icas_Step_sys/ICAS/icas/CRUISE_LongHMI/Subsystem1"
 /begin SUB_GROUP autosar_swc_icas_autosar_swc_icas_Step_sys_ICAS_icas_CRUISE_LongHMI_Subsystem1_Compare_To_Constant3 /end SUB_GROUP
 /begin REF_MEASUREMENT autosar_swc_icas_rtARID_DEF.UnitDelay4_DSTATE_g /end REF_MEASUREMENT
/end GROUP
/begin GROUP autosar_swc_icas_autosar_swc_icas_Step_sys_ICAS_icas_CRUISE_LongHMI_Subsystem2 "autosar_swc_icas/autosar_swc_icas_Step_sys/ICAS/icas/CRUISE_LongHMI/Subsystem2"
 /begin SUB_GROUP autosar_swc_icas_autosar_swc_icas_Step_sys_ICAS_icas_CRUISE_LongHMI_Subsystem2_Compare_To_Constant1 /end SUB_GROUP
 /begin REF_MEASUREMENT autosar_swc_icas_rtARID_DEF.UnitDelay4_DSTATE_b /end REF_MEASUREMENT
/end GROUP
/begin GROUP autosar_swc_icas_autosar_swc_icas_Step_sys_ICAS_icas_DataCollect "autosar_swc_icas/autosar_swc_icas_Step_sys/ICAS/icas/DataCollect"
 /begin SUB_GROUP autosar_swc_icas_autosar_swc_icas_Step_sys_ICAS_icas_DataCollect_Compare_To_Constant autosar_swc_icas_autosar_swc_icas_Step_sys_ICAS_icas_DataCollect_Compare_To_Constant1 autosar_swc_icas_autosar_swc_icas_Step_sys_ICAS_icas_DataCollect_Compare_To_Constant15 autosar_swc_icas_autosar_swc_icas_Step_sys_ICAS_icas_DataCollect_Enlong3s1 autosar_swc_icas_autosar_swc_icas_Step_sys_ICAS_icas_DataCollect_Enlong3s2 autosar_swc_icas_autosar_swc_icas_Step_sys_ICAS_icas_DataCollect_Enlong3s3 autosar_swc_icas_autosar_swc_icas_Step_sys_ICAS_icas_DataCollect_Enlong3s4 /end SUB_GROUP
 /begin REF_MEASUREMENT ICAS_LongHMI_VERSION autosar_swc_icas_rtARID_DEF.UnitDelay1_DSTATE_pi autosar_swc_icas_rtARID_DEF.UnitDelay2_DSTATE_if autosar_swc_icas_rtARID_DEF.UnitDelay_DSTATE_j /end REF_MEASUREMENT
/end GROUP
/begin GROUP autosar_swc_icas_autosar_swc_icas_Step_sys_ICAS_icas_DataCollect_Enlong3s1 "autosar_swc_icas/autosar_swc_icas_Step_sys/ICAS/icas/DataCollect/Enlong3s1"
 /begin SUB_GROUP autosar_swc_icas_autosar_swc_icas_Step_sys_ICAS_icas_DataCollect_Enlong3s1_SignalChange /end SUB_GROUP
 /begin REF_MEASUREMENT autosar_swc_icas_rtARID_DEF.UnitDelay2_DSTATE_i autosar_swc_icas_rtARID_DEF.UnitDelay3_DSTATE_o autosar_swc_icas_rtARID_DEF.UnitDelay_DSTATE_m /end REF_MEASUREMENT
/end GROUP
/begin GROUP autosar_swc_icas_autosar_swc_icas_Step_sys_ICAS_icas_DataCollect_Enlong3s1_SignalChange "autosar_swc_icas/autosar_swc_icas_Step_sys/ICAS/icas/DataCollect/Enlong3s1/SignalChange"
 /begin SUB_GROUP autosar_swc_icas_autosar_swc_icas_Step_sys_ICAS_icas_DataCollect_Enlong3s1_SignalChange_Detect_Decrease autosar_swc_icas_autosar_swc_icas_Step_sys_ICAS_icas_DataCollect_Enlong3s1_SignalChange_Detect_Increase3 /end SUB_GROUP
/end GROUP
/begin GROUP autosar_swc_icas_autosar_swc_icas_Step_sys_ICAS_icas_DataCollect_Enlong3s1_SignalChange_Detect_Decrease "autosar_swc_icas/autosar_swc_icas_Step_sys/ICAS/icas/DataCollect/Enlong3s1/SignalChange/Detect\nDecrease" /begin REF_MEASUREMENT autosar_swc_icas_rtARID_DEF.DelayInput1_DSTATE_g /end REF_MEASUREMENT /end GROUP
/begin GROUP autosar_swc_icas_autosar_swc_icas_Step_sys_ICAS_icas_DataCollect_Enlong3s1_SignalChange_Detect_Increase3 "autosar_swc_icas/autosar_swc_icas_Step_sys/ICAS/icas/DataCollect/Enlong3s1/SignalChange/Detect\nIncrease3" /begin REF_MEASUREMENT autosar_swc_icas_rtARID_DEF.DelayInput1_DSTATE_p /end REF_MEASUREMENT /end GROUP
/begin GROUP autosar_swc_icas_autosar_swc_icas_Step_sys_ICAS_icas_DataCollect_Enlong3s2 "autosar_swc_icas/autosar_swc_icas_Step_sys/ICAS/icas/DataCollect/Enlong3s2"
 /begin SUB_GROUP autosar_swc_icas_autosar_swc_icas_Step_sys_ICAS_icas_DataCollect_Enlong3s2_SignalChange /end SUB_GROUP
 /begin REF_MEASUREMENT autosar_swc_icas_rtARID_DEF.UnitDelay2_DSTATE_c autosar_swc_icas_rtARID_DEF.UnitDelay3_DSTATE_b autosar_swc_icas_rtARID_DEF.UnitDelay_DSTATE_eq /end REF_MEASUREMENT
/end GROUP
/begin GROUP autosar_swc_icas_autosar_swc_icas_Step_sys_ICAS_icas_DataCollect_Enlong3s2_SignalChange "autosar_swc_icas/autosar_swc_icas_Step_sys/ICAS/icas/DataCollect/Enlong3s2/SignalChange"
 /begin SUB_GROUP autosar_swc_icas_autosar_swc_icas_Step_sys_ICAS_icas_DataCollect_Enlong3s2_SignalChange_Detect_Decrease autosar_swc_icas_autosar_swc_icas_Step_sys_ICAS_icas_DataCollect_Enlong3s2_SignalChange_Detect_Increase3 /end SUB_GROUP
/end GROUP
/begin GROUP autosar_swc_icas_autosar_swc_icas_Step_sys_ICAS_icas_DataCollect_Enlong3s2_SignalChange_Detect_Decrease "autosar_swc_icas/autosar_swc_icas_Step_sys/ICAS/icas/DataCollect/Enlong3s2/SignalChange/Detect\nDecrease" /begin REF_MEASUREMENT autosar_swc_icas_rtARID_DEF.DelayInput1_DSTATE_c /end REF_MEASUREMENT /end GROUP
/begin GROUP autosar_swc_icas_autosar_swc_icas_Step_sys_ICAS_icas_DataCollect_Enlong3s2_SignalChange_Detect_Increase3 "autosar_swc_icas/autosar_swc_icas_Step_sys/ICAS/icas/DataCollect/Enlong3s2/SignalChange/Detect\nIncrease3" /begin REF_MEASUREMENT autosar_swc_icas_rtARID_DEF.DelayInput1_DSTATE_b /end REF_MEASUREMENT /end GROUP
/begin GROUP autosar_swc_icas_autosar_swc_icas_Step_sys_ICAS_icas_DataCollect_Enlong3s3 "autosar_swc_icas/autosar_swc_icas_Step_sys/ICAS/icas/DataCollect/Enlong3s3"
 /begin SUB_GROUP autosar_swc_icas_autosar_swc_icas_Step_sys_ICAS_icas_DataCollect_Enlong3s3_SignalChange /end SUB_GROUP
 /begin REF_MEASUREMENT autosar_swc_icas_rtARID_DEF.UnitDelay2_DSTATE_e autosar_swc_icas_rtARID_DEF.UnitDelay3_DSTATE_h autosar_swc_icas_rtARID_DEF.UnitDelay_DSTATE_dt /end REF_MEASUREMENT
/end GROUP
/begin GROUP autosar_swc_icas_autosar_swc_icas_Step_sys_ICAS_icas_DataCollect_Enlong3s3_SignalChange "autosar_swc_icas/autosar_swc_icas_Step_sys/ICAS/icas/DataCollect/Enlong3s3/SignalChange"
 /begin SUB_GROUP autosar_swc_icas_autosar_swc_icas_Step_sys_ICAS_icas_DataCollect_Enlong3s3_SignalChange_Detect_Decrease autosar_swc_icas_autosar_swc_icas_Step_sys_ICAS_icas_DataCollect_Enlong3s3_SignalChange_Detect_Increase3 /end SUB_GROUP
/end GROUP
/begin GROUP autosar_swc_icas_autosar_swc_icas_Step_sys_ICAS_icas_DataCollect_Enlong3s3_SignalChange_Detect_Decrease "autosar_swc_icas/autosar_swc_icas_Step_sys/ICAS/icas/DataCollect/Enlong3s3/SignalChange/Detect\nDecrease" /begin REF_MEASUREMENT autosar_swc_icas_rtARID_DEF.DelayInput1_DSTATE_j /end REF_MEASUREMENT /end GROUP
/begin GROUP autosar_swc_icas_autosar_swc_icas_Step_sys_ICAS_icas_DataCollect_Enlong3s3_SignalChange_Detect_Increase3 "autosar_swc_icas/autosar_swc_icas_Step_sys/ICAS/icas/DataCollect/Enlong3s3/SignalChange/Detect\nIncrease3" /begin REF_MEASUREMENT autosar_swc_icas_rtARID_DEF.DelayInput1_DSTATE_o /end REF_MEASUREMENT /end GROUP
/begin GROUP autosar_swc_icas_autosar_swc_icas_Step_sys_ICAS_icas_DataCollect_Enlong3s4 "autosar_swc_icas/autosar_swc_icas_Step_sys/ICAS/icas/DataCollect/Enlong3s4"
 /begin SUB_GROUP autosar_swc_icas_autosar_swc_icas_Step_sys_ICAS_icas_DataCollect_Enlong3s4_SignalChange /end SUB_GROUP
 /begin REF_MEASUREMENT autosar_swc_icas_rtARID_DEF.UnitDelay2_DSTATE_oj autosar_swc_icas_rtARID_DEF.UnitDelay3_DSTATE_e autosar_swc_icas_rtARID_DEF.UnitDelay_DSTATE_p /end REF_MEASUREMENT
/end GROUP
/begin GROUP autosar_swc_icas_autosar_swc_icas_Step_sys_ICAS_icas_DataCollect_Enlong3s4_SignalChange "autosar_swc_icas/autosar_swc_icas_Step_sys/ICAS/icas/DataCollect/Enlong3s4/SignalChange"
 /begin SUB_GROUP autosar_swc_icas_autosar_swc_icas_Step_sys_ICAS_icas_DataCollect_Enlong3s4_SignalChange_Detect_Decrease autosar_swc_icas_autosar_swc_icas_Step_sys_ICAS_icas_DataCollect_Enlong3s4_SignalChange_Detect_Increase3 /end SUB_GROUP
/end GROUP
/begin GROUP autosar_swc_icas_autosar_swc_icas_Step_sys_ICAS_icas_DataCollect_Enlong3s4_SignalChange_Detect_Decrease "autosar_swc_icas/autosar_swc_icas_Step_sys/ICAS/icas/DataCollect/Enlong3s4/SignalChange/Detect\nDecrease" /begin REF_MEASUREMENT autosar_swc_icas_rtARID_DEF.DelayInput1_DSTATE_jp /end REF_MEASUREMENT /end GROUP
/begin GROUP autosar_swc_icas_autosar_swc_icas_Step_sys_ICAS_icas_DataCollect_Enlong3s4_SignalChange_Detect_Increase3 "autosar_swc_icas/autosar_swc_icas_Step_sys/ICAS/icas/DataCollect/Enlong3s4/SignalChange/Detect\nIncrease3" /begin REF_MEASUREMENT autosar_swc_icas_rtARID_DEF.DelayInput1_DSTATE_m /end REF_MEASUREMENT /end GROUP
/begin GROUP autosar_swc_icas_autosar_swc_icas_Step_sys_ICAS_icas_HOD "autosar_swc_icas/autosar_swc_icas_Step_sys/ICAS/icas/HOD"
 /begin SUB_GROUP autosar_swc_icas_autosar_swc_icas_Step_sys_ICAS_icas_HOD_Detect_Increase /end SUB_GROUP
 /begin REF_CHARACTERISTIC P_CRUISE_TJA_HandsOffLev1TimeCnt_NOA P_CRUISE_TJA_HandsOffLev2TimeCnt_NOA P_CRUISE_TJA_HandsOffLev3TimeCnt_NOA P_ICAS_LCCDriverHandsOffWarning P_ICAS_Level3_To_MRM /end REF_CHARACTERISTIC
 /begin REF_MEASUREMENT ICAS_reserve03 autosar_swc_icas_rtARID_DEF.Cnt autosar_swc_icas_rtARID_DEF.Cnt2 autosar_swc_icas_rtARID_DEF.HandOn_condition autosar_swc_icas_rtARID_DEF.UnitDelay_DSTATE_g autosar_swc_icas_rtARID_DEF.is_Main autosar_swc_icas_rtARID_DEF.is_Time autosar_swc_icas_rtARID_DEF.is_active_c303_autosar_swc_icas autosar_swc_icas_rtARID_DEF.is_c303_autosar_swc_icas autosar_swc_icas_rtARID_DEF.out /end REF_MEASUREMENT
/end GROUP
/begin GROUP autosar_swc_icas_autosar_swc_icas_Step_sys_ICAS_icas_HOD_Detect_Increase "autosar_swc_icas/autosar_swc_icas_Step_sys/ICAS/icas/HOD/Detect\nIncrease" /begin REF_MEASUREMENT autosar_swc_icas_rtARID_DEF.DelayInput1_DSTATE_ej /end REF_MEASUREMENT /end GROUP
/begin GROUP autosar_swc_icas_autosar_swc_icas_Step_sys_ICAS_icas_Subsystem "autosar_swc_icas/autosar_swc_icas_Step_sys/ICAS/icas/Subsystem"
 /begin SUB_GROUP autosar_swc_icas_autosar_swc_icas_Step_sys_ICAS_icas_Subsystem_ACC_ActiveControl autosar_swc_icas_autosar_swc_icas_Step_sys_ICAS_icas_Subsystem_ACC_BrakeOnly autosar_swc_icas_autosar_swc_icas_Step_sys_ICAS_icas_Subsystem_ACC_ComfortExit autosar_swc_icas_autosar_swc_icas_Step_sys_ICAS_icas_Subsystem_ACC_Override autosar_swc_icas_autosar_swc_icas_Step_sys_ICAS_icas_Subsystem_ACC_StandActive autosar_swc_icas_autosar_swc_icas_Step_sys_ICAS_icas_Subsystem_ACC_StandWait /end SUB_GROUP
/end GROUP
/begin GROUP autosar_swc_icas_autosar_swc_icas_Step_sys_ICAS_icas_Subsystem1 "autosar_swc_icas/autosar_swc_icas_Step_sys/ICAS/icas/Subsystem1"
 /begin SUB_GROUP autosar_swc_icas_autosar_swc_icas_Step_sys_ICAS_icas_Subsystem1_Compare_To_Constant10 autosar_swc_icas_autosar_swc_icas_Step_sys_ICAS_icas_Subsystem1_Compare_To_Constant22 autosar_swc_icas_autosar_swc_icas_Step_sys_ICAS_icas_Subsystem1_Compare_To_Constant23 autosar_swc_icas_autosar_swc_icas_Step_sys_ICAS_icas_Subsystem1_Compare_To_Constant24 autosar_swc_icas_autosar_swc_icas_Step_sys_ICAS_icas_Subsystem1_Compare_To_Constant25 autosar_swc_icas_autosar_swc_icas_Step_sys_ICAS_icas_Subsystem1_Compare_To_Constant30 autosar_swc_icas_autosar_swc_icas_Step_sys_ICAS_icas_Subsystem1_Compare_To_Constant31 autosar_swc_icas_autosar_swc_icas_Step_sys_ICAS_icas_Subsystem1_Compare_To_Constant5 autosar_swc_icas_autosar_swc_icas_Step_sys_ICAS_icas_Subsystem1_Detect_Change autosar_swc_icas_autosar_swc_icas_Step_sys_ICAS_icas_Subsystem1_TrueDurationTime1 /end SUB_GROUP
 /begin REF_MEASUREMENT autosar_swc_icas_rtARID_DEF.UnitDelay1_DSTATE_c4 autosar_swc_icas_rtARID_DEF.UnitDelay_DSTATE_mu autosar_swc_icas_rtARID_DEF.i autosar_swc_icas_rtARID_DEF.is_On_k autosar_swc_icas_rtARID_DEF.is_active_c31_autosar_swc_icas autosar_swc_icas_rtARID_DEF.is_active_c6_autosar_swc_icas autosar_swc_icas_rtARID_DEF.is_c31_autosar_swc_icas autosar_swc_icas_rtARID_DEF.is_c6_autosar_swc_icas autosar_swc_icas_rtARID_DEF.out_k /end REF_MEASUREMENT
/end GROUP
/begin GROUP autosar_swc_icas_autosar_swc_icas_Step_sys_ICAS_icas_Subsystem1_Compare_To_Constant22 "autosar_swc_icas/autosar_swc_icas_Step_sys/ICAS/icas/Subsystem1/Compare\nTo Constant22" /begin REF_CHARACTERISTIC P_ICAS_DAI_P0StandbyDis /end REF_CHARACTERISTIC /end GROUP
/begin GROUP autosar_swc_icas_autosar_swc_icas_Step_sys_ICAS_icas_Subsystem1_Compare_To_Constant23 "autosar_swc_icas/autosar_swc_icas_Step_sys/ICAS/icas/Subsystem1/Compare\nTo Constant23" /begin REF_CHARACTERISTIC P_ICAS_DAI_P0ActiveDis /end REF_CHARACTERISTIC /end GROUP
/begin GROUP autosar_swc_icas_autosar_swc_icas_Step_sys_ICAS_icas_Subsystem1_Compare_To_Constant25 "autosar_swc_icas/autosar_swc_icas_Step_sys/ICAS/icas/Subsystem1/Compare\nTo Constant25" /begin REF_CHARACTERISTIC P_ICAS_DAI_P0DriveOffSpd /end REF_CHARACTERISTIC /end GROUP
/begin GROUP autosar_swc_icas_autosar_swc_icas_Step_sys_ICAS_icas_Subsystem1_Detect_Change "autosar_swc_icas/autosar_swc_icas_Step_sys/ICAS/icas/Subsystem1/Detect\nChange" /begin REF_MEASUREMENT autosar_swc_icas_rtARID_DEF.DelayInput1_DSTATE /end REF_MEASUREMENT /end GROUP
/begin GROUP autosar_swc_icas_autosar_swc_icas_Step_sys_ICAS_icas_Subsystem1_TrueDurationTime1 "autosar_swc_icas/autosar_swc_icas_Step_sys/ICAS/icas/Subsystem1/TrueDurationTime1"
 /begin REF_MEASUREMENT autosar_swc_icas_rtARID_DEF.UnitDelay1_DSTATE_ph autosar_swc_icas_rtARID_DEF.UnitDelay2_DSTATE_pr /end REF_MEASUREMENT
/end GROUP
/begin GROUP autosar_swc_icas_autosar_swc_icas_Step_sys_ICAS_icas_Subsystem3 "autosar_swc_icas/autosar_swc_icas_Step_sys/ICAS/icas/Subsystem3"
 /begin SUB_GROUP autosar_swc_icas_autosar_swc_icas_Step_sys_ICAS_icas_Subsystem3_Detect_Increase autosar_swc_icas_autosar_swc_icas_Step_sys_ICAS_icas_Subsystem3_Detect_Increase1 autosar_swc_icas_autosar_swc_icas_Step_sys_ICAS_icas_Subsystem3_Detect_Increase2 autosar_swc_icas_autosar_swc_icas_Step_sys_ICAS_icas_Subsystem3_Detect_Increase3 /end SUB_GROUP
/end GROUP
/begin GROUP autosar_swc_icas_autosar_swc_icas_Step_sys_ICAS_icas_Subsystem3_Detect_Increase "autosar_swc_icas/autosar_swc_icas_Step_sys/ICAS/icas/Subsystem3/Detect\nIncrease" /begin REF_MEASUREMENT autosar_swc_icas_rtARID_DEF.DelayInput1_DSTATE_oi /end REF_MEASUREMENT /end GROUP
/begin GROUP autosar_swc_icas_autosar_swc_icas_Step_sys_ICAS_icas_Subsystem3_Detect_Increase1 "autosar_swc_icas/autosar_swc_icas_Step_sys/ICAS/icas/Subsystem3/Detect\nIncrease1" /begin REF_MEASUREMENT autosar_swc_icas_rtARID_DEF.DelayInput1_DSTATE_kb /end REF_MEASUREMENT /end GROUP
/begin GROUP autosar_swc_icas_autosar_swc_icas_Step_sys_ICAS_icas_Subsystem3_Detect_Increase2 "autosar_swc_icas/autosar_swc_icas_Step_sys/ICAS/icas/Subsystem3/Detect\nIncrease2" /begin REF_MEASUREMENT autosar_swc_icas_rtARID_DEF.DelayInput1_DSTATE_bw /end REF_MEASUREMENT /end GROUP
/begin GROUP autosar_swc_icas_autosar_swc_icas_Step_sys_ICAS_icas_Subsystem3_Detect_Increase3 "autosar_swc_icas/autosar_swc_icas_Step_sys/ICAS/icas/Subsystem3/Detect\nIncrease3" /begin REF_MEASUREMENT autosar_swc_icas_rtARID_DEF.DelayInput1_DSTATE_h /end REF_MEASUREMENT /end GROUP
/begin GROUP autosar_swc_icas_autosar_swc_icas_Step_sys_ICAS_icas_Subsystem4 "autosar_swc_icas/autosar_swc_icas_Step_sys/ICAS/icas/Subsystem4"
 /begin SUB_GROUP autosar_swc_icas_autosar_swc_icas_Step_sys_ICAS_icas_Subsystem4_LCC_CONDITIONS autosar_swc_icas_autosar_swc_icas_Step_sys_ICAS_icas_Subsystem4_LCC_STATE_MACHINE /end SUB_GROUP
/end GROUP
/begin GROUP autosar_swc_icas_autosar_swc_icas_Step_sys_ICAS_icas_Subsystem4_LCC_CONDITIONS "autosar_swc_icas/autosar_swc_icas_Step_sys/ICAS/icas/Subsystem4/LCC_CONDITIONS"
 /begin SUB_GROUP autosar_swc_icas_autosar_swc_icas_Step_sys_ICAS_icas_Subsystem4_LCC_CONDITIONS_Compare_To_Constant autosar_swc_icas_autosar_swc_icas_Step_sys_ICAS_icas_Subsystem4_LCC_CONDITIONS_Compare_To_Constant11 autosar_swc_icas_autosar_swc_icas_Step_sys_ICAS_icas_Subsystem4_LCC_CONDITIONS_Compare_To_Constant13 autosar_swc_icas_autosar_swc_icas_Step_sys_ICAS_icas_Subsystem4_LCC_CONDITIONS_Compare_To_Constant14 autosar_swc_icas_autosar_swc_icas_Step_sys_ICAS_icas_Subsystem4_LCC_CONDITIONS_Compare_To_Constant24 autosar_swc_icas_autosar_swc_icas_Step_sys_ICAS_icas_Subsystem4_LCC_CONDITIONS_Compare_To_Constant38 autosar_swc_icas_autosar_swc_icas_Step_sys_ICAS_icas_Subsystem4_LCC_CONDITIONS_Compare_To_Constant4 autosar_swc_icas_autosar_swc_icas_Step_sys_ICAS_icas_Subsystem4_LCC_CONDITIONS_Compare_To_Constant40 autosar_swc_icas_autosar_swc_icas_Step_sys_ICAS_icas_Subsystem4_LCC_CONDITIONS_Compare_To_Constant41 autosar_swc_icas_autosar_swc_icas_Step_sys_ICAS_icas_Subsystem4_LCC_CONDITIONS_Compare_To_Constant42 autosar_swc_icas_autosar_swc_icas_Step_sys_ICAS_icas_Subsystem4_LCC_CONDITIONS_Compare_To_Constant43 autosar_swc_icas_autosar_swc_icas_Step_sys_ICAS_icas_Subsystem4_LCC_CONDITIONS_Compare_To_Constant5 autosar_swc_icas_autosar_swc_icas_Step_sys_ICAS_icas_Subsystem4_LCC_CONDITIONS_Compare_To_Constant54 autosar_swc_icas_autosar_swc_icas_Step_sys_ICAS_icas_Subsystem4_LCC_CONDITIONS_Compare_To_Constant55 autosar_swc_icas_autosar_swc_icas_Step_sys_ICAS_icas_Subsystem4_LCC_CONDITIONS_Compare_To_Constant56 autosar_swc_icas_autosar_swc_icas_Step_sys_ICAS_icas_Subsystem4_LCC_CONDITIONS_Compare_To_Constant57 autosar_swc_icas_autosar_swc_icas_Step_sys_ICAS_icas_Subsystem4_LCC_CONDITIONS_Compare_To_Constant7 autosar_swc_icas_autosar_swc_icas_Step_sys_ICAS_icas_Subsystem4_LCC_CONDITIONS_Compare_To_Constant8 autosar_swc_icas_autosar_swc_icas_Step_sys_ICAS_icas_Subsystem4_LCC_CONDITIONS_SASDegOverride autosar_swc_icas_autosar_swc_icas_Step_sys_ICAS_icas_Subsystem4_LCC_CONDITIONS_Subsystem autosar_swc_icas_autosar_swc_icas_Step_sys_ICAS_icas_Subsystem4_LCC_CONDITIONS_Subsystem1 autosar_swc_icas_autosar_swc_icas_Step_sys_ICAS_icas_Subsystem4_LCC_CONDITIONS_TrueDurationTime1 autosar_swc_icas_autosar_swc_icas_Step_sys_ICAS_icas_Subsystem4_LCC_CONDITIONS_TrueDurationTime10 autosar_swc_icas_autosar_swc_icas_Step_sys_ICAS_icas_Subsystem4_LCC_CONDITIONS_TrueDurationTime11 autosar_swc_icas_autosar_swc_icas_Step_sys_ICAS_icas_Subsystem4_LCC_CONDITIONS_TrueDurationTime12 autosar_swc_icas_autosar_swc_icas_Step_sys_ICAS_icas_Subsystem4_LCC_CONDITIONS_TrueDurationTime13 autosar_swc_icas_autosar_swc_icas_Step_sys_ICAS_icas_Subsystem4_LCC_CONDITIONS_TrueDurationTime14 autosar_swc_icas_autosar_swc_icas_Step_sys_ICAS_icas_Subsystem4_LCC_CONDITIONS_TrueDurationTime15 autosar_swc_icas_autosar_swc_icas_Step_sys_ICAS_icas_Subsystem4_LCC_CONDITIONS_TrueDurationTime16 autosar_swc_icas_autosar_swc_icas_Step_sys_ICAS_icas_Subsystem4_LCC_CONDITIONS_TrueDurationTime2 autosar_swc_icas_autosar_swc_icas_Step_sys_ICAS_icas_Subsystem4_LCC_CONDITIONS_TrueDurationTime3 autosar_swc_icas_autosar_swc_icas_Step_sys_ICAS_icas_Subsystem4_LCC_CONDITIONS_TrueDurationTime4 autosar_swc_icas_autosar_swc_icas_Step_sys_ICAS_icas_Subsystem4_LCC_CONDITIONS_TrueDurationTime5 autosar_swc_icas_autosar_swc_icas_Step_sys_ICAS_icas_Subsystem4_LCC_CONDITIONS_TrueDurationTime6 autosar_swc_icas_autosar_swc_icas_Step_sys_ICAS_icas_Subsystem4_LCC_CONDITIONS_TrueDurationTime7 autosar_swc_icas_autosar_swc_icas_Step_sys_ICAS_icas_Subsystem4_LCC_CONDITIONS_TrueDurationTime8 autosar_swc_icas_autosar_swc_icas_Step_sys_ICAS_icas_Subsystem4_LCC_CONDITIONS_TrueDurationTime9 /end SUB_GROUP
 /begin REF_CHARACTERISTIC P_ICAS_LCCSteerWhlSpdExit P_ICAS_LCCSteerWhlSpdExit_Speed P_ICAS_LCCSteerWhlSpdRcvr P_ICAS_LCCSteerWhlSpdRcvr_Speed /end REF_CHARACTERISTIC
 /begin REF_MEASUREMENT autosar_swc_icas_rtARID_DEF.Cnt_b autosar_swc_icas_rtARID_DEF.Delay_DSTATE autosar_swc_icas_rtARID_DEF.UnitDelay1_DSTATE_gs autosar_swc_icas_rtARID_DEF.UnitDelay2_DSTATE_h autosar_swc_icas_rtARID_DEF.is_active_c56_autosar_swc_icas autosar_swc_icas_rtARID_DEF.is_c56_autosar_swc_icas autosar_swc_icas_rtARID_DEF.out_mm /end REF_MEASUREMENT
/end GROUP
/begin GROUP autosar_swc_icas_autosar_swc_icas_Step_sys_ICAS_icas_Subsystem4_LCC_CONDITIONS_Compare_To_Constant "autosar_swc_icas/autosar_swc_icas_Step_sys/ICAS/icas/Subsystem4/LCC_CONDITIONS/Compare\nTo Constant" /begin REF_CHARACTERISTIC P_ICAS_AccPedalRateThreshold /end REF_CHARACTERISTIC /end GROUP
/begin GROUP autosar_swc_icas_autosar_swc_icas_Step_sys_ICAS_icas_Subsystem4_LCC_CONDITIONS_Compare_To_Constant11 "autosar_swc_icas/autosar_swc_icas_Step_sys/ICAS/icas/Subsystem4/LCC_CONDITIONS/Compare\nTo Constant11" /begin REF_CHARACTERISTIC P_ICAS_LCCInhibitPedalPosition /end REF_CHARACTERISTIC /end GROUP
/begin GROUP autosar_swc_icas_autosar_swc_icas_Step_sys_ICAS_icas_Subsystem4_LCC_CONDITIONS_Compare_To_Constant13 "autosar_swc_icas/autosar_swc_icas_Step_sys/ICAS/icas/Subsystem4/LCC_CONDITIONS/Compare\nTo Constant13" /begin REF_CHARACTERISTIC P_ICAS_LCCYawRateExit /end REF_CHARACTERISTIC /end GROUP
/begin GROUP autosar_swc_icas_autosar_swc_icas_Step_sys_ICAS_icas_Subsystem4_LCC_CONDITIONS_Compare_To_Constant24 "autosar_swc_icas/autosar_swc_icas_Step_sys/ICAS/icas/Subsystem4/LCC_CONDITIONS/Compare\nTo Constant24" /begin REF_CHARACTERISTIC P_ICAS_LCCSteerWhlSpdExitTime /end REF_CHARACTERISTIC /end GROUP
/begin GROUP autosar_swc_icas_autosar_swc_icas_Step_sys_ICAS_icas_Subsystem4_LCC_CONDITIONS_Compare_To_Constant4 "autosar_swc_icas/autosar_swc_icas_Step_sys/ICAS/icas/Subsystem4/LCC_CONDITIONS/Compare\nTo Constant4" /begin REF_CHARACTERISTIC P_ICAS_AccPedalRateInhibit /end REF_CHARACTERISTIC /end GROUP
/begin GROUP autosar_swc_icas_autosar_swc_icas_Step_sys_ICAS_icas_Subsystem4_LCC_CONDITIONS_Compare_To_Constant5 "autosar_swc_icas/autosar_swc_icas_Step_sys/ICAS/icas/Subsystem4/LCC_CONDITIONS/Compare\nTo Constant5" /begin REF_CHARACTERISTIC P_ICAS_AccPedalRateThreshold /end REF_CHARACTERISTIC /end GROUP
/begin GROUP autosar_swc_icas_autosar_swc_icas_Step_sys_ICAS_icas_Subsystem4_LCC_CONDITIONS_Compare_To_Constant7 "autosar_swc_icas/autosar_swc_icas_Step_sys/ICAS/icas/Subsystem4/LCC_CONDITIONS/Compare\nTo Constant7" /begin REF_CHARACTERISTIC P_ICAS_LCCYawRateExit /end REF_CHARACTERISTIC /end GROUP
/begin GROUP autosar_swc_icas_autosar_swc_icas_Step_sys_ICAS_icas_Subsystem4_LCC_CONDITIONS_Compare_To_Constant8 "autosar_swc_icas/autosar_swc_icas_Step_sys/ICAS/icas/Subsystem4/LCC_CONDITIONS/Compare\nTo Constant8" /begin REF_CHARACTERISTIC P_ICAS_LCCInhibitPedalPosition /end REF_CHARACTERISTIC /end GROUP
/begin GROUP autosar_swc_icas_autosar_swc_icas_Step_sys_ICAS_icas_Subsystem4_LCC_CONDITIONS_SASDegOverride "autosar_swc_icas/autosar_swc_icas_Step_sys/ICAS/icas/Subsystem4/LCC_CONDITIONS/SASDegOverride"
 /begin SUB_GROUP autosar_swc_icas_autosar_swc_icas_Step_sys_ICAS_icas_Subsystem4_LCC_CONDITIONS_SASDegOverride_Compare_To_Constant3 autosar_swc_icas_autosar_swc_icas_Step_sys_ICAS_icas_Subsystem4_LCC_CONDITIONS_SASDegOverride_Subsystem1 autosar_swc_icas_autosar_swc_icas_Step_sys_ICAS_icas_Subsystem4_LCC_CONDITIONS_SASDegOverride_Subsystem2 autosar_swc_icas_autosar_swc_icas_Step_sys_ICAS_icas_Subsystem4_LCC_CONDITIONS_SASDegOverride_Subsystem3 autosar_swc_icas_autosar_swc_icas_Step_sys_ICAS_icas_Subsystem4_LCC_CONDITIONS_SASDegOverride_Subsystem4 autosar_swc_icas_autosar_swc_icas_Step_sys_ICAS_icas_Subsystem4_LCC_CONDITIONS_SASDegOverride_TrueDurationTime3 /end SUB_GROUP
 /begin REF_CHARACTERISTIC P_CRUISE_TJALCK_EPSTqVerifyTimeDiff_s P_CRUISE_TJALCK_EPSTqVerifyTimeSame_s P_CRUISE_TJALCK_LcEPSTqVerifyTimeDiff_s P_CRUISE_TJALCK_LcEPSTqVerifyTimeSame_s P_CRUISE_TJALCK_OverideSPd_kmh P_CRUISE_TJALCK_OverrideDiffTrq P_CRUISE_TJALCK_OverrideSameTrq P_ICAS_LCCOverride P_ICAS_LcOverrideTrqRatio /end REF_CHARACTERISTIC
 /begin REF_MEASUREMENT autosar_swc_icas_rtARID_DEF.UnitDelay1_DSTATE autosar_swc_icas_rtARID_DEF.UnitDelay2_DSTATE /end REF_MEASUREMENT
/end GROUP
/begin GROUP autosar_swc_icas_autosar_swc_icas_Step_sys_ICAS_icas_Subsystem4_LCC_CONDITIONS_SASDegOverride_Compare_To_Constant3 "autosar_swc_icas/autosar_swc_icas_Step_sys/ICAS/icas/Subsystem4/LCC_CONDITIONS/SASDegOverride/Compare\nTo Constant3" /begin REF_CHARACTERISTIC P_ICAS_LCCOverrideRecoverTime /end REF_CHARACTERISTIC /end GROUP
/begin GROUP autosar_swc_icas_autosar_swc_icas_Step_sys_ICAS_icas_Subsystem4_LCC_CONDITIONS_SASDegOverride_Subsystem1 "autosar_swc_icas/autosar_swc_icas_Step_sys/ICAS/icas/Subsystem4/LCC_CONDITIONS/SASDegOverride/Subsystem1" /begin REF_MEASUREMENT autosar_swc_icas_rtARID_DEF.UnitDelay_DSTATE /end REF_MEASUREMENT /end GROUP
/begin GROUP autosar_swc_icas_autosar_swc_icas_Step_sys_ICAS_icas_Subsystem4_LCC_CONDITIONS_SASDegOverride_Subsystem2 "autosar_swc_icas/autosar_swc_icas_Step_sys/ICAS/icas/Subsystem4/LCC_CONDITIONS/SASDegOverride/Subsystem2" /begin REF_MEASUREMENT autosar_swc_icas_rtARID_DEF.UnitDelay_DSTATE_d /end REF_MEASUREMENT /end GROUP
/begin GROUP autosar_swc_icas_autosar_swc_icas_Step_sys_ICAS_icas_Subsystem4_LCC_CONDITIONS_SASDegOverride_Subsystem3 "autosar_swc_icas/autosar_swc_icas_Step_sys/ICAS/icas/Subsystem4/LCC_CONDITIONS/SASDegOverride/Subsystem3" /begin REF_MEASUREMENT autosar_swc_icas_rtARID_DEF.UnitDelay_DSTATE_c /end REF_MEASUREMENT /end GROUP
/begin GROUP autosar_swc_icas_autosar_swc_icas_Step_sys_ICAS_icas_Subsystem4_LCC_CONDITIONS_SASDegOverride_Subsystem4 "autosar_swc_icas/autosar_swc_icas_Step_sys/ICAS/icas/Subsystem4/LCC_CONDITIONS/SASDegOverride/Subsystem4" /begin REF_MEASUREMENT autosar_swc_icas_rtARID_DEF.UnitDelay_DSTATE_e /end REF_MEASUREMENT /end GROUP
/begin GROUP autosar_swc_icas_autosar_swc_icas_Step_sys_ICAS_icas_Subsystem4_LCC_CONDITIONS_SASDegOverride_TrueDurationTime3 "autosar_swc_icas/autosar_swc_icas_Step_sys/ICAS/icas/Subsystem4/LCC_CONDITIONS/SASDegOverride/TrueDurationTime3"
 /begin REF_MEASUREMENT autosar_swc_icas_rtARID_DEF.UnitDelay1_DSTATE_gi autosar_swc_icas_rtARID_DEF.UnitDelay2_DSTATE_m0 /end REF_MEASUREMENT
/end GROUP
/begin GROUP autosar_swc_icas_autosar_swc_icas_Step_sys_ICAS_icas_Subsystem4_LCC_CONDITIONS_Subsystem "autosar_swc_icas/autosar_swc_icas_Step_sys/ICAS/icas/Subsystem4/LCC_CONDITIONS/Subsystem"
 /begin REF_CHARACTERISTIC P_ICAS_CoPilotDrvTrqEntry_0to30 P_ICAS_CoPilotDrvTrqEntry_120to150 P_ICAS_CoPilotDrvTrqEntry_30to60 P_ICAS_CoPilotDrvTrqEntry_60to90 P_ICAS_CoPilotDrvTrqEntry_90to120 P_ICAS_CoPilotEntryDebouceTime /end REF_CHARACTERISTIC
 /begin REF_MEASUREMENT autosar_swc_icas_rtARID_DEF.i_ej autosar_swc_icas_rtARID_DEF.is_active_c41_autosar_swc_icas autosar_swc_icas_rtARID_DEF.is_c41_autosar_swc_icas autosar_swc_icas_rtARID_DEF.out_mm /end REF_MEASUREMENT
/end GROUP
/begin GROUP autosar_swc_icas_autosar_swc_icas_Step_sys_ICAS_icas_Subsystem4_LCC_CONDITIONS_Subsystem1 "autosar_swc_icas/autosar_swc_icas_Step_sys/ICAS/icas/Subsystem4/LCC_CONDITIONS/Subsystem1"
 /begin REF_CHARACTERISTIC P_ICAS_CoPilotDrvTrqExit_0to60 P_ICAS_CoPilotDrvTrqExit_120to150 P_ICAS_CoPilotDrvTrqExit_60to90 P_ICAS_CoPilotDrvTrqExit_90to120 P_ICAS_CoPilotExitDebouceTime /end REF_CHARACTERISTIC
 /begin REF_MEASUREMENT autosar_swc_icas_rtARID_DEF.i_f autosar_swc_icas_rtARID_DEF.is_active_c42_autosar_swc_icas autosar_swc_icas_rtARID_DEF.is_c42_autosar_swc_icas autosar_swc_icas_rtARID_DEF.out_e /end REF_MEASUREMENT
/end GROUP
/begin GROUP autosar_swc_icas_autosar_swc_icas_Step_sys_ICAS_icas_Subsystem4_LCC_CONDITIONS_TrueDurationTime1 "autosar_swc_icas/autosar_swc_icas_Step_sys/ICAS/icas/Subsystem4/LCC_CONDITIONS/TrueDurationTime1"
 /begin REF_MEASUREMENT autosar_swc_icas_rtARID_DEF.UnitDelay1_DSTATE_bf autosar_swc_icas_rtARID_DEF.UnitDelay2_DSTATE_hh /end REF_MEASUREMENT
/end GROUP
/begin GROUP autosar_swc_icas_autosar_swc_icas_Step_sys_ICAS_icas_Subsystem4_LCC_CONDITIONS_TrueDurationTime10 "autosar_swc_icas/autosar_swc_icas_Step_sys/ICAS/icas/Subsystem4/LCC_CONDITIONS/TrueDurationTime10"
 /begin REF_MEASUREMENT autosar_swc_icas_rtARID_DEF.UnitDelay1_DSTATE_ayl autosar_swc_icas_rtARID_DEF.UnitDelay2_DSTATE_fla /end REF_MEASUREMENT
/end GROUP
/begin GROUP autosar_swc_icas_autosar_swc_icas_Step_sys_ICAS_icas_Subsystem4_LCC_CONDITIONS_TrueDurationTime11 "autosar_swc_icas/autosar_swc_icas_Step_sys/ICAS/icas/Subsystem4/LCC_CONDITIONS/TrueDurationTime11"
 /begin REF_MEASUREMENT autosar_swc_icas_rtARID_DEF.UnitDelay1_DSTATE_lg autosar_swc_icas_rtARID_DEF.UnitDelay2_DSTATE_l2 /end REF_MEASUREMENT
/end GROUP
/begin GROUP autosar_swc_icas_autosar_swc_icas_Step_sys_ICAS_icas_Subsystem4_LCC_CONDITIONS_TrueDurationTime12 "autosar_swc_icas/autosar_swc_icas_Step_sys/ICAS/icas/Subsystem4/LCC_CONDITIONS/TrueDurationTime12"
 /begin REF_MEASUREMENT autosar_swc_icas_rtARID_DEF.UnitDelay1_DSTATE_bf0 autosar_swc_icas_rtARID_DEF.UnitDelay2_DSTATE_fo /end REF_MEASUREMENT
/end GROUP
/begin GROUP autosar_swc_icas_autosar_swc_icas_Step_sys_ICAS_icas_Subsystem4_LCC_CONDITIONS_TrueDurationTime13 "autosar_swc_icas/autosar_swc_icas_Step_sys/ICAS/icas/Subsystem4/LCC_CONDITIONS/TrueDurationTime13"
 /begin REF_MEASUREMENT autosar_swc_icas_rtARID_DEF.UnitDelay1_DSTATE_la autosar_swc_icas_rtARID_DEF.UnitDelay2_DSTATE_pq /end REF_MEASUREMENT
/end GROUP
/begin GROUP autosar_swc_icas_autosar_swc_icas_Step_sys_ICAS_icas_Subsystem4_LCC_CONDITIONS_TrueDurationTime14 "autosar_swc_icas/autosar_swc_icas_Step_sys/ICAS/icas/Subsystem4/LCC_CONDITIONS/TrueDurationTime14"
 /begin REF_MEASUREMENT autosar_swc_icas_rtARID_DEF.UnitDelay1_DSTATE_ex autosar_swc_icas_rtARID_DEF.UnitDelay2_DSTATE_d3 /end REF_MEASUREMENT
/end GROUP
/begin GROUP autosar_swc_icas_autosar_swc_icas_Step_sys_ICAS_icas_Subsystem4_LCC_CONDITIONS_TrueDurationTime15 "autosar_swc_icas/autosar_swc_icas_Step_sys/ICAS/icas/Subsystem4/LCC_CONDITIONS/TrueDurationTime15"
 /begin REF_MEASUREMENT autosar_swc_icas_rtARID_DEF.UnitDelay1_DSTATE_iq autosar_swc_icas_rtARID_DEF.UnitDelay2_DSTATE_b2 /end REF_MEASUREMENT
/end GROUP
/begin GROUP autosar_swc_icas_autosar_swc_icas_Step_sys_ICAS_icas_Subsystem4_LCC_CONDITIONS_TrueDurationTime16 "autosar_swc_icas/autosar_swc_icas_Step_sys/ICAS/icas/Subsystem4/LCC_CONDITIONS/TrueDurationTime16"
 /begin REF_MEASUREMENT autosar_swc_icas_rtARID_DEF.UnitDelay1_DSTATE_od autosar_swc_icas_rtARID_DEF.UnitDelay2_DSTATE_pw /end REF_MEASUREMENT
/end GROUP
/begin GROUP autosar_swc_icas_autosar_swc_icas_Step_sys_ICAS_icas_Subsystem4_LCC_CONDITIONS_TrueDurationTime2 "autosar_swc_icas/autosar_swc_icas_Step_sys/ICAS/icas/Subsystem4/LCC_CONDITIONS/TrueDurationTime2"
 /begin REF_MEASUREMENT autosar_swc_icas_rtARID_DEF.UnitDelay1_DSTATE_dy autosar_swc_icas_rtARID_DEF.UnitDelay2_DSTATE_ki /end REF_MEASUREMENT
/end GROUP
/begin GROUP autosar_swc_icas_autosar_swc_icas_Step_sys_ICAS_icas_Subsystem4_LCC_CONDITIONS_TrueDurationTime3 "autosar_swc_icas/autosar_swc_icas_Step_sys/ICAS/icas/Subsystem4/LCC_CONDITIONS/TrueDurationTime3"
 /begin REF_MEASUREMENT autosar_swc_icas_rtARID_DEF.UnitDelay1_DSTATE_bl autosar_swc_icas_rtARID_DEF.UnitDelay2_DSTATE_lh /end REF_MEASUREMENT
/end GROUP
/begin GROUP autosar_swc_icas_autosar_swc_icas_Step_sys_ICAS_icas_Subsystem4_LCC_CONDITIONS_TrueDurationTime4 "autosar_swc_icas/autosar_swc_icas_Step_sys/ICAS/icas/Subsystem4/LCC_CONDITIONS/TrueDurationTime4"
 /begin REF_MEASUREMENT autosar_swc_icas_rtARID_DEF.UnitDelay1_DSTATE_nx autosar_swc_icas_rtARID_DEF.UnitDelay2_DSTATE_hon /end REF_MEASUREMENT
/end GROUP
/begin GROUP autosar_swc_icas_autosar_swc_icas_Step_sys_ICAS_icas_Subsystem4_LCC_CONDITIONS_TrueDurationTime5 "autosar_swc_icas/autosar_swc_icas_Step_sys/ICAS/icas/Subsystem4/LCC_CONDITIONS/TrueDurationTime5"
 /begin REF_MEASUREMENT autosar_swc_icas_rtARID_DEF.UnitDelay1_DSTATE_pe autosar_swc_icas_rtARID_DEF.UnitDelay2_DSTATE_ib /end REF_MEASUREMENT
/end GROUP
/begin GROUP autosar_swc_icas_autosar_swc_icas_Step_sys_ICAS_icas_Subsystem4_LCC_CONDITIONS_TrueDurationTime6 "autosar_swc_icas/autosar_swc_icas_Step_sys/ICAS/icas/Subsystem4/LCC_CONDITIONS/TrueDurationTime6"
 /begin REF_MEASUREMENT autosar_swc_icas_rtARID_DEF.UnitDelay1_DSTATE_oug autosar_swc_icas_rtARID_DEF.UnitDelay2_DSTATE_ge /end REF_MEASUREMENT
/end GROUP
/begin GROUP autosar_swc_icas_autosar_swc_icas_Step_sys_ICAS_icas_Subsystem4_LCC_CONDITIONS_TrueDurationTime7 "autosar_swc_icas/autosar_swc_icas_Step_sys/ICAS/icas/Subsystem4/LCC_CONDITIONS/TrueDurationTime7"
 /begin REF_MEASUREMENT autosar_swc_icas_rtARID_DEF.UnitDelay1_DSTATE_ic autosar_swc_icas_rtARID_DEF.UnitDelay2_DSTATE_oa /end REF_MEASUREMENT
/end GROUP
/begin GROUP autosar_swc_icas_autosar_swc_icas_Step_sys_ICAS_icas_Subsystem4_LCC_CONDITIONS_TrueDurationTime8 "autosar_swc_icas/autosar_swc_icas_Step_sys/ICAS/icas/Subsystem4/LCC_CONDITIONS/TrueDurationTime8"
 /begin REF_MEASUREMENT autosar_swc_icas_rtARID_DEF.UnitDelay1_DSTATE_l5 autosar_swc_icas_rtARID_DEF.UnitDelay2_DSTATE_hi4 /end REF_MEASUREMENT
/end GROUP
/begin GROUP autosar_swc_icas_autosar_swc_icas_Step_sys_ICAS_icas_Subsystem4_LCC_CONDITIONS_TrueDurationTime9 "autosar_swc_icas/autosar_swc_icas_Step_sys/ICAS/icas/Subsystem4/LCC_CONDITIONS/TrueDurationTime9"
 /begin REF_MEASUREMENT autosar_swc_icas_rtARID_DEF.UnitDelay1_DSTATE_hn autosar_swc_icas_rtARID_DEF.UnitDelay2_DSTATE_e5 /end REF_MEASUREMENT
/end GROUP
/begin GROUP autosar_swc_icas_autosar_swc_icas_Step_sys_ICAS_icas_Subsystem4_LCC_STATE_MACHINE "autosar_swc_icas/autosar_swc_icas_Step_sys/ICAS/icas/Subsystem4/LCC_STATE_MACHINE"
 /begin REF_MEASUREMENT autosar_swc_icas_rtARID_DEF.is_Active autosar_swc_icas_rtARID_DEF.is_On_d autosar_swc_icas_rtARID_DEF.is_active_c9_autosar_swc_icas autosar_swc_icas_rtARID_DEF.is_c9_autosar_swc_icas autosar_swc_icas_rtARID_DEF.out_e /end REF_MEASUREMENT
/end GROUP
/begin GROUP autosar_swc_icas_autosar_swc_icas_Step_sys_Subsystem "autosar_swc_icas/autosar_swc_icas_Step_sys/Subsystem"
 /begin SUB_GROUP autosar_swc_icas_autosar_swc_icas_Step_sys_Subsystem_Enabled_Subsystem autosar_swc_icas_autosar_swc_icas_Step_sys_Subsystem_Enlong2s autosar_swc_icas_autosar_swc_icas_Step_sys_Subsystem_TrueDurationTime1 autosar_swc_icas_autosar_swc_icas_Step_sys_Subsystem_TrueDurationTime2 autosar_swc_icas_autosar_swc_icas_Step_sys_Subsystem_TrueDurationTime3 autosar_swc_icas_autosar_swc_icas_Step_sys_Subsystem_TrueDurationTime4 autosar_swc_icas_autosar_swc_icas_Step_sys_Subsystem_TrueDurationTime5 /end SUB_GROUP
 /begin REF_MEASUREMENT autosar_swc_icas_rtARID_DEF.In1 autosar_swc_icas_rtARID_DEF.i_e autosar_swc_icas_rtARID_DEF.is_On autosar_swc_icas_rtARID_DEF.is_active_c17_autosar_swc_icas autosar_swc_icas_rtARID_DEF.is_active_c19_autosar_swc_icas autosar_swc_icas_rtARID_DEF.is_active_c48_autosar_swc_icas autosar_swc_icas_rtARID_DEF.is_c17_autosar_swc_icas autosar_swc_icas_rtARID_DEF.is_c19_autosar_swc_icas autosar_swc_icas_rtARID_DEF.is_c48_autosar_swc_icas autosar_swc_icas_rtARID_DEF.out_nm /end REF_MEASUREMENT
/end GROUP
/begin GROUP autosar_swc_icas_autosar_swc_icas_Step_sys_Subsystem_Enabled_Subsystem "autosar_swc_icas/autosar_swc_icas_Step_sys/Subsystem/Enabled\nSubsystem" /begin REF_MEASUREMENT autosar_swc_icas_rtARID_DEF.In1 /end REF_MEASUREMENT /end GROUP
/begin GROUP autosar_swc_icas_autosar_swc_icas_Step_sys_Subsystem_Enlong2s "autosar_swc_icas/autosar_swc_icas_Step_sys/Subsystem/Enlong2s"
 /begin SUB_GROUP autosar_swc_icas_autosar_swc_icas_Step_sys_Subsystem_Enlong2s_SignalChange /end SUB_GROUP
 /begin REF_MEASUREMENT autosar_swc_icas_rtARID_DEF.UnitDelay2_DSTATE_oh autosar_swc_icas_rtARID_DEF.UnitDelay3_DSTATE_eq autosar_swc_icas_rtARID_DEF.UnitDelay_DSTATE_mb /end REF_MEASUREMENT
/end GROUP
/begin GROUP autosar_swc_icas_autosar_swc_icas_Step_sys_Subsystem_Enlong2s_SignalChange "autosar_swc_icas/autosar_swc_icas_Step_sys/Subsystem/Enlong2s/SignalChange"
 /begin SUB_GROUP autosar_swc_icas_autosar_swc_icas_Step_sys_Subsystem_Enlong2s_SignalChange_Detect_Decrease autosar_swc_icas_autosar_swc_icas_Step_sys_Subsystem_Enlong2s_SignalChange_Detect_Increase3 /end SUB_GROUP
/end GROUP
/begin GROUP autosar_swc_icas_autosar_swc_icas_Step_sys_Subsystem_Enlong2s_SignalChange_Detect_Decrease "autosar_swc_icas/autosar_swc_icas_Step_sys/Subsystem/Enlong2s/SignalChange/Detect\nDecrease" /begin REF_MEASUREMENT autosar_swc_icas_rtARID_DEF.DelayInput1_DSTATE_lo /end REF_MEASUREMENT /end GROUP
/begin GROUP autosar_swc_icas_autosar_swc_icas_Step_sys_Subsystem_Enlong2s_SignalChange_Detect_Increase3 "autosar_swc_icas/autosar_swc_icas_Step_sys/Subsystem/Enlong2s/SignalChange/Detect\nIncrease3" /begin REF_MEASUREMENT autosar_swc_icas_rtARID_DEF.DelayInput1_DSTATE_lr /end REF_MEASUREMENT /end GROUP
/begin GROUP autosar_swc_icas_autosar_swc_icas_Step_sys_Subsystem_TrueDurationTime1 "autosar_swc_icas/autosar_swc_icas_Step_sys/Subsystem/TrueDurationTime1"
 /begin REF_MEASUREMENT autosar_swc_icas_rtARID_DEF.UnitDelay1_DSTATE_nw autosar_swc_icas_rtARID_DEF.UnitDelay2_DSTATE_iu /end REF_MEASUREMENT
/end GROUP
/begin GROUP autosar_swc_icas_autosar_swc_icas_Step_sys_Subsystem_TrueDurationTime2 "autosar_swc_icas/autosar_swc_icas_Step_sys/Subsystem/TrueDurationTime2"
 /begin REF_MEASUREMENT autosar_swc_icas_rtARID_DEF.UnitDelay1_DSTATE_ke autosar_swc_icas_rtARID_DEF.UnitDelay2_DSTATE_flg /end REF_MEASUREMENT
/end GROUP
/begin GROUP autosar_swc_icas_autosar_swc_icas_Step_sys_Subsystem_TrueDurationTime3 "autosar_swc_icas/autosar_swc_icas_Step_sys/Subsystem/TrueDurationTime3"
 /begin REF_MEASUREMENT autosar_swc_icas_rtARID_DEF.UnitDelay1_DSTATE_nk autosar_swc_icas_rtARID_DEF.UnitDelay2_DSTATE_ei /end REF_MEASUREMENT
/end GROUP
/begin GROUP autosar_swc_icas_autosar_swc_icas_Step_sys_Subsystem_TrueDurationTime4 "autosar_swc_icas/autosar_swc_icas_Step_sys/Subsystem/TrueDurationTime4"
 /begin REF_MEASUREMENT autosar_swc_icas_rtARID_DEF.UnitDelay1_DSTATE_el autosar_swc_icas_rtARID_DEF.UnitDelay2_DSTATE_kt /end REF_MEASUREMENT
/end GROUP
/begin GROUP autosar_swc_icas_autosar_swc_icas_Step_sys_Subsystem_TrueDurationTime5 "autosar_swc_icas/autosar_swc_icas_Step_sys/Subsystem/TrueDurationTime5"
 /begin REF_MEASUREMENT autosar_swc_icas_rtARID_DEF.UnitDelay1_DSTATE_nl autosar_swc_icas_rtARID_DEF.UnitDelay2_DSTATE_bws /end REF_MEASUREMENT
/end GROUP
/begin GROUP autosar_swc_icas_rtARID_DEF.TmpSignalConversionAtVAL_VEHICLE_STATEOutport1 ""
 /begin REF_MEASUREMENT autosar_swc_icas_rtARID_DEF.TmpSignalConversionAtVAL_VEHICLE_STATEOutport1.VehStandstill autosar_swc_icas_rtARID_DEF.TmpSignalConversionAtVAL_VEHICLE_STATEOutport1.EngineOn autosar_swc_icas_rtARID_DEF.TmpSignalConversionAtVAL_VEHICLE_STATEOutport1.FAShiftInProgress autosar_swc_icas_rtARID_DEF.TmpSignalConversionAtVAL_VEHICLE_STATEOutport1.RAShiftInProgress autosar_swc_icas_rtARID_DEF.TmpSignalConversionAtVAL_VEHICLE_STATEOutport1.NoBrakeForce autosar_swc_icas_rtARID_DEF.TmpSignalConversionAtVAL_VEHICLE_STATEOutport1.VLC_InternalTargetAccelerationValid autosar_swc_icas_rtARID_DEF.TmpSignalConversionAtVAL_VEHICLE_STATEOutport1.BlindTemp autosar_swc_icas_rtARID_DEF.TmpSignalConversionAtVAL_VEHICLE_STATEOutport1.WheelPulseCounterValid autosar_swc_icas_rtARID_DEF.TmpSignalConversionAtVAL_VEHICLE_STATEOutport1.CurrentGear autosar_swc_icas_rtARID_DEF.TmpSignalConversionAtVAL_VEHICLE_STATEOutport1.TargetGear autosar_swc_icas_rtARID_DEF.TmpSignalConversionAtVAL_VEHICLE_STATEOutport1.GearSts autosar_swc_icas_rtARID_DEF.TmpSignalConversionAtVAL_VEHICLE_STATEOutport1.SysPowerMod autosar_swc_icas_rtARID_DEF.TmpSignalConversionAtVAL_VEHICLE_STATEOutport1.IPVehSpdUnit autosar_swc_icas_rtARID_DEF.TmpSignalConversionAtVAL_VEHICLE_STATEOutport1.IPVehSpdDispKph autosar_swc_icas_rtARID_DEF.TmpSignalConversionAtVAL_VEHICLE_STATEOutport1.IPVehSpdDispMph autosar_swc_icas_rtARID_DEF.TmpSignalConversionAtVAL_VEHICLE_STATEOutport1.FourWhlsBrkTrq autosar_swc_icas_rtARID_DEF.TmpSignalConversionAtVAL_VEHICLE_STATEOutport1.MaxEngTrqNorm autosar_swc_icas_rtARID_DEF.TmpSignalConversionAtVAL_VEHICLE_STATEOutport1.VehSpdKph autosar_swc_icas_rtARID_DEF.TmpSignalConversionAtVAL_VEHICLE_STATEOutport1.IPVehSpdDispKphFloat autosar_swc_icas_rtARID_DEF.TmpSignalConversionAtVAL_VEHICLE_STATEOutport1.SteerWheelAngle autosar_swc_icas_rtARID_DEF.TmpSignalConversionAtVAL_VEHICLE_STATEOutport1.SteerWheelSpd autosar_swc_icas_rtARID_DEF.TmpSignalConversionAtVAL_VEHICLE_STATEOutport1.SteerWheelTor autosar_swc_icas_rtARID_DEF.TmpSignalConversionAtVAL_VEHICLE_STATEOutport1.MasterCylBrkPress autosar_swc_icas_rtARID_DEF.TmpSignalConversionAtVAL_VEHICLE_STATEOutport1.WheelTrqNm autosar_swc_icas_rtARID_DEF.TmpSignalConversionAtVAL_VEHICLE_STATEOutport1.WheelTrqMinNm autosar_swc_icas_rtARID_DEF.TmpSignalConversionAtVAL_VEHICLE_STATEOutport1.VCUTrqNm autosar_swc_icas_rtARID_DEF.TmpSignalConversionAtVAL_VEHICLE_STATEOutport1.EngTrqNm autosar_swc_icas_rtARID_DEF.TmpSignalConversionAtVAL_VEHICLE_STATEOutport1.EngTrqMinNm autosar_swc_icas_rtARID_DEF.TmpSignalConversionAtVAL_VEHICLE_STATEOutport1.LKACtrDlvdValue autosar_swc_icas_rtARID_DEF.TmpSignalConversionAtVAL_VEHICLE_STATEOutport1.NetEngTrq autosar_swc_icas_rtARID_DEF.TmpSignalConversionAtVAL_VEHICLE_STATEOutport1.EngTrqMinAct autosar_swc_icas_rtARID_DEF.TmpSignalConversionAtVAL_VEHICLE_STATEOutport1.EngSpd autosar_swc_icas_rtARID_DEF.TmpSignalConversionAtVAL_VEHICLE_STATEOutport1.FLWheelSpdMps autosar_swc_icas_rtARID_DEF.TmpSignalConversionAtVAL_VEHICLE_STATEOutport1.FRWheelSpdMps autosar_swc_icas_rtARID_DEF.TmpSignalConversionAtVAL_VEHICLE_STATEOutport1.RLWheelSpdMps autosar_swc_icas_rtARID_DEF.TmpSignalConversionAtVAL_VEHICLE_STATEOutport1.RRWheelSpdMps autosar_swc_icas_rtARID_DEF.TmpSignalConversionAtVAL_VEHICLE_STATEOutport1.SensorVehYawRateRadps autosar_swc_icas_rtARID_DEF.TmpSignalConversionAtVAL_VEHICLE_STATEOutport1.SensorVehLonAccelMps2 autosar_swc_icas_rtARID_DEF.TmpSignalConversionAtVAL_VEHICLE_STATEOutport1.SensorVehLatAccelMps2 autosar_swc_icas_rtARID_DEF.TmpSignalConversionAtVAL_VEHICLE_STATEOutport1.VLC_InternalTargetAcceleration autosar_swc_icas_rtARID_DEF.TmpSignalConversionAtVAL_VEHICLE_STATEOutport1.TotalOdometer_km autosar_swc_icas_rtARID_DEF.TmpSignalConversionAtVAL_VEHICLE_STATEOutport1.FLWheelPulseCounter autosar_swc_icas_rtARID_DEF.TmpSignalConversionAtVAL_VEHICLE_STATEOutport1.FRWheelPulseCounter autosar_swc_icas_rtARID_DEF.TmpSignalConversionAtVAL_VEHICLE_STATEOutport1.RLWheelPulseCounter autosar_swc_icas_rtARID_DEF.TmpSignalConversionAtVAL_VEHICLE_STATEOutport1.RRWheelPulseCounter autosar_swc_icas_rtARID_DEF.TmpSignalConversionAtVAL_VEHICLE_STATEOutport1.TimeStampMs /end REF_MEASUREMENT
/end GROUP
/begin CHARACTERISTIC ZDrive_BSW_Cal_Cal.ZDrive_BSW_Cal_VehicleInfomationTable.ActiveType "" VALUE 0x3d806d Record_UBYTE 0 autosar_swc_las_CM_uint8 0 255 /end CHARACTERISTIC
/begin CHARACTERISTIC ZDrive_BSW_Cal_Cal.ZDrive_BSW_Cal_VehicleInfomationTable.Country_Code "" VALUE 0x3d8068 Record_UBYTE 0 autosar_swc_las_CM_uint8 0 255 /end CHARACTERISTIC
/begin CHARACTERISTIC ZDrive_BSW_Cal_Cal.ZDrive_BSW_Cal_VehicleInfomationTable.DrivingLongControlInterForm "" VALUE 0x3d8071 Record_UBYTE 0 autosar_swc_las_CM_uint8 0 255 /end CHARACTERISTIC
/begin CHARACTERISTIC ZDrive_BSW_Cal_Cal.ZDrive_BSW_Cal_VehicleInfomationTable.EPS_Inter "" VALUE 0x3d8070 Record_UBYTE 0 autosar_swc_las_CM_uint8 0 255 /end CHARACTERISTIC
/begin CHARACTERISTIC ZDrive_BSW_Cal_Cal.ZDrive_BSW_Cal_VehicleInfomationTable.ESP_Type "" VALUE 0x3d806b Record_UBYTE 0 autosar_swc_las_CM_uint8 0 255 /end CHARACTERISTIC
/begin CHARACTERISTIC ZDrive_BSW_Cal_Cal.ZDrive_BSW_Cal_VehicleInfomationTable.Engine_Type "" VALUE 0x3d806f Record_UBYTE 0 autosar_swc_las_CM_uint8 0 255 /end CHARACTERISTIC
/begin CHARACTERISTIC ZDrive_BSW_Cal_Cal.ZDrive_BSW_Cal_VehicleInfomationTable.Gear_Box "" VALUE 0x3d806e Record_UBYTE 0 autosar_swc_las_CM_uint8 0 255 /end CHARACTERISTIC
/begin CHARACTERISTIC ZDrive_BSW_Cal_Cal.ZDrive_BSW_Cal_VehicleInfomationTable.PowerType "" VALUE 0x3d806a Record_UBYTE 0 autosar_swc_las_CM_uint8 0 255 /end CHARACTERISTIC
/begin CHARACTERISTIC ZDrive_BSW_Cal_Cal.ZDrive_BSW_Cal_VehicleInfomationTable.TurnLevelType "" VALUE 0x3d806c Record_UBYTE 0 autosar_swc_las_CM_uint8 0 255 /end CHARACTERISTIC
/begin CHARACTERISTIC ZDrive_BSW_Cal_Cal.ZDrive_BSW_Cal_VehicleInfomationTable.VehConfig_Code1 "" VALUE 0x3d8060 Record_ULONG 0 autosar_swc_las_CM_uint32 0 4294967295 /end CHARACTERISTIC
/begin CHARACTERISTIC ZDrive_BSW_Cal_Cal.ZDrive_BSW_Cal_VehicleInfomationTable.VehConfig_Code2 "" VALUE 0x3d8064 Record_ULONG 0 autosar_swc_las_CM_uint32 0 4294967295 /end CHARACTERISTIC
/begin CHARACTERISTIC ZDrive_BSW_Cal_Cal.ZDrive_BSW_Cal_VehicleInfomationTable.Vehicle_Model "" VALUE 0x3d8069 Record_UBYTE 0 autosar_swc_las_CM_uint8 0 255 /end CHARACTERISTIC
/begin MEASUREMENT LSS_ExecTimestamp.nanoseconds "" ULONG autosar_swc_las_CM_uint32 0 0 0 4294967295 ECU_ADDRESS 0xfe4adbac /* @ECU_Address@LSS_ExecTimestamp.nanoseconds@ */ /end MEASUREMENT
/begin MEASUREMENT LSS_ExecTimestamp.seconds "" A_UINT64 autosar_swc_las_CM_uint64 0 0 0 18446744073709551615 ECU_ADDRESS 0xfe4adbb0 /* @ECU_Address@LSS_ExecTimestamp.seconds@ */ /end MEASUREMENT
/begin MEASUREMENT LSS_ExecTimestamp.timeBaseStatus "" UBYTE autosar_swc_las_CM_uint8 0 0 0 255 ECU_ADDRESS 0xfe4adba8 /* @ECU_Address@LSS_ExecTimestamp.timeBaseStatus@ */ /end MEASUREMENT
/begin MEASUREMENT SwcOut_LAS_CTRL.A0 "" FLOAT32_IEEE autosar_swc_las_CM_single 0 0 -3.4E+38 3.4E+38 ECU_ADDRESS 0xfe4adbbc /* @ECU_Address@SwcOut_LAS_CTRL.A0@ */ /end MEASUREMENT
/begin MEASUREMENT SwcOut_LAS_CTRL.A1 "" FLOAT32_IEEE autosar_swc_las_CM_single 0 0 -3.4E+38 3.4E+38 ECU_ADDRESS 0xfe4adbc0 /* @ECU_Address@SwcOut_LAS_CTRL.A1@ */ /end MEASUREMENT
/begin MEASUREMENT SwcOut_LAS_CTRL.A2 "" FLOAT32_IEEE autosar_swc_las_CM_single 0 0 -3.4E+38 3.4E+38 ECU_ADDRESS 0xfe4adbc4 /* @ECU_Address@SwcOut_LAS_CTRL.A2@ */ /end MEASUREMENT
/begin MEASUREMENT SwcOut_LAS_CTRL.A3 "" FLOAT32_IEEE autosar_swc_las_CM_single 0 0 -3.4E+38 3.4E+38 ECU_ADDRESS 0xfe4adbc8 /* @ECU_Address@SwcOut_LAS_CTRL.A3@ */ /end MEASUREMENT
/begin MEASUREMENT SwcOut_LAS_CTRL.Range "" FLOAT32_IEEE autosar_swc_las_CM_single 0 0 -3.4E+38 3.4E+38 ECU_ADDRESS 0xfe4adbcc /* @ECU_Address@SwcOut_LAS_CTRL.Range@ */ /end MEASUREMENT
/begin MEASUREMENT SwcOut_LAS_CTRL.Valid "" UBYTE autosar_swc_las_CM_boolean 0 0 0 1 ECU_ADDRESS 0xfe4adbb8 /* @ECU_Address@SwcOut_LAS_CTRL.Valid@ */ /end MEASUREMENT
/begin MEASUREMENT SwcOut_LAS_HMI.ELK_Con_Active2ReadyBit "" ULONG autosar_swc_las_CM_uint32 0 0 0 4294967295 ECU_ADDRESS 0xfe4ae644 /* @ECU_Address@SwcOut_LAS_HMI.ELK_Con_Active2ReadyBit@ */ /end MEASUREMENT
/begin MEASUREMENT SwcOut_LAS_HMI.ELK_Con_Idle2ReadyBit "" ULONG autosar_swc_las_CM_uint32 0 0 0 4294967295 ECU_ADDRESS 0xfe4ae63c /* @ECU_Address@SwcOut_LAS_HMI.ELK_Con_Idle2ReadyBit@ */ /end MEASUREMENT
/begin MEASUREMENT SwcOut_LAS_HMI.ELK_Con_Other2IdleBit "" ULONG autosar_swc_las_CM_uint32 0 0 0 4294967295 ECU_ADDRESS 0xfe4ae648 /* @ECU_Address@SwcOut_LAS_HMI.ELK_Con_Other2IdleBit@ */ /end MEASUREMENT
/begin MEASUREMENT SwcOut_LAS_HMI.ELK_Warn "" UBYTE autosar_swc_las_CM_uint8 0 0 0 255 ECU_ADDRESS 0xfe4ae611 /* @ECU_Address@SwcOut_LAS_HMI.ELK_Warn@ */ /end MEASUREMENT
/begin MEASUREMENT SwcOut_LAS_HMI.ELk_Con_Ready2ActiveBit "" ULONG autosar_swc_las_CM_uint32 0 0 0 4294967295 ECU_ADDRESS 0xfe4ae640 /* @ECU_Address@SwcOut_LAS_HMI.ELk_Con_Ready2ActiveBit@ */ /end MEASUREMENT
/begin MEASUREMENT SwcOut_LAS_HMI.FLWhelDy "" FLOAT32_IEEE autosar_swc_las_CM_single 0 0 -3.4E+38 3.4E+38 ECU_ADDRESS 0xfe4ae614 /* @ECU_Address@SwcOut_LAS_HMI.FLWhelDy@ */ /end MEASUREMENT
/begin MEASUREMENT SwcOut_LAS_HMI.FRWhelDy "" FLOAT32_IEEE autosar_swc_las_CM_single 0 0 -3.4E+38 3.4E+38 ECU_ADDRESS 0xfe4ae618 /* @ECU_Address@SwcOut_LAS_HMI.FRWhelDy@ */ /end MEASUREMENT
/begin MEASUREMENT SwcOut_LAS_HMI.HandsOffWarnLevel "" UBYTE autosar_swc_las_CM_uint8 0 0 0 255 ECU_ADDRESS 0xfe4ae612 /* @ECU_Address@SwcOut_LAS_HMI.HandsOffWarnLevel@ */ /end MEASUREMENT
/begin MEASUREMENT SwcOut_LAS_HMI.LDP_Con_Active2ReadyBit "" ULONG autosar_swc_las_CM_uint32 0 0 0 4294967295 ECU_ADDRESS 0xfe4ae624 /* @ECU_Address@SwcOut_LAS_HMI.LDP_Con_Active2ReadyBit@ */ /end MEASUREMENT
/begin MEASUREMENT SwcOut_LAS_HMI.LDP_Con_Idle2ReadyBit "" ULONG autosar_swc_las_CM_uint32 0 0 0 4294967295 ECU_ADDRESS 0xfe4ae61c /* @ECU_Address@SwcOut_LAS_HMI.LDP_Con_Idle2ReadyBit@ */ /end MEASUREMENT
/begin MEASUREMENT SwcOut_LAS_HMI.LDP_Con_Other2IdleBit "" ULONG autosar_swc_las_CM_uint32 0 0 0 4294967295 ECU_ADDRESS 0xfe4ae628 /* @ECU_Address@SwcOut_LAS_HMI.LDP_Con_Other2IdleBit@ */ /end MEASUREMENT
/begin MEASUREMENT SwcOut_LAS_HMI.LDP_Con_Ready2ActiveBit "" ULONG autosar_swc_las_CM_uint32 0 0 0 4294967295 ECU_ADDRESS 0xfe4ae620 /* @ECU_Address@SwcOut_LAS_HMI.LDP_Con_Ready2ActiveBit@ */ /end MEASUREMENT
/begin MEASUREMENT SwcOut_LAS_HMI.LDW_Con_Active2ReadyBit "" ULONG autosar_swc_las_CM_uint32 0 0 0 4294967295 ECU_ADDRESS 0xfe4ae634 /* @ECU_Address@SwcOut_LAS_HMI.LDW_Con_Active2ReadyBit@ */ /end MEASUREMENT
/begin MEASUREMENT SwcOut_LAS_HMI.LDW_Con_Idle2ReadyBit "" ULONG autosar_swc_las_CM_uint32 0 0 0 4294967295 ECU_ADDRESS 0xfe4ae62c /* @ECU_Address@SwcOut_LAS_HMI.LDW_Con_Idle2ReadyBit@ */ /end MEASUREMENT
/begin MEASUREMENT SwcOut_LAS_HMI.LDW_Con_Other2IdleBit "" ULONG autosar_swc_las_CM_uint32 0 0 0 4294967295 ECU_ADDRESS 0xfe4ae638 /* @ECU_Address@SwcOut_LAS_HMI.LDW_Con_Other2IdleBit@ */ /end MEASUREMENT
/begin MEASUREMENT SwcOut_LAS_HMI.LDW_Con_Ready2ActiveBit "" ULONG autosar_swc_las_CM_uint32 0 0 0 4294967295 ECU_ADDRESS 0xfe4ae630 /* @ECU_Address@SwcOut_LAS_HMI.LDW_Con_Ready2ActiveBit@ */ /end MEASUREMENT
/begin MEASUREMENT SwcOut_LAS_HMI.LKA_Warn "" UBYTE autosar_swc_las_CM_uint8 0 0 0 255 ECU_ADDRESS 0xfe4ae610 /* @ECU_Address@SwcOut_LAS_HMI.LKA_Warn@ */ /end MEASUREMENT
/begin MEASUREMENT SwcOut_LAS_Herbeat_info.inner_error "" ULONG autosar_swc_las_CM_uint32 0 0 0 4294967295 ECU_ADDRESS 0xfe4ae650 /* @ECU_Address@SwcOut_LAS_Herbeat_info.inner_error@ */ /end MEASUREMENT
/begin MEASUREMENT SwcOut_LAS_Herbeat_info.module_status "" UBYTE autosar_swc_las_CM_SM_MODULE_STATUS 0 0 0 3 ECU_ADDRESS 0xfe4ae654 /* @ECU_Address@SwcOut_LAS_Herbeat_info.module_status@ */ /end MEASUREMENT
/begin MEASUREMENT SwcOut_LAS_Herbeat_info.sequence_num "" UBYTE autosar_swc_las_CM_uint8 0 0 0 255 ECU_ADDRESS 0xfe4ae64d /* @ECU_Address@SwcOut_LAS_Herbeat_info.sequence_num@ */ /end MEASUREMENT
/begin MEASUREMENT SwcOut_LAS_Herbeat_info.swc_id "" UBYTE autosar_swc_las_CM_uint8 0 0 0 255 ECU_ADDRESS 0xfe4ae64c /* @ECU_Address@SwcOut_LAS_Herbeat_info.swc_id@ */ /end MEASUREMENT
/begin MEASUREMENT SwcOut_LAS_STATE.ELKSts "" UBYTE autosar_swc_las_CM_uint8 0 0 0 255 ECU_ADDRESS 0xfe4ae6f4 /* @ECU_Address@SwcOut_LAS_STATE.ELKSts@ */ /end MEASUREMENT
/begin MEASUREMENT SwcOut_LAS_STATE.LDPSts "" UBYTE autosar_swc_las_CM_uint8 0 0 0 255 ECU_ADDRESS 0xfe4ae6f2 /* @ECU_Address@SwcOut_LAS_STATE.LDPSts@ */ /end MEASUREMENT
/begin MEASUREMENT SwcOut_LAS_STATE.LDWSts "" UBYTE autosar_swc_las_CM_uint8 0 0 0 255 ECU_ADDRESS 0xfe4ae6f3 /* @ECU_Address@SwcOut_LAS_STATE.LDWSts@ */ /end MEASUREMENT
/begin COMPU_METHOD autosar_swc_las_CM_SM_MODULE_STATUS "Enumerated data type: SM_MODULE_STATUS" TAB_VERB "%0.6" "" COMPU_TAB_REF VTAB_FOR_autosar_swc_las_CM_SM_MODULE_STATUS /end COMPU_METHOD
/begin COMPU_VTAB VTAB_FOR_autosar_swc_las_CM_SM_MODULE_STATUS "Enumerated data type: SM_MODULE_STATUS" TAB_VERB 4 0 "STATUS_NORMAL" 1 "STATUS_NOT_CONNECTED" 2 "STATUS_HEARTBEAT_MISSED" 3 "STATUS_ABNORMAL" /end COMPU_VTAB
/begin COMPU_METHOD autosar_swc_las_CM_boolean "Q = V" IDENTICAL "%1.0" "" /end COMPU_METHOD
/begin COMPU_METHOD autosar_swc_las_CM_single "Q = V" IDENTICAL "%8.6" "" /end COMPU_METHOD
/begin COMPU_METHOD autosar_swc_las_CM_uint32 "Q = V" IDENTICAL "%10.0" "" /end COMPU_METHOD
/begin COMPU_METHOD autosar_swc_las_CM_uint64 "Q = V" IDENTICAL "%20.0" "" /end COMPU_METHOD
/begin COMPU_METHOD autosar_swc_las_CM_uint8 "Q = V" IDENTICAL "%3.0" "" /end COMPU_METHOD
/begin RECORD_LAYOUT Record_BOOLEAN FNC_VALUES 1 UBYTE COLUMN_DIR DIRECT /end RECORD_LAYOUT
/begin RECORD_LAYOUT Record_FLOAT32_IEEE FNC_VALUES 1 FLOAT32_IEEE COLUMN_DIR DIRECT /end RECORD_LAYOUT
/begin RECORD_LAYOUT Record_UBYTE FNC_VALUES 1 UBYTE COLUMN_DIR DIRECT /end RECORD_LAYOUT
/begin RECORD_LAYOUT Record_ULONG FNC_VALUES 1 ULONG COLUMN_DIR DIRECT /end RECORD_LAYOUT
/begin RECORD_LAYOUT Record_UWORD FNC_VALUES 1 UWORD COLUMN_DIR DIRECT /end RECORD_LAYOUT
/begin RECORD_LAYOUT Axis_FLOAT32_IEEE AXIS_PTS_X 1 FLOAT32_IEEE INDEX_INCR DIRECT /end RECORD_LAYOUT
/begin GROUP LSS_ExecTimestamp ""
 /begin REF_MEASUREMENT LSS_ExecTimestamp.timeBaseStatus LSS_ExecTimestamp.nanoseconds LSS_ExecTimestamp.seconds /end REF_MEASUREMENT
/end GROUP
/begin GROUP SwcOut_LAS_CTRL ""
 /begin REF_MEASUREMENT SwcOut_LAS_CTRL.Valid SwcOut_LAS_CTRL.A0 SwcOut_LAS_CTRL.A1 SwcOut_LAS_CTRL.A2 SwcOut_LAS_CTRL.A3 SwcOut_LAS_CTRL.Range /end REF_MEASUREMENT
/end GROUP
/begin GROUP SwcOut_LAS_HMI ""
 /begin REF_MEASUREMENT SwcOut_LAS_HMI.LKA_Warn SwcOut_LAS_HMI.ELK_Warn SwcOut_LAS_HMI.HandsOffWarnLevel SwcOut_LAS_HMI.FLWhelDy SwcOut_LAS_HMI.FRWhelDy SwcOut_LAS_HMI.LDP_Con_Idle2ReadyBit SwcOut_LAS_HMI.LDP_Con_Ready2ActiveBit SwcOut_LAS_HMI.LDP_Con_Active2ReadyBit SwcOut_LAS_HMI.LDP_Con_Other2IdleBit SwcOut_LAS_HMI.LDW_Con_Idle2ReadyBit SwcOut_LAS_HMI.LDW_Con_Ready2ActiveBit SwcOut_LAS_HMI.LDW_Con_Active2ReadyBit SwcOut_LAS_HMI.LDW_Con_Other2IdleBit SwcOut_LAS_HMI.ELK_Con_Idle2ReadyBit SwcOut_LAS_HMI.ELk_Con_Ready2ActiveBit SwcOut_LAS_HMI.ELK_Con_Active2ReadyBit SwcOut_LAS_HMI.ELK_Con_Other2IdleBit /end REF_MEASUREMENT
/end GROUP
/begin GROUP SwcOut_LAS_Herbeat_info ""
 /begin REF_MEASUREMENT SwcOut_LAS_Herbeat_info.swc_id SwcOut_LAS_Herbeat_info.sequence_num SwcOut_LAS_Herbeat_info.inner_error SwcOut_LAS_Herbeat_info.module_status /end REF_MEASUREMENT
/end GROUP
/begin GROUP SwcOut_LAS_STATE ""
 /begin REF_MEASUREMENT SwcOut_LAS_STATE.LDPSts SwcOut_LAS_STATE.LDWSts SwcOut_LAS_STATE.ELKSts /end REF_MEASUREMENT
/end GROUP
/begin GROUP ZDrive_BSW_Cal_Cal "" /begin SUB_GROUP ZDrive_BSW_Cal_Cal.ZDrive_BSW_Cal_VehicleInfomationTable /end SUB_GROUP /end GROUP
/begin GROUP ZDrive_BSW_Cal_Cal.ZDrive_BSW_Cal_VehicleInfomationTable ""
 /begin REF_CHARACTERISTIC ZDrive_BSW_Cal_Cal.ZDrive_BSW_Cal_VehicleInfomationTable.VehConfig_Code1 ZDrive_BSW_Cal_Cal.ZDrive_BSW_Cal_VehicleInfomationTable.VehConfig_Code2 ZDrive_BSW_Cal_Cal.ZDrive_BSW_Cal_VehicleInfomationTable.Country_Code ZDrive_BSW_Cal_Cal.ZDrive_BSW_Cal_VehicleInfomationTable.Vehicle_Model ZDrive_BSW_Cal_Cal.ZDrive_BSW_Cal_VehicleInfomationTable.PowerType ZDrive_BSW_Cal_Cal.ZDrive_BSW_Cal_VehicleInfomationTable.ESP_Type ZDrive_BSW_Cal_Cal.ZDrive_BSW_Cal_VehicleInfomationTable.TurnLevelType ZDrive_BSW_Cal_Cal.ZDrive_BSW_Cal_VehicleInfomationTable.ActiveType ZDrive_BSW_Cal_Cal.ZDrive_BSW_Cal_VehicleInfomationTable.Gear_Box ZDrive_BSW_Cal_Cal.ZDrive_BSW_Cal_VehicleInfomationTable.Engine_Type ZDrive_BSW_Cal_Cal.ZDrive_BSW_Cal_VehicleInfomationTable.EPS_Inter ZDrive_BSW_Cal_Cal.ZDrive_BSW_Cal_VehicleInfomationTable.DrivingLongControlInterForm /end REF_CHARACTERISTIC
/end GROUP
/begin RECORD_LAYOUT Record_BOOLEAN FNC_VALUES 1 UBYTE COLUMN_DIR DIRECT /end RECORD_LAYOUT
/begin RECORD_LAYOUT Record_FLOAT32_IEEE FNC_VALUES 1 FLOAT32_IEEE COLUMN_DIR DIRECT /end RECORD_LAYOUT
/begin RECORD_LAYOUT Record_UBYTE FNC_VALUES 1 UBYTE COLUMN_DIR DIRECT /end RECORD_LAYOUT
/begin RECORD_LAYOUT Record_ULONG FNC_VALUES 1 ULONG COLUMN_DIR DIRECT /end RECORD_LAYOUT
/begin RECORD_LAYOUT Record_UWORD FNC_VALUES 1 UWORD COLUMN_DIR DIRECT /end RECORD_LAYOUT
/begin RECORD_LAYOUT Axis_FLOAT32_IEEE AXIS_PTS_X 1 FLOAT32_IEEE INDEX_INCR DIRECT /end RECORD_LAYOUT
/begin GROUP ZDrive_BSW_Cal_Cal.ZDrive_BSW_Cal_VehicleInfomationTable ""
 /begin REF_CHARACTERISTIC ZDrive_BSW_Cal_Cal.ZDrive_BSW_Cal_VehicleInfomationTable.VehConfig_Code1 ZDrive_BSW_Cal_Cal.ZDrive_BSW_Cal_VehicleInfomationTable.VehConfig_Code2 ZDrive_BSW_Cal_Cal.ZDrive_BSW_Cal_VehicleInfomationTable.Country_Code ZDrive_BSW_Cal_Cal.ZDrive_BSW_Cal_VehicleInfomationTable.Vehicle_Model ZDrive_BSW_Cal_Cal.ZDrive_BSW_Cal_VehicleInfomationTable.PowerType ZDrive_BSW_Cal_Cal.ZDrive_BSW_Cal_VehicleInfomationTable.ESP_Type ZDrive_BSW_Cal_Cal.ZDrive_BSW_Cal_VehicleInfomationTable.TurnLevelType ZDrive_BSW_Cal_Cal.ZDrive_BSW_Cal_VehicleInfomationTable.ActiveType ZDrive_BSW_Cal_Cal.ZDrive_BSW_Cal_VehicleInfomationTable.Gear_Box ZDrive_BSW_Cal_Cal.ZDrive_BSW_Cal_VehicleInfomationTable.Engine_Type ZDrive_BSW_Cal_Cal.ZDrive_BSW_Cal_VehicleInfomationTable.EPS_Inter ZDrive_BSW_Cal_Cal.ZDrive_BSW_Cal_VehicleInfomationTable.DrivingLongControlInterForm /end REF_CHARACTERISTIC
/end GROUP
/begin RECORD_LAYOUT Record_BOOLEAN FNC_VALUES 1 UBYTE COLUMN_DIR DIRECT /end RECORD_LAYOUT
/begin RECORD_LAYOUT Record_FLOAT32_IEEE FNC_VALUES 1 FLOAT32_IEEE COLUMN_DIR DIRECT /end RECORD_LAYOUT
/begin RECORD_LAYOUT Record_UBYTE FNC_VALUES 1 UBYTE COLUMN_DIR DIRECT /end RECORD_LAYOUT
/begin RECORD_LAYOUT Record_ULONG FNC_VALUES 1 ULONG COLUMN_DIR DIRECT /end RECORD_LAYOUT
/begin RECORD_LAYOUT Record_UWORD FNC_VALUES 1 UWORD COLUMN_DIR DIRECT /end RECORD_LAYOUT
/begin GROUP ZDrive_BSW_Cal_Cal.ZDrive_BSW_Cal_VehicleInfomationTable ""
 /begin REF_CHARACTERISTIC ZDrive_BSW_Cal_Cal.ZDrive_BSW_Cal_VehicleInfomationTable.VehConfig_Code1 ZDrive_BSW_Cal_Cal.ZDrive_BSW_Cal_VehicleInfomationTable.VehConfig_Code2 ZDrive_BSW_Cal_Cal.ZDrive_BSW_Cal_VehicleInfomationTable.Country_Code ZDrive_BSW_Cal_Cal.ZDrive_BSW_Cal_VehicleInfomationTable.Vehicle_Model ZDrive_BSW_Cal_Cal.ZDrive_BSW_Cal_VehicleInfomationTable.PowerType ZDrive_BSW_Cal_Cal.ZDrive_BSW_Cal_VehicleInfomationTable.ESP_Type ZDrive_BSW_Cal_Cal.ZDrive_BSW_Cal_VehicleInfomationTable.TurnLevelType ZDrive_BSW_Cal_Cal.ZDrive_BSW_Cal_VehicleInfomationTable.ActiveType ZDrive_BSW_Cal_Cal.ZDrive_BSW_Cal_VehicleInfomationTable.Gear_Box ZDrive_BSW_Cal_Cal.ZDrive_BSW_Cal_VehicleInfomationTable.Engine_Type ZDrive_BSW_Cal_Cal.ZDrive_BSW_Cal_VehicleInfomationTable.EPS_Inter ZDrive_BSW_Cal_Cal.ZDrive_BSW_Cal_VehicleInfomationTable.DrivingLongControlInterForm /end REF_CHARACTERISTIC
/end GROUP
/begin RECORD_LAYOUT Record_BOOLEAN FNC_VALUES 1 UBYTE COLUMN_DIR DIRECT /end RECORD_LAYOUT
/begin RECORD_LAYOUT Record_FLOAT32_IEEE FNC_VALUES 1 FLOAT32_IEEE COLUMN_DIR DIRECT /end RECORD_LAYOUT
/begin RECORD_LAYOUT Record_UBYTE FNC_VALUES 1 UBYTE COLUMN_DIR DIRECT /end RECORD_LAYOUT
/begin RECORD_LAYOUT Record_ULONG FNC_VALUES 1 ULONG COLUMN_DIR DIRECT /end RECORD_LAYOUT
/begin RECORD_LAYOUT Record_UWORD FNC_VALUES 1 UWORD COLUMN_DIR DIRECT /end RECORD_LAYOUT
/begin RECORD_LAYOUT Axis_FLOAT32_IEEE AXIS_PTS_X 1 FLOAT32_IEEE INDEX_INCR DIRECT /end RECORD_LAYOUT
/begin GROUP ZDrive_BSW_Cal_Cal.ZDrive_BSW_Cal_VehicleInfomationTable ""
 /begin REF_CHARACTERISTIC ZDrive_BSW_Cal_Cal.ZDrive_BSW_Cal_VehicleInfomationTable.VehConfig_Code1 ZDrive_BSW_Cal_Cal.ZDrive_BSW_Cal_VehicleInfomationTable.VehConfig_Code2 ZDrive_BSW_Cal_Cal.ZDrive_BSW_Cal_VehicleInfomationTable.Country_Code ZDrive_BSW_Cal_Cal.ZDrive_BSW_Cal_VehicleInfomationTable.Vehicle_Model ZDrive_BSW_Cal_Cal.ZDrive_BSW_Cal_VehicleInfomationTable.PowerType ZDrive_BSW_Cal_Cal.ZDrive_BSW_Cal_VehicleInfomationTable.ESP_Type ZDrive_BSW_Cal_Cal.ZDrive_BSW_Cal_VehicleInfomationTable.TurnLevelType ZDrive_BSW_Cal_Cal.ZDrive_BSW_Cal_VehicleInfomationTable.ActiveType ZDrive_BSW_Cal_Cal.ZDrive_BSW_Cal_VehicleInfomationTable.Gear_Box ZDrive_BSW_Cal_Cal.ZDrive_BSW_Cal_VehicleInfomationTable.Engine_Type ZDrive_BSW_Cal_Cal.ZDrive_BSW_Cal_VehicleInfomationTable.EPS_Inter ZDrive_BSW_Cal_Cal.ZDrive_BSW_Cal_VehicleInfomationTable.DrivingLongControlInterForm /end REF_CHARACTERISTIC
/end GROUP
/begin RECORD_LAYOUT Record_BOOLEAN FNC_VALUES 1 UBYTE COLUMN_DIR DIRECT /end RECORD_LAYOUT
/begin RECORD_LAYOUT Record_FLOAT32_IEEE FNC_VALUES 1 FLOAT32_IEEE COLUMN_DIR DIRECT /end RECORD_LAYOUT
/begin RECORD_LAYOUT Record_UBYTE FNC_VALUES 1 UBYTE COLUMN_DIR DIRECT /end RECORD_LAYOUT
/begin RECORD_LAYOUT Record_ULONG FNC_VALUES 1 ULONG COLUMN_DIR DIRECT /end RECORD_LAYOUT
/begin RECORD_LAYOUT Record_UWORD FNC_VALUES 1 UWORD COLUMN_DIR DIRECT /end RECORD_LAYOUT
/begin RECORD_LAYOUT Axis_FLOAT32_IEEE AXIS_PTS_X 1 FLOAT32_IEEE INDEX_INCR DIRECT /end RECORD_LAYOUT
/begin GROUP ZDrive_BSW_Cal_Cal.ZDrive_BSW_Cal_VehicleInfomationTable ""
 /begin REF_CHARACTERISTIC ZDrive_BSW_Cal_Cal.ZDrive_BSW_Cal_VehicleInfomationTable.VehConfig_Code1 ZDrive_BSW_Cal_Cal.ZDrive_BSW_Cal_VehicleInfomationTable.VehConfig_Code2 ZDrive_BSW_Cal_Cal.ZDrive_BSW_Cal_VehicleInfomationTable.Country_Code ZDrive_BSW_Cal_Cal.ZDrive_BSW_Cal_VehicleInfomationTable.Vehicle_Model ZDrive_BSW_Cal_Cal.ZDrive_BSW_Cal_VehicleInfomationTable.PowerType ZDrive_BSW_Cal_Cal.ZDrive_BSW_Cal_VehicleInfomationTable.ESP_Type ZDrive_BSW_Cal_Cal.ZDrive_BSW_Cal_VehicleInfomationTable.TurnLevelType ZDrive_BSW_Cal_Cal.ZDrive_BSW_Cal_VehicleInfomationTable.ActiveType ZDrive_BSW_Cal_Cal.ZDrive_BSW_Cal_VehicleInfomationTable.Gear_Box ZDrive_BSW_Cal_Cal.ZDrive_BSW_Cal_VehicleInfomationTable.Engine_Type ZDrive_BSW_Cal_Cal.ZDrive_BSW_Cal_VehicleInfomationTable.EPS_Inter ZDrive_BSW_Cal_Cal.ZDrive_BSW_Cal_VehicleInfomationTable.DrivingLongControlInterForm /end REF_CHARACTERISTIC
/end GROUP
/begin RECORD_LAYOUT Record_BOOLEAN FNC_VALUES 1 UBYTE COLUMN_DIR DIRECT /end RECORD_LAYOUT
/begin RECORD_LAYOUT Record_FLOAT32_IEEE FNC_VALUES 1 FLOAT32_IEEE COLUMN_DIR DIRECT /end RECORD_LAYOUT
/begin RECORD_LAYOUT Record_UBYTE FNC_VALUES 1 UBYTE COLUMN_DIR DIRECT /end RECORD_LAYOUT
/begin RECORD_LAYOUT Record_ULONG FNC_VALUES 1 ULONG COLUMN_DIR DIRECT /end RECORD_LAYOUT
/begin RECORD_LAYOUT Record_UWORD FNC_VALUES 1 UWORD COLUMN_DIR DIRECT /end RECORD_LAYOUT
/begin RECORD_LAYOUT Axis_FLOAT32_IEEE AXIS_PTS_X 1 FLOAT32_IEEE INDEX_INCR DIRECT /end RECORD_LAYOUT
/begin GROUP ZDrive_BSW_Cal_Cal.ZDrive_BSW_Cal_VehicleInfomationTable ""
 /begin REF_CHARACTERISTIC ZDrive_BSW_Cal_Cal.ZDrive_BSW_Cal_VehicleInfomationTable.VehConfig_Code1 ZDrive_BSW_Cal_Cal.ZDrive_BSW_Cal_VehicleInfomationTable.VehConfig_Code2 ZDrive_BSW_Cal_Cal.ZDrive_BSW_Cal_VehicleInfomationTable.Country_Code ZDrive_BSW_Cal_Cal.ZDrive_BSW_Cal_VehicleInfomationTable.Vehicle_Model ZDrive_BSW_Cal_Cal.ZDrive_BSW_Cal_VehicleInfomationTable.PowerType ZDrive_BSW_Cal_Cal.ZDrive_BSW_Cal_VehicleInfomationTable.ESP_Type ZDrive_BSW_Cal_Cal.ZDrive_BSW_Cal_VehicleInfomationTable.TurnLevelType ZDrive_BSW_Cal_Cal.ZDrive_BSW_Cal_VehicleInfomationTable.ActiveType ZDrive_BSW_Cal_Cal.ZDrive_BSW_Cal_VehicleInfomationTable.Gear_Box ZDrive_BSW_Cal_Cal.ZDrive_BSW_Cal_VehicleInfomationTable.Engine_Type ZDrive_BSW_Cal_Cal.ZDrive_BSW_Cal_VehicleInfomationTable.EPS_Inter ZDrive_BSW_Cal_Cal.ZDrive_BSW_Cal_VehicleInfomationTable.DrivingLongControlInterForm /end REF_CHARACTERISTIC
/end GROUP
/begin RECORD_LAYOUT Record_BOOLEAN FNC_VALUES 1 UBYTE COLUMN_DIR DIRECT /end RECORD_LAYOUT
/begin RECORD_LAYOUT Record_FLOAT32_IEEE FNC_VALUES 1 FLOAT32_IEEE COLUMN_DIR DIRECT /end RECORD_LAYOUT
/begin RECORD_LAYOUT Record_UBYTE FNC_VALUES 1 UBYTE COLUMN_DIR DIRECT /end RECORD_LAYOUT
/begin RECORD_LAYOUT Record_ULONG FNC_VALUES 1 ULONG COLUMN_DIR DIRECT /end RECORD_LAYOUT
/begin RECORD_LAYOUT Record_UWORD FNC_VALUES 1 UWORD COLUMN_DIR DIRECT /end RECORD_LAYOUT
/begin RECORD_LAYOUT Axis_FLOAT32_IEEE AXIS_PTS_X 1 FLOAT32_IEEE INDEX_INCR DIRECT /end RECORD_LAYOUT
/begin GROUP ZDrive_BSW_Cal_Cal.ZDrive_BSW_Cal_VehicleInfomationTable ""
 /begin REF_CHARACTERISTIC ZDrive_BSW_Cal_Cal.ZDrive_BSW_Cal_VehicleInfomationTable.VehConfig_Code1 ZDrive_BSW_Cal_Cal.ZDrive_BSW_Cal_VehicleInfomationTable.VehConfig_Code2 ZDrive_BSW_Cal_Cal.ZDrive_BSW_Cal_VehicleInfomationTable.Country_Code ZDrive_BSW_Cal_Cal.ZDrive_BSW_Cal_VehicleInfomationTable.Vehicle_Model ZDrive_BSW_Cal_Cal.ZDrive_BSW_Cal_VehicleInfomationTable.PowerType ZDrive_BSW_Cal_Cal.ZDrive_BSW_Cal_VehicleInfomationTable.ESP_Type ZDrive_BSW_Cal_Cal.ZDrive_BSW_Cal_VehicleInfomationTable.TurnLevelType ZDrive_BSW_Cal_Cal.ZDrive_BSW_Cal_VehicleInfomationTable.ActiveType ZDrive_BSW_Cal_Cal.ZDrive_BSW_Cal_VehicleInfomationTable.Gear_Box ZDrive_BSW_Cal_Cal.ZDrive_BSW_Cal_VehicleInfomationTable.Engine_Type ZDrive_BSW_Cal_Cal.ZDrive_BSW_Cal_VehicleInfomationTable.EPS_Inter ZDrive_BSW_Cal_Cal.ZDrive_BSW_Cal_VehicleInfomationTable.DrivingLongControlInterForm /end REF_CHARACTERISTIC
/end GROUP
/end MODULE
/end PROJECT
