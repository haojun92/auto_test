ASAP2_VERSION 1 71
/begin PROJECT ProjectName ""
/begin MODULE ModuleName ""
/begin MOD_COMMON "" BYTE_ORDER MSB_LAST ALIGNMENT_BYTE 1 ALIGNMENT_WORD 1 ALIGNMENT_LONG 1 ALIGNMENT_INT64 1 ALIGNMENT_FLOAT16_IEEE 1 ALIGNMENT_FLOAT32_IEEE 1 ALIGNMENT_FLOAT64_IEEE 1 /end MOD_COMMON
/begin MEASUREMENT SwcIn_ADASFuncConfig.CONFIG_ACC "" UBYTE autosar_swc_val_CM_uint8 0 0 0 255 ECU_ADDRESS 0xfe4ccd73 /* @ECU_Address@SwcIn_ADASFuncConfig.CONFIG_ACC@ */ /end MEASUREMENT
/begin MEASUREMENT SwcIn_ADASFuncConfig.CONFIG_ACCIC "" UBYTE autosar_swc_val_CM_uint8 0 0 0 255 ECU_ADDRESS 0xfe4ccd85 /* @ECU_Address@SwcIn_ADASFuncConfig.CONFIG_ACCIC@ */ /end MEASUREMENT
/begin MEASUREMENT SwcIn_ADASFuncConfig.CONFIG_AEB "" UBYTE autosar_swc_val_CM_uint8 0 0 0 255 ECU_ADDRESS 0xfe4ccd7c /* @ECU_Address@SwcIn_ADASFuncConfig.CONFIG_AEB@ */ /end MEASUREMENT
/begin MEASUREMENT SwcIn_ADASFuncConfig.CONFIG_AES "" UBYTE autosar_swc_val_CM_uint8 0 0 0 255 ECU_ADDRESS 0xfe4ccd7e /* @ECU_Address@SwcIn_ADASFuncConfig.CONFIG_AES@ */ /end MEASUREMENT
/begin MEASUREMENT SwcIn_ADASFuncConfig.CONFIG_ALC "" UBYTE autosar_swc_val_CM_uint8 0 0 0 255 ECU_ADDRESS 0xfe4ccd75 /* @ECU_Address@SwcIn_ADASFuncConfig.CONFIG_ALC@ */ /end MEASUREMENT
/begin MEASUREMENT SwcIn_ADASFuncConfig.CONFIG_DAI "" UBYTE autosar_swc_val_CM_uint8 0 0 0 255 ECU_ADDRESS 0xfe4ccd81 /* @ECU_Address@SwcIn_ADASFuncConfig.CONFIG_DAI@ */ /end MEASUREMENT
/begin MEASUREMENT SwcIn_ADASFuncConfig.CONFIG_ELK "" UBYTE autosar_swc_val_CM_uint8 0 0 0 255 ECU_ADDRESS 0xfe4ccd79 /* @ECU_Address@SwcIn_ADASFuncConfig.CONFIG_ELK@ */ /end MEASUREMENT
/begin MEASUREMENT SwcIn_ADASFuncConfig.CONFIG_ESS "" UBYTE autosar_swc_val_CM_uint8 0 0 0 255 ECU_ADDRESS 0xfe4ccd7d /* @ECU_Address@SwcIn_ADASFuncConfig.CONFIG_ESS@ */ /end MEASUREMENT
/begin MEASUREMENT SwcIn_ADASFuncConfig.CONFIG_FCW "" UBYTE autosar_swc_val_CM_uint8 0 0 0 255 ECU_ADDRESS 0xfe4ccd7b /* @ECU_Address@SwcIn_ADASFuncConfig.CONFIG_FCW@ */ /end MEASUREMENT
/begin MEASUREMENT SwcIn_ADASFuncConfig.CONFIG_IE "" UBYTE autosar_swc_val_CM_uint8 0 0 0 255 ECU_ADDRESS 0xfe4ccd7a /* @ECU_Address@SwcIn_ADASFuncConfig.CONFIG_IE@ */ /end MEASUREMENT
/begin MEASUREMENT SwcIn_ADASFuncConfig.CONFIG_IHC "" UBYTE autosar_swc_val_CM_uint8 0 0 0 255 ECU_ADDRESS 0xfe4ccd84 /* @ECU_Address@SwcIn_ADASFuncConfig.CONFIG_IHC@ */ /end MEASUREMENT
/begin MEASUREMENT SwcIn_ADASFuncConfig.CONFIG_ISL "" UBYTE autosar_swc_val_CM_uint8 0 0 0 255 ECU_ADDRESS 0xfe4ccd7f /* @ECU_Address@SwcIn_ADASFuncConfig.CONFIG_ISL@ */ /end MEASUREMENT
/begin MEASUREMENT SwcIn_ADASFuncConfig.CONFIG_IntellgntCurve "" UBYTE autosar_swc_val_CM_uint8 0 0 0 255 ECU_ADDRESS 0xfe4ccd80 /* @ECU_Address@SwcIn_ADASFuncConfig.CONFIG_IntellgntCurve@ */ /end MEASUREMENT
/begin MEASUREMENT SwcIn_ADASFuncConfig.CONFIG_LCC "" UBYTE autosar_swc_val_CM_uint8 0 0 0 255 ECU_ADDRESS 0xfe4ccd74 /* @ECU_Address@SwcIn_ADASFuncConfig.CONFIG_LCC@ */ /end MEASUREMENT
/begin MEASUREMENT SwcIn_ADASFuncConfig.CONFIG_LDW "" UBYTE autosar_swc_val_CM_uint8 0 0 0 255 ECU_ADDRESS 0xfe4ccd77 /* @ECU_Address@SwcIn_ADASFuncConfig.CONFIG_LDW@ */ /end MEASUREMENT
/begin MEASUREMENT SwcIn_ADASFuncConfig.CONFIG_LKA "" UBYTE autosar_swc_val_CM_uint8 0 0 0 255 ECU_ADDRESS 0xfe4ccd78 /* @ECU_Address@SwcIn_ADASFuncConfig.CONFIG_LKA@ */ /end MEASUREMENT
/begin MEASUREMENT SwcIn_ADASFuncConfig.CONFIG_NOH "" UBYTE autosar_swc_val_CM_uint8 0 0 0 255 ECU_ADDRESS 0xfe4ccd76 /* @ECU_Address@SwcIn_ADASFuncConfig.CONFIG_NOH@ */ /end MEASUREMENT
/begin MEASUREMENT SwcIn_ADASFuncConfig.CONFIG_SLA "" UBYTE autosar_swc_val_CM_uint8 0 0 0 255 ECU_ADDRESS 0xfe4ccd83 /* @ECU_Address@SwcIn_ADASFuncConfig.CONFIG_SLA@ */ /end MEASUREMENT
/begin MEASUREMENT SwcIn_ADASFuncConfig.CONFIG_TSR "" UBYTE autosar_swc_val_CM_uint8 0 0 0 255 ECU_ADDRESS 0xfe4ccd82 /* @ECU_Address@SwcIn_ADASFuncConfig.CONFIG_TSR@ */ /end MEASUREMENT
/begin MEASUREMENT SwcIn_AEB_TAROBJ.ALatRqrd "" FLOAT32_IEEE autosar_swc_val_CM_single 0 0 -3.4E+38 3.4E+38 ECU_ADDRESS 0xfe4cc8d8 /* @ECU_Address@SwcIn_AEB_TAROBJ.ALatRqrd@ */ /end MEASUREMENT
/begin MEASUREMENT SwcIn_AEB_TAROBJ.ANegLgtRqrd "" FLOAT32_IEEE autosar_swc_val_CM_single 0 0 -3.4E+38 3.4E+38 ECU_ADDRESS 0xfe4cc8c8 /* @ECU_Address@SwcIn_AEB_TAROBJ.ANegLgtRqrd@ */ /end MEASUREMENT
/begin MEASUREMENT SwcIn_AEB_TAROBJ.ANegLgtRqrdForPrimTarWarn "" FLOAT32_IEEE autosar_swc_val_CM_single 0 0 -3.4E+38 3.4E+38 ECU_ADDRESS 0xfe4cc8cc /* @ECU_Address@SwcIn_AEB_TAROBJ.ANegLgtRqrdForPrimTarWarn@ */ /end MEASUREMENT
/begin MEASUREMENT SwcIn_AEB_TAROBJ.BrakeThreat "" FLOAT32_IEEE autosar_swc_val_CM_single 0 0 -3.4E+38 3.4E+38 ECU_ADDRESS 0xfe4cc8fc /* @ECU_Address@SwcIn_AEB_TAROBJ.BrakeThreat@ */ /end MEASUREMENT
/begin MEASUREMENT SwcIn_AEB_TAROBJ.CrvtRqrdLe "" FLOAT32_IEEE autosar_swc_val_CM_single 0 0 -3.4E+38 3.4E+38 ECU_ADDRESS 0xfe4cc8d0 /* @ECU_Address@SwcIn_AEB_TAROBJ.CrvtRqrdLe@ */ /end MEASUREMENT
/begin MEASUREMENT SwcIn_AEB_TAROBJ.CrvtRqrdRi "" FLOAT32_IEEE autosar_swc_val_CM_single 0 0 -3.4E+38 3.4E+38 ECU_ADDRESS 0xfe4cc8d4 /* @ECU_Address@SwcIn_AEB_TAROBJ.CrvtRqrdRi@ */ /end MEASUREMENT
/begin MEASUREMENT SwcIn_AEB_TAROBJ.Ego_axvRefMs2 "" FLOAT32_IEEE autosar_swc_val_CM_single 0 0 -3.4E+38 3.4E+38 ECU_ADDRESS 0xfe4cc8e0 /* @ECU_Address@SwcIn_AEB_TAROBJ.Ego_axvRefMs2@ */ /end MEASUREMENT
/begin MEASUREMENT SwcIn_AEB_TAROBJ.Ego_ayvRefMs2 "" FLOAT32_IEEE autosar_swc_val_CM_single 0 0 -3.4E+38 3.4E+38 ECU_ADDRESS 0xfe4cc8e8 /* @ECU_Address@SwcIn_AEB_TAROBJ.Ego_ayvRefMs2@ */ /end MEASUREMENT
/begin MEASUREMENT SwcIn_AEB_TAROBJ.Ego_kapTraj "" FLOAT32_IEEE autosar_swc_val_CM_single 0 0 -3.4E+38 3.4E+38 ECU_ADDRESS 0xfe4cc8e4 /* @ECU_Address@SwcIn_AEB_TAROBJ.Ego_kapTraj@ */ /end MEASUREMENT
/begin MEASUREMENT SwcIn_AEB_TAROBJ.Ego_psiDtOpt "" FLOAT32_IEEE autosar_swc_val_CM_single 0 0 -3.4E+38 3.4E+38 ECU_ADDRESS 0xfe4cc8ec /* @ECU_Address@SwcIn_AEB_TAROBJ.Ego_psiDtOpt@ */ /end MEASUREMENT
/begin MEASUREMENT SwcIn_AEB_TAROBJ.Ego_vxvRefMs "" FLOAT32_IEEE autosar_swc_val_CM_single 0 0 -3.4E+38 3.4E+38 ECU_ADDRESS 0xfe4cc8dc /* @ECU_Address@SwcIn_AEB_TAROBJ.Ego_vxvRefMs@ */ /end MEASUREMENT
/begin MEASUREMENT SwcIn_AEB_TAROBJ.FCW_ANegLgtRqrdForWarn "" FLOAT32_IEEE autosar_swc_val_CM_single 0 0 -3.4E+38 3.4E+38 ECU_ADDRESS 0xfe4cc8f4 /* @ECU_Address@SwcIn_AEB_TAROBJ.FCW_ANegLgtRqrdForWarn@ */ /end MEASUREMENT
/begin MEASUREMENT SwcIn_AEB_TAROBJ.FCW_startConditionMet "" FLOAT32_IEEE autosar_swc_val_CM_single 0 0 -3.4E+38 3.4E+38 ECU_ADDRESS 0xfe4cc8f8 /* @ECU_Address@SwcIn_AEB_TAROBJ.FCW_startConditionMet@ */ /end MEASUREMENT
/begin MEASUREMENT SwcIn_AEB_TAROBJ.FusionType "" UBYTE autosar_swc_val_CM_uint8 0 0 0 255 ECU_ADDRESS 0xfe4cc88e /* @ECU_Address@SwcIn_AEB_TAROBJ.FusionType@ */ /end MEASUREMENT
/begin MEASUREMENT SwcIn_AEB_TAROBJ.Host_State "" FLOAT32_IEEE autosar_swc_val_CM_single 0 0 -3.4E+38 3.4E+38 ECU_ADDRESS 0xfe4cc908 /* @ECU_Address@SwcIn_AEB_TAROBJ.Host_State@ */ /end MEASUREMENT
/begin MEASUREMENT SwcIn_AEB_TAROBJ.InPathPredict "" UBYTE autosar_swc_val_CM_boolean 0 0 0 1 ECU_ADDRESS 0xfe4cc88d /* @ECU_Address@SwcIn_AEB_TAROBJ.InPathPredict@ */ /end MEASUREMENT
/begin MEASUREMENT SwcIn_AEB_TAROBJ.ObjectHeadingAngle "" FLOAT32_IEEE autosar_swc_val_CM_single 0 0 -3.4E+38 3.4E+38 ECU_ADDRESS 0xfe4cc89c /* @ECU_Address@SwcIn_AEB_TAROBJ.ObjectHeadingAngle@ */ /end MEASUREMENT
/begin MEASUREMENT SwcIn_AEB_TAROBJ.ObjectID "" ULONG autosar_swc_val_CM_uint32 0 0 0 4294967295 ECU_ADDRESS 0xfe4cc910 /* @ECU_Address@SwcIn_AEB_TAROBJ.ObjectID@ */ /end MEASUREMENT
/begin MEASUREMENT SwcIn_AEB_TAROBJ.ObjectIndex "" UBYTE autosar_swc_val_CM_uint8 0 0 0 255 ECU_ADDRESS 0xfe4cc88f /* @ECU_Address@SwcIn_AEB_TAROBJ.ObjectIndex@ */ /end MEASUREMENT
/begin MEASUREMENT SwcIn_AEB_TAROBJ.ObjectLength "" FLOAT32_IEEE autosar_swc_val_CM_single 0 0 -3.4E+38 3.4E+38 ECU_ADDRESS 0xfe4cc894 /* @ECU_Address@SwcIn_AEB_TAROBJ.ObjectLength@ */ /end MEASUREMENT
/begin MEASUREMENT SwcIn_AEB_TAROBJ.ObjectMovingOrientation "" UBYTE autosar_swc_val_CM_uint8 0 0 0 255 ECU_ADDRESS 0xfe4cc892 /* @ECU_Address@SwcIn_AEB_TAROBJ.ObjectMovingOrientation@ */ /end MEASUREMENT
/begin MEASUREMENT SwcIn_AEB_TAROBJ.ObjectMovingState "" UBYTE autosar_swc_val_CM_uint8 0 0 0 255 ECU_ADDRESS 0xfe4cc891 /* @ECU_Address@SwcIn_AEB_TAROBJ.ObjectMovingState@ */ /end MEASUREMENT
/begin MEASUREMENT SwcIn_AEB_TAROBJ.ObjectType "" UBYTE autosar_swc_val_CM_uint8 0 0 0 255 ECU_ADDRESS 0xfe4cc890 /* @ECU_Address@SwcIn_AEB_TAROBJ.ObjectType@ */ /end MEASUREMENT
/begin MEASUREMENT SwcIn_AEB_TAROBJ.ObjectWidth "" FLOAT32_IEEE autosar_swc_val_CM_single 0 0 -3.4E+38 3.4E+38 ECU_ADDRESS 0xfe4cc898 /* @ECU_Address@SwcIn_AEB_TAROBJ.ObjectWidth@ */ /end MEASUREMENT
/begin MEASUREMENT SwcIn_AEB_TAROBJ.Object_Abs_AX "" FLOAT32_IEEE autosar_swc_val_CM_single 0 0 -3.4E+38 3.4E+38 ECU_ADDRESS 0xfe4cc8bc /* @ECU_Address@SwcIn_AEB_TAROBJ.Object_Abs_AX@ */ /end MEASUREMENT
/begin MEASUREMENT SwcIn_AEB_TAROBJ.Object_Abs_AY "" FLOAT32_IEEE autosar_swc_val_CM_single 0 0 -3.4E+38 3.4E+38 ECU_ADDRESS 0xfe4cc8c0 /* @ECU_Address@SwcIn_AEB_TAROBJ.Object_Abs_AY@ */ /end MEASUREMENT
/begin MEASUREMENT SwcIn_AEB_TAROBJ.Object_Abs_SPEED "" FLOAT32_IEEE autosar_swc_val_CM_single 0 0 -3.4E+38 3.4E+38 ECU_ADDRESS 0xfe4cc8b0 /* @ECU_Address@SwcIn_AEB_TAROBJ.Object_Abs_SPEED@ */ /end MEASUREMENT
/begin MEASUREMENT SwcIn_AEB_TAROBJ.Object_Abs_VX "" FLOAT32_IEEE autosar_swc_val_CM_single 0 0 -3.4E+38 3.4E+38 ECU_ADDRESS 0xfe4cc8b4 /* @ECU_Address@SwcIn_AEB_TAROBJ.Object_Abs_VX@ */ /end MEASUREMENT
/begin MEASUREMENT SwcIn_AEB_TAROBJ.Object_Abs_VY "" FLOAT32_IEEE autosar_swc_val_CM_single 0 0 -3.4E+38 3.4E+38 ECU_ADDRESS 0xfe4cc8b8 /* @ECU_Address@SwcIn_AEB_TAROBJ.Object_Abs_VY@ */ /end MEASUREMENT
/begin MEASUREMENT SwcIn_AEB_TAROBJ.Object_DX "" FLOAT32_IEEE autosar_swc_val_CM_single 0 0 -3.4E+38 3.4E+38 ECU_ADDRESS 0xfe4cc8a0 /* @ECU_Address@SwcIn_AEB_TAROBJ.Object_DX@ */ /end MEASUREMENT
/begin MEASUREMENT SwcIn_AEB_TAROBJ.Object_DY "" FLOAT32_IEEE autosar_swc_val_CM_single 0 0 -3.4E+38 3.4E+38 ECU_ADDRESS 0xfe4cc8a4 /* @ECU_Address@SwcIn_AEB_TAROBJ.Object_DY@ */ /end MEASUREMENT
/begin MEASUREMENT SwcIn_AEB_TAROBJ.Object_RangeX "" FLOAT32_IEEE autosar_swc_val_CM_single 0 0 -3.4E+38 3.4E+38 ECU_ADDRESS 0xfe4cc8a8 /* @ECU_Address@SwcIn_AEB_TAROBJ.Object_RangeX@ */ /end MEASUREMENT
/begin MEASUREMENT SwcIn_AEB_TAROBJ.Object_RangeY "" FLOAT32_IEEE autosar_swc_val_CM_single 0 0 -3.4E+38 3.4E+38 ECU_ADDRESS 0xfe4cc8ac /* @ECU_Address@SwcIn_AEB_TAROBJ.Object_RangeY@ */ /end MEASUREMENT
/begin MEASUREMENT SwcIn_AEB_TAROBJ.PrimTarInPahNow "" UBYTE autosar_swc_val_CM_boolean 0 0 0 1 ECU_ADDRESS 0xfe4cc88c /* @ECU_Address@SwcIn_AEB_TAROBJ.PrimTarInPahNow@ */ /end MEASUREMENT
/begin MEASUREMENT SwcIn_AEB_TAROBJ.Sceniaro_Flag "" FLOAT32_IEEE autosar_swc_val_CM_single 0 0 -3.4E+38 3.4E+38 ECU_ADDRESS 0xfe4cc90c /* @ECU_Address@SwcIn_AEB_TAROBJ.Sceniaro_Flag@ */ /end MEASUREMENT
/begin MEASUREMENT SwcIn_AEB_TAROBJ.Sceniaro_OK "" FLOAT32_IEEE autosar_swc_val_CM_single 0 0 -3.4E+38 3.4E+38 ECU_ADDRESS 0xfe4cc904 /* @ECU_Address@SwcIn_AEB_TAROBJ.Sceniaro_OK@ */ /end MEASUREMENT
/begin MEASUREMENT SwcIn_AEB_TAROBJ.SteerThreat "" FLOAT32_IEEE autosar_swc_val_CM_single 0 0 -3.4E+38 3.4E+38 ECU_ADDRESS 0xfe4cc900 /* @ECU_Address@SwcIn_AEB_TAROBJ.SteerThreat@ */ /end MEASUREMENT
/begin MEASUREMENT SwcIn_AEB_TAROBJ.TTC "" FLOAT32_IEEE autosar_swc_val_CM_single 0 0 -3.4E+38 3.4E+38 ECU_ADDRESS 0xfe4cc8f0 /* @ECU_Address@SwcIn_AEB_TAROBJ.TTC@ */ /end MEASUREMENT
/begin MEASUREMENT SwcIn_AEB_TAROBJ.TiToCllsn "" FLOAT32_IEEE autosar_swc_val_CM_single 0 0 -3.4E+38 3.4E+38 ECU_ADDRESS 0xfe4cc8c4 /* @ECU_Address@SwcIn_AEB_TAROBJ.TiToCllsn@ */ /end MEASUREMENT
/begin MEASUREMENT SwcIn_AEB_TAROBJ.camID "" ULONG autosar_swc_val_CM_uint32 0 0 0 4294967295 ECU_ADDRESS 0xfe4cc914 /* @ECU_Address@SwcIn_AEB_TAROBJ.camID@ */ /end MEASUREMENT
/begin MEASUREMENT SwcIn_ASU_1.ASU_1_ASUSysFailrSts "" UBYTE autosar_swc_val_CM_ASU_1_ASUSysFailrSts_1217_dt 0 0 0 255 ECU_ADDRESS 0xfe4ca46a /* @ECU_Address@SwcIn_ASU_1.ASU_1_ASUSysFailrSts@ */ /end MEASUREMENT
/begin MEASUREMENT SwcIn_ASU_1.ASU_1_AutoEasyEntryFb "" UBYTE autosar_swc_val_CM_ASU_1_AutoEasyEntryFb_1217_dt 0 0 0 255 ECU_ADDRESS 0xfe4ca472 /* @ECU_Address@SwcIn_ASU_1.ASU_1_AutoEasyEntryFb@ */ /end MEASUREMENT
/begin MEASUREMENT SwcIn_ASU_1.ASU_1_BluetoothManEasyEntryFb "" UBYTE autosar_swc_val_CM_ASU_1_BluetoothManEasyEntryFb_1217_dt 0 0 0 255 ECU_ADDRESS 0xfe4ca474 /* @ECU_Address@SwcIn_ASU_1.ASU_1_BluetoothManEasyEntryFb@ */ /end MEASUREMENT
/begin MEASUREMENT SwcIn_ASU_1.ASU_1_CDCErrSts "" UBYTE autosar_swc_val_CM_ASU_1_CDCErrSts_1217_dt 0 0 0 255 ECU_ADDRESS 0xfe4ca476 /* @ECU_Address@SwcIn_ASU_1.ASU_1_CDCErrSts@ */ /end MEASUREMENT
/begin MEASUREMENT SwcIn_ASU_1.ASU_1_CRC1 "" UBYTE autosar_swc_val_CM_ASU_1_CRC1_1217_dt 0 0 0 255 ECU_ADDRESS 0xfe4ca468 /* @ECU_Address@SwcIn_ASU_1.ASU_1_CRC1@ */ /end MEASUREMENT
/begin MEASUREMENT SwcIn_ASU_1.ASU_1_ECASErrSts "" UBYTE autosar_swc_val_CM_ASU_1_ECASErrSts_1217_dt 0 0 0 255 ECU_ADDRESS 0xfe4ca46f /* @ECU_Address@SwcIn_ASU_1.ASU_1_ECASErrSts@ */ /end MEASUREMENT
/begin MEASUREMENT SwcIn_ASU_1.ASU_1_ECASModeFb "" UBYTE autosar_swc_val_CM_ASU_1_ECASModeFb_1217_dt 0 0 0 255 ECU_ADDRESS 0xfe4ca473 /* @ECU_Address@SwcIn_ASU_1.ASU_1_ECASModeFb@ */ /end MEASUREMENT
/begin MEASUREMENT SwcIn_ASU_1.ASU_1_ECASSysSts "" UBYTE autosar_swc_val_CM_ASU_1_ECASSysSts_1217_dt 0 0 0 255 ECU_ADDRESS 0xfe4ca46c /* @ECU_Address@SwcIn_ASU_1.ASU_1_ECASSysSts@ */ /end MEASUREMENT
/begin MEASUREMENT SwcIn_ASU_1.ASU_1_EasyEntryEna "" UBYTE autosar_swc_val_CM_ASU_1_EasyEntryEna_1217_dt 0 0 0 255 ECU_ADDRESS 0xfe4ca471 /* @ECU_Address@SwcIn_ASU_1.ASU_1_EasyEntryEna@ */ /end MEASUREMENT
/begin MEASUREMENT SwcIn_ASU_1.ASU_1_HighwayModFb "" UBYTE autosar_swc_val_CM_ASU_1_HighwayModFb_1217_dt 0 0 0 255 ECU_ADDRESS 0xfe4ca475 /* @ECU_Address@SwcIn_ASU_1.ASU_1_HighwayModFb@ */ /end MEASUREMENT
/begin MEASUREMENT SwcIn_ASU_1.ASU_1_MaintainMod "" UBYTE autosar_swc_val_CM_ASU_1_MaintainMod_1217_dt 0 0 0 255 ECU_ADDRESS 0xfe4ca46e /* @ECU_Address@SwcIn_ASU_1.ASU_1_MaintainMod@ */ /end MEASUREMENT
/begin MEASUREMENT SwcIn_ASU_1.ASU_1_RollgCntr1 "" UBYTE autosar_swc_val_CM_ASU_1_RollgCntr1_1217_dt 0 0 0 255 ECU_ADDRESS 0xfe4ca469 /* @ECU_Address@SwcIn_ASU_1.ASU_1_RollgCntr1@ */ /end MEASUREMENT
/begin MEASUREMENT SwcIn_ASU_1.ASU_1_SuspCurrentLvl "" UBYTE autosar_swc_val_CM_ASU_1_SuspCurrentLvl_1217_dt 0 0 0 255 ECU_ADDRESS 0xfe4ca46b /* @ECU_Address@SwcIn_ASU_1.ASU_1_SuspCurrentLvl@ */ /end MEASUREMENT
/begin MEASUREMENT SwcIn_ASU_1.ASU_1_SuspDampingLvl "" UBYTE autosar_swc_val_CM_ASU_1_SuspDampingLvl_1217_dt 0 0 0 255 ECU_ADDRESS 0xfe4ca477 /* @ECU_Address@SwcIn_ASU_1.ASU_1_SuspDampingLvl@ */ /end MEASUREMENT
/begin MEASUREMENT SwcIn_ASU_1.ASU_1_SuspTarLvl "" UBYTE autosar_swc_val_CM_ASU_1_SuspTarLvl_1217_dt 0 0 0 255 ECU_ADDRESS 0xfe4ca470 /* @ECU_Address@SwcIn_ASU_1.ASU_1_SuspTarLvl@ */ /end MEASUREMENT
/begin MEASUREMENT SwcIn_ASU_1.ASU_1_SuspTmpAdjSts "" UBYTE autosar_swc_val_CM_ASU_1_SuspTmpAdjSts_1217_dt 0 0 0 255 ECU_ADDRESS 0xfe4ca46d /* @ECU_Address@SwcIn_ASU_1.ASU_1_SuspTmpAdjSts@ */ /end MEASUREMENT
/begin MEASUREMENT SwcIn_ASU_2.ASU_2_CRC1 "" UBYTE autosar_swc_val_CM_ASU_2_CRC1_776_dt 0 0 0 255 ECU_ADDRESS 0xfe4ca478 /* @ECU_Address@SwcIn_ASU_2.ASU_2_CRC1@ */ /end MEASUREMENT
/begin MEASUREMENT SwcIn_ASU_2.ASU_2_LFHeight "" FLOAT32_IEEE autosar_swc_val_CM_ASU_2_LFHeight_776_dt 0 0 -3.4E+38 3.4E+38 ECU_ADDRESS 0xfe4ca47c /* @ECU_Address@SwcIn_ASU_2.ASU_2_LFHeight@ */ /end MEASUREMENT
/begin MEASUREMENT SwcIn_ASU_2.ASU_2_LRHeight "" FLOAT32_IEEE autosar_swc_val_CM_ASU_2_LRHeight_776_dt 0 0 -3.4E+38 3.4E+38 ECU_ADDRESS 0xfe4ca484 /* @ECU_Address@SwcIn_ASU_2.ASU_2_LRHeight@ */ /end MEASUREMENT
/begin MEASUREMENT SwcIn_ASU_2.ASU_2_RFHeight "" FLOAT32_IEEE autosar_swc_val_CM_ASU_2_RFHeight_776_dt 0 0 -3.4E+38 3.4E+38 ECU_ADDRESS 0xfe4ca480 /* @ECU_Address@SwcIn_ASU_2.ASU_2_RFHeight@ */ /end MEASUREMENT
/begin MEASUREMENT SwcIn_ASU_2.ASU_2_RRHeight "" FLOAT32_IEEE autosar_swc_val_CM_ASU_2_RRHeight_776_dt 0 0 -3.4E+38 3.4E+38 ECU_ADDRESS 0xfe4ca488 /* @ECU_Address@SwcIn_ASU_2.ASU_2_RRHeight@ */ /end MEASUREMENT
/begin MEASUREMENT SwcIn_ASU_2.ASU_2_RollgCntr1 "" UBYTE autosar_swc_val_CM_ASU_2_RollgCntr1_776_dt 0 0 0 255 ECU_ADDRESS 0xfe4ca479 /* @ECU_Address@SwcIn_ASU_2.ASU_2_RollgCntr1@ */ /end MEASUREMENT
/begin MEASUREMENT SwcIn_ASU_2.ASU_2_sensorErrorSts "" UBYTE autosar_swc_val_CM_ASU_2_sensorErrorSts_776_dt 0 0 0 255 ECU_ADDRESS 0xfe4ca48c /* @ECU_Address@SwcIn_ASU_2.ASU_2_sensorErrorSts@ */ /end MEASUREMENT
/begin MEASUREMENT SwcIn_BMS_2_G.BMS_SOCLight "" UBYTE autosar_swc_val_CM_BMS_SOCLight_1291_dt 0 0 0 255 ECU_ADDRESS 0xfe4ccd86 /* @ECU_Address@SwcIn_BMS_2_G.BMS_SOCLight@ */ /end MEASUREMENT
/begin MEASUREMENT SwcIn_BMS_3_G.BMS_ChgWireConnect_LightSts "" UBYTE autosar_swc_val_CM_BMS_ChgWireConnect_LightSts_1295_dt 0 0 0 255 ECU_ADDRESS 0xfe4ccc78 /* @ECU_Address@SwcIn_BMS_3_G.BMS_ChgWireConnect_LightSts@ */ /end MEASUREMENT
/begin MEASUREMENT SwcIn_BMS_3_G.BMS_Chg_LightSts "" UBYTE autosar_swc_val_CM_BMS_Chg_LightSts_1295_dt 0 0 0 255 ECU_ADDRESS 0xfe4ccc79 /* @ECU_Address@SwcIn_BMS_3_G.BMS_Chg_LightSts@ */ /end MEASUREMENT
/begin MEASUREMENT SwcIn_CSA_1.CSA_1_CRC "" UBYTE autosar_swc_val_CM_CSA_1_CRC_321_dt 0 0 0 255 ECU_ADDRESS 0xfe4ccd87 /* @ECU_Address@SwcIn_CSA_1.CSA_1_CRC@ */ /end MEASUREMENT
/begin MEASUREMENT SwcIn_CSA_1.CSA_1_Resd "" UBYTE autosar_swc_val_CM_CSA_1_Resd_321_dt 0 0 0 255 ECU_ADDRESS 0xfe4ccd89 /* @ECU_Address@SwcIn_CSA_1.CSA_1_Resd@ */ /end MEASUREMENT
/begin MEASUREMENT SwcIn_CSA_1.CSA_1_RollgCntr "" UBYTE autosar_swc_val_CM_CSA_1_RollgCntr_321_dt 0 0 0 255 ECU_ADDRESS 0xfe4ccd88 /* @ECU_Address@SwcIn_CSA_1.CSA_1_RollgCntr@ */ /end MEASUREMENT
/begin MEASUREMENT SwcIn_CSA_1.DriveModeActive "" UBYTE autosar_swc_val_CM_DriveModeActive_321_dt 0 0 0 255 ECU_ADDRESS 0xfe4ccd8e /* @ECU_Address@SwcIn_CSA_1.DriveModeActive@ */ /end MEASUREMENT
/begin MEASUREMENT SwcIn_CSA_1.DriveModeReq "" UBYTE autosar_swc_val_CM_DriveModeReq_321_dt 0 0 0 255 ECU_ADDRESS 0xfe4ccd8f /* @ECU_Address@SwcIn_CSA_1.DriveModeReq@ */ /end MEASUREMENT
/begin MEASUREMENT SwcIn_CSA_1.GearShiftPos "" UBYTE autosar_swc_val_CM_GearShiftPos_321_dt 0 0 0 255 ECU_ADDRESS 0xfe4ccd8a /* @ECU_Address@SwcIn_CSA_1.GearShiftPos@ */ /end MEASUREMENT
/begin MEASUREMENT SwcIn_CSA_1.GearShiftPosInverse "" UBYTE autosar_swc_val_CM_GearShiftPosInverse_321_dt 0 0 0 255 ECU_ADDRESS 0xfe4ccd8b /* @ECU_Address@SwcIn_CSA_1.GearShiftPosInverse@ */ /end MEASUREMENT
/begin MEASUREMENT SwcIn_CSA_1.STAT_ParkButton "" UBYTE autosar_swc_val_CM_STAT_ParkButton_321_dt 0 0 0 255 ECU_ADDRESS 0xfe4ccd8c /* @ECU_Address@SwcIn_CSA_1.STAT_ParkButton@ */ /end MEASUREMENT
/begin MEASUREMENT SwcIn_CSA_1.STAT_ShifterLeverFault "" UBYTE autosar_swc_val_CM_STAT_ShifterLeverFault_321_dt 0 0 0 255 ECU_ADDRESS 0xfe4ccd8d /* @ECU_Address@SwcIn_CSA_1.STAT_ShifterLeverFault@ */ /end MEASUREMENT
/begin MEASUREMENT SwcIn_CSA_2.CSA_2_AllWarningInfo "" UBYTE autosar_swc_val_CM_CSA_2_AllWarningInfo_631_dt 0 0 0 255 ECU_ADDRESS 0xfe4ccc7d /* @ECU_Address@SwcIn_CSA_2.CSA_2_AllWarningInfo@ */ /end MEASUREMENT
/begin MEASUREMENT SwcIn_CSA_2.CSA_2_CRC1 "" UBYTE autosar_swc_val_CM_CSA_2_CRC1_631_dt 0 0 0 255 ECU_ADDRESS 0xfe4ccc7a /* @ECU_Address@SwcIn_CSA_2.CSA_2_CRC1@ */ /end MEASUREMENT
/begin MEASUREMENT SwcIn_CSA_2.CSA_2_Resd1 "" UBYTE autosar_swc_val_CM_CSA_2_Resd1_631_dt 0 0 0 255 ECU_ADDRESS 0xfe4ccc7c /* @ECU_Address@SwcIn_CSA_2.CSA_2_Resd1@ */ /end MEASUREMENT
/begin MEASUREMENT SwcIn_CSA_2.CSA_2_RollgCntr1 "" UBYTE autosar_swc_val_CM_CSA_2_RollgCntr1_631_dt 0 0 0 255 ECU_ADDRESS 0xfe4ccc7b /* @ECU_Address@SwcIn_CSA_2.CSA_2_RollgCntr1@ */ /end MEASUREMENT
/begin MEASUREMENT SwcIn_CSA_2.CSA_2_TurnSigLvrCmd "" UBYTE autosar_swc_val_CM_CSA_2_TurnSigLvrCmd_631_dt 0 0 0 255 ECU_ADDRESS 0xfe4ccc7e /* @ECU_Address@SwcIn_CSA_2.CSA_2_TurnSigLvrCmd@ */ /end MEASUREMENT
/begin MEASUREMENT SwcIn_CSA_2.CSA_2_WshrFrntCmd "" UBYTE autosar_swc_val_CM_CSA_2_WshrFrntCmd_631_dt 0 0 0 255 ECU_ADDRESS 0xfe4ccc7f /* @ECU_Address@SwcIn_CSA_2.CSA_2_WshrFrntCmd@ */ /end MEASUREMENT
/begin MEASUREMENT SwcIn_DIAG_OBD_REQ_Broadcast.Diag_Functional_REQ "" A_UINT64 autosar_swc_val_CM_Diag_Functional_REQ_2015_dt 0 0 0.0 1.844674407370955e+19 ECU_ADDRESS 0xfe4ca490 /* @ECU_Address@SwcIn_DIAG_OBD_REQ_Broadcast.Diag_Functional_REQ@ */ /end MEASUREMENT
/begin MEASUREMENT SwcIn_Diag_FCM_REQ.Diag_FCM_REQ "" A_UINT64 autosar_swc_val_CM_Diag_FCM_REQ_1858_dt 0 0 0.0 1.844674407370955e+19 ECU_ADDRESS 0xfe4ca498 /* @ECU_Address@SwcIn_Diag_FCM_REQ.Diag_FCM_REQ@ */ /end MEASUREMENT
/begin MEASUREMENT SwcIn_EPB_R_1.EPB_1_ActrSt "" UBYTE autosar_swc_val_CM_EPB_1_ActrSt_612_dt 0 0 0 255 ECU_ADDRESS 0xfe4ccc83 /* @ECU_Address@SwcIn_EPB_R_1.EPB_1_ActrSt@ */ /end MEASUREMENT
/begin MEASUREMENT SwcIn_EPB_R_1.EPB_1_DrvrRqParkBrk "" UBYTE autosar_swc_val_CM_EPB_1_DrvrRqParkBrk_612_dt 0 0 0 255 ECU_ADDRESS 0xfe4ccc89 /* @ECU_Address@SwcIn_EPB_R_1.EPB_1_DrvrRqParkBrk@ */ /end MEASUREMENT
/begin MEASUREMENT SwcIn_EPB_R_1.EPB_1_DrvrRqParkBrkVld "" UBYTE autosar_swc_val_CM_EPB_1_DrvrRqParkBrkVld_612_dt 0 0 0 255 ECU_ADDRESS 0xfe4ccc8a /* @ECU_Address@SwcIn_EPB_R_1.EPB_1_DrvrRqParkBrkVld@ */ /end MEASUREMENT
/begin MEASUREMENT SwcIn_EPB_R_1.EPB_1_DynBrkgSt "" UBYTE autosar_swc_val_CM_EPB_1_DynBrkgSt_612_dt 0 0 0 255 ECU_ADDRESS 0xfe4ccc85 /* @ECU_Address@SwcIn_EPB_R_1.EPB_1_DynBrkgSt@ */ /end MEASUREMENT
/begin MEASUREMENT SwcIn_EPB_R_1.EPB_1_EPBAvlSt "" UBYTE autosar_swc_val_CM_EPB_1_EPBAvlSt_612_dt 0 0 0 255 ECU_ADDRESS 0xfe4ccc86 /* @ECU_Address@SwcIn_EPB_R_1.EPB_1_EPBAvlSt@ */ /end MEASUREMENT
/begin MEASUREMENT SwcIn_EPB_R_1.EPB_1_FltLvl "" UBYTE autosar_swc_val_CM_EPB_1_FltLvl_612_dt 0 0 0 255 ECU_ADDRESS 0xfe4ccc88 /* @ECU_Address@SwcIn_EPB_R_1.EPB_1_FltLvl@ */ /end MEASUREMENT
/begin MEASUREMENT SwcIn_EPB_R_1.EPB_1_ParkBrkCpby "" UBYTE autosar_swc_val_CM_EPB_1_ParkBrkCpby_612_dt 0 0 0 255 ECU_ADDRESS 0xfe4ccc87 /* @ECU_Address@SwcIn_EPB_R_1.EPB_1_ParkBrkCpby@ */ /end MEASUREMENT
/begin MEASUREMENT SwcIn_EPB_R_1.EPB_1_RWUSt "" UBYTE autosar_swc_val_CM_EPB_1_RWUSt_612_dt 0 0 0 255 ECU_ADDRESS 0xfe4ccc84 /* @ECU_Address@SwcIn_EPB_R_1.EPB_1_RWUSt@ */ /end MEASUREMENT
/begin MEASUREMENT SwcIn_EPB_R_1.EPB_R_1_ActrSt "" UBYTE autosar_swc_val_CM_EPB_R_1_ActrSt_612_dt 0 0 0 255 ECU_ADDRESS 0xfe4ccc91 /* @ECU_Address@SwcIn_EPB_R_1.EPB_R_1_ActrSt@ */ /end MEASUREMENT
/begin MEASUREMENT SwcIn_EPB_R_1.EPB_R_1_BrkLitReq "" UBYTE autosar_swc_val_CM_EPB_R_1_BrkLitReq_612_dt 0 0 0 255 ECU_ADDRESS 0xfe4ccc8e /* @ECU_Address@SwcIn_EPB_R_1.EPB_R_1_BrkLitReq@ */ /end MEASUREMENT
/begin MEASUREMENT SwcIn_EPB_R_1.EPB_R_1_CDP_Req "" UBYTE autosar_swc_val_CM_EPB_R_1_CDP_Req_612_dt 0 0 0 255 ECU_ADDRESS 0xfe4ccc92 /* @ECU_Address@SwcIn_EPB_R_1.EPB_R_1_CDP_Req@ */ /end MEASUREMENT
/begin MEASUREMENT SwcIn_EPB_R_1.EPB_R_1_CRC1 "" UBYTE autosar_swc_val_CM_EPB_R_1_CRC1_612_dt 0 0 0 255 ECU_ADDRESS 0xfe4ccc80 /* @ECU_Address@SwcIn_EPB_R_1.EPB_R_1_CRC1@ */ /end MEASUREMENT
/begin MEASUREMENT SwcIn_EPB_R_1.EPB_R_1_CRC2 "" UBYTE autosar_swc_val_CM_EPB_R_1_CRC2_612_dt 0 0 0 255 ECU_ADDRESS 0xfe4ccc8b /* @ECU_Address@SwcIn_EPB_R_1.EPB_R_1_CRC2@ */ /end MEASUREMENT
/begin MEASUREMENT SwcIn_EPB_R_1.EPB_R_1_DrvrRqParkBrk "" UBYTE autosar_swc_val_CM_EPB_R_1_DrvrRqParkBrk_612_dt 0 0 0 255 ECU_ADDRESS 0xfe4ccc98 /* @ECU_Address@SwcIn_EPB_R_1.EPB_R_1_DrvrRqParkBrk@ */ /end MEASUREMENT
/begin MEASUREMENT SwcIn_EPB_R_1.EPB_R_1_DrvrRqParkBrkVld "" UBYTE autosar_swc_val_CM_EPB_R_1_DrvrRqParkBrkVld_612_dt 0 0 0 255 ECU_ADDRESS 0xfe4ccc99 /* @ECU_Address@SwcIn_EPB_R_1.EPB_R_1_DrvrRqParkBrkVld@ */ /end MEASUREMENT
/begin MEASUREMENT SwcIn_EPB_R_1.EPB_R_1_Dyn_BrkgSt "" UBYTE autosar_swc_val_CM_EPB_R_1_Dyn_BrkgSt_612_dt 0 0 0 255 ECU_ADDRESS 0xfe4ccc94 /* @ECU_Address@SwcIn_EPB_R_1.EPB_R_1_Dyn_BrkgSt@ */ /end MEASUREMENT
/begin MEASUREMENT SwcIn_EPB_R_1.EPB_R_1_EPB_R_1Avl_St "" UBYTE autosar_swc_val_CM_EPB_R_1_EPB_R_1Avl_St_612_dt 0 0 0 255 ECU_ADDRESS 0xfe4ccc95 /* @ECU_Address@SwcIn_EPB_R_1.EPB_R_1_EPB_R_1Avl_St@ */ /end MEASUREMENT
/begin MEASUREMENT SwcIn_EPB_R_1.EPB_R_1_FltLvl "" UBYTE autosar_swc_val_CM_EPB_R_1_FltLvl_612_dt 0 0 0 255 ECU_ADDRESS 0xfe4ccc97 /* @ECU_Address@SwcIn_EPB_R_1.EPB_R_1_FltLvl@ */ /end MEASUREMENT
/begin MEASUREMENT SwcIn_EPB_R_1.EPB_R_1_Flt_Lamp "" UBYTE autosar_swc_val_CM_EPB_R_1_Flt_Lamp_612_dt 0 0 0 255 ECU_ADDRESS 0xfe4ccc8f /* @ECU_Address@SwcIn_EPB_R_1.EPB_R_1_Flt_Lamp@ */ /end MEASUREMENT
/begin MEASUREMENT SwcIn_EPB_R_1.EPB_R_1_Park_Lamp "" UBYTE autosar_swc_val_CM_EPB_R_1_Park_Lamp_612_dt 0 0 0 255 ECU_ADDRESS 0xfe4ccc90 /* @ECU_Address@SwcIn_EPB_R_1.EPB_R_1_Park_Lamp@ */ /end MEASUREMENT
/begin MEASUREMENT SwcIn_EPB_R_1.EPB_R_1_RWU_St "" UBYTE autosar_swc_val_CM_EPB_R_1_RWU_St_612_dt 0 0 0 255 ECU_ADDRESS 0xfe4ccc93 /* @ECU_Address@SwcIn_EPB_R_1.EPB_R_1_RWU_St@ */ /end MEASUREMENT
/begin MEASUREMENT SwcIn_EPB_R_1.EPB_R_1_Resd1 "" UBYTE autosar_swc_val_CM_EPB_R_1_Resd1_612_dt 0 0 0 255 ECU_ADDRESS 0xfe4ccc82 /* @ECU_Address@SwcIn_EPB_R_1.EPB_R_1_Resd1@ */ /end MEASUREMENT
/begin MEASUREMENT SwcIn_EPB_R_1.EPB_R_1_Resd2 "" UBYTE autosar_swc_val_CM_EPB_R_1_Resd2_612_dt 0 0 0 255 ECU_ADDRESS 0xfe4ccc8d /* @ECU_Address@SwcIn_EPB_R_1.EPB_R_1_Resd2@ */ /end MEASUREMENT
/begin MEASUREMENT SwcIn_EPB_R_1.EPB_R_1_RollgCntr1 "" UBYTE autosar_swc_val_CM_EPB_R_1_RollgCntr1_612_dt 0 0 0 255 ECU_ADDRESS 0xfe4ccc81 /* @ECU_Address@SwcIn_EPB_R_1.EPB_R_1_RollgCntr1@ */ /end MEASUREMENT
/begin MEASUREMENT SwcIn_EPB_R_1.EPB_R_1_RollgCntr2 "" UBYTE autosar_swc_val_CM_EPB_R_1_RollgCntr2_612_dt 0 0 0 255 ECU_ADDRESS 0xfe4ccc8c /* @ECU_Address@SwcIn_EPB_R_1.EPB_R_1_RollgCntr2@ */ /end MEASUREMENT
/begin MEASUREMENT SwcIn_EPB_R_1.EPB_R_1_TextDisp "" UBYTE autosar_swc_val_CM_EPB_R_1_TextDisp_612_dt 0 0 0 255 ECU_ADDRESS 0xfe4ccc96 /* @ECU_Address@SwcIn_EPB_R_1.EPB_R_1_TextDisp@ */ /end MEASUREMENT
/begin MEASUREMENT SwcIn_EPS_1.EPSFailSts "" UBYTE autosar_swc_val_CM_EPSFailSts_290_dt 0 0 0 255 ECU_ADDRESS 0xfe4cc91b /* @ECU_Address@SwcIn_EPS_1.EPSFailSts@ */ /end MEASUREMENT
/begin MEASUREMENT SwcIn_EPS_1.EPS_1_CRC "" UBYTE autosar_swc_val_CM_EPS_1_CRC_290_dt 0 0 0 255 ECU_ADDRESS 0xfe4cc918 /* @ECU_Address@SwcIn_EPS_1.EPS_1_CRC@ */ /end MEASUREMENT
/begin MEASUREMENT SwcIn_EPS_1.EPS_1_Resd "" UBYTE autosar_swc_val_CM_EPS_1_Resd_290_dt 0 0 0 255 ECU_ADDRESS 0xfe4cc91a /* @ECU_Address@SwcIn_EPS_1.EPS_1_Resd@ */ /end MEASUREMENT
/begin MEASUREMENT SwcIn_EPS_1.EPS_1_RollgCntr "" UBYTE autosar_swc_val_CM_EPS_1_RollgCntr_290_dt 0 0 0 255 ECU_ADDRESS 0xfe4cc919 /* @ECU_Address@SwcIn_EPS_1.EPS_1_RollgCntr@ */ /end MEASUREMENT
/begin MEASUREMENT SwcIn_EPS_3.EPS_3_CRC "" UBYTE autosar_swc_val_CM_EPS_3_CRC_715_dt 0 0 0 255 ECU_ADDRESS 0xfe4cc91c /* @ECU_Address@SwcIn_EPS_3.EPS_3_CRC@ */ /end MEASUREMENT
/begin MEASUREMENT SwcIn_EPS_3.EPS_3_Resd "" UBYTE autosar_swc_val_CM_EPS_3_Resd_715_dt 0 0 0 255 ECU_ADDRESS 0xfe4cc91e /* @ECU_Address@SwcIn_EPS_3.EPS_3_Resd@ */ /end MEASUREMENT
/begin MEASUREMENT SwcIn_EPS_3.EPS_3_RollgCntr "" UBYTE autosar_swc_val_CM_EPS_3_RollgCntr_715_dt 0 0 0 255 ECU_ADDRESS 0xfe4cc91d /* @ECU_Address@SwcIn_EPS_3.EPS_3_RollgCntr@ */ /end MEASUREMENT
/begin MEASUREMENT SwcIn_EPS_3.TorsionBarTorque "" FLOAT32_IEEE autosar_swc_val_CM_TorsionBarTorque_715_dt 0 0 -3.4E+38 3.4E+38 ECU_ADDRESS 0xfe4cc920 /* @ECU_Address@SwcIn_EPS_3.TorsionBarTorque@ */ /end MEASUREMENT
/begin MEASUREMENT SwcIn_EPS_3.TorsionBarTorqueDir "" UBYTE autosar_swc_val_CM_TorsionBarTorqueDir_715_dt 0 0 0 255 ECU_ADDRESS 0xfe4cc924 /* @ECU_Address@SwcIn_EPS_3.TorsionBarTorqueDir@ */ /end MEASUREMENT
/begin MEASUREMENT SwcIn_EPS_3.TosionBarTorqueValid "" UBYTE autosar_swc_val_CM_TosionBarTorqueValid_715_dt 0 0 0 255 ECU_ADDRESS 0xfe4cc925 /* @ECU_Address@SwcIn_EPS_3.TosionBarTorqueValid@ */ /end MEASUREMENT
/begin MEASUREMENT SwcIn_EPS_4.EPS_4_ADSMaxTq "" FLOAT32_IEEE autosar_swc_val_CM_EPS_4_ADSMaxTq_421_dt 0 0 -3.4E+38 3.4E+38 ECU_ADDRESS 0xfe4cc958 /* @ECU_Address@SwcIn_EPS_4.EPS_4_ADSMaxTq@ */ /end MEASUREMENT
/begin MEASUREMENT SwcIn_EPS_4.EPS_4_ADSMinTq "" FLOAT32_IEEE autosar_swc_val_CM_EPS_4_ADSMinTq_421_dt 0 0 -3.4E+38 3.4E+38 ECU_ADDRESS 0xfe4cc95c /* @ECU_Address@SwcIn_EPS_4.EPS_4_ADSMinTq@ */ /end MEASUREMENT
/begin MEASUREMENT SwcIn_EPS_4.EPS_4_AgParkCtrlAvl "" UBYTE autosar_swc_val_CM_EPS_4_AgParkCtrlAvl_421_dt 0 0 0 255 ECU_ADDRESS 0xfe4cc92b /* @ECU_Address@SwcIn_EPS_4.EPS_4_AgParkCtrlAvl@ */ /end MEASUREMENT
/begin MEASUREMENT SwcIn_EPS_4.EPS_4_AgParkCtrlSts "" UBYTE autosar_swc_val_CM_EPS_4_AgParkCtrlSts_421_dt 0 0 0 255 ECU_ADDRESS 0xfe4cc932 /* @ECU_Address@SwcIn_EPS_4.EPS_4_AgParkCtrlSts@ */ /end MEASUREMENT
/begin MEASUREMENT SwcIn_EPS_4.EPS_4_AgPilotCtrlAvl "" UBYTE autosar_swc_val_CM_EPS_4_AgPilotCtrlAvl_421_dt 0 0 0 255 ECU_ADDRESS 0xfe4cc92c /* @ECU_Address@SwcIn_EPS_4.EPS_4_AgPilotCtrlAvl@ */ /end MEASUREMENT
/begin MEASUREMENT SwcIn_EPS_4.EPS_4_AgPilotCtrlSts "" UBYTE autosar_swc_val_CM_EPS_4_AgPilotCtrlSts_421_dt 0 0 0 255 ECU_ADDRESS 0xfe4cc92d /* @ECU_Address@SwcIn_EPS_4.EPS_4_AgPilotCtrlSts@ */ /end MEASUREMENT
/begin MEASUREMENT SwcIn_EPS_4.EPS_4_AsscMotCrtTq "" FLOAT32_IEEE autosar_swc_val_CM_EPS_4_AsscMotCrtTq_421_dt 0 0 -3.4E+38 3.4E+38 ECU_ADDRESS 0xfe4cc940 /* @ECU_Address@SwcIn_EPS_4.EPS_4_AsscMotCrtTq@ */ /end MEASUREMENT
/begin MEASUREMENT SwcIn_EPS_4.EPS_4_AsscMotCrtTqVld "" UBYTE autosar_swc_val_CM_EPS_4_AsscMotCrtTqVld_421_dt 0 0 0 255 ECU_ADDRESS 0xfe4cc944 /* @ECU_Address@SwcIn_EPS_4.EPS_4_AsscMotCrtTqVld@ */ /end MEASUREMENT
/begin MEASUREMENT SwcIn_EPS_4.EPS_4_CRC1 "" UBYTE autosar_swc_val_CM_EPS_4_CRC1_421_dt 0 0 0 255 ECU_ADDRESS 0xfe4cc928 /* @ECU_Address@SwcIn_EPS_4.EPS_4_CRC1@ */ /end MEASUREMENT
/begin MEASUREMENT SwcIn_EPS_4.EPS_4_CRC2 "" UBYTE autosar_swc_val_CM_EPS_4_CRC2_421_dt 0 0 0 255 ECU_ADDRESS 0xfe4cc933 /* @ECU_Address@SwcIn_EPS_4.EPS_4_CRC2@ */ /end MEASUREMENT
/begin MEASUREMENT SwcIn_EPS_4.EPS_4_CRC3 "" UBYTE autosar_swc_val_CM_EPS_4_CRC3_421_dt 0 0 0 255 ECU_ADDRESS 0xfe4cc945 /* @ECU_Address@SwcIn_EPS_4.EPS_4_CRC3@ */ /end MEASUREMENT
/begin MEASUREMENT SwcIn_EPS_4.EPS_4_CRC4 "" UBYTE autosar_swc_val_CM_EPS_4_CRC4_421_dt 0 0 0 255 ECU_ADDRESS 0xfe4cc94b /* @ECU_Address@SwcIn_EPS_4.EPS_4_CRC4@ */ /end MEASUREMENT
/begin MEASUREMENT SwcIn_EPS_4.EPS_4_CRC5 "" UBYTE autosar_swc_val_CM_EPS_4_CRC5_421_dt 0 0 0 255 ECU_ADDRESS 0xfe4cc954 /* @ECU_Address@SwcIn_EPS_4.EPS_4_CRC5@ */ /end MEASUREMENT
/begin MEASUREMENT SwcIn_EPS_4.EPS_4_LdwWarnSts "" UBYTE autosar_swc_val_CM_EPS_4_LdwWarnSts_421_dt 0 0 0 255 ECU_ADDRESS 0xfe4cc930 /* @ECU_Address@SwcIn_EPS_4.EPS_4_LdwWarnSts@ */ /end MEASUREMENT
/begin MEASUREMENT SwcIn_EPS_4.EPS_4_LdwWarnStsVD "" UBYTE autosar_swc_val_CM_EPS_4_LdwWarnStsVD_421_dt 0 0 0 255 ECU_ADDRESS 0xfe4cc931 /* @ECU_Address@SwcIn_EPS_4.EPS_4_LdwWarnStsVD@ */ /end MEASUREMENT
/begin MEASUREMENT SwcIn_EPS_4.EPS_4_OverrangeFeedback "" UBYTE autosar_swc_val_CM_EPS_4_OverrangeFeedback_421_dt 0 0 0 255 ECU_ADDRESS 0xfe4cc957 /* @ECU_Address@SwcIn_EPS_4.EPS_4_OverrangeFeedback@ */ /end MEASUREMENT
/begin MEASUREMENT SwcIn_EPS_4.EPS_4_OverrangeFeedbackVD "" UBYTE autosar_swc_val_CM_EPS_4_OverrangeFeedbackVD_421_dt 0 0 0 255 ECU_ADDRESS 0xfe4cc960 /* @ECU_Address@SwcIn_EPS_4.EPS_4_OverrangeFeedbackVD@ */ /end MEASUREMENT
/begin MEASUREMENT SwcIn_EPS_4.EPS_4_Resd1 "" UBYTE autosar_swc_val_CM_EPS_4_Resd1_421_dt 0 0 0 255 ECU_ADDRESS 0xfe4cc92a /* @ECU_Address@SwcIn_EPS_4.EPS_4_Resd1@ */ /end MEASUREMENT
/begin MEASUREMENT SwcIn_EPS_4.EPS_4_Resd2 "" UBYTE autosar_swc_val_CM_EPS_4_Resd2_421_dt 0 0 0 255 ECU_ADDRESS 0xfe4cc935 /* @ECU_Address@SwcIn_EPS_4.EPS_4_Resd2@ */ /end MEASUREMENT
/begin MEASUREMENT SwcIn_EPS_4.EPS_4_Resd3 "" UBYTE autosar_swc_val_CM_EPS_4_Resd3_421_dt 0 0 0 255 ECU_ADDRESS 0xfe4cc947 /* @ECU_Address@SwcIn_EPS_4.EPS_4_Resd3@ */ /end MEASUREMENT
/begin MEASUREMENT SwcIn_EPS_4.EPS_4_Resd4 "" UBYTE autosar_swc_val_CM_EPS_4_Resd4_421_dt 0 0 0 255 ECU_ADDRESS 0xfe4cc94d /* @ECU_Address@SwcIn_EPS_4.EPS_4_Resd4@ */ /end MEASUREMENT
/begin MEASUREMENT SwcIn_EPS_4.EPS_4_Resd5 "" UBYTE autosar_swc_val_CM_EPS_4_Resd5_421_dt 0 0 0 255 ECU_ADDRESS 0xfe4cc956 /* @ECU_Address@SwcIn_EPS_4.EPS_4_Resd5@ */ /end MEASUREMENT
/begin MEASUREMENT SwcIn_EPS_4.EPS_4_RollgCntr1 "" UBYTE autosar_swc_val_CM_EPS_4_RollgCntr1_421_dt 0 0 0 255 ECU_ADDRESS 0xfe4cc929 /* @ECU_Address@SwcIn_EPS_4.EPS_4_RollgCntr1@ */ /end MEASUREMENT
/begin MEASUREMENT SwcIn_EPS_4.EPS_4_RollgCntr2 "" UBYTE autosar_swc_val_CM_EPS_4_RollgCntr2_421_dt 0 0 0 255 ECU_ADDRESS 0xfe4cc934 /* @ECU_Address@SwcIn_EPS_4.EPS_4_RollgCntr2@ */ /end MEASUREMENT
/begin MEASUREMENT SwcIn_EPS_4.EPS_4_RollgCntr3 "" UBYTE autosar_swc_val_CM_EPS_4_RollgCntr3_421_dt 0 0 0 255 ECU_ADDRESS 0xfe4cc946 /* @ECU_Address@SwcIn_EPS_4.EPS_4_RollgCntr3@ */ /end MEASUREMENT
/begin MEASUREMENT SwcIn_EPS_4.EPS_4_RollgCntr4 "" UBYTE autosar_swc_val_CM_EPS_4_RollgCntr4_421_dt 0 0 0 255 ECU_ADDRESS 0xfe4cc94c /* @ECU_Address@SwcIn_EPS_4.EPS_4_RollgCntr4@ */ /end MEASUREMENT
/begin MEASUREMENT SwcIn_EPS_4.EPS_4_RollgCntr5 "" UBYTE autosar_swc_val_CM_EPS_4_RollgCntr5_421_dt 0 0 0 255 ECU_ADDRESS 0xfe4cc955 /* @ECU_Address@SwcIn_EPS_4.EPS_4_RollgCntr5@ */ /end MEASUREMENT
/begin MEASUREMENT SwcIn_EPS_4.EPS_4_SteerDrvrOvrd "" UBYTE autosar_swc_val_CM_EPS_4_SteerDrvrOvrd_421_dt 0 0 0 255 ECU_ADDRESS 0xfe4cc948 /* @ECU_Address@SwcIn_EPS_4.EPS_4_SteerDrvrOvrd@ */ /end MEASUREMENT
/begin MEASUREMENT SwcIn_EPS_4.EPS_4_SteerDrvrOvrdVld "" UBYTE autosar_swc_val_CM_EPS_4_SteerDrvrOvrdVld_421_dt 0 0 0 255 ECU_ADDRESS 0xfe4cc949 /* @ECU_Address@SwcIn_EPS_4.EPS_4_SteerDrvrOvrdVld@ */ /end MEASUREMENT
/begin MEASUREMENT SwcIn_EPS_4.EPS_4_SteerMod "" UBYTE autosar_swc_val_CM_EPS_4_SteerMod_421_dt 0 0 0 255 ECU_ADDRESS 0xfe4cc94a /* @ECU_Address@SwcIn_EPS_4.EPS_4_SteerMod@ */ /end MEASUREMENT
/begin MEASUREMENT SwcIn_EPS_4.EPS_4_SteerPinionTq "" FLOAT32_IEEE autosar_swc_val_CM_EPS_4_SteerPinionTq_421_dt 0 0 -3.4E+38 3.4E+38 ECU_ADDRESS 0xfe4cc938 /* @ECU_Address@SwcIn_EPS_4.EPS_4_SteerPinionTq@ */ /end MEASUREMENT
/begin MEASUREMENT SwcIn_EPS_4.EPS_4_SteerPinionTqVld "" UBYTE autosar_swc_val_CM_EPS_4_SteerPinionTqVld_421_dt 0 0 0 255 ECU_ADDRESS 0xfe4cc93c /* @ECU_Address@SwcIn_EPS_4.EPS_4_SteerPinionTqVld@ */ /end MEASUREMENT
/begin MEASUREMENT SwcIn_EPS_4.EPS_4_Tq2 "" FLOAT32_IEEE autosar_swc_val_CM_EPS_4_Tq2_421_dt 0 0 -3.4E+38 3.4E+38 ECU_ADDRESS 0xfe4cc950 /* @ECU_Address@SwcIn_EPS_4.EPS_4_Tq2@ */ /end MEASUREMENT
/begin MEASUREMENT SwcIn_EPS_4.EPS_4_TqCtrlAvl "" UBYTE autosar_swc_val_CM_EPS_4_TqCtrlAvl_421_dt 0 0 0 255 ECU_ADDRESS 0xfe4cc92e /* @ECU_Address@SwcIn_EPS_4.EPS_4_TqCtrlAvl@ */ /end MEASUREMENT
/begin MEASUREMENT SwcIn_EPS_4.EPS_4_TqCtrlSts "" UBYTE autosar_swc_val_CM_EPS_4_TqCtrlSts_421_dt 0 0 0 255 ECU_ADDRESS 0xfe4cc92f /* @ECU_Address@SwcIn_EPS_4.EPS_4_TqCtrlSts@ */ /end MEASUREMENT
/begin MEASUREMENT SwcIn_FLCR_1.FLCR_1_BlkSts "" UBYTE autosar_swc_val_CM_FLCR_1_BlkSts_1050_dt 0 0 0 255 ECU_ADDRESS 0xfe4ccd94 /* @ECU_Address@SwcIn_FLCR_1.FLCR_1_BlkSts@ */ /end MEASUREMENT
/begin MEASUREMENT SwcIn_FLCR_1.FLCR_1_CRC1 "" UBYTE autosar_swc_val_CM_FLCR_1_CRC1_1050_dt 0 0 0 255 ECU_ADDRESS 0xfe4ccd90 /* @ECU_Address@SwcIn_FLCR_1.FLCR_1_CRC1@ */ /end MEASUREMENT
/begin MEASUREMENT SwcIn_FLCR_1.FLCR_1_Resd1 "" UBYTE autosar_swc_val_CM_FLCR_1_Resd1_1050_dt 0 0 0 255 ECU_ADDRESS 0xfe4ccd92 /* @ECU_Address@SwcIn_FLCR_1.FLCR_1_Resd1@ */ /end MEASUREMENT
/begin MEASUREMENT SwcIn_FLCR_1.FLCR_1_RollgCntr1 "" UBYTE autosar_swc_val_CM_FLCR_1_RollgCntr1_1050_dt 0 0 0 255 ECU_ADDRESS 0xfe4ccd91 /* @ECU_Address@SwcIn_FLCR_1.FLCR_1_RollgCntr1@ */ /end MEASUREMENT
/begin MEASUREMENT SwcIn_FLCR_1.FLCR_1_SysSt "" UBYTE autosar_swc_val_CM_FLCR_1_SysSt_1050_dt 0 0 0 255 ECU_ADDRESS 0xfe4ccd93 /* @ECU_Address@SwcIn_FLCR_1.FLCR_1_SysSt@ */ /end MEASUREMENT
/begin MEASUREMENT SwcIn_FLCR_2.FLCR_2_CRC1 "" UBYTE autosar_swc_val_CM_FLCR_2_CRC1_1062_dt 0 0 0 255 ECU_ADDRESS 0xfe4ca4a0 /* @ECU_Address@SwcIn_FLCR_2.FLCR_2_CRC1@ */ /end MEASUREMENT
/begin MEASUREMENT SwcIn_FLCR_2.FLCR_2_FCTAFCTBONOFFSts "" UBYTE autosar_swc_val_CM_FLCR_2_FCTAFCTBONOFFSts_1062_dt 0 0 0 255 ECU_ADDRESS 0xfe4ca4ac /* @ECU_Address@SwcIn_FLCR_2.FLCR_2_FCTAFCTBONOFFSts@ */ /end MEASUREMENT
/begin MEASUREMENT SwcIn_FLCR_2.FLCR_2_FCTAWarn "" UBYTE autosar_swc_val_CM_FLCR_2_FCTAWarn_1062_dt 0 0 0 255 ECU_ADDRESS 0xfe4ca4a3 /* @ECU_Address@SwcIn_FLCR_2.FLCR_2_FCTAWarn@ */ /end MEASUREMENT
/begin MEASUREMENT SwcIn_FLCR_2.FLCR_2_FCTBCtrlA "" FLOAT32_IEEE autosar_swc_val_CM_FLCR_2_FCTBCtrlA_1062_dt 0 0 -3.4E+38 3.4E+38 ECU_ADDRESS 0xfe4ca4a8 /* @ECU_Address@SwcIn_FLCR_2.FLCR_2_FCTBCtrlA@ */ /end MEASUREMENT
/begin MEASUREMENT SwcIn_FLCR_2.FLCR_2_FCTBReq "" UBYTE autosar_swc_val_CM_FLCR_2_FCTBReq_1062_dt 0 0 0 255 ECU_ADDRESS 0xfe4ca4a5 /* @ECU_Address@SwcIn_FLCR_2.FLCR_2_FCTBReq@ */ /end MEASUREMENT
/begin MEASUREMENT SwcIn_FLCR_2.FLCR_2_FCTBWarn "" UBYTE autosar_swc_val_CM_FLCR_2_FCTBWarn_1062_dt 0 0 0 255 ECU_ADDRESS 0xfe4ca4a4 /* @ECU_Address@SwcIn_FLCR_2.FLCR_2_FCTBWarn@ */ /end MEASUREMENT
/begin MEASUREMENT SwcIn_FLCR_2.FLCR_2_Resd1 "" UBYTE autosar_swc_val_CM_FLCR_2_Resd1_1062_dt 0 0 0 255 ECU_ADDRESS 0xfe4ca4a2 /* @ECU_Address@SwcIn_FLCR_2.FLCR_2_Resd1@ */ /end MEASUREMENT
/begin MEASUREMENT SwcIn_FLCR_2.FLCR_2_RollgCntr1 "" UBYTE autosar_swc_val_CM_FLCR_2_RollgCntr1_1062_dt 0 0 0 255 ECU_ADDRESS 0xfe4ca4a1 /* @ECU_Address@SwcIn_FLCR_2.FLCR_2_RollgCntr1@ */ /end MEASUREMENT
/begin MEASUREMENT SwcIn_FLZCU_1.DirectionIndLeft "" UBYTE autosar_swc_val_CM_DirectionIndLeft_571_dt 0 0 0 255 ECU_ADDRESS 0xfe4ccda3 /* @ECU_Address@SwcIn_FLZCU_1.DirectionIndLeft@ */ /end MEASUREMENT
/begin MEASUREMENT SwcIn_FLZCU_1.DirectionIndRight "" UBYTE autosar_swc_val_CM_DirectionIndRight_571_dt 0 0 0 255 ECU_ADDRESS 0xfe4ccda4 /* @ECU_Address@SwcIn_FLZCU_1.DirectionIndRight@ */ /end MEASUREMENT
/begin MEASUREMENT SwcIn_FLZCU_1.FLZCU_1_CRC "" UBYTE autosar_swc_val_CM_FLZCU_1_CRC_571_dt 0 0 0 255 ECU_ADDRESS 0xfe4ccd95 /* @ECU_Address@SwcIn_FLZCU_1.FLZCU_1_CRC@ */ /end MEASUREMENT
/begin MEASUREMENT SwcIn_FLZCU_1.FLZCU_1_Resd "" UBYTE autosar_swc_val_CM_FLZCU_1_Resd_571_dt 0 0 0 255 ECU_ADDRESS 0xfe4ccd97 /* @ECU_Address@SwcIn_FLZCU_1.FLZCU_1_Resd@ */ /end MEASUREMENT
/begin MEASUREMENT SwcIn_FLZCU_1.FLZCU_1_RollgCntr "" UBYTE autosar_swc_val_CM_FLZCU_1_RollgCntr_571_dt 0 0 0 255 ECU_ADDRESS 0xfe4ccd96 /* @ECU_Address@SwcIn_FLZCU_1.FLZCU_1_RollgCntr@ */ /end MEASUREMENT
/begin MEASUREMENT SwcIn_FLZCU_1.FL_SeatBeltFaultStatus "" UBYTE autosar_swc_val_CM_FL_SeatBeltFaultStatus_571_dt 0 0 0 255 ECU_ADDRESS 0xfe4ccda5 /* @ECU_Address@SwcIn_FLZCU_1.FL_SeatBeltFaultStatus@ */ /end MEASUREMENT
/begin MEASUREMENT SwcIn_FLZCU_1.FL_SeatOccupiedSts "" UBYTE autosar_swc_val_CM_FL_SeatOccupiedSts_571_dt 0 0 0 255 ECU_ADDRESS 0xfe4ccd99 /* @ECU_Address@SwcIn_FLZCU_1.FL_SeatOccupiedSts@ */ /end MEASUREMENT
/begin MEASUREMENT SwcIn_FLZCU_1.HazardLightSW "" UBYTE autosar_swc_val_CM_HazardLightSW_571_dt 0 0 0 255 ECU_ADDRESS 0xfe4ccda1 /* @ECU_Address@SwcIn_FLZCU_1.HazardLightSW@ */ /end MEASUREMENT
/begin MEASUREMENT SwcIn_FLZCU_1.HoodLockSts "" UBYTE autosar_swc_val_CM_HoodLockSts_571_dt 0 0 0 255 ECU_ADDRESS 0xfe4ccd98 /* @ECU_Address@SwcIn_FLZCU_1.HoodLockSts@ */ /end MEASUREMENT
/begin MEASUREMENT SwcIn_FLZCU_1.HoodSts "" UBYTE autosar_swc_val_CM_HoodSts_571_dt 0 0 0 255 ECU_ADDRESS 0xfe4ccd9c /* @ECU_Address@SwcIn_FLZCU_1.HoodSts@ */ /end MEASUREMENT
/begin MEASUREMENT SwcIn_FLZCU_1.LHFDoorLockSts "" UBYTE autosar_swc_val_CM_LHFDoorLockSts_571_dt 0 0 0 255 ECU_ADDRESS 0xfe4ccd9d /* @ECU_Address@SwcIn_FLZCU_1.LHFDoorLockSts@ */ /end MEASUREMENT
/begin MEASUREMENT SwcIn_FLZCU_1.LHFSeatBeltSW "" UBYTE autosar_swc_val_CM_LHFSeatBeltSW_571_dt 0 0 0 255 ECU_ADDRESS 0xfe4ccda2 /* @ECU_Address@SwcIn_FLZCU_1.LHFSeatBeltSW@ */ /end MEASUREMENT
/begin MEASUREMENT SwcIn_FLZCU_1.LHFdoorSts "" UBYTE autosar_swc_val_CM_LHFdoorSts_571_dt 0 0 0 255 ECU_ADDRESS 0xfe4ccd9e /* @ECU_Address@SwcIn_FLZCU_1.LHFdoorSts@ */ /end MEASUREMENT
/begin MEASUREMENT SwcIn_FLZCU_1.LHTurnSW "" UBYTE autosar_swc_val_CM_LHTurnSW_571_dt 0 0 0 255 ECU_ADDRESS 0xfe4ccd9f /* @ECU_Address@SwcIn_FLZCU_1.LHTurnSW@ */ /end MEASUREMENT
/begin MEASUREMENT SwcIn_FLZCU_1.LHTurnlightSts "" UBYTE autosar_swc_val_CM_LHTurnlightSts_571_dt 0 0 0 255 ECU_ADDRESS 0xfe4ccd9a /* @ECU_Address@SwcIn_FLZCU_1.LHTurnlightSts@ */ /end MEASUREMENT
/begin MEASUREMENT SwcIn_FLZCU_1.RHTurnSW "" UBYTE autosar_swc_val_CM_RHTurnSW_571_dt 0 0 0 255 ECU_ADDRESS 0xfe4ccda0 /* @ECU_Address@SwcIn_FLZCU_1.RHTurnSW@ */ /end MEASUREMENT
/begin MEASUREMENT SwcIn_FLZCU_1.RHTurnlightSts "" UBYTE autosar_swc_val_CM_RHTurnlightSts_571_dt 0 0 0 255 ECU_ADDRESS 0xfe4ccd9b /* @ECU_Address@SwcIn_FLZCU_1.RHTurnlightSts@ */ /end MEASUREMENT
/begin MEASUREMENT SwcIn_FLZCU_12.FLZCU_12_CRC "" UBYTE autosar_swc_val_CM_FLZCU_12_CRC_1030_dt 0 0 0 255 ECU_ADDRESS 0xfe4ccda6 /* @ECU_Address@SwcIn_FLZCU_12.FLZCU_12_CRC@ */ /end MEASUREMENT
/begin MEASUREMENT SwcIn_FLZCU_12.FLZCU_12_RollgCntr "" UBYTE autosar_swc_val_CM_FLZCU_12_RollgCntr_1030_dt 0 0 0 255 ECU_ADDRESS 0xfe4ccda7 /* @ECU_Address@SwcIn_FLZCU_12.FLZCU_12_RollgCntr@ */ /end MEASUREMENT
/begin MEASUREMENT SwcIn_FLZCU_12.FLZCU_FrontWiperParkStatus "" UBYTE autosar_swc_val_CM_FLZCU_FrontWiperParkStatus_1030_dt 0 0 0 255 ECU_ADDRESS 0xfe4ccda8 /* @ECU_Address@SwcIn_FLZCU_12.FLZCU_FrontWiperParkStatus@ */ /end MEASUREMENT
/begin MEASUREMENT SwcIn_FLZCU_12.FLZCU_FrontWiperWipingStatus "" UBYTE autosar_swc_val_CM_FLZCU_FrontWiperWipingStatus_1030_dt 0 0 0 255 ECU_ADDRESS 0xfe4ccda9 /* @ECU_Address@SwcIn_FLZCU_12.FLZCU_FrontWiperWipingStatus@ */ /end MEASUREMENT
/begin MEASUREMENT SwcIn_FLZCU_12.RearViewFoldSts "" UBYTE autosar_swc_val_CM_RearViewFoldSts_1030_dt 0 0 0 255 ECU_ADDRESS 0xfe4ccdaa /* @ECU_Address@SwcIn_FLZCU_12.RearViewFoldSts@ */ /end MEASUREMENT
/begin MEASUREMENT SwcIn_FLZCU_13.RLHS_Humid_Temp_Error "" UBYTE autosar_swc_val_CM_RLHS_Humid_Temp_Error_1076_dt 0 0 0 255 ECU_ADDRESS 0xfe4ccdab /* @ECU_Address@SwcIn_FLZCU_13.RLHS_Humid_Temp_Error@ */ /end MEASUREMENT
/begin MEASUREMENT SwcIn_FLZCU_15.FLZCU_FLFoglightSts "" UBYTE autosar_swc_val_CM_FLZCU_FLFoglightSts_1071_dt 0 0 0 255 ECU_ADDRESS 0xfe4ccc9a /* @ECU_Address@SwcIn_FLZCU_15.FLZCU_FLFoglightSts@ */ /end MEASUREMENT
/begin MEASUREMENT SwcIn_FLZCU_15.FLZCU_FRFoglightSts "" UBYTE autosar_swc_val_CM_FLZCU_FRFoglightSts_1071_dt 0 0 0 255 ECU_ADDRESS 0xfe4ccc9b /* @ECU_Address@SwcIn_FLZCU_15.FLZCU_FRFoglightSts@ */ /end MEASUREMENT
/begin MEASUREMENT SwcIn_FLZCU_15.FLZCU_FrontFogLightSts "" UBYTE autosar_swc_val_CM_FLZCU_FrontFogLightSts_1071_dt 0 0 0 255 ECU_ADDRESS 0xfe4ccca3 /* @ECU_Address@SwcIn_FLZCU_15.FLZCU_FrontFogLightSts@ */ /end MEASUREMENT
/begin MEASUREMENT SwcIn_FLZCU_15.FLZCU_HMASwSts "" UBYTE autosar_swc_val_CM_FLZCU_HMASwSts_1071_dt 0 0 0 255 ECU_ADDRESS 0xfe4ccca2 /* @ECU_Address@SwcIn_FLZCU_15.FLZCU_HMASwSts@ */ /end MEASUREMENT
/begin MEASUREMENT SwcIn_FLZCU_15.FLZCU_HighBeamFaults "" UBYTE autosar_swc_val_CM_FLZCU_HighBeamFaults_1071_dt 0 0 0 255 ECU_ADDRESS 0xfe4ccc9f /* @ECU_Address@SwcIn_FLZCU_15.FLZCU_HighBeamFaults@ */ /end MEASUREMENT
/begin MEASUREMENT SwcIn_FLZCU_15.FLZCU_HighBeamSts "" UBYTE autosar_swc_val_CM_FLZCU_HighBeamSts_1071_dt 0 0 0 255 ECU_ADDRESS 0xfe4ccc9e /* @ECU_Address@SwcIn_FLZCU_15.FLZCU_HighBeamSts@ */ /end MEASUREMENT
/begin MEASUREMENT SwcIn_FLZCU_15.FLZCU_LowBeamSts "" UBYTE autosar_swc_val_CM_FLZCU_LowBeamSts_1071_dt 0 0 0 255 ECU_ADDRESS 0xfe4ccc9d /* @ECU_Address@SwcIn_FLZCU_15.FLZCU_LowBeamSts@ */ /end MEASUREMENT
/begin MEASUREMENT SwcIn_FLZCU_15.FLZCU_ParkLightFaults "" UBYTE autosar_swc_val_CM_FLZCU_ParkLightFaults_1071_dt 0 0 0 255 ECU_ADDRESS 0xfe4ccca1 /* @ECU_Address@SwcIn_FLZCU_15.FLZCU_ParkLightFaults@ */ /end MEASUREMENT
/begin MEASUREMENT SwcIn_FLZCU_15.FLZCU_RearFogLightFaults "" UBYTE autosar_swc_val_CM_FLZCU_RearFogLightFaults_1071_dt 0 0 0 255 ECU_ADDRESS 0xfe4ccca0 /* @ECU_Address@SwcIn_FLZCU_15.FLZCU_RearFogLightFaults@ */ /end MEASUREMENT
/begin MEASUREMENT SwcIn_FLZCU_15.FLZCU_RearFogLightSts "" UBYTE autosar_swc_val_CM_FLZCU_RearFogLightSts_1071_dt 0 0 0 255 ECU_ADDRESS 0xfe4ccc9c /* @ECU_Address@SwcIn_FLZCU_15.FLZCU_RearFogLightSts@ */ /end MEASUREMENT
/begin MEASUREMENT SwcIn_FLZCU_3.FLZCU_3_CRC "" UBYTE autosar_swc_val_CM_FLZCU_3_CRC_1120_dt 0 0 0 255 ECU_ADDRESS 0xfe4ca4b0 /* @ECU_Address@SwcIn_FLZCU_3.FLZCU_3_CRC@ */ /end MEASUREMENT
/begin MEASUREMENT SwcIn_FLZCU_3.FLZCU_3_RollgCntr "" UBYTE autosar_swc_val_CM_FLZCU_3_RollgCntr_1120_dt 0 0 0 255 ECU_ADDRESS 0xfe4ca4b1 /* @ECU_Address@SwcIn_FLZCU_3.FLZCU_3_RollgCntr@ */ /end MEASUREMENT
/begin MEASUREMENT SwcIn_FLZCU_3.RLHS_2_AmbBrightness "" ULONG autosar_swc_val_CM_RLHS_2_AmbBrightness_1120_dt 0 0 0 4294967295 ECU_ADDRESS 0xfe4ca4b4 /* @ECU_Address@SwcIn_FLZCU_3.RLHS_2_AmbBrightness@ */ /end MEASUREMENT
/begin MEASUREMENT SwcIn_FLZCU_3.RLHS_2_IRBrightness "" ULONG autosar_swc_val_CM_RLHS_2_IRBrightness_1120_dt 0 0 0 4294967295 ECU_ADDRESS 0xfe4ca4b8 /* @ECU_Address@SwcIn_FLZCU_3.RLHS_2_IRBrightness@ */ /end MEASUREMENT
/begin MEASUREMENT SwcIn_FLZCU_3.RLHS_LiSwithReason "" UBYTE autosar_swc_val_CM_RLHS_LiSwithReason_1120_dt 0 0 0 255 ECU_ADDRESS 0xfe4ca4bd /* @ECU_Address@SwcIn_FLZCU_3.RLHS_LiSwithReason@ */ /end MEASUREMENT
/begin MEASUREMENT SwcIn_FLZCU_3.RLHS_Rainfall "" UBYTE autosar_swc_val_CM_RLHS_Rainfall_1120_dt 0 0 0 255 ECU_ADDRESS 0xfe4ca4bc /* @ECU_Address@SwcIn_FLZCU_3.RLHS_Rainfall@ */ /end MEASUREMENT
/begin MEASUREMENT SwcIn_FLZCU_7.TrunLightFaults "" UBYTE autosar_swc_val_CM_TrunLightFaults_1260_dt 0 0 0 255 ECU_ADDRESS 0xfe4ccdac /* @ECU_Address@SwcIn_FLZCU_7.TrunLightFaults@ */ /end MEASUREMENT
/begin MEASUREMENT SwcIn_FLZCU_9.FLZCU_9_ArmingSts "" UBYTE autosar_swc_val_CM_FLZCU_9_ArmingSts_1181_dt 0 0 0 255 ECU_ADDRESS 0xfe4ccdb1 /* @ECU_Address@SwcIn_FLZCU_9.FLZCU_9_ArmingSts@ */ /end MEASUREMENT
/begin MEASUREMENT SwcIn_FLZCU_9.FLZCU_9_CRC "" UBYTE autosar_swc_val_CM_FLZCU_9_CRC_1181_dt 0 0 0 255 ECU_ADDRESS 0xfe4ccdad /* @ECU_Address@SwcIn_FLZCU_9.FLZCU_9_CRC@ */ /end MEASUREMENT
/begin MEASUREMENT SwcIn_FLZCU_9.FLZCU_9_PowerMode "" UBYTE autosar_swc_val_CM_FLZCU_9_PowerMode_1181_dt 0 0 0 255 ECU_ADDRESS 0xfe4ccdb0 /* @ECU_Address@SwcIn_FLZCU_9.FLZCU_9_PowerMode@ */ /end MEASUREMENT
/begin MEASUREMENT SwcIn_FLZCU_9.FLZCU_9_Resd1 "" UBYTE autosar_swc_val_CM_FLZCU_9_Resd1_1181_dt 0 0 0 255 ECU_ADDRESS 0xfe4ccdaf /* @ECU_Address@SwcIn_FLZCU_9.FLZCU_9_Resd1@ */ /end MEASUREMENT
/begin MEASUREMENT SwcIn_FLZCU_9.FLZCU_9_RollgCntr "" UBYTE autosar_swc_val_CM_FLZCU_9_RollgCntr_1181_dt 0 0 0 255 ECU_ADDRESS 0xfe4ccdae /* @ECU_Address@SwcIn_FLZCU_9.FLZCU_9_RollgCntr@ */ /end MEASUREMENT
/begin MEASUREMENT SwcIn_FM_SAF_OUT.SftyCmd "" ULONG autosar_swc_val_CM_uint32 0 0 0 4294967295 ECU_ADDRESS 0xfe4cc968 /* @ECU_Address@SwcIn_FM_SAF_OUT.SftyCmd@ */ /end MEASUREMENT
/begin MEASUREMENT SwcIn_FM_SAF_OUT.SftyErrInfo.SftyErr_0 "" ULONG autosar_swc_val_CM_uint32 0 0 0 4294967295 ECU_ADDRESS 0xfe4cc978 /* @ECU_Address@SwcIn_FM_SAF_OUT.SftyErrInfo.SftyErr_0@ */ /end MEASUREMENT
/begin MEASUREMENT SwcIn_FM_SAF_OUT.SftyErrInfo.SftyErr_1 "" ULONG autosar_swc_val_CM_uint32 0 0 0 4294967295 ECU_ADDRESS 0xfe4cc97c /* @ECU_Address@SwcIn_FM_SAF_OUT.SftyErrInfo.SftyErr_1@ */ /end MEASUREMENT
/begin MEASUREMENT SwcIn_FM_SAF_OUT.SftyErrInfo.SftyErr_2 "" ULONG autosar_swc_val_CM_uint32 0 0 0 4294967295 ECU_ADDRESS 0xfe4cc980 /* @ECU_Address@SwcIn_FM_SAF_OUT.SftyErrInfo.SftyErr_2@ */ /end MEASUREMENT
/begin MEASUREMENT SwcIn_FM_SAF_OUT.SftyErrInfo.SftyErr_3 "" ULONG autosar_swc_val_CM_uint32 0 0 0 4294967295 ECU_ADDRESS 0xfe4cc984 /* @ECU_Address@SwcIn_FM_SAF_OUT.SftyErrInfo.SftyErr_3@ */ /end MEASUREMENT
/begin MEASUREMENT SwcIn_FM_SAF_OUT.SftyErrInfo.SftyErr_4 "" ULONG autosar_swc_val_CM_uint32 0 0 0 4294967295 ECU_ADDRESS 0xfe4cc988 /* @ECU_Address@SwcIn_FM_SAF_OUT.SftyErrInfo.SftyErr_4@ */ /end MEASUREMENT
/begin MEASUREMENT SwcIn_FM_SAF_OUT.SftyErrInfo.SftyErr_5 "" ULONG autosar_swc_val_CM_uint32 0 0 0 4294967295 ECU_ADDRESS 0xfe4cc98c /* @ECU_Address@SwcIn_FM_SAF_OUT.SftyErrInfo.SftyErr_5@ */ /end MEASUREMENT
/begin MEASUREMENT SwcIn_FM_SAF_OUT.SftyErrInfo.SftyErr_6 "" ULONG autosar_swc_val_CM_uint32 0 0 0 4294967295 ECU_ADDRESS 0xfe4cc990 /* @ECU_Address@SwcIn_FM_SAF_OUT.SftyErrInfo.SftyErr_6@ */ /end MEASUREMENT
/begin MEASUREMENT SwcIn_FM_SAF_OUT.SftyErrInfo.SftyErr_7 "" ULONG autosar_swc_val_CM_uint32 0 0 0 4294967295 ECU_ADDRESS 0xfe4cc994 /* @ECU_Address@SwcIn_FM_SAF_OUT.SftyErrInfo.SftyErr_7@ */ /end MEASUREMENT
/begin MEASUREMENT SwcIn_FM_SAF_OUT.SftyErrInfo.SftyModeFuSa "" ULONG autosar_swc_val_CM_uint32 0 0 0 4294967295 ECU_ADDRESS 0xfe4cc974 /* @ECU_Address@SwcIn_FM_SAF_OUT.SftyErrInfo.SftyModeFuSa@ */ /end MEASUREMENT
/begin MEASUREMENT SwcIn_FM_SAF_OUT.SftyErrInfo.SftyVehSpdChassis "" FLOAT32_IEEE autosar_swc_val_CM_single 0 0 -3.4E+38 3.4E+38 ECU_ADDRESS 0xfe4cc970 /* @ECU_Address@SwcIn_FM_SAF_OUT.SftyErrInfo.SftyVehSpdChassis@ */ /end MEASUREMENT
/begin MEASUREMENT SwcIn_FM_SAF_OUT.SftyErrInfo.SftyVehSpdChassisVld "" UBYTE autosar_swc_val_CM_boolean 0 0 0 1 ECU_ADDRESS 0xfe4cc96c /* @ECU_Address@SwcIn_FM_SAF_OUT.SftyErrInfo.SftyVehSpdChassisVld@ */ /end MEASUREMENT
/begin MEASUREMENT SwcIn_FM_SAF_OUT.SftyErrInfoQue[0].SftyErrID "" ULONG autosar_swc_val_CM_uint32 0 0 0 4294967295 ECU_ADDRESS 0xfe4cc998 /* @ECU_Address@SwcIn_FM_SAF_OUT.SftyErrInfoQue[0].SftyErrID@ */ /end MEASUREMENT
/begin MEASUREMENT SwcIn_FM_SAF_OUT.SftyErrInfoQue[0].TrigTimeStamp "" ULONG autosar_swc_val_CM_uint32 0 0 0 4294967295 ECU_ADDRESS 0xfe4cc99c /* @ECU_Address@SwcIn_FM_SAF_OUT.SftyErrInfoQue[0].TrigTimeStamp@ */ /end MEASUREMENT
/begin MEASUREMENT SwcIn_FM_SAF_OUT.SftyErrLvl "" UBYTE autosar_swc_val_CM_uint8 0 0 0 255 ECU_ADDRESS 0xfe4cc964 /* @ECU_Address@SwcIn_FM_SAF_OUT.SftyErrLvl@ */ /end MEASUREMENT
/begin MEASUREMENT SwcIn_FRCR_1.FRCR_1_BlkSts "" UBYTE autosar_swc_val_CM_FRCR_1_BlkSts_1067_dt 0 0 0 255 ECU_ADDRESS 0xfe4ccdb6 /* @ECU_Address@SwcIn_FRCR_1.FRCR_1_BlkSts@ */ /end MEASUREMENT
/begin MEASUREMENT SwcIn_FRCR_1.FRCR_1_CRC1 "" UBYTE autosar_swc_val_CM_FRCR_1_CRC1_1067_dt 0 0 0 255 ECU_ADDRESS 0xfe4ccdb2 /* @ECU_Address@SwcIn_FRCR_1.FRCR_1_CRC1@ */ /end MEASUREMENT
/begin MEASUREMENT SwcIn_FRCR_1.FRCR_1_Resd1 "" UBYTE autosar_swc_val_CM_FRCR_1_Resd1_1067_dt 0 0 0 255 ECU_ADDRESS 0xfe4ccdb4 /* @ECU_Address@SwcIn_FRCR_1.FRCR_1_Resd1@ */ /end MEASUREMENT
/begin MEASUREMENT SwcIn_FRCR_1.FRCR_1_RollgCntr1 "" UBYTE autosar_swc_val_CM_FRCR_1_RollgCntr1_1067_dt 0 0 0 255 ECU_ADDRESS 0xfe4ccdb3 /* @ECU_Address@SwcIn_FRCR_1.FRCR_1_RollgCntr1@ */ /end MEASUREMENT
/begin MEASUREMENT SwcIn_FRCR_1.FRCR_1_SysSt "" UBYTE autosar_swc_val_CM_FRCR_1_SysSt_1067_dt 0 0 0 255 ECU_ADDRESS 0xfe4ccdb5 /* @ECU_Address@SwcIn_FRCR_1.FRCR_1_SysSt@ */ /end MEASUREMENT
/begin MEASUREMENT SwcIn_FRZCU_1.FRZCU_1_CRC "" UBYTE autosar_swc_val_CM_FRZCU_1_CRC_683_dt 0 0 0 255 ECU_ADDRESS 0xfe4ca4c0 /* @ECU_Address@SwcIn_FRZCU_1.FRZCU_1_CRC@ */ /end MEASUREMENT
/begin MEASUREMENT SwcIn_FRZCU_1.FRZCU_1_Resd "" UBYTE autosar_swc_val_CM_FRZCU_1_Resd_683_dt 0 0 0 255 ECU_ADDRESS 0xfe4ca4c2 /* @ECU_Address@SwcIn_FRZCU_1.FRZCU_1_Resd@ */ /end MEASUREMENT
/begin MEASUREMENT SwcIn_FRZCU_1.FRZCU_1_RollgCntr "" UBYTE autosar_swc_val_CM_FRZCU_1_RollgCntr_683_dt 0 0 0 255 ECU_ADDRESS 0xfe4ca4c1 /* @ECU_Address@SwcIn_FRZCU_1.FRZCU_1_RollgCntr@ */ /end MEASUREMENT
/begin MEASUREMENT SwcIn_FRZCU_1.ParkLightSts "" UBYTE autosar_swc_val_CM_ParkLightSts_683_dt 0 0 0 255 ECU_ADDRESS 0xfe4ca4c4 /* @ECU_Address@SwcIn_FRZCU_1.ParkLightSts@ */ /end MEASUREMENT
/begin MEASUREMENT SwcIn_FRZCU_1.RHFDoorLockSts "" UBYTE autosar_swc_val_CM_RHFDoorLockSts_683_dt 0 0 0 255 ECU_ADDRESS 0xfe4ca4c6 /* @ECU_Address@SwcIn_FRZCU_1.RHFDoorLockSts@ */ /end MEASUREMENT
/begin MEASUREMENT SwcIn_FRZCU_1.RHFDoorSts "" UBYTE autosar_swc_val_CM_RHFDoorSts_683_dt 0 0 0 255 ECU_ADDRESS 0xfe4ca4c3 /* @ECU_Address@SwcIn_FRZCU_1.RHFDoorSts@ */ /end MEASUREMENT
/begin MEASUREMENT SwcIn_FRZCU_1.RHRDoorLockSts "" UBYTE autosar_swc_val_CM_RHRDoorLockSts_683_dt 0 0 0 255 ECU_ADDRESS 0xfe4ca4c7 /* @ECU_Address@SwcIn_FRZCU_1.RHRDoorLockSts@ */ /end MEASUREMENT
/begin MEASUREMENT SwcIn_FRZCU_1.RHRDoorSts "" UBYTE autosar_swc_val_CM_RHRDoorSts_683_dt 0 0 0 255 ECU_ADDRESS 0xfe4ca4c5 /* @ECU_Address@SwcIn_FRZCU_1.RHRDoorSts@ */ /end MEASUREMENT
/begin MEASUREMENT SwcIn_FRZCU_7.FRZCU_7_CRC "" UBYTE autosar_swc_val_CM_FRZCU_7_CRC_1324_dt 0 0 0 255 ECU_ADDRESS 0xfe4cca98 /* @ECU_Address@SwcIn_FRZCU_7.FRZCU_7_CRC@ */ /end MEASUREMENT
/begin MEASUREMENT SwcIn_FRZCU_7.FRZCU_7_RollgCntr "" UBYTE autosar_swc_val_CM_FRZCU_7_RollgCntr_1324_dt 0 0 0 255 ECU_ADDRESS 0xfe4cca99 /* @ECU_Address@SwcIn_FRZCU_7.FRZCU_7_RollgCntr@ */ /end MEASUREMENT
/begin MEASUREMENT SwcIn_FRZCU_7.TirePressureSystemFailSts "" UBYTE autosar_swc_val_CM_TirePressureSystemFailSts_1324_dt 0 0 0 255 ECU_ADDRESS 0xfe4cca9b /* @ECU_Address@SwcIn_FRZCU_7.TirePressureSystemFailSts@ */ /end MEASUREMENT
/begin MEASUREMENT SwcIn_FRZCU_7.TirePressureWarningLampSts "" UBYTE autosar_swc_val_CM_TirePressureWarningLampSts_1324_dt 0 0 0 255 ECU_ADDRESS 0xfe4cca9a /* @ECU_Address@SwcIn_FRZCU_7.TirePressureWarningLampSts@ */ /end MEASUREMENT
/begin MEASUREMENT SwcIn_FRZCU_8.LowBeamFaults "" UBYTE autosar_swc_val_CM_LowBeamFaults_1256_dt 0 0 0 255 ECU_ADDRESS 0xfe4ccdb7 /* @ECU_Address@SwcIn_FRZCU_8.LowBeamFaults@ */ /end MEASUREMENT
/begin MEASUREMENT SwcIn_Fusa_CAN_E2E.Fusa_ACU_1_CRC1_Error "" UBYTE autosar_swc_val_CM_boolean 0 0 0 1 ECU_ADDRESS 0xfe4ccdb8 /* @ECU_Address@SwcIn_Fusa_CAN_E2E.Fusa_ACU_1_CRC1_Error@ */ /end MEASUREMENT
/begin MEASUREMENT SwcIn_Fusa_CAN_E2E.Fusa_ACU_1_RollgCntr1_Error "" UBYTE autosar_swc_val_CM_boolean 0 0 0 1 ECU_ADDRESS 0xfe4ccdb9 /* @ECU_Address@SwcIn_Fusa_CAN_E2E.Fusa_ACU_1_RollgCntr1_Error@ */ /end MEASUREMENT
/begin MEASUREMENT SwcIn_Fusa_CAN_E2E.Fusa_ACU_2_CRC1_Error "" UBYTE autosar_swc_val_CM_boolean 0 0 0 1 ECU_ADDRESS 0xfe4ccdba /* @ECU_Address@SwcIn_Fusa_CAN_E2E.Fusa_ACU_2_CRC1_Error@ */ /end MEASUREMENT
/begin MEASUREMENT SwcIn_Fusa_CAN_E2E.Fusa_ACU_2_RollgCntr1_Error "" UBYTE autosar_swc_val_CM_boolean 0 0 0 1 ECU_ADDRESS 0xfe4ccdbb /* @ECU_Address@SwcIn_Fusa_CAN_E2E.Fusa_ACU_2_RollgCntr1_Error@ */ /end MEASUREMENT
/begin MEASUREMENT SwcIn_Fusa_CAN_E2E.Fusa_ACU_2_Timeout "" UBYTE autosar_swc_val_CM_boolean 0 0 0 1 ECU_ADDRESS 0xfe4ccdbc /* @ECU_Address@SwcIn_Fusa_CAN_E2E.Fusa_ACU_2_Timeout@ */ /end MEASUREMENT
/begin MEASUREMENT SwcIn_Fusa_CAN_E2E.Fusa_ACU_3_CRC1_Error "" UBYTE autosar_swc_val_CM_boolean 0 0 0 1 ECU_ADDRESS 0xfe4ccdbd /* @ECU_Address@SwcIn_Fusa_CAN_E2E.Fusa_ACU_3_CRC1_Error@ */ /end MEASUREMENT
/begin MEASUREMENT SwcIn_Fusa_CAN_E2E.Fusa_ACU_3_RollgCntr1_Error "" UBYTE autosar_swc_val_CM_boolean 0 0 0 1 ECU_ADDRESS 0xfe4ccdbe /* @ECU_Address@SwcIn_Fusa_CAN_E2E.Fusa_ACU_3_RollgCntr1_Error@ */ /end MEASUREMENT
/begin MEASUREMENT SwcIn_Fusa_CAN_E2E.Fusa_ACU_3_Timeout "" UBYTE autosar_swc_val_CM_boolean 0 0 0 1 ECU_ADDRESS 0xfe4ccdbf /* @ECU_Address@SwcIn_Fusa_CAN_E2E.Fusa_ACU_3_Timeout@ */ /end MEASUREMENT
/begin MEASUREMENT SwcIn_Fusa_CAN_E2E.Fusa_ASU_1_CRC1_Error "" UBYTE autosar_swc_val_CM_boolean 0 0 0 1 ECU_ADDRESS 0xfe4cce0d /* @ECU_Address@SwcIn_Fusa_CAN_E2E.Fusa_ASU_1_CRC1_Error@ */ /end MEASUREMENT
/begin MEASUREMENT SwcIn_Fusa_CAN_E2E.Fusa_ASU_1_RollgCntr1_Error "" UBYTE autosar_swc_val_CM_boolean 0 0 0 1 ECU_ADDRESS 0xfe4cce0e /* @ECU_Address@SwcIn_Fusa_CAN_E2E.Fusa_ASU_1_RollgCntr1_Error@ */ /end MEASUREMENT
/begin MEASUREMENT SwcIn_Fusa_CAN_E2E.Fusa_ASU_2_CRC1_Error "" UBYTE autosar_swc_val_CM_boolean 0 0 0 1 ECU_ADDRESS 0xfe4cce0f /* @ECU_Address@SwcIn_Fusa_CAN_E2E.Fusa_ASU_2_CRC1_Error@ */ /end MEASUREMENT
/begin MEASUREMENT SwcIn_Fusa_CAN_E2E.Fusa_ASU_2_RollgCntr1_Error "" UBYTE autosar_swc_val_CM_boolean 0 0 0 1 ECU_ADDRESS 0xfe4cce10 /* @ECU_Address@SwcIn_Fusa_CAN_E2E.Fusa_ASU_2_RollgCntr1_Error@ */ /end MEASUREMENT
/begin MEASUREMENT SwcIn_Fusa_CAN_E2E.Fusa_CSA_1_CRC_Error "" UBYTE autosar_swc_val_CM_boolean 0 0 0 1 ECU_ADDRESS 0xfe4cce11 /* @ECU_Address@SwcIn_Fusa_CAN_E2E.Fusa_CSA_1_CRC_Error@ */ /end MEASUREMENT
/begin MEASUREMENT SwcIn_Fusa_CAN_E2E.Fusa_CSA_1_RollgCntr_Error "" UBYTE autosar_swc_val_CM_boolean 0 0 0 1 ECU_ADDRESS 0xfe4cce12 /* @ECU_Address@SwcIn_Fusa_CAN_E2E.Fusa_CSA_1_RollgCntr_Error@ */ /end MEASUREMENT
/begin MEASUREMENT SwcIn_Fusa_CAN_E2E.Fusa_CSA_2_CRC1_Error "" UBYTE autosar_swc_val_CM_boolean 0 0 0 1 ECU_ADDRESS 0xfe4cce13 /* @ECU_Address@SwcIn_Fusa_CAN_E2E.Fusa_CSA_2_CRC1_Error@ */ /end MEASUREMENT
/begin MEASUREMENT SwcIn_Fusa_CAN_E2E.Fusa_CSA_2_RollgCntr1_Error "" UBYTE autosar_swc_val_CM_boolean 0 0 0 1 ECU_ADDRESS 0xfe4cce14 /* @ECU_Address@SwcIn_Fusa_CAN_E2E.Fusa_CSA_2_RollgCntr1_Error@ */ /end MEASUREMENT
/begin MEASUREMENT SwcIn_Fusa_CAN_E2E.Fusa_EPB_R_1_CRC1_Error "" UBYTE autosar_swc_val_CM_boolean 0 0 0 1 ECU_ADDRESS 0xfe4ccdc0 /* @ECU_Address@SwcIn_Fusa_CAN_E2E.Fusa_EPB_R_1_CRC1_Error@ */ /end MEASUREMENT
/begin MEASUREMENT SwcIn_Fusa_CAN_E2E.Fusa_EPB_R_1_CRC2_Error "" UBYTE autosar_swc_val_CM_boolean 0 0 0 1 ECU_ADDRESS 0xfe4ccdc2 /* @ECU_Address@SwcIn_Fusa_CAN_E2E.Fusa_EPB_R_1_CRC2_Error@ */ /end MEASUREMENT
/begin MEASUREMENT SwcIn_Fusa_CAN_E2E.Fusa_EPB_R_1_RollgCntr1_Error "" UBYTE autosar_swc_val_CM_boolean 0 0 0 1 ECU_ADDRESS 0xfe4ccdc1 /* @ECU_Address@SwcIn_Fusa_CAN_E2E.Fusa_EPB_R_1_RollgCntr1_Error@ */ /end MEASUREMENT
/begin MEASUREMENT SwcIn_Fusa_CAN_E2E.Fusa_EPB_R_1_RollgCntr2_Error "" UBYTE autosar_swc_val_CM_boolean 0 0 0 1 ECU_ADDRESS 0xfe4ccdc3 /* @ECU_Address@SwcIn_Fusa_CAN_E2E.Fusa_EPB_R_1_RollgCntr2_Error@ */ /end MEASUREMENT
/begin MEASUREMENT SwcIn_Fusa_CAN_E2E.Fusa_EPB_R_1_Timeout "" UBYTE autosar_swc_val_CM_boolean 0 0 0 1 ECU_ADDRESS 0xfe4ccdc4 /* @ECU_Address@SwcIn_Fusa_CAN_E2E.Fusa_EPB_R_1_Timeout@ */ /end MEASUREMENT
/begin MEASUREMENT SwcIn_Fusa_CAN_E2E.Fusa_EPS_1_CRC_Error "" UBYTE autosar_swc_val_CM_boolean 0 0 0 1 ECU_ADDRESS 0xfe4ccdc5 /* @ECU_Address@SwcIn_Fusa_CAN_E2E.Fusa_EPS_1_CRC_Error@ */ /end MEASUREMENT
/begin MEASUREMENT SwcIn_Fusa_CAN_E2E.Fusa_EPS_1_RollgCntr_Error "" UBYTE autosar_swc_val_CM_boolean 0 0 0 1 ECU_ADDRESS 0xfe4ccdc6 /* @ECU_Address@SwcIn_Fusa_CAN_E2E.Fusa_EPS_1_RollgCntr_Error@ */ /end MEASUREMENT
/begin MEASUREMENT SwcIn_Fusa_CAN_E2E.Fusa_EPS_1_Timeout "" UBYTE autosar_swc_val_CM_boolean 0 0 0 1 ECU_ADDRESS 0xfe4ccdc7 /* @ECU_Address@SwcIn_Fusa_CAN_E2E.Fusa_EPS_1_Timeout@ */ /end MEASUREMENT
/begin MEASUREMENT SwcIn_Fusa_CAN_E2E.Fusa_EPS_3_CRC_Error "" UBYTE autosar_swc_val_CM_boolean 0 0 0 1 ECU_ADDRESS 0xfe4ccdc8 /* @ECU_Address@SwcIn_Fusa_CAN_E2E.Fusa_EPS_3_CRC_Error@ */ /end MEASUREMENT
/begin MEASUREMENT SwcIn_Fusa_CAN_E2E.Fusa_EPS_3_RollgCntr_Error "" UBYTE autosar_swc_val_CM_boolean 0 0 0 1 ECU_ADDRESS 0xfe4ccdc9 /* @ECU_Address@SwcIn_Fusa_CAN_E2E.Fusa_EPS_3_RollgCntr_Error@ */ /end MEASUREMENT
/begin MEASUREMENT SwcIn_Fusa_CAN_E2E.Fusa_EPS_3_Timeout "" UBYTE autosar_swc_val_CM_boolean 0 0 0 1 ECU_ADDRESS 0xfe4ccdca /* @ECU_Address@SwcIn_Fusa_CAN_E2E.Fusa_EPS_3_Timeout@ */ /end MEASUREMENT
/begin MEASUREMENT SwcIn_Fusa_CAN_E2E.Fusa_EPS_4_CRC1_Error "" UBYTE autosar_swc_val_CM_boolean 0 0 0 1 ECU_ADDRESS 0xfe4ccdcb /* @ECU_Address@SwcIn_Fusa_CAN_E2E.Fusa_EPS_4_CRC1_Error@ */ /end MEASUREMENT
/begin MEASUREMENT SwcIn_Fusa_CAN_E2E.Fusa_EPS_4_CRC2_Error "" UBYTE autosar_swc_val_CM_boolean 0 0 0 1 ECU_ADDRESS 0xfe4ccdcd /* @ECU_Address@SwcIn_Fusa_CAN_E2E.Fusa_EPS_4_CRC2_Error@ */ /end MEASUREMENT
/begin MEASUREMENT SwcIn_Fusa_CAN_E2E.Fusa_EPS_4_CRC3_Error "" UBYTE autosar_swc_val_CM_boolean 0 0 0 1 ECU_ADDRESS 0xfe4ccdcf /* @ECU_Address@SwcIn_Fusa_CAN_E2E.Fusa_EPS_4_CRC3_Error@ */ /end MEASUREMENT
/begin MEASUREMENT SwcIn_Fusa_CAN_E2E.Fusa_EPS_4_CRC4_Error "" UBYTE autosar_swc_val_CM_boolean 0 0 0 1 ECU_ADDRESS 0xfe4ccdd1 /* @ECU_Address@SwcIn_Fusa_CAN_E2E.Fusa_EPS_4_CRC4_Error@ */ /end MEASUREMENT
/begin MEASUREMENT SwcIn_Fusa_CAN_E2E.Fusa_EPS_4_CRC5_Error "" UBYTE autosar_swc_val_CM_boolean 0 0 0 1 ECU_ADDRESS 0xfe4ccdd3 /* @ECU_Address@SwcIn_Fusa_CAN_E2E.Fusa_EPS_4_CRC5_Error@ */ /end MEASUREMENT
/begin MEASUREMENT SwcIn_Fusa_CAN_E2E.Fusa_EPS_4_RollgCntr1_Error "" UBYTE autosar_swc_val_CM_boolean 0 0 0 1 ECU_ADDRESS 0xfe4ccdcc /* @ECU_Address@SwcIn_Fusa_CAN_E2E.Fusa_EPS_4_RollgCntr1_Error@ */ /end MEASUREMENT
/begin MEASUREMENT SwcIn_Fusa_CAN_E2E.Fusa_EPS_4_RollgCntr2_Error "" UBYTE autosar_swc_val_CM_boolean 0 0 0 1 ECU_ADDRESS 0xfe4ccdce /* @ECU_Address@SwcIn_Fusa_CAN_E2E.Fusa_EPS_4_RollgCntr2_Error@ */ /end MEASUREMENT
/begin MEASUREMENT SwcIn_Fusa_CAN_E2E.Fusa_EPS_4_RollgCntr3_Error "" UBYTE autosar_swc_val_CM_boolean 0 0 0 1 ECU_ADDRESS 0xfe4ccdd0 /* @ECU_Address@SwcIn_Fusa_CAN_E2E.Fusa_EPS_4_RollgCntr3_Error@ */ /end MEASUREMENT
/begin MEASUREMENT SwcIn_Fusa_CAN_E2E.Fusa_EPS_4_RollgCntr4_Error "" UBYTE autosar_swc_val_CM_boolean 0 0 0 1 ECU_ADDRESS 0xfe4ccdd2 /* @ECU_Address@SwcIn_Fusa_CAN_E2E.Fusa_EPS_4_RollgCntr4_Error@ */ /end MEASUREMENT
/begin MEASUREMENT SwcIn_Fusa_CAN_E2E.Fusa_EPS_4_RollgCntr5_Error "" UBYTE autosar_swc_val_CM_boolean 0 0 0 1 ECU_ADDRESS 0xfe4ccdd4 /* @ECU_Address@SwcIn_Fusa_CAN_E2E.Fusa_EPS_4_RollgCntr5_Error@ */ /end MEASUREMENT
/begin MEASUREMENT SwcIn_Fusa_CAN_E2E.Fusa_EPS_4_Timeout "" UBYTE autosar_swc_val_CM_boolean 0 0 0 1 ECU_ADDRESS 0xfe4ccdd5 /* @ECU_Address@SwcIn_Fusa_CAN_E2E.Fusa_EPS_4_Timeout@ */ /end MEASUREMENT
/begin MEASUREMENT SwcIn_Fusa_CAN_E2E.Fusa_FLCR_1_CRC1_Error "" UBYTE autosar_swc_val_CM_boolean 0 0 0 1 ECU_ADDRESS 0xfe4cce29 /* @ECU_Address@SwcIn_Fusa_CAN_E2E.Fusa_FLCR_1_CRC1_Error@ */ /end MEASUREMENT
/begin MEASUREMENT SwcIn_Fusa_CAN_E2E.Fusa_FLCR_1_RollgCntr1_Error "" UBYTE autosar_swc_val_CM_boolean 0 0 0 1 ECU_ADDRESS 0xfe4cce2a /* @ECU_Address@SwcIn_Fusa_CAN_E2E.Fusa_FLCR_1_RollgCntr1_Error@ */ /end MEASUREMENT
/begin MEASUREMENT SwcIn_Fusa_CAN_E2E.Fusa_FLCR_2_CRC1_Error "" UBYTE autosar_swc_val_CM_boolean 0 0 0 1 ECU_ADDRESS 0xfe4cce2b /* @ECU_Address@SwcIn_Fusa_CAN_E2E.Fusa_FLCR_2_CRC1_Error@ */ /end MEASUREMENT
/begin MEASUREMENT SwcIn_Fusa_CAN_E2E.Fusa_FLCR_2_RollgCntr1_Error "" UBYTE autosar_swc_val_CM_boolean 0 0 0 1 ECU_ADDRESS 0xfe4cce2c /* @ECU_Address@SwcIn_Fusa_CAN_E2E.Fusa_FLCR_2_RollgCntr1_Error@ */ /end MEASUREMENT
/begin MEASUREMENT SwcIn_Fusa_CAN_E2E.Fusa_FLZCU_12_CRC_Error "" UBYTE autosar_swc_val_CM_boolean 0 0 0 1 ECU_ADDRESS 0xfe4cce1c /* @ECU_Address@SwcIn_Fusa_CAN_E2E.Fusa_FLZCU_12_CRC_Error@ */ /end MEASUREMENT
/begin MEASUREMENT SwcIn_Fusa_CAN_E2E.Fusa_FLZCU_12_RollgCntr_Error "" UBYTE autosar_swc_val_CM_boolean 0 0 0 1 ECU_ADDRESS 0xfe4cce1d /* @ECU_Address@SwcIn_Fusa_CAN_E2E.Fusa_FLZCU_12_RollgCntr_Error@ */ /end MEASUREMENT
/begin MEASUREMENT SwcIn_Fusa_CAN_E2E.Fusa_FLZCU_1_CRC_Error "" UBYTE autosar_swc_val_CM_boolean 0 0 0 1 ECU_ADDRESS 0xfe4cce15 /* @ECU_Address@SwcIn_Fusa_CAN_E2E.Fusa_FLZCU_1_CRC_Error@ */ /end MEASUREMENT
/begin MEASUREMENT SwcIn_Fusa_CAN_E2E.Fusa_FLZCU_1_RollgCntr_Error "" UBYTE autosar_swc_val_CM_boolean 0 0 0 1 ECU_ADDRESS 0xfe4cce16 /* @ECU_Address@SwcIn_Fusa_CAN_E2E.Fusa_FLZCU_1_RollgCntr_Error@ */ /end MEASUREMENT
/begin MEASUREMENT SwcIn_Fusa_CAN_E2E.Fusa_FLZCU_1_Timeout "" UBYTE autosar_swc_val_CM_boolean 0 0 0 1 ECU_ADDRESS 0xfe4cce17 /* @ECU_Address@SwcIn_Fusa_CAN_E2E.Fusa_FLZCU_1_Timeout@ */ /end MEASUREMENT
/begin MEASUREMENT SwcIn_Fusa_CAN_E2E.Fusa_FLZCU_3_CRC_Error "" UBYTE autosar_swc_val_CM_boolean 0 0 0 1 ECU_ADDRESS 0xfe4cce18 /* @ECU_Address@SwcIn_Fusa_CAN_E2E.Fusa_FLZCU_3_CRC_Error@ */ /end MEASUREMENT
/begin MEASUREMENT SwcIn_Fusa_CAN_E2E.Fusa_FLZCU_3_RollgCntr_Error "" UBYTE autosar_swc_val_CM_boolean 0 0 0 1 ECU_ADDRESS 0xfe4cce19 /* @ECU_Address@SwcIn_Fusa_CAN_E2E.Fusa_FLZCU_3_RollgCntr_Error@ */ /end MEASUREMENT
/begin MEASUREMENT SwcIn_Fusa_CAN_E2E.Fusa_FLZCU_9_CRC_Error "" UBYTE autosar_swc_val_CM_boolean 0 0 0 1 ECU_ADDRESS 0xfe4cce1a /* @ECU_Address@SwcIn_Fusa_CAN_E2E.Fusa_FLZCU_9_CRC_Error@ */ /end MEASUREMENT
/begin MEASUREMENT SwcIn_Fusa_CAN_E2E.Fusa_FLZCU_9_RollgCntr_Error "" UBYTE autosar_swc_val_CM_boolean 0 0 0 1 ECU_ADDRESS 0xfe4cce1b /* @ECU_Address@SwcIn_Fusa_CAN_E2E.Fusa_FLZCU_9_RollgCntr_Error@ */ /end MEASUREMENT
/begin MEASUREMENT SwcIn_Fusa_CAN_E2E.Fusa_FRCR_1_CRC1_Error "" UBYTE autosar_swc_val_CM_boolean 0 0 0 1 ECU_ADDRESS 0xfe4cce2d /* @ECU_Address@SwcIn_Fusa_CAN_E2E.Fusa_FRCR_1_CRC1_Error@ */ /end MEASUREMENT
/begin MEASUREMENT SwcIn_Fusa_CAN_E2E.Fusa_FRCR_1_RollgCntr1_Error "" UBYTE autosar_swc_val_CM_boolean 0 0 0 1 ECU_ADDRESS 0xfe4cce2e /* @ECU_Address@SwcIn_Fusa_CAN_E2E.Fusa_FRCR_1_RollgCntr1_Error@ */ /end MEASUREMENT
/begin MEASUREMENT SwcIn_Fusa_CAN_E2E.Fusa_FRZCU_1_CRC_Error "" UBYTE autosar_swc_val_CM_boolean 0 0 0 1 ECU_ADDRESS 0xfe4cce21 /* @ECU_Address@SwcIn_Fusa_CAN_E2E.Fusa_FRZCU_1_CRC_Error@ */ /end MEASUREMENT
/begin MEASUREMENT SwcIn_Fusa_CAN_E2E.Fusa_FRZCU_1_RollgCntr_Error "" UBYTE autosar_swc_val_CM_boolean 0 0 0 1 ECU_ADDRESS 0xfe4cce22 /* @ECU_Address@SwcIn_Fusa_CAN_E2E.Fusa_FRZCU_1_RollgCntr_Error@ */ /end MEASUREMENT
/begin MEASUREMENT SwcIn_Fusa_CAN_E2E.Fusa_FRZCU_7_CRC_Error "" UBYTE autosar_swc_val_CM_boolean 0 0 0 1 ECU_ADDRESS 0xfe4cce23 /* @ECU_Address@SwcIn_Fusa_CAN_E2E.Fusa_FRZCU_7_CRC_Error@ */ /end MEASUREMENT
/begin MEASUREMENT SwcIn_Fusa_CAN_E2E.Fusa_FRZCU_7_RollgCntr_Error "" UBYTE autosar_swc_val_CM_boolean 0 0 0 1 ECU_ADDRESS 0xfe4cce24 /* @ECU_Address@SwcIn_Fusa_CAN_E2E.Fusa_FRZCU_7_RollgCntr_Error@ */ /end MEASUREMENT
/begin MEASUREMENT SwcIn_Fusa_CAN_E2E.Fusa_ICC_BD_11_CRC_Error "" UBYTE autosar_swc_val_CM_boolean 0 0 0 1 ECU_ADDRESS 0xfe4cce5b /* @ECU_Address@SwcIn_Fusa_CAN_E2E.Fusa_ICC_BD_11_CRC_Error@ */ /end MEASUREMENT
/begin MEASUREMENT SwcIn_Fusa_CAN_E2E.Fusa_ICC_BD_11_RollgCntr_Error "" UBYTE autosar_swc_val_CM_boolean 0 0 0 1 ECU_ADDRESS 0xfe4cce5c /* @ECU_Address@SwcIn_Fusa_CAN_E2E.Fusa_ICC_BD_11_RollgCntr_Error@ */ /end MEASUREMENT
/begin MEASUREMENT SwcIn_Fusa_CAN_E2E.Fusa_ICC_DA_15_CRC_Error "" UBYTE autosar_swc_val_CM_boolean 0 0 0 1 ECU_ADDRESS 0xfe4cce5d /* @ECU_Address@SwcIn_Fusa_CAN_E2E.Fusa_ICC_DA_15_CRC_Error@ */ /end MEASUREMENT
/begin MEASUREMENT SwcIn_Fusa_CAN_E2E.Fusa_ICC_DA_15_RollgCntr_Error "" UBYTE autosar_swc_val_CM_boolean 0 0 0 1 ECU_ADDRESS 0xfe4cce5e /* @ECU_Address@SwcIn_Fusa_CAN_E2E.Fusa_ICC_DA_15_RollgCntr_Error@ */ /end MEASUREMENT
/begin MEASUREMENT SwcIn_Fusa_CAN_E2E.Fusa_MFS_2_CRC_Error "" UBYTE autosar_swc_val_CM_boolean 0 0 0 1 ECU_ADDRESS 0xfe4cce1e /* @ECU_Address@SwcIn_Fusa_CAN_E2E.Fusa_MFS_2_CRC_Error@ */ /end MEASUREMENT
/begin MEASUREMENT SwcIn_Fusa_CAN_E2E.Fusa_MFS_2_RollgCntr_Error "" UBYTE autosar_swc_val_CM_boolean 0 0 0 1 ECU_ADDRESS 0xfe4cce1f /* @ECU_Address@SwcIn_Fusa_CAN_E2E.Fusa_MFS_2_RollgCntr_Error@ */ /end MEASUREMENT
/begin MEASUREMENT SwcIn_Fusa_CAN_E2E.Fusa_MFS_2_Timeout "" UBYTE autosar_swc_val_CM_boolean 0 0 0 1 ECU_ADDRESS 0xfe4cce20 /* @ECU_Address@SwcIn_Fusa_CAN_E2E.Fusa_MFS_2_Timeout@ */ /end MEASUREMENT
/begin MEASUREMENT SwcIn_Fusa_CAN_E2E.Fusa_ONEBOX_1_CRC1_Error "" UBYTE autosar_swc_val_CM_boolean 0 0 0 1 ECU_ADDRESS 0xfe4ccdd9 /* @ECU_Address@SwcIn_Fusa_CAN_E2E.Fusa_ONEBOX_1_CRC1_Error@ */ /end MEASUREMENT
/begin MEASUREMENT SwcIn_Fusa_CAN_E2E.Fusa_ONEBOX_1_CRC2_Error "" UBYTE autosar_swc_val_CM_boolean 0 0 0 1 ECU_ADDRESS 0xfe4ccddb /* @ECU_Address@SwcIn_Fusa_CAN_E2E.Fusa_ONEBOX_1_CRC2_Error@ */ /end MEASUREMENT
/begin MEASUREMENT SwcIn_Fusa_CAN_E2E.Fusa_ONEBOX_1_RollgCntr1_Error "" UBYTE autosar_swc_val_CM_boolean 0 0 0 1 ECU_ADDRESS 0xfe4ccdda /* @ECU_Address@SwcIn_Fusa_CAN_E2E.Fusa_ONEBOX_1_RollgCntr1_Error@ */ /end MEASUREMENT
/begin MEASUREMENT SwcIn_Fusa_CAN_E2E.Fusa_ONEBOX_1_RollgCntr2_Error "" UBYTE autosar_swc_val_CM_boolean 0 0 0 1 ECU_ADDRESS 0xfe4ccddc /* @ECU_Address@SwcIn_Fusa_CAN_E2E.Fusa_ONEBOX_1_RollgCntr2_Error@ */ /end MEASUREMENT
/begin MEASUREMENT SwcIn_Fusa_CAN_E2E.Fusa_ONEBOX_1_Timeout "" UBYTE autosar_swc_val_CM_boolean 0 0 0 1 ECU_ADDRESS 0xfe4ccddd /* @ECU_Address@SwcIn_Fusa_CAN_E2E.Fusa_ONEBOX_1_Timeout@ */ /end MEASUREMENT
/begin MEASUREMENT SwcIn_Fusa_CAN_E2E.Fusa_ONEBOX_2_G_CRC_Error "" UBYTE autosar_swc_val_CM_boolean 0 0 0 1 ECU_ADDRESS 0xfe4ccdf1 /* @ECU_Address@SwcIn_Fusa_CAN_E2E.Fusa_ONEBOX_2_G_CRC_Error@ */ /end MEASUREMENT
/begin MEASUREMENT SwcIn_Fusa_CAN_E2E.Fusa_ONEBOX_2_G_RollgCntr_Error "" UBYTE autosar_swc_val_CM_boolean 0 0 0 1 ECU_ADDRESS 0xfe4ccdf2 /* @ECU_Address@SwcIn_Fusa_CAN_E2E.Fusa_ONEBOX_2_G_RollgCntr_Error@ */ /end MEASUREMENT
/begin MEASUREMENT SwcIn_Fusa_CAN_E2E.Fusa_ONEBOX_2_G_Timeout "" UBYTE autosar_swc_val_CM_boolean 0 0 0 1 ECU_ADDRESS 0xfe4ccdf3 /* @ECU_Address@SwcIn_Fusa_CAN_E2E.Fusa_ONEBOX_2_G_Timeout@ */ /end MEASUREMENT
/begin MEASUREMENT SwcIn_Fusa_CAN_E2E.Fusa_ONEBOX_3_CRC1_Error "" UBYTE autosar_swc_val_CM_boolean 0 0 0 1 ECU_ADDRESS 0xfe4ccdde /* @ECU_Address@SwcIn_Fusa_CAN_E2E.Fusa_ONEBOX_3_CRC1_Error@ */ /end MEASUREMENT
/begin MEASUREMENT SwcIn_Fusa_CAN_E2E.Fusa_ONEBOX_3_CRC2_Error "" UBYTE autosar_swc_val_CM_boolean 0 0 0 1 ECU_ADDRESS 0xfe4ccde0 /* @ECU_Address@SwcIn_Fusa_CAN_E2E.Fusa_ONEBOX_3_CRC2_Error@ */ /end MEASUREMENT
/begin MEASUREMENT SwcIn_Fusa_CAN_E2E.Fusa_ONEBOX_3_CRC4_Error "" UBYTE autosar_swc_val_CM_boolean 0 0 0 1 ECU_ADDRESS 0xfe4ccde2 /* @ECU_Address@SwcIn_Fusa_CAN_E2E.Fusa_ONEBOX_3_CRC4_Error@ */ /end MEASUREMENT
/begin MEASUREMENT SwcIn_Fusa_CAN_E2E.Fusa_ONEBOX_3_RollgCntr1_Error "" UBYTE autosar_swc_val_CM_boolean 0 0 0 1 ECU_ADDRESS 0xfe4ccddf /* @ECU_Address@SwcIn_Fusa_CAN_E2E.Fusa_ONEBOX_3_RollgCntr1_Error@ */ /end MEASUREMENT
/begin MEASUREMENT SwcIn_Fusa_CAN_E2E.Fusa_ONEBOX_3_RollgCntr2_Error "" UBYTE autosar_swc_val_CM_boolean 0 0 0 1 ECU_ADDRESS 0xfe4ccde1 /* @ECU_Address@SwcIn_Fusa_CAN_E2E.Fusa_ONEBOX_3_RollgCntr2_Error@ */ /end MEASUREMENT
/begin MEASUREMENT SwcIn_Fusa_CAN_E2E.Fusa_ONEBOX_3_RollgCntr4_Error "" UBYTE autosar_swc_val_CM_boolean 0 0 0 1 ECU_ADDRESS 0xfe4ccde3 /* @ECU_Address@SwcIn_Fusa_CAN_E2E.Fusa_ONEBOX_3_RollgCntr4_Error@ */ /end MEASUREMENT
/begin MEASUREMENT SwcIn_Fusa_CAN_E2E.Fusa_ONEBOX_3_Timeout "" UBYTE autosar_swc_val_CM_boolean 0 0 0 1 ECU_ADDRESS 0xfe4ccde4 /* @ECU_Address@SwcIn_Fusa_CAN_E2E.Fusa_ONEBOX_3_Timeout@ */ /end MEASUREMENT
/begin MEASUREMENT SwcIn_Fusa_CAN_E2E.Fusa_ONEBOX_4_CRC1_Error "" UBYTE autosar_swc_val_CM_boolean 0 0 0 1 ECU_ADDRESS 0xfe4ccde5 /* @ECU_Address@SwcIn_Fusa_CAN_E2E.Fusa_ONEBOX_4_CRC1_Error@ */ /end MEASUREMENT
/begin MEASUREMENT SwcIn_Fusa_CAN_E2E.Fusa_ONEBOX_4_CRC2_Error "" UBYTE autosar_swc_val_CM_boolean 0 0 0 1 ECU_ADDRESS 0xfe4ccde7 /* @ECU_Address@SwcIn_Fusa_CAN_E2E.Fusa_ONEBOX_4_CRC2_Error@ */ /end MEASUREMENT
/begin MEASUREMENT SwcIn_Fusa_CAN_E2E.Fusa_ONEBOX_4_CRC3_Error "" UBYTE autosar_swc_val_CM_boolean 0 0 0 1 ECU_ADDRESS 0xfe4ccde9 /* @ECU_Address@SwcIn_Fusa_CAN_E2E.Fusa_ONEBOX_4_CRC3_Error@ */ /end MEASUREMENT
/begin MEASUREMENT SwcIn_Fusa_CAN_E2E.Fusa_ONEBOX_4_CRC4_Error "" UBYTE autosar_swc_val_CM_boolean 0 0 0 1 ECU_ADDRESS 0xfe4ccdeb /* @ECU_Address@SwcIn_Fusa_CAN_E2E.Fusa_ONEBOX_4_CRC4_Error@ */ /end MEASUREMENT
/begin MEASUREMENT SwcIn_Fusa_CAN_E2E.Fusa_ONEBOX_4_RollgCntr1_Error "" UBYTE autosar_swc_val_CM_boolean 0 0 0 1 ECU_ADDRESS 0xfe4ccde6 /* @ECU_Address@SwcIn_Fusa_CAN_E2E.Fusa_ONEBOX_4_RollgCntr1_Error@ */ /end MEASUREMENT
/begin MEASUREMENT SwcIn_Fusa_CAN_E2E.Fusa_ONEBOX_4_RollgCntr2_Error "" UBYTE autosar_swc_val_CM_boolean 0 0 0 1 ECU_ADDRESS 0xfe4ccde8 /* @ECU_Address@SwcIn_Fusa_CAN_E2E.Fusa_ONEBOX_4_RollgCntr2_Error@ */ /end MEASUREMENT
/begin MEASUREMENT SwcIn_Fusa_CAN_E2E.Fusa_ONEBOX_4_RollgCntr3_Error "" UBYTE autosar_swc_val_CM_boolean 0 0 0 1 ECU_ADDRESS 0xfe4ccdea /* @ECU_Address@SwcIn_Fusa_CAN_E2E.Fusa_ONEBOX_4_RollgCntr3_Error@ */ /end MEASUREMENT
/begin MEASUREMENT SwcIn_Fusa_CAN_E2E.Fusa_ONEBOX_4_RollgCntr4_Error "" UBYTE autosar_swc_val_CM_boolean 0 0 0 1 ECU_ADDRESS 0xfe4ccdec /* @ECU_Address@SwcIn_Fusa_CAN_E2E.Fusa_ONEBOX_4_RollgCntr4_Error@ */ /end MEASUREMENT
/begin MEASUREMENT SwcIn_Fusa_CAN_E2E.Fusa_ONEBOX_4_Timeout "" UBYTE autosar_swc_val_CM_boolean 0 0 0 1 ECU_ADDRESS 0xfe4ccded /* @ECU_Address@SwcIn_Fusa_CAN_E2E.Fusa_ONEBOX_4_Timeout@ */ /end MEASUREMENT
/begin MEASUREMENT SwcIn_Fusa_CAN_E2E.Fusa_ONEBOX_5_CRC1_Error "" UBYTE autosar_swc_val_CM_boolean 0 0 0 1 ECU_ADDRESS 0xfe4ccdee /* @ECU_Address@SwcIn_Fusa_CAN_E2E.Fusa_ONEBOX_5_CRC1_Error@ */ /end MEASUREMENT
/begin MEASUREMENT SwcIn_Fusa_CAN_E2E.Fusa_ONEBOX_5_RollgCntr1_Error "" UBYTE autosar_swc_val_CM_boolean 0 0 0 1 ECU_ADDRESS 0xfe4ccdef /* @ECU_Address@SwcIn_Fusa_CAN_E2E.Fusa_ONEBOX_5_RollgCntr1_Error@ */ /end MEASUREMENT
/begin MEASUREMENT SwcIn_Fusa_CAN_E2E.Fusa_ONEBOX_5_Timeout "" UBYTE autosar_swc_val_CM_boolean 0 0 0 1 ECU_ADDRESS 0xfe4ccdf0 /* @ECU_Address@SwcIn_Fusa_CAN_E2E.Fusa_ONEBOX_5_Timeout@ */ /end MEASUREMENT
/begin MEASUREMENT SwcIn_Fusa_CAN_E2E.Fusa_RLCR_1_CRC1_Error "" UBYTE autosar_swc_val_CM_boolean 0 0 0 1 ECU_ADDRESS 0xfe4cce2f /* @ECU_Address@SwcIn_Fusa_CAN_E2E.Fusa_RLCR_1_CRC1_Error@ */ /end MEASUREMENT
/begin MEASUREMENT SwcIn_Fusa_CAN_E2E.Fusa_RLCR_1_RollgCntr1_Error "" UBYTE autosar_swc_val_CM_boolean 0 0 0 1 ECU_ADDRESS 0xfe4cce30 /* @ECU_Address@SwcIn_Fusa_CAN_E2E.Fusa_RLCR_1_RollgCntr1_Error@ */ /end MEASUREMENT
/begin MEASUREMENT SwcIn_Fusa_CAN_E2E.Fusa_RLCR_1_Timeout "" UBYTE autosar_swc_val_CM_boolean 0 0 0 1 ECU_ADDRESS 0xfe4cce31 /* @ECU_Address@SwcIn_Fusa_CAN_E2E.Fusa_RLCR_1_Timeout@ */ /end MEASUREMENT
/begin MEASUREMENT SwcIn_Fusa_CAN_E2E.Fusa_RLCR_2_CRC1_Error "" UBYTE autosar_swc_val_CM_boolean 0 0 0 1 ECU_ADDRESS 0xfe4cce32 /* @ECU_Address@SwcIn_Fusa_CAN_E2E.Fusa_RLCR_2_CRC1_Error@ */ /end MEASUREMENT
/begin MEASUREMENT SwcIn_Fusa_CAN_E2E.Fusa_RLCR_2_RollgCntr1_Error "" UBYTE autosar_swc_val_CM_boolean 0 0 0 1 ECU_ADDRESS 0xfe4cce33 /* @ECU_Address@SwcIn_Fusa_CAN_E2E.Fusa_RLCR_2_RollgCntr1_Error@ */ /end MEASUREMENT
/begin MEASUREMENT SwcIn_Fusa_CAN_E2E.Fusa_RLCR_3_CRC_Error "" UBYTE autosar_swc_val_CM_boolean 0 0 0 1 ECU_ADDRESS 0xfe4cce34 /* @ECU_Address@SwcIn_Fusa_CAN_E2E.Fusa_RLCR_3_CRC_Error@ */ /end MEASUREMENT
/begin MEASUREMENT SwcIn_Fusa_CAN_E2E.Fusa_RLCR_3_RollgCntr_Error "" UBYTE autosar_swc_val_CM_boolean 0 0 0 1 ECU_ADDRESS 0xfe4cce35 /* @ECU_Address@SwcIn_Fusa_CAN_E2E.Fusa_RLCR_3_RollgCntr_Error@ */ /end MEASUREMENT
/begin MEASUREMENT SwcIn_Fusa_CAN_E2E.Fusa_RLCR_3_Timeout "" UBYTE autosar_swc_val_CM_boolean 0 0 0 1 ECU_ADDRESS 0xfe4cce36 /* @ECU_Address@SwcIn_Fusa_CAN_E2E.Fusa_RLCR_3_Timeout@ */ /end MEASUREMENT
/begin MEASUREMENT SwcIn_Fusa_CAN_E2E.Fusa_RLCR_4_CRC_Error "" UBYTE autosar_swc_val_CM_boolean 0 0 0 1 ECU_ADDRESS 0xfe4cce37 /* @ECU_Address@SwcIn_Fusa_CAN_E2E.Fusa_RLCR_4_CRC_Error@ */ /end MEASUREMENT
/begin MEASUREMENT SwcIn_Fusa_CAN_E2E.Fusa_RLCR_4_RollgCntr_Error "" UBYTE autosar_swc_val_CM_boolean 0 0 0 1 ECU_ADDRESS 0xfe4cce38 /* @ECU_Address@SwcIn_Fusa_CAN_E2E.Fusa_RLCR_4_RollgCntr_Error@ */ /end MEASUREMENT
/begin MEASUREMENT SwcIn_Fusa_CAN_E2E.Fusa_RLCR_4_Timeout "" UBYTE autosar_swc_val_CM_boolean 0 0 0 1 ECU_ADDRESS 0xfe4cce39 /* @ECU_Address@SwcIn_Fusa_CAN_E2E.Fusa_RLCR_4_Timeout@ */ /end MEASUREMENT
/begin MEASUREMENT SwcIn_Fusa_CAN_E2E.Fusa_RLCR_5_CRC_Error "" UBYTE autosar_swc_val_CM_boolean 0 0 0 1 ECU_ADDRESS 0xfe4cce3a /* @ECU_Address@SwcIn_Fusa_CAN_E2E.Fusa_RLCR_5_CRC_Error@ */ /end MEASUREMENT
/begin MEASUREMENT SwcIn_Fusa_CAN_E2E.Fusa_RLCR_5_RollgCntr_Error "" UBYTE autosar_swc_val_CM_boolean 0 0 0 1 ECU_ADDRESS 0xfe4cce3b /* @ECU_Address@SwcIn_Fusa_CAN_E2E.Fusa_RLCR_5_RollgCntr_Error@ */ /end MEASUREMENT
/begin MEASUREMENT SwcIn_Fusa_CAN_E2E.Fusa_RLCR_5_Timeout "" UBYTE autosar_swc_val_CM_boolean 0 0 0 1 ECU_ADDRESS 0xfe4cce3c /* @ECU_Address@SwcIn_Fusa_CAN_E2E.Fusa_RLCR_5_Timeout@ */ /end MEASUREMENT
/begin MEASUREMENT SwcIn_Fusa_CAN_E2E.Fusa_RLCR_6_CRC_Error "" UBYTE autosar_swc_val_CM_boolean 0 0 0 1 ECU_ADDRESS 0xfe4cce3d /* @ECU_Address@SwcIn_Fusa_CAN_E2E.Fusa_RLCR_6_CRC_Error@ */ /end MEASUREMENT
/begin MEASUREMENT SwcIn_Fusa_CAN_E2E.Fusa_RLCR_6_RollgCntr_Error "" UBYTE autosar_swc_val_CM_boolean 0 0 0 1 ECU_ADDRESS 0xfe4cce3e /* @ECU_Address@SwcIn_Fusa_CAN_E2E.Fusa_RLCR_6_RollgCntr_Error@ */ /end MEASUREMENT
/begin MEASUREMENT SwcIn_Fusa_CAN_E2E.Fusa_RLCR_6_Timeout "" UBYTE autosar_swc_val_CM_boolean 0 0 0 1 ECU_ADDRESS 0xfe4cce3f /* @ECU_Address@SwcIn_Fusa_CAN_E2E.Fusa_RLCR_6_Timeout@ */ /end MEASUREMENT
/begin MEASUREMENT SwcIn_Fusa_CAN_E2E.Fusa_RLCR_7_CRC_Error "" UBYTE autosar_swc_val_CM_boolean 0 0 0 1 ECU_ADDRESS 0xfe4cce40 /* @ECU_Address@SwcIn_Fusa_CAN_E2E.Fusa_RLCR_7_CRC_Error@ */ /end MEASUREMENT
/begin MEASUREMENT SwcIn_Fusa_CAN_E2E.Fusa_RLCR_7_RollgCntr_Error "" UBYTE autosar_swc_val_CM_boolean 0 0 0 1 ECU_ADDRESS 0xfe4cce41 /* @ECU_Address@SwcIn_Fusa_CAN_E2E.Fusa_RLCR_7_RollgCntr_Error@ */ /end MEASUREMENT
/begin MEASUREMENT SwcIn_Fusa_CAN_E2E.Fusa_RLCR_7_Timeout "" UBYTE autosar_swc_val_CM_boolean 0 0 0 1 ECU_ADDRESS 0xfe4cce42 /* @ECU_Address@SwcIn_Fusa_CAN_E2E.Fusa_RLCR_7_Timeout@ */ /end MEASUREMENT
/begin MEASUREMENT SwcIn_Fusa_CAN_E2E.Fusa_RLCR_8_CRC_Error "" UBYTE autosar_swc_val_CM_boolean 0 0 0 1 ECU_ADDRESS 0xfe4cce43 /* @ECU_Address@SwcIn_Fusa_CAN_E2E.Fusa_RLCR_8_CRC_Error@ */ /end MEASUREMENT
/begin MEASUREMENT SwcIn_Fusa_CAN_E2E.Fusa_RLCR_8_RollgCntr_Error "" UBYTE autosar_swc_val_CM_boolean 0 0 0 1 ECU_ADDRESS 0xfe4cce44 /* @ECU_Address@SwcIn_Fusa_CAN_E2E.Fusa_RLCR_8_RollgCntr_Error@ */ /end MEASUREMENT
/begin MEASUREMENT SwcIn_Fusa_CAN_E2E.Fusa_RLCR_8_Timeout "" UBYTE autosar_swc_val_CM_boolean 0 0 0 1 ECU_ADDRESS 0xfe4cce45 /* @ECU_Address@SwcIn_Fusa_CAN_E2E.Fusa_RLCR_8_Timeout@ */ /end MEASUREMENT
/begin MEASUREMENT SwcIn_Fusa_CAN_E2E.Fusa_RRCR_1_CRC1_Error "" UBYTE autosar_swc_val_CM_boolean 0 0 0 1 ECU_ADDRESS 0xfe4cce46 /* @ECU_Address@SwcIn_Fusa_CAN_E2E.Fusa_RRCR_1_CRC1_Error@ */ /end MEASUREMENT
/begin MEASUREMENT SwcIn_Fusa_CAN_E2E.Fusa_RRCR_1_RollgCntr1_Error "" UBYTE autosar_swc_val_CM_boolean 0 0 0 1 ECU_ADDRESS 0xfe4cce47 /* @ECU_Address@SwcIn_Fusa_CAN_E2E.Fusa_RRCR_1_RollgCntr1_Error@ */ /end MEASUREMENT
/begin MEASUREMENT SwcIn_Fusa_CAN_E2E.Fusa_RRCR_1_Timeout "" UBYTE autosar_swc_val_CM_boolean 0 0 0 1 ECU_ADDRESS 0xfe4cce48 /* @ECU_Address@SwcIn_Fusa_CAN_E2E.Fusa_RRCR_1_Timeout@ */ /end MEASUREMENT
/begin MEASUREMENT SwcIn_Fusa_CAN_E2E.Fusa_RRCR_3_CRC_Error "" UBYTE autosar_swc_val_CM_boolean 0 0 0 1 ECU_ADDRESS 0xfe4cce49 /* @ECU_Address@SwcIn_Fusa_CAN_E2E.Fusa_RRCR_3_CRC_Error@ */ /end MEASUREMENT
/begin MEASUREMENT SwcIn_Fusa_CAN_E2E.Fusa_RRCR_3_RollgCntr_Error "" UBYTE autosar_swc_val_CM_boolean 0 0 0 1 ECU_ADDRESS 0xfe4cce4a /* @ECU_Address@SwcIn_Fusa_CAN_E2E.Fusa_RRCR_3_RollgCntr_Error@ */ /end MEASUREMENT
/begin MEASUREMENT SwcIn_Fusa_CAN_E2E.Fusa_RRCR_3_Timeout "" UBYTE autosar_swc_val_CM_boolean 0 0 0 1 ECU_ADDRESS 0xfe4cce4b /* @ECU_Address@SwcIn_Fusa_CAN_E2E.Fusa_RRCR_3_Timeout@ */ /end MEASUREMENT
/begin MEASUREMENT SwcIn_Fusa_CAN_E2E.Fusa_RRCR_4_CRC_Error "" UBYTE autosar_swc_val_CM_boolean 0 0 0 1 ECU_ADDRESS 0xfe4cce4c /* @ECU_Address@SwcIn_Fusa_CAN_E2E.Fusa_RRCR_4_CRC_Error@ */ /end MEASUREMENT
/begin MEASUREMENT SwcIn_Fusa_CAN_E2E.Fusa_RRCR_4_RollgCntr_Error "" UBYTE autosar_swc_val_CM_boolean 0 0 0 1 ECU_ADDRESS 0xfe4cce4d /* @ECU_Address@SwcIn_Fusa_CAN_E2E.Fusa_RRCR_4_RollgCntr_Error@ */ /end MEASUREMENT
/begin MEASUREMENT SwcIn_Fusa_CAN_E2E.Fusa_RRCR_4_Timeout "" UBYTE autosar_swc_val_CM_boolean 0 0 0 1 ECU_ADDRESS 0xfe4cce4e /* @ECU_Address@SwcIn_Fusa_CAN_E2E.Fusa_RRCR_4_Timeout@ */ /end MEASUREMENT
/begin MEASUREMENT SwcIn_Fusa_CAN_E2E.Fusa_RRCR_5_CRC_Error "" UBYTE autosar_swc_val_CM_boolean 0 0 0 1 ECU_ADDRESS 0xfe4cce4f /* @ECU_Address@SwcIn_Fusa_CAN_E2E.Fusa_RRCR_5_CRC_Error@ */ /end MEASUREMENT
/begin MEASUREMENT SwcIn_Fusa_CAN_E2E.Fusa_RRCR_5_RollgCntr_Error "" UBYTE autosar_swc_val_CM_boolean 0 0 0 1 ECU_ADDRESS 0xfe4cce50 /* @ECU_Address@SwcIn_Fusa_CAN_E2E.Fusa_RRCR_5_RollgCntr_Error@ */ /end MEASUREMENT
/begin MEASUREMENT SwcIn_Fusa_CAN_E2E.Fusa_RRCR_5_Timeout "" UBYTE autosar_swc_val_CM_boolean 0 0 0 1 ECU_ADDRESS 0xfe4cce51 /* @ECU_Address@SwcIn_Fusa_CAN_E2E.Fusa_RRCR_5_Timeout@ */ /end MEASUREMENT
/begin MEASUREMENT SwcIn_Fusa_CAN_E2E.Fusa_RRCR_6_CRC_Error "" UBYTE autosar_swc_val_CM_boolean 0 0 0 1 ECU_ADDRESS 0xfe4cce52 /* @ECU_Address@SwcIn_Fusa_CAN_E2E.Fusa_RRCR_6_CRC_Error@ */ /end MEASUREMENT
/begin MEASUREMENT SwcIn_Fusa_CAN_E2E.Fusa_RRCR_6_RollgCntr_Error "" UBYTE autosar_swc_val_CM_boolean 0 0 0 1 ECU_ADDRESS 0xfe4cce53 /* @ECU_Address@SwcIn_Fusa_CAN_E2E.Fusa_RRCR_6_RollgCntr_Error@ */ /end MEASUREMENT
/begin MEASUREMENT SwcIn_Fusa_CAN_E2E.Fusa_RRCR_6_Timeout "" UBYTE autosar_swc_val_CM_boolean 0 0 0 1 ECU_ADDRESS 0xfe4cce54 /* @ECU_Address@SwcIn_Fusa_CAN_E2E.Fusa_RRCR_6_Timeout@ */ /end MEASUREMENT
/begin MEASUREMENT SwcIn_Fusa_CAN_E2E.Fusa_RRCR_7_CRC_Error "" UBYTE autosar_swc_val_CM_boolean 0 0 0 1 ECU_ADDRESS 0xfe4cce55 /* @ECU_Address@SwcIn_Fusa_CAN_E2E.Fusa_RRCR_7_CRC_Error@ */ /end MEASUREMENT
/begin MEASUREMENT SwcIn_Fusa_CAN_E2E.Fusa_RRCR_7_RollgCntr_Error "" UBYTE autosar_swc_val_CM_boolean 0 0 0 1 ECU_ADDRESS 0xfe4cce56 /* @ECU_Address@SwcIn_Fusa_CAN_E2E.Fusa_RRCR_7_RollgCntr_Error@ */ /end MEASUREMENT
/begin MEASUREMENT SwcIn_Fusa_CAN_E2E.Fusa_RRCR_7_Timeout "" UBYTE autosar_swc_val_CM_boolean 0 0 0 1 ECU_ADDRESS 0xfe4cce57 /* @ECU_Address@SwcIn_Fusa_CAN_E2E.Fusa_RRCR_7_Timeout@ */ /end MEASUREMENT
/begin MEASUREMENT SwcIn_Fusa_CAN_E2E.Fusa_RRCR_8_CRC_Error "" UBYTE autosar_swc_val_CM_boolean 0 0 0 1 ECU_ADDRESS 0xfe4cce58 /* @ECU_Address@SwcIn_Fusa_CAN_E2E.Fusa_RRCR_8_CRC_Error@ */ /end MEASUREMENT
/begin MEASUREMENT SwcIn_Fusa_CAN_E2E.Fusa_RRCR_8_RollgCntr_Error "" UBYTE autosar_swc_val_CM_boolean 0 0 0 1 ECU_ADDRESS 0xfe4cce59 /* @ECU_Address@SwcIn_Fusa_CAN_E2E.Fusa_RRCR_8_RollgCntr_Error@ */ /end MEASUREMENT
/begin MEASUREMENT SwcIn_Fusa_CAN_E2E.Fusa_RRCR_8_Timeout "" UBYTE autosar_swc_val_CM_boolean 0 0 0 1 ECU_ADDRESS 0xfe4cce5a /* @ECU_Address@SwcIn_Fusa_CAN_E2E.Fusa_RRCR_8_Timeout@ */ /end MEASUREMENT
/begin MEASUREMENT SwcIn_Fusa_CAN_E2E.Fusa_RZCU_2_CRC_Error "" UBYTE autosar_swc_val_CM_boolean 0 0 0 1 ECU_ADDRESS 0xfe4cce25 /* @ECU_Address@SwcIn_Fusa_CAN_E2E.Fusa_RZCU_2_CRC_Error@ */ /end MEASUREMENT
/begin MEASUREMENT SwcIn_Fusa_CAN_E2E.Fusa_RZCU_2_RollgCntr_Error "" UBYTE autosar_swc_val_CM_boolean 0 0 0 1 ECU_ADDRESS 0xfe4cce26 /* @ECU_Address@SwcIn_Fusa_CAN_E2E.Fusa_RZCU_2_RollgCntr_Error@ */ /end MEASUREMENT
/begin MEASUREMENT SwcIn_Fusa_CAN_E2E.Fusa_RZCU_7_CRC_Error "" UBYTE autosar_swc_val_CM_boolean 0 0 0 1 ECU_ADDRESS 0xfe4cce27 /* @ECU_Address@SwcIn_Fusa_CAN_E2E.Fusa_RZCU_7_CRC_Error@ */ /end MEASUREMENT
/begin MEASUREMENT SwcIn_Fusa_CAN_E2E.Fusa_RZCU_7_RollgCntr_Error "" UBYTE autosar_swc_val_CM_boolean 0 0 0 1 ECU_ADDRESS 0xfe4cce28 /* @ECU_Address@SwcIn_Fusa_CAN_E2E.Fusa_RZCU_7_RollgCntr_Error@ */ /end MEASUREMENT
/begin MEASUREMENT SwcIn_Fusa_CAN_E2E.Fusa_SAM_1_CRC_Error "" UBYTE autosar_swc_val_CM_boolean 0 0 0 1 ECU_ADDRESS 0xfe4ccdd6 /* @ECU_Address@SwcIn_Fusa_CAN_E2E.Fusa_SAM_1_CRC_Error@ */ /end MEASUREMENT
/begin MEASUREMENT SwcIn_Fusa_CAN_E2E.Fusa_SAM_1_RollgCntr_Error "" UBYTE autosar_swc_val_CM_boolean 0 0 0 1 ECU_ADDRESS 0xfe4ccdd7 /* @ECU_Address@SwcIn_Fusa_CAN_E2E.Fusa_SAM_1_RollgCntr_Error@ */ /end MEASUREMENT
/begin MEASUREMENT SwcIn_Fusa_CAN_E2E.Fusa_SAS_1_Timeout "" UBYTE autosar_swc_val_CM_boolean 0 0 0 1 ECU_ADDRESS 0xfe4ccdd8 /* @ECU_Address@SwcIn_Fusa_CAN_E2E.Fusa_SAS_1_Timeout@ */ /end MEASUREMENT
/begin MEASUREMENT SwcIn_Fusa_CAN_E2E.Fusa_VCC_3_CRC_Error "" UBYTE autosar_swc_val_CM_boolean 0 0 0 1 ECU_ADDRESS 0xfe4cce5f /* @ECU_Address@SwcIn_Fusa_CAN_E2E.Fusa_VCC_3_CRC_Error@ */ /end MEASUREMENT
/begin MEASUREMENT SwcIn_Fusa_CAN_E2E.Fusa_VCC_3_RollgCntr_Error "" UBYTE autosar_swc_val_CM_boolean 0 0 0 1 ECU_ADDRESS 0xfe4cce60 /* @ECU_Address@SwcIn_Fusa_CAN_E2E.Fusa_VCC_3_RollgCntr_Error@ */ /end MEASUREMENT
/begin MEASUREMENT SwcIn_Fusa_CAN_E2E.Fusa_VCU_10_CRC_Error "" UBYTE autosar_swc_val_CM_boolean 0 0 0 1 ECU_ADDRESS 0xfe4ccdfa /* @ECU_Address@SwcIn_Fusa_CAN_E2E.Fusa_VCU_10_CRC_Error@ */ /end MEASUREMENT
/begin MEASUREMENT SwcIn_Fusa_CAN_E2E.Fusa_VCU_10_RollgCntr_Error "" UBYTE autosar_swc_val_CM_boolean 0 0 0 1 ECU_ADDRESS 0xfe4ccdfb /* @ECU_Address@SwcIn_Fusa_CAN_E2E.Fusa_VCU_10_RollgCntr_Error@ */ /end MEASUREMENT
/begin MEASUREMENT SwcIn_Fusa_CAN_E2E.Fusa_VCU_11_CRC1_Error "" UBYTE autosar_swc_val_CM_boolean 0 0 0 1 ECU_ADDRESS 0xfe4ccdfd /* @ECU_Address@SwcIn_Fusa_CAN_E2E.Fusa_VCU_11_CRC1_Error@ */ /end MEASUREMENT
/begin MEASUREMENT SwcIn_Fusa_CAN_E2E.Fusa_VCU_11_CRC2_Error "" UBYTE autosar_swc_val_CM_boolean 0 0 0 1 ECU_ADDRESS 0xfe4ccdff /* @ECU_Address@SwcIn_Fusa_CAN_E2E.Fusa_VCU_11_CRC2_Error@ */ /end MEASUREMENT
/begin MEASUREMENT SwcIn_Fusa_CAN_E2E.Fusa_VCU_11_CRC3_Error "" UBYTE autosar_swc_val_CM_boolean 0 0 0 1 ECU_ADDRESS 0xfe4cce01 /* @ECU_Address@SwcIn_Fusa_CAN_E2E.Fusa_VCU_11_CRC3_Error@ */ /end MEASUREMENT
/begin MEASUREMENT SwcIn_Fusa_CAN_E2E.Fusa_VCU_11_CRC4_Error "" UBYTE autosar_swc_val_CM_boolean 0 0 0 1 ECU_ADDRESS 0xfe4cce03 /* @ECU_Address@SwcIn_Fusa_CAN_E2E.Fusa_VCU_11_CRC4_Error@ */ /end MEASUREMENT
/begin MEASUREMENT SwcIn_Fusa_CAN_E2E.Fusa_VCU_11_RollgCntr1_Error "" UBYTE autosar_swc_val_CM_boolean 0 0 0 1 ECU_ADDRESS 0xfe4ccdfe /* @ECU_Address@SwcIn_Fusa_CAN_E2E.Fusa_VCU_11_RollgCntr1_Error@ */ /end MEASUREMENT
/begin MEASUREMENT SwcIn_Fusa_CAN_E2E.Fusa_VCU_11_RollgCntr2_Error "" UBYTE autosar_swc_val_CM_boolean 0 0 0 1 ECU_ADDRESS 0xfe4cce00 /* @ECU_Address@SwcIn_Fusa_CAN_E2E.Fusa_VCU_11_RollgCntr2_Error@ */ /end MEASUREMENT
/begin MEASUREMENT SwcIn_Fusa_CAN_E2E.Fusa_VCU_11_RollgCntr3_Error "" UBYTE autosar_swc_val_CM_boolean 0 0 0 1 ECU_ADDRESS 0xfe4cce02 /* @ECU_Address@SwcIn_Fusa_CAN_E2E.Fusa_VCU_11_RollgCntr3_Error@ */ /end MEASUREMENT
/begin MEASUREMENT SwcIn_Fusa_CAN_E2E.Fusa_VCU_11_RollgCntr4_Error "" UBYTE autosar_swc_val_CM_boolean 0 0 0 1 ECU_ADDRESS 0xfe4cce04 /* @ECU_Address@SwcIn_Fusa_CAN_E2E.Fusa_VCU_11_RollgCntr4_Error@ */ /end MEASUREMENT
/begin MEASUREMENT SwcIn_Fusa_CAN_E2E.Fusa_VCU_12_CRC1_Error "" UBYTE autosar_swc_val_CM_boolean 0 0 0 1 ECU_ADDRESS 0xfe4cce06 /* @ECU_Address@SwcIn_Fusa_CAN_E2E.Fusa_VCU_12_CRC1_Error@ */ /end MEASUREMENT
/begin MEASUREMENT SwcIn_Fusa_CAN_E2E.Fusa_VCU_12_CRC2_Error "" UBYTE autosar_swc_val_CM_boolean 0 0 0 1 ECU_ADDRESS 0xfe4cce08 /* @ECU_Address@SwcIn_Fusa_CAN_E2E.Fusa_VCU_12_CRC2_Error@ */ /end MEASUREMENT
/begin MEASUREMENT SwcIn_Fusa_CAN_E2E.Fusa_VCU_12_CRC3_Error "" UBYTE autosar_swc_val_CM_boolean 0 0 0 1 ECU_ADDRESS 0xfe4cce0a /* @ECU_Address@SwcIn_Fusa_CAN_E2E.Fusa_VCU_12_CRC3_Error@ */ /end MEASUREMENT
/begin MEASUREMENT SwcIn_Fusa_CAN_E2E.Fusa_VCU_12_RollgCntr1_Error "" UBYTE autosar_swc_val_CM_boolean 0 0 0 1 ECU_ADDRESS 0xfe4cce07 /* @ECU_Address@SwcIn_Fusa_CAN_E2E.Fusa_VCU_12_RollgCntr1_Error@ */ /end MEASUREMENT
/begin MEASUREMENT SwcIn_Fusa_CAN_E2E.Fusa_VCU_12_RollgCntr2_Error "" UBYTE autosar_swc_val_CM_boolean 0 0 0 1 ECU_ADDRESS 0xfe4cce09 /* @ECU_Address@SwcIn_Fusa_CAN_E2E.Fusa_VCU_12_RollgCntr2_Error@ */ /end MEASUREMENT
/begin MEASUREMENT SwcIn_Fusa_CAN_E2E.Fusa_VCU_12_RollgCntr3_Error "" UBYTE autosar_swc_val_CM_boolean 0 0 0 1 ECU_ADDRESS 0xfe4cce0b /* @ECU_Address@SwcIn_Fusa_CAN_E2E.Fusa_VCU_12_RollgCntr3_Error@ */ /end MEASUREMENT
/begin MEASUREMENT SwcIn_Fusa_CAN_E2E.Fusa_VCU_1_G_CRC_Error "" UBYTE autosar_swc_val_CM_boolean 0 0 0 1 ECU_ADDRESS 0xfe4ccdf4 /* @ECU_Address@SwcIn_Fusa_CAN_E2E.Fusa_VCU_1_G_CRC_Error@ */ /end MEASUREMENT
/begin MEASUREMENT SwcIn_Fusa_CAN_E2E.Fusa_VCU_1_G_RollgCntr_Error "" UBYTE autosar_swc_val_CM_boolean 0 0 0 1 ECU_ADDRESS 0xfe4ccdf5 /* @ECU_Address@SwcIn_Fusa_CAN_E2E.Fusa_VCU_1_G_RollgCntr_Error@ */ /end MEASUREMENT
/begin MEASUREMENT SwcIn_Fusa_CAN_E2E.Fusa_VCU_1_G_Timeout "" UBYTE autosar_swc_val_CM_boolean 0 0 0 1 ECU_ADDRESS 0xfe4ccdf6 /* @ECU_Address@SwcIn_Fusa_CAN_E2E.Fusa_VCU_1_G_Timeout@ */ /end MEASUREMENT
/begin MEASUREMENT SwcIn_Fusa_CAN_E2E.Fusa_VCU_2_G_CRC_Error "" UBYTE autosar_swc_val_CM_boolean 0 0 0 1 ECU_ADDRESS 0xfe4ccdf7 /* @ECU_Address@SwcIn_Fusa_CAN_E2E.Fusa_VCU_2_G_CRC_Error@ */ /end MEASUREMENT
/begin MEASUREMENT SwcIn_Fusa_CAN_E2E.Fusa_VCU_2_G_RollgCntr_Error "" UBYTE autosar_swc_val_CM_boolean 0 0 0 1 ECU_ADDRESS 0xfe4ccdf8 /* @ECU_Address@SwcIn_Fusa_CAN_E2E.Fusa_VCU_2_G_RollgCntr_Error@ */ /end MEASUREMENT
/begin MEASUREMENT SwcIn_Fusa_CAN_E2E.Fusa_VCU_2_G_Timeout "" UBYTE autosar_swc_val_CM_boolean 0 0 0 1 ECU_ADDRESS 0xfe4ccdf9 /* @ECU_Address@SwcIn_Fusa_CAN_E2E.Fusa_VCU_2_G_Timeout@ */ /end MEASUREMENT
/begin MEASUREMENT SwcIn_Fusa_CAN_E2E.Fusa_VCU_ADCC_12_Timeout "" UBYTE autosar_swc_val_CM_boolean 0 0 0 1 ECU_ADDRESS 0xfe4cce0c /* @ECU_Address@SwcIn_Fusa_CAN_E2E.Fusa_VCU_ADCC_12_Timeout@ */ /end MEASUREMENT
/begin MEASUREMENT SwcIn_Fusa_CAN_E2E.Fusa_VCU_COM_10_Timeout "" UBYTE autosar_swc_val_CM_boolean 0 0 0 1 ECU_ADDRESS 0xfe4ccdfc /* @ECU_Address@SwcIn_Fusa_CAN_E2E.Fusa_VCU_COM_10_Timeout@ */ /end MEASUREMENT
/begin MEASUREMENT SwcIn_Fusa_CAN_E2E.Fusa_VCU_ONEBOX_11_Timeout "" UBYTE autosar_swc_val_CM_boolean 0 0 0 1 ECU_ADDRESS 0xfe4cce05 /* @ECU_Address@SwcIn_Fusa_CAN_E2E.Fusa_VCU_ONEBOX_11_Timeout@ */ /end MEASUREMENT
/begin MEASUREMENT SwcIn_Fusa_CAN_Value.Fusa_ABS_ESP_1_ABSFailSts "" UBYTE autosar_swc_val_CM_boolean 0 0 0 1 ECU_ADDRESS 0xfe4ccaa9 /* @ECU_Address@SwcIn_Fusa_CAN_Value.Fusa_ABS_ESP_1_ABSFailSts@ */ /end MEASUREMENT
/begin MEASUREMENT SwcIn_Fusa_CAN_Value.Fusa_ABS_ESP_1_EBDFailSts "" UBYTE autosar_swc_val_CM_boolean 0 0 0 1 ECU_ADDRESS 0xfe4ccaa8 /* @ECU_Address@SwcIn_Fusa_CAN_Value.Fusa_ABS_ESP_1_EBDFailSts@ */ /end MEASUREMENT
/begin MEASUREMENT SwcIn_Fusa_CAN_Value.Fusa_ABS_ESP_1_HDCFailSts "" UBYTE autosar_swc_val_CM_boolean 0 0 0 1 ECU_ADDRESS 0xfe4ccaad /* @ECU_Address@SwcIn_Fusa_CAN_Value.Fusa_ABS_ESP_1_HDCFailSts@ */ /end MEASUREMENT
/begin MEASUREMENT SwcIn_Fusa_CAN_Value.Fusa_ABS_ESP_1_HHCFailSts "" UBYTE autosar_swc_val_CM_boolean 0 0 0 1 ECU_ADDRESS 0xfe4ccaac /* @ECU_Address@SwcIn_Fusa_CAN_Value.Fusa_ABS_ESP_1_HHCFailSts@ */ /end MEASUREMENT
/begin MEASUREMENT SwcIn_Fusa_CAN_Value.Fusa_ABS_ESP_1_TCSFailSts "" UBYTE autosar_swc_val_CM_boolean 0 0 0 1 ECU_ADDRESS 0xfe4ccaab /* @ECU_Address@SwcIn_Fusa_CAN_Value.Fusa_ABS_ESP_1_TCSFailSts@ */ /end MEASUREMENT
/begin MEASUREMENT SwcIn_Fusa_CAN_Value.Fusa_ABS_ESP_1_VDCFailSts "" UBYTE autosar_swc_val_CM_boolean 0 0 0 1 ECU_ADDRESS 0xfe4ccaaa /* @ECU_Address@SwcIn_Fusa_CAN_Value.Fusa_ABS_ESP_1_VDCFailSts@ */ /end MEASUREMENT
/begin MEASUREMENT SwcIn_Fusa_CAN_Value.Fusa_ABS_ESP_1_VehicleSpeedVSOSig "" FLOAT32_IEEE autosar_swc_val_CM_single 0 0 -3.4E+38 3.4E+38 ECU_ADDRESS 0xfe4ccafc /* @ECU_Address@SwcIn_Fusa_CAN_Value.Fusa_ABS_ESP_1_VehicleSpeedVSOSig@ */ /end MEASUREMENT
/begin MEASUREMENT SwcIn_Fusa_CAN_Value.Fusa_ACU_2_LateralAcceleration "" FLOAT32_IEEE autosar_swc_val_CM_single 0 0 -3.4E+38 3.4E+38 ECU_ADDRESS 0xfe4ccae4 /* @ECU_Address@SwcIn_Fusa_CAN_Value.Fusa_ACU_2_LateralAcceleration@ */ /end MEASUREMENT
/begin MEASUREMENT SwcIn_Fusa_CAN_Value.Fusa_ACU_2_LateralAccelerationSigVD "" UBYTE autosar_swc_val_CM_uint8 0 0 0 255 ECU_ADDRESS 0xfe4ccac5 /* @ECU_Address@SwcIn_Fusa_CAN_Value.Fusa_ACU_2_LateralAccelerationSigVD@ */ /end MEASUREMENT
/begin MEASUREMENT SwcIn_Fusa_CAN_Value.Fusa_ACU_2_YASCalibrationSts "" UBYTE autosar_swc_val_CM_boolean 0 0 0 1 ECU_ADDRESS 0xfe4cca9c /* @ECU_Address@SwcIn_Fusa_CAN_Value.Fusa_ACU_2_YASCalibrationSts@ */ /end MEASUREMENT
/begin MEASUREMENT SwcIn_Fusa_CAN_Value.Fusa_ACU_2_YawRate "" FLOAT32_IEEE autosar_swc_val_CM_single 0 0 -3.4E+38 3.4E+38 ECU_ADDRESS 0xfe4ccae8 /* @ECU_Address@SwcIn_Fusa_CAN_Value.Fusa_ACU_2_YawRate@ */ /end MEASUREMENT
/begin MEASUREMENT SwcIn_Fusa_CAN_Value.Fusa_ACU_2_YawrateSigValidData "" UBYTE autosar_swc_val_CM_uint8 0 0 0 255 ECU_ADDRESS 0xfe4ccac4 /* @ECU_Address@SwcIn_Fusa_CAN_Value.Fusa_ACU_2_YawrateSigValidData@ */ /end MEASUREMENT
/begin MEASUREMENT SwcIn_Fusa_CAN_Value.Fusa_ACU_3_CrashOutputSts "" UBYTE autosar_swc_val_CM_uint8 0 0 0 255 ECU_ADDRESS 0xfe4ccac7 /* @ECU_Address@SwcIn_Fusa_CAN_Value.Fusa_ACU_3_CrashOutputSts@ */ /end MEASUREMENT
/begin MEASUREMENT SwcIn_Fusa_CAN_Value.Fusa_ACU_3_LongitudinalAcceleration "" FLOAT32_IEEE autosar_swc_val_CM_single 0 0 -3.4E+38 3.4E+38 ECU_ADDRESS 0xfe4ccaec /* @ECU_Address@SwcIn_Fusa_CAN_Value.Fusa_ACU_3_LongitudinalAcceleration@ */ /end MEASUREMENT
/begin MEASUREMENT SwcIn_Fusa_CAN_Value.Fusa_ACU_3_LongitudinalAccelerationVD "" UBYTE autosar_swc_val_CM_uint8 0 0 0 255 ECU_ADDRESS 0xfe4ccac6 /* @ECU_Address@SwcIn_Fusa_CAN_Value.Fusa_ACU_3_LongitudinalAccelerationVD@ */ /end MEASUREMENT
/begin MEASUREMENT SwcIn_Fusa_CAN_Value.Fusa_AVHFailSts "" UBYTE autosar_swc_val_CM_boolean 0 0 0 1 ECU_ADDRESS 0xfe4ccaae /* @ECU_Address@SwcIn_Fusa_CAN_Value.Fusa_AVHFailSts@ */ /end MEASUREMENT
/begin MEASUREMENT SwcIn_Fusa_CAN_Value.Fusa_BrakesystemFailSts "" UBYTE autosar_swc_val_CM_boolean 0 0 0 1 ECU_ADDRESS 0xfe4ccab7 /* @ECU_Address@SwcIn_Fusa_CAN_Value.Fusa_BrakesystemFailSts@ */ /end MEASUREMENT
/begin MEASUREMENT SwcIn_Fusa_CAN_Value.Fusa_CSA_2_AllWarningInfo "" UBYTE autosar_swc_val_CM_uint8 0 0 0 255 ECU_ADDRESS 0xfe4ccad6 /* @ECU_Address@SwcIn_Fusa_CAN_Value.Fusa_CSA_2_AllWarningInfo@ */ /end MEASUREMENT
/begin MEASUREMENT SwcIn_Fusa_CAN_Value.Fusa_CSA_2_TurnSigLvrCmd "" UBYTE autosar_swc_val_CM_uint8 0 0 0 255 ECU_ADDRESS 0xfe4ccad7 /* @ECU_Address@SwcIn_Fusa_CAN_Value.Fusa_CSA_2_TurnSigLvrCmd@ */ /end MEASUREMENT
/begin MEASUREMENT SwcIn_Fusa_CAN_Value.Fusa_DCFail "" UBYTE autosar_swc_val_CM_boolean 0 0 0 1 ECU_ADDRESS 0xfe4ccaaf /* @ECU_Address@SwcIn_Fusa_CAN_Value.Fusa_DCFail@ */ /end MEASUREMENT
/begin MEASUREMENT SwcIn_Fusa_CAN_Value.Fusa_EPB_1_ActrSt "" UBYTE autosar_swc_val_CM_uint8 0 0 0 255 ECU_ADDRESS 0xfe4ccac8 /* @ECU_Address@SwcIn_Fusa_CAN_Value.Fusa_EPB_1_ActrSt@ */ /end MEASUREMENT
/begin MEASUREMENT SwcIn_Fusa_CAN_Value.Fusa_EPB_1_EPBAvlSt "" UBYTE autosar_swc_val_CM_boolean 0 0 0 1 ECU_ADDRESS 0xfe4cca9d /* @ECU_Address@SwcIn_Fusa_CAN_Value.Fusa_EPB_1_EPBAvlSt@ */ /end MEASUREMENT
/begin MEASUREMENT SwcIn_Fusa_CAN_Value.Fusa_EPB_1_FltLvl "" UBYTE autosar_swc_val_CM_uint8 0 0 0 255 ECU_ADDRESS 0xfe4ccac9 /* @ECU_Address@SwcIn_Fusa_CAN_Value.Fusa_EPB_1_FltLvl@ */ /end MEASUREMENT
/begin MEASUREMENT SwcIn_Fusa_CAN_Value.Fusa_EPB_R_1_EPB_R_1Avl_St "" UBYTE autosar_swc_val_CM_boolean 0 0 0 1 ECU_ADDRESS 0xfe4cca9e /* @ECU_Address@SwcIn_Fusa_CAN_Value.Fusa_EPB_R_1_EPB_R_1Avl_St@ */ /end MEASUREMENT
/begin MEASUREMENT SwcIn_Fusa_CAN_Value.Fusa_EPB_R_1_FltLvl "" UBYTE autosar_swc_val_CM_boolean 0 0 0 1 ECU_ADDRESS 0xfe4cca9f /* @ECU_Address@SwcIn_Fusa_CAN_Value.Fusa_EPB_R_1_FltLvl@ */ /end MEASUREMENT
/begin MEASUREMENT SwcIn_Fusa_CAN_Value.Fusa_EPB_R_1_Flt_Lamp "" UBYTE autosar_swc_val_CM_uint8 0 0 0 255 ECU_ADDRESS 0xfe4ccaca /* @ECU_Address@SwcIn_Fusa_CAN_Value.Fusa_EPB_R_1_Flt_Lamp@ */ /end MEASUREMENT
/begin MEASUREMENT SwcIn_Fusa_CAN_Value.Fusa_EPSFailSts "" UBYTE autosar_swc_val_CM_uint8 0 0 0 255 ECU_ADDRESS 0xfe4ccacb /* @ECU_Address@SwcIn_Fusa_CAN_Value.Fusa_EPSFailSts@ */ /end MEASUREMENT
/begin MEASUREMENT SwcIn_Fusa_CAN_Value.Fusa_EPS_4_AgPilotCtrlAvl "" UBYTE autosar_swc_val_CM_uint8 0 0 0 255 ECU_ADDRESS 0xfe4ccacc /* @ECU_Address@SwcIn_Fusa_CAN_Value.Fusa_EPS_4_AgPilotCtrlAvl@ */ /end MEASUREMENT
/begin MEASUREMENT SwcIn_Fusa_CAN_Value.Fusa_EPS_4_AgPilotCtrlSts "" UBYTE autosar_swc_val_CM_uint8 0 0 0 255 ECU_ADDRESS 0xfe4ccacd /* @ECU_Address@SwcIn_Fusa_CAN_Value.Fusa_EPS_4_AgPilotCtrlSts@ */ /end MEASUREMENT
/begin MEASUREMENT SwcIn_Fusa_CAN_Value.Fusa_EPS_4_SteerDrvrOvrd "" UBYTE autosar_swc_val_CM_boolean 0 0 0 1 ECU_ADDRESS 0xfe4ccaa3 /* @ECU_Address@SwcIn_Fusa_CAN_Value.Fusa_EPS_4_SteerDrvrOvrd@ */ /end MEASUREMENT
/begin MEASUREMENT SwcIn_Fusa_CAN_Value.Fusa_EPS_4_SteerDrvrOvrdVld "" UBYTE autosar_swc_val_CM_boolean 0 0 0 1 ECU_ADDRESS 0xfe4ccaa4 /* @ECU_Address@SwcIn_Fusa_CAN_Value.Fusa_EPS_4_SteerDrvrOvrdVld@ */ /end MEASUREMENT
/begin MEASUREMENT SwcIn_Fusa_CAN_Value.Fusa_EPS_4_SteerPinionTqVld "" UBYTE autosar_swc_val_CM_boolean 0 0 0 1 ECU_ADDRESS 0xfe4ccaa2 /* @ECU_Address@SwcIn_Fusa_CAN_Value.Fusa_EPS_4_SteerPinionTqVld@ */ /end MEASUREMENT
/begin MEASUREMENT SwcIn_Fusa_CAN_Value.Fusa_ESP1_VehicleSpeedVSOSigValidData "" UBYTE autosar_swc_val_CM_boolean 0 0 0 1 ECU_ADDRESS 0xfe4ccaa7 /* @ECU_Address@SwcIn_Fusa_CAN_Value.Fusa_ESP1_VehicleSpeedVSOSigValidData@ */ /end MEASUREMENT
/begin MEASUREMENT SwcIn_Fusa_CAN_Value.Fusa_FLZCU_9_PowerMode "" UBYTE autosar_swc_val_CM_uint8 0 0 0 255 ECU_ADDRESS 0xfe4ccad9 /* @ECU_Address@SwcIn_Fusa_CAN_Value.Fusa_FLZCU_9_PowerMode@ */ /end MEASUREMENT
/begin MEASUREMENT SwcIn_Fusa_CAN_Value.Fusa_FL_SeatBeltFaultStatus "" UBYTE autosar_swc_val_CM_boolean 0 0 0 1 ECU_ADDRESS 0xfe4ccac1 /* @ECU_Address@SwcIn_Fusa_CAN_Value.Fusa_FL_SeatBeltFaultStatus@ */ /end MEASUREMENT
/begin MEASUREMENT SwcIn_Fusa_CAN_Value.Fusa_IPB_InputRodStroke "" FLOAT32_IEEE autosar_swc_val_CM_single 0 0 -3.4E+38 3.4E+38 ECU_ADDRESS 0xfe4ccb04 /* @ECU_Address@SwcIn_Fusa_CAN_Value.Fusa_IPB_InputRodStroke@ */ /end MEASUREMENT
/begin MEASUREMENT SwcIn_Fusa_CAN_Value.Fusa_IPB_InputRodStrokeStatus "" UBYTE autosar_swc_val_CM_boolean 0 0 0 1 ECU_ADDRESS 0xfe4ccab1 /* @ECU_Address@SwcIn_Fusa_CAN_Value.Fusa_IPB_InputRodStrokeStatus@ */ /end MEASUREMENT
/begin MEASUREMENT SwcIn_Fusa_CAN_Value.Fusa_IPB_PlungerPressure "" FLOAT32_IEEE autosar_swc_val_CM_single 0 0 -3.4E+38 3.4E+38 ECU_ADDRESS 0xfe4ccb00 /* @ECU_Address@SwcIn_Fusa_CAN_Value.Fusa_IPB_PlungerPressure@ */ /end MEASUREMENT
/begin MEASUREMENT SwcIn_Fusa_CAN_Value.Fusa_IPB_PlungerPressureValidData "" UBYTE autosar_swc_val_CM_boolean 0 0 0 1 ECU_ADDRESS 0xfe4ccab0 /* @ECU_Address@SwcIn_Fusa_CAN_Value.Fusa_IPB_PlungerPressureValidData@ */ /end MEASUREMENT
/begin MEASUREMENT SwcIn_Fusa_CAN_Value.Fusa_LHFSeatBeltSW "" UBYTE autosar_swc_val_CM_boolean 0 0 0 1 ECU_ADDRESS 0xfe4ccac0 /* @ECU_Address@SwcIn_Fusa_CAN_Value.Fusa_LHFSeatBeltSW@ */ /end MEASUREMENT
/begin MEASUREMENT SwcIn_Fusa_CAN_Value.Fusa_LHFWheelDriveDirection "" UBYTE autosar_swc_val_CM_uint8 0 0 0 255 ECU_ADDRESS 0xfe4ccacf /* @ECU_Address@SwcIn_Fusa_CAN_Value.Fusa_LHFWheelDriveDirection@ */ /end MEASUREMENT
/begin MEASUREMENT SwcIn_Fusa_CAN_Value.Fusa_LHFWheelSpeedRawValidData "" UBYTE autosar_swc_val_CM_boolean 0 0 0 1 ECU_ADDRESS 0xfe4ccab2 /* @ECU_Address@SwcIn_Fusa_CAN_Value.Fusa_LHFWheelSpeedRawValidData@ */ /end MEASUREMENT
/begin MEASUREMENT SwcIn_Fusa_CAN_Value.Fusa_LHFdoorSts "" UBYTE autosar_swc_val_CM_uint8 0 0 0 255 ECU_ADDRESS 0xfe4ccad8 /* @ECU_Address@SwcIn_Fusa_CAN_Value.Fusa_LHFdoorSts@ */ /end MEASUREMENT
/begin MEASUREMENT SwcIn_Fusa_CAN_Value.Fusa_LHRWheelDriveDirection "" UBYTE autosar_swc_val_CM_uint8 0 0 0 255 ECU_ADDRESS 0xfe4ccad1 /* @ECU_Address@SwcIn_Fusa_CAN_Value.Fusa_LHRWheelDriveDirection@ */ /end MEASUREMENT
/begin MEASUREMENT SwcIn_Fusa_CAN_Value.Fusa_LHRWheelSpeedRawValidData "" UBYTE autosar_swc_val_CM_boolean 0 0 0 1 ECU_ADDRESS 0xfe4ccab4 /* @ECU_Address@SwcIn_Fusa_CAN_Value.Fusa_LHRWheelSpeedRawValidData@ */ /end MEASUREMENT
/begin MEASUREMENT SwcIn_Fusa_CAN_Value.Fusa_LHRdoorSts "" UBYTE autosar_swc_val_CM_uint8 0 0 0 255 ECU_ADDRESS 0xfe4ccade /* @ECU_Address@SwcIn_Fusa_CAN_Value.Fusa_LHRdoorSts@ */ /end MEASUREMENT
/begin MEASUREMENT SwcIn_Fusa_CAN_Value.Fusa_MFS_LeftRoller "" UBYTE autosar_swc_val_CM_uint8 0 0 0 255 ECU_ADDRESS 0xfe4ccada /* @ECU_Address@SwcIn_Fusa_CAN_Value.Fusa_MFS_LeftRoller@ */ /end MEASUREMENT
/begin MEASUREMENT SwcIn_Fusa_CAN_Value.Fusa_MFS_Rsp_Error "" UBYTE autosar_swc_val_CM_boolean 0 0 0 1 ECU_ADDRESS 0xfe4ccac2 /* @ECU_Address@SwcIn_Fusa_CAN_Value.Fusa_MFS_Rsp_Error@ */ /end MEASUREMENT
/begin MEASUREMENT SwcIn_Fusa_CAN_Value.Fusa_ONEBOX_5_PilotParkBrkDecCtlAvl "" UBYTE autosar_swc_val_CM_boolean 0 0 0 1 ECU_ADDRESS 0xfe4ccab6 /* @ECU_Address@SwcIn_Fusa_CAN_Value.Fusa_ONEBOX_5_PilotParkBrkDecCtlAvl@ */ /end MEASUREMENT
/begin MEASUREMENT SwcIn_Fusa_CAN_Value.Fusa_RHFDoorSts "" UBYTE autosar_swc_val_CM_uint8 0 0 0 255 ECU_ADDRESS 0xfe4ccadb /* @ECU_Address@SwcIn_Fusa_CAN_Value.Fusa_RHFDoorSts@ */ /end MEASUREMENT
/begin MEASUREMENT SwcIn_Fusa_CAN_Value.Fusa_RHFWheelDriveDirection "" UBYTE autosar_swc_val_CM_uint8 0 0 0 255 ECU_ADDRESS 0xfe4ccad0 /* @ECU_Address@SwcIn_Fusa_CAN_Value.Fusa_RHFWheelDriveDirection@ */ /end MEASUREMENT
/begin MEASUREMENT SwcIn_Fusa_CAN_Value.Fusa_RHFWheelSpeedRawValidData "" UBYTE autosar_swc_val_CM_boolean 0 0 0 1 ECU_ADDRESS 0xfe4ccab3 /* @ECU_Address@SwcIn_Fusa_CAN_Value.Fusa_RHFWheelSpeedRawValidData@ */ /end MEASUREMENT
/begin MEASUREMENT SwcIn_Fusa_CAN_Value.Fusa_RHRDoorSts "" UBYTE autosar_swc_val_CM_uint8 0 0 0 255 ECU_ADDRESS 0xfe4ccadc /* @ECU_Address@SwcIn_Fusa_CAN_Value.Fusa_RHRDoorSts@ */ /end MEASUREMENT
/begin MEASUREMENT SwcIn_Fusa_CAN_Value.Fusa_RHRWheelDriveDirection "" UBYTE autosar_swc_val_CM_uint8 0 0 0 255 ECU_ADDRESS 0xfe4ccad2 /* @ECU_Address@SwcIn_Fusa_CAN_Value.Fusa_RHRWheelDriveDirection@ */ /end MEASUREMENT
/begin MEASUREMENT SwcIn_Fusa_CAN_Value.Fusa_RHRWheelSpeedRawValidData "" UBYTE autosar_swc_val_CM_boolean 0 0 0 1 ECU_ADDRESS 0xfe4ccab5 /* @ECU_Address@SwcIn_Fusa_CAN_Value.Fusa_RHRWheelSpeedRawValidData@ */ /end MEASUREMENT
/begin MEASUREMENT SwcIn_Fusa_CAN_Value.Fusa_RLCR_1_SysSt "" UBYTE autosar_swc_val_CM_uint8 0 0 0 255 ECU_ADDRESS 0xfe4ccae0 /* @ECU_Address@SwcIn_Fusa_CAN_Value.Fusa_RLCR_1_SysSt@ */ /end MEASUREMENT
/begin MEASUREMENT SwcIn_Fusa_CAN_Value.Fusa_RRCR_1_SysSt "" UBYTE autosar_swc_val_CM_uint8 0 0 0 255 ECU_ADDRESS 0xfe4ccadf /* @ECU_Address@SwcIn_Fusa_CAN_Value.Fusa_RRCR_1_SysSt@ */ /end MEASUREMENT
/begin MEASUREMENT SwcIn_Fusa_CAN_Value.Fusa_SAM_1_SteeringAngle "" FLOAT32_IEEE autosar_swc_val_CM_single 0 0 -3.4E+38 3.4E+38 ECU_ADDRESS 0xfe4ccaf4 /* @ECU_Address@SwcIn_Fusa_CAN_Value.Fusa_SAM_1_SteeringAngle@ */ /end MEASUREMENT
/begin MEASUREMENT SwcIn_Fusa_CAN_Value.Fusa_SAM_1_SteeringAngleSpeed "" FLOAT32_IEEE autosar_swc_val_CM_single 0 0 -3.4E+38 3.4E+38 ECU_ADDRESS 0xfe4ccaf8 /* @ECU_Address@SwcIn_Fusa_CAN_Value.Fusa_SAM_1_SteeringAngleSpeed@ */ /end MEASUREMENT
/begin MEASUREMENT SwcIn_Fusa_CAN_Value.Fusa_SAM_1_SteeringAngleSpeedVD "" UBYTE autosar_swc_val_CM_boolean 0 0 0 1 ECU_ADDRESS 0xfe4ccaa6 /* @ECU_Address@SwcIn_Fusa_CAN_Value.Fusa_SAM_1_SteeringAngleSpeedVD@ */ /end MEASUREMENT
/begin MEASUREMENT SwcIn_Fusa_CAN_Value.Fusa_SAM_1_SteeringAngleVD "" UBYTE autosar_swc_val_CM_boolean 0 0 0 1 ECU_ADDRESS 0xfe4ccaa5 /* @ECU_Address@SwcIn_Fusa_CAN_Value.Fusa_SAM_1_SteeringAngleVD@ */ /end MEASUREMENT
/begin MEASUREMENT SwcIn_Fusa_CAN_Value.Fusa_STAT_ShifterLeverFault "" UBYTE autosar_swc_val_CM_uint8 0 0 0 255 ECU_ADDRESS 0xfe4ccad5 /* @ECU_Address@SwcIn_Fusa_CAN_Value.Fusa_STAT_ShifterLeverFault@ */ /end MEASUREMENT
/begin MEASUREMENT SwcIn_Fusa_CAN_Value.Fusa_TirePressureSystemFailSts "" UBYTE autosar_swc_val_CM_boolean 0 0 0 1 ECU_ADDRESS 0xfe4ccac3 /* @ECU_Address@SwcIn_Fusa_CAN_Value.Fusa_TirePressureSystemFailSts@ */ /end MEASUREMENT
/begin MEASUREMENT SwcIn_Fusa_CAN_Value.Fusa_TirePressureWarningLampSts "" UBYTE autosar_swc_val_CM_uint8 0 0 0 255 ECU_ADDRESS 0xfe4ccadd /* @ECU_Address@SwcIn_Fusa_CAN_Value.Fusa_TirePressureWarningLampSts@ */ /end MEASUREMENT
/begin MEASUREMENT SwcIn_Fusa_CAN_Value.Fusa_TorsionBarTorque "" FLOAT32_IEEE autosar_swc_val_CM_single 0 0 -3.4E+38 3.4E+38 ECU_ADDRESS 0xfe4ccaf0 /* @ECU_Address@SwcIn_Fusa_CAN_Value.Fusa_TorsionBarTorque@ */ /end MEASUREMENT
/begin MEASUREMENT SwcIn_Fusa_CAN_Value.Fusa_TorsionBarTorqueDir "" UBYTE autosar_swc_val_CM_boolean 0 0 0 1 ECU_ADDRESS 0xfe4ccaa0 /* @ECU_Address@SwcIn_Fusa_CAN_Value.Fusa_TorsionBarTorqueDir@ */ /end MEASUREMENT
/begin MEASUREMENT SwcIn_Fusa_CAN_Value.Fusa_TosionBarTorqueValid "" UBYTE autosar_swc_val_CM_boolean 0 0 0 1 ECU_ADDRESS 0xfe4ccaa1 /* @ECU_Address@SwcIn_Fusa_CAN_Value.Fusa_TosionBarTorqueValid@ */ /end MEASUREMENT
/begin MEASUREMENT SwcIn_Fusa_CAN_Value.Fusa_VCU_12_PtTqActvSts "" UBYTE autosar_swc_val_CM_boolean 0 0 0 1 ECU_ADDRESS 0xfe4ccabf /* @ECU_Address@SwcIn_Fusa_CAN_Value.Fusa_VCU_12_PtTqActvSts@ */ /end MEASUREMENT
/begin MEASUREMENT SwcIn_Fusa_CAN_Value.Fusa_VCU_12_PtTqAvl "" UBYTE autosar_swc_val_CM_uint8 0 0 0 255 ECU_ADDRESS 0xfe4ccad4 /* @ECU_Address@SwcIn_Fusa_CAN_Value.Fusa_VCU_12_PtTqAvl@ */ /end MEASUREMENT
/begin MEASUREMENT SwcIn_Fusa_CAN_Value.Fusa_VCU_AcceleratorPosRaw "" FLOAT32_IEEE autosar_swc_val_CM_single 0 0 -3.4E+38 3.4E+38 ECU_ADDRESS 0xfe4ccb0c /* @ECU_Address@SwcIn_Fusa_CAN_Value.Fusa_VCU_AcceleratorPosRaw@ */ /end MEASUREMENT
/begin MEASUREMENT SwcIn_Fusa_CAN_Value.Fusa_VCU_AcceleratorPosRawIVD "" UBYTE autosar_swc_val_CM_boolean 0 0 0 1 ECU_ADDRESS 0xfe4ccabe /* @ECU_Address@SwcIn_Fusa_CAN_Value.Fusa_VCU_AcceleratorPosRawIVD@ */ /end MEASUREMENT
/begin MEASUREMENT SwcIn_Fusa_CAN_Value.Fusa_VCU_ActualGear "" UBYTE autosar_swc_val_CM_uint8 0 0 0 255 ECU_ADDRESS 0xfe4ccad3 /* @ECU_Address@SwcIn_Fusa_CAN_Value.Fusa_VCU_ActualGear@ */ /end MEASUREMENT
/begin MEASUREMENT SwcIn_Fusa_CAN_Value.Fusa_VCU_ActualGearValidData "" UBYTE autosar_swc_val_CM_boolean 0 0 0 1 ECU_ADDRESS 0xfe4ccaba /* @ECU_Address@SwcIn_Fusa_CAN_Value.Fusa_VCU_ActualGearValidData@ */ /end MEASUREMENT
/begin MEASUREMENT SwcIn_Fusa_CAN_Value.Fusa_VCU_BrakePedalSts "" UBYTE autosar_swc_val_CM_boolean 0 0 0 1 ECU_ADDRESS 0xfe4ccabc /* @ECU_Address@SwcIn_Fusa_CAN_Value.Fusa_VCU_BrakePedalSts@ */ /end MEASUREMENT
/begin MEASUREMENT SwcIn_Fusa_CAN_Value.Fusa_VCU_BrakePedalStsValidData "" UBYTE autosar_swc_val_CM_boolean 0 0 0 1 ECU_ADDRESS 0xfe4ccabb /* @ECU_Address@SwcIn_Fusa_CAN_Value.Fusa_VCU_BrakePedalStsValidData@ */ /end MEASUREMENT
/begin MEASUREMENT SwcIn_Fusa_CAN_Value.Fusa_VCU_GasPedalPosition "" FLOAT32_IEEE autosar_swc_val_CM_single 0 0 -3.4E+38 3.4E+38 ECU_ADDRESS 0xfe4ccb08 /* @ECU_Address@SwcIn_Fusa_CAN_Value.Fusa_VCU_GasPedalPosition@ */ /end MEASUREMENT
/begin MEASUREMENT SwcIn_Fusa_CAN_Value.Fusa_VCU_GasPedalPositionInvalidData "" UBYTE autosar_swc_val_CM_boolean 0 0 0 1 ECU_ADDRESS 0xfe4ccab8 /* @ECU_Address@SwcIn_Fusa_CAN_Value.Fusa_VCU_GasPedalPositionInvalidData@ */ /end MEASUREMENT
/begin MEASUREMENT SwcIn_Fusa_CAN_Value.Fusa_VCU_HVReady "" UBYTE autosar_swc_val_CM_boolean 0 0 0 1 ECU_ADDRESS 0xfe4ccab9 /* @ECU_Address@SwcIn_Fusa_CAN_Value.Fusa_VCU_HVReady@ */ /end MEASUREMENT
/begin MEASUREMENT SwcIn_Fusa_CAN_Value.Fusa_VCU_ONEBOX_GasPedalPositionInvalidData "" UBYTE autosar_swc_val_CM_boolean 0 0 0 1 ECU_ADDRESS 0xfe4ccabd /* @ECU_Address@SwcIn_Fusa_CAN_Value.Fusa_VCU_ONEBOX_GasPedalPositionInvalidData@ */ /end MEASUREMENT
/begin MEASUREMENT SwcIn_Fusa_CAN_Value.Fusa_VehicleStandstill "" UBYTE autosar_swc_val_CM_uint8 0 0 0 255 ECU_ADDRESS 0xfe4ccace /* @ECU_Address@SwcIn_Fusa_CAN_Value.Fusa_VehicleStandstill@ */ /end MEASUREMENT
/begin MEASUREMENT SwcIn_Fusa_ErrID.Fusa_Cam_1_Module "" ULONG autosar_swc_val_CM_uint32 0 0 0 4294967295 ECU_ADDRESS 0xfe4ccb18 /* @ECU_Address@SwcIn_Fusa_ErrID.Fusa_Cam_1_Module@ */ /end MEASUREMENT
/begin MEASUREMENT SwcIn_Fusa_ErrID.Fusa_Cam_1_Ser "" ULONG autosar_swc_val_CM_uint32 0 0 0 4294967295 ECU_ADDRESS 0xfe4ccb1c /* @ECU_Address@SwcIn_Fusa_ErrID.Fusa_Cam_1_Ser@ */ /end MEASUREMENT
/begin MEASUREMENT SwcIn_Fusa_ErrID.Fusa_J3_Err1 "" ULONG autosar_swc_val_CM_uint32 0 0 0 4294967295 ECU_ADDRESS 0xfe4ccb20 /* @ECU_Address@SwcIn_Fusa_ErrID.Fusa_J3_Err1@ */ /end MEASUREMENT
/begin MEASUREMENT SwcIn_Fusa_ErrID.Fusa_J3_Err2 "" ULONG autosar_swc_val_CM_uint32 0 0 0 4294967295 ECU_ADDRESS 0xfe4ccb24 /* @ECU_Address@SwcIn_Fusa_ErrID.Fusa_J3_Err2@ */ /end MEASUREMENT
/begin MEASUREMENT SwcIn_Fusa_ErrID.Fusa_J3_Err3 "" ULONG autosar_swc_val_CM_uint32 0 0 0 4294967295 ECU_ADDRESS 0xfe4ccb28 /* @ECU_Address@SwcIn_Fusa_ErrID.Fusa_J3_Err3@ */ /end MEASUREMENT
/begin MEASUREMENT SwcIn_Fusa_ErrID.Fusa_Mcu_U2A16 "" UBYTE autosar_swc_val_CM_uint8 0 0 0 255 ECU_ADDRESS 0xfe4ccb12 /* @ECU_Address@SwcIn_Fusa_ErrID.Fusa_Mcu_U2A16@ */ /end MEASUREMENT
/begin MEASUREMENT SwcIn_Fusa_ErrID.Fusa_Sbc_TLF35584 "" UBYTE autosar_swc_val_CM_uint8 0 0 0 255 ECU_ADDRESS 0xfe4ccb13 /* @ECU_Address@SwcIn_Fusa_ErrID.Fusa_Sbc_TLF35584@ */ /end MEASUREMENT
/begin MEASUREMENT SwcIn_Fusa_ErrID.Fusa_SerDes_MAX96716 "" UWORD autosar_swc_val_CM_uint16 0 0 0 65535 ECU_ADDRESS 0xfe4ccb14 /* @ECU_Address@SwcIn_Fusa_ErrID.Fusa_SerDes_MAX96716@ */ /end MEASUREMENT
/begin MEASUREMENT SwcIn_Fusa_ErrID.Fusa_SerDes_MAX96717_1 "" UBYTE autosar_swc_val_CM_uint8 0 0 0 255 ECU_ADDRESS 0xfe4ccb10 /* @ECU_Address@SwcIn_Fusa_ErrID.Fusa_SerDes_MAX96717_1@ */ /end MEASUREMENT
/begin MEASUREMENT SwcIn_Fusa_ErrID.Fusa_SerDes_MAX96717_2 "" UBYTE autosar_swc_val_CM_uint8 0 0 0 255 ECU_ADDRESS 0xfe4ccb11 /* @ECU_Address@SwcIn_Fusa_ErrID.Fusa_SerDes_MAX96717_2@ */ /end MEASUREMENT
/begin MEASUREMENT SwcIn_Fusa_ErrID.Fusa_SerDes_MAX96722 "" UWORD autosar_swc_val_CM_uint16 0 0 0 65535 ECU_ADDRESS 0xfe4ccb16 /* @ECU_Address@SwcIn_Fusa_ErrID.Fusa_SerDes_MAX96722@ */ /end MEASUREMENT
/begin MEASUREMENT SwcIn_ICC_BD_11.ICC_BD_11_CRC "" UBYTE autosar_swc_val_CM_ICC_BD_11_CRC_1150_dt 0 0 0 255 ECU_ADDRESS 0xfe4cce61 /* @ECU_Address@SwcIn_ICC_BD_11.ICC_BD_11_CRC@ */ /end MEASUREMENT
/begin MEASUREMENT SwcIn_ICC_BD_11.ICC_BD_11_RollgCntr "" UBYTE autosar_swc_val_CM_ICC_BD_11_RollgCntr_1150_dt 0 0 0 255 ECU_ADDRESS 0xfe4cce62 /* @ECU_Address@SwcIn_ICC_BD_11.ICC_BD_11_RollgCntr@ */ /end MEASUREMENT
/begin MEASUREMENT SwcIn_ICC_BD_11.ICC_DriveDrosinessLevel "" UBYTE autosar_swc_val_CM_ICC_DriveDrosinessLevel_1150_dt 0 0 0 255 ECU_ADDRESS 0xfe4cce63 /* @ECU_Address@SwcIn_ICC_BD_11.ICC_DriveDrosinessLevel@ */ /end MEASUREMENT
/begin MEASUREMENT SwcIn_ICC_COM_1.DisplayVehicleSpeed "" FLOAT32_IEEE autosar_swc_val_CM_DisplayVehicleSpeed_1252_dt 0 0 -3.4E+38 3.4E+38 ECU_ADDRESS 0xfe4ca4cc /* @ECU_Address@SwcIn_ICC_COM_1.DisplayVehicleSpeed@ */ /end MEASUREMENT
/begin MEASUREMENT SwcIn_ICC_COM_1.TotalOdometer_km_OBD "" FLOAT32_IEEE autosar_swc_val_CM_TotalOdometer_km_OBD_1252_dt 0 0 -3.4E+38 3.4E+38 ECU_ADDRESS 0xfe4ca4c8 /* @ECU_Address@SwcIn_ICC_COM_1.TotalOdometer_km_OBD@ */ /end MEASUREMENT
/begin MEASUREMENT SwcIn_ICC_COM_8.CurrentTimeDay "" UBYTE autosar_swc_val_CM_CurrentTimeDay_1296_dt 0 0 0 255 ECU_ADDRESS 0xfe4ca4d3 /* @ECU_Address@SwcIn_ICC_COM_8.CurrentTimeDay@ */ /end MEASUREMENT
/begin MEASUREMENT SwcIn_ICC_COM_8.CurrentTimeHour "" UBYTE autosar_swc_val_CM_CurrentTimeHour_1296_dt 0 0 0 255 ECU_ADDRESS 0xfe4ca4d4 /* @ECU_Address@SwcIn_ICC_COM_8.CurrentTimeHour@ */ /end MEASUREMENT
/begin MEASUREMENT SwcIn_ICC_COM_8.CurrentTimeMinute "" UBYTE autosar_swc_val_CM_CurrentTimeMinute_1296_dt 0 0 0 255 ECU_ADDRESS 0xfe4ca4d5 /* @ECU_Address@SwcIn_ICC_COM_8.CurrentTimeMinute@ */ /end MEASUREMENT
/begin MEASUREMENT SwcIn_ICC_COM_8.CurrentTimeMonth "" UBYTE autosar_swc_val_CM_CurrentTimeMonth_1296_dt 0 0 0 255 ECU_ADDRESS 0xfe4ca4d2 /* @ECU_Address@SwcIn_ICC_COM_8.CurrentTimeMonth@ */ /end MEASUREMENT
/begin MEASUREMENT SwcIn_ICC_COM_8.CurrentTimeSecond "" UBYTE autosar_swc_val_CM_CurrentTimeSecond_1296_dt 0 0 0 255 ECU_ADDRESS 0xfe4ca4d6 /* @ECU_Address@SwcIn_ICC_COM_8.CurrentTimeSecond@ */ /end MEASUREMENT
/begin MEASUREMENT SwcIn_ICC_COM_8.CurrentTimeYear "" UWORD autosar_swc_val_CM_CurrentTimeYear_1296_dt 0 0 0 65535 ECU_ADDRESS 0xfe4ca4d0 /* @ECU_Address@SwcIn_ICC_COM_8.CurrentTimeYear@ */ /end MEASUREMENT
/begin MEASUREMENT SwcIn_ICC_DA_15.Dms_DriverPresence "" UBYTE autosar_swc_val_CM_Dms_DriverPresence_1157_dt 0 0 0 255 ECU_ADDRESS 0xfe4cce6c /* @ECU_Address@SwcIn_ICC_DA_15.Dms_DriverPresence@ */ /end MEASUREMENT
/begin MEASUREMENT SwcIn_ICC_DA_15.Dms_Status "" UBYTE autosar_swc_val_CM_Dms_Status_1157_dt 0 0 0 255 ECU_ADDRESS 0xfe4cce69 /* @ECU_Address@SwcIn_ICC_DA_15.Dms_Status@ */ /end MEASUREMENT
/begin MEASUREMENT SwcIn_ICC_DA_15.Driver_AbnormalBehavior "" UBYTE autosar_swc_val_CM_Driver_AbnormalBehavior_1157_dt 0 0 0 255 ECU_ADDRESS 0xfe4cce6a /* @ECU_Address@SwcIn_ICC_DA_15.Driver_AbnormalBehavior@ */ /end MEASUREMENT
/begin MEASUREMENT SwcIn_ICC_DA_15.Driver_EyeOnRoad "" UBYTE autosar_swc_val_CM_Driver_EyeOnRoad_1157_dt 0 0 0 255 ECU_ADDRESS 0xfe4cce68 /* @ECU_Address@SwcIn_ICC_DA_15.Driver_EyeOnRoad@ */ /end MEASUREMENT
/begin MEASUREMENT SwcIn_ICC_DA_15.Driver_GazeRegion "" UBYTE autosar_swc_val_CM_Driver_GazeRegion_1157_dt 0 0 0 255 ECU_ADDRESS 0xfe4cce6b /* @ECU_Address@SwcIn_ICC_DA_15.Driver_GazeRegion@ */ /end MEASUREMENT
/begin MEASUREMENT SwcIn_ICC_DA_15.ICC_DA_15_CRC "" UBYTE autosar_swc_val_CM_ICC_DA_15_CRC_1157_dt 0 0 0 255 ECU_ADDRESS 0xfe4cce64 /* @ECU_Address@SwcIn_ICC_DA_15.ICC_DA_15_CRC@ */ /end MEASUREMENT
/begin MEASUREMENT SwcIn_ICC_DA_15.ICC_DA_15_ExtremeEnergySaveMode "" UBYTE autosar_swc_val_CM_ICC_DA_15_ExtremeEnergySaveMode_1157_dt 0 0 0 255 ECU_ADDRESS 0xfe4cce67 /* @ECU_Address@SwcIn_ICC_DA_15.ICC_DA_15_ExtremeEnergySaveMode@ */ /end MEASUREMENT
/begin MEASUREMENT SwcIn_ICC_DA_15.ICC_DA_15_Resd "" UBYTE autosar_swc_val_CM_ICC_DA_15_Resd_1157_dt 0 0 0 255 ECU_ADDRESS 0xfe4cce66 /* @ECU_Address@SwcIn_ICC_DA_15.ICC_DA_15_Resd@ */ /end MEASUREMENT
/begin MEASUREMENT SwcIn_ICC_DA_15.ICC_DA_15_RollgCntr "" UBYTE autosar_swc_val_CM_ICC_DA_15_RollgCntr_1157_dt 0 0 0 255 ECU_ADDRESS 0xfe4cce65 /* @ECU_Address@SwcIn_ICC_DA_15.ICC_DA_15_RollgCntr@ */ /end MEASUREMENT
/begin MEASUREMENT SwcIn_ICC_DA_15.ICC_DistractionStatus "" UBYTE autosar_swc_val_CM_ICC_DistractionStatus_1157_dt 0 0 0 255 ECU_ADDRESS 0xfe4cce6e /* @ECU_Address@SwcIn_ICC_DA_15.ICC_DistractionStatus@ */ /end MEASUREMENT
/begin MEASUREMENT SwcIn_ICC_DA_15.ICC_IHCfunctionSw "" UBYTE autosar_swc_val_CM_ICC_IHCfunctionSw_1157_dt 0 0 0 255 ECU_ADDRESS 0xfe4cce6d /* @ECU_Address@SwcIn_ICC_DA_15.ICC_IHCfunctionSw@ */ /end MEASUREMENT
/begin MEASUREMENT SwcIn_J3_LANE.Crosswalk.border[0].point_x "" FLOAT64_IEEE autosar_swc_val_CM_double 0 0 -1.7E+308 1.7E+308 ECU_ADDRESS 0xfe4ca548 /* @ECU_Address@SwcIn_J3_LANE.Crosswalk.border[0].point_x@ */ /end MEASUREMENT
/begin MEASUREMENT SwcIn_J3_LANE.Crosswalk.border[0].point_y "" FLOAT64_IEEE autosar_swc_val_CM_double 0 0 -1.7E+308 1.7E+308 ECU_ADDRESS 0xfe4ca550 /* @ECU_Address@SwcIn_J3_LANE.Crosswalk.border[0].point_y@ */ /end MEASUREMENT
/begin MEASUREMENT SwcIn_J3_LANE.Crosswalk.conf "" SLONG autosar_swc_val_CM_int32 0 0 -2147483648 2147483647 ECU_ADDRESS 0xfe4ca52c /* @ECU_Address@SwcIn_J3_LANE.Crosswalk.conf@ */ /end MEASUREMENT
/begin MEASUREMENT SwcIn_J3_LANE.Crosswalk.id "" SLONG autosar_swc_val_CM_int32 0 0 -2147483648 2147483647 ECU_ADDRESS 0xfe4ca528 /* @ECU_Address@SwcIn_J3_LANE.Crosswalk.id@ */ /end MEASUREMENT
/begin MEASUREMENT SwcIn_J3_LANE.Crosswalk.life_time "" SLONG autosar_swc_val_CM_int32 0 0 -2147483648 2147483647 ECU_ADDRESS 0xfe4ca530 /* @ECU_Address@SwcIn_J3_LANE.Crosswalk.life_time@ */ /end MEASUREMENT
/begin MEASUREMENT SwcIn_J3_LANE.Crosswalk.position.point_x "" FLOAT64_IEEE autosar_swc_val_CM_double 0 0 -1.7E+308 1.7E+308 ECU_ADDRESS 0xfe4ca538 /* @ECU_Address@SwcIn_J3_LANE.Crosswalk.position.point_x@ */ /end MEASUREMENT
/begin MEASUREMENT SwcIn_J3_LANE.Crosswalk.position.point_y "" FLOAT64_IEEE autosar_swc_val_CM_double 0 0 -1.7E+308 1.7E+308 ECU_ADDRESS 0xfe4ca540 /* @ECU_Address@SwcIn_J3_LANE.Crosswalk.position.point_y@ */ /end MEASUREMENT
/begin MEASUREMENT SwcIn_J3_LANE.HPP_Line.HPPLineModel_First_C0 "" FLOAT32_IEEE autosar_swc_val_CM_single 0 0 -3.4E+38 3.4E+38 ECU_ADDRESS 0xfe4ca59c /* @ECU_Address@SwcIn_J3_LANE.HPP_Line.HPPLineModel_First_C0@ */ /end MEASUREMENT
/begin MEASUREMENT SwcIn_J3_LANE.HPP_Line.HPPLineModel_First_C1 "" FLOAT32_IEEE autosar_swc_val_CM_single 0 0 -3.4E+38 3.4E+38 ECU_ADDRESS 0xfe4ca5a0 /* @ECU_Address@SwcIn_J3_LANE.HPP_Line.HPPLineModel_First_C1@ */ /end MEASUREMENT
/begin MEASUREMENT SwcIn_J3_LANE.HPP_Line.HPPLineModel_First_C2 "" FLOAT32_IEEE autosar_swc_val_CM_single 0 0 -3.4E+38 3.4E+38 ECU_ADDRESS 0xfe4ca5a4 /* @ECU_Address@SwcIn_J3_LANE.HPP_Line.HPPLineModel_First_C2@ */ /end MEASUREMENT
/begin MEASUREMENT SwcIn_J3_LANE.HPP_Line.HPPLineModel_First_C3 "" FLOAT32_IEEE autosar_swc_val_CM_single 0 0 -3.4E+38 3.4E+38 ECU_ADDRESS 0xfe4ca5a8 /* @ECU_Address@SwcIn_J3_LANE.HPP_Line.HPPLineModel_First_C3@ */ /end MEASUREMENT
/begin MEASUREMENT SwcIn_J3_LANE.HPP_Line.HPPLineModel_Second_C0 "" FLOAT32_IEEE autosar_swc_val_CM_single 0 0 -3.4E+38 3.4E+38 ECU_ADDRESS 0xfe4ca5b0 /* @ECU_Address@SwcIn_J3_LANE.HPP_Line.HPPLineModel_Second_C0@ */ /end MEASUREMENT
/begin MEASUREMENT SwcIn_J3_LANE.HPP_Line.HPPLineModel_Second_C1 "" FLOAT32_IEEE autosar_swc_val_CM_single 0 0 -3.4E+38 3.4E+38 ECU_ADDRESS 0xfe4ca5b4 /* @ECU_Address@SwcIn_J3_LANE.HPP_Line.HPPLineModel_Second_C1@ */ /end MEASUREMENT
/begin MEASUREMENT SwcIn_J3_LANE.HPP_Line.HPPLineModel_Second_C2 "" FLOAT32_IEEE autosar_swc_val_CM_single 0 0 -3.4E+38 3.4E+38 ECU_ADDRESS 0xfe4ca5b8 /* @ECU_Address@SwcIn_J3_LANE.HPP_Line.HPPLineModel_Second_C2@ */ /end MEASUREMENT
/begin MEASUREMENT SwcIn_J3_LANE.HPP_Line.HPPLineModel_Second_C3 "" FLOAT32_IEEE autosar_swc_val_CM_single 0 0 -3.4E+38 3.4E+38 ECU_ADDRESS 0xfe4ca5bc /* @ECU_Address@SwcIn_J3_LANE.HPP_Line.HPPLineModel_Second_C3@ */ /end MEASUREMENT
/begin MEASUREMENT SwcIn_J3_LANE.HPP_Line.HPPLineModel_Third_C0 "" FLOAT32_IEEE autosar_swc_val_CM_single 0 0 -3.4E+38 3.4E+38 ECU_ADDRESS 0xfe4ca5c0 /* @ECU_Address@SwcIn_J3_LANE.HPP_Line.HPPLineModel_Third_C0@ */ /end MEASUREMENT
/begin MEASUREMENT SwcIn_J3_LANE.HPP_Line.HPPLineModel_Third_C1 "" FLOAT32_IEEE autosar_swc_val_CM_single 0 0 -3.4E+38 3.4E+38 ECU_ADDRESS 0xfe4ca5c4 /* @ECU_Address@SwcIn_J3_LANE.HPP_Line.HPPLineModel_Third_C1@ */ /end MEASUREMENT
/begin MEASUREMENT SwcIn_J3_LANE.HPP_Line.HPPLineModel_Third_C2 "" FLOAT32_IEEE autosar_swc_val_CM_single 0 0 -3.4E+38 3.4E+38 ECU_ADDRESS 0xfe4ca5c8 /* @ECU_Address@SwcIn_J3_LANE.HPP_Line.HPPLineModel_Third_C2@ */ /end MEASUREMENT
/begin MEASUREMENT SwcIn_J3_LANE.HPP_Line.HPPLineModel_Third_C3 "" FLOAT32_IEEE autosar_swc_val_CM_single 0 0 -3.4E+38 3.4E+38 ECU_ADDRESS 0xfe4ca5cc /* @ECU_Address@SwcIn_J3_LANE.HPP_Line.HPPLineModel_Third_C3@ */ /end MEASUREMENT
/begin MEASUREMENT SwcIn_J3_LANE.HPP_Line.HPPLine_Confidence "" UBYTE autosar_swc_val_CM_uint8 0 0 0 255 ECU_ADDRESS 0xfe4ca588 /* @ECU_Address@SwcIn_J3_LANE.HPP_Line.HPPLine_Confidence@ */ /end MEASUREMENT
/begin MEASUREMENT SwcIn_J3_LANE.HPP_Line.HPPLine_First_Valid "" UBYTE autosar_swc_val_CM_uint8 0 0 0 255 ECU_ADDRESS 0xfe4ca589 /* @ECU_Address@SwcIn_J3_LANE.HPP_Line.HPPLine_First_Valid@ */ /end MEASUREMENT
/begin MEASUREMENT SwcIn_J3_LANE.HPP_Line.HPPLine_Half_Width "" FLOAT32_IEEE autosar_swc_val_CM_single 0 0 -3.4E+38 3.4E+38 ECU_ADDRESS 0xfe4ca5ac /* @ECU_Address@SwcIn_J3_LANE.HPP_Line.HPPLine_Half_Width@ */ /end MEASUREMENT
/begin MEASUREMENT SwcIn_J3_LANE.HPP_Line.HPPLine_MeasuringStatus "" UBYTE autosar_swc_val_CM_uint8 0 0 0 255 ECU_ADDRESS 0xfe4ca58c /* @ECU_Address@SwcIn_J3_LANE.HPP_Line.HPPLine_MeasuringStatus@ */ /end MEASUREMENT
/begin MEASUREMENT SwcIn_J3_LANE.HPP_Line.HPPLine_Second_Valid "" UBYTE autosar_swc_val_CM_uint8 0 0 0 255 ECU_ADDRESS 0xfe4ca58a /* @ECU_Address@SwcIn_J3_LANE.HPP_Line.HPPLine_Second_Valid@ */ /end MEASUREMENT
/begin MEASUREMENT SwcIn_J3_LANE.HPP_Line.HPPLine_Third_Valid "" UBYTE autosar_swc_val_CM_uint8 0 0 0 255 ECU_ADDRESS 0xfe4ca58b /* @ECU_Address@SwcIn_J3_LANE.HPP_Line.HPPLine_Third_Valid@ */ /end MEASUREMENT
/begin MEASUREMENT SwcIn_J3_LANE.HPP_Line.HPPLine_TrackID "" UWORD autosar_swc_val_CM_uint16 0 0 0 65535 ECU_ADDRESS 0xfe4ca58e /* @ECU_Address@SwcIn_J3_LANE.HPP_Line.HPPLine_TrackID@ */ /end MEASUREMENT
/begin MEASUREMENT SwcIn_J3_LANE.HPP_Line.HPPLine_ViewRange_End_First "" FLOAT32_IEEE autosar_swc_val_CM_single 0 0 -3.4E+38 3.4E+38 ECU_ADDRESS 0xfe4ca590 /* @ECU_Address@SwcIn_J3_LANE.HPP_Line.HPPLine_ViewRange_End_First@ */ /end MEASUREMENT
/begin MEASUREMENT SwcIn_J3_LANE.HPP_Line.HPPLine_ViewRange_End_Second "" FLOAT32_IEEE autosar_swc_val_CM_single 0 0 -3.4E+38 3.4E+38 ECU_ADDRESS 0xfe4ca594 /* @ECU_Address@SwcIn_J3_LANE.HPP_Line.HPPLine_ViewRange_End_Second@ */ /end MEASUREMENT
/begin MEASUREMENT SwcIn_J3_LANE.HPP_Line.HPPLine_ViewRange_End_Third "" FLOAT32_IEEE autosar_swc_val_CM_single 0 0 -3.4E+38 3.4E+38 ECU_ADDRESS 0xfe4ca598 /* @ECU_Address@SwcIn_J3_LANE.HPP_Line.HPPLine_ViewRange_End_Third@ */ /end MEASUREMENT
/begin MEASUREMENT SwcIn_J3_LANE.J3_LANE_SYNC.FrameIndex "" ULONG autosar_swc_val_CM_uint32 0 0 0 4294967295 ECU_ADDRESS 0xfe4cae50 /* @ECU_Address@SwcIn_J3_LANE.J3_LANE_SYNC.FrameIndex@ */ /end MEASUREMENT
/begin MEASUREMENT SwcIn_J3_LANE.J3_LANE_SYNC.ImageTimestampMs "" A_UINT64 autosar_swc_val_CM_uint64 0 0 0.0 1.844674407370955e+19 ECU_ADDRESS 0xfe4cae58 /* @ECU_Address@SwcIn_J3_LANE.J3_LANE_SYNC.ImageTimestampMs@ */ /end MEASUREMENT
/begin MEASUREMENT SwcIn_J3_LANE.J3_LANE_SYNC.SPITimestampMs "" A_UINT64 autosar_swc_val_CM_uint64 0 0 0.0 1.844674407370955e+19 ECU_ADDRESS 0xfe4cae60 /* @ECU_Address@SwcIn_J3_LANE.J3_LANE_SYNC.SPITimestampMs@ */ /end MEASUREMENT
/begin MEASUREMENT SwcIn_J3_LANE.Lane_Extra_Type[0].change_point_valid "" UBYTE autosar_swc_val_CM_boolean 0 0 0 1 ECU_ADDRESS 0xfe4cae68 /* @ECU_Address@SwcIn_J3_LANE.Lane_Extra_Type[0].change_point_valid@ */ /end MEASUREMENT
/begin MEASUREMENT SwcIn_J3_LANE.Lane_Extra_Type[0].point_x "" FLOAT64_IEEE autosar_swc_val_CM_double 0 0 -1.7E+308 1.7E+308 ECU_ADDRESS 0xfe4cae70 /* @ECU_Address@SwcIn_J3_LANE.Lane_Extra_Type[0].point_x@ */ /end MEASUREMENT
/begin MEASUREMENT SwcIn_J3_LANE.Lane_Extra_Type[0].point_y "" FLOAT64_IEEE autosar_swc_val_CM_double 0 0 -1.7E+308 1.7E+308 ECU_ADDRESS 0xfe4cae78 /* @ECU_Address@SwcIn_J3_LANE.Lane_Extra_Type[0].point_y@ */ /end MEASUREMENT
/begin MEASUREMENT SwcIn_J3_LANE.Lane_Extra_Type[0].second_line_type "" UBYTE autosar_swc_val_CM_uint8 0 0 0 255 ECU_ADDRESS 0xfe4cae69 /* @ECU_Address@SwcIn_J3_LANE.Lane_Extra_Type[0].second_line_type@ */ /end MEASUREMENT
/begin MEASUREMENT SwcIn_J3_LANE.Lane_Extra_Type[0].type_change_position "" SLONG autosar_swc_val_CM_int32 0 0 -2147483648 2147483647 ECU_ADDRESS 0xfe4cae6c /* @ECU_Address@SwcIn_J3_LANE.Lane_Extra_Type[0].type_change_position@ */ /end MEASUREMENT
/begin MEASUREMENT SwcIn_J3_LANE.Left_Cone_Road_Edge.ConeRoadEdgeConfidence "" UBYTE autosar_swc_val_CM_uint8 0 0 0 255 ECU_ADDRESS 0xfe4ca4dc /* @ECU_Address@SwcIn_J3_LANE.Left_Cone_Road_Edge.ConeRoadEdgeConfidence@ */ /end MEASUREMENT
/begin MEASUREMENT SwcIn_J3_LANE.Left_Cone_Road_Edge.ConeRoadEdgeMeasuringStatus "" UBYTE autosar_swc_val_CM_uint8 0 0 0 255 ECU_ADDRESS 0xfe4ca4dd /* @ECU_Address@SwcIn_J3_LANE.Left_Cone_Road_Edge.ConeRoadEdgeMeasuringStatus@ */ /end MEASUREMENT
/begin MEASUREMENT SwcIn_J3_LANE.Left_Cone_Road_Edge.ConeRoadEdgeModelC0 "" FLOAT32_IEEE autosar_swc_val_CM_single 0 0 -3.4E+38 3.4E+38 ECU_ADDRESS 0xfe4ca4ec /* @ECU_Address@SwcIn_J3_LANE.Left_Cone_Road_Edge.ConeRoadEdgeModelC0@ */ /end MEASUREMENT
/begin MEASUREMENT SwcIn_J3_LANE.Left_Cone_Road_Edge.ConeRoadEdgeModelC1 "" FLOAT32_IEEE autosar_swc_val_CM_single 0 0 -3.4E+38 3.4E+38 ECU_ADDRESS 0xfe4ca4f0 /* @ECU_Address@SwcIn_J3_LANE.Left_Cone_Road_Edge.ConeRoadEdgeModelC1@ */ /end MEASUREMENT
/begin MEASUREMENT SwcIn_J3_LANE.Left_Cone_Road_Edge.ConeRoadEdgeModelC2 "" FLOAT32_IEEE autosar_swc_val_CM_single 0 0 -3.4E+38 3.4E+38 ECU_ADDRESS 0xfe4ca4f4 /* @ECU_Address@SwcIn_J3_LANE.Left_Cone_Road_Edge.ConeRoadEdgeModelC2@ */ /end MEASUREMENT
/begin MEASUREMENT SwcIn_J3_LANE.Left_Cone_Road_Edge.ConeRoadEdgeModelC3 "" FLOAT32_IEEE autosar_swc_val_CM_single 0 0 -3.4E+38 3.4E+38 ECU_ADDRESS 0xfe4ca4f8 /* @ECU_Address@SwcIn_J3_LANE.Left_Cone_Road_Edge.ConeRoadEdgeModelC3@ */ /end MEASUREMENT
/begin MEASUREMENT SwcIn_J3_LANE.Left_Cone_Road_Edge.ConeRoadEdgeParsingConfidence "" UBYTE autosar_swc_val_CM_uint8 0 0 0 255 ECU_ADDRESS 0xfe4ca4e0 /* @ECU_Address@SwcIn_J3_LANE.Left_Cone_Road_Edge.ConeRoadEdgeParsingConfidence@ */ /end MEASUREMENT
/begin MEASUREMENT SwcIn_J3_LANE.Left_Cone_Road_Edge.ConeRoadEdgeQuality "" UBYTE autosar_swc_val_CM_uint8 0 0 0 255 ECU_ADDRESS 0xfe4ca4df /* @ECU_Address@SwcIn_J3_LANE.Left_Cone_Road_Edge.ConeRoadEdgeQuality@ */ /end MEASUREMENT
/begin MEASUREMENT SwcIn_J3_LANE.Left_Cone_Road_Edge.ConeRoadEdgeTLC "" FLOAT32_IEEE autosar_swc_val_CM_single 0 0 -3.4E+38 3.4E+38 ECU_ADDRESS 0xfe4ca4fc /* @ECU_Address@SwcIn_J3_LANE.Left_Cone_Road_Edge.ConeRoadEdgeTLC@ */ /end MEASUREMENT
/begin MEASUREMENT SwcIn_J3_LANE.Left_Cone_Road_Edge.ConeRoadEdgeTrackID "" UWORD autosar_swc_val_CM_uint16 0 0 0 65535 ECU_ADDRESS 0xfe4ca4e2 /* @ECU_Address@SwcIn_J3_LANE.Left_Cone_Road_Edge.ConeRoadEdgeTrackID@ */ /end MEASUREMENT
/begin MEASUREMENT SwcIn_J3_LANE.Left_Cone_Road_Edge.ConeRoadEdgeTypeClass "" UBYTE autosar_swc_val_CM_uint8 0 0 0 255 ECU_ADDRESS 0xfe4ca4de /* @ECU_Address@SwcIn_J3_LANE.Left_Cone_Road_Edge.ConeRoadEdgeTypeClass@ */ /end MEASUREMENT
/begin MEASUREMENT SwcIn_J3_LANE.Left_Cone_Road_Edge.ConeRoadEdgeViewRangeEnd "" FLOAT32_IEEE autosar_swc_val_CM_single 0 0 -3.4E+38 3.4E+38 ECU_ADDRESS 0xfe4ca4e8 /* @ECU_Address@SwcIn_J3_LANE.Left_Cone_Road_Edge.ConeRoadEdgeViewRangeEnd@ */ /end MEASUREMENT
/begin MEASUREMENT SwcIn_J3_LANE.Left_Cone_Road_Edge.ConeRoadEdgeViewRangeStart "" FLOAT32_IEEE autosar_swc_val_CM_single 0 0 -3.4E+38 3.4E+38 ECU_ADDRESS 0xfe4ca4e4 /* @ECU_Address@SwcIn_J3_LANE.Left_Cone_Road_Edge.ConeRoadEdgeViewRangeStart@ */ /end MEASUREMENT
/begin MEASUREMENT SwcIn_J3_LANE.Left_LKA_Lane.LaneConfidence "" UBYTE autosar_swc_val_CM_uint8 0 0 0 255 ECU_ADDRESS 0xfe4ca5d0 /* @ECU_Address@SwcIn_J3_LANE.Left_LKA_Lane.LaneConfidence@ */ /end MEASUREMENT
/begin MEASUREMENT SwcIn_J3_LANE.Left_LKA_Lane.LaneCrossing "" UBYTE autosar_swc_val_CM_uint8 0 0 0 255 ECU_ADDRESS 0xfe4ca5d5 /* @ECU_Address@SwcIn_J3_LANE.Left_LKA_Lane.LaneCrossing@ */ /end MEASUREMENT
/begin MEASUREMENT SwcIn_J3_LANE.Left_LKA_Lane.LaneExtraFarPointPosX "" FLOAT32_IEEE autosar_swc_val_CM_single 0 0 -3.4E+38 3.4E+38 ECU_ADDRESS 0xfe4ca600 /* @ECU_Address@SwcIn_J3_LANE.Left_LKA_Lane.LaneExtraFarPointPosX@ */ /end MEASUREMENT
/begin MEASUREMENT SwcIn_J3_LANE.Left_LKA_Lane.LaneExtraFarPointPosY "" FLOAT32_IEEE autosar_swc_val_CM_single 0 0 -3.4E+38 3.4E+38 ECU_ADDRESS 0xfe4ca604 /* @ECU_Address@SwcIn_J3_LANE.Left_LKA_Lane.LaneExtraFarPointPosY@ */ /end MEASUREMENT
/begin MEASUREMENT SwcIn_J3_LANE.Left_LKA_Lane.LaneExtraFarPointType "" UBYTE autosar_swc_val_CM_uint8 0 0 0 255 ECU_ADDRESS 0xfe4ca5d8 /* @ECU_Address@SwcIn_J3_LANE.Left_LKA_Lane.LaneExtraFarPointType@ */ /end MEASUREMENT
/begin MEASUREMENT SwcIn_J3_LANE.Left_LKA_Lane.LaneExtraNearPointPosX "" FLOAT32_IEEE autosar_swc_val_CM_single 0 0 -3.4E+38 3.4E+38 ECU_ADDRESS 0xfe4ca608 /* @ECU_Address@SwcIn_J3_LANE.Left_LKA_Lane.LaneExtraNearPointPosX@ */ /end MEASUREMENT
/begin MEASUREMENT SwcIn_J3_LANE.Left_LKA_Lane.LaneExtraNearPointPosY "" FLOAT32_IEEE autosar_swc_val_CM_single 0 0 -3.4E+38 3.4E+38 ECU_ADDRESS 0xfe4ca60c /* @ECU_Address@SwcIn_J3_LANE.Left_LKA_Lane.LaneExtraNearPointPosY@ */ /end MEASUREMENT
/begin MEASUREMENT SwcIn_J3_LANE.Left_LKA_Lane.LaneExtraNearPointType "" UBYTE autosar_swc_val_CM_uint8 0 0 0 255 ECU_ADDRESS 0xfe4ca5d7 /* @ECU_Address@SwcIn_J3_LANE.Left_LKA_Lane.LaneExtraNearPointType@ */ /end MEASUREMENT
/begin MEASUREMENT SwcIn_J3_LANE.Left_LKA_Lane.LaneMarkColor "" UBYTE autosar_swc_val_CM_uint8 0 0 0 255 ECU_ADDRESS 0xfe4ca5d3 /* @ECU_Address@SwcIn_J3_LANE.Left_LKA_Lane.LaneMarkColor@ */ /end MEASUREMENT
/begin MEASUREMENT SwcIn_J3_LANE.Left_LKA_Lane.LaneMeasuringStatus "" UBYTE autosar_swc_val_CM_uint8 0 0 0 255 ECU_ADDRESS 0xfe4ca5d1 /* @ECU_Address@SwcIn_J3_LANE.Left_LKA_Lane.LaneMeasuringStatus@ */ /end MEASUREMENT
/begin MEASUREMENT SwcIn_J3_LANE.Left_LKA_Lane.LaneModelC0 "" FLOAT32_IEEE autosar_swc_val_CM_single 0 0 -3.4E+38 3.4E+38 ECU_ADDRESS 0xfe4ca5ec /* @ECU_Address@SwcIn_J3_LANE.Left_LKA_Lane.LaneModelC0@ */ /end MEASUREMENT
/begin MEASUREMENT SwcIn_J3_LANE.Left_LKA_Lane.LaneModelC1 "" FLOAT32_IEEE autosar_swc_val_CM_single 0 0 -3.4E+38 3.4E+38 ECU_ADDRESS 0xfe4ca5f0 /* @ECU_Address@SwcIn_J3_LANE.Left_LKA_Lane.LaneModelC1@ */ /end MEASUREMENT
/begin MEASUREMENT SwcIn_J3_LANE.Left_LKA_Lane.LaneModelC2 "" FLOAT32_IEEE autosar_swc_val_CM_single 0 0 -3.4E+38 3.4E+38 ECU_ADDRESS 0xfe4ca5f4 /* @ECU_Address@SwcIn_J3_LANE.Left_LKA_Lane.LaneModelC2@ */ /end MEASUREMENT
/begin MEASUREMENT SwcIn_J3_LANE.Left_LKA_Lane.LaneModelC3 "" FLOAT32_IEEE autosar_swc_val_CM_single 0 0 -3.4E+38 3.4E+38 ECU_ADDRESS 0xfe4ca5f8 /* @ECU_Address@SwcIn_J3_LANE.Left_LKA_Lane.LaneModelC3@ */ /end MEASUREMENT
/begin MEASUREMENT SwcIn_J3_LANE.Left_LKA_Lane.LaneParsingConfidence "" UBYTE autosar_swc_val_CM_uint8 0 0 0 255 ECU_ADDRESS 0xfe4ca5d9 /* @ECU_Address@SwcIn_J3_LANE.Left_LKA_Lane.LaneParsingConfidence@ */ /end MEASUREMENT
/begin MEASUREMENT SwcIn_J3_LANE.Left_LKA_Lane.LaneQuality "" UBYTE autosar_swc_val_CM_uint8 0 0 0 255 ECU_ADDRESS 0xfe4ca5d4 /* @ECU_Address@SwcIn_J3_LANE.Left_LKA_Lane.LaneQuality@ */ /end MEASUREMENT
/begin MEASUREMENT SwcIn_J3_LANE.Left_LKA_Lane.LaneTLC "" FLOAT32_IEEE autosar_swc_val_CM_single 0 0 -3.4E+38 3.4E+38 ECU_ADDRESS 0xfe4ca5fc /* @ECU_Address@SwcIn_J3_LANE.Left_LKA_Lane.LaneTLC@ */ /end MEASUREMENT
/begin MEASUREMENT SwcIn_J3_LANE.Left_LKA_Lane.LaneTrackID "" UWORD autosar_swc_val_CM_uint16 0 0 0 65535 ECU_ADDRESS 0xfe4ca5dc /* @ECU_Address@SwcIn_J3_LANE.Left_LKA_Lane.LaneTrackID@ */ /end MEASUREMENT
/begin MEASUREMENT SwcIn_J3_LANE.Left_LKA_Lane.LaneTypeClass "" UBYTE autosar_swc_val_CM_uint8 0 0 0 255 ECU_ADDRESS 0xfe4ca5d2 /* @ECU_Address@SwcIn_J3_LANE.Left_LKA_Lane.LaneTypeClass@ */ /end MEASUREMENT
/begin MEASUREMENT SwcIn_J3_LANE.Left_LKA_Lane.LaneViewRangeEnd "" FLOAT32_IEEE autosar_swc_val_CM_single 0 0 -3.4E+38 3.4E+38 ECU_ADDRESS 0xfe4ca5e8 /* @ECU_Address@SwcIn_J3_LANE.Left_LKA_Lane.LaneViewRangeEnd@ */ /end MEASUREMENT
/begin MEASUREMENT SwcIn_J3_LANE.Left_LKA_Lane.LaneViewRangeStart "" FLOAT32_IEEE autosar_swc_val_CM_single 0 0 -3.4E+38 3.4E+38 ECU_ADDRESS 0xfe4ca5e4 /* @ECU_Address@SwcIn_J3_LANE.Left_LKA_Lane.LaneViewRangeStart@ */ /end MEASUREMENT
/begin MEASUREMENT SwcIn_J3_LANE.Left_LKA_Lane.LaneWidthMarking "" FLOAT32_IEEE autosar_swc_val_CM_single 0 0 -3.4E+38 3.4E+38 ECU_ADDRESS 0xfe4ca5e0 /* @ECU_Address@SwcIn_J3_LANE.Left_LKA_Lane.LaneWidthMarking@ */ /end MEASUREMENT
/begin MEASUREMENT SwcIn_J3_LANE.Left_LKA_Lane.ObstacleFlag "" UBYTE autosar_swc_val_CM_uint8 0 0 0 255 ECU_ADDRESS 0xfe4ca5d6 /* @ECU_Address@SwcIn_J3_LANE.Left_LKA_Lane.ObstacleFlag@ */ /end MEASUREMENT
/begin MEASUREMENT SwcIn_J3_LANE.Left_LKA_Lane.Stopline_Relevancy "" UBYTE autosar_swc_val_CM_uint8 0 0 0 255 ECU_ADDRESS 0xfe4ca5da /* @ECU_Address@SwcIn_J3_LANE.Left_LKA_Lane.Stopline_Relevancy@ */ /end MEASUREMENT
/begin MEASUREMENT SwcIn_J3_LANE.Left_Next_Lane.LaneConfidence "" UBYTE autosar_swc_val_CM_uint8 0 0 0 255 ECU_ADDRESS 0xfe4caca8 /* @ECU_Address@SwcIn_J3_LANE.Left_Next_Lane.LaneConfidence@ */ /end MEASUREMENT
/begin MEASUREMENT SwcIn_J3_LANE.Left_Next_Lane.LaneExtraFarPointPosX "" FLOAT32_IEEE autosar_swc_val_CM_single 0 0 -3.4E+38 3.4E+38 ECU_ADDRESS 0xfe4cacd0 /* @ECU_Address@SwcIn_J3_LANE.Left_Next_Lane.LaneExtraFarPointPosX@ */ /end MEASUREMENT
/begin MEASUREMENT SwcIn_J3_LANE.Left_Next_Lane.LaneExtraFarPointPosY "" FLOAT32_IEEE autosar_swc_val_CM_single 0 0 -3.4E+38 3.4E+38 ECU_ADDRESS 0xfe4cacd4 /* @ECU_Address@SwcIn_J3_LANE.Left_Next_Lane.LaneExtraFarPointPosY@ */ /end MEASUREMENT
/begin MEASUREMENT SwcIn_J3_LANE.Left_Next_Lane.LaneExtraFarPointType "" UBYTE autosar_swc_val_CM_uint8 0 0 0 255 ECU_ADDRESS 0xfe4cacaf /* @ECU_Address@SwcIn_J3_LANE.Left_Next_Lane.LaneExtraFarPointType@ */ /end MEASUREMENT
/begin MEASUREMENT SwcIn_J3_LANE.Left_Next_Lane.LaneExtraNearPointPosX "" FLOAT32_IEEE autosar_swc_val_CM_single 0 0 -3.4E+38 3.4E+38 ECU_ADDRESS 0xfe4cacd8 /* @ECU_Address@SwcIn_J3_LANE.Left_Next_Lane.LaneExtraNearPointPosX@ */ /end MEASUREMENT
/begin MEASUREMENT SwcIn_J3_LANE.Left_Next_Lane.LaneExtraNearPointPosY "" FLOAT32_IEEE autosar_swc_val_CM_single 0 0 -3.4E+38 3.4E+38 ECU_ADDRESS 0xfe4cacdc /* @ECU_Address@SwcIn_J3_LANE.Left_Next_Lane.LaneExtraNearPointPosY@ */ /end MEASUREMENT
/begin MEASUREMENT SwcIn_J3_LANE.Left_Next_Lane.LaneExtraNearPointType "" UBYTE autosar_swc_val_CM_uint8 0 0 0 255 ECU_ADDRESS 0xfe4cacae /* @ECU_Address@SwcIn_J3_LANE.Left_Next_Lane.LaneExtraNearPointType@ */ /end MEASUREMENT
/begin MEASUREMENT SwcIn_J3_LANE.Left_Next_Lane.LaneMarkColor "" UBYTE autosar_swc_val_CM_uint8 0 0 0 255 ECU_ADDRESS 0xfe4cacab /* @ECU_Address@SwcIn_J3_LANE.Left_Next_Lane.LaneMarkColor@ */ /end MEASUREMENT
/begin MEASUREMENT SwcIn_J3_LANE.Left_Next_Lane.LaneMeasuringStatus "" UBYTE autosar_swc_val_CM_uint8 0 0 0 255 ECU_ADDRESS 0xfe4caca9 /* @ECU_Address@SwcIn_J3_LANE.Left_Next_Lane.LaneMeasuringStatus@ */ /end MEASUREMENT
/begin MEASUREMENT SwcIn_J3_LANE.Left_Next_Lane.LaneModelC0 "" FLOAT32_IEEE autosar_swc_val_CM_single 0 0 -3.4E+38 3.4E+38 ECU_ADDRESS 0xfe4cacc0 /* @ECU_Address@SwcIn_J3_LANE.Left_Next_Lane.LaneModelC0@ */ /end MEASUREMENT
/begin MEASUREMENT SwcIn_J3_LANE.Left_Next_Lane.LaneModelC1 "" FLOAT32_IEEE autosar_swc_val_CM_single 0 0 -3.4E+38 3.4E+38 ECU_ADDRESS 0xfe4cacc4 /* @ECU_Address@SwcIn_J3_LANE.Left_Next_Lane.LaneModelC1@ */ /end MEASUREMENT
/begin MEASUREMENT SwcIn_J3_LANE.Left_Next_Lane.LaneModelC2 "" FLOAT32_IEEE autosar_swc_val_CM_single 0 0 -3.4E+38 3.4E+38 ECU_ADDRESS 0xfe4cacc8 /* @ECU_Address@SwcIn_J3_LANE.Left_Next_Lane.LaneModelC2@ */ /end MEASUREMENT
/begin MEASUREMENT SwcIn_J3_LANE.Left_Next_Lane.LaneModelC3 "" FLOAT32_IEEE autosar_swc_val_CM_single 0 0 -3.4E+38 3.4E+38 ECU_ADDRESS 0xfe4caccc /* @ECU_Address@SwcIn_J3_LANE.Left_Next_Lane.LaneModelC3@ */ /end MEASUREMENT
/begin MEASUREMENT SwcIn_J3_LANE.Left_Next_Lane.LaneParsingConfidence "" UBYTE autosar_swc_val_CM_uint8 0 0 0 255 ECU_ADDRESS 0xfe4cacb0 /* @ECU_Address@SwcIn_J3_LANE.Left_Next_Lane.LaneParsingConfidence@ */ /end MEASUREMENT
/begin MEASUREMENT SwcIn_J3_LANE.Left_Next_Lane.LaneQuality "" UBYTE autosar_swc_val_CM_uint8 0 0 0 255 ECU_ADDRESS 0xfe4cacac /* @ECU_Address@SwcIn_J3_LANE.Left_Next_Lane.LaneQuality@ */ /end MEASUREMENT
/begin MEASUREMENT SwcIn_J3_LANE.Left_Next_Lane.LaneTrackID "" UWORD autosar_swc_val_CM_uint16 0 0 0 65535 ECU_ADDRESS 0xfe4cacb2 /* @ECU_Address@SwcIn_J3_LANE.Left_Next_Lane.LaneTrackID@ */ /end MEASUREMENT
/begin MEASUREMENT SwcIn_J3_LANE.Left_Next_Lane.LaneTypeClass "" UBYTE autosar_swc_val_CM_uint8 0 0 0 255 ECU_ADDRESS 0xfe4cacaa /* @ECU_Address@SwcIn_J3_LANE.Left_Next_Lane.LaneTypeClass@ */ /end MEASUREMENT
/begin MEASUREMENT SwcIn_J3_LANE.Left_Next_Lane.LaneViewRangeEnd "" FLOAT32_IEEE autosar_swc_val_CM_single 0 0 -3.4E+38 3.4E+38 ECU_ADDRESS 0xfe4cacbc /* @ECU_Address@SwcIn_J3_LANE.Left_Next_Lane.LaneViewRangeEnd@ */ /end MEASUREMENT
/begin MEASUREMENT SwcIn_J3_LANE.Left_Next_Lane.LaneViewRangeStart "" FLOAT32_IEEE autosar_swc_val_CM_single 0 0 -3.4E+38 3.4E+38 ECU_ADDRESS 0xfe4cacb8 /* @ECU_Address@SwcIn_J3_LANE.Left_Next_Lane.LaneViewRangeStart@ */ /end MEASUREMENT
/begin MEASUREMENT SwcIn_J3_LANE.Left_Next_Lane.LaneWidthMarking "" FLOAT32_IEEE autosar_swc_val_CM_single 0 0 -3.4E+38 3.4E+38 ECU_ADDRESS 0xfe4cacb4 /* @ECU_Address@SwcIn_J3_LANE.Left_Next_Lane.LaneWidthMarking@ */ /end MEASUREMENT
/begin MEASUREMENT SwcIn_J3_LANE.Left_Next_Lane.ObstacleFlag "" UBYTE autosar_swc_val_CM_uint8 0 0 0 255 ECU_ADDRESS 0xfe4cacad /* @ECU_Address@SwcIn_J3_LANE.Left_Next_Lane.ObstacleFlag@ */ /end MEASUREMENT
/begin MEASUREMENT SwcIn_J3_LANE.RollingCounter_Lane "" UBYTE autosar_swc_val_CM_uint8 0 0 0 255 ECU_ADDRESS 0xfe4ca4d8 /* @ECU_Address@SwcIn_J3_LANE.RollingCounter_Lane@ */ /end MEASUREMENT
/begin COMPU_METHOD autosar_swc_val_CM_ASU_1_ASUSysFailrSts_1217_dt "Q = V" IDENTICAL "%0.6" "" /end COMPU_METHOD
/begin COMPU_METHOD autosar_swc_val_CM_ASU_1_AutoEasyEntryFb_1217_dt "Q = V" IDENTICAL "%0.6" "" /end COMPU_METHOD
/begin COMPU_METHOD autosar_swc_val_CM_ASU_1_BluetoothManEasyEntryFb_1217_dt "Q = V" IDENTICAL "%0.6" "" /end COMPU_METHOD
/begin COMPU_METHOD autosar_swc_val_CM_ASU_1_CDCErrSts_1217_dt "Q = V" IDENTICAL "%0.6" "" /end COMPU_METHOD
/begin COMPU_METHOD autosar_swc_val_CM_ASU_1_CRC1_1217_dt "Q = V" IDENTICAL "%0.6" "" /end COMPU_METHOD
/begin COMPU_METHOD autosar_swc_val_CM_ASU_1_ECASErrSts_1217_dt "Q = V" IDENTICAL "%0.6" "" /end COMPU_METHOD
/begin COMPU_METHOD autosar_swc_val_CM_ASU_1_ECASModeFb_1217_dt "Q = V" IDENTICAL "%0.6" "" /end COMPU_METHOD
/begin COMPU_METHOD autosar_swc_val_CM_ASU_1_ECASSysSts_1217_dt "Q = V" IDENTICAL "%0.6" "" /end COMPU_METHOD
/begin COMPU_METHOD autosar_swc_val_CM_ASU_1_EasyEntryEna_1217_dt "Q = V" IDENTICAL "%0.6" "" /end COMPU_METHOD
/begin COMPU_METHOD autosar_swc_val_CM_ASU_1_HighwayModFb_1217_dt "Q = V" IDENTICAL "%0.6" "" /end COMPU_METHOD
/begin COMPU_METHOD autosar_swc_val_CM_ASU_1_MaintainMod_1217_dt "Q = V" IDENTICAL "%0.6" "" /end COMPU_METHOD
/begin COMPU_METHOD autosar_swc_val_CM_ASU_1_RollgCntr1_1217_dt "Q = V" IDENTICAL "%0.6" "" /end COMPU_METHOD
/begin COMPU_METHOD autosar_swc_val_CM_ASU_1_SuspCurrentLvl_1217_dt "Q = V" IDENTICAL "%0.6" "" /end COMPU_METHOD
/begin COMPU_METHOD autosar_swc_val_CM_ASU_1_SuspDampingLvl_1217_dt "Q = V" IDENTICAL "%0.6" "" /end COMPU_METHOD
/begin COMPU_METHOD autosar_swc_val_CM_ASU_1_SuspTarLvl_1217_dt "Q = V" IDENTICAL "%0.6" "" /end COMPU_METHOD
/begin COMPU_METHOD autosar_swc_val_CM_ASU_1_SuspTmpAdjSts_1217_dt "Q = V" IDENTICAL "%0.6" "" /end COMPU_METHOD
/begin COMPU_METHOD autosar_swc_val_CM_ASU_2_CRC1_776_dt "Q = V" IDENTICAL "%0.6" "" /end COMPU_METHOD
/begin COMPU_METHOD autosar_swc_val_CM_ASU_2_LFHeight_776_dt "Q = V" IDENTICAL "%8.6" "" /end COMPU_METHOD
/begin COMPU_METHOD autosar_swc_val_CM_ASU_2_LRHeight_776_dt "Q = V" IDENTICAL "%8.6" "" /end COMPU_METHOD
/begin COMPU_METHOD autosar_swc_val_CM_ASU_2_RFHeight_776_dt "Q = V" IDENTICAL "%8.6" "" /end COMPU_METHOD
/begin COMPU_METHOD autosar_swc_val_CM_ASU_2_RRHeight_776_dt "Q = V" IDENTICAL "%8.6" "" /end COMPU_METHOD
/begin COMPU_METHOD autosar_swc_val_CM_ASU_2_RollgCntr1_776_dt "Q = V" IDENTICAL "%0.6" "" /end COMPU_METHOD
/begin COMPU_METHOD autosar_swc_val_CM_ASU_2_sensorErrorSts_776_dt "Q = V" IDENTICAL "%0.6" "" /end COMPU_METHOD
/begin COMPU_METHOD autosar_swc_val_CM_BMS_ChgWireConnect_LightSts_1295_dt "Q = V" IDENTICAL "%0.6" "" /end COMPU_METHOD
/begin COMPU_METHOD autosar_swc_val_CM_BMS_Chg_LightSts_1295_dt "Q = V" IDENTICAL "%0.6" "" /end COMPU_METHOD
/begin COMPU_METHOD autosar_swc_val_CM_BMS_SOCLight_1291_dt "Q = V" IDENTICAL "%0.6" "" /end COMPU_METHOD
/begin COMPU_METHOD autosar_swc_val_CM_CSA_1_CRC_321_dt "Q = V" IDENTICAL "%0.6" "" /end COMPU_METHOD
/begin COMPU_METHOD autosar_swc_val_CM_CSA_1_Resd_321_dt "Q = V" IDENTICAL "%0.6" "" /end COMPU_METHOD
/begin COMPU_METHOD autosar_swc_val_CM_CSA_1_RollgCntr_321_dt "Q = V" IDENTICAL "%0.6" "" /end COMPU_METHOD
/begin COMPU_METHOD autosar_swc_val_CM_CSA_2_AllWarningInfo_631_dt "Q = V" IDENTICAL "%0.6" "" /end COMPU_METHOD
/begin COMPU_METHOD autosar_swc_val_CM_CSA_2_CRC1_631_dt "Q = V" IDENTICAL "%0.6" "" /end COMPU_METHOD
/begin COMPU_METHOD autosar_swc_val_CM_CSA_2_Resd1_631_dt "Q = V" IDENTICAL "%0.6" "" /end COMPU_METHOD
/begin COMPU_METHOD autosar_swc_val_CM_CSA_2_RollgCntr1_631_dt "Q = V" IDENTICAL "%0.6" "" /end COMPU_METHOD
/begin COMPU_METHOD autosar_swc_val_CM_CSA_2_TurnSigLvrCmd_631_dt "Q = V" IDENTICAL "%0.6" "" /end COMPU_METHOD
/begin COMPU_METHOD autosar_swc_val_CM_CSA_2_WshrFrntCmd_631_dt "Q = V" IDENTICAL "%0.6" "" /end COMPU_METHOD
/begin COMPU_METHOD autosar_swc_val_CM_CurrentTimeDay_1296_dt "Q = V" IDENTICAL "%0.6" "" /end COMPU_METHOD
/begin COMPU_METHOD autosar_swc_val_CM_CurrentTimeHour_1296_dt "Q = V" IDENTICAL "%0.6" "" /end COMPU_METHOD
/begin COMPU_METHOD autosar_swc_val_CM_CurrentTimeMinute_1296_dt "Q = V" IDENTICAL "%0.6" "" /end COMPU_METHOD
/begin COMPU_METHOD autosar_swc_val_CM_CurrentTimeMonth_1296_dt "Q = V" IDENTICAL "%0.6" "" /end COMPU_METHOD
/begin COMPU_METHOD autosar_swc_val_CM_CurrentTimeSecond_1296_dt "Q = V" IDENTICAL "%0.6" "" /end COMPU_METHOD
/begin COMPU_METHOD autosar_swc_val_CM_CurrentTimeYear_1296_dt "Q = V" IDENTICAL "%0.6" "" /end COMPU_METHOD
/begin COMPU_METHOD autosar_swc_val_CM_Diag_FCM_REQ_1858_dt "Q = V" IDENTICAL "%0.6" "" /end COMPU_METHOD
/begin COMPU_METHOD autosar_swc_val_CM_Diag_Functional_REQ_2015_dt "Q = V" IDENTICAL "%0.6" "" /end COMPU_METHOD
/begin COMPU_METHOD autosar_swc_val_CM_DirectionIndLeft_571_dt "Q = V" IDENTICAL "%0.6" "" /end COMPU_METHOD
/begin COMPU_METHOD autosar_swc_val_CM_DirectionIndRight_571_dt "Q = V" IDENTICAL "%0.6" "" /end COMPU_METHOD
/begin COMPU_METHOD autosar_swc_val_CM_DisplayVehicleSpeed_1252_dt "Q = V" IDENTICAL "%8.6" "" /end COMPU_METHOD
/begin COMPU_METHOD autosar_swc_val_CM_Dms_DriverPresence_1157_dt "Q = V" IDENTICAL "%0.6" "" /end COMPU_METHOD
/begin COMPU_METHOD autosar_swc_val_CM_Dms_Status_1157_dt "Q = V" IDENTICAL "%0.6" "" /end COMPU_METHOD
/begin COMPU_METHOD autosar_swc_val_CM_DriveModeActive_321_dt "Q = V" IDENTICAL "%0.6" "" /end COMPU_METHOD
/begin COMPU_METHOD autosar_swc_val_CM_DriveModeReq_321_dt "Q = V" IDENTICAL "%0.6" "" /end COMPU_METHOD
/begin COMPU_METHOD autosar_swc_val_CM_Driver_AbnormalBehavior_1157_dt "Q = V" IDENTICAL "%0.6" "" /end COMPU_METHOD
/begin COMPU_METHOD autosar_swc_val_CM_Driver_EyeOnRoad_1157_dt "Q = V" IDENTICAL "%0.6" "" /end COMPU_METHOD
/begin COMPU_METHOD autosar_swc_val_CM_Driver_GazeRegion_1157_dt "Q = V" IDENTICAL "%0.6" "" /end COMPU_METHOD
/begin COMPU_METHOD autosar_swc_val_CM_EPB_1_ActrSt_612_dt "Q = V" IDENTICAL "%0.6" "" /end COMPU_METHOD
/begin COMPU_METHOD autosar_swc_val_CM_EPB_1_DrvrRqParkBrkVld_612_dt "Q = V" IDENTICAL "%0.6" "" /end COMPU_METHOD
/begin COMPU_METHOD autosar_swc_val_CM_EPB_1_DrvrRqParkBrk_612_dt "Q = V" IDENTICAL "%0.6" "" /end COMPU_METHOD
/begin COMPU_METHOD autosar_swc_val_CM_EPB_1_DynBrkgSt_612_dt "Q = V" IDENTICAL "%0.6" "" /end COMPU_METHOD
/begin COMPU_METHOD autosar_swc_val_CM_EPB_1_EPBAvlSt_612_dt "Q = V" IDENTICAL "%0.6" "" /end COMPU_METHOD
/begin COMPU_METHOD autosar_swc_val_CM_EPB_1_FltLvl_612_dt "Q = V" IDENTICAL "%0.6" "" /end COMPU_METHOD
/begin COMPU_METHOD autosar_swc_val_CM_EPB_1_ParkBrkCpby_612_dt "Q = V" IDENTICAL "%0.6" "" /end COMPU_METHOD
/begin COMPU_METHOD autosar_swc_val_CM_EPB_1_RWUSt_612_dt "Q = V" IDENTICAL "%0.6" "" /end COMPU_METHOD
/begin COMPU_METHOD autosar_swc_val_CM_EPB_R_1_ActrSt_612_dt "Q = V" IDENTICAL "%0.6" "" /end COMPU_METHOD
/begin COMPU_METHOD autosar_swc_val_CM_EPB_R_1_BrkLitReq_612_dt "Q = V" IDENTICAL "%0.6" "" /end COMPU_METHOD
/begin COMPU_METHOD autosar_swc_val_CM_EPB_R_1_CDP_Req_612_dt "Q = V" IDENTICAL "%0.6" "" /end COMPU_METHOD
/begin COMPU_METHOD autosar_swc_val_CM_EPB_R_1_CRC1_612_dt "Q = V" IDENTICAL "%0.6" "" /end COMPU_METHOD
/begin COMPU_METHOD autosar_swc_val_CM_EPB_R_1_CRC2_612_dt "Q = V" IDENTICAL "%0.6" "" /end COMPU_METHOD
/begin COMPU_METHOD autosar_swc_val_CM_EPB_R_1_DrvrRqParkBrkVld_612_dt "Q = V" IDENTICAL "%0.6" "" /end COMPU_METHOD
/begin COMPU_METHOD autosar_swc_val_CM_EPB_R_1_DrvrRqParkBrk_612_dt "Q = V" IDENTICAL "%0.6" "" /end COMPU_METHOD
/begin COMPU_METHOD autosar_swc_val_CM_EPB_R_1_Dyn_BrkgSt_612_dt "Q = V" IDENTICAL "%0.6" "" /end COMPU_METHOD
/begin COMPU_METHOD autosar_swc_val_CM_EPB_R_1_EPB_R_1Avl_St_612_dt "Q = V" IDENTICAL "%0.6" "" /end COMPU_METHOD
/begin COMPU_METHOD autosar_swc_val_CM_EPB_R_1_FltLvl_612_dt "Q = V" IDENTICAL "%0.6" "" /end COMPU_METHOD
/begin COMPU_METHOD autosar_swc_val_CM_EPB_R_1_Flt_Lamp_612_dt "Q = V" IDENTICAL "%0.6" "" /end COMPU_METHOD
/begin COMPU_METHOD autosar_swc_val_CM_EPB_R_1_Park_Lamp_612_dt "Q = V" IDENTICAL "%0.6" "" /end COMPU_METHOD
/begin COMPU_METHOD autosar_swc_val_CM_EPB_R_1_RWU_St_612_dt "Q = V" IDENTICAL "%0.6" "" /end COMPU_METHOD
/begin COMPU_METHOD autosar_swc_val_CM_EPB_R_1_Resd1_612_dt "Q = V" IDENTICAL "%0.6" "" /end COMPU_METHOD
/begin COMPU_METHOD autosar_swc_val_CM_EPB_R_1_Resd2_612_dt "Q = V" IDENTICAL "%0.6" "" /end COMPU_METHOD
/begin COMPU_METHOD autosar_swc_val_CM_EPB_R_1_RollgCntr1_612_dt "Q = V" IDENTICAL "%0.6" "" /end COMPU_METHOD
/begin COMPU_METHOD autosar_swc_val_CM_EPB_R_1_RollgCntr2_612_dt "Q = V" IDENTICAL "%0.6" "" /end COMPU_METHOD
/begin COMPU_METHOD autosar_swc_val_CM_EPB_R_1_TextDisp_612_dt "Q = V" IDENTICAL "%0.6" "" /end COMPU_METHOD
/begin COMPU_METHOD autosar_swc_val_CM_EPSFailSts_290_dt "Q = V" IDENTICAL "%0.6" "" /end COMPU_METHOD
/begin COMPU_METHOD autosar_swc_val_CM_EPS_1_CRC_290_dt "Q = V" IDENTICAL "%0.6" "" /end COMPU_METHOD
/begin COMPU_METHOD autosar_swc_val_CM_EPS_1_Resd_290_dt "Q = V" IDENTICAL "%0.6" "" /end COMPU_METHOD
/begin COMPU_METHOD autosar_swc_val_CM_EPS_1_RollgCntr_290_dt "Q = V" IDENTICAL "%0.6" "" /end COMPU_METHOD
/begin COMPU_METHOD autosar_swc_val_CM_EPS_3_CRC_715_dt "Q = V" IDENTICAL "%0.6" "" /end COMPU_METHOD
/begin COMPU_METHOD autosar_swc_val_CM_EPS_3_Resd_715_dt "Q = V" IDENTICAL "%0.6" "" /end COMPU_METHOD
/begin COMPU_METHOD autosar_swc_val_CM_EPS_3_RollgCntr_715_dt "Q = V" IDENTICAL "%0.6" "" /end COMPU_METHOD
/begin COMPU_METHOD autosar_swc_val_CM_EPS_4_ADSMaxTq_421_dt "Q = V" IDENTICAL "%8.6" "" /end COMPU_METHOD
/begin COMPU_METHOD autosar_swc_val_CM_EPS_4_ADSMinTq_421_dt "Q = V" IDENTICAL "%8.6" "" /end COMPU_METHOD
/begin COMPU_METHOD autosar_swc_val_CM_EPS_4_AgParkCtrlAvl_421_dt "Q = V" IDENTICAL "%0.6" "" /end COMPU_METHOD
/begin COMPU_METHOD autosar_swc_val_CM_EPS_4_AgParkCtrlSts_421_dt "Q = V" IDENTICAL "%0.6" "" /end COMPU_METHOD
/begin COMPU_METHOD autosar_swc_val_CM_EPS_4_AgPilotCtrlAvl_421_dt "Q = V" IDENTICAL "%0.6" "" /end COMPU_METHOD
/begin COMPU_METHOD autosar_swc_val_CM_EPS_4_AgPilotCtrlSts_421_dt "Q = V" IDENTICAL "%0.6" "" /end COMPU_METHOD
/begin COMPU_METHOD autosar_swc_val_CM_EPS_4_AsscMotCrtTqVld_421_dt "Q = V" IDENTICAL "%0.6" "" /end COMPU_METHOD
/begin COMPU_METHOD autosar_swc_val_CM_EPS_4_AsscMotCrtTq_421_dt "Q = V" IDENTICAL "%8.6" "" /end COMPU_METHOD
/begin COMPU_METHOD autosar_swc_val_CM_EPS_4_CRC1_421_dt "Q = V" IDENTICAL "%0.6" "" /end COMPU_METHOD
/begin COMPU_METHOD autosar_swc_val_CM_EPS_4_CRC2_421_dt "Q = V" IDENTICAL "%0.6" "" /end COMPU_METHOD
/begin COMPU_METHOD autosar_swc_val_CM_EPS_4_CRC3_421_dt "Q = V" IDENTICAL "%0.6" "" /end COMPU_METHOD
/begin COMPU_METHOD autosar_swc_val_CM_EPS_4_CRC4_421_dt "Q = V" IDENTICAL "%0.6" "" /end COMPU_METHOD
/begin COMPU_METHOD autosar_swc_val_CM_EPS_4_CRC5_421_dt "Q = V" IDENTICAL "%0.6" "" /end COMPU_METHOD
/begin COMPU_METHOD autosar_swc_val_CM_EPS_4_LdwWarnStsVD_421_dt "Q = V" IDENTICAL "%0.6" "" /end COMPU_METHOD
/begin COMPU_METHOD autosar_swc_val_CM_EPS_4_LdwWarnSts_421_dt "Q = V" IDENTICAL "%0.6" "" /end COMPU_METHOD
/begin COMPU_METHOD autosar_swc_val_CM_EPS_4_OverrangeFeedbackVD_421_dt "Q = V" IDENTICAL "%0.6" "" /end COMPU_METHOD
/begin COMPU_METHOD autosar_swc_val_CM_EPS_4_OverrangeFeedback_421_dt "Q = V" IDENTICAL "%0.6" "" /end COMPU_METHOD
/begin COMPU_METHOD autosar_swc_val_CM_EPS_4_Resd1_421_dt "Q = V" IDENTICAL "%0.6" "" /end COMPU_METHOD
/begin COMPU_METHOD autosar_swc_val_CM_EPS_4_Resd2_421_dt "Q = V" IDENTICAL "%0.6" "" /end COMPU_METHOD
/begin COMPU_METHOD autosar_swc_val_CM_EPS_4_Resd3_421_dt "Q = V" IDENTICAL "%0.6" "" /end COMPU_METHOD
/begin COMPU_METHOD autosar_swc_val_CM_EPS_4_Resd4_421_dt "Q = V" IDENTICAL "%0.6" "" /end COMPU_METHOD
/begin COMPU_METHOD autosar_swc_val_CM_EPS_4_Resd5_421_dt "Q = V" IDENTICAL "%0.6" "" /end COMPU_METHOD
/begin COMPU_METHOD autosar_swc_val_CM_EPS_4_RollgCntr1_421_dt "Q = V" IDENTICAL "%0.6" "" /end COMPU_METHOD
/begin COMPU_METHOD autosar_swc_val_CM_EPS_4_RollgCntr2_421_dt "Q = V" IDENTICAL "%0.6" "" /end COMPU_METHOD
/begin COMPU_METHOD autosar_swc_val_CM_EPS_4_RollgCntr3_421_dt "Q = V" IDENTICAL "%0.6" "" /end COMPU_METHOD
/begin COMPU_METHOD autosar_swc_val_CM_EPS_4_RollgCntr4_421_dt "Q = V" IDENTICAL "%0.6" "" /end COMPU_METHOD
/begin COMPU_METHOD autosar_swc_val_CM_EPS_4_RollgCntr5_421_dt "Q = V" IDENTICAL "%0.6" "" /end COMPU_METHOD
/begin COMPU_METHOD autosar_swc_val_CM_EPS_4_SteerDrvrOvrdVld_421_dt "Q = V" IDENTICAL "%0.6" "" /end COMPU_METHOD
/begin COMPU_METHOD autosar_swc_val_CM_EPS_4_SteerDrvrOvrd_421_dt "Q = V" IDENTICAL "%0.6" "" /end COMPU_METHOD
/begin COMPU_METHOD autosar_swc_val_CM_EPS_4_SteerMod_421_dt "Q = V" IDENTICAL "%0.6" "" /end COMPU_METHOD
/begin COMPU_METHOD autosar_swc_val_CM_EPS_4_SteerPinionTqVld_421_dt "Q = V" IDENTICAL "%0.6" "" /end COMPU_METHOD
/begin COMPU_METHOD autosar_swc_val_CM_EPS_4_SteerPinionTq_421_dt "Q = V" IDENTICAL "%8.6" "" /end COMPU_METHOD
/begin COMPU_METHOD autosar_swc_val_CM_EPS_4_Tq2_421_dt "Q = V" IDENTICAL "%8.6" "" /end COMPU_METHOD
/begin COMPU_METHOD autosar_swc_val_CM_EPS_4_TqCtrlAvl_421_dt "Q = V" IDENTICAL "%0.6" "" /end COMPU_METHOD
/begin COMPU_METHOD autosar_swc_val_CM_EPS_4_TqCtrlSts_421_dt "Q = V" IDENTICAL "%0.6" "" /end COMPU_METHOD
/begin COMPU_METHOD autosar_swc_val_CM_FLCR_1_BlkSts_1050_dt "Q = V" IDENTICAL "%0.6" "" /end COMPU_METHOD
/begin COMPU_METHOD autosar_swc_val_CM_FLCR_1_CRC1_1050_dt "Q = V" IDENTICAL "%0.6" "" /end COMPU_METHOD
/begin COMPU_METHOD autosar_swc_val_CM_FLCR_1_Resd1_1050_dt "Q = V" IDENTICAL "%0.6" "" /end COMPU_METHOD
/begin COMPU_METHOD autosar_swc_val_CM_FLCR_1_RollgCntr1_1050_dt "Q = V" IDENTICAL "%0.6" "" /end COMPU_METHOD
/begin COMPU_METHOD autosar_swc_val_CM_FLCR_1_SysSt_1050_dt "Q = V" IDENTICAL "%0.6" "" /end COMPU_METHOD
/begin COMPU_METHOD autosar_swc_val_CM_FLCR_2_CRC1_1062_dt "Q = V" IDENTICAL "%0.6" "" /end COMPU_METHOD
/begin COMPU_METHOD autosar_swc_val_CM_FLCR_2_FCTAFCTBONOFFSts_1062_dt "Q = V" IDENTICAL "%0.6" "" /end COMPU_METHOD
/begin COMPU_METHOD autosar_swc_val_CM_FLCR_2_FCTAWarn_1062_dt "Q = V" IDENTICAL "%0.6" "" /end COMPU_METHOD
/begin COMPU_METHOD autosar_swc_val_CM_FLCR_2_FCTBCtrlA_1062_dt "Q = V" IDENTICAL "%8.6" "" /end COMPU_METHOD
/begin COMPU_METHOD autosar_swc_val_CM_FLCR_2_FCTBReq_1062_dt "Q = V" IDENTICAL "%0.6" "" /end COMPU_METHOD
/begin COMPU_METHOD autosar_swc_val_CM_FLCR_2_FCTBWarn_1062_dt "Q = V" IDENTICAL "%0.6" "" /end COMPU_METHOD
/begin COMPU_METHOD autosar_swc_val_CM_FLCR_2_Resd1_1062_dt "Q = V" IDENTICAL "%0.6" "" /end COMPU_METHOD
/begin COMPU_METHOD autosar_swc_val_CM_FLCR_2_RollgCntr1_1062_dt "Q = V" IDENTICAL "%0.6" "" /end COMPU_METHOD
/begin COMPU_METHOD autosar_swc_val_CM_FLZCU_12_CRC_1030_dt "Q = V" IDENTICAL "%0.6" "" /end COMPU_METHOD
/begin COMPU_METHOD autosar_swc_val_CM_FLZCU_12_RollgCntr_1030_dt "Q = V" IDENTICAL "%0.6" "" /end COMPU_METHOD
/begin COMPU_METHOD autosar_swc_val_CM_FLZCU_1_CRC_571_dt "Q = V" IDENTICAL "%0.6" "" /end COMPU_METHOD
/begin COMPU_METHOD autosar_swc_val_CM_FLZCU_1_Resd_571_dt "Q = V" IDENTICAL "%0.6" "" /end COMPU_METHOD
/begin COMPU_METHOD autosar_swc_val_CM_FLZCU_1_RollgCntr_571_dt "Q = V" IDENTICAL "%0.6" "" /end COMPU_METHOD
/begin COMPU_METHOD autosar_swc_val_CM_FLZCU_3_CRC_1120_dt "Q = V" IDENTICAL "%0.6" "" /end COMPU_METHOD
/begin COMPU_METHOD autosar_swc_val_CM_FLZCU_3_RollgCntr_1120_dt "Q = V" IDENTICAL "%0.6" "" /end COMPU_METHOD
/begin COMPU_METHOD autosar_swc_val_CM_FLZCU_9_ArmingSts_1181_dt "Q = V" IDENTICAL "%0.6" "" /end COMPU_METHOD
/begin COMPU_METHOD autosar_swc_val_CM_FLZCU_9_CRC_1181_dt "Q = V" IDENTICAL "%0.6" "" /end COMPU_METHOD
/begin COMPU_METHOD autosar_swc_val_CM_FLZCU_9_PowerMode_1181_dt "Q = V" IDENTICAL "%0.6" "" /end COMPU_METHOD
/begin COMPU_METHOD autosar_swc_val_CM_FLZCU_9_Resd1_1181_dt "Q = V" IDENTICAL "%0.6" "" /end COMPU_METHOD
/begin COMPU_METHOD autosar_swc_val_CM_FLZCU_9_RollgCntr_1181_dt "Q = V" IDENTICAL "%0.6" "" /end COMPU_METHOD
/begin COMPU_METHOD autosar_swc_val_CM_FLZCU_FLFoglightSts_1071_dt "Q = V" IDENTICAL "%0.6" "" /end COMPU_METHOD
/begin COMPU_METHOD autosar_swc_val_CM_FLZCU_FRFoglightSts_1071_dt "Q = V" IDENTICAL "%0.6" "" /end COMPU_METHOD
/begin COMPU_METHOD autosar_swc_val_CM_FLZCU_FrontFogLightSts_1071_dt "Q = V" IDENTICAL "%0.6" "" /end COMPU_METHOD
/begin COMPU_METHOD autosar_swc_val_CM_FLZCU_FrontWiperParkStatus_1030_dt "Q = V" IDENTICAL "%0.6" "" /end COMPU_METHOD
/begin COMPU_METHOD autosar_swc_val_CM_FLZCU_FrontWiperWipingStatus_1030_dt "Q = V" IDENTICAL "%0.6" "" /end COMPU_METHOD
/begin COMPU_METHOD autosar_swc_val_CM_FLZCU_HMASwSts_1071_dt "Q = V" IDENTICAL "%0.6" "" /end COMPU_METHOD
/begin COMPU_METHOD autosar_swc_val_CM_FLZCU_HighBeamFaults_1071_dt "Q = V" IDENTICAL "%0.6" "" /end COMPU_METHOD
/begin COMPU_METHOD autosar_swc_val_CM_FLZCU_HighBeamSts_1071_dt "Q = V" IDENTICAL "%0.6" "" /end COMPU_METHOD
/begin COMPU_METHOD autosar_swc_val_CM_FLZCU_LowBeamSts_1071_dt "Q = V" IDENTICAL "%0.6" "" /end COMPU_METHOD
/begin COMPU_METHOD autosar_swc_val_CM_FLZCU_ParkLightFaults_1071_dt "Q = V" IDENTICAL "%0.6" "" /end COMPU_METHOD
/begin COMPU_METHOD autosar_swc_val_CM_FLZCU_RearFogLightFaults_1071_dt "Q = V" IDENTICAL "%0.6" "" /end COMPU_METHOD
/begin COMPU_METHOD autosar_swc_val_CM_FLZCU_RearFogLightSts_1071_dt "Q = V" IDENTICAL "%0.6" "" /end COMPU_METHOD
/begin COMPU_METHOD autosar_swc_val_CM_FL_SeatBeltFaultStatus_571_dt "Q = V" IDENTICAL "%0.6" "" /end COMPU_METHOD
/begin COMPU_METHOD autosar_swc_val_CM_FL_SeatOccupiedSts_571_dt "Q = V" IDENTICAL "%0.6" "" /end COMPU_METHOD
/begin COMPU_METHOD autosar_swc_val_CM_FRCR_1_BlkSts_1067_dt "Q = V" IDENTICAL "%0.6" "" /end COMPU_METHOD
/begin COMPU_METHOD autosar_swc_val_CM_FRCR_1_CRC1_1067_dt "Q = V" IDENTICAL "%0.6" "" /end COMPU_METHOD
/begin COMPU_METHOD autosar_swc_val_CM_FRCR_1_Resd1_1067_dt "Q = V" IDENTICAL "%0.6" "" /end COMPU_METHOD
/begin COMPU_METHOD autosar_swc_val_CM_FRCR_1_RollgCntr1_1067_dt "Q = V" IDENTICAL "%0.6" "" /end COMPU_METHOD
/begin COMPU_METHOD autosar_swc_val_CM_FRCR_1_SysSt_1067_dt "Q = V" IDENTICAL "%0.6" "" /end COMPU_METHOD
/begin COMPU_METHOD autosar_swc_val_CM_FRZCU_1_CRC_683_dt "Q = V" IDENTICAL "%0.6" "" /end COMPU_METHOD
/begin COMPU_METHOD autosar_swc_val_CM_FRZCU_1_Resd_683_dt "Q = V" IDENTICAL "%0.6" "" /end COMPU_METHOD
/begin COMPU_METHOD autosar_swc_val_CM_FRZCU_1_RollgCntr_683_dt "Q = V" IDENTICAL "%0.6" "" /end COMPU_METHOD
/begin COMPU_METHOD autosar_swc_val_CM_FRZCU_7_CRC_1324_dt "Q = V" IDENTICAL "%0.6" "" /end COMPU_METHOD
/begin COMPU_METHOD autosar_swc_val_CM_FRZCU_7_RollgCntr_1324_dt "Q = V" IDENTICAL "%0.6" "" /end COMPU_METHOD
/begin COMPU_METHOD autosar_swc_val_CM_GearShiftPosInverse_321_dt "Q = V" IDENTICAL "%0.6" "" /end COMPU_METHOD
/begin COMPU_METHOD autosar_swc_val_CM_GearShiftPos_321_dt "Q = V" IDENTICAL "%0.6" "" /end COMPU_METHOD
/begin COMPU_METHOD autosar_swc_val_CM_HazardLightSW_571_dt "Q = V" IDENTICAL "%0.6" "" /end COMPU_METHOD
/begin COMPU_METHOD autosar_swc_val_CM_HoodLockSts_571_dt "Q = V" IDENTICAL "%0.6" "" /end COMPU_METHOD
/begin COMPU_METHOD autosar_swc_val_CM_HoodSts_571_dt "Q = V" IDENTICAL "%0.6" "" /end COMPU_METHOD
/begin COMPU_METHOD autosar_swc_val_CM_ICC_BD_11_CRC_1150_dt "Q = V" IDENTICAL "%0.6" "" /end COMPU_METHOD
/begin COMPU_METHOD autosar_swc_val_CM_ICC_BD_11_RollgCntr_1150_dt "Q = V" IDENTICAL "%0.6" "" /end COMPU_METHOD
/begin COMPU_METHOD autosar_swc_val_CM_ICC_DA_15_CRC_1157_dt "Q = V" IDENTICAL "%0.6" "" /end COMPU_METHOD
/begin COMPU_METHOD autosar_swc_val_CM_ICC_DA_15_ExtremeEnergySaveMode_1157_dt "Q = V" IDENTICAL "%0.6" "" /end COMPU_METHOD
/begin COMPU_METHOD autosar_swc_val_CM_ICC_DA_15_Resd_1157_dt "Q = V" IDENTICAL "%0.6" "" /end COMPU_METHOD
/begin COMPU_METHOD autosar_swc_val_CM_ICC_DA_15_RollgCntr_1157_dt "Q = V" IDENTICAL "%0.6" "" /end COMPU_METHOD
/begin COMPU_METHOD autosar_swc_val_CM_ICC_DistractionStatus_1157_dt "Q = V" IDENTICAL "%0.6" "" /end COMPU_METHOD
/begin COMPU_METHOD autosar_swc_val_CM_ICC_DriveDrosinessLevel_1150_dt "Q = V" IDENTICAL "%0.6" "" /end COMPU_METHOD
/begin COMPU_METHOD autosar_swc_val_CM_ICC_IHCfunctionSw_1157_dt "Q = V" IDENTICAL "%0.6" "" /end COMPU_METHOD
/begin COMPU_METHOD autosar_swc_val_CM_LHFDoorLockSts_571_dt "Q = V" IDENTICAL "%0.6" "" /end COMPU_METHOD
/begin COMPU_METHOD autosar_swc_val_CM_LHFSeatBeltSW_571_dt "Q = V" IDENTICAL "%0.6" "" /end COMPU_METHOD
/begin COMPU_METHOD autosar_swc_val_CM_LHFdoorSts_571_dt "Q = V" IDENTICAL "%0.6" "" /end COMPU_METHOD
/begin COMPU_METHOD autosar_swc_val_CM_LHTurnSW_571_dt "Q = V" IDENTICAL "%0.6" "" /end COMPU_METHOD
/begin COMPU_METHOD autosar_swc_val_CM_LHTurnlightSts_571_dt "Q = V" IDENTICAL "%0.6" "" /end COMPU_METHOD
/begin COMPU_METHOD autosar_swc_val_CM_LowBeamFaults_1256_dt "Q = V" IDENTICAL "%0.6" "" /end COMPU_METHOD
/begin COMPU_METHOD autosar_swc_val_CM_ParkLightSts_683_dt "Q = V" IDENTICAL "%0.6" "" /end COMPU_METHOD
/begin COMPU_METHOD autosar_swc_val_CM_RHFDoorLockSts_683_dt "Q = V" IDENTICAL "%0.6" "" /end COMPU_METHOD
/begin COMPU_METHOD autosar_swc_val_CM_RHFDoorSts_683_dt "Q = V" IDENTICAL "%0.6" "" /end COMPU_METHOD
/begin COMPU_METHOD autosar_swc_val_CM_RHRDoorLockSts_683_dt "Q = V" IDENTICAL "%0.6" "" /end COMPU_METHOD
/begin COMPU_METHOD autosar_swc_val_CM_RHRDoorSts_683_dt "Q = V" IDENTICAL "%0.6" "" /end COMPU_METHOD
/begin COMPU_METHOD autosar_swc_val_CM_RHTurnSW_571_dt "Q = V" IDENTICAL "%0.6" "" /end COMPU_METHOD
/begin COMPU_METHOD autosar_swc_val_CM_RHTurnlightSts_571_dt "Q = V" IDENTICAL "%0.6" "" /end COMPU_METHOD
/begin COMPU_METHOD autosar_swc_val_CM_RLHS_2_AmbBrightness_1120_dt "Q = V" IDENTICAL "%0.6" "" /end COMPU_METHOD
/begin COMPU_METHOD autosar_swc_val_CM_RLHS_2_IRBrightness_1120_dt "Q = V" IDENTICAL "%0.6" "" /end COMPU_METHOD
/begin COMPU_METHOD autosar_swc_val_CM_RLHS_Humid_Temp_Error_1076_dt "Q = V" IDENTICAL "%0.6" "" /end COMPU_METHOD
/begin COMPU_METHOD autosar_swc_val_CM_RLHS_LiSwithReason_1120_dt "Q = V" IDENTICAL "%0.6" "" /end COMPU_METHOD
/begin COMPU_METHOD autosar_swc_val_CM_RLHS_Rainfall_1120_dt "Q = V" IDENTICAL "%0.6" "" /end COMPU_METHOD
/begin COMPU_METHOD autosar_swc_val_CM_RearViewFoldSts_1030_dt "Q = V" IDENTICAL "%0.6" "" /end COMPU_METHOD
/begin COMPU_METHOD autosar_swc_val_CM_STAT_ParkButton_321_dt "Q = V" IDENTICAL "%0.6" "" /end COMPU_METHOD
/begin COMPU_METHOD autosar_swc_val_CM_STAT_ShifterLeverFault_321_dt "Q = V" IDENTICAL "%0.6" "" /end COMPU_METHOD
/begin COMPU_METHOD autosar_swc_val_CM_TirePressureSystemFailSts_1324_dt "Q = V" IDENTICAL "%0.6" "" /end COMPU_METHOD
/begin COMPU_METHOD autosar_swc_val_CM_TirePressureWarningLampSts_1324_dt "Q = V" IDENTICAL "%0.6" "" /end COMPU_METHOD
/begin COMPU_METHOD autosar_swc_val_CM_TorsionBarTorqueDir_715_dt "Q = V" IDENTICAL "%0.6" "" /end COMPU_METHOD
/begin COMPU_METHOD autosar_swc_val_CM_TorsionBarTorque_715_dt "Q = V" IDENTICAL "%8.6" "" /end COMPU_METHOD
/begin COMPU_METHOD autosar_swc_val_CM_TosionBarTorqueValid_715_dt "Q = V" IDENTICAL "%0.6" "" /end COMPU_METHOD
/begin COMPU_METHOD autosar_swc_val_CM_TotalOdometer_km_OBD_1252_dt "Q = V" IDENTICAL "%8.6" "" /end COMPU_METHOD
/begin COMPU_METHOD autosar_swc_val_CM_TrunLightFaults_1260_dt "Q = V" IDENTICAL "%0.6" "" /end COMPU_METHOD
/begin COMPU_METHOD autosar_swc_val_CM_boolean "Q = V" IDENTICAL "%1.0" "" /end COMPU_METHOD
/begin COMPU_METHOD autosar_swc_val_CM_double "Q = V" IDENTICAL "%15.10" "" /end COMPU_METHOD
/begin COMPU_METHOD autosar_swc_val_CM_int32 "Q = V" IDENTICAL "%10.0" "" /end COMPU_METHOD
/begin COMPU_METHOD autosar_swc_val_CM_single "Q = V" IDENTICAL "%8.6" "" /end COMPU_METHOD
/begin COMPU_METHOD autosar_swc_val_CM_uint16 "Q = V" IDENTICAL "%5.0" "" /end COMPU_METHOD
/begin COMPU_METHOD autosar_swc_val_CM_uint32 "Q = V" IDENTICAL "%10.0" "" /end COMPU_METHOD
/begin COMPU_METHOD autosar_swc_val_CM_uint64 "Q = V" IDENTICAL "%20.0" "" /end COMPU_METHOD
/begin COMPU_METHOD autosar_swc_val_CM_uint8 "Q = V" IDENTICAL "%3.0" "" /end COMPU_METHOD
/begin GROUP SwcIn_ADASFuncConfig ""
 /begin REF_MEASUREMENT SwcIn_ADASFuncConfig.CONFIG_ACC SwcIn_ADASFuncConfig.CONFIG_LCC SwcIn_ADASFuncConfig.CONFIG_ALC SwcIn_ADASFuncConfig.CONFIG_NOH SwcIn_ADASFuncConfig.CONFIG_LDW SwcIn_ADASFuncConfig.CONFIG_LKA SwcIn_ADASFuncConfig.CONFIG_ELK SwcIn_ADASFuncConfig.CONFIG_IE SwcIn_ADASFuncConfig.CONFIG_FCW SwcIn_ADASFuncConfig.CONFIG_AEB SwcIn_ADASFuncConfig.CONFIG_ESS SwcIn_ADASFuncConfig.CONFIG_AES SwcIn_ADASFuncConfig.CONFIG_ISL SwcIn_ADASFuncConfig.CONFIG_IntellgntCurve SwcIn_ADASFuncConfig.CONFIG_DAI SwcIn_ADASFuncConfig.CONFIG_TSR SwcIn_ADASFuncConfig.CONFIG_SLA SwcIn_ADASFuncConfig.CONFIG_IHC SwcIn_ADASFuncConfig.CONFIG_ACCIC /end REF_MEASUREMENT
/end GROUP
/begin GROUP SwcIn_AEB_TAROBJ ""
 /begin REF_MEASUREMENT SwcIn_AEB_TAROBJ.PrimTarInPahNow SwcIn_AEB_TAROBJ.InPathPredict SwcIn_AEB_TAROBJ.FusionType SwcIn_AEB_TAROBJ.ObjectIndex SwcIn_AEB_TAROBJ.ObjectType SwcIn_AEB_TAROBJ.ObjectMovingState SwcIn_AEB_TAROBJ.ObjectMovingOrientation SwcIn_AEB_TAROBJ.ObjectLength SwcIn_AEB_TAROBJ.ObjectWidth SwcIn_AEB_TAROBJ.ObjectHeadingAngle SwcIn_AEB_TAROBJ.Object_DX SwcIn_AEB_TAROBJ.Object_DY SwcIn_AEB_TAROBJ.Object_RangeX SwcIn_AEB_TAROBJ.Object_RangeY SwcIn_AEB_TAROBJ.Object_Abs_SPEED SwcIn_AEB_TAROBJ.Object_Abs_VX SwcIn_AEB_TAROBJ.Object_Abs_VY SwcIn_AEB_TAROBJ.Object_Abs_AX SwcIn_AEB_TAROBJ.Object_Abs_AY SwcIn_AEB_TAROBJ.TiToCllsn SwcIn_AEB_TAROBJ.ANegLgtRqrd SwcIn_AEB_TAROBJ.ANegLgtRqrdForPrimTarWarn SwcIn_AEB_TAROBJ.CrvtRqrdLe SwcIn_AEB_TAROBJ.CrvtRqrdRi SwcIn_AEB_TAROBJ.ALatRqrd SwcIn_AEB_TAROBJ.Ego_vxvRefMs SwcIn_AEB_TAROBJ.Ego_axvRefMs2 SwcIn_AEB_TAROBJ.Ego_kapTraj SwcIn_AEB_TAROBJ.Ego_ayvRefMs2 SwcIn_AEB_TAROBJ.Ego_psiDtOpt SwcIn_AEB_TAROBJ.TTC SwcIn_AEB_TAROBJ.FCW_ANegLgtRqrdForWarn SwcIn_AEB_TAROBJ.FCW_startConditionMet SwcIn_AEB_TAROBJ.BrakeThreat SwcIn_AEB_TAROBJ.SteerThreat SwcIn_AEB_TAROBJ.Sceniaro_OK SwcIn_AEB_TAROBJ.Host_State SwcIn_AEB_TAROBJ.Sceniaro_Flag SwcIn_AEB_TAROBJ.ObjectID SwcIn_AEB_TAROBJ.camID /end REF_MEASUREMENT
/end GROUP
/begin GROUP SwcIn_ASU_1 ""
 /begin REF_MEASUREMENT SwcIn_ASU_1.ASU_1_CRC1 SwcIn_ASU_1.ASU_1_RollgCntr1 SwcIn_ASU_1.ASU_1_ASUSysFailrSts SwcIn_ASU_1.ASU_1_SuspCurrentLvl SwcIn_ASU_1.ASU_1_ECASSysSts SwcIn_ASU_1.ASU_1_SuspTmpAdjSts SwcIn_ASU_1.ASU_1_MaintainMod SwcIn_ASU_1.ASU_1_ECASErrSts SwcIn_ASU_1.ASU_1_SuspTarLvl SwcIn_ASU_1.ASU_1_EasyEntryEna SwcIn_ASU_1.ASU_1_AutoEasyEntryFb SwcIn_ASU_1.ASU_1_ECASModeFb SwcIn_ASU_1.ASU_1_BluetoothManEasyEntryFb SwcIn_ASU_1.ASU_1_HighwayModFb SwcIn_ASU_1.ASU_1_CDCErrSts SwcIn_ASU_1.ASU_1_SuspDampingLvl /end REF_MEASUREMENT
/end GROUP
/begin GROUP SwcIn_ASU_2 ""
 /begin REF_MEASUREMENT SwcIn_ASU_2.ASU_2_CRC1 SwcIn_ASU_2.ASU_2_RollgCntr1 SwcIn_ASU_2.ASU_2_LFHeight SwcIn_ASU_2.ASU_2_RFHeight SwcIn_ASU_2.ASU_2_LRHeight SwcIn_ASU_2.ASU_2_RRHeight SwcIn_ASU_2.ASU_2_sensorErrorSts /end REF_MEASUREMENT
/end GROUP
/begin GROUP SwcIn_BMS_2_G "" /begin REF_MEASUREMENT SwcIn_BMS_2_G.BMS_SOCLight /end REF_MEASUREMENT /end GROUP
/begin GROUP SwcIn_BMS_3_G ""
 /begin REF_MEASUREMENT SwcIn_BMS_3_G.BMS_ChgWireConnect_LightSts SwcIn_BMS_3_G.BMS_Chg_LightSts /end REF_MEASUREMENT
/end GROUP
/begin GROUP SwcIn_CSA_1 ""
 /begin REF_MEASUREMENT SwcIn_CSA_1.CSA_1_CRC SwcIn_CSA_1.CSA_1_RollgCntr SwcIn_CSA_1.CSA_1_Resd SwcIn_CSA_1.GearShiftPos SwcIn_CSA_1.GearShiftPosInverse SwcIn_CSA_1.STAT_ParkButton SwcIn_CSA_1.STAT_ShifterLeverFault SwcIn_CSA_1.DriveModeActive SwcIn_CSA_1.DriveModeReq /end REF_MEASUREMENT
/end GROUP
/begin GROUP SwcIn_CSA_2 ""
 /begin REF_MEASUREMENT SwcIn_CSA_2.CSA_2_CRC1 SwcIn_CSA_2.CSA_2_RollgCntr1 SwcIn_CSA_2.CSA_2_Resd1 SwcIn_CSA_2.CSA_2_AllWarningInfo SwcIn_CSA_2.CSA_2_TurnSigLvrCmd SwcIn_CSA_2.CSA_2_WshrFrntCmd /end REF_MEASUREMENT
/end GROUP
/begin GROUP SwcIn_DIAG_OBD_REQ_Broadcast "" /begin REF_MEASUREMENT SwcIn_DIAG_OBD_REQ_Broadcast.Diag_Functional_REQ /end REF_MEASUREMENT /end GROUP
/begin GROUP SwcIn_Diag_FCM_REQ "" /begin REF_MEASUREMENT SwcIn_Diag_FCM_REQ.Diag_FCM_REQ /end REF_MEASUREMENT /end GROUP
/begin GROUP SwcIn_EPB_R_1 ""
 /begin REF_MEASUREMENT SwcIn_EPB_R_1.EPB_R_1_CRC1 SwcIn_EPB_R_1.EPB_R_1_RollgCntr1 SwcIn_EPB_R_1.EPB_R_1_Resd1 SwcIn_EPB_R_1.EPB_1_ActrSt SwcIn_EPB_R_1.EPB_1_RWUSt SwcIn_EPB_R_1.EPB_1_DynBrkgSt SwcIn_EPB_R_1.EPB_1_EPBAvlSt SwcIn_EPB_R_1.EPB_1_ParkBrkCpby SwcIn_EPB_R_1.EPB_1_FltLvl SwcIn_EPB_R_1.EPB_1_DrvrRqParkBrk SwcIn_EPB_R_1.EPB_1_DrvrRqParkBrkVld SwcIn_EPB_R_1.EPB_R_1_CRC2 SwcIn_EPB_R_1.EPB_R_1_RollgCntr2 SwcIn_EPB_R_1.EPB_R_1_Resd2 SwcIn_EPB_R_1.EPB_R_1_BrkLitReq SwcIn_EPB_R_1.EPB_R_1_Flt_Lamp SwcIn_EPB_R_1.EPB_R_1_Park_Lamp SwcIn_EPB_R_1.EPB_R_1_ActrSt SwcIn_EPB_R_1.EPB_R_1_CDP_Req SwcIn_EPB_R_1.EPB_R_1_RWU_St SwcIn_EPB_R_1.EPB_R_1_Dyn_BrkgSt SwcIn_EPB_R_1.EPB_R_1_EPB_R_1Avl_St SwcIn_EPB_R_1.EPB_R_1_TextDisp SwcIn_EPB_R_1.EPB_R_1_FltLvl SwcIn_EPB_R_1.EPB_R_1_DrvrRqParkBrk SwcIn_EPB_R_1.EPB_R_1_DrvrRqParkBrkVld /end REF_MEASUREMENT
/end GROUP
/begin GROUP SwcIn_EPS_1 ""
 /begin REF_MEASUREMENT SwcIn_EPS_1.EPS_1_CRC SwcIn_EPS_1.EPS_1_RollgCntr SwcIn_EPS_1.EPS_1_Resd SwcIn_EPS_1.EPSFailSts /end REF_MEASUREMENT
/end GROUP
/begin GROUP SwcIn_EPS_3 ""
 /begin REF_MEASUREMENT SwcIn_EPS_3.EPS_3_CRC SwcIn_EPS_3.EPS_3_RollgCntr SwcIn_EPS_3.EPS_3_Resd SwcIn_EPS_3.TorsionBarTorque SwcIn_EPS_3.TorsionBarTorqueDir SwcIn_EPS_3.TosionBarTorqueValid /end REF_MEASUREMENT
/end GROUP
/begin GROUP SwcIn_EPS_4 ""
 /begin REF_MEASUREMENT SwcIn_EPS_4.EPS_4_CRC1 SwcIn_EPS_4.EPS_4_RollgCntr1 SwcIn_EPS_4.EPS_4_Resd1 SwcIn_EPS_4.EPS_4_AgParkCtrlAvl SwcIn_EPS_4.EPS_4_AgPilotCtrlAvl SwcIn_EPS_4.EPS_4_AgPilotCtrlSts SwcIn_EPS_4.EPS_4_TqCtrlAvl SwcIn_EPS_4.EPS_4_TqCtrlSts SwcIn_EPS_4.EPS_4_LdwWarnSts SwcIn_EPS_4.EPS_4_LdwWarnStsVD SwcIn_EPS_4.EPS_4_AgParkCtrlSts SwcIn_EPS_4.EPS_4_CRC2 SwcIn_EPS_4.EPS_4_RollgCntr2 SwcIn_EPS_4.EPS_4_Resd2 SwcIn_EPS_4.EPS_4_SteerPinionTq SwcIn_EPS_4.EPS_4_SteerPinionTqVld SwcIn_EPS_4.EPS_4_AsscMotCrtTq SwcIn_EPS_4.EPS_4_AsscMotCrtTqVld SwcIn_EPS_4.EPS_4_CRC3 SwcIn_EPS_4.EPS_4_RollgCntr3 SwcIn_EPS_4.EPS_4_Resd3 SwcIn_EPS_4.EPS_4_SteerDrvrOvrd SwcIn_EPS_4.EPS_4_SteerDrvrOvrdVld SwcIn_EPS_4.EPS_4_SteerMod SwcIn_EPS_4.EPS_4_CRC4 SwcIn_EPS_4.EPS_4_RollgCntr4 SwcIn_EPS_4.EPS_4_Resd4 SwcIn_EPS_4.EPS_4_Tq2 SwcIn_EPS_4.EPS_4_CRC5 SwcIn_EPS_4.EPS_4_RollgCntr5 SwcIn_EPS_4.EPS_4_Resd5 SwcIn_EPS_4.EPS_4_OverrangeFeedback SwcIn_EPS_4.EPS_4_ADSMaxTq SwcIn_EPS_4.EPS_4_ADSMinTq SwcIn_EPS_4.EPS_4_OverrangeFeedbackVD /end REF_MEASUREMENT
/end GROUP
/begin GROUP SwcIn_FLCR_1 ""
 /begin REF_MEASUREMENT SwcIn_FLCR_1.FLCR_1_CRC1 SwcIn_FLCR_1.FLCR_1_RollgCntr1 SwcIn_FLCR_1.FLCR_1_Resd1 SwcIn_FLCR_1.FLCR_1_SysSt SwcIn_FLCR_1.FLCR_1_BlkSts /end REF_MEASUREMENT
/end GROUP
/begin GROUP SwcIn_FLCR_2 ""
 /begin REF_MEASUREMENT SwcIn_FLCR_2.FLCR_2_CRC1 SwcIn_FLCR_2.FLCR_2_RollgCntr1 SwcIn_FLCR_2.FLCR_2_Resd1 SwcIn_FLCR_2.FLCR_2_FCTAWarn SwcIn_FLCR_2.FLCR_2_FCTBWarn SwcIn_FLCR_2.FLCR_2_FCTBReq SwcIn_FLCR_2.FLCR_2_FCTBCtrlA SwcIn_FLCR_2.FLCR_2_FCTAFCTBONOFFSts /end REF_MEASUREMENT
/end GROUP
/begin GROUP SwcIn_FLZCU_1 ""
 /begin REF_MEASUREMENT SwcIn_FLZCU_1.FLZCU_1_CRC SwcIn_FLZCU_1.FLZCU_1_RollgCntr SwcIn_FLZCU_1.FLZCU_1_Resd SwcIn_FLZCU_1.HoodLockSts SwcIn_FLZCU_1.FL_SeatOccupiedSts SwcIn_FLZCU_1.LHTurnlightSts SwcIn_FLZCU_1.RHTurnlightSts SwcIn_FLZCU_1.HoodSts SwcIn_FLZCU_1.LHFDoorLockSts SwcIn_FLZCU_1.LHFdoorSts SwcIn_FLZCU_1.LHTurnSW SwcIn_FLZCU_1.RHTurnSW SwcIn_FLZCU_1.HazardLightSW SwcIn_FLZCU_1.LHFSeatBeltSW SwcIn_FLZCU_1.DirectionIndLeft SwcIn_FLZCU_1.DirectionIndRight SwcIn_FLZCU_1.FL_SeatBeltFaultStatus /end REF_MEASUREMENT
/end GROUP
/begin GROUP SwcIn_FLZCU_12 ""
 /begin REF_MEASUREMENT SwcIn_FLZCU_12.FLZCU_12_CRC SwcIn_FLZCU_12.FLZCU_12_RollgCntr SwcIn_FLZCU_12.FLZCU_FrontWiperParkStatus SwcIn_FLZCU_12.FLZCU_FrontWiperWipingStatus SwcIn_FLZCU_12.RearViewFoldSts /end REF_MEASUREMENT
/end GROUP
/begin GROUP SwcIn_FLZCU_13 "" /begin REF_MEASUREMENT SwcIn_FLZCU_13.RLHS_Humid_Temp_Error /end REF_MEASUREMENT /end GROUP
/begin GROUP SwcIn_FLZCU_15 ""
 /begin REF_MEASUREMENT SwcIn_FLZCU_15.FLZCU_FLFoglightSts SwcIn_FLZCU_15.FLZCU_FRFoglightSts SwcIn_FLZCU_15.FLZCU_RearFogLightSts SwcIn_FLZCU_15.FLZCU_LowBeamSts SwcIn_FLZCU_15.FLZCU_HighBeamSts SwcIn_FLZCU_15.FLZCU_HighBeamFaults SwcIn_FLZCU_15.FLZCU_RearFogLightFaults SwcIn_FLZCU_15.FLZCU_ParkLightFaults SwcIn_FLZCU_15.FLZCU_HMASwSts SwcIn_FLZCU_15.FLZCU_FrontFogLightSts /end REF_MEASUREMENT
/end GROUP
/begin GROUP SwcIn_FLZCU_3 ""
 /begin REF_MEASUREMENT SwcIn_FLZCU_3.FLZCU_3_CRC SwcIn_FLZCU_3.FLZCU_3_RollgCntr SwcIn_FLZCU_3.RLHS_2_AmbBrightness SwcIn_FLZCU_3.RLHS_2_IRBrightness SwcIn_FLZCU_3.RLHS_Rainfall SwcIn_FLZCU_3.RLHS_LiSwithReason /end REF_MEASUREMENT
/end GROUP
/begin GROUP SwcIn_FLZCU_7 "" /begin REF_MEASUREMENT SwcIn_FLZCU_7.TrunLightFaults /end REF_MEASUREMENT /end GROUP
/begin GROUP SwcIn_FLZCU_9 ""
 /begin REF_MEASUREMENT SwcIn_FLZCU_9.FLZCU_9_CRC SwcIn_FLZCU_9.FLZCU_9_RollgCntr SwcIn_FLZCU_9.FLZCU_9_Resd1 SwcIn_FLZCU_9.FLZCU_9_PowerMode SwcIn_FLZCU_9.FLZCU_9_ArmingSts /end REF_MEASUREMENT
/end GROUP
/begin GROUP SwcIn_FM_SAF_OUT "" /begin SUB_GROUP SwcIn_FM_SAF_OUT.SftyErrInfo /end SUB_GROUP /begin REF_MEASUREMENT SwcIn_FM_SAF_OUT.SftyErrLvl SwcIn_FM_SAF_OUT.SftyCmd /end REF_MEASUREMENT /end GROUP
/begin GROUP SwcIn_FM_SAF_OUT.SftyErrInfo ""
 /begin REF_MEASUREMENT SwcIn_FM_SAF_OUT.SftyErrInfo.SftyVehSpdChassisVld SwcIn_FM_SAF_OUT.SftyErrInfo.SftyVehSpdChassis SwcIn_FM_SAF_OUT.SftyErrInfo.SftyModeFuSa SwcIn_FM_SAF_OUT.SftyErrInfo.SftyErr_0 SwcIn_FM_SAF_OUT.SftyErrInfo.SftyErr_1 SwcIn_FM_SAF_OUT.SftyErrInfo.SftyErr_2 SwcIn_FM_SAF_OUT.SftyErrInfo.SftyErr_3 SwcIn_FM_SAF_OUT.SftyErrInfo.SftyErr_4 SwcIn_FM_SAF_OUT.SftyErrInfo.SftyErr_5 SwcIn_FM_SAF_OUT.SftyErrInfo.SftyErr_6 SwcIn_FM_SAF_OUT.SftyErrInfo.SftyErr_7 /end REF_MEASUREMENT
/end GROUP
/begin GROUP SwcIn_FM_SAF_OUT.SftyErrInfoQue[0] ""
 /begin REF_MEASUREMENT SwcIn_FM_SAF_OUT.SftyErrInfoQue[0].SftyErrID SwcIn_FM_SAF_OUT.SftyErrInfoQue[0].TrigTimeStamp /end REF_MEASUREMENT
/end GROUP
/begin GROUP SwcIn_FRCR_1 ""
 /begin REF_MEASUREMENT SwcIn_FRCR_1.FRCR_1_CRC1 SwcIn_FRCR_1.FRCR_1_RollgCntr1 SwcIn_FRCR_1.FRCR_1_Resd1 SwcIn_FRCR_1.FRCR_1_SysSt SwcIn_FRCR_1.FRCR_1_BlkSts /end REF_MEASUREMENT
/end GROUP
/begin GROUP SwcIn_FRZCU_1 ""
 /begin REF_MEASUREMENT SwcIn_FRZCU_1.FRZCU_1_CRC SwcIn_FRZCU_1.FRZCU_1_RollgCntr SwcIn_FRZCU_1.FRZCU_1_Resd SwcIn_FRZCU_1.RHFDoorSts SwcIn_FRZCU_1.ParkLightSts SwcIn_FRZCU_1.RHRDoorSts SwcIn_FRZCU_1.RHFDoorLockSts SwcIn_FRZCU_1.RHRDoorLockSts /end REF_MEASUREMENT
/end GROUP
/begin GROUP SwcIn_FRZCU_7 ""
 /begin REF_MEASUREMENT SwcIn_FRZCU_7.FRZCU_7_CRC SwcIn_FRZCU_7.FRZCU_7_RollgCntr SwcIn_FRZCU_7.TirePressureWarningLampSts SwcIn_FRZCU_7.TirePressureSystemFailSts /end REF_MEASUREMENT
/end GROUP
/begin GROUP SwcIn_FRZCU_8 "" /begin REF_MEASUREMENT SwcIn_FRZCU_8.LowBeamFaults /end REF_MEASUREMENT /end GROUP
/begin GROUP SwcIn_Fusa_CAN_E2E ""
 /begin REF_MEASUREMENT SwcIn_Fusa_CAN_E2E.Fusa_ACU_1_CRC1_Error SwcIn_Fusa_CAN_E2E.Fusa_ACU_1_RollgCntr1_Error SwcIn_Fusa_CAN_E2E.Fusa_ACU_2_CRC1_Error SwcIn_Fusa_CAN_E2E.Fusa_ACU_2_RollgCntr1_Error SwcIn_Fusa_CAN_E2E.Fusa_ACU_2_Timeout SwcIn_Fusa_CAN_E2E.Fusa_ACU_3_CRC1_Error SwcIn_Fusa_CAN_E2E.Fusa_ACU_3_RollgCntr1_Error SwcIn_Fusa_CAN_E2E.Fusa_ACU_3_Timeout SwcIn_Fusa_CAN_E2E.Fusa_EPB_R_1_CRC1_Error SwcIn_Fusa_CAN_E2E.Fusa_EPB_R_1_RollgCntr1_Error SwcIn_Fusa_CAN_E2E.Fusa_EPB_R_1_CRC2_Error SwcIn_Fusa_CAN_E2E.Fusa_EPB_R_1_RollgCntr2_Error SwcIn_Fusa_CAN_E2E.Fusa_EPB_R_1_Timeout SwcIn_Fusa_CAN_E2E.Fusa_EPS_1_CRC_Error SwcIn_Fusa_CAN_E2E.Fusa_EPS_1_RollgCntr_Error SwcIn_Fusa_CAN_E2E.Fusa_EPS_1_Timeout SwcIn_Fusa_CAN_E2E.Fusa_EPS_3_CRC_Error SwcIn_Fusa_CAN_E2E.Fusa_EPS_3_RollgCntr_Error SwcIn_Fusa_CAN_E2E.Fusa_EPS_3_Timeout SwcIn_Fusa_CAN_E2E.Fusa_EPS_4_CRC1_Error SwcIn_Fusa_CAN_E2E.Fusa_EPS_4_RollgCntr1_Error SwcIn_Fusa_CAN_E2E.Fusa_EPS_4_CRC2_Error SwcIn_Fusa_CAN_E2E.Fusa_EPS_4_RollgCntr2_Error SwcIn_Fusa_CAN_E2E.Fusa_EPS_4_CRC3_Error SwcIn_Fusa_CAN_E2E.Fusa_EPS_4_RollgCntr3_Error SwcIn_Fusa_CAN_E2E.Fusa_EPS_4_CRC4_Error SwcIn_Fusa_CAN_E2E.Fusa_EPS_4_RollgCntr4_Error SwcIn_Fusa_CAN_E2E.Fusa_EPS_4_CRC5_Error SwcIn_Fusa_CAN_E2E.Fusa_EPS_4_RollgCntr5_Error SwcIn_Fusa_CAN_E2E.Fusa_EPS_4_Timeout SwcIn_Fusa_CAN_E2E.Fusa_SAM_1_CRC_Error SwcIn_Fusa_CAN_E2E.Fusa_SAM_1_RollgCntr_Error SwcIn_Fusa_CAN_E2E.Fusa_SAS_1_Timeout SwcIn_Fusa_CAN_E2E.Fusa_ONEBOX_1_CRC1_Error SwcIn_Fusa_CAN_E2E.Fusa_ONEBOX_1_RollgCntr1_Error SwcIn_Fusa_CAN_E2E.Fusa_ONEBOX_1_CRC2_Error SwcIn_Fusa_CAN_E2E.Fusa_ONEBOX_1_RollgCntr2_Error SwcIn_Fusa_CAN_E2E.Fusa_ONEBOX_1_Timeout SwcIn_Fusa_CAN_E2E.Fusa_ONEBOX_3_CRC1_Error SwcIn_Fusa_CAN_E2E.Fusa_ONEBOX_3_RollgCntr1_Error SwcIn_Fusa_CAN_E2E.Fusa_ONEBOX_3_CRC2_Error SwcIn_Fusa_CAN_E2E.Fusa_ONEBOX_3_RollgCntr2_Error SwcIn_Fusa_CAN_E2E.Fusa_ONEBOX_3_CRC4_Error SwcIn_Fusa_CAN_E2E.Fusa_ONEBOX_3_RollgCntr4_Error SwcIn_Fusa_CAN_E2E.Fusa_ONEBOX_3_Timeout SwcIn_Fusa_CAN_E2E.Fusa_ONEBOX_4_CRC1_Error SwcIn_Fusa_CAN_E2E.Fusa_ONEBOX_4_RollgCntr1_Error SwcIn_Fusa_CAN_E2E.Fusa_ONEBOX_4_CRC2_Error SwcIn_Fusa_CAN_E2E.Fusa_ONEBOX_4_RollgCntr2_Error SwcIn_Fusa_CAN_E2E.Fusa_ONEBOX_4_CRC3_Error SwcIn_Fusa_CAN_E2E.Fusa_ONEBOX_4_RollgCntr3_Error SwcIn_Fusa_CAN_E2E.Fusa_ONEBOX_4_CRC4_Error SwcIn_Fusa_CAN_E2E.Fusa_ONEBOX_4_RollgCntr4_Error SwcIn_Fusa_CAN_E2E.Fusa_ONEBOX_4_Timeout SwcIn_Fusa_CAN_E2E.Fusa_ONEBOX_5_CRC1_Error SwcIn_Fusa_CAN_E2E.Fusa_ONEBOX_5_RollgCntr1_Error SwcIn_Fusa_CAN_E2E.Fusa_ONEBOX_5_Timeout SwcIn_Fusa_CAN_E2E.Fusa_ONEBOX_2_G_CRC_Error SwcIn_Fusa_CAN_E2E.Fusa_ONEBOX_2_G_RollgCntr_Error SwcIn_Fusa_CAN_E2E.Fusa_ONEBOX_2_G_Timeout SwcIn_Fusa_CAN_E2E.Fusa_VCU_1_G_CRC_Error SwcIn_Fusa_CAN_E2E.Fusa_VCU_1_G_RollgCntr_Error SwcIn_Fusa_CAN_E2E.Fusa_VCU_1_G_Timeout SwcIn_Fusa_CAN_E2E.Fusa_VCU_2_G_CRC_Error SwcIn_Fusa_CAN_E2E.Fusa_VCU_2_G_RollgCntr_Error SwcIn_Fusa_CAN_E2E.Fusa_VCU_2_G_Timeout SwcIn_Fusa_CAN_E2E.Fusa_VCU_10_CRC_Error SwcIn_Fusa_CAN_E2E.Fusa_VCU_10_RollgCntr_Error SwcIn_Fusa_CAN_E2E.Fusa_VCU_COM_10_Timeout SwcIn_Fusa_CAN_E2E.Fusa_VCU_11_CRC1_Error SwcIn_Fusa_CAN_E2E.Fusa_VCU_11_RollgCntr1_Error SwcIn_Fusa_CAN_E2E.Fusa_VCU_11_CRC2_Error SwcIn_Fusa_CAN_E2E.Fusa_VCU_11_RollgCntr2_Error SwcIn_Fusa_CAN_E2E.Fusa_VCU_11_CRC3_Error SwcIn_Fusa_CAN_E2E.Fusa_VCU_11_RollgCntr3_Error SwcIn_Fusa_CAN_E2E.Fusa_VCU_11_CRC4_Error SwcIn_Fusa_CAN_E2E.Fusa_VCU_11_RollgCntr4_Error SwcIn_Fusa_CAN_E2E.Fusa_VCU_ONEBOX_11_Timeout SwcIn_Fusa_CAN_E2E.Fusa_VCU_12_CRC1_Error SwcIn_Fusa_CAN_E2E.Fusa_VCU_12_RollgCntr1_Error SwcIn_Fusa_CAN_E2E.Fusa_VCU_12_CRC2_Error SwcIn_Fusa_CAN_E2E.Fusa_VCU_12_RollgCntr2_Error SwcIn_Fusa_CAN_E2E.Fusa_VCU_12_CRC3_Error SwcIn_Fusa_CAN_E2E.Fusa_VCU_12_RollgCntr3_Error SwcIn_Fusa_CAN_E2E.Fusa_VCU_ADCC_12_Timeout SwcIn_Fusa_CAN_E2E.Fusa_ASU_1_CRC1_Error SwcIn_Fusa_CAN_E2E.Fusa_ASU_1_RollgCntr1_Error SwcIn_Fusa_CAN_E2E.Fusa_ASU_2_CRC1_Error SwcIn_Fusa_CAN_E2E.Fusa_ASU_2_RollgCntr1_Error SwcIn_Fusa_CAN_E2E.Fusa_CSA_1_CRC_Error SwcIn_Fusa_CAN_E2E.Fusa_CSA_1_RollgCntr_Error SwcIn_Fusa_CAN_E2E.Fusa_CSA_2_CRC1_Error SwcIn_Fusa_CAN_E2E.Fusa_CSA_2_RollgCntr1_Error SwcIn_Fusa_CAN_E2E.Fusa_FLZCU_1_CRC_Error SwcIn_Fusa_CAN_E2E.Fusa_FLZCU_1_RollgCntr_Error SwcIn_Fusa_CAN_E2E.Fusa_FLZCU_1_Timeout SwcIn_Fusa_CAN_E2E.Fusa_FLZCU_3_CRC_Error SwcIn_Fusa_CAN_E2E.Fusa_FLZCU_3_RollgCntr_Error SwcIn_Fusa_CAN_E2E.Fusa_FLZCU_9_CRC_Error SwcIn_Fusa_CAN_E2E.Fusa_FLZCU_9_RollgCntr_Error SwcIn_Fusa_CAN_E2E.Fusa_FLZCU_12_CRC_Error SwcIn_Fusa_CAN_E2E.Fusa_FLZCU_12_RollgCntr_Error SwcIn_Fusa_CAN_E2E.Fusa_MFS_2_CRC_Error SwcIn_Fusa_CAN_E2E.Fusa_MFS_2_RollgCntr_Error SwcIn_Fusa_CAN_E2E.Fusa_MFS_2_Timeout SwcIn_Fusa_CAN_E2E.Fusa_FRZCU_1_CRC_Error SwcIn_Fusa_CAN_E2E.Fusa_FRZCU_1_RollgCntr_Error SwcIn_Fusa_CAN_E2E.Fusa_FRZCU_7_CRC_Error SwcIn_Fusa_CAN_E2E.Fusa_FRZCU_7_RollgCntr_Error SwcIn_Fusa_CAN_E2E.Fusa_RZCU_2_CRC_Error SwcIn_Fusa_CAN_E2E.Fusa_RZCU_2_RollgCntr_Error SwcIn_Fusa_CAN_E2E.Fusa_RZCU_7_CRC_Error SwcIn_Fusa_CAN_E2E.Fusa_RZCU_7_RollgCntr_Error SwcIn_Fusa_CAN_E2E.Fusa_FLCR_1_CRC1_Error SwcIn_Fusa_CAN_E2E.Fusa_FLCR_1_RollgCntr1_Error SwcIn_Fusa_CAN_E2E.Fusa_FLCR_2_CRC1_Error SwcIn_Fusa_CAN_E2E.Fusa_FLCR_2_RollgCntr1_Error SwcIn_Fusa_CAN_E2E.Fusa_FRCR_1_CRC1_Error SwcIn_Fusa_CAN_E2E.Fusa_FRCR_1_RollgCntr1_Error SwcIn_Fusa_CAN_E2E.Fusa_RLCR_1_CRC1_Error SwcIn_Fusa_CAN_E2E.Fusa_RLCR_1_RollgCntr1_Error SwcIn_Fusa_CAN_E2E.Fusa_RLCR_1_Timeout SwcIn_Fusa_CAN_E2E.Fusa_RLCR_2_CRC1_Error SwcIn_Fusa_CAN_E2E.Fusa_RLCR_2_RollgCntr1_Error SwcIn_Fusa_CAN_E2E.Fusa_RLCR_3_CRC_Error SwcIn_Fusa_CAN_E2E.Fusa_RLCR_3_RollgCntr_Error SwcIn_Fusa_CAN_E2E.Fusa_RLCR_3_Timeout SwcIn_Fusa_CAN_E2E.Fusa_RLCR_4_CRC_Error SwcIn_Fusa_CAN_E2E.Fusa_RLCR_4_RollgCntr_Error SwcIn_Fusa_CAN_E2E.Fusa_RLCR_4_Timeout SwcIn_Fusa_CAN_E2E.Fusa_RLCR_5_CRC_Error SwcIn_Fusa_CAN_E2E.Fusa_RLCR_5_RollgCntr_Error SwcIn_Fusa_CAN_E2E.Fusa_RLCR_5_Timeout SwcIn_Fusa_CAN_E2E.Fusa_RLCR_6_CRC_Error SwcIn_Fusa_CAN_E2E.Fusa_RLCR_6_RollgCntr_Error SwcIn_Fusa_CAN_E2E.Fusa_RLCR_6_Timeout SwcIn_Fusa_CAN_E2E.Fusa_RLCR_7_CRC_Error SwcIn_Fusa_CAN_E2E.Fusa_RLCR_7_RollgCntr_Error SwcIn_Fusa_CAN_E2E.Fusa_RLCR_7_Timeout SwcIn_Fusa_CAN_E2E.Fusa_RLCR_8_CRC_Error SwcIn_Fusa_CAN_E2E.Fusa_RLCR_8_RollgCntr_Error SwcIn_Fusa_CAN_E2E.Fusa_RLCR_8_Timeout SwcIn_Fusa_CAN_E2E.Fusa_RRCR_1_CRC1_Error SwcIn_Fusa_CAN_E2E.Fusa_RRCR_1_RollgCntr1_Error SwcIn_Fusa_CAN_E2E.Fusa_RRCR_1_Timeout SwcIn_Fusa_CAN_E2E.Fusa_RRCR_3_CRC_Error SwcIn_Fusa_CAN_E2E.Fusa_RRCR_3_RollgCntr_Error SwcIn_Fusa_CAN_E2E.Fusa_RRCR_3_Timeout SwcIn_Fusa_CAN_E2E.Fusa_RRCR_4_CRC_Error SwcIn_Fusa_CAN_E2E.Fusa_RRCR_4_RollgCntr_Error SwcIn_Fusa_CAN_E2E.Fusa_RRCR_4_Timeout SwcIn_Fusa_CAN_E2E.Fusa_RRCR_5_CRC_Error SwcIn_Fusa_CAN_E2E.Fusa_RRCR_5_RollgCntr_Error SwcIn_Fusa_CAN_E2E.Fusa_RRCR_5_Timeout SwcIn_Fusa_CAN_E2E.Fusa_RRCR_6_CRC_Error SwcIn_Fusa_CAN_E2E.Fusa_RRCR_6_RollgCntr_Error SwcIn_Fusa_CAN_E2E.Fusa_RRCR_6_Timeout SwcIn_Fusa_CAN_E2E.Fusa_RRCR_7_CRC_Error SwcIn_Fusa_CAN_E2E.Fusa_RRCR_7_RollgCntr_Error SwcIn_Fusa_CAN_E2E.Fusa_RRCR_7_Timeout SwcIn_Fusa_CAN_E2E.Fusa_RRCR_8_CRC_Error SwcIn_Fusa_CAN_E2E.Fusa_RRCR_8_RollgCntr_Error SwcIn_Fusa_CAN_E2E.Fusa_RRCR_8_Timeout SwcIn_Fusa_CAN_E2E.Fusa_ICC_BD_11_CRC_Error SwcIn_Fusa_CAN_E2E.Fusa_ICC_BD_11_RollgCntr_Error SwcIn_Fusa_CAN_E2E.Fusa_ICC_DA_15_CRC_Error SwcIn_Fusa_CAN_E2E.Fusa_ICC_DA_15_RollgCntr_Error SwcIn_Fusa_CAN_E2E.Fusa_VCC_3_CRC_Error SwcIn_Fusa_CAN_E2E.Fusa_VCC_3_RollgCntr_Error /end REF_MEASUREMENT
/end GROUP
/begin GROUP SwcIn_Fusa_CAN_Value ""
 /begin REF_MEASUREMENT SwcIn_Fusa_CAN_Value.Fusa_ACU_2_YASCalibrationSts SwcIn_Fusa_CAN_Value.Fusa_EPB_1_EPBAvlSt SwcIn_Fusa_CAN_Value.Fusa_EPB_R_1_EPB_R_1Avl_St SwcIn_Fusa_CAN_Value.Fusa_EPB_R_1_FltLvl SwcIn_Fusa_CAN_Value.Fusa_TorsionBarTorqueDir SwcIn_Fusa_CAN_Value.Fusa_TosionBarTorqueValid SwcIn_Fusa_CAN_Value.Fusa_EPS_4_SteerPinionTqVld SwcIn_Fusa_CAN_Value.Fusa_EPS_4_SteerDrvrOvrd SwcIn_Fusa_CAN_Value.Fusa_EPS_4_SteerDrvrOvrdVld SwcIn_Fusa_CAN_Value.Fusa_SAM_1_SteeringAngleVD SwcIn_Fusa_CAN_Value.Fusa_SAM_1_SteeringAngleSpeedVD SwcIn_Fusa_CAN_Value.Fusa_ESP1_VehicleSpeedVSOSigValidData SwcIn_Fusa_CAN_Value.Fusa_ABS_ESP_1_EBDFailSts SwcIn_Fusa_CAN_Value.Fusa_ABS_ESP_1_ABSFailSts SwcIn_Fusa_CAN_Value.Fusa_ABS_ESP_1_VDCFailSts SwcIn_Fusa_CAN_Value.Fusa_ABS_ESP_1_TCSFailSts SwcIn_Fusa_CAN_Value.Fusa_ABS_ESP_1_HHCFailSts SwcIn_Fusa_CAN_Value.Fusa_ABS_ESP_1_HDCFailSts SwcIn_Fusa_CAN_Value.Fusa_AVHFailSts SwcIn_Fusa_CAN_Value.Fusa_DCFail SwcIn_Fusa_CAN_Value.Fusa_IPB_PlungerPressureValidData SwcIn_Fusa_CAN_Value.Fusa_IPB_InputRodStrokeStatus SwcIn_Fusa_CAN_Value.Fusa_LHFWheelSpeedRawValidData SwcIn_Fusa_CAN_Value.Fusa_RHFWheelSpeedRawValidData SwcIn_Fusa_CAN_Value.Fusa_LHRWheelSpeedRawValidData SwcIn_Fusa_CAN_Value.Fusa_RHRWheelSpeedRawValidData SwcIn_Fusa_CAN_Value.Fusa_ONEBOX_5_PilotParkBrkDecCtlAvl SwcIn_Fusa_CAN_Value.Fusa_BrakesystemFailSts SwcIn_Fusa_CAN_Value.Fusa_VCU_GasPedalPositionInvalidData SwcIn_Fusa_CAN_Value.Fusa_VCU_HVReady SwcIn_Fusa_CAN_Value.Fusa_VCU_ActualGearValidData SwcIn_Fusa_CAN_Value.Fusa_VCU_BrakePedalStsValidData SwcIn_Fusa_CAN_Value.Fusa_VCU_BrakePedalSts SwcIn_Fusa_CAN_Value.Fusa_VCU_ONEBOX_GasPedalPositionInvalidData SwcIn_Fusa_CAN_Value.Fusa_VCU_AcceleratorPosRawIVD SwcIn_Fusa_CAN_Value.Fusa_VCU_12_PtTqActvSts SwcIn_Fusa_CAN_Value.Fusa_LHFSeatBeltSW SwcIn_Fusa_CAN_Value.Fusa_FL_SeatBeltFaultStatus SwcIn_Fusa_CAN_Value.Fusa_MFS_Rsp_Error SwcIn_Fusa_CAN_Value.Fusa_TirePressureSystemFailSts SwcIn_Fusa_CAN_Value.Fusa_ACU_2_YawrateSigValidData SwcIn_Fusa_CAN_Value.Fusa_ACU_2_LateralAccelerationSigVD SwcIn_Fusa_CAN_Value.Fusa_ACU_3_LongitudinalAccelerationVD SwcIn_Fusa_CAN_Value.Fusa_ACU_3_CrashOutputSts SwcIn_Fusa_CAN_Value.Fusa_EPB_1_ActrSt SwcIn_Fusa_CAN_Value.Fusa_EPB_1_FltLvl SwcIn_Fusa_CAN_Value.Fusa_EPB_R_1_Flt_Lamp SwcIn_Fusa_CAN_Value.Fusa_EPSFailSts SwcIn_Fusa_CAN_Value.Fusa_EPS_4_AgPilotCtrlAvl SwcIn_Fusa_CAN_Value.Fusa_EPS_4_AgPilotCtrlSts SwcIn_Fusa_CAN_Value.Fusa_VehicleStandstill SwcIn_Fusa_CAN_Value.Fusa_LHFWheelDriveDirection SwcIn_Fusa_CAN_Value.Fusa_RHFWheelDriveDirection SwcIn_Fusa_CAN_Value.Fusa_LHRWheelDriveDirection SwcIn_Fusa_CAN_Value.Fusa_RHRWheelDriveDirection SwcIn_Fusa_CAN_Value.Fusa_VCU_ActualGear SwcIn_Fusa_CAN_Value.Fusa_VCU_12_PtTqAvl SwcIn_Fusa_CAN_Value.Fusa_STAT_ShifterLeverFault SwcIn_Fusa_CAN_Value.Fusa_CSA_2_AllWarningInfo SwcIn_Fusa_CAN_Value.Fusa_CSA_2_TurnSigLvrCmd SwcIn_Fusa_CAN_Value.Fusa_LHFdoorSts SwcIn_Fusa_CAN_Value.Fusa_FLZCU_9_PowerMode SwcIn_Fusa_CAN_Value.Fusa_MFS_LeftRoller SwcIn_Fusa_CAN_Value.Fusa_RHFDoorSts SwcIn_Fusa_CAN_Value.Fusa_RHRDoorSts SwcIn_Fusa_CAN_Value.Fusa_TirePressureWarningLampSts SwcIn_Fusa_CAN_Value.Fusa_LHRdoorSts SwcIn_Fusa_CAN_Value.Fusa_RRCR_1_SysSt SwcIn_Fusa_CAN_Value.Fusa_RLCR_1_SysSt SwcIn_Fusa_CAN_Value.Fusa_ACU_2_LateralAcceleration SwcIn_Fusa_CAN_Value.Fusa_ACU_2_YawRate SwcIn_Fusa_CAN_Value.Fusa_ACU_3_LongitudinalAcceleration SwcIn_Fusa_CAN_Value.Fusa_TorsionBarTorque SwcIn_Fusa_CAN_Value.Fusa_SAM_1_SteeringAngle SwcIn_Fusa_CAN_Value.Fusa_SAM_1_SteeringAngleSpeed SwcIn_Fusa_CAN_Value.Fusa_ABS_ESP_1_VehicleSpeedVSOSig SwcIn_Fusa_CAN_Value.Fusa_IPB_PlungerPressure SwcIn_Fusa_CAN_Value.Fusa_IPB_InputRodStroke SwcIn_Fusa_CAN_Value.Fusa_VCU_GasPedalPosition SwcIn_Fusa_CAN_Value.Fusa_VCU_AcceleratorPosRaw /end REF_MEASUREMENT
/end GROUP
/begin GROUP SwcIn_Fusa_ErrID ""
 /begin REF_MEASUREMENT SwcIn_Fusa_ErrID.Fusa_SerDes_MAX96717_1 SwcIn_Fusa_ErrID.Fusa_SerDes_MAX96717_2 SwcIn_Fusa_ErrID.Fusa_Mcu_U2A16 SwcIn_Fusa_ErrID.Fusa_Sbc_TLF35584 SwcIn_Fusa_ErrID.Fusa_SerDes_MAX96716 SwcIn_Fusa_ErrID.Fusa_SerDes_MAX96722 SwcIn_Fusa_ErrID.Fusa_Cam_1_Module SwcIn_Fusa_ErrID.Fusa_Cam_1_Ser SwcIn_Fusa_ErrID.Fusa_J3_Err1 SwcIn_Fusa_ErrID.Fusa_J3_Err2 SwcIn_Fusa_ErrID.Fusa_J3_Err3 /end REF_MEASUREMENT
/end GROUP
/begin GROUP SwcIn_ICC_BD_11 ""
 /begin REF_MEASUREMENT SwcIn_ICC_BD_11.ICC_BD_11_CRC SwcIn_ICC_BD_11.ICC_BD_11_RollgCntr SwcIn_ICC_BD_11.ICC_DriveDrosinessLevel /end REF_MEASUREMENT
/end GROUP
/begin GROUP SwcIn_ICC_COM_1 ""
 /begin REF_MEASUREMENT SwcIn_ICC_COM_1.TotalOdometer_km_OBD SwcIn_ICC_COM_1.DisplayVehicleSpeed /end REF_MEASUREMENT
/end GROUP
/begin GROUP SwcIn_ICC_COM_8 ""
 /begin REF_MEASUREMENT SwcIn_ICC_COM_8.CurrentTimeYear SwcIn_ICC_COM_8.CurrentTimeMonth SwcIn_ICC_COM_8.CurrentTimeDay SwcIn_ICC_COM_8.CurrentTimeHour SwcIn_ICC_COM_8.CurrentTimeMinute SwcIn_ICC_COM_8.CurrentTimeSecond /end REF_MEASUREMENT
/end GROUP
/begin GROUP SwcIn_ICC_DA_15 ""
 /begin REF_MEASUREMENT SwcIn_ICC_DA_15.ICC_DA_15_CRC SwcIn_ICC_DA_15.ICC_DA_15_RollgCntr SwcIn_ICC_DA_15.ICC_DA_15_Resd SwcIn_ICC_DA_15.ICC_DA_15_ExtremeEnergySaveMode SwcIn_ICC_DA_15.Driver_EyeOnRoad SwcIn_ICC_DA_15.Dms_Status SwcIn_ICC_DA_15.Driver_AbnormalBehavior SwcIn_ICC_DA_15.Driver_GazeRegion SwcIn_ICC_DA_15.Dms_DriverPresence SwcIn_ICC_DA_15.ICC_IHCfunctionSw SwcIn_ICC_DA_15.ICC_DistractionStatus /end REF_MEASUREMENT
/end GROUP
/begin GROUP SwcIn_J3_LANE ""
 /begin SUB_GROUP SwcIn_J3_LANE.Left_Cone_Road_Edge SwcIn_J3_LANE.Right_Cone_Road_Edge SwcIn_J3_LANE.Crosswalk SwcIn_J3_LANE.HPP_Line SwcIn_J3_LANE.Left_LKA_Lane SwcIn_J3_LANE.Right_LKA_Lane SwcIn_J3_LANE.LinePoints SwcIn_J3_LANE.Left_Next_Lane SwcIn_J3_LANE.Right_Next_Lane SwcIn_J3_LANE.Left_Out_Lane SwcIn_J3_LANE.Right_Out_Lane SwcIn_J3_LANE.Left_Road_Edge SwcIn_J3_LANE.Right_Road_Edge SwcIn_J3_LANE.Road_Information SwcIn_J3_LANE.J3_LANE_SYNC /end SUB_GROUP
 /begin REF_MEASUREMENT SwcIn_J3_LANE.RollingCounter_Lane /end REF_MEASUREMENT
/end GROUP
/begin GROUP SwcIn_J3_LANE.Crosswalk "" /begin SUB_GROUP SwcIn_J3_LANE.Crosswalk.position /end SUB_GROUP
 /begin REF_MEASUREMENT SwcIn_J3_LANE.Crosswalk.id SwcIn_J3_LANE.Crosswalk.conf SwcIn_J3_LANE.Crosswalk.life_time /end REF_MEASUREMENT
/end GROUP
/begin GROUP SwcIn_J3_LANE.Crosswalk.border[0] ""
 /begin REF_MEASUREMENT SwcIn_J3_LANE.Crosswalk.border[0].point_x SwcIn_J3_LANE.Crosswalk.border[0].point_y /end REF_MEASUREMENT
/end GROUP
/begin GROUP SwcIn_J3_LANE.Crosswalk.position ""
 /begin REF_MEASUREMENT SwcIn_J3_LANE.Crosswalk.position.point_x SwcIn_J3_LANE.Crosswalk.position.point_y /end REF_MEASUREMENT
/end GROUP
/begin GROUP SwcIn_J3_LANE.HPP_Line ""
 /begin REF_MEASUREMENT SwcIn_J3_LANE.HPP_Line.HPPLine_Confidence SwcIn_J3_LANE.HPP_Line.HPPLine_First_Valid SwcIn_J3_LANE.HPP_Line.HPPLine_Second_Valid SwcIn_J3_LANE.HPP_Line.HPPLine_Third_Valid SwcIn_J3_LANE.HPP_Line.HPPLine_MeasuringStatus SwcIn_J3_LANE.HPP_Line.HPPLine_TrackID SwcIn_J3_LANE.HPP_Line.HPPLine_ViewRange_End_First SwcIn_J3_LANE.HPP_Line.HPPLine_ViewRange_End_Second SwcIn_J3_LANE.HPP_Line.HPPLine_ViewRange_End_Third SwcIn_J3_LANE.HPP_Line.HPPLineModel_First_C0 SwcIn_J3_LANE.HPP_Line.HPPLineModel_First_C1 SwcIn_J3_LANE.HPP_Line.HPPLineModel_First_C2 SwcIn_J3_LANE.HPP_Line.HPPLineModel_First_C3 SwcIn_J3_LANE.HPP_Line.HPPLine_Half_Width SwcIn_J3_LANE.HPP_Line.HPPLineModel_Second_C0 SwcIn_J3_LANE.HPP_Line.HPPLineModel_Second_C1 SwcIn_J3_LANE.HPP_Line.HPPLineModel_Second_C2 SwcIn_J3_LANE.HPP_Line.HPPLineModel_Second_C3 SwcIn_J3_LANE.HPP_Line.HPPLineModel_Third_C0 SwcIn_J3_LANE.HPP_Line.HPPLineModel_Third_C1 SwcIn_J3_LANE.HPP_Line.HPPLineModel_Third_C2 SwcIn_J3_LANE.HPP_Line.HPPLineModel_Third_C3 /end REF_MEASUREMENT
/end GROUP
/begin GROUP SwcIn_J3_LANE.J3_LANE_SYNC ""
 /begin REF_MEASUREMENT SwcIn_J3_LANE.J3_LANE_SYNC.FrameIndex SwcIn_J3_LANE.J3_LANE_SYNC.ImageTimestampMs SwcIn_J3_LANE.J3_LANE_SYNC.SPITimestampMs /end REF_MEASUREMENT
/end GROUP
/begin GROUP SwcIn_J3_LANE.Lane_Extra_Type[0] ""
 /begin REF_MEASUREMENT SwcIn_J3_LANE.Lane_Extra_Type[0].change_point_valid SwcIn_J3_LANE.Lane_Extra_Type[0].second_line_type SwcIn_J3_LANE.Lane_Extra_Type[0].type_change_position SwcIn_J3_LANE.Lane_Extra_Type[0].point_x SwcIn_J3_LANE.Lane_Extra_Type[0].point_y /end REF_MEASUREMENT
/end GROUP
/begin GROUP SwcIn_J3_LANE.Left_Cone_Road_Edge ""
 /begin REF_MEASUREMENT SwcIn_J3_LANE.Left_Cone_Road_Edge.ConeRoadEdgeConfidence SwcIn_J3_LANE.Left_Cone_Road_Edge.ConeRoadEdgeMeasuringStatus SwcIn_J3_LANE.Left_Cone_Road_Edge.ConeRoadEdgeTypeClass SwcIn_J3_LANE.Left_Cone_Road_Edge.ConeRoadEdgeQuality SwcIn_J3_LANE.Left_Cone_Road_Edge.ConeRoadEdgeParsingConfidence SwcIn_J3_LANE.Left_Cone_Road_Edge.ConeRoadEdgeTrackID SwcIn_J3_LANE.Left_Cone_Road_Edge.ConeRoadEdgeViewRangeStart SwcIn_J3_LANE.Left_Cone_Road_Edge.ConeRoadEdgeViewRangeEnd SwcIn_J3_LANE.Left_Cone_Road_Edge.ConeRoadEdgeModelC0 SwcIn_J3_LANE.Left_Cone_Road_Edge.ConeRoadEdgeModelC1 SwcIn_J3_LANE.Left_Cone_Road_Edge.ConeRoadEdgeModelC2 SwcIn_J3_LANE.Left_Cone_Road_Edge.ConeRoadEdgeModelC3 SwcIn_J3_LANE.Left_Cone_Road_Edge.ConeRoadEdgeTLC /end REF_MEASUREMENT
/end GROUP
/begin GROUP SwcIn_J3_LANE.Left_LKA_Lane ""
 /begin REF_MEASUREMENT SwcIn_J3_LANE.Left_LKA_Lane.LaneConfidence SwcIn_J3_LANE.Left_LKA_Lane.LaneMeasuringStatus SwcIn_J3_LANE.Left_LKA_Lane.LaneTypeClass SwcIn_J3_LANE.Left_LKA_Lane.LaneMarkColor SwcIn_J3_LANE.Left_LKA_Lane.LaneQuality SwcIn_J3_LANE.Left_LKA_Lane.LaneCrossing SwcIn_J3_LANE.Left_LKA_Lane.ObstacleFlag SwcIn_J3_LANE.Left_LKA_Lane.LaneExtraNearPointType SwcIn_J3_LANE.Left_LKA_Lane.LaneExtraFarPointType SwcIn_J3_LANE.Left_LKA_Lane.LaneParsingConfidence SwcIn_J3_LANE.Left_LKA_Lane.Stopline_Relevancy SwcIn_J3_LANE.Left_LKA_Lane.LaneTrackID SwcIn_J3_LANE.Left_LKA_Lane.LaneWidthMarking SwcIn_J3_LANE.Left_LKA_Lane.LaneViewRangeStart SwcIn_J3_LANE.Left_LKA_Lane.LaneViewRangeEnd SwcIn_J3_LANE.Left_LKA_Lane.LaneModelC0 SwcIn_J3_LANE.Left_LKA_Lane.LaneModelC1 SwcIn_J3_LANE.Left_LKA_Lane.LaneModelC2 SwcIn_J3_LANE.Left_LKA_Lane.LaneModelC3 SwcIn_J3_LANE.Left_LKA_Lane.LaneTLC SwcIn_J3_LANE.Left_LKA_Lane.LaneExtraFarPointPosX SwcIn_J3_LANE.Left_LKA_Lane.LaneExtraFarPointPosY SwcIn_J3_LANE.Left_LKA_Lane.LaneExtraNearPointPosX SwcIn_J3_LANE.Left_LKA_Lane.LaneExtraNearPointPosY /end REF_MEASUREMENT
/end GROUP
/begin GROUP SwcIn_J3_LANE.Left_Next_Lane ""
 /begin REF_MEASUREMENT SwcIn_J3_LANE.Left_Next_Lane.LaneConfidence SwcIn_J3_LANE.Left_Next_Lane.LaneMeasuringStatus SwcIn_J3_LANE.Left_Next_Lane.LaneTypeClass SwcIn_J3_LANE.Left_Next_Lane.LaneMarkColor SwcIn_J3_LANE.Left_Next_Lane.LaneQuality SwcIn_J3_LANE.Left_Next_Lane.ObstacleFlag SwcIn_J3_LANE.Left_Next_Lane.LaneExtraNearPointType SwcIn_J3_LANE.Left_Next_Lane.LaneExtraFarPointType SwcIn_J3_LANE.Left_Next_Lane.LaneParsingConfidence SwcIn_J3_LANE.Left_Next_Lane.LaneTrackID SwcIn_J3_LANE.Left_Next_Lane.LaneWidthMarking SwcIn_J3_LANE.Left_Next_Lane.LaneViewRangeStart SwcIn_J3_LANE.Left_Next_Lane.LaneViewRangeEnd SwcIn_J3_LANE.Left_Next_Lane.LaneModelC0 SwcIn_J3_LANE.Left_Next_Lane.LaneModelC1 SwcIn_J3_LANE.Left_Next_Lane.LaneModelC2 SwcIn_J3_LANE.Left_Next_Lane.LaneModelC3 SwcIn_J3_LANE.Left_Next_Lane.LaneExtraFarPointPosX SwcIn_J3_LANE.Left_Next_Lane.LaneExtraFarPointPosY SwcIn_J3_LANE.Left_Next_Lane.LaneExtraNearPointPosX SwcIn_J3_LANE.Left_Next_Lane.LaneExtraNearPointPosY /end REF_MEASUREMENT
/end GROUP
/end MODULE
/end PROJECT
