ASAP2_VERSION 1 71
/begin PROJECT ProjectName ""
/begin MODULE ModuleName ""
/begin MOD_COMMON "" BYTE_ORDER MSB_LAST ALIGNMENT_BYTE 1 ALIGNMENT_WORD 1 ALIGNMENT_LONG 1 ALIGNMENT_INT64 1 ALIGNMENT_FLOAT16_IEEE 1 ALIGNMENT_FLOAT32_IEEE 1 ALIGNMENT_FLOAT64_IEEE 1 /end MOD_COMMON
/begin RECORD_LAYOUT Lookup1D_X_BYTE AXIS_PTS_X 1 SBYTE INDEX_INCR DIRECT /end RECORD_LAYOUT
/begin RECORD_LAYOUT Lookup1D_UBYTE FNC_VALUES 1 UBYTE COLUMN_DIR DIRECT /end RECORD_LAYOUT
/begin RECORD_LAYOUT Lookup1D_X_UBYTE AXIS_PTS_X 1 UBYTE INDEX_INCR DIRECT /end RECORD_LAYOUT
/begin RECORD_LAYOUT Lookup1D_UWORD FNC_VALUES 1 UWORD COLUMN_DIR DIRECT /end RECORD_LAYOUT
/begin RECORD_LAYOUT Lookup1D_X_UWORD AXIS_PTS_X 1 UWORD INDEX_INCR DIRECT /end RECORD_LAYOUT
/begin RECORD_LAYOUT Lookup1D_WORD FNC_VALUES 1 SWORD COLUMN_DIR DIRECT /end RECORD_LAYOUT
/begin RECORD_LAYOUT Lookup1D_X_WORD AXIS_PTS_X 1 SWORD INDEX_INCR DIRECT /end RECORD_LAYOUT
/begin RECORD_LAYOUT Lookup1D_ULONG FNC_VALUES 1 ULONG COLUMN_DIR DIRECT /end RECORD_LAYOUT
/begin RECORD_LAYOUT Lookup1D_X_ULONG AXIS_PTS_X 1 ULONG INDEX_INCR DIRECT /end RECORD_LAYOUT
/begin RECORD_LAYOUT Lookup1D_SLONG FNC_VALUES 1 SLONG COLUMN_DIR DIRECT /end RECORD_LAYOUT
/begin MEASUREMENT autosar_swc_aeb_rtARID_DEF.ARID_DEF_MATLABFunction11_m.Active_Time "" FLOAT32_IEEE autosar_swc_aeb_CM_single 0 0 -3.4E+38 3.4E+38 ECU_ADDRESS 0xfe4a5048 /* @ECU_Address@autosar_swc_aeb_rtARID_DEF.ARID_DEF_MATLABFunction11_m.Active_Time@ */ /end MEASUREMENT
/begin MEASUREMENT autosar_swc_aeb_rtARID_DEF.ARID_DEF_MATLABFunction12.Active_Sts "" UBYTE autosar_swc_aeb_CM_uint8 0 0 0 255 ECU_ADDRESS 0xfe4a4f14 /* @ECU_Address@autosar_swc_aeb_rtARID_DEF.ARID_DEF_MATLABFunction12.Active_Sts@ */ /end MEASUREMENT
/begin MEASUREMENT autosar_swc_aeb_rtARID_DEF.ARID_DEF_MATLABFunction12.Active_Time "" FLOAT32_IEEE autosar_swc_aeb_CM_single 0 0 -3.4E+38 3.4E+38 ECU_ADDRESS 0xfe4a4f10 /* @ECU_Address@autosar_swc_aeb_rtARID_DEF.ARID_DEF_MATLABFunction12.Active_Time@ */ /end MEASUREMENT
/begin MEASUREMENT autosar_swc_aeb_rtARID_DEF.ARID_DEF_MATLABFunction12_m.Active_Sts "" UBYTE autosar_swc_aeb_CM_uint8 0 0 0 255 ECU_ADDRESS 0xfe4a5044 /* @ECU_Address@autosar_swc_aeb_rtARID_DEF.ARID_DEF_MATLABFunction12_m.Active_Sts@ */ /end MEASUREMENT
/begin MEASUREMENT autosar_swc_aeb_rtARID_DEF.ARID_DEF_MATLABFunction12_m.Active_Time "" FLOAT32_IEEE autosar_swc_aeb_CM_single 0 0 -3.4E+38 3.4E+38 ECU_ADDRESS 0xfe4a5040 /* @ECU_Address@autosar_swc_aeb_rtARID_DEF.ARID_DEF_MATLABFunction12_m.Active_Time@ */ /end MEASUREMENT
/begin MEASUREMENT autosar_swc_aeb_rtARID_DEF.ARID_DEF_MATLABFunction13.Active_Sts "" UBYTE autosar_swc_aeb_CM_uint8 0 0 0 255 ECU_ADDRESS 0xfe4a4f0c /* @ECU_Address@autosar_swc_aeb_rtARID_DEF.ARID_DEF_MATLABFunction13.Active_Sts@ */ /end MEASUREMENT
/begin MEASUREMENT autosar_swc_aeb_rtARID_DEF.ARID_DEF_MATLABFunction13.Active_Time "" FLOAT32_IEEE autosar_swc_aeb_CM_single 0 0 -3.4E+38 3.4E+38 ECU_ADDRESS 0xfe4a4f08 /* @ECU_Address@autosar_swc_aeb_rtARID_DEF.ARID_DEF_MATLABFunction13.Active_Time@ */ /end MEASUREMENT
/begin MEASUREMENT autosar_swc_aeb_rtARID_DEF.ARID_DEF_MATLABFunction13_c.Active_Sts "" UBYTE autosar_swc_aeb_CM_uint8 0 0 0 255 ECU_ADDRESS 0xfe4a503c /* @ECU_Address@autosar_swc_aeb_rtARID_DEF.ARID_DEF_MATLABFunction13_c.Active_Sts@ */ /end MEASUREMENT
/begin MEASUREMENT autosar_swc_aeb_rtARID_DEF.ARID_DEF_MATLABFunction13_c.Active_Time "" FLOAT32_IEEE autosar_swc_aeb_CM_single 0 0 -3.4E+38 3.4E+38 ECU_ADDRESS 0xfe4a5038 /* @ECU_Address@autosar_swc_aeb_rtARID_DEF.ARID_DEF_MATLABFunction13_c.Active_Time@ */ /end MEASUREMENT
/begin MEASUREMENT autosar_swc_aeb_rtARID_DEF.ARID_DEF_MATLABFunction14.Active_Sts "" UBYTE autosar_swc_aeb_CM_uint8 0 0 0 255 ECU_ADDRESS 0xfe4a4f04 /* @ECU_Address@autosar_swc_aeb_rtARID_DEF.ARID_DEF_MATLABFunction14.Active_Sts@ */ /end MEASUREMENT
/begin MEASUREMENT autosar_swc_aeb_rtARID_DEF.ARID_DEF_MATLABFunction14.Active_Time "" FLOAT32_IEEE autosar_swc_aeb_CM_single 0 0 -3.4E+38 3.4E+38 ECU_ADDRESS 0xfe4a4f00 /* @ECU_Address@autosar_swc_aeb_rtARID_DEF.ARID_DEF_MATLABFunction14.Active_Time@ */ /end MEASUREMENT
/begin MEASUREMENT autosar_swc_aeb_rtARID_DEF.ARID_DEF_MATLABFunction14_m.Active_Sts "" UBYTE autosar_swc_aeb_CM_uint8 0 0 0 255 ECU_ADDRESS 0xfe4a5034 /* @ECU_Address@autosar_swc_aeb_rtARID_DEF.ARID_DEF_MATLABFunction14_m.Active_Sts@ */ /end MEASUREMENT
/begin MEASUREMENT autosar_swc_aeb_rtARID_DEF.ARID_DEF_MATLABFunction14_m.Active_Time "" FLOAT32_IEEE autosar_swc_aeb_CM_single 0 0 -3.4E+38 3.4E+38 ECU_ADDRESS 0xfe4a5030 /* @ECU_Address@autosar_swc_aeb_rtARID_DEF.ARID_DEF_MATLABFunction14_m.Active_Time@ */ /end MEASUREMENT
/begin MEASUREMENT autosar_swc_aeb_rtARID_DEF.ARID_DEF_MATLABFunction15.Active_Sts "" UBYTE autosar_swc_aeb_CM_uint8 0 0 0 255 ECU_ADDRESS 0xfe4a4efc /* @ECU_Address@autosar_swc_aeb_rtARID_DEF.ARID_DEF_MATLABFunction15.Active_Sts@ */ /end MEASUREMENT
/begin MEASUREMENT autosar_swc_aeb_rtARID_DEF.ARID_DEF_MATLABFunction15.Active_Time "" FLOAT32_IEEE autosar_swc_aeb_CM_single 0 0 -3.4E+38 3.4E+38 ECU_ADDRESS 0xfe4a4ef8 /* @ECU_Address@autosar_swc_aeb_rtARID_DEF.ARID_DEF_MATLABFunction15.Active_Time@ */ /end MEASUREMENT
/begin MEASUREMENT autosar_swc_aeb_rtARID_DEF.ARID_DEF_MATLABFunction15_n.Active_Sts "" UBYTE autosar_swc_aeb_CM_uint8 0 0 0 255 ECU_ADDRESS 0xfe4a502c /* @ECU_Address@autosar_swc_aeb_rtARID_DEF.ARID_DEF_MATLABFunction15_n.Active_Sts@ */ /end MEASUREMENT
/begin MEASUREMENT autosar_swc_aeb_rtARID_DEF.ARID_DEF_MATLABFunction15_n.Active_Time "" FLOAT32_IEEE autosar_swc_aeb_CM_single 0 0 -3.4E+38 3.4E+38 ECU_ADDRESS 0xfe4a5028 /* @ECU_Address@autosar_swc_aeb_rtARID_DEF.ARID_DEF_MATLABFunction15_n.Active_Time@ */ /end MEASUREMENT
/begin MEASUREMENT autosar_swc_aeb_rtARID_DEF.ARID_DEF_MATLABFunction16.Active_Sts "" UBYTE autosar_swc_aeb_CM_uint8 0 0 0 255 ECU_ADDRESS 0xfe4a4ef4 /* @ECU_Address@autosar_swc_aeb_rtARID_DEF.ARID_DEF_MATLABFunction16.Active_Sts@ */ /end MEASUREMENT
/begin MEASUREMENT autosar_swc_aeb_rtARID_DEF.ARID_DEF_MATLABFunction16.Active_Time "" FLOAT32_IEEE autosar_swc_aeb_CM_single 0 0 -3.4E+38 3.4E+38 ECU_ADDRESS 0xfe4a4ef0 /* @ECU_Address@autosar_swc_aeb_rtARID_DEF.ARID_DEF_MATLABFunction16.Active_Time@ */ /end MEASUREMENT
/begin MEASUREMENT autosar_swc_aeb_rtARID_DEF.ARID_DEF_MATLABFunction16_o.Active_Sts "" UBYTE autosar_swc_aeb_CM_uint8 0 0 0 255 ECU_ADDRESS 0xfe4a5024 /* @ECU_Address@autosar_swc_aeb_rtARID_DEF.ARID_DEF_MATLABFunction16_o.Active_Sts@ */ /end MEASUREMENT
/begin MEASUREMENT autosar_swc_aeb_rtARID_DEF.ARID_DEF_MATLABFunction16_o.Active_Time "" FLOAT32_IEEE autosar_swc_aeb_CM_single 0 0 -3.4E+38 3.4E+38 ECU_ADDRESS 0xfe4a5020 /* @ECU_Address@autosar_swc_aeb_rtARID_DEF.ARID_DEF_MATLABFunction16_o.Active_Time@ */ /end MEASUREMENT
/begin MEASUREMENT autosar_swc_aeb_rtARID_DEF.ARID_DEF_MATLABFunction17.Active_Sts "" UBYTE autosar_swc_aeb_CM_uint8 0 0 0 255 ECU_ADDRESS 0xfe4a4eec /* @ECU_Address@autosar_swc_aeb_rtARID_DEF.ARID_DEF_MATLABFunction17.Active_Sts@ */ /end MEASUREMENT
/begin MEASUREMENT autosar_swc_aeb_rtARID_DEF.ARID_DEF_MATLABFunction17.Active_Time "" FLOAT32_IEEE autosar_swc_aeb_CM_single 0 0 -3.4E+38 3.4E+38 ECU_ADDRESS 0xfe4a4ee8 /* @ECU_Address@autosar_swc_aeb_rtARID_DEF.ARID_DEF_MATLABFunction17.Active_Time@ */ /end MEASUREMENT
/begin MEASUREMENT autosar_swc_aeb_rtARID_DEF.ARID_DEF_MATLABFunction17_i.Active_Sts "" UBYTE autosar_swc_aeb_CM_uint8 0 0 0 255 ECU_ADDRESS 0xfe4a501c /* @ECU_Address@autosar_swc_aeb_rtARID_DEF.ARID_DEF_MATLABFunction17_i.Active_Sts@ */ /end MEASUREMENT
/begin MEASUREMENT autosar_swc_aeb_rtARID_DEF.ARID_DEF_MATLABFunction17_i.Active_Time "" FLOAT32_IEEE autosar_swc_aeb_CM_single 0 0 -3.4E+38 3.4E+38 ECU_ADDRESS 0xfe4a5018 /* @ECU_Address@autosar_swc_aeb_rtARID_DEF.ARID_DEF_MATLABFunction17_i.Active_Time@ */ /end MEASUREMENT
/begin MEASUREMENT autosar_swc_aeb_rtARID_DEF.ARID_DEF_MATLABFunction18.Active_Sts "" UBYTE autosar_swc_aeb_CM_uint8 0 0 0 255 ECU_ADDRESS 0xfe4a4ee4 /* @ECU_Address@autosar_swc_aeb_rtARID_DEF.ARID_DEF_MATLABFunction18.Active_Sts@ */ /end MEASUREMENT
/begin MEASUREMENT autosar_swc_aeb_rtARID_DEF.ARID_DEF_MATLABFunction18.Active_Time "" FLOAT32_IEEE autosar_swc_aeb_CM_single 0 0 -3.4E+38 3.4E+38 ECU_ADDRESS 0xfe4a4ee0 /* @ECU_Address@autosar_swc_aeb_rtARID_DEF.ARID_DEF_MATLABFunction18.Active_Time@ */ /end MEASUREMENT
/begin MEASUREMENT autosar_swc_aeb_rtARID_DEF.ARID_DEF_MATLABFunction18_n.Active_Sts "" UBYTE autosar_swc_aeb_CM_uint8 0 0 0 255 ECU_ADDRESS 0xfe4a5014 /* @ECU_Address@autosar_swc_aeb_rtARID_DEF.ARID_DEF_MATLABFunction18_n.Active_Sts@ */ /end MEASUREMENT
/begin MEASUREMENT autosar_swc_aeb_rtARID_DEF.ARID_DEF_MATLABFunction18_n.Active_Time "" FLOAT32_IEEE autosar_swc_aeb_CM_single 0 0 -3.4E+38 3.4E+38 ECU_ADDRESS 0xfe4a5010 /* @ECU_Address@autosar_swc_aeb_rtARID_DEF.ARID_DEF_MATLABFunction18_n.Active_Time@ */ /end MEASUREMENT
/begin MEASUREMENT autosar_swc_aeb_rtARID_DEF.ARID_DEF_MATLABFunction19.Active_Sts "" UBYTE autosar_swc_aeb_CM_uint8 0 0 0 255 ECU_ADDRESS 0xfe4a4edc /* @ECU_Address@autosar_swc_aeb_rtARID_DEF.ARID_DEF_MATLABFunction19.Active_Sts@ */ /end MEASUREMENT
/begin MEASUREMENT autosar_swc_aeb_rtARID_DEF.ARID_DEF_MATLABFunction19.Active_Time "" FLOAT32_IEEE autosar_swc_aeb_CM_single 0 0 -3.4E+38 3.4E+38 ECU_ADDRESS 0xfe4a4ed8 /* @ECU_Address@autosar_swc_aeb_rtARID_DEF.ARID_DEF_MATLABFunction19.Active_Time@ */ /end MEASUREMENT
/begin MEASUREMENT autosar_swc_aeb_rtARID_DEF.ARID_DEF_MATLABFunction19_o.Active_Sts "" UBYTE autosar_swc_aeb_CM_uint8 0 0 0 255 ECU_ADDRESS 0xfe4a500c /* @ECU_Address@autosar_swc_aeb_rtARID_DEF.ARID_DEF_MATLABFunction19_o.Active_Sts@ */ /end MEASUREMENT
/begin MEASUREMENT autosar_swc_aeb_rtARID_DEF.ARID_DEF_MATLABFunction19_o.Active_Time "" FLOAT32_IEEE autosar_swc_aeb_CM_single 0 0 -3.4E+38 3.4E+38 ECU_ADDRESS 0xfe4a5008 /* @ECU_Address@autosar_swc_aeb_rtARID_DEF.ARID_DEF_MATLABFunction19_o.Active_Time@ */ /end MEASUREMENT
/begin MEASUREMENT autosar_swc_aeb_rtARID_DEF.ARID_DEF_MATLABFunction1_j.Active_Sts "" UBYTE autosar_swc_aeb_CM_uint8 0 0 0 255 ECU_ADDRESS 0xfe4a505c /* @ECU_Address@autosar_swc_aeb_rtARID_DEF.ARID_DEF_MATLABFunction1_j.Active_Sts@ */ /end MEASUREMENT
/begin MEASUREMENT autosar_swc_aeb_rtARID_DEF.ARID_DEF_MATLABFunction1_j.Active_Time "" FLOAT32_IEEE autosar_swc_aeb_CM_single 0 0 -3.4E+38 3.4E+38 ECU_ADDRESS 0xfe4a5058 /* @ECU_Address@autosar_swc_aeb_rtARID_DEF.ARID_DEF_MATLABFunction1_j.Active_Time@ */ /end MEASUREMENT
/begin MEASUREMENT autosar_swc_aeb_rtARID_DEF.ARID_DEF_MATLABFunction2.Active_Sts "" UBYTE autosar_swc_aeb_CM_uint8 0 0 0 255 ECU_ADDRESS 0xfe4a4ed4 /* @ECU_Address@autosar_swc_aeb_rtARID_DEF.ARID_DEF_MATLABFunction2.Active_Sts@ */ /end MEASUREMENT
/begin MEASUREMENT autosar_swc_aeb_rtARID_DEF.ARID_DEF_MATLABFunction2.Active_Time "" FLOAT32_IEEE autosar_swc_aeb_CM_single 0 0 -3.4E+38 3.4E+38 ECU_ADDRESS 0xfe4a4ed0 /* @ECU_Address@autosar_swc_aeb_rtARID_DEF.ARID_DEF_MATLABFunction2.Active_Time@ */ /end MEASUREMENT
/begin MEASUREMENT autosar_swc_aeb_rtARID_DEF.ARID_DEF_MATLABFunction20.Active_Sts "" UBYTE autosar_swc_aeb_CM_uint8 0 0 0 255 ECU_ADDRESS 0xfe4a4ecc /* @ECU_Address@autosar_swc_aeb_rtARID_DEF.ARID_DEF_MATLABFunction20.Active_Sts@ */ /end MEASUREMENT
/begin MEASUREMENT autosar_swc_aeb_rtARID_DEF.ARID_DEF_MATLABFunction20.Active_Time "" FLOAT32_IEEE autosar_swc_aeb_CM_single 0 0 -3.4E+38 3.4E+38 ECU_ADDRESS 0xfe4a4ec8 /* @ECU_Address@autosar_swc_aeb_rtARID_DEF.ARID_DEF_MATLABFunction20.Active_Time@ */ /end MEASUREMENT
/begin MEASUREMENT autosar_swc_aeb_rtARID_DEF.ARID_DEF_MATLABFunction20_j.Active_Sts "" UBYTE autosar_swc_aeb_CM_uint8 0 0 0 255 ECU_ADDRESS 0xfe4a4ffc /* @ECU_Address@autosar_swc_aeb_rtARID_DEF.ARID_DEF_MATLABFunction20_j.Active_Sts@ */ /end MEASUREMENT
/begin MEASUREMENT autosar_swc_aeb_rtARID_DEF.ARID_DEF_MATLABFunction20_j.Active_Time "" FLOAT32_IEEE autosar_swc_aeb_CM_single 0 0 -3.4E+38 3.4E+38 ECU_ADDRESS 0xfe4a4ff8 /* @ECU_Address@autosar_swc_aeb_rtARID_DEF.ARID_DEF_MATLABFunction20_j.Active_Time@ */ /end MEASUREMENT
/begin MEASUREMENT autosar_swc_aeb_rtARID_DEF.ARID_DEF_MATLABFunction21.Active_Sts "" UBYTE autosar_swc_aeb_CM_uint8 0 0 0 255 ECU_ADDRESS 0xfe4a4ec4 /* @ECU_Address@autosar_swc_aeb_rtARID_DEF.ARID_DEF_MATLABFunction21.Active_Sts@ */ /end MEASUREMENT
/begin MEASUREMENT autosar_swc_aeb_rtARID_DEF.ARID_DEF_MATLABFunction21.Active_Time "" FLOAT32_IEEE autosar_swc_aeb_CM_single 0 0 -3.4E+38 3.4E+38 ECU_ADDRESS 0xfe4a4ec0 /* @ECU_Address@autosar_swc_aeb_rtARID_DEF.ARID_DEF_MATLABFunction21.Active_Time@ */ /end MEASUREMENT
/begin MEASUREMENT autosar_swc_aeb_rtARID_DEF.ARID_DEF_MATLABFunction21_a.Active_Sts "" UBYTE autosar_swc_aeb_CM_uint8 0 0 0 255 ECU_ADDRESS 0xfe4a4ff4 /* @ECU_Address@autosar_swc_aeb_rtARID_DEF.ARID_DEF_MATLABFunction21_a.Active_Sts@ */ /end MEASUREMENT
/begin MEASUREMENT autosar_swc_aeb_rtARID_DEF.ARID_DEF_MATLABFunction21_a.Active_Time "" FLOAT32_IEEE autosar_swc_aeb_CM_single 0 0 -3.4E+38 3.4E+38 ECU_ADDRESS 0xfe4a4ff0 /* @ECU_Address@autosar_swc_aeb_rtARID_DEF.ARID_DEF_MATLABFunction21_a.Active_Time@ */ /end MEASUREMENT
/begin MEASUREMENT autosar_swc_aeb_rtARID_DEF.ARID_DEF_MATLABFunction22.Active_Sts "" UBYTE autosar_swc_aeb_CM_uint8 0 0 0 255 ECU_ADDRESS 0xfe4a4ebc /* @ECU_Address@autosar_swc_aeb_rtARID_DEF.ARID_DEF_MATLABFunction22.Active_Sts@ */ /end MEASUREMENT
/begin MEASUREMENT autosar_swc_aeb_rtARID_DEF.ARID_DEF_MATLABFunction22.Active_Time "" FLOAT32_IEEE autosar_swc_aeb_CM_single 0 0 -3.4E+38 3.4E+38 ECU_ADDRESS 0xfe4a4eb8 /* @ECU_Address@autosar_swc_aeb_rtARID_DEF.ARID_DEF_MATLABFunction22.Active_Time@ */ /end MEASUREMENT
/begin MEASUREMENT autosar_swc_aeb_rtARID_DEF.ARID_DEF_MATLABFunction22_f.Active_Sts "" UBYTE autosar_swc_aeb_CM_uint8 0 0 0 255 ECU_ADDRESS 0xfe4a4fec /* @ECU_Address@autosar_swc_aeb_rtARID_DEF.ARID_DEF_MATLABFunction22_f.Active_Sts@ */ /end MEASUREMENT
/begin MEASUREMENT autosar_swc_aeb_rtARID_DEF.ARID_DEF_MATLABFunction22_f.Active_Time "" FLOAT32_IEEE autosar_swc_aeb_CM_single 0 0 -3.4E+38 3.4E+38 ECU_ADDRESS 0xfe4a4fe8 /* @ECU_Address@autosar_swc_aeb_rtARID_DEF.ARID_DEF_MATLABFunction22_f.Active_Time@ */ /end MEASUREMENT
/begin MEASUREMENT autosar_swc_aeb_rtARID_DEF.ARID_DEF_MATLABFunction23.Active_Sts "" UBYTE autosar_swc_aeb_CM_uint8 0 0 0 255 ECU_ADDRESS 0xfe4a4eb4 /* @ECU_Address@autosar_swc_aeb_rtARID_DEF.ARID_DEF_MATLABFunction23.Active_Sts@ */ /end MEASUREMENT
/begin MEASUREMENT autosar_swc_aeb_rtARID_DEF.ARID_DEF_MATLABFunction23.Active_Time "" FLOAT32_IEEE autosar_swc_aeb_CM_single 0 0 -3.4E+38 3.4E+38 ECU_ADDRESS 0xfe4a4eb0 /* @ECU_Address@autosar_swc_aeb_rtARID_DEF.ARID_DEF_MATLABFunction23.Active_Time@ */ /end MEASUREMENT
/begin MEASUREMENT autosar_swc_aeb_rtARID_DEF.ARID_DEF_MATLABFunction23_j.Active_Sts "" UBYTE autosar_swc_aeb_CM_uint8 0 0 0 255 ECU_ADDRESS 0xfe4a4fe4 /* @ECU_Address@autosar_swc_aeb_rtARID_DEF.ARID_DEF_MATLABFunction23_j.Active_Sts@ */ /end MEASUREMENT
/begin MEASUREMENT autosar_swc_aeb_rtARID_DEF.ARID_DEF_MATLABFunction23_j.Active_Time "" FLOAT32_IEEE autosar_swc_aeb_CM_single 0 0 -3.4E+38 3.4E+38 ECU_ADDRESS 0xfe4a4fe0 /* @ECU_Address@autosar_swc_aeb_rtARID_DEF.ARID_DEF_MATLABFunction23_j.Active_Time@ */ /end MEASUREMENT
/begin MEASUREMENT autosar_swc_aeb_rtARID_DEF.ARID_DEF_MATLABFunction24.Active_Sts "" UBYTE autosar_swc_aeb_CM_uint8 0 0 0 255 ECU_ADDRESS 0xfe4a4eac /* @ECU_Address@autosar_swc_aeb_rtARID_DEF.ARID_DEF_MATLABFunction24.Active_Sts@ */ /end MEASUREMENT
/begin MEASUREMENT autosar_swc_aeb_rtARID_DEF.ARID_DEF_MATLABFunction24.Active_Time "" FLOAT32_IEEE autosar_swc_aeb_CM_single 0 0 -3.4E+38 3.4E+38 ECU_ADDRESS 0xfe4a4ea8 /* @ECU_Address@autosar_swc_aeb_rtARID_DEF.ARID_DEF_MATLABFunction24.Active_Time@ */ /end MEASUREMENT
/begin MEASUREMENT autosar_swc_aeb_rtARID_DEF.ARID_DEF_MATLABFunction24_b.Active_Sts "" UBYTE autosar_swc_aeb_CM_uint8 0 0 0 255 ECU_ADDRESS 0xfe4a4fdc /* @ECU_Address@autosar_swc_aeb_rtARID_DEF.ARID_DEF_MATLABFunction24_b.Active_Sts@ */ /end MEASUREMENT
/begin MEASUREMENT autosar_swc_aeb_rtARID_DEF.ARID_DEF_MATLABFunction24_b.Active_Time "" FLOAT32_IEEE autosar_swc_aeb_CM_single 0 0 -3.4E+38 3.4E+38 ECU_ADDRESS 0xfe4a4fd8 /* @ECU_Address@autosar_swc_aeb_rtARID_DEF.ARID_DEF_MATLABFunction24_b.Active_Time@ */ /end MEASUREMENT
/begin MEASUREMENT autosar_swc_aeb_rtARID_DEF.ARID_DEF_MATLABFunction25.Active_Sts "" UBYTE autosar_swc_aeb_CM_uint8 0 0 0 255 ECU_ADDRESS 0xfe4a4ea4 /* @ECU_Address@autosar_swc_aeb_rtARID_DEF.ARID_DEF_MATLABFunction25.Active_Sts@ */ /end MEASUREMENT
/begin MEASUREMENT autosar_swc_aeb_rtARID_DEF.ARID_DEF_MATLABFunction25.Active_Time "" FLOAT32_IEEE autosar_swc_aeb_CM_single 0 0 -3.4E+38 3.4E+38 ECU_ADDRESS 0xfe4a4ea0 /* @ECU_Address@autosar_swc_aeb_rtARID_DEF.ARID_DEF_MATLABFunction25.Active_Time@ */ /end MEASUREMENT
/begin MEASUREMENT autosar_swc_aeb_rtARID_DEF.ARID_DEF_MATLABFunction25_e.Active_Sts "" UBYTE autosar_swc_aeb_CM_uint8 0 0 0 255 ECU_ADDRESS 0xfe4a4fd4 /* @ECU_Address@autosar_swc_aeb_rtARID_DEF.ARID_DEF_MATLABFunction25_e.Active_Sts@ */ /end MEASUREMENT
/begin MEASUREMENT autosar_swc_aeb_rtARID_DEF.ARID_DEF_MATLABFunction25_e.Active_Time "" FLOAT32_IEEE autosar_swc_aeb_CM_single 0 0 -3.4E+38 3.4E+38 ECU_ADDRESS 0xfe4a4fd0 /* @ECU_Address@autosar_swc_aeb_rtARID_DEF.ARID_DEF_MATLABFunction25_e.Active_Time@ */ /end MEASUREMENT
/begin MEASUREMENT autosar_swc_aeb_rtARID_DEF.ARID_DEF_MATLABFunction26.Active_Sts "" UBYTE autosar_swc_aeb_CM_uint8 0 0 0 255 ECU_ADDRESS 0xfe4a4e9c /* @ECU_Address@autosar_swc_aeb_rtARID_DEF.ARID_DEF_MATLABFunction26.Active_Sts@ */ /end MEASUREMENT
/begin MEASUREMENT autosar_swc_aeb_rtARID_DEF.ARID_DEF_MATLABFunction26.Active_Time "" FLOAT32_IEEE autosar_swc_aeb_CM_single 0 0 -3.4E+38 3.4E+38 ECU_ADDRESS 0xfe4a4e98 /* @ECU_Address@autosar_swc_aeb_rtARID_DEF.ARID_DEF_MATLABFunction26.Active_Time@ */ /end MEASUREMENT
/begin MEASUREMENT autosar_swc_aeb_rtARID_DEF.ARID_DEF_MATLABFunction26_d.Active_Sts "" UBYTE autosar_swc_aeb_CM_uint8 0 0 0 255 ECU_ADDRESS 0xfe4a4fcc /* @ECU_Address@autosar_swc_aeb_rtARID_DEF.ARID_DEF_MATLABFunction26_d.Active_Sts@ */ /end MEASUREMENT
/begin MEASUREMENT autosar_swc_aeb_rtARID_DEF.ARID_DEF_MATLABFunction26_d.Active_Time "" FLOAT32_IEEE autosar_swc_aeb_CM_single 0 0 -3.4E+38 3.4E+38 ECU_ADDRESS 0xfe4a4fc8 /* @ECU_Address@autosar_swc_aeb_rtARID_DEF.ARID_DEF_MATLABFunction26_d.Active_Time@ */ /end MEASUREMENT
/begin MEASUREMENT autosar_swc_aeb_rtARID_DEF.ARID_DEF_MATLABFunction27.Active_Sts "" UBYTE autosar_swc_aeb_CM_uint8 0 0 0 255 ECU_ADDRESS 0xfe4a4e94 /* @ECU_Address@autosar_swc_aeb_rtARID_DEF.ARID_DEF_MATLABFunction27.Active_Sts@ */ /end MEASUREMENT
/begin MEASUREMENT autosar_swc_aeb_rtARID_DEF.ARID_DEF_MATLABFunction27.Active_Time "" FLOAT32_IEEE autosar_swc_aeb_CM_single 0 0 -3.4E+38 3.4E+38 ECU_ADDRESS 0xfe4a4e90 /* @ECU_Address@autosar_swc_aeb_rtARID_DEF.ARID_DEF_MATLABFunction27.Active_Time@ */ /end MEASUREMENT
/begin MEASUREMENT autosar_swc_aeb_rtARID_DEF.ARID_DEF_MATLABFunction27_b.Active_Sts "" UBYTE autosar_swc_aeb_CM_uint8 0 0 0 255 ECU_ADDRESS 0xfe4a4fc4 /* @ECU_Address@autosar_swc_aeb_rtARID_DEF.ARID_DEF_MATLABFunction27_b.Active_Sts@ */ /end MEASUREMENT
/begin MEASUREMENT autosar_swc_aeb_rtARID_DEF.ARID_DEF_MATLABFunction27_b.Active_Time "" FLOAT32_IEEE autosar_swc_aeb_CM_single 0 0 -3.4E+38 3.4E+38 ECU_ADDRESS 0xfe4a4fc0 /* @ECU_Address@autosar_swc_aeb_rtARID_DEF.ARID_DEF_MATLABFunction27_b.Active_Time@ */ /end MEASUREMENT
/begin MEASUREMENT autosar_swc_aeb_rtARID_DEF.ARID_DEF_MATLABFunction28.Active_Sts "" UBYTE autosar_swc_aeb_CM_uint8 0 0 0 255 ECU_ADDRESS 0xfe4a4e8c /* @ECU_Address@autosar_swc_aeb_rtARID_DEF.ARID_DEF_MATLABFunction28.Active_Sts@ */ /end MEASUREMENT
/begin MEASUREMENT autosar_swc_aeb_rtARID_DEF.ARID_DEF_MATLABFunction28.Active_Time "" FLOAT32_IEEE autosar_swc_aeb_CM_single 0 0 -3.4E+38 3.4E+38 ECU_ADDRESS 0xfe4a4e88 /* @ECU_Address@autosar_swc_aeb_rtARID_DEF.ARID_DEF_MATLABFunction28.Active_Time@ */ /end MEASUREMENT
/begin MEASUREMENT autosar_swc_aeb_rtARID_DEF.ARID_DEF_MATLABFunction28_h.Active_Sts "" UBYTE autosar_swc_aeb_CM_uint8 0 0 0 255 ECU_ADDRESS 0xfe4a4fbc /* @ECU_Address@autosar_swc_aeb_rtARID_DEF.ARID_DEF_MATLABFunction28_h.Active_Sts@ */ /end MEASUREMENT
/begin MEASUREMENT autosar_swc_aeb_rtARID_DEF.ARID_DEF_MATLABFunction28_h.Active_Time "" FLOAT32_IEEE autosar_swc_aeb_CM_single 0 0 -3.4E+38 3.4E+38 ECU_ADDRESS 0xfe4a4fb8 /* @ECU_Address@autosar_swc_aeb_rtARID_DEF.ARID_DEF_MATLABFunction28_h.Active_Time@ */ /end MEASUREMENT
/begin MEASUREMENT autosar_swc_aeb_rtARID_DEF.ARID_DEF_MATLABFunction29.Active_Sts "" UBYTE autosar_swc_aeb_CM_uint8 0 0 0 255 ECU_ADDRESS 0xfe4a4e84 /* @ECU_Address@autosar_swc_aeb_rtARID_DEF.ARID_DEF_MATLABFunction29.Active_Sts@ */ /end MEASUREMENT
/begin MEASUREMENT autosar_swc_aeb_rtARID_DEF.ARID_DEF_MATLABFunction29.Active_Time "" FLOAT32_IEEE autosar_swc_aeb_CM_single 0 0 -3.4E+38 3.4E+38 ECU_ADDRESS 0xfe4a4e80 /* @ECU_Address@autosar_swc_aeb_rtARID_DEF.ARID_DEF_MATLABFunction29.Active_Time@ */ /end MEASUREMENT
/begin MEASUREMENT autosar_swc_aeb_rtARID_DEF.ARID_DEF_MATLABFunction29_l.Active_Sts "" UBYTE autosar_swc_aeb_CM_uint8 0 0 0 255 ECU_ADDRESS 0xfe4a4fb4 /* @ECU_Address@autosar_swc_aeb_rtARID_DEF.ARID_DEF_MATLABFunction29_l.Active_Sts@ */ /end MEASUREMENT
/begin MEASUREMENT autosar_swc_aeb_rtARID_DEF.ARID_DEF_MATLABFunction29_l.Active_Time "" FLOAT32_IEEE autosar_swc_aeb_CM_single 0 0 -3.4E+38 3.4E+38 ECU_ADDRESS 0xfe4a4fb0 /* @ECU_Address@autosar_swc_aeb_rtARID_DEF.ARID_DEF_MATLABFunction29_l.Active_Time@ */ /end MEASUREMENT
/begin MEASUREMENT autosar_swc_aeb_rtARID_DEF.ARID_DEF_MATLABFunction2_j.Active_Sts "" UBYTE autosar_swc_aeb_CM_uint8 0 0 0 255 ECU_ADDRESS 0xfe4a5004 /* @ECU_Address@autosar_swc_aeb_rtARID_DEF.ARID_DEF_MATLABFunction2_j.Active_Sts@ */ /end MEASUREMENT
/begin MEASUREMENT autosar_swc_aeb_rtARID_DEF.ARID_DEF_MATLABFunction2_j.Active_Time "" FLOAT32_IEEE autosar_swc_aeb_CM_single 0 0 -3.4E+38 3.4E+38 ECU_ADDRESS 0xfe4a5000 /* @ECU_Address@autosar_swc_aeb_rtARID_DEF.ARID_DEF_MATLABFunction2_j.Active_Time@ */ /end MEASUREMENT
/begin MEASUREMENT autosar_swc_aeb_rtARID_DEF.ARID_DEF_MATLABFunction3.Active_Sts "" UBYTE autosar_swc_aeb_CM_uint8 0 0 0 255 ECU_ADDRESS 0xfe4a4e7c /* @ECU_Address@autosar_swc_aeb_rtARID_DEF.ARID_DEF_MATLABFunction3.Active_Sts@ */ /end MEASUREMENT
/begin MEASUREMENT autosar_swc_aeb_rtARID_DEF.ARID_DEF_MATLABFunction3.Active_Time "" FLOAT32_IEEE autosar_swc_aeb_CM_single 0 0 -3.4E+38 3.4E+38 ECU_ADDRESS 0xfe4a4e78 /* @ECU_Address@autosar_swc_aeb_rtARID_DEF.ARID_DEF_MATLABFunction3.Active_Time@ */ /end MEASUREMENT
/begin MEASUREMENT autosar_swc_aeb_rtARID_DEF.ARID_DEF_MATLABFunction30.Active_Sts "" UBYTE autosar_swc_aeb_CM_uint8 0 0 0 255 ECU_ADDRESS 0xfe4a4e74 /* @ECU_Address@autosar_swc_aeb_rtARID_DEF.ARID_DEF_MATLABFunction30.Active_Sts@ */ /end MEASUREMENT
/begin MEASUREMENT autosar_swc_aeb_rtARID_DEF.ARID_DEF_MATLABFunction30.Active_Time "" FLOAT32_IEEE autosar_swc_aeb_CM_single 0 0 -3.4E+38 3.4E+38 ECU_ADDRESS 0xfe4a4e70 /* @ECU_Address@autosar_swc_aeb_rtARID_DEF.ARID_DEF_MATLABFunction30.Active_Time@ */ /end MEASUREMENT
/begin MEASUREMENT autosar_swc_aeb_rtARID_DEF.ARID_DEF_MATLABFunction30_n.Active_Sts "" UBYTE autosar_swc_aeb_CM_uint8 0 0 0 255 ECU_ADDRESS 0xfe4a4fa4 /* @ECU_Address@autosar_swc_aeb_rtARID_DEF.ARID_DEF_MATLABFunction30_n.Active_Sts@ */ /end MEASUREMENT
/begin MEASUREMENT autosar_swc_aeb_rtARID_DEF.ARID_DEF_MATLABFunction30_n.Active_Time "" FLOAT32_IEEE autosar_swc_aeb_CM_single 0 0 -3.4E+38 3.4E+38 ECU_ADDRESS 0xfe4a4fa0 /* @ECU_Address@autosar_swc_aeb_rtARID_DEF.ARID_DEF_MATLABFunction30_n.Active_Time@ */ /end MEASUREMENT
/begin MEASUREMENT autosar_swc_aeb_rtARID_DEF.ARID_DEF_MATLABFunction31_b.Active_Sts "" UBYTE autosar_swc_aeb_CM_uint8 0 0 0 255 ECU_ADDRESS 0xfe4a4f9c /* @ECU_Address@autosar_swc_aeb_rtARID_DEF.ARID_DEF_MATLABFunction31_b.Active_Sts@ */ /end MEASUREMENT
/begin MEASUREMENT autosar_swc_aeb_rtARID_DEF.ARID_DEF_MATLABFunction31_b.Active_Time "" FLOAT32_IEEE autosar_swc_aeb_CM_single 0 0 -3.4E+38 3.4E+38 ECU_ADDRESS 0xfe4a4f98 /* @ECU_Address@autosar_swc_aeb_rtARID_DEF.ARID_DEF_MATLABFunction31_b.Active_Time@ */ /end MEASUREMENT
/begin MEASUREMENT autosar_swc_aeb_rtARID_DEF.ARID_DEF_MATLABFunction31_f.Active_Sts "" UBYTE autosar_swc_aeb_CM_uint8 0 0 0 255 ECU_ADDRESS 0xfe4a4e6c /* @ECU_Address@autosar_swc_aeb_rtARID_DEF.ARID_DEF_MATLABFunction31_f.Active_Sts@ */ /end MEASUREMENT
/begin MEASUREMENT autosar_swc_aeb_rtARID_DEF.ARID_DEF_MATLABFunction31_f.Active_Time "" FLOAT32_IEEE autosar_swc_aeb_CM_single 0 0 -3.4E+38 3.4E+38 ECU_ADDRESS 0xfe4a4e68 /* @ECU_Address@autosar_swc_aeb_rtARID_DEF.ARID_DEF_MATLABFunction31_f.Active_Time@ */ /end MEASUREMENT
/begin MEASUREMENT autosar_swc_aeb_rtARID_DEF.ARID_DEF_MATLABFunction32.Active_Sts "" UBYTE autosar_swc_aeb_CM_uint8 0 0 0 255 ECU_ADDRESS 0xfe4a4e64 /* @ECU_Address@autosar_swc_aeb_rtARID_DEF.ARID_DEF_MATLABFunction32.Active_Sts@ */ /end MEASUREMENT
/begin MEASUREMENT autosar_swc_aeb_rtARID_DEF.ARID_DEF_MATLABFunction32.Active_Time "" FLOAT32_IEEE autosar_swc_aeb_CM_single 0 0 -3.4E+38 3.4E+38 ECU_ADDRESS 0xfe4a4e60 /* @ECU_Address@autosar_swc_aeb_rtARID_DEF.ARID_DEF_MATLABFunction32.Active_Time@ */ /end MEASUREMENT
/begin MEASUREMENT autosar_swc_aeb_rtARID_DEF.ARID_DEF_MATLABFunction32_o.Active_Sts "" UBYTE autosar_swc_aeb_CM_uint8 0 0 0 255 ECU_ADDRESS 0xfe4a4f94 /* @ECU_Address@autosar_swc_aeb_rtARID_DEF.ARID_DEF_MATLABFunction32_o.Active_Sts@ */ /end MEASUREMENT
/begin MEASUREMENT autosar_swc_aeb_rtARID_DEF.ARID_DEF_MATLABFunction32_o.Active_Time "" FLOAT32_IEEE autosar_swc_aeb_CM_single 0 0 -3.4E+38 3.4E+38 ECU_ADDRESS 0xfe4a4f90 /* @ECU_Address@autosar_swc_aeb_rtARID_DEF.ARID_DEF_MATLABFunction32_o.Active_Time@ */ /end MEASUREMENT
/begin MEASUREMENT autosar_swc_aeb_rtARID_DEF.ARID_DEF_MATLABFunction33.Active_Sts "" UBYTE autosar_swc_aeb_CM_uint8 0 0 0 255 ECU_ADDRESS 0xfe4a4e5c /* @ECU_Address@autosar_swc_aeb_rtARID_DEF.ARID_DEF_MATLABFunction33.Active_Sts@ */ /end MEASUREMENT
/begin MEASUREMENT autosar_swc_aeb_rtARID_DEF.ARID_DEF_MATLABFunction33.Active_Time "" FLOAT32_IEEE autosar_swc_aeb_CM_single 0 0 -3.4E+38 3.4E+38 ECU_ADDRESS 0xfe4a4e58 /* @ECU_Address@autosar_swc_aeb_rtARID_DEF.ARID_DEF_MATLABFunction33.Active_Time@ */ /end MEASUREMENT
/begin MEASUREMENT autosar_swc_aeb_rtARID_DEF.ARID_DEF_MATLABFunction33_l.Active_Sts "" UBYTE autosar_swc_aeb_CM_uint8 0 0 0 255 ECU_ADDRESS 0xfe4a4f8c /* @ECU_Address@autosar_swc_aeb_rtARID_DEF.ARID_DEF_MATLABFunction33_l.Active_Sts@ */ /end MEASUREMENT
/begin MEASUREMENT autosar_swc_aeb_rtARID_DEF.ARID_DEF_MATLABFunction33_l.Active_Time "" FLOAT32_IEEE autosar_swc_aeb_CM_single 0 0 -3.4E+38 3.4E+38 ECU_ADDRESS 0xfe4a4f88 /* @ECU_Address@autosar_swc_aeb_rtARID_DEF.ARID_DEF_MATLABFunction33_l.Active_Time@ */ /end MEASUREMENT
/begin MEASUREMENT autosar_swc_aeb_rtARID_DEF.ARID_DEF_MATLABFunction34.Active_Sts "" UBYTE autosar_swc_aeb_CM_uint8 0 0 0 255 ECU_ADDRESS 0xfe4a4e54 /* @ECU_Address@autosar_swc_aeb_rtARID_DEF.ARID_DEF_MATLABFunction34.Active_Sts@ */ /end MEASUREMENT
/begin MEASUREMENT autosar_swc_aeb_rtARID_DEF.ARID_DEF_MATLABFunction34.Active_Time "" FLOAT32_IEEE autosar_swc_aeb_CM_single 0 0 -3.4E+38 3.4E+38 ECU_ADDRESS 0xfe4a4e50 /* @ECU_Address@autosar_swc_aeb_rtARID_DEF.ARID_DEF_MATLABFunction34.Active_Time@ */ /end MEASUREMENT
/begin MEASUREMENT autosar_swc_aeb_rtARID_DEF.ARID_DEF_MATLABFunction34_d.Active_Sts "" UBYTE autosar_swc_aeb_CM_uint8 0 0 0 255 ECU_ADDRESS 0xfe4a4f84 /* @ECU_Address@autosar_swc_aeb_rtARID_DEF.ARID_DEF_MATLABFunction34_d.Active_Sts@ */ /end MEASUREMENT
/begin MEASUREMENT autosar_swc_aeb_rtARID_DEF.ARID_DEF_MATLABFunction34_d.Active_Time "" FLOAT32_IEEE autosar_swc_aeb_CM_single 0 0 -3.4E+38 3.4E+38 ECU_ADDRESS 0xfe4a4f80 /* @ECU_Address@autosar_swc_aeb_rtARID_DEF.ARID_DEF_MATLABFunction34_d.Active_Time@ */ /end MEASUREMENT
/begin MEASUREMENT autosar_swc_aeb_rtARID_DEF.ARID_DEF_MATLABFunction35.Active_Sts "" UBYTE autosar_swc_aeb_CM_uint8 0 0 0 255 ECU_ADDRESS 0xfe4a4e4c /* @ECU_Address@autosar_swc_aeb_rtARID_DEF.ARID_DEF_MATLABFunction35.Active_Sts@ */ /end MEASUREMENT
/begin MEASUREMENT autosar_swc_aeb_rtARID_DEF.ARID_DEF_MATLABFunction35.Active_Time "" FLOAT32_IEEE autosar_swc_aeb_CM_single 0 0 -3.4E+38 3.4E+38 ECU_ADDRESS 0xfe4a4e48 /* @ECU_Address@autosar_swc_aeb_rtARID_DEF.ARID_DEF_MATLABFunction35.Active_Time@ */ /end MEASUREMENT
/begin MEASUREMENT autosar_swc_aeb_rtARID_DEF.ARID_DEF_MATLABFunction35_d.Active_Sts "" UBYTE autosar_swc_aeb_CM_uint8 0 0 0 255 ECU_ADDRESS 0xfe4a4f7c /* @ECU_Address@autosar_swc_aeb_rtARID_DEF.ARID_DEF_MATLABFunction35_d.Active_Sts@ */ /end MEASUREMENT
/begin MEASUREMENT autosar_swc_aeb_rtARID_DEF.ARID_DEF_MATLABFunction35_d.Active_Time "" FLOAT32_IEEE autosar_swc_aeb_CM_single 0 0 -3.4E+38 3.4E+38 ECU_ADDRESS 0xfe4a4f78 /* @ECU_Address@autosar_swc_aeb_rtARID_DEF.ARID_DEF_MATLABFunction35_d.Active_Time@ */ /end MEASUREMENT
/begin MEASUREMENT autosar_swc_aeb_rtARID_DEF.ARID_DEF_MATLABFunction36.Active_Sts "" UBYTE autosar_swc_aeb_CM_uint8 0 0 0 255 ECU_ADDRESS 0xfe4a4e44 /* @ECU_Address@autosar_swc_aeb_rtARID_DEF.ARID_DEF_MATLABFunction36.Active_Sts@ */ /end MEASUREMENT
/begin MEASUREMENT autosar_swc_aeb_rtARID_DEF.ARID_DEF_MATLABFunction36.Active_Time "" FLOAT32_IEEE autosar_swc_aeb_CM_single 0 0 -3.4E+38 3.4E+38 ECU_ADDRESS 0xfe4a4e40 /* @ECU_Address@autosar_swc_aeb_rtARID_DEF.ARID_DEF_MATLABFunction36.Active_Time@ */ /end MEASUREMENT
/begin MEASUREMENT autosar_swc_aeb_rtARID_DEF.ARID_DEF_MATLABFunction36_l.Active_Sts "" UBYTE autosar_swc_aeb_CM_uint8 0 0 0 255 ECU_ADDRESS 0xfe4a4f74 /* @ECU_Address@autosar_swc_aeb_rtARID_DEF.ARID_DEF_MATLABFunction36_l.Active_Sts@ */ /end MEASUREMENT
/begin MEASUREMENT autosar_swc_aeb_rtARID_DEF.ARID_DEF_MATLABFunction36_l.Active_Time "" FLOAT32_IEEE autosar_swc_aeb_CM_single 0 0 -3.4E+38 3.4E+38 ECU_ADDRESS 0xfe4a4f70 /* @ECU_Address@autosar_swc_aeb_rtARID_DEF.ARID_DEF_MATLABFunction36_l.Active_Time@ */ /end MEASUREMENT
/begin MEASUREMENT autosar_swc_aeb_rtARID_DEF.ARID_DEF_MATLABFunction37.Active_Sts "" UBYTE autosar_swc_aeb_CM_uint8 0 0 0 255 ECU_ADDRESS 0xfe4a4e3c /* @ECU_Address@autosar_swc_aeb_rtARID_DEF.ARID_DEF_MATLABFunction37.Active_Sts@ */ /end MEASUREMENT
/begin MEASUREMENT autosar_swc_aeb_rtARID_DEF.ARID_DEF_MATLABFunction37.Active_Time "" FLOAT32_IEEE autosar_swc_aeb_CM_single 0 0 -3.4E+38 3.4E+38 ECU_ADDRESS 0xfe4a4e38 /* @ECU_Address@autosar_swc_aeb_rtARID_DEF.ARID_DEF_MATLABFunction37.Active_Time@ */ /end MEASUREMENT
/begin MEASUREMENT autosar_swc_aeb_rtARID_DEF.ARID_DEF_MATLABFunction37_g.Active_Sts "" UBYTE autosar_swc_aeb_CM_uint8 0 0 0 255 ECU_ADDRESS 0xfe4a4f6c /* @ECU_Address@autosar_swc_aeb_rtARID_DEF.ARID_DEF_MATLABFunction37_g.Active_Sts@ */ /end MEASUREMENT
/begin MEASUREMENT autosar_swc_aeb_rtARID_DEF.ARID_DEF_MATLABFunction37_g.Active_Time "" FLOAT32_IEEE autosar_swc_aeb_CM_single 0 0 -3.4E+38 3.4E+38 ECU_ADDRESS 0xfe4a4f68 /* @ECU_Address@autosar_swc_aeb_rtARID_DEF.ARID_DEF_MATLABFunction37_g.Active_Time@ */ /end MEASUREMENT
/begin MEASUREMENT autosar_swc_aeb_rtARID_DEF.ARID_DEF_MATLABFunction38.Active_Sts "" UBYTE autosar_swc_aeb_CM_uint8 0 0 0 255 ECU_ADDRESS 0xfe4a4e34 /* @ECU_Address@autosar_swc_aeb_rtARID_DEF.ARID_DEF_MATLABFunction38.Active_Sts@ */ /end MEASUREMENT
/begin MEASUREMENT autosar_swc_aeb_rtARID_DEF.ARID_DEF_MATLABFunction38.Active_Time "" FLOAT32_IEEE autosar_swc_aeb_CM_single 0 0 -3.4E+38 3.4E+38 ECU_ADDRESS 0xfe4a4e30 /* @ECU_Address@autosar_swc_aeb_rtARID_DEF.ARID_DEF_MATLABFunction38.Active_Time@ */ /end MEASUREMENT
/begin MEASUREMENT autosar_swc_aeb_rtARID_DEF.ARID_DEF_MATLABFunction38_d.Active_Sts "" UBYTE autosar_swc_aeb_CM_uint8 0 0 0 255 ECU_ADDRESS 0xfe4a4f64 /* @ECU_Address@autosar_swc_aeb_rtARID_DEF.ARID_DEF_MATLABFunction38_d.Active_Sts@ */ /end MEASUREMENT
/begin MEASUREMENT autosar_swc_aeb_rtARID_DEF.ARID_DEF_MATLABFunction38_d.Active_Time "" FLOAT32_IEEE autosar_swc_aeb_CM_single 0 0 -3.4E+38 3.4E+38 ECU_ADDRESS 0xfe4a4f60 /* @ECU_Address@autosar_swc_aeb_rtARID_DEF.ARID_DEF_MATLABFunction38_d.Active_Time@ */ /end MEASUREMENT
/begin MEASUREMENT autosar_swc_aeb_rtARID_DEF.ARID_DEF_MATLABFunction39.Active_Sts "" UBYTE autosar_swc_aeb_CM_uint8 0 0 0 255 ECU_ADDRESS 0xfe4a4e2c /* @ECU_Address@autosar_swc_aeb_rtARID_DEF.ARID_DEF_MATLABFunction39.Active_Sts@ */ /end MEASUREMENT
/begin MEASUREMENT autosar_swc_aeb_rtARID_DEF.ARID_DEF_MATLABFunction39.Active_Time "" FLOAT32_IEEE autosar_swc_aeb_CM_single 0 0 -3.4E+38 3.4E+38 ECU_ADDRESS 0xfe4a4e28 /* @ECU_Address@autosar_swc_aeb_rtARID_DEF.ARID_DEF_MATLABFunction39.Active_Time@ */ /end MEASUREMENT
/begin MEASUREMENT autosar_swc_aeb_rtARID_DEF.ARID_DEF_MATLABFunction39_j.Active_Sts "" UBYTE autosar_swc_aeb_CM_uint8 0 0 0 255 ECU_ADDRESS 0xfe4a4f5c /* @ECU_Address@autosar_swc_aeb_rtARID_DEF.ARID_DEF_MATLABFunction39_j.Active_Sts@ */ /end MEASUREMENT
/begin MEASUREMENT autosar_swc_aeb_rtARID_DEF.ARID_DEF_MATLABFunction39_j.Active_Time "" FLOAT32_IEEE autosar_swc_aeb_CM_single 0 0 -3.4E+38 3.4E+38 ECU_ADDRESS 0xfe4a4f58 /* @ECU_Address@autosar_swc_aeb_rtARID_DEF.ARID_DEF_MATLABFunction39_j.Active_Time@ */ /end MEASUREMENT
/begin MEASUREMENT autosar_swc_aeb_rtARID_DEF.ARID_DEF_MATLABFunction3_b.Active_Sts "" UBYTE autosar_swc_aeb_CM_uint8 0 0 0 255 ECU_ADDRESS 0xfe4a4fac /* @ECU_Address@autosar_swc_aeb_rtARID_DEF.ARID_DEF_MATLABFunction3_b.Active_Sts@ */ /end MEASUREMENT
/begin MEASUREMENT autosar_swc_aeb_rtARID_DEF.ARID_DEF_MATLABFunction3_b.Active_Time "" FLOAT32_IEEE autosar_swc_aeb_CM_single 0 0 -3.4E+38 3.4E+38 ECU_ADDRESS 0xfe4a4fa8 /* @ECU_Address@autosar_swc_aeb_rtARID_DEF.ARID_DEF_MATLABFunction3_b.Active_Time@ */ /end MEASUREMENT
/begin MEASUREMENT autosar_swc_aeb_rtARID_DEF.ARID_DEF_MATLABFunction4.Active_Sts "" UBYTE autosar_swc_aeb_CM_uint8 0 0 0 255 ECU_ADDRESS 0xfe4a4e24 /* @ECU_Address@autosar_swc_aeb_rtARID_DEF.ARID_DEF_MATLABFunction4.Active_Sts@ */ /end MEASUREMENT
/begin MEASUREMENT autosar_swc_aeb_rtARID_DEF.ARID_DEF_MATLABFunction4.Active_Time "" FLOAT32_IEEE autosar_swc_aeb_CM_single 0 0 -3.4E+38 3.4E+38 ECU_ADDRESS 0xfe4a4e20 /* @ECU_Address@autosar_swc_aeb_rtARID_DEF.ARID_DEF_MATLABFunction4.Active_Time@ */ /end MEASUREMENT
/begin MEASUREMENT autosar_swc_aeb_rtARID_DEF.ARID_DEF_MATLABFunction4_l.Active_Sts "" UBYTE autosar_swc_aeb_CM_uint8 0 0 0 255 ECU_ADDRESS 0xfe4a4f54 /* @ECU_Address@autosar_swc_aeb_rtARID_DEF.ARID_DEF_MATLABFunction4_l.Active_Sts@ */ /end MEASUREMENT
/begin MEASUREMENT autosar_swc_aeb_rtARID_DEF.ARID_DEF_MATLABFunction4_l.Active_Time "" FLOAT32_IEEE autosar_swc_aeb_CM_single 0 0 -3.4E+38 3.4E+38 ECU_ADDRESS 0xfe4a4f50 /* @ECU_Address@autosar_swc_aeb_rtARID_DEF.ARID_DEF_MATLABFunction4_l.Active_Time@ */ /end MEASUREMENT
/begin MEASUREMENT autosar_swc_aeb_rtARID_DEF.ARID_DEF_MATLABFunction5.Active_Sts "" UBYTE autosar_swc_aeb_CM_uint8 0 0 0 255 ECU_ADDRESS 0xfe4a4e1c /* @ECU_Address@autosar_swc_aeb_rtARID_DEF.ARID_DEF_MATLABFunction5.Active_Sts@ */ /end MEASUREMENT
/begin MEASUREMENT autosar_swc_aeb_rtARID_DEF.ARID_DEF_MATLABFunction5.Active_Time "" FLOAT32_IEEE autosar_swc_aeb_CM_single 0 0 -3.4E+38 3.4E+38 ECU_ADDRESS 0xfe4a4e18 /* @ECU_Address@autosar_swc_aeb_rtARID_DEF.ARID_DEF_MATLABFunction5.Active_Time@ */ /end MEASUREMENT
/begin MEASUREMENT autosar_swc_aeb_rtARID_DEF.ARID_DEF_MATLABFunction5_p.Active_Sts "" UBYTE autosar_swc_aeb_CM_uint8 0 0 0 255 ECU_ADDRESS 0xfe4a4f4c /* @ECU_Address@autosar_swc_aeb_rtARID_DEF.ARID_DEF_MATLABFunction5_p.Active_Sts@ */ /end MEASUREMENT
/begin MEASUREMENT autosar_swc_aeb_rtARID_DEF.ARID_DEF_MATLABFunction5_p.Active_Time "" FLOAT32_IEEE autosar_swc_aeb_CM_single 0 0 -3.4E+38 3.4E+38 ECU_ADDRESS 0xfe4a4f48 /* @ECU_Address@autosar_swc_aeb_rtARID_DEF.ARID_DEF_MATLABFunction5_p.Active_Time@ */ /end MEASUREMENT
/begin MEASUREMENT autosar_swc_aeb_rtARID_DEF.ARID_DEF_MATLABFunction6.Active_Sts "" UBYTE autosar_swc_aeb_CM_uint8 0 0 0 255 ECU_ADDRESS 0xfe4a4e14 /* @ECU_Address@autosar_swc_aeb_rtARID_DEF.ARID_DEF_MATLABFunction6.Active_Sts@ */ /end MEASUREMENT
/begin MEASUREMENT autosar_swc_aeb_rtARID_DEF.ARID_DEF_MATLABFunction6.Active_Time "" FLOAT32_IEEE autosar_swc_aeb_CM_single 0 0 -3.4E+38 3.4E+38 ECU_ADDRESS 0xfe4a4e10 /* @ECU_Address@autosar_swc_aeb_rtARID_DEF.ARID_DEF_MATLABFunction6.Active_Time@ */ /end MEASUREMENT
/begin MEASUREMENT autosar_swc_aeb_rtARID_DEF.ARID_DEF_MATLABFunction6_n.Active_Sts "" UBYTE autosar_swc_aeb_CM_uint8 0 0 0 255 ECU_ADDRESS 0xfe4a4f44 /* @ECU_Address@autosar_swc_aeb_rtARID_DEF.ARID_DEF_MATLABFunction6_n.Active_Sts@ */ /end MEASUREMENT
/begin MEASUREMENT autosar_swc_aeb_rtARID_DEF.ARID_DEF_MATLABFunction6_n.Active_Time "" FLOAT32_IEEE autosar_swc_aeb_CM_single 0 0 -3.4E+38 3.4E+38 ECU_ADDRESS 0xfe4a4f40 /* @ECU_Address@autosar_swc_aeb_rtARID_DEF.ARID_DEF_MATLABFunction6_n.Active_Time@ */ /end MEASUREMENT
/begin MEASUREMENT autosar_swc_aeb_rtARID_DEF.ARID_DEF_MATLABFunction7.Active_Sts "" UBYTE autosar_swc_aeb_CM_uint8 0 0 0 255 ECU_ADDRESS 0xfe4a4e0c /* @ECU_Address@autosar_swc_aeb_rtARID_DEF.ARID_DEF_MATLABFunction7.Active_Sts@ */ /end MEASUREMENT
/begin MEASUREMENT autosar_swc_aeb_rtARID_DEF.ARID_DEF_MATLABFunction7.Active_Time "" FLOAT32_IEEE autosar_swc_aeb_CM_single 0 0 -3.4E+38 3.4E+38 ECU_ADDRESS 0xfe4a4e08 /* @ECU_Address@autosar_swc_aeb_rtARID_DEF.ARID_DEF_MATLABFunction7.Active_Time@ */ /end MEASUREMENT
/begin MEASUREMENT autosar_swc_aeb_rtARID_DEF.ARID_DEF_MATLABFunction7_m.Active_Sts "" UBYTE autosar_swc_aeb_CM_uint8 0 0 0 255 ECU_ADDRESS 0xfe4a4f3c /* @ECU_Address@autosar_swc_aeb_rtARID_DEF.ARID_DEF_MATLABFunction7_m.Active_Sts@ */ /end MEASUREMENT
/begin MEASUREMENT autosar_swc_aeb_rtARID_DEF.ARID_DEF_MATLABFunction7_m.Active_Time "" FLOAT32_IEEE autosar_swc_aeb_CM_single 0 0 -3.4E+38 3.4E+38 ECU_ADDRESS 0xfe4a4f38 /* @ECU_Address@autosar_swc_aeb_rtARID_DEF.ARID_DEF_MATLABFunction7_m.Active_Time@ */ /end MEASUREMENT
/begin MEASUREMENT autosar_swc_aeb_rtARID_DEF.ARID_DEF_MATLABFunction8.Active_Sts "" UBYTE autosar_swc_aeb_CM_uint8 0 0 0 255 ECU_ADDRESS 0xfe4a4e04 /* @ECU_Address@autosar_swc_aeb_rtARID_DEF.ARID_DEF_MATLABFunction8.Active_Sts@ */ /end MEASUREMENT
/begin MEASUREMENT autosar_swc_aeb_rtARID_DEF.ARID_DEF_MATLABFunction8.Active_Time "" FLOAT32_IEEE autosar_swc_aeb_CM_single 0 0 -3.4E+38 3.4E+38 ECU_ADDRESS 0xfe4a4e00 /* @ECU_Address@autosar_swc_aeb_rtARID_DEF.ARID_DEF_MATLABFunction8.Active_Time@ */ /end MEASUREMENT
/begin MEASUREMENT autosar_swc_aeb_rtARID_DEF.ARID_DEF_MATLABFunction8_g.Active_Sts "" UBYTE autosar_swc_aeb_CM_uint8 0 0 0 255 ECU_ADDRESS 0xfe4a4f34 /* @ECU_Address@autosar_swc_aeb_rtARID_DEF.ARID_DEF_MATLABFunction8_g.Active_Sts@ */ /end MEASUREMENT
/begin MEASUREMENT autosar_swc_aeb_rtARID_DEF.ARID_DEF_MATLABFunction8_g.Active_Time "" FLOAT32_IEEE autosar_swc_aeb_CM_single 0 0 -3.4E+38 3.4E+38 ECU_ADDRESS 0xfe4a4f30 /* @ECU_Address@autosar_swc_aeb_rtARID_DEF.ARID_DEF_MATLABFunction8_g.Active_Time@ */ /end MEASUREMENT
/begin MEASUREMENT autosar_swc_aeb_rtARID_DEF.ARID_DEF_MATLABFunction9.Active_Sts "" UBYTE autosar_swc_aeb_CM_uint8 0 0 0 255 ECU_ADDRESS 0xfe4a4dfc /* @ECU_Address@autosar_swc_aeb_rtARID_DEF.ARID_DEF_MATLABFunction9.Active_Sts@ */ /end MEASUREMENT
/begin MEASUREMENT autosar_swc_aeb_rtARID_DEF.ARID_DEF_MATLABFunction9.Active_Time "" FLOAT32_IEEE autosar_swc_aeb_CM_single 0 0 -3.4E+38 3.4E+38 ECU_ADDRESS 0xfe4a4df8 /* @ECU_Address@autosar_swc_aeb_rtARID_DEF.ARID_DEF_MATLABFunction9.Active_Time@ */ /end MEASUREMENT
/begin MEASUREMENT autosar_swc_aeb_rtARID_DEF.ARID_DEF_MATLABFunction9_g.Active_Sts "" UBYTE autosar_swc_aeb_CM_uint8 0 0 0 255 ECU_ADDRESS 0xfe4a4f2c /* @ECU_Address@autosar_swc_aeb_rtARID_DEF.ARID_DEF_MATLABFunction9_g.Active_Sts@ */ /end MEASUREMENT
/begin MEASUREMENT autosar_swc_aeb_rtARID_DEF.ARID_DEF_MATLABFunction9_g.Active_Time "" FLOAT32_IEEE autosar_swc_aeb_CM_single 0 0 -3.4E+38 3.4E+38 ECU_ADDRESS 0xfe4a4f28 /* @ECU_Address@autosar_swc_aeb_rtARID_DEF.ARID_DEF_MATLABFunction9_g.Active_Time@ */ /end MEASUREMENT
/begin COMPU_METHOD autosar_swc_aeb_CM_single "Q = V" IDENTICAL "%8.6" "" /end COMPU_METHOD
/begin COMPU_METHOD autosar_swc_aeb_CM_uint8 "Q = V" IDENTICAL "%3.0" "" /end COMPU_METHOD
/begin RECORD_LAYOUT Record_FLOAT32_IEEE FNC_VALUES 1 FLOAT32_IEEE COLUMN_DIR DIRECT /end RECORD_LAYOUT
/begin RECORD_LAYOUT Record_SBYTE FNC_VALUES 1 SBYTE COLUMN_DIR DIRECT /end RECORD_LAYOUT
/begin RECORD_LAYOUT Record_SWORD FNC_VALUES 1 SWORD COLUMN_DIR DIRECT /end RECORD_LAYOUT
/begin RECORD_LAYOUT Record_UBYTE FNC_VALUES 1 UBYTE COLUMN_DIR DIRECT /end RECORD_LAYOUT
/begin RECORD_LAYOUT Record_ULONG FNC_VALUES 1 ULONG COLUMN_DIR DIRECT /end RECORD_LAYOUT
/begin RECORD_LAYOUT Record_UWORD FNC_VALUES 1 UWORD COLUMN_DIR DIRECT /end RECORD_LAYOUT
/begin MEASUREMENT SwcOut_FUSAMON_FM_SAF_OUT.SftyErrInfoQue[10].SftyErrID "" ULONG autosar_swc_fusamon_CM_uint32 0 0 0 4294967295 ECU_ADDRESS 0xfe4acf40 /* @ECU_Address@SwcOut_FUSAMON_FM_SAF_OUT.SftyErrInfoQue[10].SftyErrID@ */ /end MEASUREMENT
/begin MEASUREMENT SwcOut_FUSAMON_FM_SAF_OUT.SftyErrInfoQue[10].TrigTimeStamp "" ULONG autosar_swc_fusamon_CM_uint32 0 0 0 4294967295 ECU_ADDRESS 0xfe4acf44 /* @ECU_Address@SwcOut_FUSAMON_FM_SAF_OUT.SftyErrInfoQue[10].TrigTimeStamp@ */ /end MEASUREMENT
/begin MEASUREMENT SwcOut_FUSAMON_FM_SAF_OUT.SftyErrInfoQue[11].SftyErrID "" ULONG autosar_swc_fusamon_CM_uint32 0 0 0 4294967295 ECU_ADDRESS 0xfe4acf48 /* @ECU_Address@SwcOut_FUSAMON_FM_SAF_OUT.SftyErrInfoQue[11].SftyErrID@ */ /end MEASUREMENT
/begin MEASUREMENT SwcOut_FUSAMON_FM_SAF_OUT.SftyErrInfoQue[11].TrigTimeStamp "" ULONG autosar_swc_fusamon_CM_uint32 0 0 0 4294967295 ECU_ADDRESS 0xfe4acf4c /* @ECU_Address@SwcOut_FUSAMON_FM_SAF_OUT.SftyErrInfoQue[11].TrigTimeStamp@ */ /end MEASUREMENT
/begin MEASUREMENT SwcOut_FUSAMON_FM_SAF_OUT.SftyErrInfoQue[12].SftyErrID "" ULONG autosar_swc_fusamon_CM_uint32 0 0 0 4294967295 ECU_ADDRESS 0xfe4acf50 /* @ECU_Address@SwcOut_FUSAMON_FM_SAF_OUT.SftyErrInfoQue[12].SftyErrID@ */ /end MEASUREMENT
/begin MEASUREMENT SwcOut_FUSAMON_FM_SAF_OUT.SftyErrInfoQue[12].TrigTimeStamp "" ULONG autosar_swc_fusamon_CM_uint32 0 0 0 4294967295 ECU_ADDRESS 0xfe4acf54 /* @ECU_Address@SwcOut_FUSAMON_FM_SAF_OUT.SftyErrInfoQue[12].TrigTimeStamp@ */ /end MEASUREMENT
/begin MEASUREMENT SwcOut_FUSAMON_FM_SAF_OUT.SftyErrInfoQue[13].SftyErrID "" ULONG autosar_swc_fusamon_CM_uint32 0 0 0 4294967295 ECU_ADDRESS 0xfe4acf58 /* @ECU_Address@SwcOut_FUSAMON_FM_SAF_OUT.SftyErrInfoQue[13].SftyErrID@ */ /end MEASUREMENT
/begin MEASUREMENT SwcOut_FUSAMON_FM_SAF_OUT.SftyErrInfoQue[13].TrigTimeStamp "" ULONG autosar_swc_fusamon_CM_uint32 0 0 0 4294967295 ECU_ADDRESS 0xfe4acf5c /* @ECU_Address@SwcOut_FUSAMON_FM_SAF_OUT.SftyErrInfoQue[13].TrigTimeStamp@ */ /end MEASUREMENT
/begin MEASUREMENT SwcOut_FUSAMON_FM_SAF_OUT.SftyErrInfoQue[14].SftyErrID "" ULONG autosar_swc_fusamon_CM_uint32 0 0 0 4294967295 ECU_ADDRESS 0xfe4acf60 /* @ECU_Address@SwcOut_FUSAMON_FM_SAF_OUT.SftyErrInfoQue[14].SftyErrID@ */ /end MEASUREMENT
/begin MEASUREMENT SwcOut_FUSAMON_FM_SAF_OUT.SftyErrInfoQue[14].TrigTimeStamp "" ULONG autosar_swc_fusamon_CM_uint32 0 0 0 4294967295 ECU_ADDRESS 0xfe4acf64 /* @ECU_Address@SwcOut_FUSAMON_FM_SAF_OUT.SftyErrInfoQue[14].TrigTimeStamp@ */ /end MEASUREMENT
/begin MEASUREMENT SwcOut_FUSAMON_FM_SAF_OUT.SftyErrInfoQue[15].SftyErrID "" ULONG autosar_swc_fusamon_CM_uint32 0 0 0 4294967295 ECU_ADDRESS 0xfe4acf68 /* @ECU_Address@SwcOut_FUSAMON_FM_SAF_OUT.SftyErrInfoQue[15].SftyErrID@ */ /end MEASUREMENT
/begin MEASUREMENT SwcOut_FUSAMON_FM_SAF_OUT.SftyErrInfoQue[15].TrigTimeStamp "" ULONG autosar_swc_fusamon_CM_uint32 0 0 0 4294967295 ECU_ADDRESS 0xfe4acf6c /* @ECU_Address@SwcOut_FUSAMON_FM_SAF_OUT.SftyErrInfoQue[15].TrigTimeStamp@ */ /end MEASUREMENT
/begin MEASUREMENT SwcOut_FUSAMON_FM_SAF_OUT.SftyErrInfoQue[16].SftyErrID "" ULONG autosar_swc_fusamon_CM_uint32 0 0 0 4294967295 ECU_ADDRESS 0xfe4acf70 /* @ECU_Address@SwcOut_FUSAMON_FM_SAF_OUT.SftyErrInfoQue[16].SftyErrID@ */ /end MEASUREMENT
/begin MEASUREMENT SwcOut_FUSAMON_FM_SAF_OUT.SftyErrInfoQue[16].TrigTimeStamp "" ULONG autosar_swc_fusamon_CM_uint32 0 0 0 4294967295 ECU_ADDRESS 0xfe4acf74 /* @ECU_Address@SwcOut_FUSAMON_FM_SAF_OUT.SftyErrInfoQue[16].TrigTimeStamp@ */ /end MEASUREMENT
/begin MEASUREMENT SwcOut_FUSAMON_FM_SAF_OUT.SftyErrInfoQue[17].SftyErrID "" ULONG autosar_swc_fusamon_CM_uint32 0 0 0 4294967295 ECU_ADDRESS 0xfe4acf78 /* @ECU_Address@SwcOut_FUSAMON_FM_SAF_OUT.SftyErrInfoQue[17].SftyErrID@ */ /end MEASUREMENT
/begin MEASUREMENT SwcOut_FUSAMON_FM_SAF_OUT.SftyErrInfoQue[17].TrigTimeStamp "" ULONG autosar_swc_fusamon_CM_uint32 0 0 0 4294967295 ECU_ADDRESS 0xfe4acf7c /* @ECU_Address@SwcOut_FUSAMON_FM_SAF_OUT.SftyErrInfoQue[17].TrigTimeStamp@ */ /end MEASUREMENT
/begin MEASUREMENT SwcOut_FUSAMON_FM_SAF_OUT.SftyErrInfoQue[18].SftyErrID "" ULONG autosar_swc_fusamon_CM_uint32 0 0 0 4294967295 ECU_ADDRESS 0xfe4acf80 /* @ECU_Address@SwcOut_FUSAMON_FM_SAF_OUT.SftyErrInfoQue[18].SftyErrID@ */ /end MEASUREMENT
/begin MEASUREMENT SwcOut_FUSAMON_FM_SAF_OUT.SftyErrInfoQue[18].TrigTimeStamp "" ULONG autosar_swc_fusamon_CM_uint32 0 0 0 4294967295 ECU_ADDRESS 0xfe4acf84 /* @ECU_Address@SwcOut_FUSAMON_FM_SAF_OUT.SftyErrInfoQue[18].TrigTimeStamp@ */ /end MEASUREMENT
/begin MEASUREMENT SwcOut_FUSAMON_FM_SAF_OUT.SftyErrInfoQue[19].SftyErrID "" ULONG autosar_swc_fusamon_CM_uint32 0 0 0 4294967295 ECU_ADDRESS 0xfe4acf88 /* @ECU_Address@SwcOut_FUSAMON_FM_SAF_OUT.SftyErrInfoQue[19].SftyErrID@ */ /end MEASUREMENT
/begin MEASUREMENT SwcOut_FUSAMON_FM_SAF_OUT.SftyErrInfoQue[19].TrigTimeStamp "" ULONG autosar_swc_fusamon_CM_uint32 0 0 0 4294967295 ECU_ADDRESS 0xfe4acf8c /* @ECU_Address@SwcOut_FUSAMON_FM_SAF_OUT.SftyErrInfoQue[19].TrigTimeStamp@ */ /end MEASUREMENT
/begin MEASUREMENT SwcOut_FUSAMON_FM_SAF_OUT.SftyErrInfoQue[1].SftyErrID "" ULONG autosar_swc_fusamon_CM_uint32 0 0 0 4294967295 ECU_ADDRESS 0xfe4acef8 /* @ECU_Address@SwcOut_FUSAMON_FM_SAF_OUT.SftyErrInfoQue[1].SftyErrID@ */ /end MEASUREMENT
/begin MEASUREMENT SwcOut_FUSAMON_FM_SAF_OUT.SftyErrInfoQue[1].TrigTimeStamp "" ULONG autosar_swc_fusamon_CM_uint32 0 0 0 4294967295 ECU_ADDRESS 0xfe4acefc /* @ECU_Address@SwcOut_FUSAMON_FM_SAF_OUT.SftyErrInfoQue[1].TrigTimeStamp@ */ /end MEASUREMENT
/begin MEASUREMENT SwcOut_FUSAMON_FM_SAF_OUT.SftyErrInfoQue[20].SftyErrID "" ULONG autosar_swc_fusamon_CM_uint32 0 0 0 4294967295 ECU_ADDRESS 0xfe4acf90 /* @ECU_Address@SwcOut_FUSAMON_FM_SAF_OUT.SftyErrInfoQue[20].SftyErrID@ */ /end MEASUREMENT
/begin MEASUREMENT SwcOut_FUSAMON_FM_SAF_OUT.SftyErrInfoQue[20].TrigTimeStamp "" ULONG autosar_swc_fusamon_CM_uint32 0 0 0 4294967295 ECU_ADDRESS 0xfe4acf94 /* @ECU_Address@SwcOut_FUSAMON_FM_SAF_OUT.SftyErrInfoQue[20].TrigTimeStamp@ */ /end MEASUREMENT
/begin MEASUREMENT SwcOut_FUSAMON_FM_SAF_OUT.SftyErrInfoQue[21].SftyErrID "" ULONG autosar_swc_fusamon_CM_uint32 0 0 0 4294967295 ECU_ADDRESS 0xfe4acf98 /* @ECU_Address@SwcOut_FUSAMON_FM_SAF_OUT.SftyErrInfoQue[21].SftyErrID@ */ /end MEASUREMENT
/begin MEASUREMENT SwcOut_FUSAMON_FM_SAF_OUT.SftyErrInfoQue[21].TrigTimeStamp "" ULONG autosar_swc_fusamon_CM_uint32 0 0 0 4294967295 ECU_ADDRESS 0xfe4acf9c /* @ECU_Address@SwcOut_FUSAMON_FM_SAF_OUT.SftyErrInfoQue[21].TrigTimeStamp@ */ /end MEASUREMENT
/begin MEASUREMENT SwcOut_FUSAMON_FM_SAF_OUT.SftyErrInfoQue[22].SftyErrID "" ULONG autosar_swc_fusamon_CM_uint32 0 0 0 4294967295 ECU_ADDRESS 0xfe4acfa0 /* @ECU_Address@SwcOut_FUSAMON_FM_SAF_OUT.SftyErrInfoQue[22].SftyErrID@ */ /end MEASUREMENT
/begin MEASUREMENT SwcOut_FUSAMON_FM_SAF_OUT.SftyErrInfoQue[22].TrigTimeStamp "" ULONG autosar_swc_fusamon_CM_uint32 0 0 0 4294967295 ECU_ADDRESS 0xfe4acfa4 /* @ECU_Address@SwcOut_FUSAMON_FM_SAF_OUT.SftyErrInfoQue[22].TrigTimeStamp@ */ /end MEASUREMENT
/begin MEASUREMENT SwcOut_FUSAMON_FM_SAF_OUT.SftyErrInfoQue[23].SftyErrID "" ULONG autosar_swc_fusamon_CM_uint32 0 0 0 4294967295 ECU_ADDRESS 0xfe4acfa8 /* @ECU_Address@SwcOut_FUSAMON_FM_SAF_OUT.SftyErrInfoQue[23].SftyErrID@ */ /end MEASUREMENT
/begin MEASUREMENT SwcOut_FUSAMON_FM_SAF_OUT.SftyErrInfoQue[23].TrigTimeStamp "" ULONG autosar_swc_fusamon_CM_uint32 0 0 0 4294967295 ECU_ADDRESS 0xfe4acfac /* @ECU_Address@SwcOut_FUSAMON_FM_SAF_OUT.SftyErrInfoQue[23].TrigTimeStamp@ */ /end MEASUREMENT
/begin MEASUREMENT SwcOut_FUSAMON_FM_SAF_OUT.SftyErrInfoQue[24].SftyErrID "" ULONG autosar_swc_fusamon_CM_uint32 0 0 0 4294967295 ECU_ADDRESS 0xfe4acfb0 /* @ECU_Address@SwcOut_FUSAMON_FM_SAF_OUT.SftyErrInfoQue[24].SftyErrID@ */ /end MEASUREMENT
/begin MEASUREMENT SwcOut_FUSAMON_FM_SAF_OUT.SftyErrInfoQue[24].TrigTimeStamp "" ULONG autosar_swc_fusamon_CM_uint32 0 0 0 4294967295 ECU_ADDRESS 0xfe4acfb4 /* @ECU_Address@SwcOut_FUSAMON_FM_SAF_OUT.SftyErrInfoQue[24].TrigTimeStamp@ */ /end MEASUREMENT
/begin MEASUREMENT SwcOut_FUSAMON_FM_SAF_OUT.SftyErrInfoQue[25].SftyErrID "" ULONG autosar_swc_fusamon_CM_uint32 0 0 0 4294967295 ECU_ADDRESS 0xfe4acfb8 /* @ECU_Address@SwcOut_FUSAMON_FM_SAF_OUT.SftyErrInfoQue[25].SftyErrID@ */ /end MEASUREMENT
/begin MEASUREMENT SwcOut_FUSAMON_FM_SAF_OUT.SftyErrInfoQue[25].TrigTimeStamp "" ULONG autosar_swc_fusamon_CM_uint32 0 0 0 4294967295 ECU_ADDRESS 0xfe4acfbc /* @ECU_Address@SwcOut_FUSAMON_FM_SAF_OUT.SftyErrInfoQue[25].TrigTimeStamp@ */ /end MEASUREMENT
/begin MEASUREMENT SwcOut_FUSAMON_FM_SAF_OUT.SftyErrInfoQue[26].SftyErrID "" ULONG autosar_swc_fusamon_CM_uint32 0 0 0 4294967295 ECU_ADDRESS 0xfe4acfc0 /* @ECU_Address@SwcOut_FUSAMON_FM_SAF_OUT.SftyErrInfoQue[26].SftyErrID@ */ /end MEASUREMENT
/begin MEASUREMENT SwcOut_FUSAMON_FM_SAF_OUT.SftyErrInfoQue[26].TrigTimeStamp "" ULONG autosar_swc_fusamon_CM_uint32 0 0 0 4294967295 ECU_ADDRESS 0xfe4acfc4 /* @ECU_Address@SwcOut_FUSAMON_FM_SAF_OUT.SftyErrInfoQue[26].TrigTimeStamp@ */ /end MEASUREMENT
/begin MEASUREMENT SwcOut_FUSAMON_FM_SAF_OUT.SftyErrInfoQue[27].SftyErrID "" ULONG autosar_swc_fusamon_CM_uint32 0 0 0 4294967295 ECU_ADDRESS 0xfe4acfc8 /* @ECU_Address@SwcOut_FUSAMON_FM_SAF_OUT.SftyErrInfoQue[27].SftyErrID@ */ /end MEASUREMENT
/begin MEASUREMENT SwcOut_FUSAMON_FM_SAF_OUT.SftyErrInfoQue[27].TrigTimeStamp "" ULONG autosar_swc_fusamon_CM_uint32 0 0 0 4294967295 ECU_ADDRESS 0xfe4acfcc /* @ECU_Address@SwcOut_FUSAMON_FM_SAF_OUT.SftyErrInfoQue[27].TrigTimeStamp@ */ /end MEASUREMENT
/begin MEASUREMENT SwcOut_FUSAMON_FM_SAF_OUT.SftyErrInfoQue[28].SftyErrID "" ULONG autosar_swc_fusamon_CM_uint32 0 0 0 4294967295 ECU_ADDRESS 0xfe4acfd0 /* @ECU_Address@SwcOut_FUSAMON_FM_SAF_OUT.SftyErrInfoQue[28].SftyErrID@ */ /end MEASUREMENT
/begin MEASUREMENT SwcOut_FUSAMON_FM_SAF_OUT.SftyErrInfoQue[28].TrigTimeStamp "" ULONG autosar_swc_fusamon_CM_uint32 0 0 0 4294967295 ECU_ADDRESS 0xfe4acfd4 /* @ECU_Address@SwcOut_FUSAMON_FM_SAF_OUT.SftyErrInfoQue[28].TrigTimeStamp@ */ /end MEASUREMENT
/begin MEASUREMENT SwcOut_FUSAMON_FM_SAF_OUT.SftyErrInfoQue[29].SftyErrID "" ULONG autosar_swc_fusamon_CM_uint32 0 0 0 4294967295 ECU_ADDRESS 0xfe4acfd8 /* @ECU_Address@SwcOut_FUSAMON_FM_SAF_OUT.SftyErrInfoQue[29].SftyErrID@ */ /end MEASUREMENT
/begin MEASUREMENT SwcOut_FUSAMON_FM_SAF_OUT.SftyErrInfoQue[29].TrigTimeStamp "" ULONG autosar_swc_fusamon_CM_uint32 0 0 0 4294967295 ECU_ADDRESS 0xfe4acfdc /* @ECU_Address@SwcOut_FUSAMON_FM_SAF_OUT.SftyErrInfoQue[29].TrigTimeStamp@ */ /end MEASUREMENT
/begin MEASUREMENT SwcOut_FUSAMON_FM_SAF_OUT.SftyErrInfoQue[2].SftyErrID "" ULONG autosar_swc_fusamon_CM_uint32 0 0 0 4294967295 ECU_ADDRESS 0xfe4acf00 /* @ECU_Address@SwcOut_FUSAMON_FM_SAF_OUT.SftyErrInfoQue[2].SftyErrID@ */ /end MEASUREMENT
/begin MEASUREMENT SwcOut_FUSAMON_FM_SAF_OUT.SftyErrInfoQue[2].TrigTimeStamp "" ULONG autosar_swc_fusamon_CM_uint32 0 0 0 4294967295 ECU_ADDRESS 0xfe4acf04 /* @ECU_Address@SwcOut_FUSAMON_FM_SAF_OUT.SftyErrInfoQue[2].TrigTimeStamp@ */ /end MEASUREMENT
/begin MEASUREMENT SwcOut_FUSAMON_FM_SAF_OUT.SftyErrInfoQue[30].SftyErrID "" ULONG autosar_swc_fusamon_CM_uint32 0 0 0 4294967295 ECU_ADDRESS 0xfe4acfe0 /* @ECU_Address@SwcOut_FUSAMON_FM_SAF_OUT.SftyErrInfoQue[30].SftyErrID@ */ /end MEASUREMENT
/begin MEASUREMENT SwcOut_FUSAMON_FM_SAF_OUT.SftyErrInfoQue[30].TrigTimeStamp "" ULONG autosar_swc_fusamon_CM_uint32 0 0 0 4294967295 ECU_ADDRESS 0xfe4acfe4 /* @ECU_Address@SwcOut_FUSAMON_FM_SAF_OUT.SftyErrInfoQue[30].TrigTimeStamp@ */ /end MEASUREMENT
/begin MEASUREMENT SwcOut_FUSAMON_FM_SAF_OUT.SftyErrInfoQue[31].SftyErrID "" ULONG autosar_swc_fusamon_CM_uint32 0 0 0 4294967295 ECU_ADDRESS 0xfe4acfe8 /* @ECU_Address@SwcOut_FUSAMON_FM_SAF_OUT.SftyErrInfoQue[31].SftyErrID@ */ /end MEASUREMENT
/begin MEASUREMENT SwcOut_FUSAMON_FM_SAF_OUT.SftyErrInfoQue[31].TrigTimeStamp "" ULONG autosar_swc_fusamon_CM_uint32 0 0 0 4294967295 ECU_ADDRESS 0xfe4acfec /* @ECU_Address@SwcOut_FUSAMON_FM_SAF_OUT.SftyErrInfoQue[31].TrigTimeStamp@ */ /end MEASUREMENT
/begin MEASUREMENT SwcOut_FUSAMON_FM_SAF_OUT.SftyErrInfoQue[3].SftyErrID "" ULONG autosar_swc_fusamon_CM_uint32 0 0 0 4294967295 ECU_ADDRESS 0xfe4acf08 /* @ECU_Address@SwcOut_FUSAMON_FM_SAF_OUT.SftyErrInfoQue[3].SftyErrID@ */ /end MEASUREMENT
/begin MEASUREMENT SwcOut_FUSAMON_FM_SAF_OUT.SftyErrInfoQue[3].TrigTimeStamp "" ULONG autosar_swc_fusamon_CM_uint32 0 0 0 4294967295 ECU_ADDRESS 0xfe4acf0c /* @ECU_Address@SwcOut_FUSAMON_FM_SAF_OUT.SftyErrInfoQue[3].TrigTimeStamp@ */ /end MEASUREMENT
/begin MEASUREMENT SwcOut_FUSAMON_FM_SAF_OUT.SftyErrInfoQue[4].SftyErrID "" ULONG autosar_swc_fusamon_CM_uint32 0 0 0 4294967295 ECU_ADDRESS 0xfe4acf10 /* @ECU_Address@SwcOut_FUSAMON_FM_SAF_OUT.SftyErrInfoQue[4].SftyErrID@ */ /end MEASUREMENT
/begin MEASUREMENT SwcOut_FUSAMON_FM_SAF_OUT.SftyErrInfoQue[4].TrigTimeStamp "" ULONG autosar_swc_fusamon_CM_uint32 0 0 0 4294967295 ECU_ADDRESS 0xfe4acf14 /* @ECU_Address@SwcOut_FUSAMON_FM_SAF_OUT.SftyErrInfoQue[4].TrigTimeStamp@ */ /end MEASUREMENT
/begin MEASUREMENT SwcOut_FUSAMON_FM_SAF_OUT.SftyErrInfoQue[5].SftyErrID "" ULONG autosar_swc_fusamon_CM_uint32 0 0 0 4294967295 ECU_ADDRESS 0xfe4acf18 /* @ECU_Address@SwcOut_FUSAMON_FM_SAF_OUT.SftyErrInfoQue[5].SftyErrID@ */ /end MEASUREMENT
/begin MEASUREMENT SwcOut_FUSAMON_FM_SAF_OUT.SftyErrInfoQue[5].TrigTimeStamp "" ULONG autosar_swc_fusamon_CM_uint32 0 0 0 4294967295 ECU_ADDRESS 0xfe4acf1c /* @ECU_Address@SwcOut_FUSAMON_FM_SAF_OUT.SftyErrInfoQue[5].TrigTimeStamp@ */ /end MEASUREMENT
/begin MEASUREMENT SwcOut_FUSAMON_FM_SAF_OUT.SftyErrInfoQue[6].SftyErrID "" ULONG autosar_swc_fusamon_CM_uint32 0 0 0 4294967295 ECU_ADDRESS 0xfe4acf20 /* @ECU_Address@SwcOut_FUSAMON_FM_SAF_OUT.SftyErrInfoQue[6].SftyErrID@ */ /end MEASUREMENT
/begin MEASUREMENT SwcOut_FUSAMON_FM_SAF_OUT.SftyErrInfoQue[6].TrigTimeStamp "" ULONG autosar_swc_fusamon_CM_uint32 0 0 0 4294967295 ECU_ADDRESS 0xfe4acf24 /* @ECU_Address@SwcOut_FUSAMON_FM_SAF_OUT.SftyErrInfoQue[6].TrigTimeStamp@ */ /end MEASUREMENT
/begin MEASUREMENT SwcOut_FUSAMON_FM_SAF_OUT.SftyErrInfoQue[7].SftyErrID "" ULONG autosar_swc_fusamon_CM_uint32 0 0 0 4294967295 ECU_ADDRESS 0xfe4acf28 /* @ECU_Address@SwcOut_FUSAMON_FM_SAF_OUT.SftyErrInfoQue[7].SftyErrID@ */ /end MEASUREMENT
/begin MEASUREMENT SwcOut_FUSAMON_FM_SAF_OUT.SftyErrInfoQue[7].TrigTimeStamp "" ULONG autosar_swc_fusamon_CM_uint32 0 0 0 4294967295 ECU_ADDRESS 0xfe4acf2c /* @ECU_Address@SwcOut_FUSAMON_FM_SAF_OUT.SftyErrInfoQue[7].TrigTimeStamp@ */ /end MEASUREMENT
/begin MEASUREMENT SwcOut_FUSAMON_FM_SAF_OUT.SftyErrInfoQue[8].SftyErrID "" ULONG autosar_swc_fusamon_CM_uint32 0 0 0 4294967295 ECU_ADDRESS 0xfe4acf30 /* @ECU_Address@SwcOut_FUSAMON_FM_SAF_OUT.SftyErrInfoQue[8].SftyErrID@ */ /end MEASUREMENT
/begin MEASUREMENT SwcOut_FUSAMON_FM_SAF_OUT.SftyErrInfoQue[8].TrigTimeStamp "" ULONG autosar_swc_fusamon_CM_uint32 0 0 0 4294967295 ECU_ADDRESS 0xfe4acf34 /* @ECU_Address@SwcOut_FUSAMON_FM_SAF_OUT.SftyErrInfoQue[8].TrigTimeStamp@ */ /end MEASUREMENT
/begin MEASUREMENT SwcOut_FUSAMON_FM_SAF_OUT.SftyErrInfoQue[9].SftyErrID "" ULONG autosar_swc_fusamon_CM_uint32 0 0 0 4294967295 ECU_ADDRESS 0xfe4acf38 /* @ECU_Address@SwcOut_FUSAMON_FM_SAF_OUT.SftyErrInfoQue[9].SftyErrID@ */ /end MEASUREMENT
/begin MEASUREMENT SwcOut_FUSAMON_FM_SAF_OUT.SftyErrInfoQue[9].TrigTimeStamp "" ULONG autosar_swc_fusamon_CM_uint32 0 0 0 4294967295 ECU_ADDRESS 0xfe4acf3c /* @ECU_Address@SwcOut_FUSAMON_FM_SAF_OUT.SftyErrInfoQue[9].TrigTimeStamp@ */ /end MEASUREMENT
/begin COMPU_METHOD autosar_swc_fusamon_CM_uint32 "Q = V" IDENTICAL "%10.0" "" /end COMPU_METHOD
/begin RECORD_LAYOUT Record_FLOAT32_IEEE FNC_VALUES 1 FLOAT32_IEEE COLUMN_DIR DIRECT /end RECORD_LAYOUT
/begin RECORD_LAYOUT Record_UBYTE FNC_VALUES 1 UBYTE COLUMN_DIR DIRECT /end RECORD_LAYOUT
/begin RECORD_LAYOUT Record_ULONG FNC_VALUES 1 ULONG COLUMN_DIR DIRECT /end RECORD_LAYOUT
/begin RECORD_LAYOUT Record_UWORD FNC_VALUES 1 UWORD COLUMN_DIR DIRECT /end RECORD_LAYOUT
/begin RECORD_LAYOUT Record_FLOAT32_IEEE FNC_VALUES 1 FLOAT32_IEEE COLUMN_DIR DIRECT /end RECORD_LAYOUT
/begin RECORD_LAYOUT Record_SWORD FNC_VALUES 1 SWORD COLUMN_DIR DIRECT /end RECORD_LAYOUT
/begin RECORD_LAYOUT Record_UBYTE FNC_VALUES 1 UBYTE COLUMN_DIR DIRECT /end RECORD_LAYOUT
/begin RECORD_LAYOUT Record_ULONG FNC_VALUES 1 ULONG COLUMN_DIR DIRECT /end RECORD_LAYOUT
/begin MEASUREMENT autosar_swc_icas_rtARID_DEF.ARID_DEF_Chart2.count "" UWORD autosar_swc_icas_CM_uint16 0 0 0 65535 ECU_ADDRESS 0xfe4ad6b4 /* @ECU_Address@autosar_swc_icas_rtARID_DEF.ARID_DEF_Chart2.count@ */ /end MEASUREMENT
/begin MEASUREMENT autosar_swc_icas_rtARID_DEF.ARID_DEF_Chart2.is_Active "" UBYTE autosar_swc_icas_CM_uint8 0 0 0 255 ECU_ADDRESS 0xfe4ad6b8 /* @ECU_Address@autosar_swc_icas_rtARID_DEF.ARID_DEF_Chart2.is_Active@ */ /end MEASUREMENT
/begin MEASUREMENT autosar_swc_icas_rtARID_DEF.ARID_DEF_Chart2.is_active_c58_autosar_swc_icas "" UBYTE autosar_swc_icas_CM_uint8 0 0 0 255 ECU_ADDRESS 0xfe4ad6b6 /* @ECU_Address@autosar_swc_icas_rtARID_DEF.ARID_DEF_Chart2.is_active_c58_autosar_swc_icas@ */ /end MEASUREMENT
/begin MEASUREMENT autosar_swc_icas_rtARID_DEF.ARID_DEF_Chart2.is_c58_autosar_swc_icas "" UBYTE autosar_swc_icas_CM_uint8 0 0 0 255 ECU_ADDRESS 0xfe4ad6b7 /* @ECU_Address@autosar_swc_icas_rtARID_DEF.ARID_DEF_Chart2.is_c58_autosar_swc_icas@ */ /end MEASUREMENT
/begin MEASUREMENT autosar_swc_icas_rtARID_DEF.ARID_DEF_Chart3.count "" UWORD autosar_swc_icas_CM_uint16 0 0 0 65535 ECU_ADDRESS 0xfe4ad6ae /* @ECU_Address@autosar_swc_icas_rtARID_DEF.ARID_DEF_Chart3.count@ */ /end MEASUREMENT
/begin MEASUREMENT autosar_swc_icas_rtARID_DEF.ARID_DEF_Chart3.is_Active "" UBYTE autosar_swc_icas_CM_uint8 0 0 0 255 ECU_ADDRESS 0xfe4ad6b2 /* @ECU_Address@autosar_swc_icas_rtARID_DEF.ARID_DEF_Chart3.is_Active@ */ /end MEASUREMENT
/begin MEASUREMENT autosar_swc_icas_rtARID_DEF.ARID_DEF_Chart3.is_active_c58_autosar_swc_icas "" UBYTE autosar_swc_icas_CM_uint8 0 0 0 255 ECU_ADDRESS 0xfe4ad6b0 /* @ECU_Address@autosar_swc_icas_rtARID_DEF.ARID_DEF_Chart3.is_active_c58_autosar_swc_icas@ */ /end MEASUREMENT
/begin MEASUREMENT autosar_swc_icas_rtARID_DEF.ARID_DEF_Chart3.is_c58_autosar_swc_icas "" UBYTE autosar_swc_icas_CM_uint8 0 0 0 255 ECU_ADDRESS 0xfe4ad6b1 /* @ECU_Address@autosar_swc_icas_rtARID_DEF.ARID_DEF_Chart3.is_c58_autosar_swc_icas@ */ /end MEASUREMENT
/begin MEASUREMENT autosar_swc_icas_rtARID_DEF.ARID_DEF_Chart4.count "" UWORD autosar_swc_icas_CM_uint16 0 0 0 65535 ECU_ADDRESS 0xfe4ad6a8 /* @ECU_Address@autosar_swc_icas_rtARID_DEF.ARID_DEF_Chart4.count@ */ /end MEASUREMENT
/begin MEASUREMENT autosar_swc_icas_rtARID_DEF.ARID_DEF_Chart4.is_Active "" UBYTE autosar_swc_icas_CM_uint8 0 0 0 255 ECU_ADDRESS 0xfe4ad6ac /* @ECU_Address@autosar_swc_icas_rtARID_DEF.ARID_DEF_Chart4.is_Active@ */ /end MEASUREMENT
/begin MEASUREMENT autosar_swc_icas_rtARID_DEF.ARID_DEF_Chart4.is_active_c58_autosar_swc_icas "" UBYTE autosar_swc_icas_CM_uint8 0 0 0 255 ECU_ADDRESS 0xfe4ad6aa /* @ECU_Address@autosar_swc_icas_rtARID_DEF.ARID_DEF_Chart4.is_active_c58_autosar_swc_icas@ */ /end MEASUREMENT
/begin MEASUREMENT autosar_swc_icas_rtARID_DEF.ARID_DEF_Chart4.is_c58_autosar_swc_icas "" UBYTE autosar_swc_icas_CM_uint8 0 0 0 255 ECU_ADDRESS 0xfe4ad6ab /* @ECU_Address@autosar_swc_icas_rtARID_DEF.ARID_DEF_Chart4.is_c58_autosar_swc_icas@ */ /end MEASUREMENT
/begin COMPU_METHOD autosar_swc_icas_CM_uint16 "Q = V" IDENTICAL "%5.0" "" /end COMPU_METHOD
/begin COMPU_METHOD autosar_swc_icas_CM_uint8 "Q = V" IDENTICAL "%3.0" "" /end COMPU_METHOD
/begin RECORD_LAYOUT Record_FLOAT32_IEEE FNC_VALUES 1 FLOAT32_IEEE COLUMN_DIR DIRECT /end RECORD_LAYOUT
/begin RECORD_LAYOUT Record_SBYTE FNC_VALUES 1 SBYTE COLUMN_DIR DIRECT /end RECORD_LAYOUT
/begin RECORD_LAYOUT Record_UBYTE FNC_VALUES 1 UBYTE COLUMN_DIR DIRECT /end RECORD_LAYOUT
/begin RECORD_LAYOUT Record_ULONG FNC_VALUES 1 ULONG COLUMN_DIR DIRECT /end RECORD_LAYOUT
/begin RECORD_LAYOUT Record_UWORD FNC_VALUES 1 UWORD COLUMN_DIR DIRECT /end RECORD_LAYOUT
/begin MEASUREMENT autosar_swc_las_rtARID_DEF.ARID_DEF_Chart.cntleft "" UBYTE autosar_swc_las_CM_uint8 0 0 0 255 ECU_ADDRESS 0xfe4adbda /* @ECU_Address@autosar_swc_las_rtARID_DEF.ARID_DEF_Chart.cntleft@ */ /end MEASUREMENT
/begin MEASUREMENT autosar_swc_las_rtARID_DEF.ARID_DEF_Chart.is_active_c83_autosar_swc_las "" UBYTE autosar_swc_las_CM_uint8 0 0 0 255 ECU_ADDRESS 0xfe4adbdb /* @ECU_Address@autosar_swc_las_rtARID_DEF.ARID_DEF_Chart.is_active_c83_autosar_swc_las@ */ /end MEASUREMENT
/begin MEASUREMENT autosar_swc_las_rtARID_DEF.ARID_DEF_Chart.is_c83_autosar_swc_las "" UBYTE autosar_swc_las_CM_uint8 0 0 0 255 ECU_ADDRESS 0xfe4adbdc /* @ECU_Address@autosar_swc_las_rtARID_DEF.ARID_DEF_Chart.is_c83_autosar_swc_las@ */ /end MEASUREMENT
/begin MEASUREMENT autosar_swc_las_rtARID_DEF.ARID_DEF_Chart1.is_active_c91_autosar_swc_las "" UBYTE autosar_swc_las_CM_uint8 0 0 0 255 ECU_ADDRESS 0xfe4adbd5 /* @ECU_Address@autosar_swc_las_rtARID_DEF.ARID_DEF_Chart1.is_active_c91_autosar_swc_las@ */ /end MEASUREMENT
/begin MEASUREMENT autosar_swc_las_rtARID_DEF.ARID_DEF_Chart1.is_c91_autosar_swc_las "" UBYTE autosar_swc_las_CM_uint8 0 0 0 255 ECU_ADDRESS 0xfe4adbd6 /* @ECU_Address@autosar_swc_las_rtARID_DEF.ARID_DEF_Chart1.is_c91_autosar_swc_las@ */ /end MEASUREMENT
/begin MEASUREMENT autosar_swc_las_rtARID_DEF.ARID_DEF_Chart1_c.is_active_c91_autosar_swc_las "" UBYTE autosar_swc_las_CM_uint8 0 0 0 255 ECU_ADDRESS 0xfe4adbdd /* @ECU_Address@autosar_swc_las_rtARID_DEF.ARID_DEF_Chart1_c.is_active_c91_autosar_swc_las@ */ /end MEASUREMENT
/begin MEASUREMENT autosar_swc_las_rtARID_DEF.ARID_DEF_Chart1_c.is_c91_autosar_swc_las "" UBYTE autosar_swc_las_CM_uint8 0 0 0 255 ECU_ADDRESS 0xfe4adbde /* @ECU_Address@autosar_swc_las_rtARID_DEF.ARID_DEF_Chart1_c.is_c91_autosar_swc_las@ */ /end MEASUREMENT
/begin MEASUREMENT autosar_swc_las_rtARID_DEF.ARID_DEF_Chart1_k.cntleft "" UBYTE autosar_swc_las_CM_uint8 0 0 0 255 ECU_ADDRESS 0xfe4adbd7 /* @ECU_Address@autosar_swc_las_rtARID_DEF.ARID_DEF_Chart1_k.cntleft@ */ /end MEASUREMENT
/begin MEASUREMENT autosar_swc_las_rtARID_DEF.ARID_DEF_Chart1_k.is_active_c83_autosar_swc_las "" UBYTE autosar_swc_las_CM_uint8 0 0 0 255 ECU_ADDRESS 0xfe4adbd8 /* @ECU_Address@autosar_swc_las_rtARID_DEF.ARID_DEF_Chart1_k.is_active_c83_autosar_swc_las@ */ /end MEASUREMENT
/begin MEASUREMENT autosar_swc_las_rtARID_DEF.ARID_DEF_Chart1_k.is_c83_autosar_swc_las "" UBYTE autosar_swc_las_CM_uint8 0 0 0 255 ECU_ADDRESS 0xfe4adbd9 /* @ECU_Address@autosar_swc_las_rtARID_DEF.ARID_DEF_Chart1_k.is_c83_autosar_swc_las@ */ /end MEASUREMENT
/begin MEASUREMENT autosar_swc_las_rtARID_DEF.ARID_DEF_Chart2.cnt1 "" UBYTE autosar_swc_las_CM_uint8 0 0 0 255 ECU_ADDRESS 0xfe4adbd0 /* @ECU_Address@autosar_swc_las_rtARID_DEF.ARID_DEF_Chart2.cnt1@ */ /end MEASUREMENT
/begin MEASUREMENT autosar_swc_las_rtARID_DEF.ARID_DEF_Chart2.cnt2 "" UBYTE autosar_swc_las_CM_uint8 0 0 0 255 ECU_ADDRESS 0xfe4adbd1 /* @ECU_Address@autosar_swc_las_rtARID_DEF.ARID_DEF_Chart2.cnt2@ */ /end MEASUREMENT
/begin MEASUREMENT autosar_swc_las_rtARID_DEF.ARID_DEF_Chart2.is_Name1 "" UBYTE autosar_swc_las_CM_uint8 0 0 0 255 ECU_ADDRESS 0xfe4adbd3 /* @ECU_Address@autosar_swc_las_rtARID_DEF.ARID_DEF_Chart2.is_Name1@ */ /end MEASUREMENT
/begin MEASUREMENT autosar_swc_las_rtARID_DEF.ARID_DEF_Chart2.is_Name2 "" UBYTE autosar_swc_las_CM_uint8 0 0 0 255 ECU_ADDRESS 0xfe4adbd4 /* @ECU_Address@autosar_swc_las_rtARID_DEF.ARID_DEF_Chart2.is_Name2@ */ /end MEASUREMENT
/begin MEASUREMENT autosar_swc_las_rtARID_DEF.ARID_DEF_Chart2.is_active_c1_autosar_swc_las "" UBYTE autosar_swc_las_CM_uint8 0 0 0 255 ECU_ADDRESS 0xfe4adbd2 /* @ECU_Address@autosar_swc_las_rtARID_DEF.ARID_DEF_Chart2.is_active_c1_autosar_swc_las@ */ /end MEASUREMENT
/begin MEASUREMENT autosar_swc_las_rtARID_DEF.ARID_DEF_Chart_b.is_active_c94_autosar_swc_las "" UBYTE autosar_swc_las_CM_uint8 0 0 0 255 ECU_ADDRESS 0xfe4adbdf /* @ECU_Address@autosar_swc_las_rtARID_DEF.ARID_DEF_Chart_b.is_active_c94_autosar_swc_las@ */ /end MEASUREMENT
/begin MEASUREMENT autosar_swc_las_rtARID_DEF.ARID_DEF_Chart_b.is_c94_autosar_swc_las "" UBYTE autosar_swc_las_CM_uint8 0 0 0 255 ECU_ADDRESS 0xfe4adbe0 /* @ECU_Address@autosar_swc_las_rtARID_DEF.ARID_DEF_Chart_b.is_c94_autosar_swc_las@ */ /end MEASUREMENT
/begin MEASUREMENT autosar_swc_las_rtARID_DEF.ARID_DEF_Chart_c.cnt1 "" UBYTE autosar_swc_las_CM_uint8 0 0 0 255 ECU_ADDRESS 0xfe4adf0c /* @ECU_Address@autosar_swc_las_rtARID_DEF.ARID_DEF_Chart_c.cnt1@ */ /end MEASUREMENT
/begin MEASUREMENT autosar_swc_las_rtARID_DEF.ARID_DEF_Chart_c.cnt2 "" UBYTE autosar_swc_las_CM_uint8 0 0 0 255 ECU_ADDRESS 0xfe4adf0d /* @ECU_Address@autosar_swc_las_rtARID_DEF.ARID_DEF_Chart_c.cnt2@ */ /end MEASUREMENT
/begin MEASUREMENT autosar_swc_las_rtARID_DEF.ARID_DEF_Chart_c.is_Name1 "" UBYTE autosar_swc_las_CM_uint8 0 0 0 255 ECU_ADDRESS 0xfe4adf0f /* @ECU_Address@autosar_swc_las_rtARID_DEF.ARID_DEF_Chart_c.is_Name1@ */ /end MEASUREMENT
/begin MEASUREMENT autosar_swc_las_rtARID_DEF.ARID_DEF_Chart_c.is_Name2 "" UBYTE autosar_swc_las_CM_uint8 0 0 0 255 ECU_ADDRESS 0xfe4adf10 /* @ECU_Address@autosar_swc_las_rtARID_DEF.ARID_DEF_Chart_c.is_Name2@ */ /end MEASUREMENT
/begin MEASUREMENT autosar_swc_las_rtARID_DEF.ARID_DEF_Chart_c.is_active_c1_autosar_swc_las "" UBYTE autosar_swc_las_CM_uint8 0 0 0 255 ECU_ADDRESS 0xfe4adf0e /* @ECU_Address@autosar_swc_las_rtARID_DEF.ARID_DEF_Chart_c.is_active_c1_autosar_swc_las@ */ /end MEASUREMENT
/begin MEASUREMENT autosar_swc_las_rtARID_DEF.ARID_DEF_Chart_p.is_active_c94_autosar_swc_las "" UBYTE autosar_swc_las_CM_uint8 0 0 0 255 ECU_ADDRESS 0xfe4adbe1 /* @ECU_Address@autosar_swc_las_rtARID_DEF.ARID_DEF_Chart_p.is_active_c94_autosar_swc_las@ */ /end MEASUREMENT
/begin MEASUREMENT autosar_swc_las_rtARID_DEF.ARID_DEF_Chart_p.is_c94_autosar_swc_las "" UBYTE autosar_swc_las_CM_uint8 0 0 0 255 ECU_ADDRESS 0xfe4adbe2 /* @ECU_Address@autosar_swc_las_rtARID_DEF.ARID_DEF_Chart_p.is_c94_autosar_swc_las@ */ /end MEASUREMENT
/begin MEASUREMENT autosar_swc_las_rtARID_DEF.ARID_DEF_MATLABFunction1.sTrajBufIsEmpty "" UBYTE autosar_swc_las_CM_logical 0 0 0 1 ECU_ADDRESS 0xfe4adf09 /* @ECU_Address@autosar_swc_las_rtARID_DEF.ARID_DEF_MATLABFunction1.sTrajBufIsEmpty@ */ /end MEASUREMENT
/begin MEASUREMENT autosar_swc_las_rtARID_DEF.ARID_DEF_MATLABFunction1.sTrajDx "" FLOAT32_IEEE autosar_swc_las_CM_single 0 0 -3.4E+38 3.4E+38 LAYOUT COLUMN_DIR MATRIX_DIM 50 ECU_ADDRESS 0xfe4ade40 /* @ECU_Address@autosar_swc_las_rtARID_DEF.ARID_DEF_MATLABFunction1.sTrajDx@ */ /end MEASUREMENT
/begin MEASUREMENT autosar_swc_las_rtARID_DEF.ARID_DEF_MATLABFunction1.sTrajDy "" FLOAT32_IEEE autosar_swc_las_CM_single 0 0 -3.4E+38 3.4E+38 LAYOUT COLUMN_DIR MATRIX_DIM 50 ECU_ADDRESS 0xfe4add78 /* @ECU_Address@autosar_swc_las_rtARID_DEF.ARID_DEF_MATLABFunction1.sTrajDy@ */ /end MEASUREMENT
/begin MEASUREMENT autosar_swc_las_rtARID_DEF.ARID_DEF_MATLABFunction1.sTrajPointNum "" UBYTE autosar_swc_las_CM_uint8 0 0 0 255 ECU_ADDRESS 0xfe4adf08 /* @ECU_Address@autosar_swc_las_rtARID_DEF.ARID_DEF_MATLABFunction1.sTrajPointNum@ */ /end MEASUREMENT
/begin MEASUREMENT autosar_swc_las_rtARID_DEF.ARID_DEF_MATLABFunction3.sTrajBufIsEmpty "" UBYTE autosar_swc_las_CM_logical 0 0 0 1 ECU_ADDRESS 0xfe4add75 /* @ECU_Address@autosar_swc_las_rtARID_DEF.ARID_DEF_MATLABFunction3.sTrajBufIsEmpty@ */ /end MEASUREMENT
/begin MEASUREMENT autosar_swc_las_rtARID_DEF.ARID_DEF_MATLABFunction3.sTrajDx "" FLOAT32_IEEE autosar_swc_las_CM_single 0 0 -3.4E+38 3.4E+38 LAYOUT COLUMN_DIR MATRIX_DIM 50 ECU_ADDRESS 0xfe4adcac /* @ECU_Address@autosar_swc_las_rtARID_DEF.ARID_DEF_MATLABFunction3.sTrajDx@ */ /end MEASUREMENT
/begin MEASUREMENT autosar_swc_las_rtARID_DEF.ARID_DEF_MATLABFunction3.sTrajDy "" FLOAT32_IEEE autosar_swc_las_CM_single 0 0 -3.4E+38 3.4E+38 LAYOUT COLUMN_DIR MATRIX_DIM 50 ECU_ADDRESS 0xfe4adbe4 /* @ECU_Address@autosar_swc_las_rtARID_DEF.ARID_DEF_MATLABFunction3.sTrajDy@ */ /end MEASUREMENT
/begin MEASUREMENT autosar_swc_las_rtARID_DEF.ARID_DEF_MATLABFunction3.sTrajPointNum "" UBYTE autosar_swc_las_CM_uint8 0 0 0 255 ECU_ADDRESS 0xfe4add74 /* @ECU_Address@autosar_swc_las_rtARID_DEF.ARID_DEF_MATLABFunction3.sTrajPointNum@ */ /end MEASUREMENT
/begin COMPU_METHOD autosar_swc_las_CM_logical "Q = V" IDENTICAL "%1.0" "" /end COMPU_METHOD
/begin COMPU_METHOD autosar_swc_las_CM_single "Q = V" IDENTICAL "%8.6" "" /end COMPU_METHOD
/begin COMPU_METHOD autosar_swc_las_CM_uint8 "Q = V" IDENTICAL "%3.0" "" /end COMPU_METHOD
/begin RECORD_LAYOUT Record_FLOAT32_IEEE FNC_VALUES 1 FLOAT32_IEEE COLUMN_DIR DIRECT /end RECORD_LAYOUT
/begin RECORD_LAYOUT Record_SBYTE FNC_VALUES 1 SBYTE COLUMN_DIR DIRECT /end RECORD_LAYOUT
/begin RECORD_LAYOUT Record_SWORD FNC_VALUES 1 SWORD COLUMN_DIR DIRECT /end RECORD_LAYOUT
/begin RECORD_LAYOUT Record_UBYTE FNC_VALUES 1 UBYTE COLUMN_DIR DIRECT /end RECORD_LAYOUT
/begin RECORD_LAYOUT Record_ULONG FNC_VALUES 1 ULONG COLUMN_DIR DIRECT /end RECORD_LAYOUT
/begin RECORD_LAYOUT Record_UWORD FNC_VALUES 1 UWORD COLUMN_DIR DIRECT /end RECORD_LAYOUT
/begin CHARACTERISTIC ZDrive_BSW_Cal_Cal.ZDrive_BSW_Cal_VehicleInfomationTable.ASU_Type "" VALUE 0x3d8081 Record_UBYTE 0 autosar_swc_rlgs_CM_uint8 0 255 /end CHARACTERISTIC
/begin CHARACTERISTIC ZDrive_BSW_Cal_Cal.ZDrive_BSW_Cal_VehicleInfomationTable.AccSens_LatAccSigDirect "" VALUE 0x3d8078 Record_UBYTE 0 autosar_swc_rlgs_CM_uint8 0 255 /end CHARACTERISTIC
/begin CHARACTERISTIC ZDrive_BSW_Cal_Cal.ZDrive_BSW_Cal_VehicleInfomationTable.AccSens_LonAccSigDirect "" VALUE 0x3d8079 Record_UBYTE 0 autosar_swc_rlgs_CM_uint8 0 255 /end CHARACTERISTIC
/begin CHARACTERISTIC ZDrive_BSW_Cal_Cal.ZDrive_BSW_Cal_VehicleInfomationTable.ActiveType "" VALUE 0x3d806d Record_UBYTE 0 autosar_swc_rlgs_CM_uint8 0 255 /end CHARACTERISTIC
/begin CHARACTERISTIC ZDrive_BSW_Cal_Cal.ZDrive_BSW_Cal_VehicleInfomationTable.AutoHold_Type "" VALUE 0x3d8077 Record_UBYTE 0 autosar_swc_rlgs_CM_uint8 0 255 /end CHARACTERISTIC
/begin CHARACTERISTIC ZDrive_BSW_Cal_Cal.ZDrive_BSW_Cal_VehicleInfomationTable.CURB_kg "" VALUE 0x3d810c Record_FLOAT32_IEEE 0 autosar_swc_rlgs_CM_single -3.4E+38 3.4E+38 /end CHARACTERISTIC
/begin CHARACTERISTIC ZDrive_BSW_Cal_Cal.ZDrive_BSW_Cal_VehicleInfomationTable.CamDistToRearAxleCenter_DZ "" VALUE 0x3d8174 Record_FLOAT32_IEEE 0 autosar_swc_rlgs_CM_single -3.4E+38 3.4E+38 /end CHARACTERISTIC
/begin CHARACTERISTIC ZDrive_BSW_Cal_Cal.ZDrive_BSW_Cal_VehicleInfomationTable.CharSpd_mps "" VALUE 0x3d8138 Record_FLOAT32_IEEE 0 autosar_swc_rlgs_CM_single -3.4E+38 3.4E+38 /end CHARACTERISTIC
/begin CHARACTERISTIC ZDrive_BSW_Cal_Cal.ZDrive_BSW_Cal_VehicleInfomationTable.Country_Code "" VALUE 0x3d8068 Record_UBYTE 0 autosar_swc_rlgs_CM_uint8 0 255 /end CHARACTERISTIC
/begin CHARACTERISTIC ZDrive_BSW_Cal_Cal.ZDrive_BSW_Cal_VehicleInfomationTable.DriHandTorqueDirect "" VALUE 0x3d807b Record_UBYTE 0 autosar_swc_rlgs_CM_uint8 0 255 /end CHARACTERISTIC
/begin CHARACTERISTIC ZDrive_BSW_Cal_Cal.ZDrive_BSW_Cal_VehicleInfomationTable.DrivingLongControlInterForm "" VALUE 0x3d8071 Record_UBYTE 0 autosar_swc_rlgs_CM_uint8 0 255 /end CHARACTERISTIC
/begin CHARACTERISTIC ZDrive_BSW_Cal_Cal.ZDrive_BSW_Cal_VehicleInfomationTable.Driving_Type "" VALUE 0x3d8075 Record_UBYTE 0 autosar_swc_rlgs_CM_uint8 0 255 /end CHARACTERISTIC
/begin CHARACTERISTIC ZDrive_BSW_Cal_Cal.ZDrive_BSW_Cal_VehicleInfomationTable.DxvFrontBumper_m "" VALUE 0x3d80cc Record_FLOAT32_IEEE 0 autosar_swc_rlgs_CM_single -3.4E+38 3.4E+38 /end CHARACTERISTIC
/begin CHARACTERISTIC ZDrive_BSW_Cal_Cal.ZDrive_BSW_Cal_VehicleInfomationTable.DxvRearBumper_m "" VALUE 0x3d80c8 Record_FLOAT32_IEEE 0 autosar_swc_rlgs_CM_single -3.4E+38 3.4E+38 /end CHARACTERISTIC
/begin CHARACTERISTIC ZDrive_BSW_Cal_Cal.ZDrive_BSW_Cal_VehicleInfomationTable.EPS_Inter "" VALUE 0x3d8070 Record_UBYTE 0 autosar_swc_rlgs_CM_uint8 0 255 /end CHARACTERISTIC
/begin CHARACTERISTIC ZDrive_BSW_Cal_Cal.ZDrive_BSW_Cal_VehicleInfomationTable.ESP_Type "" VALUE 0x3d806b Record_UBYTE 0 autosar_swc_rlgs_CM_uint8 0 255 /end CHARACTERISTIC
/begin CHARACTERISTIC ZDrive_BSW_Cal_Cal.ZDrive_BSW_Cal_VehicleInfomationTable.Empty_mass_kg "" VALUE 0x3d8118 Record_FLOAT32_IEEE 0 autosar_swc_rlgs_CM_single -3.4E+38 3.4E+38 /end CHARACTERISTIC
/begin CHARACTERISTIC ZDrive_BSW_Cal_Cal.ZDrive_BSW_Cal_VehicleInfomationTable.EngineMaxiTorque_N "" VALUE 0x3d80a0 Record_FLOAT32_IEEE 0 autosar_swc_rlgs_CM_single -3.4E+38 3.4E+38 /end CHARACTERISTIC
/begin CHARACTERISTIC ZDrive_BSW_Cal_Cal.ZDrive_BSW_Cal_VehicleInfomationTable.Engine_Type "" VALUE 0x3d806f Record_UBYTE 0 autosar_swc_rlgs_CM_uint8 0 255 /end CHARACTERISTIC
/begin CHARACTERISTIC ZDrive_BSW_Cal_Cal.ZDrive_BSW_Cal_VehicleInfomationTable.FC2LeftWheel_m "" VALUE 0x3d8188 Record_FLOAT32_IEEE 0 autosar_swc_rlgs_CM_single -3.4E+38 3.4E+38 /end CHARACTERISTIC
/begin CHARACTERISTIC ZDrive_BSW_Cal_Cal.ZDrive_BSW_Cal_VehicleInfomationTable.FC2RearAxisX_m "" VALUE 0x3d816c Record_FLOAT32_IEEE 0 autosar_swc_rlgs_CM_single -3.4E+38 3.4E+38 /end CHARACTERISTIC
/begin CHARACTERISTIC ZDrive_BSW_Cal_Cal.ZDrive_BSW_Cal_VehicleInfomationTable.FC2RearAxisY_m "" VALUE 0x3d8170 Record_FLOAT32_IEEE 0 autosar_swc_rlgs_CM_single -3.4E+38 3.4E+38 /end CHARACTERISTIC
/begin CHARACTERISTIC ZDrive_BSW_Cal_Cal.ZDrive_BSW_Cal_VehicleInfomationTable.FC2RightWheel_m "" VALUE 0x3d818c Record_FLOAT32_IEEE 0 autosar_swc_rlgs_CM_single -3.4E+38 3.4E+38 /end CHARACTERISTIC
/begin CHARACTERISTIC ZDrive_BSW_Cal_Cal.ZDrive_BSW_Cal_VehicleInfomationTable.FCFirstViewPointDist_m "" VALUE 0x3d8178 Record_FLOAT32_IEEE 0 autosar_swc_rlgs_CM_single -3.4E+38 3.4E+38 /end CHARACTERISTIC
/begin CHARACTERISTIC ZDrive_BSW_Cal_Cal.ZDrive_BSW_Cal_VehicleInfomationTable.FCFocus2FrAxleDist_Y_m "" VALUE 0x3d8164 Record_FLOAT32_IEEE 0 autosar_swc_rlgs_CM_single -3.4E+38 3.4E+38 /end CHARACTERISTIC
/begin CHARACTERISTIC ZDrive_BSW_Cal_Cal.ZDrive_BSW_Cal_VehicleInfomationTable.FCFocus2FrAxleDist_Z_m "" VALUE 0x3d8168 Record_FLOAT32_IEEE 0 autosar_swc_rlgs_CM_single -3.4E+38 3.4E+38 /end CHARACTERISTIC
/begin CHARACTERISTIC ZDrive_BSW_Cal_Cal.ZDrive_BSW_Cal_VehicleInfomationTable.FRollingRadius_m "" VALUE 0x3d8150 Record_FLOAT32_IEEE 0 autosar_swc_rlgs_CM_single -3.4E+38 3.4E+38 /end CHARACTERISTIC
/begin CHARACTERISTIC ZDrive_BSW_Cal_Cal.ZDrive_BSW_Cal_VehicleInfomationTable.FrSCBlindSpotLength_m "" VALUE 0x3d81d0 Record_FLOAT32_IEEE 0 autosar_swc_rlgs_CM_single -3.4E+38 3.4E+38 /end CHARACTERISTIC
/begin CHARACTERISTIC ZDrive_BSW_Cal_Cal.ZDrive_BSW_Cal_VehicleInfomationTable.FrSCDist2OuterMostSide_m "" VALUE 0x3d81d4 Record_FLOAT32_IEEE 0 autosar_swc_rlgs_CM_single -3.4E+38 3.4E+38 /end CHARACTERISTIC
/begin CHARACTERISTIC ZDrive_BSW_Cal_Cal.ZDrive_BSW_Cal_VehicleInfomationTable.FrWhlHousingHeight_m "" VALUE 0x3d80c0 Record_FLOAT32_IEEE 0 autosar_swc_rlgs_CM_single -3.4E+38 3.4E+38 /end CHARACTERISTIC
/begin CHARACTERISTIC ZDrive_BSW_Cal_Cal.ZDrive_BSW_Cal_VehicleInfomationTable.FrWhlTrack_m "" VALUE 0x3d80b0 Record_FLOAT32_IEEE 0 autosar_swc_rlgs_CM_single -3.4E+38 3.4E+38 /end CHARACTERISTIC
/begin CHARACTERISTIC ZDrive_BSW_Cal_Cal.ZDrive_BSW_Cal_VehicleInfomationTable.FrntLeCrnrUss_Dx "" VALUE 0x3d8260 Record_FLOAT32_IEEE 0 autosar_swc_rlgs_CM_single -3.4E+38 3.4E+38 /end CHARACTERISTIC
/begin CHARACTERISTIC ZDrive_BSW_Cal_Cal.ZDrive_BSW_Cal_VehicleInfomationTable.FrntLeCrnrUss_Dy "" VALUE 0x3d8264 Record_FLOAT32_IEEE 0 autosar_swc_rlgs_CM_single -3.4E+38 3.4E+38 /end CHARACTERISTIC
/begin CHARACTERISTIC ZDrive_BSW_Cal_Cal.ZDrive_BSW_Cal_VehicleInfomationTable.FrntLeCrnrUss_Dz "" VALUE 0x3d8268 Record_FLOAT32_IEEE 0 autosar_swc_rlgs_CM_single -3.4E+38 3.4E+38 /end CHARACTERISTIC
/begin CHARACTERISTIC ZDrive_BSW_Cal_Cal.ZDrive_BSW_Cal_VehicleInfomationTable.FrntLeCrnrUss_Pitch "" VALUE 0x3d8274 Record_FLOAT32_IEEE 0 autosar_swc_rlgs_CM_single -3.4E+38 3.4E+38 /end CHARACTERISTIC
/begin CHARACTERISTIC ZDrive_BSW_Cal_Cal.ZDrive_BSW_Cal_VehicleInfomationTable.FrntLeCrnrUss_Roll "" VALUE 0x3d8270 Record_FLOAT32_IEEE 0 autosar_swc_rlgs_CM_single -3.4E+38 3.4E+38 /end CHARACTERISTIC
/begin CHARACTERISTIC ZDrive_BSW_Cal_Cal.ZDrive_BSW_Cal_VehicleInfomationTable.FrntLeCrnrUss_Yaw "" VALUE 0x3d8278 Record_FLOAT32_IEEE 0 autosar_swc_rlgs_CM_single -3.4E+38 3.4E+38 /end CHARACTERISTIC
/begin CHARACTERISTIC ZDrive_BSW_Cal_Cal.ZDrive_BSW_Cal_VehicleInfomationTable.FrntLeMidUss_Dx "" VALUE 0x3d827c Record_FLOAT32_IEEE 0 autosar_swc_rlgs_CM_single -3.4E+38 3.4E+38 /end CHARACTERISTIC
/begin CHARACTERISTIC ZDrive_BSW_Cal_Cal.ZDrive_BSW_Cal_VehicleInfomationTable.FrntLeMidUss_Dy "" VALUE 0x3d8280 Record_FLOAT32_IEEE 0 autosar_swc_rlgs_CM_single -3.4E+38 3.4E+38 /end CHARACTERISTIC
/begin CHARACTERISTIC ZDrive_BSW_Cal_Cal.ZDrive_BSW_Cal_VehicleInfomationTable.FrntLeMidUss_Dz "" VALUE 0x3d8284 Record_FLOAT32_IEEE 0 autosar_swc_rlgs_CM_single -3.4E+38 3.4E+38 /end CHARACTERISTIC
/begin CHARACTERISTIC ZDrive_BSW_Cal_Cal.ZDrive_BSW_Cal_VehicleInfomationTable.FrntLeMidUss_Pitch "" VALUE 0x3d8290 Record_FLOAT32_IEEE 0 autosar_swc_rlgs_CM_single -3.4E+38 3.4E+38 /end CHARACTERISTIC
/begin CHARACTERISTIC ZDrive_BSW_Cal_Cal.ZDrive_BSW_Cal_VehicleInfomationTable.FrntLeMidUss_Roll "" VALUE 0x3d828c Record_FLOAT32_IEEE 0 autosar_swc_rlgs_CM_single -3.4E+38 3.4E+38 /end CHARACTERISTIC
/begin CHARACTERISTIC ZDrive_BSW_Cal_Cal.ZDrive_BSW_Cal_VehicleInfomationTable.FrntLeMidUss_Yaw "" VALUE 0x3d8294 Record_FLOAT32_IEEE 0 autosar_swc_rlgs_CM_single -3.4E+38 3.4E+38 /end CHARACTERISTIC
/begin CHARACTERISTIC ZDrive_BSW_Cal_Cal.ZDrive_BSW_Cal_VehicleInfomationTable.FrntLeSideUss_Dx "" VALUE 0x3d8244 Record_FLOAT32_IEEE 0 autosar_swc_rlgs_CM_single -3.4E+38 3.4E+38 /end CHARACTERISTIC
/begin CHARACTERISTIC ZDrive_BSW_Cal_Cal.ZDrive_BSW_Cal_VehicleInfomationTable.FrntLeSideUss_Dy "" VALUE 0x3d8248 Record_FLOAT32_IEEE 0 autosar_swc_rlgs_CM_single -3.4E+38 3.4E+38 /end CHARACTERISTIC
/begin CHARACTERISTIC ZDrive_BSW_Cal_Cal.ZDrive_BSW_Cal_VehicleInfomationTable.FrntLeSideUss_Dz "" VALUE 0x3d824c Record_FLOAT32_IEEE 0 autosar_swc_rlgs_CM_single -3.4E+38 3.4E+38 /end CHARACTERISTIC
/begin CHARACTERISTIC ZDrive_BSW_Cal_Cal.ZDrive_BSW_Cal_VehicleInfomationTable.FrntLeSideUss_Pitch "" VALUE 0x3d8258 Record_FLOAT32_IEEE 0 autosar_swc_rlgs_CM_single -3.4E+38 3.4E+38 /end CHARACTERISTIC
/begin CHARACTERISTIC ZDrive_BSW_Cal_Cal.ZDrive_BSW_Cal_VehicleInfomationTable.FrntLeSideUss_Roll "" VALUE 0x3d8254 Record_FLOAT32_IEEE 0 autosar_swc_rlgs_CM_single -3.4E+38 3.4E+38 /end CHARACTERISTIC
/begin CHARACTERISTIC ZDrive_BSW_Cal_Cal.ZDrive_BSW_Cal_VehicleInfomationTable.FrntLeSideUss_Yaw "" VALUE 0x3d825c Record_FLOAT32_IEEE 0 autosar_swc_rlgs_CM_single -3.4E+38 3.4E+38 /end CHARACTERISTIC
/begin CHARACTERISTIC ZDrive_BSW_Cal_Cal.ZDrive_BSW_Cal_VehicleInfomationTable.FrntRiCrnrUss_Dx "" VALUE 0x3d82b4 Record_FLOAT32_IEEE 0 autosar_swc_rlgs_CM_single -3.4E+38 3.4E+38 /end CHARACTERISTIC
/begin CHARACTERISTIC ZDrive_BSW_Cal_Cal.ZDrive_BSW_Cal_VehicleInfomationTable.FrntRiCrnrUss_Dy "" VALUE 0x3d82b8 Record_FLOAT32_IEEE 0 autosar_swc_rlgs_CM_single -3.4E+38 3.4E+38 /end CHARACTERISTIC
/begin CHARACTERISTIC ZDrive_BSW_Cal_Cal.ZDrive_BSW_Cal_VehicleInfomationTable.FrntRiCrnrUss_Dz "" VALUE 0x3d82bc Record_FLOAT32_IEEE 0 autosar_swc_rlgs_CM_single -3.4E+38 3.4E+38 /end CHARACTERISTIC
/begin CHARACTERISTIC ZDrive_BSW_Cal_Cal.ZDrive_BSW_Cal_VehicleInfomationTable.FrntRiCrnrUss_Pitch "" VALUE 0x3d82c8 Record_FLOAT32_IEEE 0 autosar_swc_rlgs_CM_single -3.4E+38 3.4E+38 /end CHARACTERISTIC
/begin CHARACTERISTIC ZDrive_BSW_Cal_Cal.ZDrive_BSW_Cal_VehicleInfomationTable.FrntRiCrnrUss_Roll "" VALUE 0x3d82c4 Record_FLOAT32_IEEE 0 autosar_swc_rlgs_CM_single -3.4E+38 3.4E+38 /end CHARACTERISTIC
/begin CHARACTERISTIC ZDrive_BSW_Cal_Cal.ZDrive_BSW_Cal_VehicleInfomationTable.FrntRiCrnrUss_Yaw "" VALUE 0x3d82cc Record_FLOAT32_IEEE 0 autosar_swc_rlgs_CM_single -3.4E+38 3.4E+38 /end CHARACTERISTIC
/begin CHARACTERISTIC ZDrive_BSW_Cal_Cal.ZDrive_BSW_Cal_VehicleInfomationTable.FrntRiMidUss_Dx "" VALUE 0x3d8298 Record_FLOAT32_IEEE 0 autosar_swc_rlgs_CM_single -3.4E+38 3.4E+38 /end CHARACTERISTIC
/begin CHARACTERISTIC ZDrive_BSW_Cal_Cal.ZDrive_BSW_Cal_VehicleInfomationTable.FrntRiMidUss_Dy "" VALUE 0x3d829c Record_FLOAT32_IEEE 0 autosar_swc_rlgs_CM_single -3.4E+38 3.4E+38 /end CHARACTERISTIC
/begin CHARACTERISTIC ZDrive_BSW_Cal_Cal.ZDrive_BSW_Cal_VehicleInfomationTable.FrntRiMidUss_Dz "" VALUE 0x3d82a0 Record_FLOAT32_IEEE 0 autosar_swc_rlgs_CM_single -3.4E+38 3.4E+38 /end CHARACTERISTIC
/begin CHARACTERISTIC ZDrive_BSW_Cal_Cal.ZDrive_BSW_Cal_VehicleInfomationTable.FrntRiMidUss_Pitch "" VALUE 0x3d82ac Record_FLOAT32_IEEE 0 autosar_swc_rlgs_CM_single -3.4E+38 3.4E+38 /end CHARACTERISTIC
/begin CHARACTERISTIC ZDrive_BSW_Cal_Cal.ZDrive_BSW_Cal_VehicleInfomationTable.FrntRiMidUss_Roll "" VALUE 0x3d82a8 Record_FLOAT32_IEEE 0 autosar_swc_rlgs_CM_single -3.4E+38 3.4E+38 /end CHARACTERISTIC
/begin CHARACTERISTIC ZDrive_BSW_Cal_Cal.ZDrive_BSW_Cal_VehicleInfomationTable.FrntRiMidUss_Yaw "" VALUE 0x3d82b0 Record_FLOAT32_IEEE 0 autosar_swc_rlgs_CM_single -3.4E+38 3.4E+38 /end CHARACTERISTIC
/begin CHARACTERISTIC ZDrive_BSW_Cal_Cal.ZDrive_BSW_Cal_VehicleInfomationTable.FrntRiSideUss_Dx "" VALUE 0x3d82d0 Record_FLOAT32_IEEE 0 autosar_swc_rlgs_CM_single -3.4E+38 3.4E+38 /end CHARACTERISTIC
/begin CHARACTERISTIC ZDrive_BSW_Cal_Cal.ZDrive_BSW_Cal_VehicleInfomationTable.FrntRiSideUss_Dy "" VALUE 0x3d82d4 Record_FLOAT32_IEEE 0 autosar_swc_rlgs_CM_single -3.4E+38 3.4E+38 /end CHARACTERISTIC
/begin CHARACTERISTIC ZDrive_BSW_Cal_Cal.ZDrive_BSW_Cal_VehicleInfomationTable.FrntRiSideUss_Dz "" VALUE 0x3d82d8 Record_FLOAT32_IEEE 0 autosar_swc_rlgs_CM_single -3.4E+38 3.4E+38 /end CHARACTERISTIC
/begin CHARACTERISTIC ZDrive_BSW_Cal_Cal.ZDrive_BSW_Cal_VehicleInfomationTable.FrntRiSideUss_Pitch "" VALUE 0x3d82e4 Record_FLOAT32_IEEE 0 autosar_swc_rlgs_CM_single -3.4E+38 3.4E+38 /end CHARACTERISTIC
/begin CHARACTERISTIC ZDrive_BSW_Cal_Cal.ZDrive_BSW_Cal_VehicleInfomationTable.FrntRiSideUss_Roll "" VALUE 0x3d82e0 Record_FLOAT32_IEEE 0 autosar_swc_rlgs_CM_single -3.4E+38 3.4E+38 /end CHARACTERISTIC
/begin CHARACTERISTIC ZDrive_BSW_Cal_Cal.ZDrive_BSW_Cal_VehicleInfomationTable.FrntRiSideUss_Yaw "" VALUE 0x3d82e8 Record_FLOAT32_IEEE 0 autosar_swc_rlgs_CM_single -3.4E+38 3.4E+38 /end CHARACTERISTIC
/begin CHARACTERISTIC ZDrive_BSW_Cal_Cal.ZDrive_BSW_Cal_VehicleInfomationTable.FrontAxleToCenter_m "" VALUE 0x3d80d0 Record_FLOAT32_IEEE 0 autosar_swc_rlgs_CM_single -3.4E+38 3.4E+38 /end CHARACTERISTIC
/begin CHARACTERISTIC ZDrive_BSW_Cal_Cal.ZDrive_BSW_Cal_VehicleInfomationTable.FrontAxleToRearAxLeCenterX_m "" VALUE 0x3d80a8 Record_FLOAT32_IEEE 0 autosar_swc_rlgs_CM_single -3.4E+38 3.4E+38 /end CHARACTERISTIC
/begin CHARACTERISTIC ZDrive_BSW_Cal_Cal.ZDrive_BSW_Cal_VehicleInfomationTable.FrontLeftFrontPointToCenterLine_Distance_m "" VALUE 0x3d80f0 Record_FLOAT32_IEEE 0 autosar_swc_rlgs_CM_single -3.4E+38 3.4E+38 /end CHARACTERISTIC
/begin CHARACTERISTIC ZDrive_BSW_Cal_Cal.ZDrive_BSW_Cal_VehicleInfomationTable.FrontLeftFrontPointToRearAxleCenter_Distance_m "" VALUE 0x3d80ec Record_FLOAT32_IEEE 0 autosar_swc_rlgs_CM_single -3.4E+38 3.4E+38 /end CHARACTERISTIC
/begin CHARACTERISTIC ZDrive_BSW_Cal_Cal.ZDrive_BSW_Cal_VehicleInfomationTable.FrontLeftOutsidePointToCenterLine_Distance_m "" VALUE 0x3d80f8 Record_FLOAT32_IEEE 0 autosar_swc_rlgs_CM_single -3.4E+38 3.4E+38 /end CHARACTERISTIC
/begin CHARACTERISTIC ZDrive_BSW_Cal_Cal.ZDrive_BSW_Cal_VehicleInfomationTable.FrontLeftOutsidePointToRearAxleCenter_Distance_m "" VALUE 0x3d80f4 Record_FLOAT32_IEEE 0 autosar_swc_rlgs_CM_single -3.4E+38 3.4E+38 /end CHARACTERISTIC
/begin CHARACTERISTIC ZDrive_BSW_Cal_Cal.ZDrive_BSW_Cal_VehicleInfomationTable.FrontOverhang_Length_m "" VALUE 0x3d80b8 Record_FLOAT32_IEEE 0 autosar_swc_rlgs_CM_single -3.4E+38 3.4E+38 /end CHARACTERISTIC
/begin CHARACTERISTIC ZDrive_BSW_Cal_Cal.ZDrive_BSW_Cal_VehicleInfomationTable.FrontShortCamera_Dx "" VALUE 0x3d81b4 Record_FLOAT32_IEEE 0 autosar_swc_rlgs_CM_single -3.4E+38 3.4E+38 /end CHARACTERISTIC
/begin CHARACTERISTIC ZDrive_BSW_Cal_Cal.ZDrive_BSW_Cal_VehicleInfomationTable.FrontShortCamera_Dy "" VALUE 0x3d81b8 Record_FLOAT32_IEEE 0 autosar_swc_rlgs_CM_single -3.4E+38 3.4E+38 /end CHARACTERISTIC
/begin CHARACTERISTIC ZDrive_BSW_Cal_Cal.ZDrive_BSW_Cal_VehicleInfomationTable.FrontShortCamera_Dz "" VALUE 0x3d81bc Record_FLOAT32_IEEE 0 autosar_swc_rlgs_CM_single -3.4E+38 3.4E+38 /end CHARACTERISTIC
/begin CHARACTERISTIC ZDrive_BSW_Cal_Cal.ZDrive_BSW_Cal_VehicleInfomationTable.FrontShortCamera_Pitch "" VALUE 0x3d81c8 Record_FLOAT32_IEEE 0 autosar_swc_rlgs_CM_single -3.4E+38 3.4E+38 /end CHARACTERISTIC
/begin CHARACTERISTIC ZDrive_BSW_Cal_Cal.ZDrive_BSW_Cal_VehicleInfomationTable.FrontShortCamera_Roll "" VALUE 0x3d81c4 Record_FLOAT32_IEEE 0 autosar_swc_rlgs_CM_single -3.4E+38 3.4E+38 /end CHARACTERISTIC
/begin CHARACTERISTIC ZDrive_BSW_Cal_Cal.ZDrive_BSW_Cal_VehicleInfomationTable.FrontShortCamera_Yaw "" VALUE 0x3d81cc Record_FLOAT32_IEEE 0 autosar_swc_rlgs_CM_single -3.4E+38 3.4E+38 /end CHARACTERISTIC
/begin CHARACTERISTIC ZDrive_BSW_Cal_Cal.ZDrive_BSW_Cal_VehicleInfomationTable.GVW_kg "" VALUE 0x3d8114 Record_FLOAT32_IEEE 0 autosar_swc_rlgs_CM_single -3.4E+38 3.4E+38 /end CHARACTERISTIC
/begin CHARACTERISTIC ZDrive_BSW_Cal_Cal.ZDrive_BSW_Cal_VehicleInfomationTable.Gear_Box "" VALUE 0x3d806e Record_UBYTE 0 autosar_swc_rlgs_CM_uint8 0 255 /end CHARACTERISTIC
/begin CHARACTERISTIC ZDrive_BSW_Cal_Cal.ZDrive_BSW_Cal_VehicleInfomationTable.Height_m "" VALUE 0x3d809c Record_FLOAT32_IEEE 0 autosar_swc_rlgs_CM_single -3.4E+38 3.4E+38 /end CHARACTERISTIC
/begin CHARACTERISTIC ZDrive_BSW_Cal_Cal.ZDrive_BSW_Cal_VehicleInfomationTable.IEnviroment_Bottom_Crop "" VALUE 0x3d8184 Record_SWORD 0 autosar_swc_rlgs_CM_int16 -32768 32767 /end CHARACTERISTIC
/begin CHARACTERISTIC ZDrive_BSW_Cal_Cal.ZDrive_BSW_Cal_VehicleInfomationTable.IEnviroment_Top_Crop "" VALUE 0x3d8182 Record_UWORD 0 autosar_swc_rlgs_CM_uint16 0 65535 /end CHARACTERISTIC
/begin CHARACTERISTIC ZDrive_BSW_Cal_Cal.ZDrive_BSW_Cal_VehicleInfomationTable.IEnvironment_CamToFrontAxle "" VALUE 0x3d8160 Record_FLOAT32_IEEE 0 autosar_swc_rlgs_CM_single -3.4E+38 3.4E+38 /end CHARACTERISTIC
/begin CHARACTERISTIC ZDrive_BSW_Cal_Cal.ZDrive_BSW_Cal_VehicleInfomationTable.IEnvironment_RefPX_Front_Bumper "" VALUE 0x3d817c Record_FLOAT32_IEEE 0 autosar_swc_rlgs_CM_single -3.4E+38 3.4E+38 /end CHARACTERISTIC
/begin CHARACTERISTIC ZDrive_BSW_Cal_Cal.ZDrive_BSW_Cal_VehicleInfomationTable.IEnvironment_WheelWidth "" VALUE 0x3d8120 Record_FLOAT32_IEEE 0 autosar_swc_rlgs_CM_single -3.4E+38 3.4E+38 /end CHARACTERISTIC
/begin CHARACTERISTIC ZDrive_BSW_Cal_Cal.ZDrive_BSW_Cal_VehicleInfomationTable.LeSCBlindSpotLength_m "" VALUE 0x3d81f4 Record_FLOAT32_IEEE 0 autosar_swc_rlgs_CM_single -3.4E+38 3.4E+38 /end CHARACTERISTIC
/begin CHARACTERISTIC ZDrive_BSW_Cal_Cal.ZDrive_BSW_Cal_VehicleInfomationTable.LeSCVerticalDist2Body_m "" VALUE 0x3d81f8 Record_FLOAT32_IEEE 0 autosar_swc_rlgs_CM_single -3.4E+38 3.4E+38 /end CHARACTERISTIC
/begin CHARACTERISTIC ZDrive_BSW_Cal_Cal.ZDrive_BSW_Cal_VehicleInfomationTable.LeftShortCamera_Dx "" VALUE 0x3d81d8 Record_FLOAT32_IEEE 0 autosar_swc_rlgs_CM_single -3.4E+38 3.4E+38 /end CHARACTERISTIC
/begin CHARACTERISTIC ZDrive_BSW_Cal_Cal.ZDrive_BSW_Cal_VehicleInfomationTable.LeftShortCamera_Dy "" VALUE 0x3d81dc Record_FLOAT32_IEEE 0 autosar_swc_rlgs_CM_single -3.4E+38 3.4E+38 /end CHARACTERISTIC
/begin CHARACTERISTIC ZDrive_BSW_Cal_Cal.ZDrive_BSW_Cal_VehicleInfomationTable.LeftShortCamera_Dz "" VALUE 0x3d81e0 Record_FLOAT32_IEEE 0 autosar_swc_rlgs_CM_single -3.4E+38 3.4E+38 /end CHARACTERISTIC
/begin CHARACTERISTIC ZDrive_BSW_Cal_Cal.ZDrive_BSW_Cal_VehicleInfomationTable.LeftShortCamera_Pitch "" VALUE 0x3d81ec Record_FLOAT32_IEEE 0 autosar_swc_rlgs_CM_single -3.4E+38 3.4E+38 /end CHARACTERISTIC
/begin CHARACTERISTIC ZDrive_BSW_Cal_Cal.ZDrive_BSW_Cal_VehicleInfomationTable.LeftShortCamera_Roll "" VALUE 0x3d81e8 Record_FLOAT32_IEEE 0 autosar_swc_rlgs_CM_single -3.4E+38 3.4E+38 /end CHARACTERISTIC
/begin CHARACTERISTIC ZDrive_BSW_Cal_Cal.ZDrive_BSW_Cal_VehicleInfomationTable.LeftShortCamera_Yaw "" VALUE 0x3d81f0 Record_FLOAT32_IEEE 0 autosar_swc_rlgs_CM_single -3.4E+38 3.4E+38 /end CHARACTERISTIC
/begin CHARACTERISTIC ZDrive_BSW_Cal_Cal.ZDrive_BSW_Cal_VehicleInfomationTable.Left_Right_handType "" VALUE 0x3d8076 Record_UBYTE 0 autosar_swc_rlgs_CM_uint8 0 255 /end CHARACTERISTIC
/begin CHARACTERISTIC ZDrive_BSW_Cal_Cal.ZDrive_BSW_Cal_VehicleInfomationTable.MaxSteeringAngle "" VALUE 0x3d8140 Record_FLOAT32_IEEE 0 autosar_swc_rlgs_CM_single -3.4E+38 3.4E+38 /end CHARACTERISTIC
/begin CHARACTERISTIC ZDrive_BSW_Cal_Cal.ZDrive_BSW_Cal_VehicleInfomationTable.ParkingBrakeType "" VALUE 0x3d8072 Record_UBYTE 0 autosar_swc_rlgs_CM_uint8 0 255 /end CHARACTERISTIC
/begin CHARACTERISTIC ZDrive_BSW_Cal_Cal.ZDrive_BSW_Cal_VehicleInfomationTable.ParkingLongControlInterForm "" VALUE 0x3d8074 Record_UBYTE 0 autosar_swc_rlgs_CM_uint8 0 255 /end CHARACTERISTIC
/begin CHARACTERISTIC ZDrive_BSW_Cal_Cal.ZDrive_BSW_Cal_VehicleInfomationTable.PitchAngOfCAD "" VALUE 0x3d81ac Record_FLOAT32_IEEE 0 autosar_swc_rlgs_CM_single -3.4E+38 3.4E+38 /end CHARACTERISTIC
/begin CHARACTERISTIC ZDrive_BSW_Cal_Cal.ZDrive_BSW_Cal_VehicleInfomationTable.PowerTransRatio "" VALUE 0x3d8158 Record_FLOAT32_IEEE 0 autosar_swc_rlgs_CM_single -3.4E+38 3.4E+38 /end CHARACTERISTIC
/begin CHARACTERISTIC ZDrive_BSW_Cal_Cal.ZDrive_BSW_Cal_VehicleInfomationTable.PowerType "" VALUE 0x3d806a Record_UBYTE 0 autosar_swc_rlgs_CM_uint8 0 255 /end CHARACTERISTIC
/begin CHARACTERISTIC ZDrive_BSW_Cal_Cal.ZDrive_BSW_Cal_VehicleInfomationTable.RADAR_MOUNT_PARAM_FL_X_POSITION "" VALUE 0x3d83fc Record_FLOAT32_IEEE 0 autosar_swc_rlgs_CM_single -3.4E+38 3.4E+38 /end CHARACTERISTIC
/begin CHARACTERISTIC ZDrive_BSW_Cal_Cal.ZDrive_BSW_Cal_VehicleInfomationTable.RADAR_MOUNT_PARAM_FL_YAW_ANGLE "" VALUE 0x3d8404 Record_FLOAT32_IEEE 0 autosar_swc_rlgs_CM_single -3.4E+38 3.4E+38 /end CHARACTERISTIC
/begin CHARACTERISTIC ZDrive_BSW_Cal_Cal.ZDrive_BSW_Cal_VehicleInfomationTable.RADAR_MOUNT_PARAM_FL_Y_POSITION "" VALUE 0x3d8400 Record_FLOAT32_IEEE 0 autosar_swc_rlgs_CM_single -3.4E+38 3.4E+38 /end CHARACTERISTIC
/begin CHARACTERISTIC ZDrive_BSW_Cal_Cal.ZDrive_BSW_Cal_VehicleInfomationTable.RADAR_MOUNT_PARAM_FRONT_X_POSITION "" VALUE 0x3d83f0 Record_FLOAT32_IEEE 0 autosar_swc_rlgs_CM_single -3.4E+38 3.4E+38 /end CHARACTERISTIC
/begin CHARACTERISTIC ZDrive_BSW_Cal_Cal.ZDrive_BSW_Cal_VehicleInfomationTable.RADAR_MOUNT_PARAM_FRONT_YAW_ANGLE "" VALUE 0x3d83f8 Record_FLOAT32_IEEE 0 autosar_swc_rlgs_CM_single -3.4E+38 3.4E+38 /end CHARACTERISTIC
/begin CHARACTERISTIC ZDrive_BSW_Cal_Cal.ZDrive_BSW_Cal_VehicleInfomationTable.RADAR_MOUNT_PARAM_FRONT_Y_POSITION "" VALUE 0x3d83f4 Record_FLOAT32_IEEE 0 autosar_swc_rlgs_CM_single -3.4E+38 3.4E+38 /end CHARACTERISTIC
/begin CHARACTERISTIC ZDrive_BSW_Cal_Cal.ZDrive_BSW_Cal_VehicleInfomationTable.RADAR_MOUNT_PARAM_FR_X_POSITION "" VALUE 0x3d8408 Record_FLOAT32_IEEE 0 autosar_swc_rlgs_CM_single -3.4E+38 3.4E+38 /end CHARACTERISTIC
/begin CHARACTERISTIC ZDrive_BSW_Cal_Cal.ZDrive_BSW_Cal_VehicleInfomationTable.RADAR_MOUNT_PARAM_FR_YAW_ANGLE "" VALUE 0x3d8410 Record_FLOAT32_IEEE 0 autosar_swc_rlgs_CM_single -3.4E+38 3.4E+38 /end CHARACTERISTIC
/begin CHARACTERISTIC ZDrive_BSW_Cal_Cal.ZDrive_BSW_Cal_VehicleInfomationTable.RADAR_MOUNT_PARAM_FR_Y_POSITION "" VALUE 0x3d840c Record_FLOAT32_IEEE 0 autosar_swc_rlgs_CM_single -3.4E+38 3.4E+38 /end CHARACTERISTIC
/begin CHARACTERISTIC ZDrive_BSW_Cal_Cal.ZDrive_BSW_Cal_VehicleInfomationTable.RADAR_MOUNT_PARAM_RL_X_POSITION "" VALUE 0x3d8414 Record_FLOAT32_IEEE 0 autosar_swc_rlgs_CM_single -3.4E+38 3.4E+38 /end CHARACTERISTIC
/begin CHARACTERISTIC ZDrive_BSW_Cal_Cal.ZDrive_BSW_Cal_VehicleInfomationTable.RADAR_MOUNT_PARAM_RL_YAW_ANGLE "" VALUE 0x3d841c Record_FLOAT32_IEEE 0 autosar_swc_rlgs_CM_single -3.4E+38 3.4E+38 /end CHARACTERISTIC
/begin CHARACTERISTIC ZDrive_BSW_Cal_Cal.ZDrive_BSW_Cal_VehicleInfomationTable.RADAR_MOUNT_PARAM_RL_Y_POSITION "" VALUE 0x3d8418 Record_FLOAT32_IEEE 0 autosar_swc_rlgs_CM_single -3.4E+38 3.4E+38 /end CHARACTERISTIC
/begin CHARACTERISTIC ZDrive_BSW_Cal_Cal.ZDrive_BSW_Cal_VehicleInfomationTable.RADAR_MOUNT_PARAM_RR_X_POSITION "" VALUE 0x3d8420 Record_FLOAT32_IEEE 0 autosar_swc_rlgs_CM_single -3.4E+38 3.4E+38 /end CHARACTERISTIC
/begin CHARACTERISTIC ZDrive_BSW_Cal_Cal.ZDrive_BSW_Cal_VehicleInfomationTable.RADAR_MOUNT_PARAM_RR_YAW_ANGLE "" VALUE 0x3d8428 Record_FLOAT32_IEEE 0 autosar_swc_rlgs_CM_single -3.4E+38 3.4E+38 /end CHARACTERISTIC
/begin CHARACTERISTIC ZDrive_BSW_Cal_Cal.ZDrive_BSW_Cal_VehicleInfomationTable.RADAR_MOUNT_PARAM_RR_Y_POSITION "" VALUE 0x3d8424 Record_FLOAT32_IEEE 0 autosar_swc_rlgs_CM_single -3.4E+38 3.4E+38 /end CHARACTERISTIC
/begin CHARACTERISTIC ZDrive_BSW_Cal_Cal.ZDrive_BSW_Cal_VehicleInfomationTable.RRollingRadius_m "" VALUE 0x3d8154 Record_FLOAT32_IEEE 0 autosar_swc_rlgs_CM_single -3.4E+38 3.4E+38 /end CHARACTERISTIC
/begin CHARACTERISTIC ZDrive_BSW_Cal_Cal.ZDrive_BSW_Cal_VehicleInfomationTable.ReLeCrnrUss_Dx "" VALUE 0x3d835c Record_FLOAT32_IEEE 0 autosar_swc_rlgs_CM_single -3.4E+38 3.4E+38 /end CHARACTERISTIC
/begin CHARACTERISTIC ZDrive_BSW_Cal_Cal.ZDrive_BSW_Cal_VehicleInfomationTable.ReLeCrnrUss_Dy "" VALUE 0x3d8360 Record_FLOAT32_IEEE 0 autosar_swc_rlgs_CM_single -3.4E+38 3.4E+38 /end CHARACTERISTIC
/begin CHARACTERISTIC ZDrive_BSW_Cal_Cal.ZDrive_BSW_Cal_VehicleInfomationTable.ReLeCrnrUss_Dz "" VALUE 0x3d8364 Record_FLOAT32_IEEE 0 autosar_swc_rlgs_CM_single -3.4E+38 3.4E+38 /end CHARACTERISTIC
/begin CHARACTERISTIC ZDrive_BSW_Cal_Cal.ZDrive_BSW_Cal_VehicleInfomationTable.ReLeCrnrUss_Pitch "" VALUE 0x3d8370 Record_FLOAT32_IEEE 0 autosar_swc_rlgs_CM_single -3.4E+38 3.4E+38 /end CHARACTERISTIC
/begin CHARACTERISTIC ZDrive_BSW_Cal_Cal.ZDrive_BSW_Cal_VehicleInfomationTable.ReLeCrnrUss_Roll "" VALUE 0x3d836c Record_FLOAT32_IEEE 0 autosar_swc_rlgs_CM_single -3.4E+38 3.4E+38 /end CHARACTERISTIC
/begin CHARACTERISTIC ZDrive_BSW_Cal_Cal.ZDrive_BSW_Cal_VehicleInfomationTable.ReLeCrnrUss_Yaw "" VALUE 0x3d8374 Record_FLOAT32_IEEE 0 autosar_swc_rlgs_CM_single -3.4E+38 3.4E+38 /end CHARACTERISTIC
/begin CHARACTERISTIC ZDrive_BSW_Cal_Cal.ZDrive_BSW_Cal_VehicleInfomationTable.ReLeMidUss_Dx "" VALUE 0x3d8340 Record_FLOAT32_IEEE 0 autosar_swc_rlgs_CM_single -3.4E+38 3.4E+38 /end CHARACTERISTIC
/begin CHARACTERISTIC ZDrive_BSW_Cal_Cal.ZDrive_BSW_Cal_VehicleInfomationTable.ReLeMidUss_Dy "" VALUE 0x3d8344 Record_FLOAT32_IEEE 0 autosar_swc_rlgs_CM_single -3.4E+38 3.4E+38 /end CHARACTERISTIC
/begin CHARACTERISTIC ZDrive_BSW_Cal_Cal.ZDrive_BSW_Cal_VehicleInfomationTable.ReLeMidUss_Dz "" VALUE 0x3d8348 Record_FLOAT32_IEEE 0 autosar_swc_rlgs_CM_single -3.4E+38 3.4E+38 /end CHARACTERISTIC
/begin CHARACTERISTIC ZDrive_BSW_Cal_Cal.ZDrive_BSW_Cal_VehicleInfomationTable.ReLeMidUss_Pitch "" VALUE 0x3d8354 Record_FLOAT32_IEEE 0 autosar_swc_rlgs_CM_single -3.4E+38 3.4E+38 /end CHARACTERISTIC
/begin CHARACTERISTIC ZDrive_BSW_Cal_Cal.ZDrive_BSW_Cal_VehicleInfomationTable.ReLeMidUss_Roll "" VALUE 0x3d8350 Record_FLOAT32_IEEE 0 autosar_swc_rlgs_CM_single -3.4E+38 3.4E+38 /end CHARACTERISTIC
/begin CHARACTERISTIC ZDrive_BSW_Cal_Cal.ZDrive_BSW_Cal_VehicleInfomationTable.ReLeMidUss_Yaw "" VALUE 0x3d8358 Record_FLOAT32_IEEE 0 autosar_swc_rlgs_CM_single -3.4E+38 3.4E+38 /end CHARACTERISTIC
/begin CHARACTERISTIC ZDrive_BSW_Cal_Cal.ZDrive_BSW_Cal_VehicleInfomationTable.ReLeSideUss_Dx "" VALUE 0x3d8378 Record_FLOAT32_IEEE 0 autosar_swc_rlgs_CM_single -3.4E+38 3.4E+38 /end CHARACTERISTIC
/begin CHARACTERISTIC ZDrive_BSW_Cal_Cal.ZDrive_BSW_Cal_VehicleInfomationTable.ReLeSideUss_Dy "" VALUE 0x3d837c Record_FLOAT32_IEEE 0 autosar_swc_rlgs_CM_single -3.4E+38 3.4E+38 /end CHARACTERISTIC
/begin CHARACTERISTIC ZDrive_BSW_Cal_Cal.ZDrive_BSW_Cal_VehicleInfomationTable.ReLeSideUss_Dz "" VALUE 0x3d8380 Record_FLOAT32_IEEE 0 autosar_swc_rlgs_CM_single -3.4E+38 3.4E+38 /end CHARACTERISTIC
/begin CHARACTERISTIC ZDrive_BSW_Cal_Cal.ZDrive_BSW_Cal_VehicleInfomationTable.ReLeSideUss_Pitch "" VALUE 0x3d838c Record_FLOAT32_IEEE 0 autosar_swc_rlgs_CM_single -3.4E+38 3.4E+38 /end CHARACTERISTIC
/begin CHARACTERISTIC ZDrive_BSW_Cal_Cal.ZDrive_BSW_Cal_VehicleInfomationTable.ReLeSideUss_Roll "" VALUE 0x3d8388 Record_FLOAT32_IEEE 0 autosar_swc_rlgs_CM_single -3.4E+38 3.4E+38 /end CHARACTERISTIC
/begin CHARACTERISTIC ZDrive_BSW_Cal_Cal.ZDrive_BSW_Cal_VehicleInfomationTable.ReLeSideUss_Yaw "" VALUE 0x3d8390 Record_FLOAT32_IEEE 0 autosar_swc_rlgs_CM_single -3.4E+38 3.4E+38 /end CHARACTERISTIC
/begin CHARACTERISTIC ZDrive_BSW_Cal_Cal.ZDrive_BSW_Cal_VehicleInfomationTable.ReRiCrnrUss_Dx "" VALUE 0x3d8308 Record_FLOAT32_IEEE 0 autosar_swc_rlgs_CM_single -3.4E+38 3.4E+38 /end CHARACTERISTIC
/begin CHARACTERISTIC ZDrive_BSW_Cal_Cal.ZDrive_BSW_Cal_VehicleInfomationTable.ReRiCrnrUss_Dy "" VALUE 0x3d830c Record_FLOAT32_IEEE 0 autosar_swc_rlgs_CM_single -3.4E+38 3.4E+38 /end CHARACTERISTIC
/begin CHARACTERISTIC ZDrive_BSW_Cal_Cal.ZDrive_BSW_Cal_VehicleInfomationTable.ReRiCrnrUss_Dz "" VALUE 0x3d8310 Record_FLOAT32_IEEE 0 autosar_swc_rlgs_CM_single -3.4E+38 3.4E+38 /end CHARACTERISTIC
/begin CHARACTERISTIC ZDrive_BSW_Cal_Cal.ZDrive_BSW_Cal_VehicleInfomationTable.ReRiCrnrUss_Pitch "" VALUE 0x3d831c Record_FLOAT32_IEEE 0 autosar_swc_rlgs_CM_single -3.4E+38 3.4E+38 /end CHARACTERISTIC
/begin CHARACTERISTIC ZDrive_BSW_Cal_Cal.ZDrive_BSW_Cal_VehicleInfomationTable.ReRiCrnrUss_Roll "" VALUE 0x3d8318 Record_FLOAT32_IEEE 0 autosar_swc_rlgs_CM_single -3.4E+38 3.4E+38 /end CHARACTERISTIC
/begin CHARACTERISTIC ZDrive_BSW_Cal_Cal.ZDrive_BSW_Cal_VehicleInfomationTable.ReRiCrnrUss_Yaw "" VALUE 0x3d8320 Record_FLOAT32_IEEE 0 autosar_swc_rlgs_CM_single -3.4E+38 3.4E+38 /end CHARACTERISTIC
/begin CHARACTERISTIC ZDrive_BSW_Cal_Cal.ZDrive_BSW_Cal_VehicleInfomationTable.ReRiMidUss_Dx "" VALUE 0x3d8324 Record_FLOAT32_IEEE 0 autosar_swc_rlgs_CM_single -3.4E+38 3.4E+38 /end CHARACTERISTIC
/begin CHARACTERISTIC ZDrive_BSW_Cal_Cal.ZDrive_BSW_Cal_VehicleInfomationTable.ReRiMidUss_Dy "" VALUE 0x3d8328 Record_FLOAT32_IEEE 0 autosar_swc_rlgs_CM_single -3.4E+38 3.4E+38 /end CHARACTERISTIC
/begin CHARACTERISTIC ZDrive_BSW_Cal_Cal.ZDrive_BSW_Cal_VehicleInfomationTable.ReRiMidUss_Dz "" VALUE 0x3d832c Record_FLOAT32_IEEE 0 autosar_swc_rlgs_CM_single -3.4E+38 3.4E+38 /end CHARACTERISTIC
/begin CHARACTERISTIC ZDrive_BSW_Cal_Cal.ZDrive_BSW_Cal_VehicleInfomationTable.ReRiMidUss_Pitch "" VALUE 0x3d8338 Record_FLOAT32_IEEE 0 autosar_swc_rlgs_CM_single -3.4E+38 3.4E+38 /end CHARACTERISTIC
/begin CHARACTERISTIC ZDrive_BSW_Cal_Cal.ZDrive_BSW_Cal_VehicleInfomationTable.ReRiMidUss_Roll "" VALUE 0x3d8334 Record_FLOAT32_IEEE 0 autosar_swc_rlgs_CM_single -3.4E+38 3.4E+38 /end CHARACTERISTIC
/begin CHARACTERISTIC ZDrive_BSW_Cal_Cal.ZDrive_BSW_Cal_VehicleInfomationTable.ReRiMidUss_Yaw "" VALUE 0x3d833c Record_FLOAT32_IEEE 0 autosar_swc_rlgs_CM_single -3.4E+38 3.4E+38 /end CHARACTERISTIC
/begin CHARACTERISTIC ZDrive_BSW_Cal_Cal.ZDrive_BSW_Cal_VehicleInfomationTable.ReRiSideUss_Dx "" VALUE 0x3d82ec Record_FLOAT32_IEEE 0 autosar_swc_rlgs_CM_single -3.4E+38 3.4E+38 /end CHARACTERISTIC
/begin CHARACTERISTIC ZDrive_BSW_Cal_Cal.ZDrive_BSW_Cal_VehicleInfomationTable.ReRiSideUss_Dy "" VALUE 0x3d82f0 Record_FLOAT32_IEEE 0 autosar_swc_rlgs_CM_single -3.4E+38 3.4E+38 /end CHARACTERISTIC
/begin CHARACTERISTIC ZDrive_BSW_Cal_Cal.ZDrive_BSW_Cal_VehicleInfomationTable.ReRiSideUss_Dz "" VALUE 0x3d82f4 Record_FLOAT32_IEEE 0 autosar_swc_rlgs_CM_single -3.4E+38 3.4E+38 /end CHARACTERISTIC
/begin CHARACTERISTIC ZDrive_BSW_Cal_Cal.ZDrive_BSW_Cal_VehicleInfomationTable.ReRiSideUss_Pitch "" VALUE 0x3d8300 Record_FLOAT32_IEEE 0 autosar_swc_rlgs_CM_single -3.4E+38 3.4E+38 /end CHARACTERISTIC
/begin CHARACTERISTIC ZDrive_BSW_Cal_Cal.ZDrive_BSW_Cal_VehicleInfomationTable.ReRiSideUss_Roll "" VALUE 0x3d82fc Record_FLOAT32_IEEE 0 autosar_swc_rlgs_CM_single -3.4E+38 3.4E+38 /end CHARACTERISTIC
/begin CHARACTERISTIC ZDrive_BSW_Cal_Cal.ZDrive_BSW_Cal_VehicleInfomationTable.ReRiSideUss_Yaw "" VALUE 0x3d8304 Record_FLOAT32_IEEE 0 autosar_swc_rlgs_CM_single -3.4E+38 3.4E+38 /end CHARACTERISTIC
/begin CHARACTERISTIC ZDrive_BSW_Cal_Cal.ZDrive_BSW_Cal_VehicleInfomationTable.ReSCBlindSpotLength_m "" VALUE 0x3d8218 Record_FLOAT32_IEEE 0 autosar_swc_rlgs_CM_single -3.4E+38 3.4E+38 /end CHARACTERISTIC
/begin CHARACTERISTIC ZDrive_BSW_Cal_Cal.ZDrive_BSW_Cal_VehicleInfomationTable.ReSCDist2OuterMostSide_m "" VALUE 0x3d821c Record_FLOAT32_IEEE 0 autosar_swc_rlgs_CM_single -3.4E+38 3.4E+38 /end CHARACTERISTIC
/begin CHARACTERISTIC ZDrive_BSW_Cal_Cal.ZDrive_BSW_Cal_VehicleInfomationTable.ReWhlHousingHeight_m "" VALUE 0x3d80c4 Record_FLOAT32_IEEE 0 autosar_swc_rlgs_CM_single -3.4E+38 3.4E+38 /end CHARACTERISTIC
/begin CHARACTERISTIC ZDrive_BSW_Cal_Cal.ZDrive_BSW_Cal_VehicleInfomationTable.ReWhlTrack_m "" VALUE 0x3d80b4 Record_FLOAT32_IEEE 0 autosar_swc_rlgs_CM_single -3.4E+38 3.4E+38 /end CHARACTERISTIC
/begin CHARACTERISTIC ZDrive_BSW_Cal_Cal.ZDrive_BSW_Cal_VehicleInfomationTable.RearAxleToCenter_m "" VALUE 0x3d80d4 Record_FLOAT32_IEEE 0 autosar_swc_rlgs_CM_single -3.4E+38 3.4E+38 /end CHARACTERISTIC
/begin CHARACTERISTIC ZDrive_BSW_Cal_Cal.ZDrive_BSW_Cal_VehicleInfomationTable.RearAxlecCenterTurningCircle "" VALUE 0x3d8148 Record_FLOAT32_IEEE 0 autosar_swc_rlgs_CM_single -3.4E+38 3.4E+38 /end CHARACTERISTIC
/begin CHARACTERISTIC ZDrive_BSW_Cal_Cal.ZDrive_BSW_Cal_VehicleInfomationTable.RearLeftOutsidePointToCenterLine_Distance_m "" VALUE 0x3d8100 Record_FLOAT32_IEEE 0 autosar_swc_rlgs_CM_single -3.4E+38 3.4E+38 /end CHARACTERISTIC
/begin CHARACTERISTIC ZDrive_BSW_Cal_Cal.ZDrive_BSW_Cal_VehicleInfomationTable.RearLeftOutsidePointToRearAxleCenter_Distance_m "" VALUE 0x3d80fc Record_FLOAT32_IEEE 0 autosar_swc_rlgs_CM_single -3.4E+38 3.4E+38 /end CHARACTERISTIC
/begin CHARACTERISTIC ZDrive_BSW_Cal_Cal.ZDrive_BSW_Cal_VehicleInfomationTable.RearLeftRearPointToCenterLine_Distance_m "" VALUE 0x3d8108 Record_FLOAT32_IEEE 0 autosar_swc_rlgs_CM_single -3.4E+38 3.4E+38 /end CHARACTERISTIC
/begin CHARACTERISTIC ZDrive_BSW_Cal_Cal.ZDrive_BSW_Cal_VehicleInfomationTable.RearLeftRearPointToRearAxleCenter_Distance_m "" VALUE 0x3d8104 Record_FLOAT32_IEEE 0 autosar_swc_rlgs_CM_single -3.4E+38 3.4E+38 /end CHARACTERISTIC
/begin CHARACTERISTIC ZDrive_BSW_Cal_Cal.ZDrive_BSW_Cal_VehicleInfomationTable.RearOverhang_Length_m "" VALUE 0x3d80bc Record_FLOAT32_IEEE 0 autosar_swc_rlgs_CM_single -3.4E+38 3.4E+38 /end CHARACTERISTIC
/begin CHARACTERISTIC ZDrive_BSW_Cal_Cal.ZDrive_BSW_Cal_VehicleInfomationTable.RearShortCamera_Dx "" VALUE 0x3d81fc Record_FLOAT32_IEEE 0 autosar_swc_rlgs_CM_single -3.4E+38 3.4E+38 /end CHARACTERISTIC
/begin CHARACTERISTIC ZDrive_BSW_Cal_Cal.ZDrive_BSW_Cal_VehicleInfomationTable.RearShortCamera_Dy "" VALUE 0x3d8200 Record_FLOAT32_IEEE 0 autosar_swc_rlgs_CM_single -3.4E+38 3.4E+38 /end CHARACTERISTIC
/begin CHARACTERISTIC ZDrive_BSW_Cal_Cal.ZDrive_BSW_Cal_VehicleInfomationTable.RearShortCamera_Dz "" VALUE 0x3d8204 Record_FLOAT32_IEEE 0 autosar_swc_rlgs_CM_single -3.4E+38 3.4E+38 /end CHARACTERISTIC
/begin CHARACTERISTIC ZDrive_BSW_Cal_Cal.ZDrive_BSW_Cal_VehicleInfomationTable.RearShortCamera_Pitch "" VALUE 0x3d8210 Record_FLOAT32_IEEE 0 autosar_swc_rlgs_CM_single -3.4E+38 3.4E+38 /end CHARACTERISTIC
/begin CHARACTERISTIC ZDrive_BSW_Cal_Cal.ZDrive_BSW_Cal_VehicleInfomationTable.RearShortCamera_Roll "" VALUE 0x3d820c Record_FLOAT32_IEEE 0 autosar_swc_rlgs_CM_single -3.4E+38 3.4E+38 /end CHARACTERISTIC
/begin CHARACTERISTIC ZDrive_BSW_Cal_Cal.ZDrive_BSW_Cal_VehicleInfomationTable.RearShortCamera_Yaw "" VALUE 0x3d8214 Record_FLOAT32_IEEE 0 autosar_swc_rlgs_CM_single -3.4E+38 3.4E+38 /end CHARACTERISTIC
/begin CHARACTERISTIC ZDrive_BSW_Cal_Cal.ZDrive_BSW_Cal_VehicleInfomationTable.RearViewMirrorBottomSide_Height "" VALUE 0x3d80e4 Record_FLOAT32_IEEE 0 autosar_swc_rlgs_CM_single -3.4E+38 3.4E+38 /end CHARACTERISTIC
/begin CHARACTERISTIC ZDrive_BSW_Cal_Cal.ZDrive_BSW_Cal_VehicleInfomationTable.RearViewMirrorLength_On_X "" VALUE 0x3d80dc Record_FLOAT32_IEEE 0 autosar_swc_rlgs_CM_single -3.4E+38 3.4E+38 /end CHARACTERISTIC
/begin CHARACTERISTIC ZDrive_BSW_Cal_Cal.ZDrive_BSW_Cal_VehicleInfomationTable.RearViewMirrorLength_On_Y "" VALUE 0x3d80d8 Record_FLOAT32_IEEE 0 autosar_swc_rlgs_CM_single -3.4E+38 3.4E+38 /end CHARACTERISTIC
/begin CHARACTERISTIC ZDrive_BSW_Cal_Cal.ZDrive_BSW_Cal_VehicleInfomationTable.RearViewMirrorOutsidePointToRearAxle_Diatance_m "" VALUE 0x3d80e8 Record_FLOAT32_IEEE 0 autosar_swc_rlgs_CM_single -3.4E+38 3.4E+38 /end CHARACTERISTIC
/begin CHARACTERISTIC ZDrive_BSW_Cal_Cal.ZDrive_BSW_Cal_VehicleInfomationTable.RearViewMirrorTopSide_Height "" VALUE 0x3d80e0 Record_FLOAT32_IEEE 0 autosar_swc_rlgs_CM_single -3.4E+38 3.4E+38 /end CHARACTERISTIC
/begin CHARACTERISTIC ZDrive_BSW_Cal_Cal.ZDrive_BSW_Cal_VehicleInfomationTable.RiSCBlindSpotLength_m "" VALUE 0x3d823c Record_FLOAT32_IEEE 0 autosar_swc_rlgs_CM_single -3.4E+38 3.4E+38 /end CHARACTERISTIC
/begin CHARACTERISTIC ZDrive_BSW_Cal_Cal.ZDrive_BSW_Cal_VehicleInfomationTable.RiSCVerticalDist2Body_m "" VALUE 0x3d8240 Record_FLOAT32_IEEE 0 autosar_swc_rlgs_CM_single -3.4E+38 3.4E+38 /end CHARACTERISTIC
/begin CHARACTERISTIC ZDrive_BSW_Cal_Cal.ZDrive_BSW_Cal_VehicleInfomationTable.RightShortCamera_Dx "" VALUE 0x3d8220 Record_FLOAT32_IEEE 0 autosar_swc_rlgs_CM_single -3.4E+38 3.4E+38 /end CHARACTERISTIC
/begin CHARACTERISTIC ZDrive_BSW_Cal_Cal.ZDrive_BSW_Cal_VehicleInfomationTable.RightShortCamera_Dy "" VALUE 0x3d8224 Record_FLOAT32_IEEE 0 autosar_swc_rlgs_CM_single -3.4E+38 3.4E+38 /end CHARACTERISTIC
/begin CHARACTERISTIC ZDrive_BSW_Cal_Cal.ZDrive_BSW_Cal_VehicleInfomationTable.RightShortCamera_Dz "" VALUE 0x3d8228 Record_FLOAT32_IEEE 0 autosar_swc_rlgs_CM_single -3.4E+38 3.4E+38 /end CHARACTERISTIC
/begin CHARACTERISTIC ZDrive_BSW_Cal_Cal.ZDrive_BSW_Cal_VehicleInfomationTable.RightShortCamera_Pitch "" VALUE 0x3d8234 Record_FLOAT32_IEEE 0 autosar_swc_rlgs_CM_single -3.4E+38 3.4E+38 /end CHARACTERISTIC
/begin CHARACTERISTIC ZDrive_BSW_Cal_Cal.ZDrive_BSW_Cal_VehicleInfomationTable.RightShortCamera_Roll "" VALUE 0x3d8230 Record_FLOAT32_IEEE 0 autosar_swc_rlgs_CM_single -3.4E+38 3.4E+38 /end CHARACTERISTIC
/begin CHARACTERISTIC ZDrive_BSW_Cal_Cal.ZDrive_BSW_Cal_VehicleInfomationTable.RightShortCamera_Yaw "" VALUE 0x3d8238 Record_FLOAT32_IEEE 0 autosar_swc_rlgs_CM_single -3.4E+38 3.4E+38 /end CHARACTERISTIC
/begin CHARACTERISTIC ZDrive_BSW_Cal_Cal.ZDrive_BSW_Cal_VehicleInfomationTable.RollingAngOfCAD "" VALUE 0x3d81a8 Record_FLOAT32_IEEE 0 autosar_swc_rlgs_CM_single -3.4E+38 3.4E+38 /end CHARACTERISTIC
/begin CHARACTERISTIC ZDrive_BSW_Cal_Cal.ZDrive_BSW_Cal_VehicleInfomationTable.SideSlipAnglefactor "" VALUE 0x3d813c Record_FLOAT32_IEEE 0 autosar_swc_rlgs_CM_single -3.4E+38 3.4E+38 /end CHARACTERISTIC
/begin CHARACTERISTIC ZDrive_BSW_Cal_Cal.ZDrive_BSW_Cal_VehicleInfomationTable.SteeringAngleRatio "" VALUE 0x3d8144 Record_FLOAT32_IEEE 0 autosar_swc_rlgs_CM_single -3.4E+38 3.4E+38 /end CHARACTERISTIC
/begin CHARACTERISTIC ZDrive_BSW_Cal_Cal.ZDrive_BSW_Cal_VehicleInfomationTable.StrWhlAngSigDirect "" VALUE 0x3d807a Record_UBYTE 0 autosar_swc_rlgs_CM_uint8 0 255 /end CHARACTERISTIC
/begin CHARACTERISTIC ZDrive_BSW_Cal_Cal.ZDrive_BSW_Cal_VehicleInfomationTable.StrWhlConfig "" VALUE 0x3d8073 Record_UBYTE 0 autosar_swc_rlgs_CM_uint8 0 255 /end CHARACTERISTIC
/begin CHARACTERISTIC ZDrive_BSW_Cal_Cal.ZDrive_BSW_Cal_VehicleInfomationTable.StrWhlMappingTable "" VALUE 0x3d814c Record_FLOAT32_IEEE 0 autosar_swc_rlgs_CM_single -3.4E+38 3.4E+38 /end CHARACTERISTIC
/begin CHARACTERISTIC ZDrive_BSW_Cal_Cal.ZDrive_BSW_Cal_VehicleInfomationTable.Suspension "" VALUE 0x3d8082 Record_UBYTE 0 autosar_swc_rlgs_CM_uint8 0 255 /end CHARACTERISTIC
/begin CHARACTERISTIC ZDrive_BSW_Cal_Cal.ZDrive_BSW_Cal_VehicleInfomationTable.TAC_Bottom "" VALUE 0x3d8180 Record_SBYTE 0 autosar_swc_rlgs_CM_int8 -128 127 /end CHARACTERISTIC
/begin CHARACTERISTIC ZDrive_BSW_Cal_Cal.ZDrive_BSW_Cal_VehicleInfomationTable.TAC_Camera_Height "" VALUE 0x3d815c Record_FLOAT32_IEEE 0 autosar_swc_rlgs_CM_single -3.4E+38 3.4E+38 /end CHARACTERISTIC
/begin CHARACTERISTIC ZDrive_BSW_Cal_Cal.ZDrive_BSW_Cal_VehicleInfomationTable.TAC_Targets_Num "" VALUE 0x3d8190 Record_UBYTE 0 autosar_swc_rlgs_CM_uint8 0 255 /end CHARACTERISTIC
/begin CHARACTERISTIC ZDrive_BSW_Cal_Cal.ZDrive_BSW_Cal_VehicleInfomationTable.TireRadius_m "" VALUE 0x3d811c Record_FLOAT32_IEEE 0 autosar_swc_rlgs_CM_single -3.4E+38 3.4E+38 /end CHARACTERISTIC
/begin CHARACTERISTIC ZDrive_BSW_Cal_Cal.ZDrive_BSW_Cal_VehicleInfomationTable.TurnLevelType "" VALUE 0x3d806c Record_UBYTE 0 autosar_swc_rlgs_CM_uint8 0 255 /end CHARACTERISTIC
/begin CHARACTERISTIC ZDrive_BSW_Cal_Cal.ZDrive_BSW_Cal_VehicleInfomationTable.UltraInstallAng_FA "" VALUE 0x3d8398 Record_FLOAT32_IEEE 0 autosar_swc_rlgs_CM_single -3.4E+38 3.4E+38 /end CHARACTERISTIC
/begin CHARACTERISTIC ZDrive_BSW_Cal_Cal.ZDrive_BSW_Cal_VehicleInfomationTable.UltraInstallAng_FM "" VALUE 0x3d8394 Record_FLOAT32_IEEE 0 autosar_swc_rlgs_CM_single -3.4E+38 3.4E+38 /end CHARACTERISTIC
/begin CHARACTERISTIC ZDrive_BSW_Cal_Cal.ZDrive_BSW_Cal_VehicleInfomationTable.UltraInstallAng_FS "" VALUE 0x3d839c Record_FLOAT32_IEEE 0 autosar_swc_rlgs_CM_single -3.4E+38 3.4E+38 /end CHARACTERISTIC
/begin CHARACTERISTIC ZDrive_BSW_Cal_Cal.ZDrive_BSW_Cal_VehicleInfomationTable.UltraInstallAng_RA "" VALUE 0x3d83b4 Record_FLOAT32_IEEE 0 autosar_swc_rlgs_CM_single -3.4E+38 3.4E+38 /end CHARACTERISTIC
/begin CHARACTERISTIC ZDrive_BSW_Cal_Cal.ZDrive_BSW_Cal_VehicleInfomationTable.UltraInstallAng_RM "" VALUE 0x3d83b0 Record_FLOAT32_IEEE 0 autosar_swc_rlgs_CM_single -3.4E+38 3.4E+38 /end CHARACTERISTIC
/begin CHARACTERISTIC ZDrive_BSW_Cal_Cal.ZDrive_BSW_Cal_VehicleInfomationTable.UltraInstallAng_RS "" VALUE 0x3d83b8 Record_FLOAT32_IEEE 0 autosar_swc_rlgs_CM_single -3.4E+38 3.4E+38 /end CHARACTERISTIC
/begin CHARACTERISTIC ZDrive_BSW_Cal_Cal.ZDrive_BSW_Cal_VehicleInfomationTable.UltraInstallHeight_FA_m "" VALUE 0x3d83cc Record_FLOAT32_IEEE 0 autosar_swc_rlgs_CM_single -3.4E+38 3.4E+38 /end CHARACTERISTIC
/begin CHARACTERISTIC ZDrive_BSW_Cal_Cal.ZDrive_BSW_Cal_VehicleInfomationTable.UltraInstallHeight_FM_m "" VALUE 0x3d83c8 Record_FLOAT32_IEEE 0 autosar_swc_rlgs_CM_single -3.4E+38 3.4E+38 /end CHARACTERISTIC
/begin CHARACTERISTIC ZDrive_BSW_Cal_Cal.ZDrive_BSW_Cal_VehicleInfomationTable.UltraInstallHeight_FS_m "" VALUE 0x3d83d0 Record_FLOAT32_IEEE 0 autosar_swc_rlgs_CM_single -3.4E+38 3.4E+38 /end CHARACTERISTIC
/begin CHARACTERISTIC ZDrive_BSW_Cal_Cal.ZDrive_BSW_Cal_VehicleInfomationTable.UltraInstallHeight_RA_m "" VALUE 0x3d83d8 Record_FLOAT32_IEEE 0 autosar_swc_rlgs_CM_single -3.4E+38 3.4E+38 /end CHARACTERISTIC
/begin CHARACTERISTIC ZDrive_BSW_Cal_Cal.ZDrive_BSW_Cal_VehicleInfomationTable.UltraInstallHeight_RM_m "" VALUE 0x3d83d4 Record_FLOAT32_IEEE 0 autosar_swc_rlgs_CM_single -3.4E+38 3.4E+38 /end CHARACTERISTIC
/begin CHARACTERISTIC ZDrive_BSW_Cal_Cal.ZDrive_BSW_Cal_VehicleInfomationTable.UltraInstallHeight_RS_m "" VALUE 0x3d83dc Record_FLOAT32_IEEE 0 autosar_swc_rlgs_CM_single -3.4E+38 3.4E+38 /end CHARACTERISTIC
/begin CHARACTERISTIC ZDrive_BSW_Cal_Cal.ZDrive_BSW_Cal_VehicleInfomationTable.UltraInstallLatOffset_FA_m "" VALUE 0x3d83a4 Record_FLOAT32_IEEE 0 autosar_swc_rlgs_CM_single -3.4E+38 3.4E+38 /end CHARACTERISTIC
/begin CHARACTERISTIC ZDrive_BSW_Cal_Cal.ZDrive_BSW_Cal_VehicleInfomationTable.UltraInstallLatOffset_FM_m "" VALUE 0x3d83a0 Record_FLOAT32_IEEE 0 autosar_swc_rlgs_CM_single -3.4E+38 3.4E+38 /end CHARACTERISTIC
/begin CHARACTERISTIC ZDrive_BSW_Cal_Cal.ZDrive_BSW_Cal_VehicleInfomationTable.UltraInstallLatOffset_FS_m "" VALUE 0x3d83a8 Record_FLOAT32_IEEE 0 autosar_swc_rlgs_CM_single -3.4E+38 3.4E+38 /end CHARACTERISTIC
/begin CHARACTERISTIC ZDrive_BSW_Cal_Cal.ZDrive_BSW_Cal_VehicleInfomationTable.UltraInstallLatOffset_RA_m "" VALUE 0x3d83c0 Record_FLOAT32_IEEE 0 autosar_swc_rlgs_CM_single -3.4E+38 3.4E+38 /end CHARACTERISTIC
/begin CHARACTERISTIC ZDrive_BSW_Cal_Cal.ZDrive_BSW_Cal_VehicleInfomationTable.UltraInstallLatOffset_RM_m "" VALUE 0x3d83bc Record_FLOAT32_IEEE 0 autosar_swc_rlgs_CM_single -3.4E+38 3.4E+38 /end CHARACTERISTIC
/begin CHARACTERISTIC ZDrive_BSW_Cal_Cal.ZDrive_BSW_Cal_VehicleInfomationTable.UltraInstallLatOffset_RS_m "" VALUE 0x3d83c4 Record_FLOAT32_IEEE 0 autosar_swc_rlgs_CM_single -3.4E+38 3.4E+38 /end CHARACTERISTIC
/begin CHARACTERISTIC ZDrive_BSW_Cal_Cal.ZDrive_BSW_Cal_VehicleInfomationTable.VISION_MOUNT_PARAM_FRONT_X_POSITION "" VALUE 0x3d83e4 Record_FLOAT32_IEEE 0 autosar_swc_rlgs_CM_single -3.4E+38 3.4E+38 /end CHARACTERISTIC
/begin CHARACTERISTIC ZDrive_BSW_Cal_Cal.ZDrive_BSW_Cal_VehicleInfomationTable.VISION_MOUNT_PARAM_FRONT_YAW_ANGLE "" VALUE 0x3d83ec Record_FLOAT32_IEEE 0 autosar_swc_rlgs_CM_single -3.4E+38 3.4E+38 /end CHARACTERISTIC
/begin CHARACTERISTIC ZDrive_BSW_Cal_Cal.ZDrive_BSW_Cal_VehicleInfomationTable.VISION_MOUNT_PARAM_FRONT_Y_POSITION "" VALUE 0x3d83e8 Record_FLOAT32_IEEE 0 autosar_swc_rlgs_CM_single -3.4E+38 3.4E+38 /end CHARACTERISTIC
/begin CHARACTERISTIC ZDrive_BSW_Cal_Cal.ZDrive_BSW_Cal_VehicleInfomationTable.ValFunc_Reserve1 "" VALUE 0x3d807f Record_UBYTE 0 autosar_swc_rlgs_CM_uint8 0 255 /end CHARACTERISTIC
/begin CHARACTERISTIC ZDrive_BSW_Cal_Cal.ZDrive_BSW_Cal_VehicleInfomationTable.ValFunc_Reserve2 "" VALUE 0x3d8080 Record_UBYTE 0 autosar_swc_rlgs_CM_uint8 0 255 /end CHARACTERISTIC
/begin CHARACTERISTIC ZDrive_BSW_Cal_Cal.ZDrive_BSW_Cal_VehicleInfomationTable.VehConfig_Code1 "" VALUE 0x3d8060 Record_ULONG 0 autosar_swc_rlgs_CM_uint32 0 4294967295 /end CHARACTERISTIC
/begin CHARACTERISTIC ZDrive_BSW_Cal_Cal.ZDrive_BSW_Cal_VehicleInfomationTable.VehConfig_Code2 "" VALUE 0x3d8064 Record_ULONG 0 autosar_swc_rlgs_CM_uint32 0 4294967295 /end CHARACTERISTIC
/begin CHARACTERISTIC ZDrive_BSW_Cal_Cal.ZDrive_BSW_Cal_VehicleInfomationTable.VehicleWidthMax_m "" VALUE 0x3d8094 Record_FLOAT32_IEEE 0 autosar_swc_rlgs_CM_single -3.4E+38 3.4E+38 /end CHARACTERISTIC
/begin CHARACTERISTIC ZDrive_BSW_Cal_Cal.ZDrive_BSW_Cal_VehicleInfomationTable.VehicleWidthMin_m "" VALUE 0x3d8098 Record_FLOAT32_IEEE 0 autosar_swc_rlgs_CM_single -3.4E+38 3.4E+38 /end CHARACTERISTIC
/begin CHARACTERISTIC ZDrive_BSW_Cal_Cal.ZDrive_BSW_Cal_VehicleInfomationTable.Vehicle_Information_End_Tag "" VALUE 0x3d855f Record_UBYTE 0 autosar_swc_rlgs_CM_uint8 0 255 /end CHARACTERISTIC
/begin CHARACTERISTIC ZDrive_BSW_Cal_Cal.ZDrive_BSW_Cal_VehicleInfomationTable.Vehicle_Information_Reserved_Line102 "" VALUE 0x3d8181 Record_UBYTE 0 autosar_swc_rlgs_CM_uint8 0 255 /end CHARACTERISTIC
/begin CHARACTERISTIC ZDrive_BSW_Cal_Cal.ZDrive_BSW_Cal_VehicleInfomationTable.Vehicle_Information_Reserved_Line105 "" VALUE 0x3d8186 Record_UWORD 0 autosar_swc_rlgs_CM_uint16 0 65535 /end CHARACTERISTIC
/begin CHARACTERISTIC ZDrive_BSW_Cal_Cal.ZDrive_BSW_Cal_VehicleInfomationTable.Vehicle_Information_Reserved_Line109 "" VALUE 0x3d8191 Record_UBYTE 0 autosar_swc_rlgs_CM_uint8 0 255 /end CHARACTERISTIC
/begin CHARACTERISTIC ZDrive_BSW_Cal_Cal.ZDrive_BSW_Cal_VehicleInfomationTable.Vehicle_Information_Reserved_Line110 "" VALUE 0x3d8192 Record_UWORD 0 autosar_swc_rlgs_CM_uint16 0 65535 /end CHARACTERISTIC
/begin CHARACTERISTIC ZDrive_BSW_Cal_Cal.ZDrive_BSW_Cal_VehicleInfomationTable.Vehicle_Information_Reserved_Line115 "" VALUE 0x3d81a4 Record_ULONG 0 autosar_swc_rlgs_CM_uint32 0 4294967295 /end CHARACTERISTIC
/begin CHARACTERISTIC ZDrive_BSW_Cal_Cal.ZDrive_BSW_Cal_VehicleInfomationTable.Vehicle_Information_Reserved_Line122 "" VALUE 0x3d81c0 Record_ULONG 0 autosar_swc_rlgs_CM_uint32 0 4294967295 /end CHARACTERISTIC
/begin CHARACTERISTIC ZDrive_BSW_Cal_Cal.ZDrive_BSW_Cal_VehicleInfomationTable.Vehicle_Information_Reserved_Line131 "" VALUE 0x3d81e4 Record_ULONG 0 autosar_swc_rlgs_CM_uint32 0 4294967295 /end CHARACTERISTIC
/begin CHARACTERISTIC ZDrive_BSW_Cal_Cal.ZDrive_BSW_Cal_VehicleInfomationTable.Vehicle_Information_Reserved_Line140 "" VALUE 0x3d8208 Record_ULONG 0 autosar_swc_rlgs_CM_uint32 0 4294967295 /end CHARACTERISTIC
/begin CHARACTERISTIC ZDrive_BSW_Cal_Cal.ZDrive_BSW_Cal_VehicleInfomationTable.Vehicle_Information_Reserved_Line149 "" VALUE 0x3d822c Record_ULONG 0 autosar_swc_rlgs_CM_uint32 0 4294967295 /end CHARACTERISTIC
/begin CHARACTERISTIC ZDrive_BSW_Cal_Cal.ZDrive_BSW_Cal_VehicleInfomationTable.Vehicle_Information_Reserved_Line158 "" VALUE 0x3d8250 Record_ULONG 0 autosar_swc_rlgs_CM_uint32 0 4294967295 /end CHARACTERISTIC
/begin CHARACTERISTIC ZDrive_BSW_Cal_Cal.ZDrive_BSW_Cal_VehicleInfomationTable.Vehicle_Information_Reserved_Line165 "" VALUE 0x3d826c Record_ULONG 0 autosar_swc_rlgs_CM_uint32 0 4294967295 /end CHARACTERISTIC
/begin CHARACTERISTIC ZDrive_BSW_Cal_Cal.ZDrive_BSW_Cal_VehicleInfomationTable.Vehicle_Information_Reserved_Line172 "" VALUE 0x3d8288 Record_ULONG 0 autosar_swc_rlgs_CM_uint32 0 4294967295 /end CHARACTERISTIC
/begin CHARACTERISTIC ZDrive_BSW_Cal_Cal.ZDrive_BSW_Cal_VehicleInfomationTable.Vehicle_Information_Reserved_Line179 "" VALUE 0x3d82a4 Record_ULONG 0 autosar_swc_rlgs_CM_uint32 0 4294967295 /end CHARACTERISTIC
/begin CHARACTERISTIC ZDrive_BSW_Cal_Cal.ZDrive_BSW_Cal_VehicleInfomationTable.Vehicle_Information_Reserved_Line186 "" VALUE 0x3d82c0 Record_ULONG 0 autosar_swc_rlgs_CM_uint32 0 4294967295 /end CHARACTERISTIC
/begin CHARACTERISTIC ZDrive_BSW_Cal_Cal.ZDrive_BSW_Cal_VehicleInfomationTable.Vehicle_Information_Reserved_Line193 "" VALUE 0x3d82dc Record_ULONG 0 autosar_swc_rlgs_CM_uint32 0 4294967295 /end CHARACTERISTIC
/begin CHARACTERISTIC ZDrive_BSW_Cal_Cal.ZDrive_BSW_Cal_VehicleInfomationTable.Vehicle_Information_Reserved_Line200 "" VALUE 0x3d82f8 Record_ULONG 0 autosar_swc_rlgs_CM_uint32 0 4294967295 /end CHARACTERISTIC
/begin CHARACTERISTIC ZDrive_BSW_Cal_Cal.ZDrive_BSW_Cal_VehicleInfomationTable.Vehicle_Information_Reserved_Line207 "" VALUE 0x3d8314 Record_ULONG 0 autosar_swc_rlgs_CM_uint32 0 4294967295 /end CHARACTERISTIC
/begin CHARACTERISTIC ZDrive_BSW_Cal_Cal.ZDrive_BSW_Cal_VehicleInfomationTable.Vehicle_Information_Reserved_Line214 "" VALUE 0x3d8330 Record_ULONG 0 autosar_swc_rlgs_CM_uint32 0 4294967295 /end CHARACTERISTIC
/begin CHARACTERISTIC ZDrive_BSW_Cal_Cal.ZDrive_BSW_Cal_VehicleInfomationTable.Vehicle_Information_Reserved_Line221 "" VALUE 0x3d834c Record_ULONG 0 autosar_swc_rlgs_CM_uint32 0 4294967295 /end CHARACTERISTIC
/begin CHARACTERISTIC ZDrive_BSW_Cal_Cal.ZDrive_BSW_Cal_VehicleInfomationTable.Vehicle_Information_Reserved_Line228 "" VALUE 0x3d8368 Record_ULONG 0 autosar_swc_rlgs_CM_uint32 0 4294967295 /end CHARACTERISTIC
/begin CHARACTERISTIC ZDrive_BSW_Cal_Cal.ZDrive_BSW_Cal_VehicleInfomationTable.Vehicle_Information_Reserved_Line235 "" VALUE 0x3d8384 Record_ULONG 0 autosar_swc_rlgs_CM_uint32 0 4294967295 /end CHARACTERISTIC
/begin CHARACTERISTIC ZDrive_BSW_Cal_Cal.ZDrive_BSW_Cal_VehicleInfomationTable.Vehicle_Information_Reserved_Line24 "" VALUE 0x0 Record_UBYTE 0 autosar_swc_rlgs_CM_uint8 0 255 /end CHARACTERISTIC
/begin CHARACTERISTIC ZDrive_BSW_Cal_Cal.ZDrive_BSW_Cal_VehicleInfomationTable.Vehicle_Information_Reserved_Line245 "" VALUE 0x3d83ac Record_ULONG 0 autosar_swc_rlgs_CM_uint32 0 4294967295 /end CHARACTERISTIC
/begin CHARACTERISTIC ZDrive_BSW_Cal_Cal.ZDrive_BSW_Cal_VehicleInfomationTable.Vehicle_Information_Reserved_Line25 "" VALUE 0x0 Record_UBYTE 0 autosar_swc_rlgs_CM_uint8 0 255 /end CHARACTERISTIC
/begin CHARACTERISTIC ZDrive_BSW_Cal_Cal.ZDrive_BSW_Cal_VehicleInfomationTable.Vehicle_Information_Reserved_Line258 "" VALUE 0x3d83e0 Record_ULONG 0 autosar_swc_rlgs_CM_uint32 0 4294967295 /end CHARACTERISTIC
/begin CHARACTERISTIC ZDrive_BSW_Cal_Cal.ZDrive_BSW_Cal_VehicleInfomationTable.Vehicle_Information_Reserved_Line26 "" VALUE 0x3d807e Record_UBYTE 0 autosar_swc_rlgs_CM_uint8 0 255 /end CHARACTERISTIC
/begin CHARACTERISTIC ZDrive_BSW_Cal_Cal.ZDrive_BSW_Cal_VehicleInfomationTable.Vehicle_Information_Reserved_Line277 "" VALUE 0x3d842c Record_ULONG 0 autosar_swc_rlgs_CM_uint32 0 4294967295 /end CHARACTERISTIC
/begin CHARACTERISTIC ZDrive_BSW_Cal_Cal.ZDrive_BSW_Cal_VehicleInfomationTable.Vehicle_Information_Reserved_Line278 "" VALUE 0x3d8430 Record_ULONG 0 autosar_swc_rlgs_CM_uint32 0 4294967295 /end CHARACTERISTIC
/begin CHARACTERISTIC ZDrive_BSW_Cal_Cal.ZDrive_BSW_Cal_VehicleInfomationTable.Vehicle_Information_Reserved_Line279 "" VALUE 0x3d8434 Record_ULONG 0 autosar_swc_rlgs_CM_uint32 0 4294967295 /end CHARACTERISTIC
/begin CHARACTERISTIC ZDrive_BSW_Cal_Cal.ZDrive_BSW_Cal_VehicleInfomationTable.Vehicle_Information_Reserved_Line280 "" VALUE 0x3d8438 Record_ULONG 0 autosar_swc_rlgs_CM_uint32 0 4294967295 /end CHARACTERISTIC
/begin CHARACTERISTIC ZDrive_BSW_Cal_Cal.ZDrive_BSW_Cal_VehicleInfomationTable.Vehicle_Information_Reserved_Line281 "" VALUE 0x3d843c Record_ULONG 0 autosar_swc_rlgs_CM_uint32 0 4294967295 /end CHARACTERISTIC
/begin CHARACTERISTIC ZDrive_BSW_Cal_Cal.ZDrive_BSW_Cal_VehicleInfomationTable.Vehicle_Information_Reserved_Line282 "" VALUE 0x3d8440 Record_ULONG 0 autosar_swc_rlgs_CM_uint32 0 4294967295 /end CHARACTERISTIC
/begin CHARACTERISTIC ZDrive_BSW_Cal_Cal.ZDrive_BSW_Cal_VehicleInfomationTable.Vehicle_Information_Reserved_Line283 "" VALUE 0x3d8444 Record_ULONG 0 autosar_swc_rlgs_CM_uint32 0 4294967295 /end CHARACTERISTIC
/begin CHARACTERISTIC ZDrive_BSW_Cal_Cal.ZDrive_BSW_Cal_VehicleInfomationTable.Vehicle_Information_Reserved_Line284 "" VALUE 0x3d8448 Record_ULONG 0 autosar_swc_rlgs_CM_uint32 0 4294967295 /end CHARACTERISTIC
/begin CHARACTERISTIC ZDrive_BSW_Cal_Cal.ZDrive_BSW_Cal_VehicleInfomationTable.Vehicle_Information_Reserved_Line285 "" VALUE 0x3d844c Record_ULONG 0 autosar_swc_rlgs_CM_uint32 0 4294967295 /end CHARACTERISTIC
/begin CHARACTERISTIC ZDrive_BSW_Cal_Cal.ZDrive_BSW_Cal_VehicleInfomationTable.Vehicle_Information_Reserved_Line286 "" VALUE 0x3d8450 Record_ULONG 0 autosar_swc_rlgs_CM_uint32 0 4294967295 /end CHARACTERISTIC
/begin CHARACTERISTIC ZDrive_BSW_Cal_Cal.ZDrive_BSW_Cal_VehicleInfomationTable.Vehicle_Information_Reserved_Line287 "" VALUE 0x3d8454 Record_ULONG 0 autosar_swc_rlgs_CM_uint32 0 4294967295 /end CHARACTERISTIC
/begin CHARACTERISTIC ZDrive_BSW_Cal_Cal.ZDrive_BSW_Cal_VehicleInfomationTable.Vehicle_Information_Reserved_Line288 "" VALUE 0x3d8458 Record_ULONG 0 autosar_swc_rlgs_CM_uint32 0 4294967295 /end CHARACTERISTIC
/begin CHARACTERISTIC ZDrive_BSW_Cal_Cal.ZDrive_BSW_Cal_VehicleInfomationTable.Vehicle_Information_Reserved_Line289 "" VALUE 0x3d845c Record_ULONG 0 autosar_swc_rlgs_CM_uint32 0 4294967295 /end CHARACTERISTIC
/begin CHARACTERISTIC ZDrive_BSW_Cal_Cal.ZDrive_BSW_Cal_VehicleInfomationTable.Vehicle_Information_Reserved_Line290 "" VALUE 0x3d8460 Record_ULONG 0 autosar_swc_rlgs_CM_uint32 0 4294967295 /end CHARACTERISTIC
/begin CHARACTERISTIC ZDrive_BSW_Cal_Cal.ZDrive_BSW_Cal_VehicleInfomationTable.Vehicle_Information_Reserved_Line291 "" VALUE 0x3d8464 Record_ULONG 0 autosar_swc_rlgs_CM_uint32 0 4294967295 /end CHARACTERISTIC
/begin CHARACTERISTIC ZDrive_BSW_Cal_Cal.ZDrive_BSW_Cal_VehicleInfomationTable.Vehicle_Information_Reserved_Line292 "" VALUE 0x3d8468 Record_ULONG 0 autosar_swc_rlgs_CM_uint32 0 4294967295 /end CHARACTERISTIC
/begin CHARACTERISTIC ZDrive_BSW_Cal_Cal.ZDrive_BSW_Cal_VehicleInfomationTable.Vehicle_Information_Reserved_Line293 "" VALUE 0x3d846c Record_ULONG 0 autosar_swc_rlgs_CM_uint32 0 4294967295 /end CHARACTERISTIC
/begin CHARACTERISTIC ZDrive_BSW_Cal_Cal.ZDrive_BSW_Cal_VehicleInfomationTable.Vehicle_Information_Reserved_Line294 "" VALUE 0x3d8470 Record_ULONG 0 autosar_swc_rlgs_CM_uint32 0 4294967295 /end CHARACTERISTIC
/begin CHARACTERISTIC ZDrive_BSW_Cal_Cal.ZDrive_BSW_Cal_VehicleInfomationTable.Vehicle_Information_Reserved_Line295 "" VALUE 0x3d8474 Record_ULONG 0 autosar_swc_rlgs_CM_uint32 0 4294967295 /end CHARACTERISTIC
/begin CHARACTERISTIC ZDrive_BSW_Cal_Cal.ZDrive_BSW_Cal_VehicleInfomationTable.Vehicle_Information_Reserved_Line296 "" VALUE 0x3d8478 Record_ULONG 0 autosar_swc_rlgs_CM_uint32 0 4294967295 /end CHARACTERISTIC
/begin CHARACTERISTIC ZDrive_BSW_Cal_Cal.ZDrive_BSW_Cal_VehicleInfomationTable.Vehicle_Information_Reserved_Line297 "" VALUE 0x3d847c Record_ULONG 0 autosar_swc_rlgs_CM_uint32 0 4294967295 /end CHARACTERISTIC
/begin CHARACTERISTIC ZDrive_BSW_Cal_Cal.ZDrive_BSW_Cal_VehicleInfomationTable.Vehicle_Information_Reserved_Line298 "" VALUE 0x3d8480 Record_ULONG 0 autosar_swc_rlgs_CM_uint32 0 4294967295 /end CHARACTERISTIC
/begin CHARACTERISTIC ZDrive_BSW_Cal_Cal.ZDrive_BSW_Cal_VehicleInfomationTable.Vehicle_Information_Reserved_Line299 "" VALUE 0x3d8484 Record_ULONG 0 autosar_swc_rlgs_CM_uint32 0 4294967295 /end CHARACTERISTIC
/begin CHARACTERISTIC ZDrive_BSW_Cal_Cal.ZDrive_BSW_Cal_VehicleInfomationTable.Vehicle_Information_Reserved_Line300 "" VALUE 0x3d8488 Record_ULONG 0 autosar_swc_rlgs_CM_uint32 0 4294967295 /end CHARACTERISTIC
/begin CHARACTERISTIC ZDrive_BSW_Cal_Cal.ZDrive_BSW_Cal_VehicleInfomationTable.Vehicle_Information_Reserved_Line301 "" VALUE 0x3d848c Record_ULONG 0 autosar_swc_rlgs_CM_uint32 0 4294967295 /end CHARACTERISTIC
/begin CHARACTERISTIC ZDrive_BSW_Cal_Cal.ZDrive_BSW_Cal_VehicleInfomationTable.Vehicle_Information_Reserved_Line302 "" VALUE 0x3d8490 Record_ULONG 0 autosar_swc_rlgs_CM_uint32 0 4294967295 /end CHARACTERISTIC
/begin CHARACTERISTIC ZDrive_BSW_Cal_Cal.ZDrive_BSW_Cal_VehicleInfomationTable.Vehicle_Information_Reserved_Line303 "" VALUE 0x3d8494 Record_ULONG 0 autosar_swc_rlgs_CM_uint32 0 4294967295 /end CHARACTERISTIC
/begin CHARACTERISTIC ZDrive_BSW_Cal_Cal.ZDrive_BSW_Cal_VehicleInfomationTable.Vehicle_Information_Reserved_Line304 "" VALUE 0x3d8498 Record_ULONG 0 autosar_swc_rlgs_CM_uint32 0 4294967295 /end CHARACTERISTIC
/begin CHARACTERISTIC ZDrive_BSW_Cal_Cal.ZDrive_BSW_Cal_VehicleInfomationTable.Vehicle_Information_Reserved_Line305 "" VALUE 0x3d849c Record_ULONG 0 autosar_swc_rlgs_CM_uint32 0 4294967295 /end CHARACTERISTIC
/begin CHARACTERISTIC ZDrive_BSW_Cal_Cal.ZDrive_BSW_Cal_VehicleInfomationTable.Vehicle_Information_Reserved_Line306 "" VALUE 0x3d84a0 Record_ULONG 0 autosar_swc_rlgs_CM_uint32 0 4294967295 /end CHARACTERISTIC
/begin CHARACTERISTIC ZDrive_BSW_Cal_Cal.ZDrive_BSW_Cal_VehicleInfomationTable.Vehicle_Information_Reserved_Line307 "" VALUE 0x3d84a4 Record_ULONG 0 autosar_swc_rlgs_CM_uint32 0 4294967295 /end CHARACTERISTIC
/begin CHARACTERISTIC ZDrive_BSW_Cal_Cal.ZDrive_BSW_Cal_VehicleInfomationTable.Vehicle_Information_Reserved_Line308 "" VALUE 0x3d84a8 Record_ULONG 0 autosar_swc_rlgs_CM_uint32 0 4294967295 /end CHARACTERISTIC
/begin CHARACTERISTIC ZDrive_BSW_Cal_Cal.ZDrive_BSW_Cal_VehicleInfomationTable.Vehicle_Information_Reserved_Line309 "" VALUE 0x3d84ac Record_ULONG 0 autosar_swc_rlgs_CM_uint32 0 4294967295 /end CHARACTERISTIC
/begin CHARACTERISTIC ZDrive_BSW_Cal_Cal.ZDrive_BSW_Cal_VehicleInfomationTable.Vehicle_Information_Reserved_Line31 "" VALUE 0x3d8083 Record_UBYTE 0 autosar_swc_rlgs_CM_uint8 0 255 /end CHARACTERISTIC
/begin CHARACTERISTIC ZDrive_BSW_Cal_Cal.ZDrive_BSW_Cal_VehicleInfomationTable.Vehicle_Information_Reserved_Line310 "" VALUE 0x3d84b0 Record_ULONG 0 autosar_swc_rlgs_CM_uint32 0 4294967295 /end CHARACTERISTIC
/begin CHARACTERISTIC ZDrive_BSW_Cal_Cal.ZDrive_BSW_Cal_VehicleInfomationTable.Vehicle_Information_Reserved_Line311 "" VALUE 0x3d84b4 Record_ULONG 0 autosar_swc_rlgs_CM_uint32 0 4294967295 /end CHARACTERISTIC
/begin CHARACTERISTIC ZDrive_BSW_Cal_Cal.ZDrive_BSW_Cal_VehicleInfomationTable.Vehicle_Information_Reserved_Line312 "" VALUE 0x3d84b8 Record_ULONG 0 autosar_swc_rlgs_CM_uint32 0 4294967295 /end CHARACTERISTIC
/begin CHARACTERISTIC ZDrive_BSW_Cal_Cal.ZDrive_BSW_Cal_VehicleInfomationTable.Vehicle_Information_Reserved_Line313 "" VALUE 0x3d84bc Record_ULONG 0 autosar_swc_rlgs_CM_uint32 0 4294967295 /end CHARACTERISTIC
/begin CHARACTERISTIC ZDrive_BSW_Cal_Cal.ZDrive_BSW_Cal_VehicleInfomationTable.Vehicle_Information_Reserved_Line314 "" VALUE 0x3d84c0 Record_ULONG 0 autosar_swc_rlgs_CM_uint32 0 4294967295 /end CHARACTERISTIC
/begin CHARACTERISTIC ZDrive_BSW_Cal_Cal.ZDrive_BSW_Cal_VehicleInfomationTable.Vehicle_Information_Reserved_Line315 "" VALUE 0x3d84c4 Record_ULONG 0 autosar_swc_rlgs_CM_uint32 0 4294967295 /end CHARACTERISTIC
/begin CHARACTERISTIC ZDrive_BSW_Cal_Cal.ZDrive_BSW_Cal_VehicleInfomationTable.Vehicle_Information_Reserved_Line316 "" VALUE 0x3d84c8 Record_ULONG 0 autosar_swc_rlgs_CM_uint32 0 4294967295 /end CHARACTERISTIC
/begin CHARACTERISTIC ZDrive_BSW_Cal_Cal.ZDrive_BSW_Cal_VehicleInfomationTable.Vehicle_Information_Reserved_Line317 "" VALUE 0x3d84cc Record_ULONG 0 autosar_swc_rlgs_CM_uint32 0 4294967295 /end CHARACTERISTIC
/begin CHARACTERISTIC ZDrive_BSW_Cal_Cal.ZDrive_BSW_Cal_VehicleInfomationTable.Vehicle_Information_Reserved_Line318 "" VALUE 0x3d84d0 Record_ULONG 0 autosar_swc_rlgs_CM_uint32 0 4294967295 /end CHARACTERISTIC
/begin CHARACTERISTIC ZDrive_BSW_Cal_Cal.ZDrive_BSW_Cal_VehicleInfomationTable.Vehicle_Information_Reserved_Line319 "" VALUE 0x3d84d4 Record_ULONG 0 autosar_swc_rlgs_CM_uint32 0 4294967295 /end CHARACTERISTIC
/begin CHARACTERISTIC ZDrive_BSW_Cal_Cal.ZDrive_BSW_Cal_VehicleInfomationTable.Vehicle_Information_Reserved_Line32 "" VALUE 0x3d8084 Record_UWORD 0 autosar_swc_rlgs_CM_uint16 0 65535 /end CHARACTERISTIC
/begin CHARACTERISTIC ZDrive_BSW_Cal_Cal.ZDrive_BSW_Cal_VehicleInfomationTable.Vehicle_Information_Reserved_Line320 "" VALUE 0x3d84d8 Record_ULONG 0 autosar_swc_rlgs_CM_uint32 0 4294967295 /end CHARACTERISTIC
/begin CHARACTERISTIC ZDrive_BSW_Cal_Cal.ZDrive_BSW_Cal_VehicleInfomationTable.Vehicle_Information_Reserved_Line321 "" VALUE 0x3d84dc Record_ULONG 0 autosar_swc_rlgs_CM_uint32 0 4294967295 /end CHARACTERISTIC
/begin CHARACTERISTIC ZDrive_BSW_Cal_Cal.ZDrive_BSW_Cal_VehicleInfomationTable.Vehicle_Information_Reserved_Line322 "" VALUE 0x3d84e0 Record_ULONG 0 autosar_swc_rlgs_CM_uint32 0 4294967295 /end CHARACTERISTIC
/begin CHARACTERISTIC ZDrive_BSW_Cal_Cal.ZDrive_BSW_Cal_VehicleInfomationTable.Vehicle_Information_Reserved_Line323 "" VALUE 0x3d84e4 Record_ULONG 0 autosar_swc_rlgs_CM_uint32 0 4294967295 /end CHARACTERISTIC
/begin CHARACTERISTIC ZDrive_BSW_Cal_Cal.ZDrive_BSW_Cal_VehicleInfomationTable.Vehicle_Information_Reserved_Line324 "" VALUE 0x3d84e8 Record_ULONG 0 autosar_swc_rlgs_CM_uint32 0 4294967295 /end CHARACTERISTIC
/begin CHARACTERISTIC ZDrive_BSW_Cal_Cal.ZDrive_BSW_Cal_VehicleInfomationTable.Vehicle_Information_Reserved_Line325 "" VALUE 0x3d84ec Record_ULONG 0 autosar_swc_rlgs_CM_uint32 0 4294967295 /end CHARACTERISTIC
/begin CHARACTERISTIC ZDrive_BSW_Cal_Cal.ZDrive_BSW_Cal_VehicleInfomationTable.Vehicle_Information_Reserved_Line326 "" VALUE 0x3d84f0 Record_ULONG 0 autosar_swc_rlgs_CM_uint32 0 4294967295 /end CHARACTERISTIC
/begin CHARACTERISTIC ZDrive_BSW_Cal_Cal.ZDrive_BSW_Cal_VehicleInfomationTable.Vehicle_Information_Reserved_Line327 "" VALUE 0x3d84f4 Record_ULONG 0 autosar_swc_rlgs_CM_uint32 0 4294967295 /end CHARACTERISTIC
/begin CHARACTERISTIC ZDrive_BSW_Cal_Cal.ZDrive_BSW_Cal_VehicleInfomationTable.Vehicle_Information_Reserved_Line328 "" VALUE 0x3d84f8 Record_ULONG 0 autosar_swc_rlgs_CM_uint32 0 4294967295 /end CHARACTERISTIC
/begin CHARACTERISTIC ZDrive_BSW_Cal_Cal.ZDrive_BSW_Cal_VehicleInfomationTable.Vehicle_Information_Reserved_Line329 "" VALUE 0x3d84fc Record_ULONG 0 autosar_swc_rlgs_CM_uint32 0 4294967295 /end CHARACTERISTIC
/begin CHARACTERISTIC ZDrive_BSW_Cal_Cal.ZDrive_BSW_Cal_VehicleInfomationTable.Vehicle_Information_Reserved_Line33 "" VALUE 0x3d8086 Record_UWORD 0 autosar_swc_rlgs_CM_uint16 0 65535 /end CHARACTERISTIC
/begin CHARACTERISTIC ZDrive_BSW_Cal_Cal.ZDrive_BSW_Cal_VehicleInfomationTable.Vehicle_Information_Reserved_Line330 "" VALUE 0x3d8500 Record_ULONG 0 autosar_swc_rlgs_CM_uint32 0 4294967295 /end CHARACTERISTIC
/begin CHARACTERISTIC ZDrive_BSW_Cal_Cal.ZDrive_BSW_Cal_VehicleInfomationTable.Vehicle_Information_Reserved_Line331 "" VALUE 0x3d8504 Record_ULONG 0 autosar_swc_rlgs_CM_uint32 0 4294967295 /end CHARACTERISTIC
/begin CHARACTERISTIC ZDrive_BSW_Cal_Cal.ZDrive_BSW_Cal_VehicleInfomationTable.Vehicle_Information_Reserved_Line332 "" VALUE 0x3d8508 Record_ULONG 0 autosar_swc_rlgs_CM_uint32 0 4294967295 /end CHARACTERISTIC
/begin CHARACTERISTIC ZDrive_BSW_Cal_Cal.ZDrive_BSW_Cal_VehicleInfomationTable.Vehicle_Information_Reserved_Line333 "" VALUE 0x3d850c Record_ULONG 0 autosar_swc_rlgs_CM_uint32 0 4294967295 /end CHARACTERISTIC
/begin CHARACTERISTIC ZDrive_BSW_Cal_Cal.ZDrive_BSW_Cal_VehicleInfomationTable.Vehicle_Information_Reserved_Line334 "" VALUE 0x3d8510 Record_ULONG 0 autosar_swc_rlgs_CM_uint32 0 4294967295 /end CHARACTERISTIC
/begin CHARACTERISTIC ZDrive_BSW_Cal_Cal.ZDrive_BSW_Cal_VehicleInfomationTable.Vehicle_Information_Reserved_Line335 "" VALUE 0x3d8514 Record_ULONG 0 autosar_swc_rlgs_CM_uint32 0 4294967295 /end CHARACTERISTIC
/begin CHARACTERISTIC ZDrive_BSW_Cal_Cal.ZDrive_BSW_Cal_VehicleInfomationTable.Vehicle_Information_Reserved_Line336 "" VALUE 0x3d8518 Record_ULONG 0 autosar_swc_rlgs_CM_uint32 0 4294967295 /end CHARACTERISTIC
/begin CHARACTERISTIC ZDrive_BSW_Cal_Cal.ZDrive_BSW_Cal_VehicleInfomationTable.Vehicle_Information_Reserved_Line337 "" VALUE 0x3d851c Record_ULONG 0 autosar_swc_rlgs_CM_uint32 0 4294967295 /end CHARACTERISTIC
/begin CHARACTERISTIC ZDrive_BSW_Cal_Cal.ZDrive_BSW_Cal_VehicleInfomationTable.Vehicle_Information_Reserved_Line338 "" VALUE 0x3d8520 Record_ULONG 0 autosar_swc_rlgs_CM_uint32 0 4294967295 /end CHARACTERISTIC
/begin CHARACTERISTIC ZDrive_BSW_Cal_Cal.ZDrive_BSW_Cal_VehicleInfomationTable.Vehicle_Information_Reserved_Line339 "" VALUE 0x3d8524 Record_ULONG 0 autosar_swc_rlgs_CM_uint32 0 4294967295 /end CHARACTERISTIC
/begin CHARACTERISTIC ZDrive_BSW_Cal_Cal.ZDrive_BSW_Cal_VehicleInfomationTable.Vehicle_Information_Reserved_Line34 "" VALUE 0x3d8088 Record_UWORD 0 autosar_swc_rlgs_CM_uint16 0 65535 /end CHARACTERISTIC
/begin CHARACTERISTIC ZDrive_BSW_Cal_Cal.ZDrive_BSW_Cal_VehicleInfomationTable.Vehicle_Information_Reserved_Line340 "" VALUE 0x3d8528 Record_ULONG 0 autosar_swc_rlgs_CM_uint32 0 4294967295 /end CHARACTERISTIC
/begin CHARACTERISTIC ZDrive_BSW_Cal_Cal.ZDrive_BSW_Cal_VehicleInfomationTable.Vehicle_Information_Reserved_Line341 "" VALUE 0x3d852c Record_ULONG 0 autosar_swc_rlgs_CM_uint32 0 4294967295 /end CHARACTERISTIC
/begin CHARACTERISTIC ZDrive_BSW_Cal_Cal.ZDrive_BSW_Cal_VehicleInfomationTable.Vehicle_Information_Reserved_Line342 "" VALUE 0x3d8530 Record_ULONG 0 autosar_swc_rlgs_CM_uint32 0 4294967295 /end CHARACTERISTIC
/begin CHARACTERISTIC ZDrive_BSW_Cal_Cal.ZDrive_BSW_Cal_VehicleInfomationTable.Vehicle_Information_Reserved_Line343 "" VALUE 0x3d8534 Record_ULONG 0 autosar_swc_rlgs_CM_uint32 0 4294967295 /end CHARACTERISTIC
/begin CHARACTERISTIC ZDrive_BSW_Cal_Cal.ZDrive_BSW_Cal_VehicleInfomationTable.Vehicle_Information_Reserved_Line344 "" VALUE 0x3d8538 Record_ULONG 0 autosar_swc_rlgs_CM_uint32 0 4294967295 /end CHARACTERISTIC
/begin CHARACTERISTIC ZDrive_BSW_Cal_Cal.ZDrive_BSW_Cal_VehicleInfomationTable.Vehicle_Information_Reserved_Line345 "" VALUE 0x3d853c Record_ULONG 0 autosar_swc_rlgs_CM_uint32 0 4294967295 /end CHARACTERISTIC
/begin CHARACTERISTIC ZDrive_BSW_Cal_Cal.ZDrive_BSW_Cal_VehicleInfomationTable.Vehicle_Information_Reserved_Line346 "" VALUE 0x3d8540 Record_ULONG 0 autosar_swc_rlgs_CM_uint32 0 4294967295 /end CHARACTERISTIC
/begin CHARACTERISTIC ZDrive_BSW_Cal_Cal.ZDrive_BSW_Cal_VehicleInfomationTable.Vehicle_Information_Reserved_Line347 "" VALUE 0x3d8544 Record_ULONG 0 autosar_swc_rlgs_CM_uint32 0 4294967295 /end CHARACTERISTIC
/begin CHARACTERISTIC ZDrive_BSW_Cal_Cal.ZDrive_BSW_Cal_VehicleInfomationTable.Vehicle_Information_Reserved_Line348 "" VALUE 0x3d8548 Record_ULONG 0 autosar_swc_rlgs_CM_uint32 0 4294967295 /end CHARACTERISTIC
/begin CHARACTERISTIC ZDrive_BSW_Cal_Cal.ZDrive_BSW_Cal_VehicleInfomationTable.Vehicle_Information_Reserved_Line349 "" VALUE 0x3d854c Record_ULONG 0 autosar_swc_rlgs_CM_uint32 0 4294967295 /end CHARACTERISTIC
/begin CHARACTERISTIC ZDrive_BSW_Cal_Cal.ZDrive_BSW_Cal_VehicleInfomationTable.Vehicle_Information_Reserved_Line35 "" VALUE 0x3d808a Record_UWORD 0 autosar_swc_rlgs_CM_uint16 0 65535 /end CHARACTERISTIC
/begin CHARACTERISTIC ZDrive_BSW_Cal_Cal.ZDrive_BSW_Cal_VehicleInfomationTable.Vehicle_Information_Reserved_Line350 "" VALUE 0x3d8550 Record_ULONG 0 autosar_swc_rlgs_CM_uint32 0 4294967295 /end CHARACTERISTIC
/begin CHARACTERISTIC ZDrive_BSW_Cal_Cal.ZDrive_BSW_Cal_VehicleInfomationTable.Vehicle_Information_Reserved_Line351 "" VALUE 0x3d8554 Record_ULONG 0 autosar_swc_rlgs_CM_uint32 0 4294967295 /end CHARACTERISTIC
/begin CHARACTERISTIC ZDrive_BSW_Cal_Cal.ZDrive_BSW_Cal_VehicleInfomationTable.Vehicle_Information_Reserved_Line352 "" VALUE 0x3d8558 Record_ULONG 0 autosar_swc_rlgs_CM_uint32 0 4294967295 /end CHARACTERISTIC
/begin CHARACTERISTIC ZDrive_BSW_Cal_Cal.ZDrive_BSW_Cal_VehicleInfomationTable.Vehicle_Information_Reserved_Line353 "" VALUE 0x3d855c Record_UWORD 0 autosar_swc_rlgs_CM_uint16 0 65535 /end CHARACTERISTIC
/begin CHARACTERISTIC ZDrive_BSW_Cal_Cal.ZDrive_BSW_Cal_VehicleInfomationTable.Vehicle_Information_Reserved_Line354 "" VALUE 0x3d855e Record_UBYTE 0 autosar_swc_rlgs_CM_uint8 0 255 /end CHARACTERISTIC
/begin CHARACTERISTIC ZDrive_BSW_Cal_Cal.ZDrive_BSW_Cal_VehicleInfomationTable.Vehicle_Information_Reserved_Line36 "" VALUE 0x3d808c Record_UWORD 0 autosar_swc_rlgs_CM_uint16 0 65535 /end CHARACTERISTIC
/begin CHARACTERISTIC ZDrive_BSW_Cal_Cal.ZDrive_BSW_Cal_VehicleInfomationTable.Vehicle_Information_Reserved_Line37 "" VALUE 0x3d808e Record_UWORD 0 autosar_swc_rlgs_CM_uint16 0 65535 /end CHARACTERISTIC
/begin CHARACTERISTIC ZDrive_BSW_Cal_Cal.ZDrive_BSW_Cal_VehicleInfomationTable.Vehicle_Information_Reserved_Line81 "" VALUE 0x3d8134 Record_UWORD 0 autosar_swc_rlgs_CM_uint16 0 65535 /end CHARACTERISTIC
/begin CHARACTERISTIC ZDrive_BSW_Cal_Cal.ZDrive_BSW_Cal_VehicleInfomationTable.Vehicle_Information_Reserved_Line82 "" VALUE 0x3d8136 Record_UWORD 0 autosar_swc_rlgs_CM_uint16 0 65535 /end CHARACTERISTIC
/begin CHARACTERISTIC ZDrive_BSW_Cal_Cal.ZDrive_BSW_Cal_VehicleInfomationTable.Vehicle_Length_m "" VALUE 0x3d8090 Record_FLOAT32_IEEE 0 autosar_swc_rlgs_CM_single -3.4E+38 3.4E+38 /end CHARACTERISTIC
/begin CHARACTERISTIC ZDrive_BSW_Cal_Cal.ZDrive_BSW_Cal_VehicleInfomationTable.Vehicle_Model "" VALUE 0x3d8069 Record_UBYTE 0 autosar_swc_rlgs_CM_uint8 0 255 /end CHARACTERISTIC
/begin CHARACTERISTIC ZDrive_BSW_Cal_Cal.ZDrive_BSW_Cal_VehicleInfomationTable.Weight_N "" VALUE 0x3d8110 Record_FLOAT32_IEEE 0 autosar_swc_rlgs_CM_single -3.4E+38 3.4E+38 /end CHARACTERISTIC
/begin CHARACTERISTIC ZDrive_BSW_Cal_Cal.ZDrive_BSW_Cal_VehicleInfomationTable.WheelBase_m "" VALUE 0x3d80a4 Record_FLOAT32_IEEE 0 autosar_swc_rlgs_CM_single -3.4E+38 3.4E+38 /end CHARACTERISTIC
/begin CHARACTERISTIC ZDrive_BSW_Cal_Cal.ZDrive_BSW_Cal_VehicleInfomationTable.WheelDiameter "" VALUE 0x3d8124 Record_FLOAT32_IEEE 0 autosar_swc_rlgs_CM_single -3.4E+38 3.4E+38 /end CHARACTERISTIC
/begin CHARACTERISTIC ZDrive_BSW_Cal_Cal.ZDrive_BSW_Cal_VehicleInfomationTable.WheelSpeedCounterIsUnsigned "" VALUE 0x3d8130 Record_UWORD 0 autosar_swc_rlgs_CM_uint16 0 65535 /end CHARACTERISTIC
/begin CHARACTERISTIC ZDrive_BSW_Cal_Cal.ZDrive_BSW_Cal_VehicleInfomationTable.WheelSpeedCounterMax "" VALUE 0x3d812c Record_UWORD 0 autosar_swc_rlgs_CM_uint16 0 65535 /end CHARACTERISTIC
/begin CHARACTERISTIC ZDrive_BSW_Cal_Cal.ZDrive_BSW_Cal_VehicleInfomationTable.WheelSpeedCounterMin "" VALUE 0x3d8132 Record_UWORD 0 autosar_swc_rlgs_CM_uint16 0 65535 /end CHARACTERISTIC
/begin CHARACTERISTIC ZDrive_BSW_Cal_Cal.ZDrive_BSW_Cal_VehicleInfomationTable.WheelSpeedCounterPulse "" VALUE 0x3d812e Record_UWORD 0 autosar_swc_rlgs_CM_uint16 0 65535 /end CHARACTERISTIC
/begin CHARACTERISTIC ZDrive_BSW_Cal_Cal.ZDrive_BSW_Cal_VehicleInfomationTable.WheelTrack_m "" VALUE 0x3d80ac Record_FLOAT32_IEEE 0 autosar_swc_rlgs_CM_single -3.4E+38 3.4E+38 /end CHARACTERISTIC
/begin CHARACTERISTIC ZDrive_BSW_Cal_Cal.ZDrive_BSW_Cal_VehicleInfomationTable.WhlSpdSensUnitPulseDist "" VALUE 0x3d8128 Record_FLOAT32_IEEE 0 autosar_swc_rlgs_CM_single -3.4E+38 3.4E+38 /end CHARACTERISTIC
/begin CHARACTERISTIC ZDrive_BSW_Cal_Cal.ZDrive_BSW_Cal_VehicleInfomationTable.YawAngOfCAD "" VALUE 0x3d81b0 Record_FLOAT32_IEEE 0 autosar_swc_rlgs_CM_single -3.4E+38 3.4E+38 /end CHARACTERISTIC
/begin CHARACTERISTIC ZDrive_BSW_Cal_Cal.ZDrive_BSW_Cal_VehicleInfomationTable.camera_x_m "" VALUE 0x3d8194 Record_FLOAT32_IEEE 0 autosar_swc_rlgs_CM_single -3.4E+38 3.4E+38 /end CHARACTERISTIC
/begin CHARACTERISTIC ZDrive_BSW_Cal_Cal.ZDrive_BSW_Cal_VehicleInfomationTable.camera_y_m "" VALUE 0x3d8198 Record_FLOAT32_IEEE 0 autosar_swc_rlgs_CM_single -3.4E+38 3.4E+38 /end CHARACTERISTIC
/begin CHARACTERISTIC ZDrive_BSW_Cal_Cal.ZDrive_BSW_Cal_VehicleInfomationTable.camera_z_m "" VALUE 0x3d819c Record_FLOAT32_IEEE 0 autosar_swc_rlgs_CM_single -3.4E+38 3.4E+38 /end CHARACTERISTIC
/begin CHARACTERISTIC ZDrive_BSW_Cal_Cal.ZDrive_BSW_Cal_VehicleInfomationTable.translation_x_m "" VALUE 0x3d81a0 Record_FLOAT32_IEEE 0 autosar_swc_rlgs_CM_single -3.4E+38 3.4E+38 /end CHARACTERISTIC
/begin MEASUREMENT SwcOut_RLGS_EVM_PILOT_SCEN.scenario_vec[1].behavior_lane "" UBYTE autosar_swc_rlgs_CM_uint8 0 0 0 255 ECU_ADDRESS 0xfe4aeae3 /* @ECU_Address@SwcOut_RLGS_EVM_PILOT_SCEN.scenario_vec[1].behavior_lane@ */ /end MEASUREMENT
/begin MEASUREMENT SwcOut_RLGS_EVM_PILOT_SCEN.scenario_vec[1].behavior_road "" UBYTE autosar_swc_rlgs_CM_uint8 0 0 0 255 ECU_ADDRESS 0xfe4aeae2 /* @ECU_Address@SwcOut_RLGS_EVM_PILOT_SCEN.scenario_vec[1].behavior_road@ */ /end MEASUREMENT
/begin MEASUREMENT SwcOut_RLGS_EVM_PILOT_SCEN.scenario_vec[1].exec_start_dist "" FLOAT32_IEEE autosar_swc_rlgs_CM_single 0 0 -3.4E+38 3.4E+38 ECU_ADDRESS 0xfe4aeae4 /* @ECU_Address@SwcOut_RLGS_EVM_PILOT_SCEN.scenario_vec[1].exec_start_dist@ */ /end MEASUREMENT
/begin MEASUREMENT SwcOut_RLGS_EVM_PILOT_SCEN.scenario_vec[1].main_road_type "" UBYTE autosar_swc_rlgs_CM_uint8 0 0 0 255 ECU_ADDRESS 0xfe4aeae0 /* @ECU_Address@SwcOut_RLGS_EVM_PILOT_SCEN.scenario_vec[1].main_road_type@ */ /end MEASUREMENT
/begin MEASUREMENT SwcOut_RLGS_EVM_PILOT_SCEN.scenario_vec[1].sub_road_type "" UBYTE autosar_swc_rlgs_CM_uint8 0 0 0 255 ECU_ADDRESS 0xfe4aeae1 /* @ECU_Address@SwcOut_RLGS_EVM_PILOT_SCEN.scenario_vec[1].sub_road_type@ */ /end MEASUREMENT
/begin MEASUREMENT SwcOut_RLGS_EVM_PILOT_SCEN.scenario_vec[2].behavior_lane "" UBYTE autosar_swc_rlgs_CM_uint8 0 0 0 255 ECU_ADDRESS 0xfe4aeaeb /* @ECU_Address@SwcOut_RLGS_EVM_PILOT_SCEN.scenario_vec[2].behavior_lane@ */ /end MEASUREMENT
/begin MEASUREMENT SwcOut_RLGS_EVM_PILOT_SCEN.scenario_vec[2].behavior_road "" UBYTE autosar_swc_rlgs_CM_uint8 0 0 0 255 ECU_ADDRESS 0xfe4aeaea /* @ECU_Address@SwcOut_RLGS_EVM_PILOT_SCEN.scenario_vec[2].behavior_road@ */ /end MEASUREMENT
/begin MEASUREMENT SwcOut_RLGS_EVM_PILOT_SCEN.scenario_vec[2].exec_start_dist "" FLOAT32_IEEE autosar_swc_rlgs_CM_single 0 0 -3.4E+38 3.4E+38 ECU_ADDRESS 0xfe4aeaec /* @ECU_Address@SwcOut_RLGS_EVM_PILOT_SCEN.scenario_vec[2].exec_start_dist@ */ /end MEASUREMENT
/begin MEASUREMENT SwcOut_RLGS_EVM_PILOT_SCEN.scenario_vec[2].main_road_type "" UBYTE autosar_swc_rlgs_CM_uint8 0 0 0 255 ECU_ADDRESS 0xfe4aeae8 /* @ECU_Address@SwcOut_RLGS_EVM_PILOT_SCEN.scenario_vec[2].main_road_type@ */ /end MEASUREMENT
/begin MEASUREMENT SwcOut_RLGS_EVM_PILOT_SCEN.scenario_vec[2].sub_road_type "" UBYTE autosar_swc_rlgs_CM_uint8 0 0 0 255 ECU_ADDRESS 0xfe4aeae9 /* @ECU_Address@SwcOut_RLGS_EVM_PILOT_SCEN.scenario_vec[2].sub_road_type@ */ /end MEASUREMENT
/begin MEASUREMENT autosar_swc_rlgs_rtARID_DEF.ARID_DEF_Chart1.Cnt "" UBYTE autosar_swc_rlgs_CM_uint8 0 0 0 255 ECU_ADDRESS 0xfe4aeaf3 /* @ECU_Address@autosar_swc_rlgs_rtARID_DEF.ARID_DEF_Chart1.Cnt@ */ /end MEASUREMENT
/begin MEASUREMENT autosar_swc_rlgs_rtARID_DEF.ARID_DEF_Chart1.is_active_c1085_autosar_swc_rlgs "" UBYTE autosar_swc_rlgs_CM_uint8 0 0 0 255 ECU_ADDRESS 0xfe4aeaf4 /* @ECU_Address@autosar_swc_rlgs_rtARID_DEF.ARID_DEF_Chart1.is_active_c1085_autosar_swc_rlgs@ */ /end MEASUREMENT
/begin MEASUREMENT autosar_swc_rlgs_rtARID_DEF.ARID_DEF_Chart1.is_c1085_autosar_swc_rlgs "" UBYTE autosar_swc_rlgs_CM_uint8 0 0 0 255 ECU_ADDRESS 0xfe4aeaf5 /* @ECU_Address@autosar_swc_rlgs_rtARID_DEF.ARID_DEF_Chart1.is_c1085_autosar_swc_rlgs@ */ /end MEASUREMENT
/begin MEASUREMENT autosar_swc_rlgs_rtARID_DEF.ARID_DEF_Chart2.cnt1 "" UBYTE autosar_swc_rlgs_CM_uint8 0 0 0 255 ECU_ADDRESS 0xfe4aeafa /* @ECU_Address@autosar_swc_rlgs_rtARID_DEF.ARID_DEF_Chart2.cnt1@ */ /end MEASUREMENT
/begin MEASUREMENT autosar_swc_rlgs_rtARID_DEF.ARID_DEF_Chart2.cnt2 "" UBYTE autosar_swc_rlgs_CM_uint8 0 0 0 255 ECU_ADDRESS 0xfe4aeafb /* @ECU_Address@autosar_swc_rlgs_rtARID_DEF.ARID_DEF_Chart2.cnt2@ */ /end MEASUREMENT
/begin MEASUREMENT autosar_swc_rlgs_rtARID_DEF.ARID_DEF_Chart2.is_active_c165_autosar_swc_rlgs "" UBYTE autosar_swc_rlgs_CM_uint8 0 0 0 255 ECU_ADDRESS 0xfe4aeafc /* @ECU_Address@autosar_swc_rlgs_rtARID_DEF.ARID_DEF_Chart2.is_active_c165_autosar_swc_rlgs@ */ /end MEASUREMENT
/begin MEASUREMENT autosar_swc_rlgs_rtARID_DEF.ARID_DEF_Chart2.is_c165_autosar_swc_rlgs "" UBYTE autosar_swc_rlgs_CM_uint8 0 0 0 255 ECU_ADDRESS 0xfe4aeafd /* @ECU_Address@autosar_swc_rlgs_rtARID_DEF.ARID_DEF_Chart2.is_c165_autosar_swc_rlgs@ */ /end MEASUREMENT
/begin MEASUREMENT autosar_swc_rlgs_rtARID_DEF.ARID_DEF_Chart2_c.Cnt "" UBYTE autosar_swc_rlgs_CM_uint8 0 0 0 255 ECU_ADDRESS 0xfe4aeb03 /* @ECU_Address@autosar_swc_rlgs_rtARID_DEF.ARID_DEF_Chart2_c.Cnt@ */ /end MEASUREMENT
/begin MEASUREMENT autosar_swc_rlgs_rtARID_DEF.ARID_DEF_Chart2_c.HoldCondEnable "" UBYTE autosar_swc_rlgs_CM_logical 0 0 0 1 ECU_ADDRESS 0xfe4aeb07 /* @ECU_Address@autosar_swc_rlgs_rtARID_DEF.ARID_DEF_Chart2_c.HoldCondEnable@ */ /end MEASUREMENT
/begin MEASUREMENT autosar_swc_rlgs_rtARID_DEF.ARID_DEF_Chart2_c.is_Lci "" UBYTE autosar_swc_rlgs_CM_uint8 0 0 0 255 ECU_ADDRESS 0xfe4aeb05 /* @ECU_Address@autosar_swc_rlgs_rtARID_DEF.ARID_DEF_Chart2_c.is_Lci@ */ /end MEASUREMENT
/begin MEASUREMENT autosar_swc_rlgs_rtARID_DEF.ARID_DEF_Chart2_c.is_PreConds "" UBYTE autosar_swc_rlgs_CM_uint8 0 0 0 255 ECU_ADDRESS 0xfe4aeb06 /* @ECU_Address@autosar_swc_rlgs_rtARID_DEF.ARID_DEF_Chart2_c.is_PreConds@ */ /end MEASUREMENT
/begin MEASUREMENT autosar_swc_rlgs_rtARID_DEF.ARID_DEF_Chart2_c.is_active_c1317_autosar_swc_rlgs "" UBYTE autosar_swc_rlgs_CM_uint8 0 0 0 255 ECU_ADDRESS 0xfe4aeb04 /* @ECU_Address@autosar_swc_rlgs_rtARID_DEF.ARID_DEF_Chart2_c.is_active_c1317_autosar_swc_rlgs@ */ /end MEASUREMENT
/begin MEASUREMENT autosar_swc_rlgs_rtARID_DEF.ARID_DEF_Chart3.Cnt "" UBYTE autosar_swc_rlgs_CM_uint8 0 0 0 255 ECU_ADDRESS 0xfe4aeaf0 /* @ECU_Address@autosar_swc_rlgs_rtARID_DEF.ARID_DEF_Chart3.Cnt@ */ /end MEASUREMENT
/begin MEASUREMENT autosar_swc_rlgs_rtARID_DEF.ARID_DEF_Chart3.is_active_c1085_autosar_swc_rlgs "" UBYTE autosar_swc_rlgs_CM_uint8 0 0 0 255 ECU_ADDRESS 0xfe4aeaf1 /* @ECU_Address@autosar_swc_rlgs_rtARID_DEF.ARID_DEF_Chart3.is_active_c1085_autosar_swc_rlgs@ */ /end MEASUREMENT
/begin MEASUREMENT autosar_swc_rlgs_rtARID_DEF.ARID_DEF_Chart3.is_c1085_autosar_swc_rlgs "" UBYTE autosar_swc_rlgs_CM_uint8 0 0 0 255 ECU_ADDRESS 0xfe4aeaf2 /* @ECU_Address@autosar_swc_rlgs_rtARID_DEF.ARID_DEF_Chart3.is_c1085_autosar_swc_rlgs@ */ /end MEASUREMENT
/begin MEASUREMENT autosar_swc_rlgs_rtARID_DEF.ARID_DEF_Chart3_m.cnt1 "" UBYTE autosar_swc_rlgs_CM_uint8 0 0 0 255 ECU_ADDRESS 0xfe4aeaf6 /* @ECU_Address@autosar_swc_rlgs_rtARID_DEF.ARID_DEF_Chart3_m.cnt1@ */ /end MEASUREMENT
/begin MEASUREMENT autosar_swc_rlgs_rtARID_DEF.ARID_DEF_Chart3_m.cnt2 "" UBYTE autosar_swc_rlgs_CM_uint8 0 0 0 255 ECU_ADDRESS 0xfe4aeaf7 /* @ECU_Address@autosar_swc_rlgs_rtARID_DEF.ARID_DEF_Chart3_m.cnt2@ */ /end MEASUREMENT
/begin MEASUREMENT autosar_swc_rlgs_rtARID_DEF.ARID_DEF_Chart3_m.is_active_c165_autosar_swc_rlgs "" UBYTE autosar_swc_rlgs_CM_uint8 0 0 0 255 ECU_ADDRESS 0xfe4aeaf8 /* @ECU_Address@autosar_swc_rlgs_rtARID_DEF.ARID_DEF_Chart3_m.is_active_c165_autosar_swc_rlgs@ */ /end MEASUREMENT
/begin MEASUREMENT autosar_swc_rlgs_rtARID_DEF.ARID_DEF_Chart3_m.is_c165_autosar_swc_rlgs "" UBYTE autosar_swc_rlgs_CM_uint8 0 0 0 255 ECU_ADDRESS 0xfe4aeaf9 /* @ECU_Address@autosar_swc_rlgs_rtARID_DEF.ARID_DEF_Chart3_m.is_c165_autosar_swc_rlgs@ */ /end MEASUREMENT
/begin MEASUREMENT autosar_swc_rlgs_rtARID_DEF.ARID_DEF_Chart4.Cnt "" UBYTE autosar_swc_rlgs_CM_uint8 0 0 0 255 ECU_ADDRESS 0xfe4aeafe /* @ECU_Address@autosar_swc_rlgs_rtARID_DEF.ARID_DEF_Chart4.Cnt@ */ /end MEASUREMENT
/begin MEASUREMENT autosar_swc_rlgs_rtARID_DEF.ARID_DEF_Chart4.HoldCondEnable "" UBYTE autosar_swc_rlgs_CM_logical 0 0 0 1 ECU_ADDRESS 0xfe4aeb02 /* @ECU_Address@autosar_swc_rlgs_rtARID_DEF.ARID_DEF_Chart4.HoldCondEnable@ */ /end MEASUREMENT
/begin MEASUREMENT autosar_swc_rlgs_rtARID_DEF.ARID_DEF_Chart4.is_Lci "" UBYTE autosar_swc_rlgs_CM_uint8 0 0 0 255 ECU_ADDRESS 0xfe4aeb00 /* @ECU_Address@autosar_swc_rlgs_rtARID_DEF.ARID_DEF_Chart4.is_Lci@ */ /end MEASUREMENT
/begin MEASUREMENT autosar_swc_rlgs_rtARID_DEF.ARID_DEF_Chart4.is_PreConds "" UBYTE autosar_swc_rlgs_CM_uint8 0 0 0 255 ECU_ADDRESS 0xfe4aeb01 /* @ECU_Address@autosar_swc_rlgs_rtARID_DEF.ARID_DEF_Chart4.is_PreConds@ */ /end MEASUREMENT
/begin MEASUREMENT autosar_swc_rlgs_rtARID_DEF.ARID_DEF_Chart4.is_active_c1317_autosar_swc_rlgs "" UBYTE autosar_swc_rlgs_CM_uint8 0 0 0 255 ECU_ADDRESS 0xfe4aeaff /* @ECU_Address@autosar_swc_rlgs_rtARID_DEF.ARID_DEF_Chart4.is_active_c1317_autosar_swc_rlgs@ */ /end MEASUREMENT
/begin MEASUREMENT autosar_swc_rlgs_rtARID_DEF.ARID_DEF_MATLABFunction.A0 "" FLOAT32_IEEE autosar_swc_rlgs_CM_single 0 0 -3.4E+38 3.4E+38 ECU_ADDRESS 0xfe4aebcc /* @ECU_Address@autosar_swc_rlgs_rtARID_DEF.ARID_DEF_MATLABFunction.A0@ */ /end MEASUREMENT
/begin MEASUREMENT autosar_swc_rlgs_rtARID_DEF.ARID_DEF_MATLABFunction.A0K1 "" FLOAT32_IEEE autosar_swc_rlgs_CM_single 0 0 -3.4E+38 3.4E+38 ECU_ADDRESS 0xfe4aebfc /* @ECU_Address@autosar_swc_rlgs_rtARID_DEF.ARID_DEF_MATLABFunction.A0K1@ */ /end MEASUREMENT
/begin MEASUREMENT autosar_swc_rlgs_rtARID_DEF.ARID_DEF_MATLABFunction.A1 "" FLOAT32_IEEE autosar_swc_rlgs_CM_single 0 0 -3.4E+38 3.4E+38 ECU_ADDRESS 0xfe4aebc8 /* @ECU_Address@autosar_swc_rlgs_rtARID_DEF.ARID_DEF_MATLABFunction.A1@ */ /end MEASUREMENT
/begin MEASUREMENT autosar_swc_rlgs_rtARID_DEF.ARID_DEF_MATLABFunction.A1K1 "" FLOAT32_IEEE autosar_swc_rlgs_CM_single 0 0 -3.4E+38 3.4E+38 ECU_ADDRESS 0xfe4aebf8 /* @ECU_Address@autosar_swc_rlgs_rtARID_DEF.ARID_DEF_MATLABFunction.A1K1@ */ /end MEASUREMENT
/begin MEASUREMENT autosar_swc_rlgs_rtARID_DEF.ARID_DEF_MATLABFunction.A2 "" FLOAT32_IEEE autosar_swc_rlgs_CM_single 0 0 -3.4E+38 3.4E+38 ECU_ADDRESS 0xfe4aebc4 /* @ECU_Address@autosar_swc_rlgs_rtARID_DEF.ARID_DEF_MATLABFunction.A2@ */ /end MEASUREMENT
/begin MEASUREMENT autosar_swc_rlgs_rtARID_DEF.ARID_DEF_MATLABFunction.A2K1 "" FLOAT32_IEEE autosar_swc_rlgs_CM_single 0 0 -3.4E+38 3.4E+38 ECU_ADDRESS 0xfe4aebf4 /* @ECU_Address@autosar_swc_rlgs_rtARID_DEF.ARID_DEF_MATLABFunction.A2K1@ */ /end MEASUREMENT
/begin MEASUREMENT autosar_swc_rlgs_rtARID_DEF.ARID_DEF_MATLABFunction.A3 "" FLOAT32_IEEE autosar_swc_rlgs_CM_single 0 0 -3.4E+38 3.4E+38 ECU_ADDRESS 0xfe4aebc0 /* @ECU_Address@autosar_swc_rlgs_rtARID_DEF.ARID_DEF_MATLABFunction.A3@ */ /end MEASUREMENT
/begin MEASUREMENT autosar_swc_rlgs_rtARID_DEF.ARID_DEF_MATLABFunction.A3K1 "" FLOAT32_IEEE autosar_swc_rlgs_CM_single 0 0 -3.4E+38 3.4E+38 ECU_ADDRESS 0xfe4aebf0 /* @ECU_Address@autosar_swc_rlgs_rtARID_DEF.ARID_DEF_MATLABFunction.A3K1@ */ /end MEASUREMENT
/begin MEASUREMENT autosar_swc_rlgs_rtARID_DEF.ARID_DEF_MATLABFunction.Crossing "" UBYTE autosar_swc_rlgs_CM_uint8 0 0 0 255 ECU_ADDRESS 0xfe4aec12 /* @ECU_Address@autosar_swc_rlgs_rtARID_DEF.ARID_DEF_MATLABFunction.Crossing@ */ /end MEASUREMENT
/begin MEASUREMENT autosar_swc_rlgs_rtARID_DEF.ARID_DEF_MATLABFunction.LaneExtraFarPointPosX "" FLOAT32_IEEE autosar_swc_rlgs_CM_single 0 0 -3.4E+38 3.4E+38 ECU_ADDRESS 0xfe4aebdc /* @ECU_Address@autosar_swc_rlgs_rtARID_DEF.ARID_DEF_MATLABFunction.LaneExtraFarPointPosX@ */ /end MEASUREMENT
/begin MEASUREMENT autosar_swc_rlgs_rtARID_DEF.ARID_DEF_MATLABFunction.LaneExtraFarPointPosY "" FLOAT32_IEEE autosar_swc_rlgs_CM_single 0 0 -3.4E+38 3.4E+38 ECU_ADDRESS 0xfe4aebe0 /* @ECU_Address@autosar_swc_rlgs_rtARID_DEF.ARID_DEF_MATLABFunction.LaneExtraFarPointPosY@ */ /end MEASUREMENT
/begin MEASUREMENT autosar_swc_rlgs_rtARID_DEF.ARID_DEF_MATLABFunction.LaneExtraFarPointType "" UBYTE autosar_swc_rlgs_CM_uint8 0 0 0 255 ECU_ADDRESS 0xfe4aec15 /* @ECU_Address@autosar_swc_rlgs_rtARID_DEF.ARID_DEF_MATLABFunction.LaneExtraFarPointType@ */ /end MEASUREMENT
/begin MEASUREMENT autosar_swc_rlgs_rtARID_DEF.ARID_DEF_MATLABFunction.LaneExtraNearPointPosX "" FLOAT32_IEEE autosar_swc_rlgs_CM_single 0 0 -3.4E+38 3.4E+38 ECU_ADDRESS 0xfe4aebe4 /* @ECU_Address@autosar_swc_rlgs_rtARID_DEF.ARID_DEF_MATLABFunction.LaneExtraNearPointPosX@ */ /end MEASUREMENT
/begin MEASUREMENT autosar_swc_rlgs_rtARID_DEF.ARID_DEF_MATLABFunction.LaneExtraNearPointPosY "" FLOAT32_IEEE autosar_swc_rlgs_CM_single 0 0 -3.4E+38 3.4E+38 ECU_ADDRESS 0xfe4aebe8 /* @ECU_Address@autosar_swc_rlgs_rtARID_DEF.ARID_DEF_MATLABFunction.LaneExtraNearPointPosY@ */ /end MEASUREMENT
/begin MEASUREMENT autosar_swc_rlgs_rtARID_DEF.ARID_DEF_MATLABFunction.LaneExtraNearPointType "" UBYTE autosar_swc_rlgs_CM_uint8 0 0 0 255 ECU_ADDRESS 0xfe4aec14 /* @ECU_Address@autosar_swc_rlgs_rtARID_DEF.ARID_DEF_MATLABFunction.LaneExtraNearPointType@ */ /end MEASUREMENT
/begin MEASUREMENT autosar_swc_rlgs_rtARID_DEF.ARID_DEF_MATLABFunction.LaneParsingConfidence "" UBYTE autosar_swc_rlgs_CM_uint8 0 0 0 255 ECU_ADDRESS 0xfe4aec16 /* @ECU_Address@autosar_swc_rlgs_rtARID_DEF.ARID_DEF_MATLABFunction.LaneParsingConfidence@ */ /end MEASUREMENT
/begin MEASUREMENT autosar_swc_rlgs_rtARID_DEF.ARID_DEF_MATLABFunction.LaneWidth "" FLOAT32_IEEE autosar_swc_rlgs_CM_single 0 0 -3.4E+38 3.4E+38 ECU_ADDRESS 0xfe4aebd8 /* @ECU_Address@autosar_swc_rlgs_rtARID_DEF.ARID_DEF_MATLABFunction.LaneWidth@ */ /end MEASUREMENT
/begin MEASUREMENT autosar_swc_rlgs_rtARID_DEF.ARID_DEF_MATLABFunction.LineConf "" UBYTE autosar_swc_rlgs_CM_uint8 0 0 0 255 ECU_ADDRESS 0xfe4aec0f /* @ECU_Address@autosar_swc_rlgs_rtARID_DEF.ARID_DEF_MATLABFunction.LineConf@ */ /end MEASUREMENT
/begin MEASUREMENT autosar_swc_rlgs_rtARID_DEF.ARID_DEF_MATLABFunction.LineConfK1 "" UBYTE autosar_swc_rlgs_CM_uint8 0 0 0 255 ECU_ADDRESS 0xfe4aec18 /* @ECU_Address@autosar_swc_rlgs_rtARID_DEF.ARID_DEF_MATLABFunction.LineConfK1@ */ /end MEASUREMENT
/begin MEASUREMENT autosar_swc_rlgs_rtARID_DEF.ARID_DEF_MATLABFunction.LineReliable "" FLOAT32_IEEE autosar_swc_rlgs_CM_single 0 0 -3.4E+38 3.4E+38 ECU_ADDRESS 0xfe4aebbc /* @ECU_Address@autosar_swc_rlgs_rtARID_DEF.ARID_DEF_MATLABFunction.LineReliable@ */ /end MEASUREMENT
/begin MEASUREMENT autosar_swc_rlgs_rtARID_DEF.ARID_DEF_MATLABFunction.LineReliableK1 "" FLOAT32_IEEE autosar_swc_rlgs_CM_single 0 0 -3.4E+38 3.4E+38 ECU_ADDRESS 0xfe4aebec /* @ECU_Address@autosar_swc_rlgs_rtARID_DEF.ARID_DEF_MATLABFunction.LineReliableK1@ */ /end MEASUREMENT
/begin MEASUREMENT autosar_swc_rlgs_rtARID_DEF.ARID_DEF_MATLABFunction.LineType "" UBYTE autosar_swc_rlgs_CM_uint8 0 0 0 255 ECU_ADDRESS 0xfe4aec10 /* @ECU_Address@autosar_swc_rlgs_rtARID_DEF.ARID_DEF_MATLABFunction.LineType@ */ /end MEASUREMENT
/begin MEASUREMENT autosar_swc_rlgs_rtARID_DEF.ARID_DEF_MATLABFunction.ObstacleFlag "" UBYTE autosar_swc_rlgs_CM_uint8 0 0 0 255 ECU_ADDRESS 0xfe4aec13 /* @ECU_Address@autosar_swc_rlgs_rtARID_DEF.ARID_DEF_MATLABFunction.ObstacleFlag@ */ /end MEASUREMENT
/begin MEASUREMENT autosar_swc_rlgs_rtARID_DEF.ARID_DEF_MATLABFunction.OperateState "" UBYTE autosar_swc_rlgs_CM_uint8 0 0 0 255 ECU_ADDRESS 0xfe4aec0e /* @ECU_Address@autosar_swc_rlgs_rtARID_DEF.ARID_DEF_MATLABFunction.OperateState@ */ /end MEASUREMENT
/begin MEASUREMENT autosar_swc_rlgs_rtARID_DEF.ARID_DEF_MATLABFunction.Range "" FLOAT32_IEEE autosar_swc_rlgs_CM_single 0 0 -3.4E+38 3.4E+38 ECU_ADDRESS 0xfe4aebd4 /* @ECU_Address@autosar_swc_rlgs_rtARID_DEF.ARID_DEF_MATLABFunction.Range@ */ /end MEASUREMENT
/begin MEASUREMENT autosar_swc_rlgs_rtARID_DEF.ARID_DEF_MATLABFunction.RangeK1 "" FLOAT32_IEEE autosar_swc_rlgs_CM_single 0 0 -3.4E+38 3.4E+38 ECU_ADDRESS 0xfe4aec04 /* @ECU_Address@autosar_swc_rlgs_rtARID_DEF.ARID_DEF_MATLABFunction.RangeK1@ */ /end MEASUREMENT
/begin MEASUREMENT autosar_swc_rlgs_rtARID_DEF.ARID_DEF_MATLABFunction.Start "" FLOAT32_IEEE autosar_swc_rlgs_CM_single 0 0 -3.4E+38 3.4E+38 ECU_ADDRESS 0xfe4aebd0 /* @ECU_Address@autosar_swc_rlgs_rtARID_DEF.ARID_DEF_MATLABFunction.Start@ */ /end MEASUREMENT
/begin MEASUREMENT autosar_swc_rlgs_rtARID_DEF.ARID_DEF_MATLABFunction.StartK1 "" FLOAT32_IEEE autosar_swc_rlgs_CM_single 0 0 -3.4E+38 3.4E+38 ECU_ADDRESS 0xfe4aec00 /* @ECU_Address@autosar_swc_rlgs_rtARID_DEF.ARID_DEF_MATLABFunction.StartK1@ */ /end MEASUREMENT
/begin MEASUREMENT autosar_swc_rlgs_rtARID_DEF.ARID_DEF_MATLABFunction.Stopline_Relevancy "" UBYTE autosar_swc_rlgs_CM_uint8 0 0 0 255 ECU_ADDRESS 0xfe4aec17 /* @ECU_Address@autosar_swc_rlgs_rtARID_DEF.ARID_DEF_MATLABFunction.Stopline_Relevancy@ */ /end MEASUREMENT
/begin MEASUREMENT autosar_swc_rlgs_rtARID_DEF.ARID_DEF_MATLABFunction.TrackID "" UWORD autosar_swc_rlgs_CM_uint16 0 0 0 65535 ECU_ADDRESS 0xfe4aec0c /* @ECU_Address@autosar_swc_rlgs_rtARID_DEF.ARID_DEF_MATLABFunction.TrackID@ */ /end MEASUREMENT
/begin MEASUREMENT autosar_swc_rlgs_rtARID_DEF.ARID_DEF_MATLABFunction.eColor "" UBYTE autosar_swc_rlgs_CM_uint8 0 0 0 255 ECU_ADDRESS 0xfe4aec11 /* @ECU_Address@autosar_swc_rlgs_rtARID_DEF.ARID_DEF_MATLABFunction.eColor@ */ /end MEASUREMENT
/begin MEASUREMENT autosar_swc_rlgs_rtARID_DEF.ARID_DEF_MATLABFunction.lineTypeK1 "" UBYTE autosar_swc_rlgs_CM_uint8 0 0 0 255 ECU_ADDRESS 0xfe4aec19 /* @ECU_Address@autosar_swc_rlgs_rtARID_DEF.ARID_DEF_MATLABFunction.lineTypeK1@ */ /end MEASUREMENT
/begin MEASUREMENT autosar_swc_rlgs_rtARID_DEF.ARID_DEF_MATLABFunction.tLostK1 "" FLOAT32_IEEE autosar_swc_rlgs_CM_single 0 0 -3.4E+38 3.4E+38 ECU_ADDRESS 0xfe4aec08 /* @ECU_Address@autosar_swc_rlgs_rtARID_DEF.ARID_DEF_MATLABFunction.tLostK1@ */ /end MEASUREMENT
/begin MEASUREMENT autosar_swc_rlgs_rtARID_DEF.ARID_DEF_MATLABFunction1.Line_Crossing "" UBYTE autosar_swc_rlgs_CM_uint8 0 0 0 255 ECU_ADDRESS 0xfe4aeb3d /* @ECU_Address@autosar_swc_rlgs_rtARID_DEF.ARID_DEF_MATLABFunction1.Line_Crossing@ */ /end MEASUREMENT
/begin MEASUREMENT autosar_swc_rlgs_rtARID_DEF.ARID_DEF_MATLABFunction1.Line_LaneExtraFarPointPosX "" FLOAT32_IEEE autosar_swc_rlgs_CM_single 0 0 -3.4E+38 3.4E+38 ECU_ADDRESS 0xfe4aeb28 /* @ECU_Address@autosar_swc_rlgs_rtARID_DEF.ARID_DEF_MATLABFunction1.Line_LaneExtraFarPointPosX@ */ /end MEASUREMENT
/begin MEASUREMENT autosar_swc_rlgs_rtARID_DEF.ARID_DEF_MATLABFunction1.Line_LaneExtraFarPointPosY "" FLOAT32_IEEE autosar_swc_rlgs_CM_single 0 0 -3.4E+38 3.4E+38 ECU_ADDRESS 0xfe4aeb2c /* @ECU_Address@autosar_swc_rlgs_rtARID_DEF.ARID_DEF_MATLABFunction1.Line_LaneExtraFarPointPosY@ */ /end MEASUREMENT
/begin MEASUREMENT autosar_swc_rlgs_rtARID_DEF.ARID_DEF_MATLABFunction1.Line_LaneExtraFarPointType "" UBYTE autosar_swc_rlgs_CM_uint8 0 0 0 255 ECU_ADDRESS 0xfe4aeb40 /* @ECU_Address@autosar_swc_rlgs_rtARID_DEF.ARID_DEF_MATLABFunction1.Line_LaneExtraFarPointType@ */ /end MEASUREMENT
/begin MEASUREMENT autosar_swc_rlgs_rtARID_DEF.ARID_DEF_MATLABFunction1.Line_LaneExtraNearPointPosX "" FLOAT32_IEEE autosar_swc_rlgs_CM_single 0 0 -3.4E+38 3.4E+38 ECU_ADDRESS 0xfe4aeb30 /* @ECU_Address@autosar_swc_rlgs_rtARID_DEF.ARID_DEF_MATLABFunction1.Line_LaneExtraNearPointPosX@ */ /end MEASUREMENT
/begin MEASUREMENT autosar_swc_rlgs_rtARID_DEF.ARID_DEF_MATLABFunction1.Line_LaneExtraNearPointPosY "" FLOAT32_IEEE autosar_swc_rlgs_CM_single 0 0 -3.4E+38 3.4E+38 ECU_ADDRESS 0xfe4aeb34 /* @ECU_Address@autosar_swc_rlgs_rtARID_DEF.ARID_DEF_MATLABFunction1.Line_LaneExtraNearPointPosY@ */ /end MEASUREMENT
/begin MEASUREMENT autosar_swc_rlgs_rtARID_DEF.ARID_DEF_MATLABFunction1.Line_LaneExtraNearPointType "" UBYTE autosar_swc_rlgs_CM_uint8 0 0 0 255 ECU_ADDRESS 0xfe4aeb3f /* @ECU_Address@autosar_swc_rlgs_rtARID_DEF.ARID_DEF_MATLABFunction1.Line_LaneExtraNearPointType@ */ /end MEASUREMENT
/begin MEASUREMENT autosar_swc_rlgs_rtARID_DEF.ARID_DEF_MATLABFunction1.Line_LaneParsingConfidence "" UBYTE autosar_swc_rlgs_CM_uint8 0 0 0 255 ECU_ADDRESS 0xfe4aeb41 /* @ECU_Address@autosar_swc_rlgs_rtARID_DEF.ARID_DEF_MATLABFunction1.Line_LaneParsingConfidence@ */ /end MEASUREMENT
/begin MEASUREMENT autosar_swc_rlgs_rtARID_DEF.ARID_DEF_MATLABFunction1.Line_ObstacleFlag "" UBYTE autosar_swc_rlgs_CM_uint8 0 0 0 255 ECU_ADDRESS 0xfe4aeb3e /* @ECU_Address@autosar_swc_rlgs_rtARID_DEF.ARID_DEF_MATLABFunction1.Line_ObstacleFlag@ */ /end MEASUREMENT
/begin MEASUREMENT autosar_swc_rlgs_rtARID_DEF.ARID_DEF_MATLABFunction1.Line_Stopline_Relevancy "" UBYTE autosar_swc_rlgs_CM_uint8 0 0 0 255 ECU_ADDRESS 0xfe4aeb42 /* @ECU_Address@autosar_swc_rlgs_rtARID_DEF.ARID_DEF_MATLABFunction1.Line_Stopline_Relevancy@ */ /end MEASUREMENT
/begin MEASUREMENT autosar_swc_rlgs_rtARID_DEF.ARID_DEF_MATLABFunction1.Line_TrackID "" UWORD autosar_swc_rlgs_CM_uint16 0 0 0 65535 ECU_ADDRESS 0xfe4aeb38 /* @ECU_Address@autosar_swc_rlgs_rtARID_DEF.ARID_DEF_MATLABFunction1.Line_TrackID@ */ /end MEASUREMENT
/begin MEASUREMENT autosar_swc_rlgs_rtARID_DEF.ARID_DEF_MATLABFunction1.Line_bIsLineExist "" UBYTE autosar_swc_rlgs_CM_uint8 0 0 0 255 ECU_ADDRESS 0xfe4aeb3a /* @ECU_Address@autosar_swc_rlgs_rtARID_DEF.ARID_DEF_MATLABFunction1.Line_bIsLineExist@ */ /end MEASUREMENT
/begin MEASUREMENT autosar_swc_rlgs_rtARID_DEF.ARID_DEF_MATLABFunction1.Line_dC0V "" FLOAT32_IEEE autosar_swc_rlgs_CM_single 0 0 -3.4E+38 3.4E+38 ECU_ADDRESS 0xfe4aeb18 /* @ECU_Address@autosar_swc_rlgs_rtARID_DEF.ARID_DEF_MATLABFunction1.Line_dC0V@ */ /end MEASUREMENT
/begin MEASUREMENT autosar_swc_rlgs_rtARID_DEF.ARID_DEF_MATLABFunction1.Line_dC1V "" FLOAT32_IEEE autosar_swc_rlgs_CM_single 0 0 -3.4E+38 3.4E+38 ECU_ADDRESS 0xfe4aeb1c /* @ECU_Address@autosar_swc_rlgs_rtARID_DEF.ARID_DEF_MATLABFunction1.Line_dC1V@ */ /end MEASUREMENT
/begin MEASUREMENT autosar_swc_rlgs_rtARID_DEF.ARID_DEF_MATLABFunction1.Line_dC2V "" FLOAT32_IEEE autosar_swc_rlgs_CM_single 0 0 -3.4E+38 3.4E+38 ECU_ADDRESS 0xfe4aeb20 /* @ECU_Address@autosar_swc_rlgs_rtARID_DEF.ARID_DEF_MATLABFunction1.Line_dC2V@ */ /end MEASUREMENT
/begin MEASUREMENT autosar_swc_rlgs_rtARID_DEF.ARID_DEF_MATLABFunction1.Line_dC3V "" FLOAT32_IEEE autosar_swc_rlgs_CM_single 0 0 -3.4E+38 3.4E+38 ECU_ADDRESS 0xfe4aeb24 /* @ECU_Address@autosar_swc_rlgs_rtARID_DEF.ARID_DEF_MATLABFunction1.Line_dC3V@ */ /end MEASUREMENT
/begin MEASUREMENT autosar_swc_rlgs_rtARID_DEF.ARID_DEF_MATLABFunction1.Line_dDisFront "" FLOAT32_IEEE autosar_swc_rlgs_CM_single 0 0 -3.4E+38 3.4E+38 ECU_ADDRESS 0xfe4aeb14 /* @ECU_Address@autosar_swc_rlgs_rtARID_DEF.ARID_DEF_MATLABFunction1.Line_dDisFront@ */ /end MEASUREMENT
/begin MEASUREMENT autosar_swc_rlgs_rtARID_DEF.ARID_DEF_MATLABFunction1.Line_dDisStart "" FLOAT32_IEEE autosar_swc_rlgs_CM_single 0 0 -3.4E+38 3.4E+38 ECU_ADDRESS 0xfe4aeb10 /* @ECU_Address@autosar_swc_rlgs_rtARID_DEF.ARID_DEF_MATLABFunction1.Line_dDisStart@ */ /end MEASUREMENT
/begin MEASUREMENT autosar_swc_rlgs_rtARID_DEF.ARID_DEF_MATLABFunction1.Line_dLaneWidth "" FLOAT32_IEEE autosar_swc_rlgs_CM_single 0 0 -3.4E+38 3.4E+38 ECU_ADDRESS 0xfe4aeb0c /* @ECU_Address@autosar_swc_rlgs_rtARID_DEF.ARID_DEF_MATLABFunction1.Line_dLaneWidth@ */ /end MEASUREMENT
/begin MEASUREMENT autosar_swc_rlgs_rtARID_DEF.ARID_DEF_MATLABFunction1.Line_dQuality "" FLOAT32_IEEE autosar_swc_rlgs_CM_single 0 0 -3.4E+38 3.4E+38 ECU_ADDRESS 0xfe4aeb08 /* @ECU_Address@autosar_swc_rlgs_rtARID_DEF.ARID_DEF_MATLABFunction1.Line_dQuality@ */ /end MEASUREMENT
/begin MEASUREMENT autosar_swc_rlgs_rtARID_DEF.ARID_DEF_MATLABFunction1.Line_eColour "" UBYTE autosar_swc_rlgs_CM_uint8 0 0 0 255 ECU_ADDRESS 0xfe4aeb3c /* @ECU_Address@autosar_swc_rlgs_rtARID_DEF.ARID_DEF_MATLABFunction1.Line_eColour@ */ /end MEASUREMENT
/begin MEASUREMENT autosar_swc_rlgs_rtARID_DEF.ARID_DEF_MATLABFunction1.Line_eLineType "" UBYTE autosar_swc_rlgs_CM_uint8 0 0 0 255 ECU_ADDRESS 0xfe4aeb3b /* @ECU_Address@autosar_swc_rlgs_rtARID_DEF.ARID_DEF_MATLABFunction1.Line_eLineType@ */ /end MEASUREMENT
/begin MEASUREMENT autosar_swc_rlgs_rtARID_DEF.ARID_DEF_MATLABFunction1_b.Line_Crossing "" UBYTE autosar_swc_rlgs_CM_uint8 0 0 0 255 ECU_ADDRESS 0xfe4aec51 /* @ECU_Address@autosar_swc_rlgs_rtARID_DEF.ARID_DEF_MATLABFunction1_b.Line_Crossing@ */ /end MEASUREMENT
/begin MEASUREMENT autosar_swc_rlgs_rtARID_DEF.ARID_DEF_MATLABFunction1_b.Line_LaneExtraFarPointPosX "" FLOAT32_IEEE autosar_swc_rlgs_CM_single 0 0 -3.4E+38 3.4E+38 ECU_ADDRESS 0xfe4aec3c /* @ECU_Address@autosar_swc_rlgs_rtARID_DEF.ARID_DEF_MATLABFunction1_b.Line_LaneExtraFarPointPosX@ */ /end MEASUREMENT
/begin MEASUREMENT autosar_swc_rlgs_rtARID_DEF.ARID_DEF_MATLABFunction1_b.Line_LaneExtraFarPointPosY "" FLOAT32_IEEE autosar_swc_rlgs_CM_single 0 0 -3.4E+38 3.4E+38 ECU_ADDRESS 0xfe4aec40 /* @ECU_Address@autosar_swc_rlgs_rtARID_DEF.ARID_DEF_MATLABFunction1_b.Line_LaneExtraFarPointPosY@ */ /end MEASUREMENT
/begin MEASUREMENT autosar_swc_rlgs_rtARID_DEF.ARID_DEF_MATLABFunction1_b.Line_LaneExtraFarPointType "" UBYTE autosar_swc_rlgs_CM_uint8 0 0 0 255 ECU_ADDRESS 0xfe4aec54 /* @ECU_Address@autosar_swc_rlgs_rtARID_DEF.ARID_DEF_MATLABFunction1_b.Line_LaneExtraFarPointType@ */ /end MEASUREMENT
/begin MEASUREMENT autosar_swc_rlgs_rtARID_DEF.ARID_DEF_MATLABFunction1_b.Line_LaneExtraNearPointPosX "" FLOAT32_IEEE autosar_swc_rlgs_CM_single 0 0 -3.4E+38 3.4E+38 ECU_ADDRESS 0xfe4aec44 /* @ECU_Address@autosar_swc_rlgs_rtARID_DEF.ARID_DEF_MATLABFunction1_b.Line_LaneExtraNearPointPosX@ */ /end MEASUREMENT
/begin MEASUREMENT autosar_swc_rlgs_rtARID_DEF.ARID_DEF_MATLABFunction1_b.Line_LaneExtraNearPointPosY "" FLOAT32_IEEE autosar_swc_rlgs_CM_single 0 0 -3.4E+38 3.4E+38 ECU_ADDRESS 0xfe4aec48 /* @ECU_Address@autosar_swc_rlgs_rtARID_DEF.ARID_DEF_MATLABFunction1_b.Line_LaneExtraNearPointPosY@ */ /end MEASUREMENT
/begin MEASUREMENT autosar_swc_rlgs_rtARID_DEF.ARID_DEF_MATLABFunction1_b.Line_LaneExtraNearPointType "" UBYTE autosar_swc_rlgs_CM_uint8 0 0 0 255 ECU_ADDRESS 0xfe4aec53 /* @ECU_Address@autosar_swc_rlgs_rtARID_DEF.ARID_DEF_MATLABFunction1_b.Line_LaneExtraNearPointType@ */ /end MEASUREMENT
/begin MEASUREMENT autosar_swc_rlgs_rtARID_DEF.ARID_DEF_MATLABFunction1_b.Line_LaneParsingConfidence "" UBYTE autosar_swc_rlgs_CM_uint8 0 0 0 255 ECU_ADDRESS 0xfe4aec55 /* @ECU_Address@autosar_swc_rlgs_rtARID_DEF.ARID_DEF_MATLABFunction1_b.Line_LaneParsingConfidence@ */ /end MEASUREMENT
/begin MEASUREMENT autosar_swc_rlgs_rtARID_DEF.ARID_DEF_MATLABFunction1_b.Line_ObstacleFlag "" UBYTE autosar_swc_rlgs_CM_uint8 0 0 0 255 ECU_ADDRESS 0xfe4aec52 /* @ECU_Address@autosar_swc_rlgs_rtARID_DEF.ARID_DEF_MATLABFunction1_b.Line_ObstacleFlag@ */ /end MEASUREMENT
/begin MEASUREMENT autosar_swc_rlgs_rtARID_DEF.ARID_DEF_MATLABFunction1_b.Line_Stopline_Relevancy "" UBYTE autosar_swc_rlgs_CM_uint8 0 0 0 255 ECU_ADDRESS 0xfe4aec56 /* @ECU_Address@autosar_swc_rlgs_rtARID_DEF.ARID_DEF_MATLABFunction1_b.Line_Stopline_Relevancy@ */ /end MEASUREMENT
/begin MEASUREMENT autosar_swc_rlgs_rtARID_DEF.ARID_DEF_MATLABFunction1_b.Line_TrackID "" UWORD autosar_swc_rlgs_CM_uint16 0 0 0 65535 ECU_ADDRESS 0xfe4aec4c /* @ECU_Address@autosar_swc_rlgs_rtARID_DEF.ARID_DEF_MATLABFunction1_b.Line_TrackID@ */ /end MEASUREMENT
/begin MEASUREMENT autosar_swc_rlgs_rtARID_DEF.ARID_DEF_MATLABFunction1_b.Line_bIsLineExist "" UBYTE autosar_swc_rlgs_CM_uint8 0 0 0 255 ECU_ADDRESS 0xfe4aec4e /* @ECU_Address@autosar_swc_rlgs_rtARID_DEF.ARID_DEF_MATLABFunction1_b.Line_bIsLineExist@ */ /end MEASUREMENT
/begin MEASUREMENT autosar_swc_rlgs_rtARID_DEF.ARID_DEF_MATLABFunction1_b.Line_dC0V "" FLOAT32_IEEE autosar_swc_rlgs_CM_single 0 0 -3.4E+38 3.4E+38 ECU_ADDRESS 0xfe4aec2c /* @ECU_Address@autosar_swc_rlgs_rtARID_DEF.ARID_DEF_MATLABFunction1_b.Line_dC0V@ */ /end MEASUREMENT
/begin MEASUREMENT autosar_swc_rlgs_rtARID_DEF.ARID_DEF_MATLABFunction1_b.Line_dC1V "" FLOAT32_IEEE autosar_swc_rlgs_CM_single 0 0 -3.4E+38 3.4E+38 ECU_ADDRESS 0xfe4aec30 /* @ECU_Address@autosar_swc_rlgs_rtARID_DEF.ARID_DEF_MATLABFunction1_b.Line_dC1V@ */ /end MEASUREMENT
/begin MEASUREMENT autosar_swc_rlgs_rtARID_DEF.ARID_DEF_MATLABFunction1_b.Line_dC2V "" FLOAT32_IEEE autosar_swc_rlgs_CM_single 0 0 -3.4E+38 3.4E+38 ECU_ADDRESS 0xfe4aec34 /* @ECU_Address@autosar_swc_rlgs_rtARID_DEF.ARID_DEF_MATLABFunction1_b.Line_dC2V@ */ /end MEASUREMENT
/begin MEASUREMENT autosar_swc_rlgs_rtARID_DEF.ARID_DEF_MATLABFunction1_b.Line_dC3V "" FLOAT32_IEEE autosar_swc_rlgs_CM_single 0 0 -3.4E+38 3.4E+38 ECU_ADDRESS 0xfe4aec38 /* @ECU_Address@autosar_swc_rlgs_rtARID_DEF.ARID_DEF_MATLABFunction1_b.Line_dC3V@ */ /end MEASUREMENT
/begin MEASUREMENT autosar_swc_rlgs_rtARID_DEF.ARID_DEF_MATLABFunction1_b.Line_dDisFront "" FLOAT32_IEEE autosar_swc_rlgs_CM_single 0 0 -3.4E+38 3.4E+38 ECU_ADDRESS 0xfe4aec28 /* @ECU_Address@autosar_swc_rlgs_rtARID_DEF.ARID_DEF_MATLABFunction1_b.Line_dDisFront@ */ /end MEASUREMENT
/begin MEASUREMENT autosar_swc_rlgs_rtARID_DEF.ARID_DEF_MATLABFunction1_b.Line_dDisStart "" FLOAT32_IEEE autosar_swc_rlgs_CM_single 0 0 -3.4E+38 3.4E+38 ECU_ADDRESS 0xfe4aec24 /* @ECU_Address@autosar_swc_rlgs_rtARID_DEF.ARID_DEF_MATLABFunction1_b.Line_dDisStart@ */ /end MEASUREMENT
/begin MEASUREMENT autosar_swc_rlgs_rtARID_DEF.ARID_DEF_MATLABFunction1_b.Line_dLaneWidth "" FLOAT32_IEEE autosar_swc_rlgs_CM_single 0 0 -3.4E+38 3.4E+38 ECU_ADDRESS 0xfe4aec20 /* @ECU_Address@autosar_swc_rlgs_rtARID_DEF.ARID_DEF_MATLABFunction1_b.Line_dLaneWidth@ */ /end MEASUREMENT
/begin MEASUREMENT autosar_swc_rlgs_rtARID_DEF.ARID_DEF_MATLABFunction1_b.Line_dQuality "" FLOAT32_IEEE autosar_swc_rlgs_CM_single 0 0 -3.4E+38 3.4E+38 ECU_ADDRESS 0xfe4aec1c /* @ECU_Address@autosar_swc_rlgs_rtARID_DEF.ARID_DEF_MATLABFunction1_b.Line_dQuality@ */ /end MEASUREMENT
/begin MEASUREMENT autosar_swc_rlgs_rtARID_DEF.ARID_DEF_MATLABFunction1_b.Line_eColour "" UBYTE autosar_swc_rlgs_CM_uint8 0 0 0 255 ECU_ADDRESS 0xfe4aec50 /* @ECU_Address@autosar_swc_rlgs_rtARID_DEF.ARID_DEF_MATLABFunction1_b.Line_eColour@ */ /end MEASUREMENT
/begin MEASUREMENT autosar_swc_rlgs_rtARID_DEF.ARID_DEF_MATLABFunction1_b.Line_eLineType "" UBYTE autosar_swc_rlgs_CM_uint8 0 0 0 255 ECU_ADDRESS 0xfe4aec4f /* @ECU_Address@autosar_swc_rlgs_rtARID_DEF.ARID_DEF_MATLABFunction1_b.Line_eLineType@ */ /end MEASUREMENT
/begin MEASUREMENT autosar_swc_rlgs_rtARID_DEF.ARID_DEF_MATLABFunction1_c.Line_Crossing "" UBYTE autosar_swc_rlgs_CM_uint8 0 0 0 255 ECU_ADDRESS 0xfe4aebb5 /* @ECU_Address@autosar_swc_rlgs_rtARID_DEF.ARID_DEF_MATLABFunction1_c.Line_Crossing@ */ /end MEASUREMENT
/begin MEASUREMENT autosar_swc_rlgs_rtARID_DEF.ARID_DEF_MATLABFunction1_c.Line_LaneExtraFarPointPosX "" FLOAT32_IEEE autosar_swc_rlgs_CM_single 0 0 -3.4E+38 3.4E+38 ECU_ADDRESS 0xfe4aeba0 /* @ECU_Address@autosar_swc_rlgs_rtARID_DEF.ARID_DEF_MATLABFunction1_c.Line_LaneExtraFarPointPosX@ */ /end MEASUREMENT
/begin MEASUREMENT autosar_swc_rlgs_rtARID_DEF.ARID_DEF_MATLABFunction1_c.Line_LaneExtraFarPointPosY "" FLOAT32_IEEE autosar_swc_rlgs_CM_single 0 0 -3.4E+38 3.4E+38 ECU_ADDRESS 0xfe4aeba4 /* @ECU_Address@autosar_swc_rlgs_rtARID_DEF.ARID_DEF_MATLABFunction1_c.Line_LaneExtraFarPointPosY@ */ /end MEASUREMENT
/begin MEASUREMENT autosar_swc_rlgs_rtARID_DEF.ARID_DEF_MATLABFunction1_c.Line_LaneExtraFarPointType "" UBYTE autosar_swc_rlgs_CM_uint8 0 0 0 255 ECU_ADDRESS 0xfe4aebb8 /* @ECU_Address@autosar_swc_rlgs_rtARID_DEF.ARID_DEF_MATLABFunction1_c.Line_LaneExtraFarPointType@ */ /end MEASUREMENT
/begin MEASUREMENT autosar_swc_rlgs_rtARID_DEF.ARID_DEF_MATLABFunction1_c.Line_LaneExtraNearPointPosX "" FLOAT32_IEEE autosar_swc_rlgs_CM_single 0 0 -3.4E+38 3.4E+38 ECU_ADDRESS 0xfe4aeba8 /* @ECU_Address@autosar_swc_rlgs_rtARID_DEF.ARID_DEF_MATLABFunction1_c.Line_LaneExtraNearPointPosX@ */ /end MEASUREMENT
/begin MEASUREMENT autosar_swc_rlgs_rtARID_DEF.ARID_DEF_MATLABFunction1_c.Line_LaneExtraNearPointPosY "" FLOAT32_IEEE autosar_swc_rlgs_CM_single 0 0 -3.4E+38 3.4E+38 ECU_ADDRESS 0xfe4aebac /* @ECU_Address@autosar_swc_rlgs_rtARID_DEF.ARID_DEF_MATLABFunction1_c.Line_LaneExtraNearPointPosY@ */ /end MEASUREMENT
/begin MEASUREMENT autosar_swc_rlgs_rtARID_DEF.ARID_DEF_MATLABFunction1_c.Line_LaneExtraNearPointType "" UBYTE autosar_swc_rlgs_CM_uint8 0 0 0 255 ECU_ADDRESS 0xfe4aebb7 /* @ECU_Address@autosar_swc_rlgs_rtARID_DEF.ARID_DEF_MATLABFunction1_c.Line_LaneExtraNearPointType@ */ /end MEASUREMENT
/begin MEASUREMENT autosar_swc_rlgs_rtARID_DEF.ARID_DEF_MATLABFunction1_c.Line_LaneParsingConfidence "" UBYTE autosar_swc_rlgs_CM_uint8 0 0 0 255 ECU_ADDRESS 0xfe4aebb9 /* @ECU_Address@autosar_swc_rlgs_rtARID_DEF.ARID_DEF_MATLABFunction1_c.Line_LaneParsingConfidence@ */ /end MEASUREMENT
/begin MEASUREMENT autosar_swc_rlgs_rtARID_DEF.ARID_DEF_MATLABFunction1_c.Line_ObstacleFlag "" UBYTE autosar_swc_rlgs_CM_uint8 0 0 0 255 ECU_ADDRESS 0xfe4aebb6 /* @ECU_Address@autosar_swc_rlgs_rtARID_DEF.ARID_DEF_MATLABFunction1_c.Line_ObstacleFlag@ */ /end MEASUREMENT
/begin MEASUREMENT autosar_swc_rlgs_rtARID_DEF.ARID_DEF_MATLABFunction1_c.Line_Stopline_Relevancy "" UBYTE autosar_swc_rlgs_CM_uint8 0 0 0 255 ECU_ADDRESS 0xfe4aebba /* @ECU_Address@autosar_swc_rlgs_rtARID_DEF.ARID_DEF_MATLABFunction1_c.Line_Stopline_Relevancy@ */ /end MEASUREMENT
/begin MEASUREMENT autosar_swc_rlgs_rtARID_DEF.ARID_DEF_MATLABFunction1_c.Line_TrackID "" UWORD autosar_swc_rlgs_CM_uint16 0 0 0 65535 ECU_ADDRESS 0xfe4aebb0 /* @ECU_Address@autosar_swc_rlgs_rtARID_DEF.ARID_DEF_MATLABFunction1_c.Line_TrackID@ */ /end MEASUREMENT
/begin MEASUREMENT autosar_swc_rlgs_rtARID_DEF.ARID_DEF_MATLABFunction1_c.Line_bIsLineExist "" UBYTE autosar_swc_rlgs_CM_uint8 0 0 0 255 ECU_ADDRESS 0xfe4aebb2 /* @ECU_Address@autosar_swc_rlgs_rtARID_DEF.ARID_DEF_MATLABFunction1_c.Line_bIsLineExist@ */ /end MEASUREMENT
/begin MEASUREMENT autosar_swc_rlgs_rtARID_DEF.ARID_DEF_MATLABFunction1_c.Line_dC0V "" FLOAT32_IEEE autosar_swc_rlgs_CM_single 0 0 -3.4E+38 3.4E+38 ECU_ADDRESS 0xfe4aeb90 /* @ECU_Address@autosar_swc_rlgs_rtARID_DEF.ARID_DEF_MATLABFunction1_c.Line_dC0V@ */ /end MEASUREMENT
/begin MEASUREMENT autosar_swc_rlgs_rtARID_DEF.ARID_DEF_MATLABFunction1_c.Line_dC1V "" FLOAT32_IEEE autosar_swc_rlgs_CM_single 0 0 -3.4E+38 3.4E+38 ECU_ADDRESS 0xfe4aeb94 /* @ECU_Address@autosar_swc_rlgs_rtARID_DEF.ARID_DEF_MATLABFunction1_c.Line_dC1V@ */ /end MEASUREMENT
/begin MEASUREMENT autosar_swc_rlgs_rtARID_DEF.ARID_DEF_MATLABFunction1_c.Line_dC2V "" FLOAT32_IEEE autosar_swc_rlgs_CM_single 0 0 -3.4E+38 3.4E+38 ECU_ADDRESS 0xfe4aeb98 /* @ECU_Address@autosar_swc_rlgs_rtARID_DEF.ARID_DEF_MATLABFunction1_c.Line_dC2V@ */ /end MEASUREMENT
/begin MEASUREMENT autosar_swc_rlgs_rtARID_DEF.ARID_DEF_MATLABFunction1_c.Line_dC3V "" FLOAT32_IEEE autosar_swc_rlgs_CM_single 0 0 -3.4E+38 3.4E+38 ECU_ADDRESS 0xfe4aeb9c /* @ECU_Address@autosar_swc_rlgs_rtARID_DEF.ARID_DEF_MATLABFunction1_c.Line_dC3V@ */ /end MEASUREMENT
/begin MEASUREMENT autosar_swc_rlgs_rtARID_DEF.ARID_DEF_MATLABFunction1_c.Line_dDisFront "" FLOAT32_IEEE autosar_swc_rlgs_CM_single 0 0 -3.4E+38 3.4E+38 ECU_ADDRESS 0xfe4aeb8c /* @ECU_Address@autosar_swc_rlgs_rtARID_DEF.ARID_DEF_MATLABFunction1_c.Line_dDisFront@ */ /end MEASUREMENT
/begin MEASUREMENT autosar_swc_rlgs_rtARID_DEF.ARID_DEF_MATLABFunction1_c.Line_dDisStart "" FLOAT32_IEEE autosar_swc_rlgs_CM_single 0 0 -3.4E+38 3.4E+38 ECU_ADDRESS 0xfe4aeb88 /* @ECU_Address@autosar_swc_rlgs_rtARID_DEF.ARID_DEF_MATLABFunction1_c.Line_dDisStart@ */ /end MEASUREMENT
/begin MEASUREMENT autosar_swc_rlgs_rtARID_DEF.ARID_DEF_MATLABFunction1_c.Line_dLaneWidth "" FLOAT32_IEEE autosar_swc_rlgs_CM_single 0 0 -3.4E+38 3.4E+38 ECU_ADDRESS 0xfe4aeb84 /* @ECU_Address@autosar_swc_rlgs_rtARID_DEF.ARID_DEF_MATLABFunction1_c.Line_dLaneWidth@ */ /end MEASUREMENT
/begin MEASUREMENT autosar_swc_rlgs_rtARID_DEF.ARID_DEF_MATLABFunction1_c.Line_dQuality "" FLOAT32_IEEE autosar_swc_rlgs_CM_single 0 0 -3.4E+38 3.4E+38 ECU_ADDRESS 0xfe4aeb80 /* @ECU_Address@autosar_swc_rlgs_rtARID_DEF.ARID_DEF_MATLABFunction1_c.Line_dQuality@ */ /end MEASUREMENT
/begin MEASUREMENT autosar_swc_rlgs_rtARID_DEF.ARID_DEF_MATLABFunction1_c.Line_eColour "" UBYTE autosar_swc_rlgs_CM_uint8 0 0 0 255 ECU_ADDRESS 0xfe4aebb4 /* @ECU_Address@autosar_swc_rlgs_rtARID_DEF.ARID_DEF_MATLABFunction1_c.Line_eColour@ */ /end MEASUREMENT
/begin MEASUREMENT autosar_swc_rlgs_rtARID_DEF.ARID_DEF_MATLABFunction1_c.Line_eLineType "" UBYTE autosar_swc_rlgs_CM_uint8 0 0 0 255 ECU_ADDRESS 0xfe4aebb3 /* @ECU_Address@autosar_swc_rlgs_rtARID_DEF.ARID_DEF_MATLABFunction1_c.Line_eLineType@ */ /end MEASUREMENT
/begin MEASUREMENT autosar_swc_rlgs_rtARID_DEF.ARID_DEF_MATLABFunction1_cv.Line_Crossing "" UBYTE autosar_swc_rlgs_CM_uint8 0 0 0 255 ECU_ADDRESS 0xfe4aed29 /* @ECU_Address@autosar_swc_rlgs_rtARID_DEF.ARID_DEF_MATLABFunction1_cv.Line_Crossing@ */ /end MEASUREMENT
/begin MEASUREMENT autosar_swc_rlgs_rtARID_DEF.ARID_DEF_MATLABFunction1_cv.Line_LaneExtraFarPointPosX "" FLOAT32_IEEE autosar_swc_rlgs_CM_single 0 0 -3.4E+38 3.4E+38 ECU_ADDRESS 0xfe4aed14 /* @ECU_Address@autosar_swc_rlgs_rtARID_DEF.ARID_DEF_MATLABFunction1_cv.Line_LaneExtraFarPointPosX@ */ /end MEASUREMENT
/begin MEASUREMENT autosar_swc_rlgs_rtARID_DEF.ARID_DEF_MATLABFunction1_cv.Line_LaneExtraFarPointPosY "" FLOAT32_IEEE autosar_swc_rlgs_CM_single 0 0 -3.4E+38 3.4E+38 ECU_ADDRESS 0xfe4aed18 /* @ECU_Address@autosar_swc_rlgs_rtARID_DEF.ARID_DEF_MATLABFunction1_cv.Line_LaneExtraFarPointPosY@ */ /end MEASUREMENT
/begin MEASUREMENT autosar_swc_rlgs_rtARID_DEF.ARID_DEF_MATLABFunction1_cv.Line_LaneExtraFarPointType "" UBYTE autosar_swc_rlgs_CM_uint8 0 0 0 255 ECU_ADDRESS 0xfe4aed2c /* @ECU_Address@autosar_swc_rlgs_rtARID_DEF.ARID_DEF_MATLABFunction1_cv.Line_LaneExtraFarPointType@ */ /end MEASUREMENT
/begin MEASUREMENT autosar_swc_rlgs_rtARID_DEF.ARID_DEF_MATLABFunction1_cv.Line_LaneExtraNearPointPosX "" FLOAT32_IEEE autosar_swc_rlgs_CM_single 0 0 -3.4E+38 3.4E+38 ECU_ADDRESS 0xfe4aed1c /* @ECU_Address@autosar_swc_rlgs_rtARID_DEF.ARID_DEF_MATLABFunction1_cv.Line_LaneExtraNearPointPosX@ */ /end MEASUREMENT
/begin MEASUREMENT autosar_swc_rlgs_rtARID_DEF.ARID_DEF_MATLABFunction1_cv.Line_LaneExtraNearPointPosY "" FLOAT32_IEEE autosar_swc_rlgs_CM_single 0 0 -3.4E+38 3.4E+38 ECU_ADDRESS 0xfe4aed20 /* @ECU_Address@autosar_swc_rlgs_rtARID_DEF.ARID_DEF_MATLABFunction1_cv.Line_LaneExtraNearPointPosY@ */ /end MEASUREMENT
/begin MEASUREMENT autosar_swc_rlgs_rtARID_DEF.ARID_DEF_MATLABFunction1_cv.Line_LaneExtraNearPointType "" UBYTE autosar_swc_rlgs_CM_uint8 0 0 0 255 ECU_ADDRESS 0xfe4aed2b /* @ECU_Address@autosar_swc_rlgs_rtARID_DEF.ARID_DEF_MATLABFunction1_cv.Line_LaneExtraNearPointType@ */ /end MEASUREMENT
/begin MEASUREMENT autosar_swc_rlgs_rtARID_DEF.ARID_DEF_MATLABFunction1_cv.Line_LaneParsingConfidence "" UBYTE autosar_swc_rlgs_CM_uint8 0 0 0 255 ECU_ADDRESS 0xfe4aed2d /* @ECU_Address@autosar_swc_rlgs_rtARID_DEF.ARID_DEF_MATLABFunction1_cv.Line_LaneParsingConfidence@ */ /end MEASUREMENT
/begin MEASUREMENT autosar_swc_rlgs_rtARID_DEF.ARID_DEF_MATLABFunction1_cv.Line_ObstacleFlag "" UBYTE autosar_swc_rlgs_CM_uint8 0 0 0 255 ECU_ADDRESS 0xfe4aed2a /* @ECU_Address@autosar_swc_rlgs_rtARID_DEF.ARID_DEF_MATLABFunction1_cv.Line_ObstacleFlag@ */ /end MEASUREMENT
/begin MEASUREMENT autosar_swc_rlgs_rtARID_DEF.ARID_DEF_MATLABFunction1_cv.Line_Stopline_Relevancy "" UBYTE autosar_swc_rlgs_CM_uint8 0 0 0 255 ECU_ADDRESS 0xfe4aed2e /* @ECU_Address@autosar_swc_rlgs_rtARID_DEF.ARID_DEF_MATLABFunction1_cv.Line_Stopline_Relevancy@ */ /end MEASUREMENT
/begin MEASUREMENT autosar_swc_rlgs_rtARID_DEF.ARID_DEF_MATLABFunction1_cv.Line_TrackID "" UWORD autosar_swc_rlgs_CM_uint16 0 0 0 65535 ECU_ADDRESS 0xfe4aed24 /* @ECU_Address@autosar_swc_rlgs_rtARID_DEF.ARID_DEF_MATLABFunction1_cv.Line_TrackID@ */ /end MEASUREMENT
/begin MEASUREMENT autosar_swc_rlgs_rtARID_DEF.ARID_DEF_MATLABFunction1_cv.Line_bIsLineExist "" UBYTE autosar_swc_rlgs_CM_uint8 0 0 0 255 ECU_ADDRESS 0xfe4aed26 /* @ECU_Address@autosar_swc_rlgs_rtARID_DEF.ARID_DEF_MATLABFunction1_cv.Line_bIsLineExist@ */ /end MEASUREMENT
/begin MEASUREMENT autosar_swc_rlgs_rtARID_DEF.ARID_DEF_MATLABFunction1_cv.Line_dC0V "" FLOAT32_IEEE autosar_swc_rlgs_CM_single 0 0 -3.4E+38 3.4E+38 ECU_ADDRESS 0xfe4aed04 /* @ECU_Address@autosar_swc_rlgs_rtARID_DEF.ARID_DEF_MATLABFunction1_cv.Line_dC0V@ */ /end MEASUREMENT
/begin MEASUREMENT autosar_swc_rlgs_rtARID_DEF.ARID_DEF_MATLABFunction1_cv.Line_dC1V "" FLOAT32_IEEE autosar_swc_rlgs_CM_single 0 0 -3.4E+38 3.4E+38 ECU_ADDRESS 0xfe4aed08 /* @ECU_Address@autosar_swc_rlgs_rtARID_DEF.ARID_DEF_MATLABFunction1_cv.Line_dC1V@ */ /end MEASUREMENT
/begin MEASUREMENT autosar_swc_rlgs_rtARID_DEF.ARID_DEF_MATLABFunction1_cv.Line_dC2V "" FLOAT32_IEEE autosar_swc_rlgs_CM_single 0 0 -3.4E+38 3.4E+38 ECU_ADDRESS 0xfe4aed0c /* @ECU_Address@autosar_swc_rlgs_rtARID_DEF.ARID_DEF_MATLABFunction1_cv.Line_dC2V@ */ /end MEASUREMENT
/begin MEASUREMENT autosar_swc_rlgs_rtARID_DEF.ARID_DEF_MATLABFunction1_cv.Line_dC3V "" FLOAT32_IEEE autosar_swc_rlgs_CM_single 0 0 -3.4E+38 3.4E+38 ECU_ADDRESS 0xfe4aed10 /* @ECU_Address@autosar_swc_rlgs_rtARID_DEF.ARID_DEF_MATLABFunction1_cv.Line_dC3V@ */ /end MEASUREMENT
/begin MEASUREMENT autosar_swc_rlgs_rtARID_DEF.ARID_DEF_MATLABFunction1_cv.Line_dDisFront "" FLOAT32_IEEE autosar_swc_rlgs_CM_single 0 0 -3.4E+38 3.4E+38 ECU_ADDRESS 0xfe4aed00 /* @ECU_Address@autosar_swc_rlgs_rtARID_DEF.ARID_DEF_MATLABFunction1_cv.Line_dDisFront@ */ /end MEASUREMENT
/begin MEASUREMENT autosar_swc_rlgs_rtARID_DEF.ARID_DEF_MATLABFunction1_cv.Line_dDisStart "" FLOAT32_IEEE autosar_swc_rlgs_CM_single 0 0 -3.4E+38 3.4E+38 ECU_ADDRESS 0xfe4aecfc /* @ECU_Address@autosar_swc_rlgs_rtARID_DEF.ARID_DEF_MATLABFunction1_cv.Line_dDisStart@ */ /end MEASUREMENT
/begin MEASUREMENT autosar_swc_rlgs_rtARID_DEF.ARID_DEF_MATLABFunction1_cv.Line_dLaneWidth "" FLOAT32_IEEE autosar_swc_rlgs_CM_single 0 0 -3.4E+38 3.4E+38 ECU_ADDRESS 0xfe4aecf8 /* @ECU_Address@autosar_swc_rlgs_rtARID_DEF.ARID_DEF_MATLABFunction1_cv.Line_dLaneWidth@ */ /end MEASUREMENT
/begin MEASUREMENT autosar_swc_rlgs_rtARID_DEF.ARID_DEF_MATLABFunction1_cv.Line_dQuality "" FLOAT32_IEEE autosar_swc_rlgs_CM_single 0 0 -3.4E+38 3.4E+38 ECU_ADDRESS 0xfe4aecf4 /* @ECU_Address@autosar_swc_rlgs_rtARID_DEF.ARID_DEF_MATLABFunction1_cv.Line_dQuality@ */ /end MEASUREMENT
/begin MEASUREMENT autosar_swc_rlgs_rtARID_DEF.ARID_DEF_MATLABFunction1_cv.Line_eColour "" UBYTE autosar_swc_rlgs_CM_uint8 0 0 0 255 ECU_ADDRESS 0xfe4aed28 /* @ECU_Address@autosar_swc_rlgs_rtARID_DEF.ARID_DEF_MATLABFunction1_cv.Line_eColour@ */ /end MEASUREMENT
/begin MEASUREMENT autosar_swc_rlgs_rtARID_DEF.ARID_DEF_MATLABFunction1_cv.Line_eLineType "" UBYTE autosar_swc_rlgs_CM_uint8 0 0 0 255 ECU_ADDRESS 0xfe4aed27 /* @ECU_Address@autosar_swc_rlgs_rtARID_DEF.ARID_DEF_MATLABFunction1_cv.Line_eLineType@ */ /end MEASUREMENT
/begin MEASUREMENT autosar_swc_rlgs_rtARID_DEF.ARID_DEF_MATLABFunction1_f.Cnt "" UBYTE autosar_swc_rlgs_CM_uint8 0 0 0 255 ECU_ADDRESS 0xfe4aed31 /* @ECU_Address@autosar_swc_rlgs_rtARID_DEF.ARID_DEF_MATLABFunction1_f.Cnt@ */ /end MEASUREMENT
/begin MEASUREMENT autosar_swc_rlgs_rtARID_DEF.ARID_DEF_MATLABFunction1_f.TurnLmpIn_K1 "" UBYTE autosar_swc_rlgs_CM_uint8 0 0 0 255 ECU_ADDRESS 0xfe4aed30 /* @ECU_Address@autosar_swc_rlgs_rtARID_DEF.ARID_DEF_MATLABFunction1_f.TurnLmpIn_K1@ */ /end MEASUREMENT
/begin MEASUREMENT autosar_swc_rlgs_rtARID_DEF.ARID_DEF_MATLABFunction1_g.Cnt "" UBYTE autosar_swc_rlgs_CM_uint8 0 0 0 255 ECU_ADDRESS 0xfe4aed35 /* @ECU_Address@autosar_swc_rlgs_rtARID_DEF.ARID_DEF_MATLABFunction1_g.Cnt@ */ /end MEASUREMENT
/begin MEASUREMENT autosar_swc_rlgs_rtARID_DEF.ARID_DEF_MATLABFunction1_g.TurnLmpIn_K1 "" UBYTE autosar_swc_rlgs_CM_uint8 0 0 0 255 ECU_ADDRESS 0xfe4aed34 /* @ECU_Address@autosar_swc_rlgs_rtARID_DEF.ARID_DEF_MATLABFunction1_g.TurnLmpIn_K1@ */ /end MEASUREMENT
/begin MEASUREMENT autosar_swc_rlgs_rtARID_DEF.ARID_DEF_MATLABFunction1_k.Line_Crossing "" UBYTE autosar_swc_rlgs_CM_uint8 0 0 0 255 ECU_ADDRESS 0xfe4aeb79 /* @ECU_Address@autosar_swc_rlgs_rtARID_DEF.ARID_DEF_MATLABFunction1_k.Line_Crossing@ */ /end MEASUREMENT
/begin MEASUREMENT autosar_swc_rlgs_rtARID_DEF.ARID_DEF_MATLABFunction1_k.Line_LaneExtraFarPointPosX "" FLOAT32_IEEE autosar_swc_rlgs_CM_single 0 0 -3.4E+38 3.4E+38 ECU_ADDRESS 0xfe4aeb64 /* @ECU_Address@autosar_swc_rlgs_rtARID_DEF.ARID_DEF_MATLABFunction1_k.Line_LaneExtraFarPointPosX@ */ /end MEASUREMENT
/begin MEASUREMENT autosar_swc_rlgs_rtARID_DEF.ARID_DEF_MATLABFunction1_k.Line_LaneExtraFarPointPosY "" FLOAT32_IEEE autosar_swc_rlgs_CM_single 0 0 -3.4E+38 3.4E+38 ECU_ADDRESS 0xfe4aeb68 /* @ECU_Address@autosar_swc_rlgs_rtARID_DEF.ARID_DEF_MATLABFunction1_k.Line_LaneExtraFarPointPosY@ */ /end MEASUREMENT
/begin MEASUREMENT autosar_swc_rlgs_rtARID_DEF.ARID_DEF_MATLABFunction1_k.Line_LaneExtraFarPointType "" UBYTE autosar_swc_rlgs_CM_uint8 0 0 0 255 ECU_ADDRESS 0xfe4aeb7c /* @ECU_Address@autosar_swc_rlgs_rtARID_DEF.ARID_DEF_MATLABFunction1_k.Line_LaneExtraFarPointType@ */ /end MEASUREMENT
/begin MEASUREMENT autosar_swc_rlgs_rtARID_DEF.ARID_DEF_MATLABFunction1_k.Line_LaneExtraNearPointPosX "" FLOAT32_IEEE autosar_swc_rlgs_CM_single 0 0 -3.4E+38 3.4E+38 ECU_ADDRESS 0xfe4aeb6c /* @ECU_Address@autosar_swc_rlgs_rtARID_DEF.ARID_DEF_MATLABFunction1_k.Line_LaneExtraNearPointPosX@ */ /end MEASUREMENT
/begin MEASUREMENT autosar_swc_rlgs_rtARID_DEF.ARID_DEF_MATLABFunction1_k.Line_LaneExtraNearPointPosY "" FLOAT32_IEEE autosar_swc_rlgs_CM_single 0 0 -3.4E+38 3.4E+38 ECU_ADDRESS 0xfe4aeb70 /* @ECU_Address@autosar_swc_rlgs_rtARID_DEF.ARID_DEF_MATLABFunction1_k.Line_LaneExtraNearPointPosY@ */ /end MEASUREMENT
/begin MEASUREMENT autosar_swc_rlgs_rtARID_DEF.ARID_DEF_MATLABFunction1_k.Line_LaneExtraNearPointType "" UBYTE autosar_swc_rlgs_CM_uint8 0 0 0 255 ECU_ADDRESS 0xfe4aeb7b /* @ECU_Address@autosar_swc_rlgs_rtARID_DEF.ARID_DEF_MATLABFunction1_k.Line_LaneExtraNearPointType@ */ /end MEASUREMENT
/begin MEASUREMENT autosar_swc_rlgs_rtARID_DEF.ARID_DEF_MATLABFunction1_k.Line_LaneParsingConfidence "" UBYTE autosar_swc_rlgs_CM_uint8 0 0 0 255 ECU_ADDRESS 0xfe4aeb7d /* @ECU_Address@autosar_swc_rlgs_rtARID_DEF.ARID_DEF_MATLABFunction1_k.Line_LaneParsingConfidence@ */ /end MEASUREMENT
/begin MEASUREMENT autosar_swc_rlgs_rtARID_DEF.ARID_DEF_MATLABFunction1_k.Line_ObstacleFlag "" UBYTE autosar_swc_rlgs_CM_uint8 0 0 0 255 ECU_ADDRESS 0xfe4aeb7a /* @ECU_Address@autosar_swc_rlgs_rtARID_DEF.ARID_DEF_MATLABFunction1_k.Line_ObstacleFlag@ */ /end MEASUREMENT
/begin MEASUREMENT autosar_swc_rlgs_rtARID_DEF.ARID_DEF_MATLABFunction1_k.Line_Stopline_Relevancy "" UBYTE autosar_swc_rlgs_CM_uint8 0 0 0 255 ECU_ADDRESS 0xfe4aeb7e /* @ECU_Address@autosar_swc_rlgs_rtARID_DEF.ARID_DEF_MATLABFunction1_k.Line_Stopline_Relevancy@ */ /end MEASUREMENT
/begin MEASUREMENT autosar_swc_rlgs_rtARID_DEF.ARID_DEF_MATLABFunction1_k.Line_TrackID "" UWORD autosar_swc_rlgs_CM_uint16 0 0 0 65535 ECU_ADDRESS 0xfe4aeb74 /* @ECU_Address@autosar_swc_rlgs_rtARID_DEF.ARID_DEF_MATLABFunction1_k.Line_TrackID@ */ /end MEASUREMENT
/begin MEASUREMENT autosar_swc_rlgs_rtARID_DEF.ARID_DEF_MATLABFunction1_k.Line_bIsLineExist "" UBYTE autosar_swc_rlgs_CM_uint8 0 0 0 255 ECU_ADDRESS 0xfe4aeb76 /* @ECU_Address@autosar_swc_rlgs_rtARID_DEF.ARID_DEF_MATLABFunction1_k.Line_bIsLineExist@ */ /end MEASUREMENT
/begin MEASUREMENT autosar_swc_rlgs_rtARID_DEF.ARID_DEF_MATLABFunction1_k.Line_dC0V "" FLOAT32_IEEE autosar_swc_rlgs_CM_single 0 0 -3.4E+38 3.4E+38 ECU_ADDRESS 0xfe4aeb54 /* @ECU_Address@autosar_swc_rlgs_rtARID_DEF.ARID_DEF_MATLABFunction1_k.Line_dC0V@ */ /end MEASUREMENT
/begin MEASUREMENT autosar_swc_rlgs_rtARID_DEF.ARID_DEF_MATLABFunction1_k.Line_dC1V "" FLOAT32_IEEE autosar_swc_rlgs_CM_single 0 0 -3.4E+38 3.4E+38 ECU_ADDRESS 0xfe4aeb58 /* @ECU_Address@autosar_swc_rlgs_rtARID_DEF.ARID_DEF_MATLABFunction1_k.Line_dC1V@ */ /end MEASUREMENT
/begin MEASUREMENT autosar_swc_rlgs_rtARID_DEF.ARID_DEF_MATLABFunction1_k.Line_dC2V "" FLOAT32_IEEE autosar_swc_rlgs_CM_single 0 0 -3.4E+38 3.4E+38 ECU_ADDRESS 0xfe4aeb5c /* @ECU_Address@autosar_swc_rlgs_rtARID_DEF.ARID_DEF_MATLABFunction1_k.Line_dC2V@ */ /end MEASUREMENT
/begin MEASUREMENT autosar_swc_rlgs_rtARID_DEF.ARID_DEF_MATLABFunction1_k.Line_dC3V "" FLOAT32_IEEE autosar_swc_rlgs_CM_single 0 0 -3.4E+38 3.4E+38 ECU_ADDRESS 0xfe4aeb60 /* @ECU_Address@autosar_swc_rlgs_rtARID_DEF.ARID_DEF_MATLABFunction1_k.Line_dC3V@ */ /end MEASUREMENT
/begin MEASUREMENT autosar_swc_rlgs_rtARID_DEF.ARID_DEF_MATLABFunction1_k.Line_dDisFront "" FLOAT32_IEEE autosar_swc_rlgs_CM_single 0 0 -3.4E+38 3.4E+38 ECU_ADDRESS 0xfe4aeb50 /* @ECU_Address@autosar_swc_rlgs_rtARID_DEF.ARID_DEF_MATLABFunction1_k.Line_dDisFront@ */ /end MEASUREMENT
/begin MEASUREMENT autosar_swc_rlgs_rtARID_DEF.ARID_DEF_MATLABFunction1_k.Line_dDisStart "" FLOAT32_IEEE autosar_swc_rlgs_CM_single 0 0 -3.4E+38 3.4E+38 ECU_ADDRESS 0xfe4aeb4c /* @ECU_Address@autosar_swc_rlgs_rtARID_DEF.ARID_DEF_MATLABFunction1_k.Line_dDisStart@ */ /end MEASUREMENT
/begin MEASUREMENT autosar_swc_rlgs_rtARID_DEF.ARID_DEF_MATLABFunction1_k.Line_dLaneWidth "" FLOAT32_IEEE autosar_swc_rlgs_CM_single 0 0 -3.4E+38 3.4E+38 ECU_ADDRESS 0xfe4aeb48 /* @ECU_Address@autosar_swc_rlgs_rtARID_DEF.ARID_DEF_MATLABFunction1_k.Line_dLaneWidth@ */ /end MEASUREMENT
/begin MEASUREMENT autosar_swc_rlgs_rtARID_DEF.ARID_DEF_MATLABFunction1_k.Line_dQuality "" FLOAT32_IEEE autosar_swc_rlgs_CM_single 0 0 -3.4E+38 3.4E+38 ECU_ADDRESS 0xfe4aeb44 /* @ECU_Address@autosar_swc_rlgs_rtARID_DEF.ARID_DEF_MATLABFunction1_k.Line_dQuality@ */ /end MEASUREMENT
/begin MEASUREMENT autosar_swc_rlgs_rtARID_DEF.ARID_DEF_MATLABFunction1_k.Line_eColour "" UBYTE autosar_swc_rlgs_CM_uint8 0 0 0 255 ECU_ADDRESS 0xfe4aeb78 /* @ECU_Address@autosar_swc_rlgs_rtARID_DEF.ARID_DEF_MATLABFunction1_k.Line_eColour@ */ /end MEASUREMENT
/begin MEASUREMENT autosar_swc_rlgs_rtARID_DEF.ARID_DEF_MATLABFunction1_k.Line_eLineType "" UBYTE autosar_swc_rlgs_CM_uint8 0 0 0 255 ECU_ADDRESS 0xfe4aeb77 /* @ECU_Address@autosar_swc_rlgs_rtARID_DEF.ARID_DEF_MATLABFunction1_k.Line_eLineType@ */ /end MEASUREMENT
/begin MEASUREMENT autosar_swc_rlgs_rtARID_DEF.ARID_DEF_MATLABFunction6.Line_Crossing "" UBYTE autosar_swc_rlgs_CM_uint8 0 0 0 255 ECU_ADDRESS 0xfe4aeced /* @ECU_Address@autosar_swc_rlgs_rtARID_DEF.ARID_DEF_MATLABFunction6.Line_Crossing@ */ /end MEASUREMENT
/begin MEASUREMENT autosar_swc_rlgs_rtARID_DEF.ARID_DEF_MATLABFunction6.Line_LaneExtraFarPointPosX "" FLOAT32_IEEE autosar_swc_rlgs_CM_single 0 0 -3.4E+38 3.4E+38 ECU_ADDRESS 0xfe4aecd8 /* @ECU_Address@autosar_swc_rlgs_rtARID_DEF.ARID_DEF_MATLABFunction6.Line_LaneExtraFarPointPosX@ */ /end MEASUREMENT
/begin MEASUREMENT autosar_swc_rlgs_rtARID_DEF.ARID_DEF_MATLABFunction6.Line_LaneExtraFarPointPosY "" FLOAT32_IEEE autosar_swc_rlgs_CM_single 0 0 -3.4E+38 3.4E+38 ECU_ADDRESS 0xfe4aecdc /* @ECU_Address@autosar_swc_rlgs_rtARID_DEF.ARID_DEF_MATLABFunction6.Line_LaneExtraFarPointPosY@ */ /end MEASUREMENT
/begin COMPU_METHOD autosar_swc_rlgs_CM_int16 "Q = V" IDENTICAL "%5.0" "" /end COMPU_METHOD
/begin COMPU_METHOD autosar_swc_rlgs_CM_int8 "Q = V" IDENTICAL "%3.0" "" /end COMPU_METHOD
/begin COMPU_METHOD autosar_swc_rlgs_CM_logical "Q = V" IDENTICAL "%1.0" "" /end COMPU_METHOD
/begin COMPU_METHOD autosar_swc_rlgs_CM_single "Q = V" IDENTICAL "%8.6" "" /end COMPU_METHOD
/begin COMPU_METHOD autosar_swc_rlgs_CM_uint16 "Q = V" IDENTICAL "%5.0" "" /end COMPU_METHOD
/begin COMPU_METHOD autosar_swc_rlgs_CM_uint32 "Q = V" IDENTICAL "%10.0" "" /end COMPU_METHOD
/begin COMPU_METHOD autosar_swc_rlgs_CM_uint8 "Q = V" IDENTICAL "%3.0" "" /end COMPU_METHOD
/begin RECORD_LAYOUT Record_FLOAT32_IEEE FNC_VALUES 1 FLOAT32_IEEE COLUMN_DIR DIRECT /end RECORD_LAYOUT
/begin RECORD_LAYOUT Record_SBYTE FNC_VALUES 1 SBYTE COLUMN_DIR DIRECT /end RECORD_LAYOUT
/begin RECORD_LAYOUT Record_SWORD FNC_VALUES 1 SWORD COLUMN_DIR DIRECT /end RECORD_LAYOUT
/begin RECORD_LAYOUT Record_UBYTE FNC_VALUES 1 UBYTE COLUMN_DIR DIRECT /end RECORD_LAYOUT
/begin RECORD_LAYOUT Record_ULONG FNC_VALUES 1 ULONG COLUMN_DIR DIRECT /end RECORD_LAYOUT
/begin RECORD_LAYOUT Record_UWORD FNC_VALUES 1 UWORD COLUMN_DIR DIRECT /end RECORD_LAYOUT
/begin RECORD_LAYOUT Record_FLOAT32_IEEE FNC_VALUES 1 FLOAT32_IEEE COLUMN_DIR DIRECT /end RECORD_LAYOUT
/begin RECORD_LAYOUT Record_SBYTE FNC_VALUES 1 SBYTE COLUMN_DIR DIRECT /end RECORD_LAYOUT
/begin RECORD_LAYOUT Record_SWORD FNC_VALUES 1 SWORD COLUMN_DIR DIRECT /end RECORD_LAYOUT
/begin RECORD_LAYOUT Record_UBYTE FNC_VALUES 1 UBYTE COLUMN_DIR DIRECT /end RECORD_LAYOUT
/begin RECORD_LAYOUT Record_ULONG FNC_VALUES 1 ULONG COLUMN_DIR DIRECT /end RECORD_LAYOUT
/begin RECORD_LAYOUT Record_UWORD FNC_VALUES 1 UWORD COLUMN_DIR DIRECT /end RECORD_LAYOUT
/begin RECORD_LAYOUT Record_FLOAT32_IEEE FNC_VALUES 1 FLOAT32_IEEE COLUMN_DIR DIRECT /end RECORD_LAYOUT
/begin RECORD_LAYOUT Record_SBYTE FNC_VALUES 1 SBYTE COLUMN_DIR DIRECT /end RECORD_LAYOUT
/begin RECORD_LAYOUT Record_SWORD FNC_VALUES 1 SWORD COLUMN_DIR DIRECT /end RECORD_LAYOUT
/begin RECORD_LAYOUT Record_UBYTE FNC_VALUES 1 UBYTE COLUMN_DIR DIRECT /end RECORD_LAYOUT
/begin RECORD_LAYOUT Record_ULONG FNC_VALUES 1 ULONG COLUMN_DIR DIRECT /end RECORD_LAYOUT
/begin RECORD_LAYOUT Record_UWORD FNC_VALUES 1 UWORD COLUMN_DIR DIRECT /end RECORD_LAYOUT
/begin RECORD_LAYOUT Record_FLOAT32_IEEE FNC_VALUES 1 FLOAT32_IEEE COLUMN_DIR DIRECT /end RECORD_LAYOUT
/begin RECORD_LAYOUT Record_SBYTE FNC_VALUES 1 SBYTE COLUMN_DIR DIRECT /end RECORD_LAYOUT
/begin RECORD_LAYOUT Record_SWORD FNC_VALUES 1 SWORD COLUMN_DIR DIRECT /end RECORD_LAYOUT
/begin RECORD_LAYOUT Record_UBYTE FNC_VALUES 1 UBYTE COLUMN_DIR DIRECT /end RECORD_LAYOUT
/begin RECORD_LAYOUT Record_ULONG FNC_VALUES 1 ULONG COLUMN_DIR DIRECT /end RECORD_LAYOUT
/begin RECORD_LAYOUT Record_UWORD FNC_VALUES 1 UWORD COLUMN_DIR DIRECT /end RECORD_LAYOUT
/begin RECORD_LAYOUT Record_FLOAT32_IEEE FNC_VALUES 1 FLOAT32_IEEE COLUMN_DIR DIRECT /end RECORD_LAYOUT
/begin RECORD_LAYOUT Record_SBYTE FNC_VALUES 1 SBYTE COLUMN_DIR DIRECT /end RECORD_LAYOUT
/begin RECORD_LAYOUT Record_SWORD FNC_VALUES 1 SWORD COLUMN_DIR DIRECT /end RECORD_LAYOUT
/begin RECORD_LAYOUT Record_UBYTE FNC_VALUES 1 UBYTE COLUMN_DIR DIRECT /end RECORD_LAYOUT
/begin RECORD_LAYOUT Record_ULONG FNC_VALUES 1 ULONG COLUMN_DIR DIRECT /end RECORD_LAYOUT
/begin RECORD_LAYOUT Record_UWORD FNC_VALUES 1 UWORD COLUMN_DIR DIRECT /end RECORD_LAYOUT
/begin RECORD_LAYOUT Record_FLOAT32_IEEE FNC_VALUES 1 FLOAT32_IEEE COLUMN_DIR DIRECT /end RECORD_LAYOUT
/begin RECORD_LAYOUT Record_SBYTE FNC_VALUES 1 SBYTE COLUMN_DIR DIRECT /end RECORD_LAYOUT
/begin RECORD_LAYOUT Record_SWORD FNC_VALUES 1 SWORD COLUMN_DIR DIRECT /end RECORD_LAYOUT
/begin RECORD_LAYOUT Record_UBYTE FNC_VALUES 1 UBYTE COLUMN_DIR DIRECT /end RECORD_LAYOUT
/begin RECORD_LAYOUT Record_ULONG FNC_VALUES 1 ULONG COLUMN_DIR DIRECT /end RECORD_LAYOUT
/begin RECORD_LAYOUT Record_UWORD FNC_VALUES 1 UWORD COLUMN_DIR DIRECT /end RECORD_LAYOUT
/end MODULE
/end PROJECT
