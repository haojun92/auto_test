ASAP2_VERSION 1 71
/begin PROJECT ProjectName ""
/begin MODULE ModuleName ""
/begin MOD_COMMON "" BYTE_ORDER MSB_LAST ALIGNMENT_BYTE 1 ALIGNMENT_WORD 1 ALIGNMENT_LONG 1 ALIGNMENT_INT64 1 ALIGNMENT_FLOAT16_IEEE 1 ALIGNMENT_FLOAT32_IEEE 1 ALIGNMENT_FLOAT64_IEEE 1 /end MOD_COMMON
/begin RECORD_LAYOUT SSV__UBYTE_S AXIS_PTS_X 1 UBYTE INDEX_INCR DIRECT /end RECORD_LAYOUT
/begin RECORD_LAYOUT Record_BOOLEAN FNC_VALUES 1 UBYTE COLUMN_DIR DIRECT /end RECORD_LAYOUT
/begin RECORD_LAYOUT Record_FLOAT32_IEEE FNC_VALUES 1 FLOAT32_IEEE COLUMN_DIR DIRECT /end RECORD_LAYOUT
/begin RECORD_LAYOUT Record_FLOAT64_IEEE FNC_VALUES 1 FLOAT64_IEEE COLUMN_DIR DIRECT /end RECORD_LAYOUT
/begin RECORD_LAYOUT Record_UBYTE FNC_VALUES 1 UBYTE COLUMN_DIR DIRECT /end RECORD_LAYOUT
/begin RECORD_LAYOUT Record_ULONG FNC_VALUES 1 ULONG COLUMN_DIR DIRECT /end RECORD_LAYOUT
/begin RECORD_LAYOUT Record_UWORD FNC_VALUES 1 UWORD COLUMN_DIR DIRECT /end RECORD_LAYOUT
/begin RECORD_LAYOUT Axis_FLOAT32_IEEE AXIS_PTS_X 1 FLOAT32_IEEE INDEX_INCR DIRECT /end RECORD_LAYOUT
/begin RECORD_LAYOUT Record_BOOLEAN FNC_VALUES 1 UBYTE COLUMN_DIR DIRECT /end RECORD_LAYOUT
/begin RECORD_LAYOUT Record_FLOAT32_IEEE FNC_VALUES 1 FLOAT32_IEEE COLUMN_DIR DIRECT /end RECORD_LAYOUT
/begin RECORD_LAYOUT Record_UBYTE FNC_VALUES 1 UBYTE COLUMN_DIR DIRECT /end RECORD_LAYOUT
/begin RECORD_LAYOUT Record_ULONG FNC_VALUES 1 ULONG COLUMN_DIR DIRECT /end RECORD_LAYOUT
/begin RECORD_LAYOUT Record_UWORD FNC_VALUES 1 UWORD COLUMN_DIR DIRECT /end RECORD_LAYOUT
/begin RECORD_LAYOUT Axis_FLOAT32_IEEE AXIS_PTS_X 1 FLOAT32_IEEE INDEX_INCR DIRECT /end RECORD_LAYOUT
/begin RECORD_LAYOUT Record_BOOLEAN FNC_VALUES 1 UBYTE COLUMN_DIR DIRECT /end RECORD_LAYOUT
/begin RECORD_LAYOUT Record_FLOAT32_IEEE FNC_VALUES 1 FLOAT32_IEEE COLUMN_DIR DIRECT /end RECORD_LAYOUT
/begin RECORD_LAYOUT Record_FLOAT64_IEEE FNC_VALUES 1 FLOAT64_IEEE COLUMN_DIR DIRECT /end RECORD_LAYOUT
/begin RECORD_LAYOUT Record_UBYTE FNC_VALUES 1 UBYTE COLUMN_DIR DIRECT /end RECORD_LAYOUT
/begin RECORD_LAYOUT Record_ULONG FNC_VALUES 1 ULONG COLUMN_DIR DIRECT /end RECORD_LAYOUT
/begin RECORD_LAYOUT Record_BOOLEAN FNC_VALUES 1 UBYTE COLUMN_DIR DIRECT /end RECORD_LAYOUT
/begin RECORD_LAYOUT Record_FLOAT32_IEEE FNC_VALUES 1 FLOAT32_IEEE COLUMN_DIR DIRECT /end RECORD_LAYOUT
/begin RECORD_LAYOUT Record_UBYTE FNC_VALUES 1 UBYTE COLUMN_DIR DIRECT /end RECORD_LAYOUT
/begin RECORD_LAYOUT Record_ULONG FNC_VALUES 1 ULONG COLUMN_DIR DIRECT /end RECORD_LAYOUT
/begin RECORD_LAYOUT Record_UWORD FNC_VALUES 1 UWORD COLUMN_DIR DIRECT /end RECORD_LAYOUT
/begin RECORD_LAYOUT Axis_FLOAT32_IEEE AXIS_PTS_X 1 FLOAT32_IEEE INDEX_INCR DIRECT /end RECORD_LAYOUT
/begin CHARACTERISTIC P_LSS_ELK_AccRateIn "" VALUE 0xfe821090 /* @ECU_Address@P_LSS_ELK_AccRateIn@ */ Record_FLOAT32_IEEE 0 autosar_swc_las_CM_single -3.4E+38 3.4E+38 /end CHARACTERISTIC
/begin CHARACTERISTIC P_LSS_ELK_AccRateInTime "" VALUE 0xfe821094 /* @ECU_Address@P_LSS_ELK_AccRateInTime@ */ Record_FLOAT32_IEEE 0 autosar_swc_las_CM_single -3.4E+38 3.4E+38 /end CHARACTERISTIC
/begin CHARACTERISTIC P_LSS_ELK_AccRateOut "" VALUE 0xfe821098 /* @ECU_Address@P_LSS_ELK_AccRateOut@ */ Record_FLOAT32_IEEE 0 autosar_swc_las_CM_single -3.4E+38 3.4E+38 /end CHARACTERISTIC
/begin CHARACTERISTIC P_LSS_ELK_AccRateOutTime "" VALUE 0xfe82109c /* @ECU_Address@P_LSS_ELK_AccRateOutTime@ */ Record_FLOAT32_IEEE 0 autosar_swc_las_CM_single -3.4E+38 3.4E+38 /end CHARACTERISTIC
/begin CHARACTERISTIC P_LSS_ELK_BrakePressIn "" VALUE 0xfe8210a0 /* @ECU_Address@P_LSS_ELK_BrakePressIn@ */ Record_FLOAT32_IEEE 0 autosar_swc_las_CM_single -3.4E+38 3.4E+38 /end CHARACTERISTIC
/begin CHARACTERISTIC P_LSS_ELK_BrakePressInTime "" VALUE 0xfe8210a4 /* @ECU_Address@P_LSS_ELK_BrakePressInTime@ */ Record_FLOAT32_IEEE 0 autosar_swc_las_CM_single -3.4E+38 3.4E+38 /end CHARACTERISTIC
/begin CHARACTERISTIC P_LSS_ELK_BrakePressOut "" VALUE 0xfe8210a8 /* @ECU_Address@P_LSS_ELK_BrakePressOut@ */ Record_FLOAT32_IEEE 0 autosar_swc_las_CM_single -3.4E+38 3.4E+38 /end CHARACTERISTIC
/begin CHARACTERISTIC P_LSS_ELK_Configure "" VALUE 0xfe82146b /* @ECU_Address@P_LSS_ELK_Configure@ */ Record_UBYTE 0 autosar_swc_las_CM_uint8 0 255 /end CHARACTERISTIC
/begin CHARACTERISTIC P_LSS_ELK_ConfigureSW "" VALUE 0xfe82146c /* @ECU_Address@P_LSS_ELK_ConfigureSW@ */ Record_BOOLEAN 0 autosar_swc_las_CM_boolean 0 1 /end CHARACTERISTIC
/begin CHARACTERISTIC P_LSS_ELK_CurveFactor "" VALUE 0xfe8210ac /* @ECU_Address@P_LSS_ELK_CurveFactor@ */ Record_FLOAT32_IEEE 0 autosar_swc_las_CM_single -3.4E+38 3.4E+38 /end CHARACTERISTIC
/begin CHARACTERISTIC P_LSS_ELK_DriverInputTrqValueIn "" VALUE 0xfe8210b4 /* @ECU_Address@P_LSS_ELK_DriverInputTrqValueIn@ */ Record_FLOAT32_IEEE 0 autosar_swc_las_CM_single -3.4E+38 3.4E+38 /end CHARACTERISTIC
/begin CHARACTERISTIC P_LSS_ELK_DriverInputTrqValueOut "" VALUE 0xfe8210b8 /* @ECU_Address@P_LSS_ELK_DriverInputTrqValueOut@ */ Record_FLOAT32_IEEE 0 autosar_swc_las_CM_single -3.4E+38 3.4E+38 /end CHARACTERISTIC
/begin CHARACTERISTIC P_LSS_ELK_DriverInputTrqValueOutTime "" VALUE 0xfe8210bc /* @ECU_Address@P_LSS_ELK_DriverInputTrqValueOutTime@ */ Record_FLOAT32_IEEE 0 autosar_swc_las_CM_single -3.4E+38 3.4E+38 /end CHARACTERISTIC
/begin CHARACTERISTIC P_LSS_ELK_ExitVehSpdMaxValue_kph "" VALUE 0xfe8210c0 /* @ECU_Address@P_LSS_ELK_ExitVehSpdMaxValue_kph@ */ Record_FLOAT32_IEEE 0 autosar_swc_las_CM_single -3.4E+38 3.4E+38 /end CHARACTERISTIC
/begin CHARACTERISTIC P_LSS_ELK_ExitVehSpdMinValue_kph "" VALUE 0xfe8210c4 /* @ECU_Address@P_LSS_ELK_ExitVehSpdMinValue_kph@ */ Record_FLOAT32_IEEE 0 autosar_swc_las_CM_single -3.4E+38 3.4E+38 /end CHARACTERISTIC
/begin CHARACTERISTIC P_LSS_ELK_LaneCurveIn "" VALUE 0xfe8210d0 /* @ECU_Address@P_LSS_ELK_LaneCurveIn@ */ Record_FLOAT32_IEEE 0 autosar_swc_las_CM_single -3.4E+38 3.4E+38 /end CHARACTERISTIC
/begin CHARACTERISTIC P_LSS_ELK_LaneCurveOut "" VALUE 0xfe8210d4 /* @ECU_Address@P_LSS_ELK_LaneCurveOut@ */ Record_FLOAT32_IEEE 0 autosar_swc_las_CM_single -3.4E+38 3.4E+38 /end CHARACTERISTIC
/begin CHARACTERISTIC P_LSS_ELK_Lane_Width_Table_Calibration "" CURVE 0xfe8217d0 /* @ECU_Address@P_LSS_ELK_Lane_Width_Table_Calibration@ */ Record_FLOAT32_IEEE 0 autosar_swc_las_CM_single -3.4E+38 3.4E+38
 /begin AXIS_DESCR COM_AXIS NO_INPUT_QUANTITY autosar_swc_las_CM_single 7 -3.4E+38 3.4E+38 AXIS_PTS_REF P_LSS_ELK_Lane_Width_Table /end AXIS_DESCR
/end CHARACTERISTIC
/begin CHARACTERISTIC P_LSS_ELK_Sensitive_Switch "" VALUE 0xfe821000 /* @ECU_Address@P_LSS_ELK_Sensitive_Switch@ */ Record_FLOAT64_IEEE 0 autosar_swc_las_CM_double -1.7E+308 1.7E+308 /end CHARACTERISTIC
/begin CHARACTERISTIC P_LSS_ELK_Sensitive_Table_Calibration "" CURVE 0xfe8217f8 /* @ECU_Address@P_LSS_ELK_Sensitive_Table_Calibration@ */ Record_FLOAT32_IEEE 0 autosar_swc_las_CM_single -3.4E+38 3.4E+38
 /begin AXIS_DESCR COM_AXIS NO_INPUT_QUANTITY autosar_swc_las_CM_single 3 -3.4E+38 3.4E+38 AXIS_PTS_REF P_LSS_ELK_Sensitive_Table /end AXIS_DESCR
/end CHARACTERISTIC
/begin CHARACTERISTIC P_LSS_ELK_State_AEBActiveOutTime "" VALUE 0xfe8211ac /* @ECU_Address@P_LSS_ELK_State_AEBActiveOutTime@ */ Record_FLOAT32_IEEE 0 autosar_swc_las_CM_single -3.4E+38 3.4E+38 /end CHARACTERISTIC
/begin CHARACTERISTIC P_LSS_ELK_State_AEBActive_enable "" VALUE 0xfe8211b0 /* @ECU_Address@P_LSS_ELK_State_AEBActive_enable@ */ Record_FLOAT32_IEEE 0 autosar_swc_las_CM_single -3.4E+38 3.4E+38 /end CHARACTERISTIC
/begin CHARACTERISTIC P_LSS_ELK_State_Absesp_enable "" VALUE 0xfe8211b4 /* @ECU_Address@P_LSS_ELK_State_Absesp_enable@ */ Record_FLOAT32_IEEE 0 autosar_swc_las_CM_single -3.4E+38 3.4E+38 /end CHARACTERISTIC
/begin CHARACTERISTIC P_LSS_ELK_State_Accpedalrate_enable "" VALUE 0xfe8211b8 /* @ECU_Address@P_LSS_ELK_State_Accpedalrate_enable@ */ Record_FLOAT32_IEEE 0 autosar_swc_las_CM_single -3.4E+38 3.4E+38 /end CHARACTERISTIC
/begin CHARACTERISTIC P_LSS_ELK_State_Breakpressure_enable "" VALUE 0xfe8211bc /* @ECU_Address@P_LSS_ELK_State_Breakpressure_enable@ */ Record_FLOAT32_IEEE 0 autosar_swc_las_CM_single -3.4E+38 3.4E+38 /end CHARACTERISTIC
/begin CHARACTERISTIC P_LSS_ELK_State_DriverInputTrqValue_enable "" VALUE 0xfe8211c0 /* @ECU_Address@P_LSS_ELK_State_DriverInputTrqValue_enable@ */ Record_FLOAT32_IEEE 0 autosar_swc_las_CM_single -3.4E+38 3.4E+38 /end CHARACTERISTIC
/begin CHARACTERISTIC P_LSS_ELK_State_DriverInputTrqValue_enableTime "" VALUE 0xfe8211c4 /* @ECU_Address@P_LSS_ELK_State_DriverInputTrqValue_enableTime@ */ Record_FLOAT32_IEEE 0 autosar_swc_las_CM_single -3.4E+38 3.4E+38 /end CHARACTERISTIC
/begin CHARACTERISTIC P_LSS_ELK_State_EPSOn_enable "" VALUE 0xfe8211c8 /* @ECU_Address@P_LSS_ELK_State_EPSOn_enable@ */ Record_FLOAT32_IEEE 0 autosar_swc_las_CM_single -3.4E+38 3.4E+38 /end CHARACTERISTIC
/begin CHARACTERISTIC P_LSS_ELK_State_ESPOn_enable "" VALUE 0xfe8211cc /* @ECU_Address@P_LSS_ELK_State_ESPOn_enable@ */ Record_FLOAT32_IEEE 0 autosar_swc_las_CM_single -3.4E+38 3.4E+38 /end CHARACTERISTIC
/begin CHARACTERISTIC P_LSS_ELK_State_GEAR_enable "" VALUE 0xfe821479 /* @ECU_Address@P_LSS_ELK_State_GEAR_enable@ */ Record_BOOLEAN 0 autosar_swc_las_CM_boolean 0 1 /end CHARACTERISTIC
/begin CHARACTERISTIC P_LSS_ELK_State_HazardLmpSts_enable "" VALUE 0xfe82147a /* @ECU_Address@P_LSS_ELK_State_HazardLmpSts_enable@ */ Record_BOOLEAN 0 autosar_swc_las_CM_boolean 0 1 /end CHARACTERISTIC
/begin CHARACTERISTIC P_LSS_ELK_State_HazardLmpSts_enableTime "" VALUE 0xfe8211d0 /* @ECU_Address@P_LSS_ELK_State_HazardLmpSts_enableTime@ */ Record_FLOAT32_IEEE 0 autosar_swc_las_CM_single -3.4E+38 3.4E+38 /end CHARACTERISTIC
/begin CHARACTERISTIC P_LSS_ELK_State_Inhibit_enable "" VALUE 0xfe82147b /* @ECU_Address@P_LSS_ELK_State_Inhibit_enable@ */ Record_BOOLEAN 0 autosar_swc_las_CM_boolean 0 1 /end CHARACTERISTIC
/begin CHARACTERISTIC P_LSS_ELK_State_LaneChange_enable "" VALUE 0xfe82147c /* @ECU_Address@P_LSS_ELK_State_LaneChange_enable@ */ Record_BOOLEAN 0 autosar_swc_las_CM_boolean 0 1 /end CHARACTERISTIC
/begin CHARACTERISTIC P_LSS_ELK_State_Lane_enable "" VALUE 0xfe82147d /* @ECU_Address@P_LSS_ELK_State_Lane_enable@ */ Record_BOOLEAN 0 autosar_swc_las_CM_boolean 0 1 /end CHARACTERISTIC
/begin CHARACTERISTIC P_LSS_ELK_State_LanecurveOutTime "" VALUE 0xfe8211d4 /* @ECU_Address@P_LSS_ELK_State_LanecurveOutTime@ */ Record_FLOAT32_IEEE 0 autosar_swc_las_CM_single -3.4E+38 3.4E+38 /end CHARACTERISTIC
/begin CHARACTERISTIC P_LSS_ELK_State_Lanecurve_enable "" VALUE 0xfe82147e /* @ECU_Address@P_LSS_ELK_State_Lanecurve_enable@ */ Record_BOOLEAN 0 autosar_swc_las_CM_boolean 0 1 /end CHARACTERISTIC
/begin CHARACTERISTIC P_LSS_ELK_State_LineInterventionSWSts "" VALUE 0xfe82147f /* @ECU_Address@P_LSS_ELK_State_LineInterventionSWSts@ */ Record_UBYTE 0 autosar_swc_las_CM_uint8 0 255 /end CHARACTERISTIC
/begin CHARACTERISTIC P_LSS_ELK_State_Param_AngleOffset "" VALUE 0xfe8211e0 /* @ECU_Address@P_LSS_ELK_State_Param_AngleOffset@ */ Record_FLOAT32_IEEE 0 autosar_swc_las_CM_single -3.4E+38 3.4E+38 /end CHARACTERISTIC
/begin CHARACTERISTIC P_LSS_ELK_State_Param_LaneCurve_Offset "" CURVE 0xfe8215a4 /* @ECU_Address@P_LSS_ELK_State_Param_LaneCurve_Offset@ */ Record_FLOAT32_IEEE 0 autosar_swc_las_CM_single -3.4E+38 3.4E+38
 /begin AXIS_DESCR COM_AXIS NO_INPUT_QUANTITY autosar_swc_las_CM_single 8 -3.4E+38 3.4E+38 AXIS_PTS_REF P_LSS_ELK_State_Param_LaneCurve /end AXIS_DESCR
/end CHARACTERISTIC
/begin CHARACTERISTIC P_LSS_ELK_State_Param_OnTime "" CURVE 0xfe8215c4 /* @ECU_Address@P_LSS_ELK_State_Param_OnTime@ */ Record_FLOAT32_IEEE 0 autosar_swc_las_CM_single -3.4E+38 3.4E+38
 /begin AXIS_DESCR COM_AXIS NO_INPUT_QUANTITY autosar_swc_las_CM_single 16 -3.4E+38 3.4E+38 AXIS_PTS_REF P_LSS_ELK_State_Param_Speed /end AXIS_DESCR
/end CHARACTERISTIC
/begin CHARACTERISTIC P_LSS_ELK_State_Param_Oncoming "" VALUE 0xfe8211ec /* @ECU_Address@P_LSS_ELK_State_Param_Oncoming@ */ Record_FLOAT32_IEEE 0 autosar_swc_las_CM_single -3.4E+38 3.4E+38 /end CHARACTERISTIC
/begin CHARACTERISTIC P_LSS_ELK_State_Param_OutOffset "" VALUE 0xfe8211f0 /* @ECU_Address@P_LSS_ELK_State_Param_OutOffset@ */ Record_FLOAT32_IEEE 0 autosar_swc_las_CM_single -3.4E+38 3.4E+38 /end CHARACTERISTIC
/begin CHARACTERISTIC P_LSS_ELK_State_Param_OvTime "" CURVE 0xfe821604 /* @ECU_Address@P_LSS_ELK_State_Param_OvTime@ */ Record_FLOAT32_IEEE 0 autosar_swc_las_CM_single -3.4E+38 3.4E+38
 /begin AXIS_DESCR COM_AXIS NO_INPUT_QUANTITY autosar_swc_las_CM_single 16 -3.4E+38 3.4E+38 AXIS_PTS_REF P_LSS_ELK_State_Param_Speed /end AXIS_DESCR
/end CHARACTERISTIC
/begin CHARACTERISTIC P_LSS_ELK_State_Param_Over "" VALUE 0xfe8211f4 /* @ECU_Address@P_LSS_ELK_State_Param_Over@ */ Record_FLOAT32_IEEE 0 autosar_swc_las_CM_single -3.4E+38 3.4E+38 /end CHARACTERISTIC
/begin CHARACTERISTIC P_LSS_ELK_State_SteerWheelAngle_enable "" VALUE 0xfe821204 /* @ECU_Address@P_LSS_ELK_State_SteerWheelAngle_enable@ */ Record_FLOAT32_IEEE 0 autosar_swc_las_CM_single -3.4E+38 3.4E+38 /end CHARACTERISTIC
/begin CHARACTERISTIC P_LSS_ELK_State_SteerWheelSpd_enable "" VALUE 0xfe821208 /* @ECU_Address@P_LSS_ELK_State_SteerWheelSpd_enable@ */ Record_FLOAT32_IEEE 0 autosar_swc_las_CM_single -3.4E+38 3.4E+38 /end CHARACTERISTIC
/begin CHARACTERISTIC P_LSS_ELK_State_TrailerSts_enable "" VALUE 0xfe82120c /* @ECU_Address@P_LSS_ELK_State_TrailerSts_enable@ */ Record_FLOAT32_IEEE 0 autosar_swc_las_CM_single -3.4E+38 3.4E+38 /end CHARACTERISTIC
/begin CHARACTERISTIC P_LSS_ELK_State_TurnSWSts_enable "" VALUE 0xfe821210 /* @ECU_Address@P_LSS_ELK_State_TurnSWSts_enable@ */ Record_FLOAT32_IEEE 0 autosar_swc_las_CM_single -3.4E+38 3.4E+38 /end CHARACTERISTIC
/begin CHARACTERISTIC P_LSS_ELK_State_Vehspeed_enable "" VALUE 0xfe821480 /* @ECU_Address@P_LSS_ELK_State_Vehspeed_enable@ */ Record_BOOLEAN 0 autosar_swc_las_CM_boolean 0 1 /end CHARACTERISTIC
/begin CHARACTERISTIC P_LSS_ELK_State_Vehspeed_enableTime "" VALUE 0xfe821214 /* @ECU_Address@P_LSS_ELK_State_Vehspeed_enableTime@ */ Record_FLOAT32_IEEE 0 autosar_swc_las_CM_single -3.4E+38 3.4E+38 /end CHARACTERISTIC
/begin CHARACTERISTIC P_LSS_ELK_State_Yawsup_enable "" VALUE 0xfe821218 /* @ECU_Address@P_LSS_ELK_State_Yawsup_enable@ */ Record_FLOAT32_IEEE 0 autosar_swc_las_CM_single -3.4E+38 3.4E+38 /end CHARACTERISTIC
/begin CHARACTERISTIC P_LSS_ELK_State_Yawsup_enableTime "" VALUE 0xfe82121c /* @ECU_Address@P_LSS_ELK_State_Yawsup_enableTime@ */ Record_FLOAT32_IEEE 0 autosar_swc_las_CM_single -3.4E+38 3.4E+38 /end CHARACTERISTIC
/begin CHARACTERISTIC P_LSS_ELK_SteerSpd2IDEL_SteerSpdFactor "" VALUE 0xfe821220 /* @ECU_Address@P_LSS_ELK_SteerSpd2IDEL_SteerSpdFactor@ */ Record_FLOAT32_IEEE 0 autosar_swc_las_CM_single -3.4E+38 3.4E+38 /end CHARACTERISTIC
/begin CHARACTERISTIC P_LSS_ELK_SteerSpd2IEDL_VehicleSpdFactor "" VALUE 0xfe821224 /* @ECU_Address@P_LSS_ELK_SteerSpd2IEDL_VehicleSpdFactor@ */ Record_FLOAT32_IEEE 0 autosar_swc_las_CM_single -3.4E+38 3.4E+38 /end CHARACTERISTIC
/begin CHARACTERISTIC P_LSS_ELK_SteerSpd2Ready_SteerSpdFactor "" VALUE 0xfe821228 /* @ECU_Address@P_LSS_ELK_SteerSpd2Ready_SteerSpdFactor@ */ Record_FLOAT32_IEEE 0 autosar_swc_las_CM_single -3.4E+38 3.4E+38 /end CHARACTERISTIC
/begin CHARACTERISTIC P_LSS_ELK_SteerSpd2Ready_VehicleSpdFactor "" VALUE 0xfe82122c /* @ECU_Address@P_LSS_ELK_SteerSpd2Ready_VehicleSpdFactor@ */ Record_FLOAT32_IEEE 0 autosar_swc_las_CM_single -3.4E+38 3.4E+38 /end CHARACTERISTIC
/begin CHARACTERISTIC P_LSS_ELK_SteerWheelAngleOutTime "" VALUE 0xfe821230 /* @ECU_Address@P_LSS_ELK_SteerWheelAngleOutTime@ */ Record_FLOAT32_IEEE 0 autosar_swc_las_CM_single -3.4E+38 3.4E+38 /end CHARACTERISTIC
/begin CHARACTERISTIC P_LSS_ELK_SteerWheelSpdInTime "" VALUE 0xfe821234 /* @ECU_Address@P_LSS_ELK_SteerWheelSpdInTime@ */ Record_FLOAT32_IEEE 0 autosar_swc_las_CM_single -3.4E+38 3.4E+38 /end CHARACTERISTIC
/begin CHARACTERISTIC P_LSS_ELK_TrailerStsInTime "" VALUE 0xfe821238 /* @ECU_Address@P_LSS_ELK_TrailerStsInTime@ */ Record_FLOAT32_IEEE 0 autosar_swc_las_CM_single -3.4E+38 3.4E+38 /end CHARACTERISTIC
/begin CHARACTERISTIC P_LSS_ELK_VehSpdMaxValue_kph "" VALUE 0xfe821240 /* @ECU_Address@P_LSS_ELK_VehSpdMaxValue_kph@ */ Record_FLOAT32_IEEE 0 autosar_swc_las_CM_single -3.4E+38 3.4E+38 /end CHARACTERISTIC
/begin CHARACTERISTIC P_LSS_ELK_VehSpdMinValue_kph "" VALUE 0xfe821244 /* @ECU_Address@P_LSS_ELK_VehSpdMinValue_kph@ */ Record_FLOAT32_IEEE 0 autosar_swc_las_CM_single -3.4E+38 3.4E+38 /end CHARACTERISTIC
/begin CHARACTERISTIC P_LSS_ELK_WarnInTime "" VALUE 0xfe821248 /* @ECU_Address@P_LSS_ELK_WarnInTime@ */ Record_FLOAT32_IEEE 0 autosar_swc_las_CM_single -3.4E+38 3.4E+38 /end CHARACTERISTIC
/begin CHARACTERISTIC P_LSS_ELK_YawRateIn "" VALUE 0xfe821258 /* @ECU_Address@P_LSS_ELK_YawRateIn@ */ Record_FLOAT32_IEEE 0 autosar_swc_las_CM_single -3.4E+38 3.4E+38 /end CHARACTERISTIC
/begin CHARACTERISTIC P_LSS_ELK_YawRateOut "" VALUE 0xfe82125c /* @ECU_Address@P_LSS_ELK_YawRateOut@ */ Record_FLOAT32_IEEE 0 autosar_swc_las_CM_single -3.4E+38 3.4E+38 /end CHARACTERISTIC
/begin CHARACTERISTIC P_LSS_ELK_YawRateOutTime "" VALUE 0xfe821260 /* @ECU_Address@P_LSS_ELK_YawRateOutTime@ */ Record_FLOAT32_IEEE 0 autosar_swc_las_CM_single -3.4E+38 3.4E+38 /end CHARACTERISTIC
/begin CHARACTERISTIC P_LSS_LKA_StateManMachineSharingSts_TIme "" VALUE 0xfe82137c /* @ECU_Address@P_LSS_LKA_StateManMachineSharingSts_TIme@ */ Record_FLOAT32_IEEE 0 autosar_swc_las_CM_single -3.4E+38 3.4E+38 /end CHARACTERISTIC
/begin CHARACTERISTIC P_LSS_LKA_StateManMachineSharingSts_enable "" VALUE 0xfe821380 /* @ECU_Address@P_LSS_LKA_StateManMachineSharingSts_enable@ */ Record_FLOAT32_IEEE 0 autosar_swc_las_CM_single -3.4E+38 3.4E+38 /end CHARACTERISTIC
/begin CHARACTERISTIC P_LSS_LSMC_SampleTime "" VALUE 0xfe821088 /* @ECU_Address@P_LSS_LSMC_SampleTime@ */ Record_FLOAT64_IEEE 0 autosar_swc_las_CM_double -1.7E+308 1.7E+308 /end CHARACTERISTIC
/begin CHARACTERISTIC ZDrive_BSW_Cal_Cal.ZDrive_BSW_Cal_VehicleInfomationTable.RADAR_MOUNT_PARAM_FL_X_POSITION "" VALUE 0x3d83fc Record_FLOAT32_IEEE 0 autosar_swc_las_CM_single -3.4E+38 3.4E+38 /end CHARACTERISTIC
/begin CHARACTERISTIC ZDrive_BSW_Cal_Cal.ZDrive_BSW_Cal_VehicleInfomationTable.RADAR_MOUNT_PARAM_FL_YAW_ANGLE "" VALUE 0x3d8404 Record_FLOAT32_IEEE 0 autosar_swc_las_CM_single -3.4E+38 3.4E+38 /end CHARACTERISTIC
/begin CHARACTERISTIC ZDrive_BSW_Cal_Cal.ZDrive_BSW_Cal_VehicleInfomationTable.RADAR_MOUNT_PARAM_FL_Y_POSITION "" VALUE 0x3d8400 Record_FLOAT32_IEEE 0 autosar_swc_las_CM_single -3.4E+38 3.4E+38 /end CHARACTERISTIC
/begin CHARACTERISTIC ZDrive_BSW_Cal_Cal.ZDrive_BSW_Cal_VehicleInfomationTable.RADAR_MOUNT_PARAM_FRONT_X_POSITION "" VALUE 0x3d83f0 Record_FLOAT32_IEEE 0 autosar_swc_las_CM_single -3.4E+38 3.4E+38 /end CHARACTERISTIC
/begin CHARACTERISTIC ZDrive_BSW_Cal_Cal.ZDrive_BSW_Cal_VehicleInfomationTable.RADAR_MOUNT_PARAM_FRONT_YAW_ANGLE "" VALUE 0x3d83f8 Record_FLOAT32_IEEE 0 autosar_swc_las_CM_single -3.4E+38 3.4E+38 /end CHARACTERISTIC
/begin CHARACTERISTIC ZDrive_BSW_Cal_Cal.ZDrive_BSW_Cal_VehicleInfomationTable.RADAR_MOUNT_PARAM_FRONT_Y_POSITION "" VALUE 0x3d83f4 Record_FLOAT32_IEEE 0 autosar_swc_las_CM_single -3.4E+38 3.4E+38 /end CHARACTERISTIC
/begin CHARACTERISTIC ZDrive_BSW_Cal_Cal.ZDrive_BSW_Cal_VehicleInfomationTable.RADAR_MOUNT_PARAM_FR_X_POSITION "" VALUE 0x3d8408 Record_FLOAT32_IEEE 0 autosar_swc_las_CM_single -3.4E+38 3.4E+38 /end CHARACTERISTIC
/begin CHARACTERISTIC ZDrive_BSW_Cal_Cal.ZDrive_BSW_Cal_VehicleInfomationTable.RADAR_MOUNT_PARAM_FR_YAW_ANGLE "" VALUE 0x3d8410 Record_FLOAT32_IEEE 0 autosar_swc_las_CM_single -3.4E+38 3.4E+38 /end CHARACTERISTIC
/begin CHARACTERISTIC ZDrive_BSW_Cal_Cal.ZDrive_BSW_Cal_VehicleInfomationTable.RADAR_MOUNT_PARAM_FR_Y_POSITION "" VALUE 0x3d840c Record_FLOAT32_IEEE 0 autosar_swc_las_CM_single -3.4E+38 3.4E+38 /end CHARACTERISTIC
/begin CHARACTERISTIC ZDrive_BSW_Cal_Cal.ZDrive_BSW_Cal_VehicleInfomationTable.RADAR_MOUNT_PARAM_RL_X_POSITION "" VALUE 0x3d8414 Record_FLOAT32_IEEE 0 autosar_swc_las_CM_single -3.4E+38 3.4E+38 /end CHARACTERISTIC
/begin CHARACTERISTIC ZDrive_BSW_Cal_Cal.ZDrive_BSW_Cal_VehicleInfomationTable.RADAR_MOUNT_PARAM_RL_YAW_ANGLE "" VALUE 0x3d841c Record_FLOAT32_IEEE 0 autosar_swc_las_CM_single -3.4E+38 3.4E+38 /end CHARACTERISTIC
/begin CHARACTERISTIC ZDrive_BSW_Cal_Cal.ZDrive_BSW_Cal_VehicleInfomationTable.RADAR_MOUNT_PARAM_RL_Y_POSITION "" VALUE 0x3d8418 Record_FLOAT32_IEEE 0 autosar_swc_las_CM_single -3.4E+38 3.4E+38 /end CHARACTERISTIC
/begin CHARACTERISTIC ZDrive_BSW_Cal_Cal.ZDrive_BSW_Cal_VehicleInfomationTable.RADAR_MOUNT_PARAM_RR_X_POSITION "" VALUE 0x3d8420 Record_FLOAT32_IEEE 0 autosar_swc_las_CM_single -3.4E+38 3.4E+38 /end CHARACTERISTIC
/begin CHARACTERISTIC ZDrive_BSW_Cal_Cal.ZDrive_BSW_Cal_VehicleInfomationTable.RADAR_MOUNT_PARAM_RR_YAW_ANGLE "" VALUE 0x3d8428 Record_FLOAT32_IEEE 0 autosar_swc_las_CM_single -3.4E+38 3.4E+38 /end CHARACTERISTIC
/begin CHARACTERISTIC ZDrive_BSW_Cal_Cal.ZDrive_BSW_Cal_VehicleInfomationTable.RADAR_MOUNT_PARAM_RR_Y_POSITION "" VALUE 0x3d8424 Record_FLOAT32_IEEE 0 autosar_swc_las_CM_single -3.4E+38 3.4E+38 /end CHARACTERISTIC
/begin CHARACTERISTIC ZDrive_BSW_Cal_Cal.ZDrive_BSW_Cal_VehicleInfomationTable.Vehicle_Information_End_Tag "" VALUE 0x3d855f Record_UBYTE 0 autosar_swc_las_CM_uint8 0 255 /end CHARACTERISTIC
/begin CHARACTERISTIC ZDrive_BSW_Cal_Cal.ZDrive_BSW_Cal_VehicleInfomationTable.Vehicle_Information_Reserved_Line277 "" VALUE 0x3d842c Record_ULONG 0 autosar_swc_las_CM_uint32 0 4294967295 /end CHARACTERISTIC
/begin CHARACTERISTIC ZDrive_BSW_Cal_Cal.ZDrive_BSW_Cal_VehicleInfomationTable.Vehicle_Information_Reserved_Line278 "" VALUE 0x3d8430 Record_ULONG 0 autosar_swc_las_CM_uint32 0 4294967295 /end CHARACTERISTIC
/begin CHARACTERISTIC ZDrive_BSW_Cal_Cal.ZDrive_BSW_Cal_VehicleInfomationTable.Vehicle_Information_Reserved_Line279 "" VALUE 0x3d8434 Record_ULONG 0 autosar_swc_las_CM_uint32 0 4294967295 /end CHARACTERISTIC
/begin CHARACTERISTIC ZDrive_BSW_Cal_Cal.ZDrive_BSW_Cal_VehicleInfomationTable.Vehicle_Information_Reserved_Line280 "" VALUE 0x3d8438 Record_ULONG 0 autosar_swc_las_CM_uint32 0 4294967295 /end CHARACTERISTIC
/begin CHARACTERISTIC ZDrive_BSW_Cal_Cal.ZDrive_BSW_Cal_VehicleInfomationTable.Vehicle_Information_Reserved_Line281 "" VALUE 0x3d843c Record_ULONG 0 autosar_swc_las_CM_uint32 0 4294967295 /end CHARACTERISTIC
/begin CHARACTERISTIC ZDrive_BSW_Cal_Cal.ZDrive_BSW_Cal_VehicleInfomationTable.Vehicle_Information_Reserved_Line282 "" VALUE 0x3d8440 Record_ULONG 0 autosar_swc_las_CM_uint32 0 4294967295 /end CHARACTERISTIC
/begin CHARACTERISTIC ZDrive_BSW_Cal_Cal.ZDrive_BSW_Cal_VehicleInfomationTable.Vehicle_Information_Reserved_Line283 "" VALUE 0x3d8444 Record_ULONG 0 autosar_swc_las_CM_uint32 0 4294967295 /end CHARACTERISTIC
/begin CHARACTERISTIC ZDrive_BSW_Cal_Cal.ZDrive_BSW_Cal_VehicleInfomationTable.Vehicle_Information_Reserved_Line284 "" VALUE 0x3d8448 Record_ULONG 0 autosar_swc_las_CM_uint32 0 4294967295 /end CHARACTERISTIC
/begin CHARACTERISTIC ZDrive_BSW_Cal_Cal.ZDrive_BSW_Cal_VehicleInfomationTable.Vehicle_Information_Reserved_Line285 "" VALUE 0x3d844c Record_ULONG 0 autosar_swc_las_CM_uint32 0 4294967295 /end CHARACTERISTIC
/begin CHARACTERISTIC ZDrive_BSW_Cal_Cal.ZDrive_BSW_Cal_VehicleInfomationTable.Vehicle_Information_Reserved_Line286 "" VALUE 0x3d8450 Record_ULONG 0 autosar_swc_las_CM_uint32 0 4294967295 /end CHARACTERISTIC
/begin CHARACTERISTIC ZDrive_BSW_Cal_Cal.ZDrive_BSW_Cal_VehicleInfomationTable.Vehicle_Information_Reserved_Line287 "" VALUE 0x3d8454 Record_ULONG 0 autosar_swc_las_CM_uint32 0 4294967295 /end CHARACTERISTIC
/begin CHARACTERISTIC ZDrive_BSW_Cal_Cal.ZDrive_BSW_Cal_VehicleInfomationTable.Vehicle_Information_Reserved_Line288 "" VALUE 0x3d8458 Record_ULONG 0 autosar_swc_las_CM_uint32 0 4294967295 /end CHARACTERISTIC
/begin CHARACTERISTIC ZDrive_BSW_Cal_Cal.ZDrive_BSW_Cal_VehicleInfomationTable.Vehicle_Information_Reserved_Line289 "" VALUE 0x3d845c Record_ULONG 0 autosar_swc_las_CM_uint32 0 4294967295 /end CHARACTERISTIC
/begin CHARACTERISTIC ZDrive_BSW_Cal_Cal.ZDrive_BSW_Cal_VehicleInfomationTable.Vehicle_Information_Reserved_Line290 "" VALUE 0x3d8460 Record_ULONG 0 autosar_swc_las_CM_uint32 0 4294967295 /end CHARACTERISTIC
/begin CHARACTERISTIC ZDrive_BSW_Cal_Cal.ZDrive_BSW_Cal_VehicleInfomationTable.Vehicle_Information_Reserved_Line291 "" VALUE 0x3d8464 Record_ULONG 0 autosar_swc_las_CM_uint32 0 4294967295 /end CHARACTERISTIC
/begin CHARACTERISTIC ZDrive_BSW_Cal_Cal.ZDrive_BSW_Cal_VehicleInfomationTable.Vehicle_Information_Reserved_Line292 "" VALUE 0x3d8468 Record_ULONG 0 autosar_swc_las_CM_uint32 0 4294967295 /end CHARACTERISTIC
/begin CHARACTERISTIC ZDrive_BSW_Cal_Cal.ZDrive_BSW_Cal_VehicleInfomationTable.Vehicle_Information_Reserved_Line293 "" VALUE 0x3d846c Record_ULONG 0 autosar_swc_las_CM_uint32 0 4294967295 /end CHARACTERISTIC
/begin CHARACTERISTIC ZDrive_BSW_Cal_Cal.ZDrive_BSW_Cal_VehicleInfomationTable.Vehicle_Information_Reserved_Line294 "" VALUE 0x3d8470 Record_ULONG 0 autosar_swc_las_CM_uint32 0 4294967295 /end CHARACTERISTIC
/begin CHARACTERISTIC ZDrive_BSW_Cal_Cal.ZDrive_BSW_Cal_VehicleInfomationTable.Vehicle_Information_Reserved_Line295 "" VALUE 0x3d8474 Record_ULONG 0 autosar_swc_las_CM_uint32 0 4294967295 /end CHARACTERISTIC
/begin CHARACTERISTIC ZDrive_BSW_Cal_Cal.ZDrive_BSW_Cal_VehicleInfomationTable.Vehicle_Information_Reserved_Line296 "" VALUE 0x3d8478 Record_ULONG 0 autosar_swc_las_CM_uint32 0 4294967295 /end CHARACTERISTIC
/begin CHARACTERISTIC ZDrive_BSW_Cal_Cal.ZDrive_BSW_Cal_VehicleInfomationTable.Vehicle_Information_Reserved_Line297 "" VALUE 0x3d847c Record_ULONG 0 autosar_swc_las_CM_uint32 0 4294967295 /end CHARACTERISTIC
/begin CHARACTERISTIC ZDrive_BSW_Cal_Cal.ZDrive_BSW_Cal_VehicleInfomationTable.Vehicle_Information_Reserved_Line298 "" VALUE 0x3d8480 Record_ULONG 0 autosar_swc_las_CM_uint32 0 4294967295 /end CHARACTERISTIC
/begin CHARACTERISTIC ZDrive_BSW_Cal_Cal.ZDrive_BSW_Cal_VehicleInfomationTable.Vehicle_Information_Reserved_Line299 "" VALUE 0x3d8484 Record_ULONG 0 autosar_swc_las_CM_uint32 0 4294967295 /end CHARACTERISTIC
/begin CHARACTERISTIC ZDrive_BSW_Cal_Cal.ZDrive_BSW_Cal_VehicleInfomationTable.Vehicle_Information_Reserved_Line300 "" VALUE 0x3d8488 Record_ULONG 0 autosar_swc_las_CM_uint32 0 4294967295 /end CHARACTERISTIC
/begin CHARACTERISTIC ZDrive_BSW_Cal_Cal.ZDrive_BSW_Cal_VehicleInfomationTable.Vehicle_Information_Reserved_Line301 "" VALUE 0x3d848c Record_ULONG 0 autosar_swc_las_CM_uint32 0 4294967295 /end CHARACTERISTIC
/begin CHARACTERISTIC ZDrive_BSW_Cal_Cal.ZDrive_BSW_Cal_VehicleInfomationTable.Vehicle_Information_Reserved_Line302 "" VALUE 0x3d8490 Record_ULONG 0 autosar_swc_las_CM_uint32 0 4294967295 /end CHARACTERISTIC
/begin CHARACTERISTIC ZDrive_BSW_Cal_Cal.ZDrive_BSW_Cal_VehicleInfomationTable.Vehicle_Information_Reserved_Line303 "" VALUE 0x3d8494 Record_ULONG 0 autosar_swc_las_CM_uint32 0 4294967295 /end CHARACTERISTIC
/begin CHARACTERISTIC ZDrive_BSW_Cal_Cal.ZDrive_BSW_Cal_VehicleInfomationTable.Vehicle_Information_Reserved_Line304 "" VALUE 0x3d8498 Record_ULONG 0 autosar_swc_las_CM_uint32 0 4294967295 /end CHARACTERISTIC
/begin CHARACTERISTIC ZDrive_BSW_Cal_Cal.ZDrive_BSW_Cal_VehicleInfomationTable.Vehicle_Information_Reserved_Line305 "" VALUE 0x3d849c Record_ULONG 0 autosar_swc_las_CM_uint32 0 4294967295 /end CHARACTERISTIC
/begin CHARACTERISTIC ZDrive_BSW_Cal_Cal.ZDrive_BSW_Cal_VehicleInfomationTable.Vehicle_Information_Reserved_Line306 "" VALUE 0x3d84a0 Record_ULONG 0 autosar_swc_las_CM_uint32 0 4294967295 /end CHARACTERISTIC
/begin CHARACTERISTIC ZDrive_BSW_Cal_Cal.ZDrive_BSW_Cal_VehicleInfomationTable.Vehicle_Information_Reserved_Line307 "" VALUE 0x3d84a4 Record_ULONG 0 autosar_swc_las_CM_uint32 0 4294967295 /end CHARACTERISTIC
/begin CHARACTERISTIC ZDrive_BSW_Cal_Cal.ZDrive_BSW_Cal_VehicleInfomationTable.Vehicle_Information_Reserved_Line308 "" VALUE 0x3d84a8 Record_ULONG 0 autosar_swc_las_CM_uint32 0 4294967295 /end CHARACTERISTIC
/begin CHARACTERISTIC ZDrive_BSW_Cal_Cal.ZDrive_BSW_Cal_VehicleInfomationTable.Vehicle_Information_Reserved_Line309 "" VALUE 0x3d84ac Record_ULONG 0 autosar_swc_las_CM_uint32 0 4294967295 /end CHARACTERISTIC
/begin CHARACTERISTIC ZDrive_BSW_Cal_Cal.ZDrive_BSW_Cal_VehicleInfomationTable.Vehicle_Information_Reserved_Line310 "" VALUE 0x3d84b0 Record_ULONG 0 autosar_swc_las_CM_uint32 0 4294967295 /end CHARACTERISTIC
/begin CHARACTERISTIC ZDrive_BSW_Cal_Cal.ZDrive_BSW_Cal_VehicleInfomationTable.Vehicle_Information_Reserved_Line311 "" VALUE 0x3d84b4 Record_ULONG 0 autosar_swc_las_CM_uint32 0 4294967295 /end CHARACTERISTIC
/begin CHARACTERISTIC ZDrive_BSW_Cal_Cal.ZDrive_BSW_Cal_VehicleInfomationTable.Vehicle_Information_Reserved_Line312 "" VALUE 0x3d84b8 Record_ULONG 0 autosar_swc_las_CM_uint32 0 4294967295 /end CHARACTERISTIC
/begin CHARACTERISTIC ZDrive_BSW_Cal_Cal.ZDrive_BSW_Cal_VehicleInfomationTable.Vehicle_Information_Reserved_Line313 "" VALUE 0x3d84bc Record_ULONG 0 autosar_swc_las_CM_uint32 0 4294967295 /end CHARACTERISTIC
/begin CHARACTERISTIC ZDrive_BSW_Cal_Cal.ZDrive_BSW_Cal_VehicleInfomationTable.Vehicle_Information_Reserved_Line314 "" VALUE 0x3d84c0 Record_ULONG 0 autosar_swc_las_CM_uint32 0 4294967295 /end CHARACTERISTIC
/begin CHARACTERISTIC ZDrive_BSW_Cal_Cal.ZDrive_BSW_Cal_VehicleInfomationTable.Vehicle_Information_Reserved_Line315 "" VALUE 0x3d84c4 Record_ULONG 0 autosar_swc_las_CM_uint32 0 4294967295 /end CHARACTERISTIC
/begin CHARACTERISTIC ZDrive_BSW_Cal_Cal.ZDrive_BSW_Cal_VehicleInfomationTable.Vehicle_Information_Reserved_Line316 "" VALUE 0x3d84c8 Record_ULONG 0 autosar_swc_las_CM_uint32 0 4294967295 /end CHARACTERISTIC
/begin CHARACTERISTIC ZDrive_BSW_Cal_Cal.ZDrive_BSW_Cal_VehicleInfomationTable.Vehicle_Information_Reserved_Line317 "" VALUE 0x3d84cc Record_ULONG 0 autosar_swc_las_CM_uint32 0 4294967295 /end CHARACTERISTIC
/begin CHARACTERISTIC ZDrive_BSW_Cal_Cal.ZDrive_BSW_Cal_VehicleInfomationTable.Vehicle_Information_Reserved_Line318 "" VALUE 0x3d84d0 Record_ULONG 0 autosar_swc_las_CM_uint32 0 4294967295 /end CHARACTERISTIC
/begin CHARACTERISTIC ZDrive_BSW_Cal_Cal.ZDrive_BSW_Cal_VehicleInfomationTable.Vehicle_Information_Reserved_Line319 "" VALUE 0x3d84d4 Record_ULONG 0 autosar_swc_las_CM_uint32 0 4294967295 /end CHARACTERISTIC
/begin CHARACTERISTIC ZDrive_BSW_Cal_Cal.ZDrive_BSW_Cal_VehicleInfomationTable.Vehicle_Information_Reserved_Line320 "" VALUE 0x3d84d8 Record_ULONG 0 autosar_swc_las_CM_uint32 0 4294967295 /end CHARACTERISTIC
/begin CHARACTERISTIC ZDrive_BSW_Cal_Cal.ZDrive_BSW_Cal_VehicleInfomationTable.Vehicle_Information_Reserved_Line321 "" VALUE 0x3d84dc Record_ULONG 0 autosar_swc_las_CM_uint32 0 4294967295 /end CHARACTERISTIC
/begin CHARACTERISTIC ZDrive_BSW_Cal_Cal.ZDrive_BSW_Cal_VehicleInfomationTable.Vehicle_Information_Reserved_Line322 "" VALUE 0x3d84e0 Record_ULONG 0 autosar_swc_las_CM_uint32 0 4294967295 /end CHARACTERISTIC
/begin CHARACTERISTIC ZDrive_BSW_Cal_Cal.ZDrive_BSW_Cal_VehicleInfomationTable.Vehicle_Information_Reserved_Line323 "" VALUE 0x3d84e4 Record_ULONG 0 autosar_swc_las_CM_uint32 0 4294967295 /end CHARACTERISTIC
/begin CHARACTERISTIC ZDrive_BSW_Cal_Cal.ZDrive_BSW_Cal_VehicleInfomationTable.Vehicle_Information_Reserved_Line324 "" VALUE 0x3d84e8 Record_ULONG 0 autosar_swc_las_CM_uint32 0 4294967295 /end CHARACTERISTIC
/begin CHARACTERISTIC ZDrive_BSW_Cal_Cal.ZDrive_BSW_Cal_VehicleInfomationTable.Vehicle_Information_Reserved_Line325 "" VALUE 0x3d84ec Record_ULONG 0 autosar_swc_las_CM_uint32 0 4294967295 /end CHARACTERISTIC
/begin CHARACTERISTIC ZDrive_BSW_Cal_Cal.ZDrive_BSW_Cal_VehicleInfomationTable.Vehicle_Information_Reserved_Line326 "" VALUE 0x3d84f0 Record_ULONG 0 autosar_swc_las_CM_uint32 0 4294967295 /end CHARACTERISTIC
/begin CHARACTERISTIC ZDrive_BSW_Cal_Cal.ZDrive_BSW_Cal_VehicleInfomationTable.Vehicle_Information_Reserved_Line327 "" VALUE 0x3d84f4 Record_ULONG 0 autosar_swc_las_CM_uint32 0 4294967295 /end CHARACTERISTIC
/begin CHARACTERISTIC ZDrive_BSW_Cal_Cal.ZDrive_BSW_Cal_VehicleInfomationTable.Vehicle_Information_Reserved_Line328 "" VALUE 0x3d84f8 Record_ULONG 0 autosar_swc_las_CM_uint32 0 4294967295 /end CHARACTERISTIC
/begin CHARACTERISTIC ZDrive_BSW_Cal_Cal.ZDrive_BSW_Cal_VehicleInfomationTable.Vehicle_Information_Reserved_Line329 "" VALUE 0x3d84fc Record_ULONG 0 autosar_swc_las_CM_uint32 0 4294967295 /end CHARACTERISTIC
/begin CHARACTERISTIC ZDrive_BSW_Cal_Cal.ZDrive_BSW_Cal_VehicleInfomationTable.Vehicle_Information_Reserved_Line330 "" VALUE 0x3d8500 Record_ULONG 0 autosar_swc_las_CM_uint32 0 4294967295 /end CHARACTERISTIC
/begin CHARACTERISTIC ZDrive_BSW_Cal_Cal.ZDrive_BSW_Cal_VehicleInfomationTable.Vehicle_Information_Reserved_Line331 "" VALUE 0x3d8504 Record_ULONG 0 autosar_swc_las_CM_uint32 0 4294967295 /end CHARACTERISTIC
/begin CHARACTERISTIC ZDrive_BSW_Cal_Cal.ZDrive_BSW_Cal_VehicleInfomationTable.Vehicle_Information_Reserved_Line332 "" VALUE 0x3d8508 Record_ULONG 0 autosar_swc_las_CM_uint32 0 4294967295 /end CHARACTERISTIC
/begin CHARACTERISTIC ZDrive_BSW_Cal_Cal.ZDrive_BSW_Cal_VehicleInfomationTable.Vehicle_Information_Reserved_Line333 "" VALUE 0x3d850c Record_ULONG 0 autosar_swc_las_CM_uint32 0 4294967295 /end CHARACTERISTIC
/begin CHARACTERISTIC ZDrive_BSW_Cal_Cal.ZDrive_BSW_Cal_VehicleInfomationTable.Vehicle_Information_Reserved_Line334 "" VALUE 0x3d8510 Record_ULONG 0 autosar_swc_las_CM_uint32 0 4294967295 /end CHARACTERISTIC
/begin CHARACTERISTIC ZDrive_BSW_Cal_Cal.ZDrive_BSW_Cal_VehicleInfomationTable.Vehicle_Information_Reserved_Line335 "" VALUE 0x3d8514 Record_ULONG 0 autosar_swc_las_CM_uint32 0 4294967295 /end CHARACTERISTIC
/begin CHARACTERISTIC ZDrive_BSW_Cal_Cal.ZDrive_BSW_Cal_VehicleInfomationTable.Vehicle_Information_Reserved_Line336 "" VALUE 0x3d8518 Record_ULONG 0 autosar_swc_las_CM_uint32 0 4294967295 /end CHARACTERISTIC
/begin CHARACTERISTIC ZDrive_BSW_Cal_Cal.ZDrive_BSW_Cal_VehicleInfomationTable.Vehicle_Information_Reserved_Line337 "" VALUE 0x3d851c Record_ULONG 0 autosar_swc_las_CM_uint32 0 4294967295 /end CHARACTERISTIC
/begin CHARACTERISTIC ZDrive_BSW_Cal_Cal.ZDrive_BSW_Cal_VehicleInfomationTable.Vehicle_Information_Reserved_Line338 "" VALUE 0x3d8520 Record_ULONG 0 autosar_swc_las_CM_uint32 0 4294967295 /end CHARACTERISTIC
/begin CHARACTERISTIC ZDrive_BSW_Cal_Cal.ZDrive_BSW_Cal_VehicleInfomationTable.Vehicle_Information_Reserved_Line339 "" VALUE 0x3d8524 Record_ULONG 0 autosar_swc_las_CM_uint32 0 4294967295 /end CHARACTERISTIC
/begin CHARACTERISTIC ZDrive_BSW_Cal_Cal.ZDrive_BSW_Cal_VehicleInfomationTable.Vehicle_Information_Reserved_Line340 "" VALUE 0x3d8528 Record_ULONG 0 autosar_swc_las_CM_uint32 0 4294967295 /end CHARACTERISTIC
/begin CHARACTERISTIC ZDrive_BSW_Cal_Cal.ZDrive_BSW_Cal_VehicleInfomationTable.Vehicle_Information_Reserved_Line341 "" VALUE 0x3d852c Record_ULONG 0 autosar_swc_las_CM_uint32 0 4294967295 /end CHARACTERISTIC
/begin CHARACTERISTIC ZDrive_BSW_Cal_Cal.ZDrive_BSW_Cal_VehicleInfomationTable.Vehicle_Information_Reserved_Line342 "" VALUE 0x3d8530 Record_ULONG 0 autosar_swc_las_CM_uint32 0 4294967295 /end CHARACTERISTIC
/begin CHARACTERISTIC ZDrive_BSW_Cal_Cal.ZDrive_BSW_Cal_VehicleInfomationTable.Vehicle_Information_Reserved_Line343 "" VALUE 0x3d8534 Record_ULONG 0 autosar_swc_las_CM_uint32 0 4294967295 /end CHARACTERISTIC
/begin CHARACTERISTIC ZDrive_BSW_Cal_Cal.ZDrive_BSW_Cal_VehicleInfomationTable.Vehicle_Information_Reserved_Line344 "" VALUE 0x3d8538 Record_ULONG 0 autosar_swc_las_CM_uint32 0 4294967295 /end CHARACTERISTIC
/begin CHARACTERISTIC ZDrive_BSW_Cal_Cal.ZDrive_BSW_Cal_VehicleInfomationTable.Vehicle_Information_Reserved_Line345 "" VALUE 0x3d853c Record_ULONG 0 autosar_swc_las_CM_uint32 0 4294967295 /end CHARACTERISTIC
/begin CHARACTERISTIC ZDrive_BSW_Cal_Cal.ZDrive_BSW_Cal_VehicleInfomationTable.Vehicle_Information_Reserved_Line346 "" VALUE 0x3d8540 Record_ULONG 0 autosar_swc_las_CM_uint32 0 4294967295 /end CHARACTERISTIC
/begin CHARACTERISTIC ZDrive_BSW_Cal_Cal.ZDrive_BSW_Cal_VehicleInfomationTable.Vehicle_Information_Reserved_Line347 "" VALUE 0x3d8544 Record_ULONG 0 autosar_swc_las_CM_uint32 0 4294967295 /end CHARACTERISTIC
/begin CHARACTERISTIC ZDrive_BSW_Cal_Cal.ZDrive_BSW_Cal_VehicleInfomationTable.Vehicle_Information_Reserved_Line348 "" VALUE 0x3d8548 Record_ULONG 0 autosar_swc_las_CM_uint32 0 4294967295 /end CHARACTERISTIC
/begin CHARACTERISTIC ZDrive_BSW_Cal_Cal.ZDrive_BSW_Cal_VehicleInfomationTable.Vehicle_Information_Reserved_Line349 "" VALUE 0x3d854c Record_ULONG 0 autosar_swc_las_CM_uint32 0 4294967295 /end CHARACTERISTIC
/begin CHARACTERISTIC ZDrive_BSW_Cal_Cal.ZDrive_BSW_Cal_VehicleInfomationTable.Vehicle_Information_Reserved_Line350 "" VALUE 0x3d8550 Record_ULONG 0 autosar_swc_las_CM_uint32 0 4294967295 /end CHARACTERISTIC
/begin CHARACTERISTIC ZDrive_BSW_Cal_Cal.ZDrive_BSW_Cal_VehicleInfomationTable.Vehicle_Information_Reserved_Line351 "" VALUE 0x3d8554 Record_ULONG 0 autosar_swc_las_CM_uint32 0 4294967295 /end CHARACTERISTIC
/begin CHARACTERISTIC ZDrive_BSW_Cal_Cal.ZDrive_BSW_Cal_VehicleInfomationTable.Vehicle_Information_Reserved_Line352 "" VALUE 0x3d8558 Record_ULONG 0 autosar_swc_las_CM_uint32 0 4294967295 /end CHARACTERISTIC
/begin CHARACTERISTIC ZDrive_BSW_Cal_Cal.ZDrive_BSW_Cal_VehicleInfomationTable.Vehicle_Information_Reserved_Line353 "" VALUE 0x3d855c Record_UWORD 0 autosar_swc_las_CM_uint16 0 65535 /end CHARACTERISTIC
/begin CHARACTERISTIC ZDrive_BSW_Cal_Cal.ZDrive_BSW_Cal_VehicleInfomationTable.Vehicle_Information_Reserved_Line354 "" VALUE 0x3d855e Record_UBYTE 0 autosar_swc_las_CM_uint8 0 255 /end CHARACTERISTIC
/begin MEASUREMENT LAS_ELKState "" UBYTE autosar_swc_las_CM_uint8 0 0 0 255 ECU_ADDRESS 0xfe4ae65e /* @ECU_Address@LAS_ELKState@ */ /end MEASUREMENT
/begin MEASUREMENT LAS_ELK_Active2Ready "" UBYTE autosar_swc_las_CM_boolean 0 0 0 1 ECU_ADDRESS 0xfe4ae65f /* @ECU_Address@LAS_ELK_Active2Ready@ */ /end MEASUREMENT
/begin MEASUREMENT LAS_ELK_EPSTqDegOverrideFlag_b "" UBYTE autosar_swc_las_CM_boolean 0 0 0 1 ECU_ADDRESS 0xfe4ae662 /* @ECU_Address@LAS_ELK_EPSTqDegOverrideFlag_b@ */ /end MEASUREMENT
/begin MEASUREMENT LAS_ELK_EPSTqDiffOverFlag_b "" UBYTE autosar_swc_las_CM_boolean 0 0 0 1 ECU_ADDRESS 0xfe4ae663 /* @ECU_Address@LAS_ELK_EPSTqDiffOverFlag_b@ */ /end MEASUREMENT
/begin MEASUREMENT LAS_ELK_EPSTqSameOverFlag_b "" UBYTE autosar_swc_las_CM_boolean 0 0 0 1 ECU_ADDRESS 0xfe4ae664 /* @ECU_Address@LAS_ELK_EPSTqSameOverFlag_b@ */ /end MEASUREMENT
/begin MEASUREMENT LAS_ELK_Idle2Ready "" UBYTE autosar_swc_las_CM_boolean 0 0 0 1 MATRIX_DIM 1 1 ECU_ADDRESS 0xfe4ae66a /* @ECU_Address@LAS_ELK_Idle2Ready@ */ /end MEASUREMENT
/begin MEASUREMENT LAS_ELK_Ldy "" UBYTE autosar_swc_las_CM_boolean 0 0 0 1 ECU_ADDRESS 0xfe4ae66c /* @ECU_Address@LAS_ELK_Ldy@ */ /end MEASUREMENT
/begin MEASUREMENT LAS_ELK_LeftInCrossLineFlag_b "" UBYTE autosar_swc_las_CM_boolean 0 0 0 1 ECU_ADDRESS 0xfe4ae66f /* @ECU_Address@LAS_ELK_LeftInCrossLineFlag_b@ */ /end MEASUREMENT
/begin MEASUREMENT LAS_ELK_LeftLaneChangeReFlag_b "" UBYTE autosar_swc_las_CM_boolean 0 0 0 1 ECU_ADDRESS 0xfe4ae671 /* @ECU_Address@LAS_ELK_LeftLaneChangeReFlag_b@ */ /end MEASUREMENT
/begin MEASUREMENT LAS_ELK_LeftOutCrossLineFlag_b "" UBYTE autosar_swc_las_CM_boolean 0 0 0 1 ECU_ADDRESS 0xfe4ae67b /* @ECU_Address@LAS_ELK_LeftOutCrossLineFlag_b@ */ /end MEASUREMENT
/begin MEASUREMENT LAS_ELK_LeftWarn "" UBYTE autosar_swc_las_CM_boolean 0 0 0 1 ECU_ADDRESS 0xfe4ae686 /* @ECU_Address@LAS_ELK_LeftWarn@ */ /end MEASUREMENT
/begin MEASUREMENT LAS_ELK_Number "" UWORD autosar_swc_las_CM_uint16 0 0 0 65535 ECU_ADDRESS 0xfe4ae658 /* @ECU_Address@LAS_ELK_Number@ */ /end MEASUREMENT
/begin MEASUREMENT LAS_ELK_OnComingFlag_b "" UBYTE autosar_swc_las_CM_uint8 0 0 0 255 ECU_ADDRESS 0xfe4ae68a /* @ECU_Address@LAS_ELK_OnComingFlag_b@ */ /end MEASUREMENT
/begin MEASUREMENT LAS_ELK_Other2Idle "" UBYTE autosar_swc_las_CM_boolean 0 0 0 1 MATRIX_DIM 1 1 ECU_ADDRESS 0xfe4ae68f /* @ECU_Address@LAS_ELK_Other2Idle@ */ /end MEASUREMENT
/begin MEASUREMENT LAS_ELK_OvertakingFlag_b "" UBYTE autosar_swc_las_CM_uint8 0 0 0 255 ECU_ADDRESS 0xfe4ae694 /* @ECU_Address@LAS_ELK_OvertakingFlag_b@ */ /end MEASUREMENT
/begin MEASUREMENT LAS_ELK_Rdy "" UBYTE autosar_swc_las_CM_boolean 0 0 0 1 ECU_ADDRESS 0xfe4ae695 /* @ECU_Address@LAS_ELK_Rdy@ */ /end MEASUREMENT
/begin MEASUREMENT LAS_ELK_Ready2Active "" UBYTE autosar_swc_las_CM_boolean 0 0 0 1 ECU_ADDRESS 0xfe4ae696 /* @ECU_Address@LAS_ELK_Ready2Active@ */ /end MEASUREMENT
/begin MEASUREMENT LAS_ELK_RiInCrossLineFlag_b "" UBYTE autosar_swc_las_CM_boolean 0 0 0 1 ECU_ADDRESS 0xfe4ae697 /* @ECU_Address@LAS_ELK_RiInCrossLineFlag_b@ */ /end MEASUREMENT
/begin MEASUREMENT LAS_ELK_RiLaneChangeReFlag_b "" UBYTE autosar_swc_las_CM_boolean 0 0 0 1 ECU_ADDRESS 0xfe4ae698 /* @ECU_Address@LAS_ELK_RiLaneChangeReFlag_b@ */ /end MEASUREMENT
/begin MEASUREMENT LAS_ELK_RiOutCrossLineFlag_b "" UBYTE autosar_swc_las_CM_boolean 0 0 0 1 ECU_ADDRESS 0xfe4ae69b /* @ECU_Address@LAS_ELK_RiOutCrossLineFlag_b@ */ /end MEASUREMENT
/begin MEASUREMENT LAS_ELK_RightWarn "" UBYTE autosar_swc_las_CM_boolean 0 0 0 1 ECU_ADDRESS 0xfe4ae6b0 /* @ECU_Address@LAS_ELK_RightWarn@ */ /end MEASUREMENT
/begin MEASUREMENT LAS_ELK_VERSION "" ULONG autosar_swc_las_CM_uint32 0 0 0 4294967295 ECU_ADDRESS 0xfe4ae57c /* @ECU_Address@LAS_ELK_VERSION@ */ /end MEASUREMENT
/begin MEASUREMENT LAS_ELK_VehConfigELK "" UBYTE autosar_swc_las_CM_uint8 0 0 0 255 ECU_ADDRESS 0xfe4ae6b3 /* @ECU_Address@LAS_ELK_VehConfigELK@ */ /end MEASUREMENT
/begin MEASUREMENT LAS_LDW_Active2Ready "" UBYTE autosar_swc_las_CM_boolean 0 0 0 1 ECU_ADDRESS 0xfe4ae6b6 /* @ECU_Address@LAS_LDW_Active2Ready@ */ /end MEASUREMENT
/begin MEASUREMENT LAS_LDW_Ldy "" UBYTE autosar_swc_las_CM_boolean 0 0 0 1 ECU_ADDRESS 0xfe4ae6ba /* @ECU_Address@LAS_LDW_Ldy@ */ /end MEASUREMENT
/begin MEASUREMENT LAS_LDW_LeftInCrossLineFlag_b "" UBYTE autosar_swc_las_CM_boolean 0 0 0 1 ECU_ADDRESS 0xfe4ae6bb /* @ECU_Address@LAS_LDW_LeftInCrossLineFlag_b@ */ /end MEASUREMENT
/begin MEASUREMENT LAS_LDW_LeftLaneChangeReFlag_b "" UBYTE autosar_swc_las_CM_boolean 0 0 0 1 ECU_ADDRESS 0xfe4ae6bc /* @ECU_Address@LAS_LDW_LeftLaneChangeReFlag_b@ */ /end MEASUREMENT
/begin MEASUREMENT LAS_LDW_LeftOutCrossLineFlag_b "" UBYTE autosar_swc_las_CM_boolean 0 0 0 1 ECU_ADDRESS 0xfe4ae6bd /* @ECU_Address@LAS_LDW_LeftOutCrossLineFlag_b@ */ /end MEASUREMENT
/begin MEASUREMENT LAS_LDW_Rdy "" UBYTE autosar_swc_las_CM_boolean 0 0 0 1 ECU_ADDRESS 0xfe4ae6c1 /* @ECU_Address@LAS_LDW_Rdy@ */ /end MEASUREMENT
/begin MEASUREMENT LAS_LDW_Ready2Active "" UBYTE autosar_swc_las_CM_boolean 0 0 0 1 ECU_ADDRESS 0xfe4ae6c2 /* @ECU_Address@LAS_LDW_Ready2Active@ */ /end MEASUREMENT
/begin MEASUREMENT LAS_LDW_RiInCrossLineFlag_b "" UBYTE autosar_swc_las_CM_boolean 0 0 0 1 ECU_ADDRESS 0xfe4ae6c3 /* @ECU_Address@LAS_LDW_RiInCrossLineFlag_b@ */ /end MEASUREMENT
/begin MEASUREMENT LAS_LDW_RiLaneChangeReFlag_b "" UBYTE autosar_swc_las_CM_boolean 0 0 0 1 ECU_ADDRESS 0xfe4ae6c4 /* @ECU_Address@LAS_LDW_RiLaneChangeReFlag_b@ */ /end MEASUREMENT
/begin MEASUREMENT LAS_LDW_RiOutCrossLineFlag_b "" UBYTE autosar_swc_las_CM_boolean 0 0 0 1 ECU_ADDRESS 0xfe4ae6c5 /* @ECU_Address@LAS_LDW_RiOutCrossLineFlag_b@ */ /end MEASUREMENT
/begin MEASUREMENT LAS_LKA_EPSTqDegOverrideFlag_b "" UBYTE autosar_swc_las_CM_boolean 0 0 0 1 ECU_ADDRESS 0xfe4ae6ca /* @ECU_Address@LAS_LKA_EPSTqDegOverrideFlag_b@ */ /end MEASUREMENT
/begin MEASUREMENT LAS_LKA_EPSTqDiffOverFlag_b "" UBYTE autosar_swc_las_CM_boolean 0 0 0 1 ECU_ADDRESS 0xfe4ae6cb /* @ECU_Address@LAS_LKA_EPSTqDiffOverFlag_b@ */ /end MEASUREMENT
/begin MEASUREMENT LAS_LKA_EPSTqSameOverFlag_b "" UBYTE autosar_swc_las_CM_boolean 0 0 0 1 ECU_ADDRESS 0xfe4ae6cc /* @ECU_Address@LAS_LKA_EPSTqSameOverFlag_b@ */ /end MEASUREMENT
/begin MEASUREMENT LAS_LKA_Ldy "" UBYTE autosar_swc_las_CM_boolean 0 0 0 1 ECU_ADDRESS 0xfe4ae6d0 /* @ECU_Address@LAS_LKA_Ldy@ */ /end MEASUREMENT
/begin MEASUREMENT LAS_LKA_LeftInCrossLineFlag_b "" UBYTE autosar_swc_las_CM_boolean 0 0 0 1 ECU_ADDRESS 0xfe4ae6d1 /* @ECU_Address@LAS_LKA_LeftInCrossLineFlag_b@ */ /end MEASUREMENT
/begin MEASUREMENT LAS_LKA_LeftLaneChangeReFlag_b "" UBYTE autosar_swc_las_CM_boolean 0 0 0 1 ECU_ADDRESS 0xfe4ae6d4 /* @ECU_Address@LAS_LKA_LeftLaneChangeReFlag_b@ */ /end MEASUREMENT
/begin MEASUREMENT LAS_LKA_LeftOutCrossLineFlag_b "" UBYTE autosar_swc_las_CM_boolean 0 0 0 1 ECU_ADDRESS 0xfe4ae6d5 /* @ECU_Address@LAS_LKA_LeftOutCrossLineFlag_b@ */ /end MEASUREMENT
/begin MEASUREMENT LAS_LKA_Rdy "" UBYTE autosar_swc_las_CM_boolean 0 0 0 1 ECU_ADDRESS 0xfe4ae6d8 /* @ECU_Address@LAS_LKA_Rdy@ */ /end MEASUREMENT
/begin MEASUREMENT LAS_LKA_RiInCrossLineFlag_b "" UBYTE autosar_swc_las_CM_boolean 0 0 0 1 ECU_ADDRESS 0xfe4ae6d9 /* @ECU_Address@LAS_LKA_RiInCrossLineFlag_b@ */ /end MEASUREMENT
/begin MEASUREMENT LAS_LKA_RiLaneChangeReFlag_b "" UBYTE autosar_swc_las_CM_boolean 0 0 0 1 ECU_ADDRESS 0xfe4ae6da /* @ECU_Address@LAS_LKA_RiLaneChangeReFlag_b@ */ /end MEASUREMENT
/begin MEASUREMENT LAS_LKA_RiOutCrossLineFlag_b "" UBYTE autosar_swc_las_CM_boolean 0 0 0 1 ECU_ADDRESS 0xfe4ae6db /* @ECU_Address@LAS_LKA_RiOutCrossLineFlag_b@ */ /end MEASUREMENT
/begin MEASUREMENT LAS_Reserve4 "" FLOAT32_IEEE autosar_swc_las_CM_single 0 0 -3.4E+38 3.4E+38 MATRIX_DIM 1 1 ECU_ADDRESS 0xfe4ae5b0 /* @ECU_Address@LAS_Reserve4@ */ /end MEASUREMENT
/begin MEASUREMENT LAS_Reserve7 "" FLOAT32_IEEE autosar_swc_las_CM_single 0 0 -3.4E+38 3.4E+38 MATRIX_DIM 1 1 ECU_ADDRESS 0xfe4ae5bc /* @ECU_Address@LAS_Reserve7@ */ /end MEASUREMENT
/begin MEASUREMENT LAS_Version "" ULONG autosar_swc_las_CM_uint32 0 0 0 4294967295 ECU_ADDRESS 0xfe4ae604 /* @ECU_Address@LAS_Version@ */ /end MEASUREMENT
/begin MEASUREMENT autosar_swc_las_rtARID_DEF.Cnt_HandsOff "" FLOAT32_IEEE autosar_swc_las_CM_single 0 0 -3.4E+38 3.4E+38 ECU_ADDRESS 0xfe4ae388 /* @ECU_Address@autosar_swc_las_rtARID_DEF.Cnt_HandsOff@ */ /end MEASUREMENT
/begin MEASUREMENT autosar_swc_las_rtARID_DEF.Delay2_DSTATE_i "" UBYTE autosar_swc_las_CM_uint8 0 0 0 255 ECU_ADDRESS 0xfe4ae4c7 /* @ECU_Address@autosar_swc_las_rtARID_DEF.Delay2_DSTATE_i@ */ /end MEASUREMENT
/begin MEASUREMENT autosar_swc_las_rtARID_DEF.Delay2_DSTATE_p "" UBYTE autosar_swc_las_CM_uint8 0 0 0 255 ECU_ADDRESS 0xfe4ae4c6 /* @ECU_Address@autosar_swc_las_rtARID_DEF.Delay2_DSTATE_p@ */ /end MEASUREMENT
/begin MEASUREMENT autosar_swc_las_rtARID_DEF.Delay_DSTATE_m "" FLOAT32_IEEE autosar_swc_las_CM_single 0 0 -3.4E+38 3.4E+38 LAYOUT COLUMN_DIR MATRIX_DIM 5 ECU_ADDRESS 0xfe4ae33c /* @ECU_Address@autosar_swc_las_rtARID_DEF.Delay_DSTATE_m@ */ /end MEASUREMENT
/begin MEASUREMENT autosar_swc_las_rtARID_DEF.UnitDelay1_DSTATE_l "" UBYTE autosar_swc_las_CM_logical 0 0 0 1 ECU_ADDRESS 0xfe4ae51b /* @ECU_Address@autosar_swc_las_rtARID_DEF.UnitDelay1_DSTATE_l@ */ /end MEASUREMENT
/begin MEASUREMENT autosar_swc_las_rtARID_DEF.UnitDelay2_DSTATE_bl "" UBYTE autosar_swc_las_CM_logical 0 0 0 1 ECU_ADDRESS 0xfe4ae51c /* @ECU_Address@autosar_swc_las_rtARID_DEF.UnitDelay2_DSTATE_bl@ */ /end MEASUREMENT
/begin MEASUREMENT autosar_swc_las_rtARID_DEF.UnitDelay3_DSTATE_h "" UBYTE autosar_swc_las_CM_uint8 0 0 0 255 ECU_ADDRESS 0xfe4ae4c1 /* @ECU_Address@autosar_swc_las_rtARID_DEF.UnitDelay3_DSTATE_h@ */ /end MEASUREMENT
/begin MEASUREMENT autosar_swc_las_rtARID_DEF.UnitDelay3_DSTATE_hr "" UBYTE autosar_swc_las_CM_logical 0 0 0 1 ECU_ADDRESS 0xfe4ae51d /* @ECU_Address@autosar_swc_las_rtARID_DEF.UnitDelay3_DSTATE_hr@ */ /end MEASUREMENT
/begin MEASUREMENT autosar_swc_las_rtARID_DEF.UnitDelay_DSTATE_a0 "" UBYTE autosar_swc_las_CM_logical 0 0 0 1 ECU_ADDRESS 0xfe4ae51a /* @ECU_Address@autosar_swc_las_rtARID_DEF.UnitDelay_DSTATE_a0@ */ /end MEASUREMENT
/begin MEASUREMENT autosar_swc_las_rtARID_DEF.UnitDelay_DSTATE_cj "" FLOAT64_IEEE autosar_swc_las_CM_double 0 0 -1.7E+308 1.7E+308 ECU_ADDRESS 0xfe4ae178 /* @ECU_Address@autosar_swc_las_rtARID_DEF.UnitDelay_DSTATE_cj@ */ /end MEASUREMENT
/begin MEASUREMENT autosar_swc_las_rtARID_DEF.UnitDelay_DSTATE_cq "" FLOAT64_IEEE autosar_swc_las_CM_double 0 0 -1.7E+308 1.7E+308 ECU_ADDRESS 0xfe4ae168 /* @ECU_Address@autosar_swc_las_rtARID_DEF.UnitDelay_DSTATE_cq@ */ /end MEASUREMENT
/begin MEASUREMENT autosar_swc_las_rtARID_DEF.UnitDelay_DSTATE_dt "" FLOAT64_IEEE autosar_swc_las_CM_double 0 0 -1.7E+308 1.7E+308 ECU_ADDRESS 0xfe4ae158 /* @ECU_Address@autosar_swc_las_rtARID_DEF.UnitDelay_DSTATE_dt@ */ /end MEASUREMENT
/begin MEASUREMENT autosar_swc_las_rtARID_DEF.UnitDelay_DSTATE_ep "" FLOAT64_IEEE autosar_swc_las_CM_double 0 0 -1.7E+308 1.7E+308 ECU_ADDRESS 0xfe4ae128 /* @ECU_Address@autosar_swc_las_rtARID_DEF.UnitDelay_DSTATE_ep@ */ /end MEASUREMENT
/begin MEASUREMENT autosar_swc_las_rtARID_DEF.UnitDelay_DSTATE_gl "" FLOAT64_IEEE autosar_swc_las_CM_double 0 0 -1.7E+308 1.7E+308 ECU_ADDRESS 0xfe4ae1b0 /* @ECU_Address@autosar_swc_las_rtARID_DEF.UnitDelay_DSTATE_gl@ */ /end MEASUREMENT
/begin MEASUREMENT autosar_swc_las_rtARID_DEF.UnitDelay_DSTATE_he "" FLOAT64_IEEE autosar_swc_las_CM_double 0 0 -1.7E+308 1.7E+308 ECU_ADDRESS 0xfe4ae1a8 /* @ECU_Address@autosar_swc_las_rtARID_DEF.UnitDelay_DSTATE_he@ */ /end MEASUREMENT
/begin MEASUREMENT autosar_swc_las_rtARID_DEF.UnitDelay_DSTATE_hq "" FLOAT64_IEEE autosar_swc_las_CM_double 0 0 -1.7E+308 1.7E+308 ECU_ADDRESS 0xfe4ae180 /* @ECU_Address@autosar_swc_las_rtARID_DEF.UnitDelay_DSTATE_hq@ */ /end MEASUREMENT
/begin MEASUREMENT autosar_swc_las_rtARID_DEF.UnitDelay_DSTATE_iqm "" FLOAT64_IEEE autosar_swc_las_CM_double 0 0 -1.7E+308 1.7E+308 ECU_ADDRESS 0xfe4ae150 /* @ECU_Address@autosar_swc_las_rtARID_DEF.UnitDelay_DSTATE_iqm@ */ /end MEASUREMENT
/begin MEASUREMENT autosar_swc_las_rtARID_DEF.UnitDelay_DSTATE_jj "" FLOAT64_IEEE autosar_swc_las_CM_double 0 0 -1.7E+308 1.7E+308 ECU_ADDRESS 0xfe4ae160 /* @ECU_Address@autosar_swc_las_rtARID_DEF.UnitDelay_DSTATE_jj@ */ /end MEASUREMENT
/begin MEASUREMENT autosar_swc_las_rtARID_DEF.UnitDelay_DSTATE_ld "" FLOAT64_IEEE autosar_swc_las_CM_double 0 0 -1.7E+308 1.7E+308 ECU_ADDRESS 0xfe4ae188 /* @ECU_Address@autosar_swc_las_rtARID_DEF.UnitDelay_DSTATE_ld@ */ /end MEASUREMENT
/begin MEASUREMENT autosar_swc_las_rtARID_DEF.UnitDelay_DSTATE_lr "" FLOAT64_IEEE autosar_swc_las_CM_double 0 0 -1.7E+308 1.7E+308 ECU_ADDRESS 0xfe4ae190 /* @ECU_Address@autosar_swc_las_rtARID_DEF.UnitDelay_DSTATE_lr@ */ /end MEASUREMENT
/begin MEASUREMENT autosar_swc_las_rtARID_DEF.UnitDelay_DSTATE_n5 "" FLOAT64_IEEE autosar_swc_las_CM_double 0 0 -1.7E+308 1.7E+308 ECU_ADDRESS 0xfe4ae1b8 /* @ECU_Address@autosar_swc_las_rtARID_DEF.UnitDelay_DSTATE_n5@ */ /end MEASUREMENT
/begin MEASUREMENT autosar_swc_las_rtARID_DEF.UnitDelay_DSTATE_oj "" FLOAT64_IEEE autosar_swc_las_CM_double 0 0 -1.7E+308 1.7E+308 ECU_ADDRESS 0xfe4ae170 /* @ECU_Address@autosar_swc_las_rtARID_DEF.UnitDelay_DSTATE_oj@ */ /end MEASUREMENT
/begin MEASUREMENT autosar_swc_las_rtARID_DEF.UnitDelay_DSTATE_oz "" FLOAT64_IEEE autosar_swc_las_CM_double 0 0 -1.7E+308 1.7E+308 ECU_ADDRESS 0xfe4ae148 /* @ECU_Address@autosar_swc_las_rtARID_DEF.UnitDelay_DSTATE_oz@ */ /end MEASUREMENT
/begin MEASUREMENT autosar_swc_las_rtARID_DEF.UnitDelay_DSTATE_ps "" FLOAT64_IEEE autosar_swc_las_CM_double 0 0 -1.7E+308 1.7E+308 ECU_ADDRESS 0xfe4ae130 /* @ECU_Address@autosar_swc_las_rtARID_DEF.UnitDelay_DSTATE_ps@ */ /end MEASUREMENT
/begin MEASUREMENT autosar_swc_las_rtARID_DEF.nums "" UBYTE autosar_swc_las_CM_uint8 0 0 0 255 ECU_ADDRESS 0xfe4ae4b5 /* @ECU_Address@autosar_swc_las_rtARID_DEF.nums@ */ /end MEASUREMENT
/begin MEASUREMENT autosar_swc_las_rtARID_DEF.state "" UBYTE autosar_swc_las_CM_uint8 0 0 0 255 ECU_ADDRESS 0xfe4ae4b6 /* @ECU_Address@autosar_swc_las_rtARID_DEF.state@ */ /end MEASUREMENT
/begin AXIS_PTS P_LSS_ELK_Lane_Width_Table "" 0xfe8217b4 /* @ECU_Address@P_LSS_ELK_Lane_Width_Table@ */ NO_INPUT_QUANTITY Axis_FLOAT32_IEEE 0 autosar_swc_las_CM_single 7 -3.4E+38 3.4E+38 /end AXIS_PTS
/begin AXIS_PTS P_LSS_ELK_Sensitive_Table "" 0xfe8217ec /* @ECU_Address@P_LSS_ELK_Sensitive_Table@ */ NO_INPUT_QUANTITY Axis_FLOAT32_IEEE 0 autosar_swc_las_CM_single 3 -3.4E+38 3.4E+38 /end AXIS_PTS
/begin AXIS_PTS P_LSS_ELK_State_Param_LaneCurve "" 0xfe821584 /* @ECU_Address@P_LSS_ELK_State_Param_LaneCurve@ */ NO_INPUT_QUANTITY Axis_FLOAT32_IEEE 0 autosar_swc_las_CM_single 8 -3.4E+38 3.4E+38 /end AXIS_PTS
/begin AXIS_PTS P_LSS_ELK_State_Param_Speed "" 0xfe821644 /* @ECU_Address@P_LSS_ELK_State_Param_Speed@ */ NO_INPUT_QUANTITY Axis_FLOAT32_IEEE 0 autosar_swc_las_CM_single 16 -3.4E+38 3.4E+38 /end AXIS_PTS
/begin COMPU_METHOD autosar_swc_las_CM_boolean "Q = V" IDENTICAL "%1.0" "" /end COMPU_METHOD
/begin COMPU_METHOD autosar_swc_las_CM_double "Q = V" IDENTICAL "%15.10" "" /end COMPU_METHOD
/begin COMPU_METHOD autosar_swc_las_CM_logical "Q = V" IDENTICAL "%1.0" "" /end COMPU_METHOD
/begin COMPU_METHOD autosar_swc_las_CM_single "Q = V" IDENTICAL "%8.6" "" /end COMPU_METHOD
/begin COMPU_METHOD autosar_swc_las_CM_uint16 "Q = V" IDENTICAL "%5.0" "" /end COMPU_METHOD
/begin COMPU_METHOD autosar_swc_las_CM_uint32 "Q = V" IDENTICAL "%10.0" "" /end COMPU_METHOD
/begin COMPU_METHOD autosar_swc_las_CM_uint8 "Q = V" IDENTICAL "%3.0" "" /end COMPU_METHOD
/begin RECORD_LAYOUT Record_BOOLEAN FNC_VALUES 1 UBYTE COLUMN_DIR DIRECT /end RECORD_LAYOUT
/begin RECORD_LAYOUT Record_FLOAT32_IEEE FNC_VALUES 1 FLOAT32_IEEE COLUMN_DIR DIRECT /end RECORD_LAYOUT
/begin RECORD_LAYOUT Record_FLOAT64_IEEE FNC_VALUES 1 FLOAT64_IEEE COLUMN_DIR DIRECT /end RECORD_LAYOUT
/begin RECORD_LAYOUT Record_UBYTE FNC_VALUES 1 UBYTE COLUMN_DIR DIRECT /end RECORD_LAYOUT
/begin RECORD_LAYOUT Record_ULONG FNC_VALUES 1 ULONG COLUMN_DIR DIRECT /end RECORD_LAYOUT
/begin RECORD_LAYOUT Record_UWORD FNC_VALUES 1 UWORD COLUMN_DIR DIRECT /end RECORD_LAYOUT
/begin RECORD_LAYOUT Axis_FLOAT32_IEEE AXIS_PTS_X 1 FLOAT32_IEEE INDEX_INCR DIRECT /end RECORD_LAYOUT
/begin GROUP ZDrive_BSW_Cal_Cal.ZDrive_BSW_Cal_VehicleInfomationTable ""
 /begin REF_CHARACTERISTIC ZDrive_BSW_Cal_Cal.ZDrive_BSW_Cal_VehicleInfomationTable.RADAR_MOUNT_PARAM_FRONT_X_POSITION ZDrive_BSW_Cal_Cal.ZDrive_BSW_Cal_VehicleInfomationTable.RADAR_MOUNT_PARAM_FRONT_Y_POSITION ZDrive_BSW_Cal_Cal.ZDrive_BSW_Cal_VehicleInfomationTable.RADAR_MOUNT_PARAM_FRONT_YAW_ANGLE ZDrive_BSW_Cal_Cal.ZDrive_BSW_Cal_VehicleInfomationTable.RADAR_MOUNT_PARAM_FL_X_POSITION ZDrive_BSW_Cal_Cal.ZDrive_BSW_Cal_VehicleInfomationTable.RADAR_MOUNT_PARAM_FL_Y_POSITION ZDrive_BSW_Cal_Cal.ZDrive_BSW_Cal_VehicleInfomationTable.RADAR_MOUNT_PARAM_FL_YAW_ANGLE ZDrive_BSW_Cal_Cal.ZDrive_BSW_Cal_VehicleInfomationTable.RADAR_MOUNT_PARAM_FR_X_POSITION ZDrive_BSW_Cal_Cal.ZDrive_BSW_Cal_VehicleInfomationTable.RADAR_MOUNT_PARAM_FR_Y_POSITION ZDrive_BSW_Cal_Cal.ZDrive_BSW_Cal_VehicleInfomationTable.RADAR_MOUNT_PARAM_FR_YAW_ANGLE ZDrive_BSW_Cal_Cal.ZDrive_BSW_Cal_VehicleInfomationTable.RADAR_MOUNT_PARAM_RL_X_POSITION ZDrive_BSW_Cal_Cal.ZDrive_BSW_Cal_VehicleInfomationTable.RADAR_MOUNT_PARAM_RL_Y_POSITION ZDrive_BSW_Cal_Cal.ZDrive_BSW_Cal_VehicleInfomationTable.RADAR_MOUNT_PARAM_RL_YAW_ANGLE ZDrive_BSW_Cal_Cal.ZDrive_BSW_Cal_VehicleInfomationTable.RADAR_MOUNT_PARAM_RR_X_POSITION ZDrive_BSW_Cal_Cal.ZDrive_BSW_Cal_VehicleInfomationTable.RADAR_MOUNT_PARAM_RR_Y_POSITION ZDrive_BSW_Cal_Cal.ZDrive_BSW_Cal_VehicleInfomationTable.RADAR_MOUNT_PARAM_RR_YAW_ANGLE ZDrive_BSW_Cal_Cal.ZDrive_BSW_Cal_VehicleInfomationTable.Vehicle_Information_Reserved_Line277 ZDrive_BSW_Cal_Cal.ZDrive_BSW_Cal_VehicleInfomationTable.Vehicle_Information_Reserved_Line278 ZDrive_BSW_Cal_Cal.ZDrive_BSW_Cal_VehicleInfomationTable.Vehicle_Information_Reserved_Line279 ZDrive_BSW_Cal_Cal.ZDrive_BSW_Cal_VehicleInfomationTable.Vehicle_Information_Reserved_Line280 ZDrive_BSW_Cal_Cal.ZDrive_BSW_Cal_VehicleInfomationTable.Vehicle_Information_Reserved_Line281 ZDrive_BSW_Cal_Cal.ZDrive_BSW_Cal_VehicleInfomationTable.Vehicle_Information_Reserved_Line282 ZDrive_BSW_Cal_Cal.ZDrive_BSW_Cal_VehicleInfomationTable.Vehicle_Information_Reserved_Line283 ZDrive_BSW_Cal_Cal.ZDrive_BSW_Cal_VehicleInfomationTable.Vehicle_Information_Reserved_Line284 ZDrive_BSW_Cal_Cal.ZDrive_BSW_Cal_VehicleInfomationTable.Vehicle_Information_Reserved_Line285 ZDrive_BSW_Cal_Cal.ZDrive_BSW_Cal_VehicleInfomationTable.Vehicle_Information_Reserved_Line286 ZDrive_BSW_Cal_Cal.ZDrive_BSW_Cal_VehicleInfomationTable.Vehicle_Information_Reserved_Line287 ZDrive_BSW_Cal_Cal.ZDrive_BSW_Cal_VehicleInfomationTable.Vehicle_Information_Reserved_Line288 ZDrive_BSW_Cal_Cal.ZDrive_BSW_Cal_VehicleInfomationTable.Vehicle_Information_Reserved_Line289 ZDrive_BSW_Cal_Cal.ZDrive_BSW_Cal_VehicleInfomationTable.Vehicle_Information_Reserved_Line290 ZDrive_BSW_Cal_Cal.ZDrive_BSW_Cal_VehicleInfomationTable.Vehicle_Information_Reserved_Line291 ZDrive_BSW_Cal_Cal.ZDrive_BSW_Cal_VehicleInfomationTable.Vehicle_Information_Reserved_Line292 ZDrive_BSW_Cal_Cal.ZDrive_BSW_Cal_VehicleInfomationTable.Vehicle_Information_Reserved_Line293 ZDrive_BSW_Cal_Cal.ZDrive_BSW_Cal_VehicleInfomationTable.Vehicle_Information_Reserved_Line294 ZDrive_BSW_Cal_Cal.ZDrive_BSW_Cal_VehicleInfomationTable.Vehicle_Information_Reserved_Line295 ZDrive_BSW_Cal_Cal.ZDrive_BSW_Cal_VehicleInfomationTable.Vehicle_Information_Reserved_Line296 ZDrive_BSW_Cal_Cal.ZDrive_BSW_Cal_VehicleInfomationTable.Vehicle_Information_Reserved_Line297 ZDrive_BSW_Cal_Cal.ZDrive_BSW_Cal_VehicleInfomationTable.Vehicle_Information_Reserved_Line298 ZDrive_BSW_Cal_Cal.ZDrive_BSW_Cal_VehicleInfomationTable.Vehicle_Information_Reserved_Line299 ZDrive_BSW_Cal_Cal.ZDrive_BSW_Cal_VehicleInfomationTable.Vehicle_Information_Reserved_Line300 ZDrive_BSW_Cal_Cal.ZDrive_BSW_Cal_VehicleInfomationTable.Vehicle_Information_Reserved_Line301 ZDrive_BSW_Cal_Cal.ZDrive_BSW_Cal_VehicleInfomationTable.Vehicle_Information_Reserved_Line302 ZDrive_BSW_Cal_Cal.ZDrive_BSW_Cal_VehicleInfomationTable.Vehicle_Information_Reserved_Line303 ZDrive_BSW_Cal_Cal.ZDrive_BSW_Cal_VehicleInfomationTable.Vehicle_Information_Reserved_Line304 ZDrive_BSW_Cal_Cal.ZDrive_BSW_Cal_VehicleInfomationTable.Vehicle_Information_Reserved_Line305 ZDrive_BSW_Cal_Cal.ZDrive_BSW_Cal_VehicleInfomationTable.Vehicle_Information_Reserved_Line306 ZDrive_BSW_Cal_Cal.ZDrive_BSW_Cal_VehicleInfomationTable.Vehicle_Information_Reserved_Line307 ZDrive_BSW_Cal_Cal.ZDrive_BSW_Cal_VehicleInfomationTable.Vehicle_Information_Reserved_Line308 ZDrive_BSW_Cal_Cal.ZDrive_BSW_Cal_VehicleInfomationTable.Vehicle_Information_Reserved_Line309 ZDrive_BSW_Cal_Cal.ZDrive_BSW_Cal_VehicleInfomationTable.Vehicle_Information_Reserved_Line310 ZDrive_BSW_Cal_Cal.ZDrive_BSW_Cal_VehicleInfomationTable.Vehicle_Information_Reserved_Line311 ZDrive_BSW_Cal_Cal.ZDrive_BSW_Cal_VehicleInfomationTable.Vehicle_Information_Reserved_Line312 ZDrive_BSW_Cal_Cal.ZDrive_BSW_Cal_VehicleInfomationTable.Vehicle_Information_Reserved_Line313 ZDrive_BSW_Cal_Cal.ZDrive_BSW_Cal_VehicleInfomationTable.Vehicle_Information_Reserved_Line314 ZDrive_BSW_Cal_Cal.ZDrive_BSW_Cal_VehicleInfomationTable.Vehicle_Information_Reserved_Line315 ZDrive_BSW_Cal_Cal.ZDrive_BSW_Cal_VehicleInfomationTable.Vehicle_Information_Reserved_Line316 ZDrive_BSW_Cal_Cal.ZDrive_BSW_Cal_VehicleInfomationTable.Vehicle_Information_Reserved_Line317 ZDrive_BSW_Cal_Cal.ZDrive_BSW_Cal_VehicleInfomationTable.Vehicle_Information_Reserved_Line318 ZDrive_BSW_Cal_Cal.ZDrive_BSW_Cal_VehicleInfomationTable.Vehicle_Information_Reserved_Line319 ZDrive_BSW_Cal_Cal.ZDrive_BSW_Cal_VehicleInfomationTable.Vehicle_Information_Reserved_Line320 ZDrive_BSW_Cal_Cal.ZDrive_BSW_Cal_VehicleInfomationTable.Vehicle_Information_Reserved_Line321 ZDrive_BSW_Cal_Cal.ZDrive_BSW_Cal_VehicleInfomationTable.Vehicle_Information_Reserved_Line322 ZDrive_BSW_Cal_Cal.ZDrive_BSW_Cal_VehicleInfomationTable.Vehicle_Information_Reserved_Line323 ZDrive_BSW_Cal_Cal.ZDrive_BSW_Cal_VehicleInfomationTable.Vehicle_Information_Reserved_Line324 ZDrive_BSW_Cal_Cal.ZDrive_BSW_Cal_VehicleInfomationTable.Vehicle_Information_Reserved_Line325 ZDrive_BSW_Cal_Cal.ZDrive_BSW_Cal_VehicleInfomationTable.Vehicle_Information_Reserved_Line326 ZDrive_BSW_Cal_Cal.ZDrive_BSW_Cal_VehicleInfomationTable.Vehicle_Information_Reserved_Line327 ZDrive_BSW_Cal_Cal.ZDrive_BSW_Cal_VehicleInfomationTable.Vehicle_Information_Reserved_Line328 ZDrive_BSW_Cal_Cal.ZDrive_BSW_Cal_VehicleInfomationTable.Vehicle_Information_Reserved_Line329 ZDrive_BSW_Cal_Cal.ZDrive_BSW_Cal_VehicleInfomationTable.Vehicle_Information_Reserved_Line330 ZDrive_BSW_Cal_Cal.ZDrive_BSW_Cal_VehicleInfomationTable.Vehicle_Information_Reserved_Line331 ZDrive_BSW_Cal_Cal.ZDrive_BSW_Cal_VehicleInfomationTable.Vehicle_Information_Reserved_Line332 ZDrive_BSW_Cal_Cal.ZDrive_BSW_Cal_VehicleInfomationTable.Vehicle_Information_Reserved_Line333 ZDrive_BSW_Cal_Cal.ZDrive_BSW_Cal_VehicleInfomationTable.Vehicle_Information_Reserved_Line334 ZDrive_BSW_Cal_Cal.ZDrive_BSW_Cal_VehicleInfomationTable.Vehicle_Information_Reserved_Line335 ZDrive_BSW_Cal_Cal.ZDrive_BSW_Cal_VehicleInfomationTable.Vehicle_Information_Reserved_Line336 ZDrive_BSW_Cal_Cal.ZDrive_BSW_Cal_VehicleInfomationTable.Vehicle_Information_Reserved_Line337 ZDrive_BSW_Cal_Cal.ZDrive_BSW_Cal_VehicleInfomationTable.Vehicle_Information_Reserved_Line338 ZDrive_BSW_Cal_Cal.ZDrive_BSW_Cal_VehicleInfomationTable.Vehicle_Information_Reserved_Line339 ZDrive_BSW_Cal_Cal.ZDrive_BSW_Cal_VehicleInfomationTable.Vehicle_Information_Reserved_Line340 ZDrive_BSW_Cal_Cal.ZDrive_BSW_Cal_VehicleInfomationTable.Vehicle_Information_Reserved_Line341 ZDrive_BSW_Cal_Cal.ZDrive_BSW_Cal_VehicleInfomationTable.Vehicle_Information_Reserved_Line342 ZDrive_BSW_Cal_Cal.ZDrive_BSW_Cal_VehicleInfomationTable.Vehicle_Information_Reserved_Line343 ZDrive_BSW_Cal_Cal.ZDrive_BSW_Cal_VehicleInfomationTable.Vehicle_Information_Reserved_Line344 ZDrive_BSW_Cal_Cal.ZDrive_BSW_Cal_VehicleInfomationTable.Vehicle_Information_Reserved_Line345 ZDrive_BSW_Cal_Cal.ZDrive_BSW_Cal_VehicleInfomationTable.Vehicle_Information_Reserved_Line346 ZDrive_BSW_Cal_Cal.ZDrive_BSW_Cal_VehicleInfomationTable.Vehicle_Information_Reserved_Line347 ZDrive_BSW_Cal_Cal.ZDrive_BSW_Cal_VehicleInfomationTable.Vehicle_Information_Reserved_Line348 ZDrive_BSW_Cal_Cal.ZDrive_BSW_Cal_VehicleInfomationTable.Vehicle_Information_Reserved_Line349 ZDrive_BSW_Cal_Cal.ZDrive_BSW_Cal_VehicleInfomationTable.Vehicle_Information_Reserved_Line350 ZDrive_BSW_Cal_Cal.ZDrive_BSW_Cal_VehicleInfomationTable.Vehicle_Information_Reserved_Line351 ZDrive_BSW_Cal_Cal.ZDrive_BSW_Cal_VehicleInfomationTable.Vehicle_Information_Reserved_Line352 ZDrive_BSW_Cal_Cal.ZDrive_BSW_Cal_VehicleInfomationTable.Vehicle_Information_Reserved_Line353 ZDrive_BSW_Cal_Cal.ZDrive_BSW_Cal_VehicleInfomationTable.Vehicle_Information_Reserved_Line354 ZDrive_BSW_Cal_Cal.ZDrive_BSW_Cal_VehicleInfomationTable.Vehicle_Information_End_Tag /end REF_CHARACTERISTIC
/end GROUP
/begin GROUP autosar_swc_las "autosar_swc_las" ROOT
 /begin SUB_GROUP LSS_ExecTimestamp SwcOut_LAS_CTRL SwcOut_LAS_HMI SwcOut_LAS_Herbeat_info SwcOut_LAS_STATE autosar_swc_las_autosar_swc_las_Step_sys /end SUB_GROUP
/end GROUP
/begin GROUP autosar_swc_las_autosar_swc_las_Step_sys "autosar_swc_las/autosar_swc_las_Step_sys"
 /begin SUB_GROUP autosar_swc_las_autosar_swc_las_Step_sys_Subsystem autosar_swc_las_autosar_swc_las_Step_sys_las /end SUB_GROUP
/end GROUP
/begin GROUP autosar_swc_las_autosar_swc_las_Step_sys_Subsystem "autosar_swc_las/autosar_swc_las_Step_sys/Subsystem" /begin REF_MEASUREMENT LAS_Version /end REF_MEASUREMENT /end GROUP
/begin GROUP autosar_swc_las_autosar_swc_las_Step_sys_las "autosar_swc_las/autosar_swc_las_Step_sys/las"
 /begin SUB_GROUP autosar_swc_las_autosar_swc_las_Step_sys_las_ELKState_Machine autosar_swc_las_autosar_swc_las_Step_sys_las_LDW autosar_swc_las_autosar_swc_las_Step_sys_las_LKA autosar_swc_las_autosar_swc_las_Step_sys_las_OutPort autosar_swc_las_autosar_swc_las_Step_sys_las_SCM1 autosar_swc_las_autosar_swc_las_Step_sys_las_Subsystem1 /end SUB_GROUP
 /begin REF_MEASUREMENT LAS_ELK_Active2Ready LAS_ELK_EPSTqDegOverrideFlag_b LAS_ELK_EPSTqDiffOverFlag_b LAS_ELK_EPSTqSameOverFlag_b LAS_ELK_Ldy LAS_ELK_LeftInCrossLineFlag_b LAS_ELK_LeftLaneChangeReFlag_b LAS_ELK_LeftOutCrossLineFlag_b LAS_ELK_Rdy LAS_ELK_Ready2Active LAS_ELK_RiInCrossLineFlag_b LAS_ELK_RiLaneChangeReFlag_b LAS_ELK_RiOutCrossLineFlag_b LAS_LDW_Active2Ready LAS_LDW_Ldy LAS_LDW_LeftInCrossLineFlag_b LAS_LDW_LeftLaneChangeReFlag_b LAS_LDW_LeftOutCrossLineFlag_b LAS_LDW_Rdy LAS_LDW_Ready2Active LAS_LDW_RiInCrossLineFlag_b LAS_LDW_RiLaneChangeReFlag_b LAS_LDW_RiOutCrossLineFlag_b LAS_LKA_EPSTqDegOverrideFlag_b LAS_LKA_EPSTqDiffOverFlag_b LAS_LKA_EPSTqSameOverFlag_b LAS_LKA_Ldy LAS_LKA_LeftInCrossLineFlag_b LAS_LKA_LeftLaneChangeReFlag_b LAS_LKA_LeftOutCrossLineFlag_b LAS_LKA_Rdy LAS_LKA_RiInCrossLineFlag_b LAS_LKA_RiLaneChangeReFlag_b LAS_LKA_RiOutCrossLineFlag_b /end REF_MEASUREMENT
/end GROUP
/begin GROUP autosar_swc_las_autosar_swc_las_Step_sys_las_ELKState_Machine "autosar_swc_las/autosar_swc_las_Step_sys/las/ELKState_Machine"
 /begin SUB_GROUP autosar_swc_las_autosar_swc_las_Step_sys_las_ELKState_Machine_ELK_Condition1 autosar_swc_las_autosar_swc_las_Step_sys_las_ELKState_Machine_ELK_Scene autosar_swc_las_autosar_swc_las_Step_sys_las_ELKState_Machine_StateMachine1 /end SUB_GROUP
 /begin REF_CHARACTERISTIC P_LSS_ELK_Configure P_LSS_ELK_ConfigureSW /end REF_CHARACTERISTIC
 /begin REF_MEASUREMENT LAS_ELKState LAS_ELK_Number LAS_ELK_VERSION LAS_ELK_VehConfigELK LAS_Reserve7 autosar_swc_las_rtARID_DEF.UnitDelay3_DSTATE_h autosar_swc_las_rtARID_DEF.state /end REF_MEASUREMENT
/end GROUP
/begin GROUP autosar_swc_las_autosar_swc_las_Step_sys_las_ELKState_Machine_ELK_Condition1 "autosar_swc_las/autosar_swc_las_Step_sys/las/ELKState_Machine/ELK_Condition1"
 /begin SUB_GROUP autosar_swc_las_autosar_swc_las_Step_sys_las_ELKState_Machine_ELK_Condition1_Compare_To_Constant autosar_swc_las_autosar_swc_las_Step_sys_las_ELKState_Machine_ELK_Condition1_Compare_To_Constant1 autosar_swc_las_autosar_swc_las_Step_sys_las_ELKState_Machine_ELK_Condition1_Compare_To_Constant101 autosar_swc_las_autosar_swc_las_Step_sys_las_ELKState_Machine_ELK_Condition1_Compare_To_Constant104 autosar_swc_las_autosar_swc_las_Step_sys_las_ELKState_Machine_ELK_Condition1_Compare_To_Constant106 autosar_swc_las_autosar_swc_las_Step_sys_las_ELKState_Machine_ELK_Condition1_Compare_To_Constant107 autosar_swc_las_autosar_swc_las_Step_sys_las_ELKState_Machine_ELK_Condition1_Compare_To_Constant11 autosar_swc_las_autosar_swc_las_Step_sys_las_ELKState_Machine_ELK_Condition1_Compare_To_Constant111 autosar_swc_las_autosar_swc_las_Step_sys_las_ELKState_Machine_ELK_Condition1_Compare_To_Constant112 autosar_swc_las_autosar_swc_las_Step_sys_las_ELKState_Machine_ELK_Condition1_Compare_To_Constant12 autosar_swc_las_autosar_swc_las_Step_sys_las_ELKState_Machine_ELK_Condition1_Compare_To_Constant122 autosar_swc_las_autosar_swc_las_Step_sys_las_ELKState_Machine_ELK_Condition1_Compare_To_Constant123 autosar_swc_las_autosar_swc_las_Step_sys_las_ELKState_Machine_ELK_Condition1_Compare_To_Constant13 autosar_swc_las_autosar_swc_las_Step_sys_las_ELKState_Machine_ELK_Condition1_Compare_To_Constant14 autosar_swc_las_autosar_swc_las_Step_sys_las_ELKState_Machine_ELK_Condition1_Compare_To_Constant15 autosar_swc_las_autosar_swc_las_Step_sys_las_ELKState_Machine_ELK_Condition1_Compare_To_Constant17 autosar_swc_las_autosar_swc_las_Step_sys_las_ELKState_Machine_ELK_Condition1_Compare_To_Constant18 autosar_swc_las_autosar_swc_las_Step_sys_las_ELKState_Machine_ELK_Condition1_Compare_To_Constant20 autosar_swc_las_autosar_swc_las_Step_sys_las_ELKState_Machine_ELK_Condition1_Compare_To_Constant22 autosar_swc_las_autosar_swc_las_Step_sys_las_ELKState_Machine_ELK_Condition1_Compare_To_Constant225 autosar_swc_las_autosar_swc_las_Step_sys_las_ELKState_Machine_ELK_Condition1_Compare_To_Constant23 autosar_swc_las_autosar_swc_las_Step_sys_las_ELKState_Machine_ELK_Condition1_Compare_To_Constant24 autosar_swc_las_autosar_swc_las_Step_sys_las_ELKState_Machine_ELK_Condition1_Compare_To_Constant27 autosar_swc_las_autosar_swc_las_Step_sys_las_ELKState_Machine_ELK_Condition1_Compare_To_Constant30 autosar_swc_las_autosar_swc_las_Step_sys_las_ELKState_Machine_ELK_Condition1_Compare_To_Constant51 autosar_swc_las_autosar_swc_las_Step_sys_las_ELKState_Machine_ELK_Condition1_Compare_To_Constant52 autosar_swc_las_autosar_swc_las_Step_sys_las_ELKState_Machine_ELK_Condition1_Compare_To_Constant63 autosar_swc_las_autosar_swc_las_Step_sys_las_ELKState_Machine_ELK_Condition1_Compare_To_Constant65 autosar_swc_las_autosar_swc_las_Step_sys_las_ELKState_Machine_ELK_Condition1_Compare_To_Constant70 autosar_swc_las_autosar_swc_las_Step_sys_las_ELKState_Machine_ELK_Condition1_Compare_To_Constant71 autosar_swc_las_autosar_swc_las_Step_sys_las_ELKState_Machine_ELK_Condition1_Compare_To_Constant72 autosar_swc_las_autosar_swc_las_Step_sys_las_ELKState_Machine_ELK_Condition1_Compare_To_Constant80 autosar_swc_las_autosar_swc_las_Step_sys_las_ELKState_Machine_ELK_Condition1_Compare_To_Constant83 autosar_swc_las_autosar_swc_las_Step_sys_las_ELKState_Machine_ELK_Condition1_Compare_To_Constant84 autosar_swc_las_autosar_swc_las_Step_sys_las_ELKState_Machine_ELK_Condition1_Compare_To_Constant85 autosar_swc_las_autosar_swc_las_Step_sys_las_ELKState_Machine_ELK_Condition1_Compare_To_Constant86 autosar_swc_las_autosar_swc_las_Step_sys_las_ELKState_Machine_ELK_Condition1_Compare_To_Constant9 autosar_swc_las_autosar_swc_las_Step_sys_las_ELKState_Machine_ELK_Condition1_Compare_To_Constant91 autosar_swc_las_autosar_swc_las_Step_sys_las_ELKState_Machine_ELK_Condition1_Compare_To_Constant92 autosar_swc_las_autosar_swc_las_Step_sys_las_ELKState_Machine_ELK_Condition1_Subsystem1 autosar_swc_las_autosar_swc_las_Step_sys_las_ELKState_Machine_ELK_Condition1_Subsystem10 autosar_swc_las_autosar_swc_las_Step_sys_las_ELKState_Machine_ELK_Condition1_Subsystem11 autosar_swc_las_autosar_swc_las_Step_sys_las_ELKState_Machine_ELK_Condition1_Subsystem12 autosar_swc_las_autosar_swc_las_Step_sys_las_ELKState_Machine_ELK_Condition1_Subsystem13 autosar_swc_las_autosar_swc_las_Step_sys_las_ELKState_Machine_ELK_Condition1_Subsystem14 autosar_swc_las_autosar_swc_las_Step_sys_las_ELKState_Machine_ELK_Condition1_Subsystem16 autosar_swc_las_autosar_swc_las_Step_sys_las_ELKState_Machine_ELK_Condition1_Subsystem18 autosar_swc_las_autosar_swc_las_Step_sys_las_ELKState_Machine_ELK_Condition1_Subsystem19 autosar_swc_las_autosar_swc_las_Step_sys_las_ELKState_Machine_ELK_Condition1_Subsystem2 autosar_swc_las_autosar_swc_las_Step_sys_las_ELKState_Machine_ELK_Condition1_Subsystem20 autosar_swc_las_autosar_swc_las_Step_sys_las_ELKState_Machine_ELK_Condition1_Subsystem3 autosar_swc_las_autosar_swc_las_Step_sys_las_ELKState_Machine_ELK_Condition1_Subsystem5 autosar_swc_las_autosar_swc_las_Step_sys_las_ELKState_Machine_ELK_Condition1_Subsystem6 autosar_swc_las_autosar_swc_las_Step_sys_las_ELKState_Machine_ELK_Condition1_Subsystem7 autosar_swc_las_autosar_swc_las_Step_sys_las_ELKState_Machine_ELK_Condition1_Subsystem8 autosar_swc_las_autosar_swc_las_Step_sys_las_ELKState_Machine_ELK_Condition1_Subsystem9 /end SUB_GROUP
 /begin REF_CHARACTERISTIC P_LSS_ELK_State_AEBActive_enable P_LSS_ELK_State_Absesp_enable P_LSS_ELK_State_Accpedalrate_enable P_LSS_ELK_State_Breakpressure_enable P_LSS_ELK_State_DriverInputTrqValue_enable P_LSS_ELK_State_EPSOn_enable P_LSS_ELK_State_ESPOn_enable P_LSS_ELK_State_GEAR_enable P_LSS_ELK_State_HazardLmpSts_enable P_LSS_ELK_State_Inhibit_enable P_LSS_ELK_State_LaneChange_enable P_LSS_ELK_State_Lane_enable P_LSS_ELK_State_Lanecurve_enable P_LSS_ELK_State_SteerWheelAngle_enable P_LSS_ELK_State_SteerWheelSpd_enable P_LSS_ELK_State_TrailerSts_enable P_LSS_ELK_State_TurnSWSts_enable P_LSS_ELK_State_Vehspeed_enable P_LSS_ELK_State_Yawsup_enable P_LSS_ELK_SteerSpd2IDEL_SteerSpdFactor P_LSS_ELK_SteerSpd2IEDL_VehicleSpdFactor P_LSS_ELK_SteerSpd2Ready_SteerSpdFactor P_LSS_ELK_SteerSpd2Ready_VehicleSpdFactor P_LSS_LKA_StateManMachineSharingSts_TIme P_LSS_LKA_StateManMachineSharingSts_enable /end REF_CHARACTERISTIC
 /begin REF_MEASUREMENT LAS_ELK_Idle2Ready LAS_ELK_Other2Idle LAS_Reserve4 autosar_swc_las_rtARID_DEF.Delay_DSTATE_m /end REF_MEASUREMENT
/end GROUP
/begin GROUP autosar_swc_las_autosar_swc_las_Step_sys_las_ELKState_Machine_ELK_Condition1_Compare_To_Constant "autosar_swc_las/autosar_swc_las_Step_sys/las/ELKState_Machine/ELK_Condition1/Compare\nTo Constant" /begin REF_MEASUREMENT autosar_swc_las_rtARID_DEF.nums /end REF_MEASUREMENT /end GROUP
/begin GROUP autosar_swc_las_autosar_swc_las_Step_sys_las_ELKState_Machine_ELK_Condition1_Compare_To_Constant1 "autosar_swc_las/autosar_swc_las_Step_sys/las/ELKState_Machine/ELK_Condition1/Compare\nTo Constant1" /begin REF_MEASUREMENT autosar_swc_las_rtARID_DEF.Cnt_HandsOff /end REF_MEASUREMENT /end GROUP
/begin GROUP autosar_swc_las_autosar_swc_las_Step_sys_las_ELKState_Machine_ELK_Condition1_Compare_To_Constant101 "autosar_swc_las/autosar_swc_las_Step_sys/las/ELKState_Machine/ELK_Condition1/Compare\nTo Constant101" /begin REF_CHARACTERISTIC P_LSS_ELK_State_HazardLmpSts_enableTime /end REF_CHARACTERISTIC /end GROUP
/begin GROUP autosar_swc_las_autosar_swc_las_Step_sys_las_ELKState_Machine_ELK_Condition1_Compare_To_Constant104 "autosar_swc_las/autosar_swc_las_Step_sys/las/ELKState_Machine/ELK_Condition1/Compare\nTo Constant104" /begin REF_CHARACTERISTIC P_LSS_ELK_State_Vehspeed_enableTime /end REF_CHARACTERISTIC /end GROUP
/begin GROUP autosar_swc_las_autosar_swc_las_Step_sys_las_ELKState_Machine_ELK_Condition1_Compare_To_Constant106 "autosar_swc_las/autosar_swc_las_Step_sys/las/ELKState_Machine/ELK_Condition1/Compare\nTo Constant106" /begin REF_CHARACTERISTIC P_LSS_ELK_State_Yawsup_enableTime /end REF_CHARACTERISTIC /end GROUP
/begin GROUP autosar_swc_las_autosar_swc_las_Step_sys_las_ELKState_Machine_ELK_Condition1_Compare_To_Constant107 "autosar_swc_las/autosar_swc_las_Step_sys/las/ELKState_Machine/ELK_Condition1/Compare\nTo Constant107" /begin REF_CHARACTERISTIC P_LSS_ELK_State_DriverInputTrqValue_enableTime /end REF_CHARACTERISTIC /end GROUP
/begin GROUP autosar_swc_las_autosar_swc_las_Step_sys_las_ELKState_Machine_ELK_Condition1_Compare_To_Constant11 "autosar_swc_las/autosar_swc_las_Step_sys/las/ELKState_Machine/ELK_Condition1/Compare\nTo Constant11" /begin REF_MEASUREMENT LAS_ELKState /end REF_MEASUREMENT /end GROUP
/begin GROUP autosar_swc_las_autosar_swc_las_Step_sys_las_ELKState_Machine_ELK_Condition1_Compare_To_Constant111 "autosar_swc_las/autosar_swc_las_Step_sys/las/ELKState_Machine/ELK_Condition1/Compare\nTo Constant111" /begin REF_CHARACTERISTIC P_LSS_ELK_VehSpdMinValue_kph /end REF_CHARACTERISTIC /end GROUP
/begin GROUP autosar_swc_las_autosar_swc_las_Step_sys_las_ELKState_Machine_ELK_Condition1_Compare_To_Constant112 "autosar_swc_las/autosar_swc_las_Step_sys/las/ELKState_Machine/ELK_Condition1/Compare\nTo Constant112" /begin REF_CHARACTERISTIC P_LSS_ELK_VehSpdMaxValue_kph /end REF_CHARACTERISTIC /end GROUP
/begin GROUP autosar_swc_las_autosar_swc_las_Step_sys_las_ELKState_Machine_ELK_Condition1_Compare_To_Constant12 "autosar_swc_las/autosar_swc_las_Step_sys/las/ELKState_Machine/ELK_Condition1/Compare\nTo Constant12" /begin REF_MEASUREMENT LAS_ELKState /end REF_MEASUREMENT /end GROUP
/begin GROUP autosar_swc_las_autosar_swc_las_Step_sys_las_ELKState_Machine_ELK_Condition1_Compare_To_Constant122 "autosar_swc_las/autosar_swc_las_Step_sys/las/ELKState_Machine/ELK_Condition1/Compare\nTo Constant122" /begin REF_CHARACTERISTIC P_LSS_ELK_TrailerStsInTime /end REF_CHARACTERISTIC /end GROUP
/begin GROUP autosar_swc_las_autosar_swc_las_Step_sys_las_ELKState_Machine_ELK_Condition1_Compare_To_Constant123 "autosar_swc_las/autosar_swc_las_Step_sys/las/ELKState_Machine/ELK_Condition1/Compare\nTo Constant123" /begin REF_CHARACTERISTIC P_LSS_ELK_AccRateOutTime /end REF_CHARACTERISTIC /end GROUP
/begin GROUP autosar_swc_las_autosar_swc_las_Step_sys_las_ELKState_Machine_ELK_Condition1_Compare_To_Constant13 "autosar_swc_las/autosar_swc_las_Step_sys/las/ELKState_Machine/ELK_Condition1/Compare\nTo Constant13" /begin REF_MEASUREMENT LAS_ELKState /end REF_MEASUREMENT /end GROUP
/begin GROUP autosar_swc_las_autosar_swc_las_Step_sys_las_ELKState_Machine_ELK_Condition1_Compare_To_Constant14 "autosar_swc_las/autosar_swc_las_Step_sys/las/ELKState_Machine/ELK_Condition1/Compare\nTo Constant14" /begin REF_CHARACTERISTIC P_LSS_ELK_AccRateInTime /end REF_CHARACTERISTIC /end GROUP
/begin GROUP autosar_swc_las_autosar_swc_las_Step_sys_las_ELKState_Machine_ELK_Condition1_Compare_To_Constant15 "autosar_swc_las/autosar_swc_las_Step_sys/las/ELKState_Machine/ELK_Condition1/Compare\nTo Constant15" /begin REF_MEASUREMENT LAS_ELKState /end REF_MEASUREMENT /end GROUP
/begin GROUP autosar_swc_las_autosar_swc_las_Step_sys_las_ELKState_Machine_ELK_Condition1_Compare_To_Constant17 "autosar_swc_las/autosar_swc_las_Step_sys/las/ELKState_Machine/ELK_Condition1/Compare\nTo Constant17" /begin REF_MEASUREMENT LAS_ELKState /end REF_MEASUREMENT /end GROUP
/begin GROUP autosar_swc_las_autosar_swc_las_Step_sys_las_ELKState_Machine_ELK_Condition1_Compare_To_Constant18 "autosar_swc_las/autosar_swc_las_Step_sys/las/ELKState_Machine/ELK_Condition1/Compare\nTo Constant18" /begin REF_MEASUREMENT LAS_ELKState /end REF_MEASUREMENT /end GROUP
/begin GROUP autosar_swc_las_autosar_swc_las_Step_sys_las_ELKState_Machine_ELK_Condition1_Compare_To_Constant20 "autosar_swc_las/autosar_swc_las_Step_sys/las/ELKState_Machine/ELK_Condition1/Compare\nTo Constant20" /begin REF_CHARACTERISTIC P_LSS_ELK_BrakePressIn /end REF_CHARACTERISTIC /end GROUP
/begin GROUP autosar_swc_las_autosar_swc_las_Step_sys_las_ELKState_Machine_ELK_Condition1_Compare_To_Constant22 "autosar_swc_las/autosar_swc_las_Step_sys/las/ELKState_Machine/ELK_Condition1/Compare\nTo Constant22" /begin REF_CHARACTERISTIC P_LSS_ELK_YawRateIn /end REF_CHARACTERISTIC /end GROUP
/begin GROUP autosar_swc_las_autosar_swc_las_Step_sys_las_ELKState_Machine_ELK_Condition1_Compare_To_Constant225 "autosar_swc_las/autosar_swc_las_Step_sys/las/ELKState_Machine/ELK_Condition1/Compare\nTo Constant225" /begin REF_CHARACTERISTIC P_LSS_ELK_DriverInputTrqValueOut /end REF_CHARACTERISTIC /end GROUP
/begin GROUP autosar_swc_las_autosar_swc_las_Step_sys_las_ELKState_Machine_ELK_Condition1_Compare_To_Constant23 "autosar_swc_las/autosar_swc_las_Step_sys/las/ELKState_Machine/ELK_Condition1/Compare\nTo Constant23" /begin REF_CHARACTERISTIC P_LSS_ELK_YawRateOutTime /end REF_CHARACTERISTIC /end GROUP
/begin GROUP autosar_swc_las_autosar_swc_las_Step_sys_las_ELKState_Machine_ELK_Condition1_Compare_To_Constant24 "autosar_swc_las/autosar_swc_las_Step_sys/las/ELKState_Machine/ELK_Condition1/Compare\nTo Constant24" /begin REF_MEASUREMENT LAS_ELKState /end REF_MEASUREMENT /end GROUP
/begin GROUP autosar_swc_las_autosar_swc_las_Step_sys_las_ELKState_Machine_ELK_Condition1_Compare_To_Constant27 "autosar_swc_las/autosar_swc_las_Step_sys/las/ELKState_Machine/ELK_Condition1/Compare\nTo Constant27" /begin REF_MEASUREMENT autosar_swc_las_rtARID_DEF.Cnt_HandsOff /end REF_MEASUREMENT /end GROUP
/begin GROUP autosar_swc_las_autosar_swc_las_Step_sys_las_ELKState_Machine_ELK_Condition1_Compare_To_Constant30 "autosar_swc_las/autosar_swc_las_Step_sys/las/ELKState_Machine/ELK_Condition1/Compare\nTo Constant30" /begin REF_CHARACTERISTIC P_LSS_ELK_DriverInputTrqValueIn /end REF_CHARACTERISTIC /end GROUP
/begin GROUP autosar_swc_las_autosar_swc_las_Step_sys_las_ELKState_Machine_ELK_Condition1_Compare_To_Constant51 "autosar_swc_las/autosar_swc_las_Step_sys/las/ELKState_Machine/ELK_Condition1/Compare\nTo Constant51" /begin REF_CHARACTERISTIC P_LSS_ELK_ExitVehSpdMinValue_kph /end REF_CHARACTERISTIC /end GROUP
/begin GROUP autosar_swc_las_autosar_swc_las_Step_sys_las_ELKState_Machine_ELK_Condition1_Compare_To_Constant52 "autosar_swc_las/autosar_swc_las_Step_sys/las/ELKState_Machine/ELK_Condition1/Compare\nTo Constant52" /begin REF_CHARACTERISTIC P_LSS_ELK_SteerWheelSpdInTime /end REF_CHARACTERISTIC /end GROUP
/begin GROUP autosar_swc_las_autosar_swc_las_Step_sys_las_ELKState_Machine_ELK_Condition1_Compare_To_Constant63 "autosar_swc_las/autosar_swc_las_Step_sys/las/ELKState_Machine/ELK_Condition1/Compare\nTo Constant63" /begin REF_CHARACTERISTIC P_LSS_ELK_LaneCurveIn /end REF_CHARACTERISTIC /end GROUP
/begin GROUP autosar_swc_las_autosar_swc_las_Step_sys_las_ELKState_Machine_ELK_Condition1_Compare_To_Constant65 "autosar_swc_las/autosar_swc_las_Step_sys/las/ELKState_Machine/ELK_Condition1/Compare\nTo Constant65" /begin REF_CHARACTERISTIC P_LSS_ELK_SteerWheelAngleOutTime /end REF_CHARACTERISTIC /end GROUP
/begin GROUP autosar_swc_las_autosar_swc_las_Step_sys_las_ELKState_Machine_ELK_Condition1_Compare_To_Constant70 "autosar_swc_las/autosar_swc_las_Step_sys/las/ELKState_Machine/ELK_Condition1/Compare\nTo Constant70" /begin REF_CHARACTERISTIC P_LSS_ELK_YawRateOut /end REF_CHARACTERISTIC /end GROUP
/begin GROUP autosar_swc_las_autosar_swc_las_Step_sys_las_ELKState_Machine_ELK_Condition1_Compare_To_Constant71 "autosar_swc_las/autosar_swc_las_Step_sys/las/ELKState_Machine/ELK_Condition1/Compare\nTo Constant71" /begin REF_CHARACTERISTIC P_LSS_ELK_ExitVehSpdMaxValue_kph /end REF_CHARACTERISTIC /end GROUP
/begin GROUP autosar_swc_las_autosar_swc_las_Step_sys_las_ELKState_Machine_ELK_Condition1_Compare_To_Constant72 "autosar_swc_las/autosar_swc_las_Step_sys/las/ELKState_Machine/ELK_Condition1/Compare\nTo Constant72" /begin REF_CHARACTERISTIC P_LSS_ELK_DriverInputTrqValueOutTime /end REF_CHARACTERISTIC /end GROUP
/begin GROUP autosar_swc_las_autosar_swc_las_Step_sys_las_ELKState_Machine_ELK_Condition1_Compare_To_Constant80 "autosar_swc_las/autosar_swc_las_Step_sys/las/ELKState_Machine/ELK_Condition1/Compare\nTo Constant80" /begin REF_CHARACTERISTIC P_LSS_ELK_BrakePressOut /end REF_CHARACTERISTIC /end GROUP
/begin GROUP autosar_swc_las_autosar_swc_las_Step_sys_las_ELKState_Machine_ELK_Condition1_Compare_To_Constant83 "autosar_swc_las/autosar_swc_las_Step_sys/las/ELKState_Machine/ELK_Condition1/Compare\nTo Constant83" /begin REF_CHARACTERISTIC P_LSS_ELK_AccRateOut /end REF_CHARACTERISTIC /end GROUP
/begin GROUP autosar_swc_las_autosar_swc_las_Step_sys_las_ELKState_Machine_ELK_Condition1_Compare_To_Constant84 "autosar_swc_las/autosar_swc_las_Step_sys/las/ELKState_Machine/ELK_Condition1/Compare\nTo Constant84" /begin REF_CHARACTERISTIC P_LSS_ELK_State_AEBActiveOutTime /end REF_CHARACTERISTIC /end GROUP
/begin GROUP autosar_swc_las_autosar_swc_las_Step_sys_las_ELKState_Machine_ELK_Condition1_Compare_To_Constant85 "autosar_swc_las/autosar_swc_las_Step_sys/las/ELKState_Machine/ELK_Condition1/Compare\nTo Constant85" /begin REF_CHARACTERISTIC P_LSS_ELK_LaneCurveOut /end REF_CHARACTERISTIC /end GROUP
/begin GROUP autosar_swc_las_autosar_swc_las_Step_sys_las_ELKState_Machine_ELK_Condition1_Compare_To_Constant86 "autosar_swc_las/autosar_swc_las_Step_sys/las/ELKState_Machine/ELK_Condition1/Compare\nTo Constant86" /begin REF_CHARACTERISTIC P_LSS_ELK_State_LanecurveOutTime /end REF_CHARACTERISTIC /end GROUP
/begin GROUP autosar_swc_las_autosar_swc_las_Step_sys_las_ELKState_Machine_ELK_Condition1_Compare_To_Constant9 "autosar_swc_las/autosar_swc_las_Step_sys/las/ELKState_Machine/ELK_Condition1/Compare\nTo Constant9" /begin REF_MEASUREMENT LAS_ELKState /end REF_MEASUREMENT /end GROUP
/begin GROUP autosar_swc_las_autosar_swc_las_Step_sys_las_ELKState_Machine_ELK_Condition1_Compare_To_Constant91 "autosar_swc_las/autosar_swc_las_Step_sys/las/ELKState_Machine/ELK_Condition1/Compare\nTo Constant91" /begin REF_CHARACTERISTIC P_LSS_ELK_AccRateIn /end REF_CHARACTERISTIC /end GROUP
/begin GROUP autosar_swc_las_autosar_swc_las_Step_sys_las_ELKState_Machine_ELK_Condition1_Compare_To_Constant92 "autosar_swc_las/autosar_swc_las_Step_sys/las/ELKState_Machine/ELK_Condition1/Compare\nTo Constant92" /begin REF_CHARACTERISTIC P_LSS_ELK_BrakePressInTime /end REF_CHARACTERISTIC /end GROUP
/begin GROUP autosar_swc_las_autosar_swc_las_Step_sys_las_ELKState_Machine_ELK_Condition1_Subsystem1 "autosar_swc_las/autosar_swc_las_Step_sys/las/ELKState_Machine/ELK_Condition1/Subsystem1" /begin REF_CHARACTERISTIC P_LSS_LSMC_SampleTime /end REF_CHARACTERISTIC /begin REF_MEASUREMENT autosar_swc_las_rtARID_DEF.UnitDelay_DSTATE_ep /end REF_MEASUREMENT /end GROUP
/begin GROUP autosar_swc_las_autosar_swc_las_Step_sys_las_ELKState_Machine_ELK_Condition1_Subsystem10 "autosar_swc_las/autosar_swc_las_Step_sys/las/ELKState_Machine/ELK_Condition1/Subsystem10" /begin REF_CHARACTERISTIC P_LSS_LSMC_SampleTime /end REF_CHARACTERISTIC /begin REF_MEASUREMENT autosar_swc_las_rtARID_DEF.UnitDelay_DSTATE_lr /end REF_MEASUREMENT /end GROUP
/begin GROUP autosar_swc_las_autosar_swc_las_Step_sys_las_ELKState_Machine_ELK_Condition1_Subsystem11 "autosar_swc_las/autosar_swc_las_Step_sys/las/ELKState_Machine/ELK_Condition1/Subsystem11" /begin REF_CHARACTERISTIC P_LSS_LSMC_SampleTime /end REF_CHARACTERISTIC /begin REF_MEASUREMENT autosar_swc_las_rtARID_DEF.UnitDelay_DSTATE_cj /end REF_MEASUREMENT /end GROUP
/begin GROUP autosar_swc_las_autosar_swc_las_Step_sys_las_ELKState_Machine_ELK_Condition1_Subsystem12 "autosar_swc_las/autosar_swc_las_Step_sys/las/ELKState_Machine/ELK_Condition1/Subsystem12" /begin REF_CHARACTERISTIC P_LSS_LSMC_SampleTime /end REF_CHARACTERISTIC /begin REF_MEASUREMENT autosar_swc_las_rtARID_DEF.UnitDelay_DSTATE_gl /end REF_MEASUREMENT /end GROUP
/begin GROUP autosar_swc_las_autosar_swc_las_Step_sys_las_ELKState_Machine_ELK_Condition1_Subsystem13 "autosar_swc_las/autosar_swc_las_Step_sys/las/ELKState_Machine/ELK_Condition1/Subsystem13" /begin REF_CHARACTERISTIC P_LSS_LSMC_SampleTime /end REF_CHARACTERISTIC /begin REF_MEASUREMENT autosar_swc_las_rtARID_DEF.UnitDelay_DSTATE_ps /end REF_MEASUREMENT /end GROUP
/begin GROUP autosar_swc_las_autosar_swc_las_Step_sys_las_ELKState_Machine_ELK_Condition1_Subsystem14 "autosar_swc_las/autosar_swc_las_Step_sys/las/ELKState_Machine/ELK_Condition1/Subsystem14" /begin REF_CHARACTERISTIC P_LSS_LSMC_SampleTime /end REF_CHARACTERISTIC /begin REF_MEASUREMENT autosar_swc_las_rtARID_DEF.UnitDelay_DSTATE_he /end REF_MEASUREMENT /end GROUP
/begin GROUP autosar_swc_las_autosar_swc_las_Step_sys_las_ELKState_Machine_ELK_Condition1_Subsystem16 "autosar_swc_las/autosar_swc_las_Step_sys/las/ELKState_Machine/ELK_Condition1/Subsystem16" /begin REF_MEASUREMENT autosar_swc_las_rtARID_DEF.Delay2_DSTATE_p /end REF_MEASUREMENT /end GROUP
/begin GROUP autosar_swc_las_autosar_swc_las_Step_sys_las_ELKState_Machine_ELK_Condition1_Subsystem18 "autosar_swc_las/autosar_swc_las_Step_sys/las/ELKState_Machine/ELK_Condition1/Subsystem18" /begin REF_MEASUREMENT autosar_swc_las_rtARID_DEF.Delay2_DSTATE_i /end REF_MEASUREMENT /end GROUP
/begin GROUP autosar_swc_las_autosar_swc_las_Step_sys_las_ELKState_Machine_ELK_Condition1_Subsystem19 "autosar_swc_las/autosar_swc_las_Step_sys/las/ELKState_Machine/ELK_Condition1/Subsystem19" /begin REF_CHARACTERISTIC P_LSS_LSMC_SampleTime /end REF_CHARACTERISTIC /begin REF_MEASUREMENT autosar_swc_las_rtARID_DEF.UnitDelay_DSTATE_cq /end REF_MEASUREMENT /end GROUP
/begin GROUP autosar_swc_las_autosar_swc_las_Step_sys_las_ELKState_Machine_ELK_Condition1_Subsystem2 "autosar_swc_las/autosar_swc_las_Step_sys/las/ELKState_Machine/ELK_Condition1/Subsystem2" /begin REF_CHARACTERISTIC P_LSS_LSMC_SampleTime /end REF_CHARACTERISTIC /begin REF_MEASUREMENT autosar_swc_las_rtARID_DEF.UnitDelay_DSTATE_oz /end REF_MEASUREMENT /end GROUP
/begin GROUP autosar_swc_las_autosar_swc_las_Step_sys_las_ELKState_Machine_ELK_Condition1_Subsystem20 "autosar_swc_las/autosar_swc_las_Step_sys/las/ELKState_Machine/ELK_Condition1/Subsystem20" /begin REF_CHARACTERISTIC P_LSS_LSMC_SampleTime /end REF_CHARACTERISTIC /begin REF_MEASUREMENT autosar_swc_las_rtARID_DEF.UnitDelay_DSTATE_oj /end REF_MEASUREMENT /end GROUP
/begin GROUP autosar_swc_las_autosar_swc_las_Step_sys_las_ELKState_Machine_ELK_Condition1_Subsystem3 "autosar_swc_las/autosar_swc_las_Step_sys/las/ELKState_Machine/ELK_Condition1/Subsystem3" /begin REF_CHARACTERISTIC P_LSS_LSMC_SampleTime /end REF_CHARACTERISTIC /begin REF_MEASUREMENT autosar_swc_las_rtARID_DEF.UnitDelay_DSTATE_n5 /end REF_MEASUREMENT /end GROUP
/begin GROUP autosar_swc_las_autosar_swc_las_Step_sys_las_ELKState_Machine_ELK_Condition1_Subsystem5 "autosar_swc_las/autosar_swc_las_Step_sys/las/ELKState_Machine/ELK_Condition1/Subsystem5" /begin REF_CHARACTERISTIC P_LSS_LSMC_SampleTime /end REF_CHARACTERISTIC /begin REF_MEASUREMENT autosar_swc_las_rtARID_DEF.UnitDelay_DSTATE_dt /end REF_MEASUREMENT /end GROUP
/begin GROUP autosar_swc_las_autosar_swc_las_Step_sys_las_ELKState_Machine_ELK_Condition1_Subsystem6 "autosar_swc_las/autosar_swc_las_Step_sys/las/ELKState_Machine/ELK_Condition1/Subsystem6" /begin REF_CHARACTERISTIC P_LSS_LSMC_SampleTime /end REF_CHARACTERISTIC /begin REF_MEASUREMENT autosar_swc_las_rtARID_DEF.UnitDelay_DSTATE_iqm /end REF_MEASUREMENT /end GROUP
/begin GROUP autosar_swc_las_autosar_swc_las_Step_sys_las_ELKState_Machine_ELK_Condition1_Subsystem7 "autosar_swc_las/autosar_swc_las_Step_sys/las/ELKState_Machine/ELK_Condition1/Subsystem7" /begin REF_CHARACTERISTIC P_LSS_LSMC_SampleTime /end REF_CHARACTERISTIC /begin REF_MEASUREMENT autosar_swc_las_rtARID_DEF.UnitDelay_DSTATE_jj /end REF_MEASUREMENT /end GROUP
/begin GROUP autosar_swc_las_autosar_swc_las_Step_sys_las_ELKState_Machine_ELK_Condition1_Subsystem8 "autosar_swc_las/autosar_swc_las_Step_sys/las/ELKState_Machine/ELK_Condition1/Subsystem8" /begin REF_CHARACTERISTIC P_LSS_LSMC_SampleTime /end REF_CHARACTERISTIC /begin REF_MEASUREMENT autosar_swc_las_rtARID_DEF.UnitDelay_DSTATE_hq /end REF_MEASUREMENT /end GROUP
/begin GROUP autosar_swc_las_autosar_swc_las_Step_sys_las_ELKState_Machine_ELK_Condition1_Subsystem9 "autosar_swc_las/autosar_swc_las_Step_sys/las/ELKState_Machine/ELK_Condition1/Subsystem9" /begin REF_CHARACTERISTIC P_LSS_LSMC_SampleTime /end REF_CHARACTERISTIC /begin REF_MEASUREMENT autosar_swc_las_rtARID_DEF.UnitDelay_DSTATE_ld /end REF_MEASUREMENT /end GROUP
/begin GROUP autosar_swc_las_autosar_swc_las_Step_sys_las_ELKState_Machine_ELK_Scene "autosar_swc_las/autosar_swc_las_Step_sys/las/ELKState_Machine/ELK_Scene"
 /begin SUB_GROUP autosar_swc_las_autosar_swc_las_Step_sys_las_ELKState_Machine_ELK_Scene_Compare_To_Constant10 autosar_swc_las_autosar_swc_las_Step_sys_las_ELKState_Machine_ELK_Scene_Compare_To_Constant2 autosar_swc_las_autosar_swc_las_Step_sys_las_ELKState_Machine_ELK_Scene_Compare_To_Constant3 autosar_swc_las_autosar_swc_las_Step_sys_las_ELKState_Machine_ELK_Scene_Compare_To_Constant4 autosar_swc_las_autosar_swc_las_Step_sys_las_ELKState_Machine_ELK_Scene_Compare_To_Constant5 autosar_swc_las_autosar_swc_las_Step_sys_las_ELKState_Machine_ELK_Scene_Compare_To_Constant6 autosar_swc_las_autosar_swc_las_Step_sys_las_ELKState_Machine_ELK_Scene_Compare_To_Constant7 autosar_swc_las_autosar_swc_las_Step_sys_las_ELKState_Machine_ELK_Scene_Compare_To_Constant8 autosar_swc_las_autosar_swc_las_Step_sys_las_ELKState_Machine_ELK_Scene_Compare_To_Constant9 autosar_swc_las_autosar_swc_las_Step_sys_las_ELKState_Machine_ELK_Scene_DashLine autosar_swc_las_autosar_swc_las_Step_sys_las_ELKState_Machine_ELK_Scene_Line autosar_swc_las_autosar_swc_las_Step_sys_las_ELKState_Machine_ELK_Scene_OnComingCal autosar_swc_las_autosar_swc_las_Step_sys_las_ELKState_Machine_ELK_Scene_OvertakingCal autosar_swc_las_autosar_swc_las_Step_sys_las_ELKState_Machine_ELK_Scene_RoadEge autosar_swc_las_autosar_swc_las_Step_sys_las_ELKState_Machine_ELK_Scene_Subsystem autosar_swc_las_autosar_swc_las_Step_sys_las_ELKState_Machine_ELK_Scene_Subsystem1 autosar_swc_las_autosar_swc_las_Step_sys_las_ELKState_Machine_ELK_Scene_Subsystem2 autosar_swc_las_autosar_swc_las_Step_sys_las_ELKState_Machine_ELK_Scene_Subsystem3 autosar_swc_las_autosar_swc_las_Step_sys_las_ELKState_Machine_ELK_Scene_Subsystem5 /end SUB_GROUP
 /begin REF_CHARACTERISTIC P_LSS_ELK_CurveFactor P_LSS_ELK_Lane_Width_Table P_LSS_ELK_Lane_Width_Table_Calibration P_LSS_ELK_Sensitive_Switch P_LSS_ELK_Sensitive_Table P_LSS_ELK_Sensitive_Table_Calibration P_LSS_ELK_State_LineInterventionSWSts P_LSS_ELK_State_Param_AngleOffset P_LSS_ELK_State_Param_LaneCurve P_LSS_ELK_State_Param_LaneCurve_Offset P_LSS_ELK_State_Param_OnTime P_LSS_ELK_State_Param_Oncoming P_LSS_ELK_State_Param_OutOffset P_LSS_ELK_State_Param_OvTime P_LSS_ELK_State_Param_Over P_LSS_ELK_State_Param_Speed /end REF_CHARACTERISTIC
 /begin REF_MEASUREMENT LAS_ELK_LeftWarn LAS_ELK_OnComingFlag_b LAS_ELK_OvertakingFlag_b LAS_ELK_RightWarn autosar_swc_las_rtARID_DEF.UnitDelay1_DSTATE_l autosar_swc_las_rtARID_DEF.UnitDelay2_DSTATE_bl autosar_swc_las_rtARID_DEF.UnitDelay3_DSTATE_hr autosar_swc_las_rtARID_DEF.UnitDelay_DSTATE_a0 /end REF_MEASUREMENT
/end GROUP
/begin GROUP autosar_swc_las_autosar_swc_las_Step_sys_las_ELKState_Machine_ELK_Scene_Compare_To_Constant10 "autosar_swc_las/autosar_swc_las_Step_sys/las/ELKState_Machine/ELK_Scene/Compare\nTo Constant10" /begin REF_CHARACTERISTIC P_LSS_ELK_WarnInTime /end REF_CHARACTERISTIC /end GROUP
/begin GROUP autosar_swc_las_autosar_swc_las_Step_sys_las_ELKState_Machine_ELK_Scene_Compare_To_Constant8 "autosar_swc_las/autosar_swc_las_Step_sys/las/ELKState_Machine/ELK_Scene/Compare\nTo Constant8" /begin REF_CHARACTERISTIC P_LSS_ELK_WarnInTime /end REF_CHARACTERISTIC /end GROUP
/begin GROUP autosar_swc_las_autosar_swc_las_Step_sys_las_ELKState_Machine_ELK_Scene_Compare_To_Constant9 "autosar_swc_las/autosar_swc_las_Step_sys/las/ELKState_Machine/ELK_Scene/Compare\nTo Constant9" /begin REF_MEASUREMENT LAS_ELKState /end REF_MEASUREMENT /end GROUP
/begin GROUP autosar_swc_las_autosar_swc_las_Step_sys_las_ELKState_Machine_ELK_Scene_DashLine "autosar_swc_las/autosar_swc_las_Step_sys/las/ELKState_Machine/ELK_Scene/DashLine" /begin REF_MEASUREMENT LAS_ELKState LAS_ELK_Idle2Ready LAS_ELK_Other2Idle /end REF_MEASUREMENT /end GROUP
/begin GROUP autosar_swc_las_autosar_swc_las_Step_sys_las_ELKState_Machine_ELK_Scene_DashLine_Subsystem1_Subsystem2 "autosar_swc_las/autosar_swc_las_Step_sys/las/ELKState_Machine/ELK_Scene/DashLine/Subsystem1/Subsystem2" /begin REF_CHARACTERISTIC P_LSS_LSMC_SampleTime /end REF_CHARACTERISTIC /end GROUP
/begin GROUP autosar_swc_las_autosar_swc_las_Step_sys_las_ELKState_Machine_ELK_Scene_DashLine_Subsystem_Subsystem2 "autosar_swc_las/autosar_swc_las_Step_sys/las/ELKState_Machine/ELK_Scene/DashLine/Subsystem/Subsystem2" /begin REF_CHARACTERISTIC P_LSS_LSMC_SampleTime /end REF_CHARACTERISTIC /end GROUP
/begin GROUP autosar_swc_las_autosar_swc_las_Step_sys_las_ELKState_Machine_ELK_Scene_DashLine_TurnLightAffirm1_Subsystem9 "autosar_swc_las/autosar_swc_las_Step_sys/las/ELKState_Machine/ELK_Scene/DashLine/TurnLightAffirm1/Subsystem9" /begin REF_CHARACTERISTIC P_LSS_LSMC_SampleTime /end REF_CHARACTERISTIC /end GROUP
/begin GROUP autosar_swc_las_autosar_swc_las_Step_sys_las_ELKState_Machine_ELK_Scene_DashLine_TurnLightAffirm_Subsystem9 "autosar_swc_las/autosar_swc_las_Step_sys/las/ELKState_Machine/ELK_Scene/DashLine/TurnLightAffirm/Subsystem9" /begin REF_CHARACTERISTIC P_LSS_LSMC_SampleTime /end REF_CHARACTERISTIC /end GROUP
/begin GROUP autosar_swc_las_autosar_swc_las_Step_sys_las_ELKState_Machine_ELK_Scene_Line "autosar_swc_las/autosar_swc_las_Step_sys/las/ELKState_Machine/ELK_Scene/Line"
 /begin REF_CHARACTERISTIC P_LSS_ELK_State_Param_AngleOffset P_LSS_ELK_State_Param_OutOffset /end REF_CHARACTERISTIC
 /begin REF_MEASUREMENT LAS_ELKState /end REF_MEASUREMENT
/end GROUP
/begin GROUP autosar_swc_las_autosar_swc_las_Step_sys_las_ELKState_Machine_ELK_Scene_Line_Compare_To_Constant1 "autosar_swc_las/autosar_swc_las_Step_sys/las/ELKState_Machine/ELK_Scene/Line/Compare\nTo Constant1" /begin REF_MEASUREMENT LAS_ELKState /end REF_MEASUREMENT /end GROUP
/begin GROUP autosar_swc_las_autosar_swc_las_Step_sys_las_ELKState_Machine_ELK_Scene_Line_Compare_To_Constant2 "autosar_swc_las/autosar_swc_las_Step_sys/las/ELKState_Machine/ELK_Scene/Line/Compare\nTo Constant2" /begin REF_MEASUREMENT LAS_ELKState /end REF_MEASUREMENT /end GROUP
/begin GROUP autosar_swc_las_autosar_swc_las_Step_sys_las_ELKState_Machine_ELK_Scene_Line_Compare_To_Constant3 "autosar_swc_las/autosar_swc_las_Step_sys/las/ELKState_Machine/ELK_Scene/Line/Compare\nTo Constant3" /begin REF_MEASUREMENT LAS_ELKState /end REF_MEASUREMENT /end GROUP
/begin GROUP autosar_swc_las_autosar_swc_las_Step_sys_las_ELKState_Machine_ELK_Scene_Line_Compare_To_Constant4 "autosar_swc_las/autosar_swc_las_Step_sys/las/ELKState_Machine/ELK_Scene/Line/Compare\nTo Constant4" /begin REF_MEASUREMENT LAS_ELKState /end REF_MEASUREMENT /end GROUP
/begin GROUP autosar_swc_las_autosar_swc_las_Step_sys_las_ELKState_Machine_ELK_Scene_Line_Compare_To_Constant5 "autosar_swc_las/autosar_swc_las_Step_sys/las/ELKState_Machine/ELK_Scene/Line/Compare\nTo Constant5" /begin REF_MEASUREMENT LAS_ELKState /end REF_MEASUREMENT /end GROUP
/begin GROUP autosar_swc_las_autosar_swc_las_Step_sys_las_ELKState_Machine_ELK_Scene_Line_Compare_To_Constant6 "autosar_swc_las/autosar_swc_las_Step_sys/las/ELKState_Machine/ELK_Scene/Line/Compare\nTo Constant6" /begin REF_MEASUREMENT LAS_ELKState /end REF_MEASUREMENT /end GROUP
/begin GROUP autosar_swc_las_autosar_swc_las_Step_sys_las_ELKState_Machine_ELK_Scene_Line_Compare_To_Constant7 "autosar_swc_las/autosar_swc_las_Step_sys/las/ELKState_Machine/ELK_Scene/Line/Compare\nTo Constant7" /begin REF_MEASUREMENT LAS_ELKState /end REF_MEASUREMENT /end GROUP
/begin GROUP autosar_swc_las_autosar_swc_las_Step_sys_las_ELKState_Machine_ELK_Scene_Line_Compare_To_Constant8 "autosar_swc_las/autosar_swc_las_Step_sys/las/ELKState_Machine/ELK_Scene/Line/Compare\nTo Constant8" /begin REF_MEASUREMENT LAS_ELKState /end REF_MEASUREMENT /end GROUP
/begin GROUP autosar_swc_las_autosar_swc_las_Step_sys_las_ELKState_Machine_ELK_Scene_Line_ObsAffirm1_Subsystem9 "autosar_swc_las/autosar_swc_las_Step_sys/las/ELKState_Machine/ELK_Scene/Line/ObsAffirm1/Subsystem9" /begin REF_CHARACTERISTIC P_LSS_LSMC_SampleTime /end REF_CHARACTERISTIC /end GROUP
/begin GROUP autosar_swc_las_autosar_swc_las_Step_sys_las_ELKState_Machine_ELK_Scene_Line_ObsAffirm_Subsystem9 "autosar_swc_las/autosar_swc_las_Step_sys/las/ELKState_Machine/ELK_Scene/Line/ObsAffirm/Subsystem9" /begin REF_CHARACTERISTIC P_LSS_LSMC_SampleTime /end REF_CHARACTERISTIC /end GROUP
/begin GROUP autosar_swc_las_autosar_swc_las_Step_sys_las_ELKState_Machine_ELK_Scene_Line_Subsystem1_Subsystem2 "autosar_swc_las/autosar_swc_las_Step_sys/las/ELKState_Machine/ELK_Scene/Line/Subsystem1/Subsystem2" /begin REF_CHARACTERISTIC P_LSS_LSMC_SampleTime /end REF_CHARACTERISTIC /end GROUP
/begin GROUP autosar_swc_las_autosar_swc_las_Step_sys_las_ELKState_Machine_ELK_Scene_Line_Subsystem_Subsystem2 "autosar_swc_las/autosar_swc_las_Step_sys/las/ELKState_Machine/ELK_Scene/Line/Subsystem/Subsystem2" /begin REF_CHARACTERISTIC P_LSS_LSMC_SampleTime /end REF_CHARACTERISTIC /end GROUP
/begin GROUP autosar_swc_las_autosar_swc_las_Step_sys_las_ELKState_Machine_ELK_Scene_Line_TurnLightAffirm1_Subsystem9 "autosar_swc_las/autosar_swc_las_Step_sys/las/ELKState_Machine/ELK_Scene/Line/TurnLightAffirm1/Subsystem9" /begin REF_CHARACTERISTIC P_LSS_LSMC_SampleTime /end REF_CHARACTERISTIC /end GROUP
/begin GROUP autosar_swc_las_autosar_swc_las_Step_sys_las_ELKState_Machine_ELK_Scene_Line_TurnLightAffirm_Subsystem9 "autosar_swc_las/autosar_swc_las_Step_sys/las/ELKState_Machine/ELK_Scene/Line/TurnLightAffirm/Subsystem9" /begin REF_CHARACTERISTIC P_LSS_LSMC_SampleTime /end REF_CHARACTERISTIC /end GROUP
/begin GROUP autosar_swc_las_autosar_swc_las_Step_sys_las_ELKState_Machine_ELK_Scene_OnComingCal "autosar_swc_las/autosar_swc_las_Step_sys/las/ELKState_Machine/ELK_Scene/OnComingCal" /begin REF_MEASUREMENT LAS_ELKState LAS_ELK_OnComingFlag_b /end REF_MEASUREMENT /end GROUP
/begin GROUP autosar_swc_las_autosar_swc_las_Step_sys_las_ELKState_Machine_ELK_Scene_OnComingCal_LeftOnComingFlag_Subsystem10 "autosar_swc_las/autosar_swc_las_Step_sys/las/ELKState_Machine/ELK_Scene/OnComingCal/LeftOnComingFlag/Subsystem10" /begin REF_CHARACTERISTIC P_LSS_LSMC_SampleTime /end REF_CHARACTERISTIC /end GROUP
/begin GROUP autosar_swc_las_autosar_swc_las_Step_sys_las_ELKState_Machine_ELK_Scene_OnComingCal_LeftOnComingFlag_Subsystem3_Subsystem2 "autosar_swc_las/autosar_swc_las_Step_sys/las/ELKState_Machine/ELK_Scene/OnComingCal/LeftOnComingFlag/Subsystem3/Subsystem2" /begin REF_CHARACTERISTIC P_LSS_LSMC_SampleTime /end REF_CHARACTERISTIC /end GROUP
/begin GROUP autosar_swc_las_autosar_swc_las_Step_sys_las_ELKState_Machine_ELK_Scene_OnComingCal_RightOnComingFlag_Subsystem10 "autosar_swc_las/autosar_swc_las_Step_sys/las/ELKState_Machine/ELK_Scene/OnComingCal/RightOnComingFlag/Subsystem10" /begin REF_CHARACTERISTIC P_LSS_LSMC_SampleTime /end REF_CHARACTERISTIC /end GROUP
/begin GROUP autosar_swc_las_autosar_swc_las_Step_sys_las_ELKState_Machine_ELK_Scene_OnComingCal_RightOnComingFlag_Subsystem4_Subsystem2 "autosar_swc_las/autosar_swc_las_Step_sys/las/ELKState_Machine/ELK_Scene/OnComingCal/RightOnComingFlag/Subsystem4/Subsystem2" /begin REF_CHARACTERISTIC P_LSS_LSMC_SampleTime /end REF_CHARACTERISTIC /end GROUP
/begin GROUP autosar_swc_las_autosar_swc_las_Step_sys_las_ELKState_Machine_ELK_Scene_OvertakingCal "autosar_swc_las/autosar_swc_las_Step_sys/las/ELKState_Machine/ELK_Scene/OvertakingCal" /begin REF_MEASUREMENT LAS_ELKState LAS_ELK_OvertakingFlag_b /end REF_MEASUREMENT /end GROUP
/begin GROUP autosar_swc_las_autosar_swc_las_Step_sys_las_ELKState_Machine_ELK_Scene_OvertakingCal_LeftOvertakingFlag_Subsystem10 "autosar_swc_las/autosar_swc_las_Step_sys/las/ELKState_Machine/ELK_Scene/OvertakingCal/LeftOvertakingFlag/Subsystem10" /begin REF_CHARACTERISTIC P_LSS_LSMC_SampleTime /end REF_CHARACTERISTIC /end GROUP
/begin GROUP autosar_swc_las_autosar_swc_las_Step_sys_las_ELKState_Machine_ELK_Scene_OvertakingCal_LeftOvertakingFlag_Subsystem3_Subsystem1 "autosar_swc_las/autosar_swc_las_Step_sys/las/ELKState_Machine/ELK_Scene/OvertakingCal/LeftOvertakingFlag/Subsystem3/Subsystem1" /begin REF_CHARACTERISTIC P_LSS_LSMC_SampleTime /end REF_CHARACTERISTIC /end GROUP
/begin GROUP autosar_swc_las_autosar_swc_las_Step_sys_las_ELKState_Machine_ELK_Scene_OvertakingCal_LeftOvertakingFlag_Subsystem3_Subsystem2 "autosar_swc_las/autosar_swc_las_Step_sys/las/ELKState_Machine/ELK_Scene/OvertakingCal/LeftOvertakingFlag/Subsystem3/Subsystem2" /begin REF_CHARACTERISTIC P_LSS_LSMC_SampleTime /end REF_CHARACTERISTIC /end GROUP
/begin GROUP autosar_swc_las_autosar_swc_las_Step_sys_las_ELKState_Machine_ELK_Scene_OvertakingCal_RightOvertakingFlag_Subsystem10 "autosar_swc_las/autosar_swc_las_Step_sys/las/ELKState_Machine/ELK_Scene/OvertakingCal/RightOvertakingFlag/Subsystem10" /begin REF_CHARACTERISTIC P_LSS_LSMC_SampleTime /end REF_CHARACTERISTIC /end GROUP
/begin GROUP autosar_swc_las_autosar_swc_las_Step_sys_las_ELKState_Machine_ELK_Scene_OvertakingCal_RightOvertakingFlag_Subsystem4_Subsystem1 "autosar_swc_las/autosar_swc_las_Step_sys/las/ELKState_Machine/ELK_Scene/OvertakingCal/RightOvertakingFlag/Subsystem4/Subsystem1" /begin REF_CHARACTERISTIC P_LSS_LSMC_SampleTime /end REF_CHARACTERISTIC /end GROUP
/begin GROUP autosar_swc_las_autosar_swc_las_Step_sys_las_ELKState_Machine_ELK_Scene_OvertakingCal_RightOvertakingFlag_Subsystem4_Subsystem2 "autosar_swc_las/autosar_swc_las_Step_sys/las/ELKState_Machine/ELK_Scene/OvertakingCal/RightOvertakingFlag/Subsystem4/Subsystem2" /begin REF_CHARACTERISTIC P_LSS_LSMC_SampleTime /end REF_CHARACTERISTIC /end GROUP
/begin GROUP autosar_swc_las_autosar_swc_las_Step_sys_las_ELKState_Machine_ELK_Scene_RoadEge "autosar_swc_las/autosar_swc_las_Step_sys/las/ELKState_Machine/ELK_Scene/RoadEge" /begin REF_MEASUREMENT LAS_ELKState /end REF_MEASUREMENT /end GROUP
/begin GROUP autosar_swc_las_autosar_swc_las_Step_sys_las_ELKState_Machine_ELK_Scene_RoadEge_LeftRoadEgeInterJudge "autosar_swc_las/autosar_swc_las_Step_sys/las/ELKState_Machine/ELK_Scene/RoadEge/LeftRoadEgeInterJudge" /begin REF_MEASUREMENT LAS_ELKState /end REF_MEASUREMENT /end GROUP
/begin GROUP autosar_swc_las_autosar_swc_las_Step_sys_las_ELKState_Machine_ELK_Scene_RoadEge_LeftRoadEgeInterJudge_Subsystem1_Subsystem8 "autosar_swc_las/autosar_swc_las_Step_sys/las/ELKState_Machine/ELK_Scene/RoadEge/LeftRoadEgeInterJudge/Subsystem1/Subsystem8" /begin REF_CHARACTERISTIC P_LSS_LSMC_SampleTime /end REF_CHARACTERISTIC /end GROUP
/begin GROUP autosar_swc_las_autosar_swc_las_Step_sys_las_ELKState_Machine_ELK_Scene_RoadEge_ObsAffirm1_Subsystem9 "autosar_swc_las/autosar_swc_las_Step_sys/las/ELKState_Machine/ELK_Scene/RoadEge/ObsAffirm1/Subsystem9" /begin REF_CHARACTERISTIC P_LSS_LSMC_SampleTime /end REF_CHARACTERISTIC /end GROUP
/begin GROUP autosar_swc_las_autosar_swc_las_Step_sys_las_ELKState_Machine_ELK_Scene_RoadEge_ObsAffirm_Subsystem9 "autosar_swc_las/autosar_swc_las_Step_sys/las/ELKState_Machine/ELK_Scene/RoadEge/ObsAffirm/Subsystem9" /begin REF_CHARACTERISTIC P_LSS_LSMC_SampleTime /end REF_CHARACTERISTIC /end GROUP
/begin GROUP autosar_swc_las_autosar_swc_las_Step_sys_las_ELKState_Machine_ELK_Scene_RoadEge_RightRoadEgeInterJudge "autosar_swc_las/autosar_swc_las_Step_sys/las/ELKState_Machine/ELK_Scene/RoadEge/RightRoadEgeInterJudge" /begin REF_MEASUREMENT LAS_ELKState /end REF_MEASUREMENT /end GROUP
/begin GROUP autosar_swc_las_autosar_swc_las_Step_sys_las_ELKState_Machine_ELK_Scene_RoadEge_RightRoadEgeInterJudge_Subsystem1_Subsystem8 "autosar_swc_las/autosar_swc_las_Step_sys/las/ELKState_Machine/ELK_Scene/RoadEge/RightRoadEgeInterJudge/Subsystem1/Subsystem8" /begin REF_CHARACTERISTIC P_LSS_LSMC_SampleTime /end REF_CHARACTERISTIC /end GROUP
/begin GROUP autosar_swc_las_autosar_swc_las_Step_sys_las_ELKState_Machine_ELK_Scene_Subsystem1_Subsystem1 "autosar_swc_las/autosar_swc_las_Step_sys/las/ELKState_Machine/ELK_Scene/Subsystem1/Subsystem1" /begin REF_CHARACTERISTIC P_LSS_LSMC_SampleTime /end REF_CHARACTERISTIC /end GROUP
/begin GROUP autosar_swc_las_autosar_swc_las_Step_sys_las_ELKState_Machine_ELK_Scene_Subsystem1_Subsystem2 "autosar_swc_las/autosar_swc_las_Step_sys/las/ELKState_Machine/ELK_Scene/Subsystem1/Subsystem2" /begin REF_CHARACTERISTIC P_LSS_LSMC_SampleTime /end REF_CHARACTERISTIC /end GROUP
/begin GROUP autosar_swc_las_autosar_swc_las_Step_sys_las_ELKState_Machine_ELK_Scene_Subsystem1_Subsystem4 "autosar_swc_las/autosar_swc_las_Step_sys/las/ELKState_Machine/ELK_Scene/Subsystem1/Subsystem4" /begin REF_CHARACTERISTIC P_LSS_LSMC_SampleTime /end REF_CHARACTERISTIC /end GROUP
/begin GROUP autosar_swc_las_autosar_swc_las_Step_sys_las_ELKState_Machine_ELK_Scene_Subsystem1_Subsystem7 "autosar_swc_las/autosar_swc_las_Step_sys/las/ELKState_Machine/ELK_Scene/Subsystem1/Subsystem7" /begin REF_CHARACTERISTIC P_LSS_LSMC_SampleTime /end REF_CHARACTERISTIC /end GROUP
/begin GROUP autosar_swc_las_autosar_swc_las_Step_sys_las_ELKState_Machine_ELK_Scene_Subsystem2 "autosar_swc_las/autosar_swc_las_Step_sys/las/ELKState_Machine/ELK_Scene/Subsystem2" /begin REF_CHARACTERISTIC P_LSS_LSMC_SampleTime /end REF_CHARACTERISTIC /end GROUP
/begin GROUP autosar_swc_las_autosar_swc_las_Step_sys_las_ELKState_Machine_ELK_Scene_Subsystem3 "autosar_swc_las/autosar_swc_las_Step_sys/las/ELKState_Machine/ELK_Scene/Subsystem3" /begin REF_CHARACTERISTIC P_LSS_LSMC_SampleTime /end REF_CHARACTERISTIC /end GROUP
/begin GROUP autosar_swc_las_autosar_swc_las_Step_sys_las_ELKState_Machine_StateMachine1 "autosar_swc_las/autosar_swc_las_Step_sys/las/ELKState_Machine/StateMachine1"
 /begin REF_MEASUREMENT LAS_ELK_Idle2Ready LAS_ELK_LeftWarn LAS_ELK_Other2Idle LAS_ELK_RightWarn LAS_ELK_VehConfigELK autosar_swc_las_rtARID_DEF.state /end REF_MEASUREMENT
/end GROUP
/begin GROUP autosar_swc_las_autosar_swc_las_Step_sys_las_ELKState_Machine_StateMachine1_Subsystem9 "autosar_swc_las/autosar_swc_las_Step_sys/las/ELKState_Machine/StateMachine1/Subsystem9" /begin REF_CHARACTERISTIC P_LSS_LSMC_SampleTime /end REF_CHARACTERISTIC /end GROUP
/begin GROUP autosar_swc_las_autosar_swc_las_Step_sys_las_LDW_LDWSignal_calculate "autosar_swc_las/autosar_swc_las_Step_sys/las/LDW/LDWSignal_calculate" /begin REF_MEASUREMENT autosar_swc_las_rtARID_DEF.state /end REF_MEASUREMENT /end GROUP
/begin GROUP autosar_swc_las_autosar_swc_las_Step_sys_las_LDW_LDWSignal_calculate_Subsystem1 "autosar_swc_las/autosar_swc_las_Step_sys/las/LDW/LDWSignal_calculate/Subsystem1" /begin REF_CHARACTERISTIC P_LSS_LSMC_SampleTime /end REF_CHARACTERISTIC /end GROUP
/begin GROUP autosar_swc_las_autosar_swc_las_Step_sys_las_LDW_LDWSignal_calculate_Subsystem2 "autosar_swc_las/autosar_swc_las_Step_sys/las/LDW/LDWSignal_calculate/Subsystem2" /begin REF_CHARACTERISTIC P_LSS_LSMC_SampleTime /end REF_CHARACTERISTIC /end GROUP
/begin GROUP autosar_swc_las_autosar_swc_las_Step_sys_las_LDW_LDWSignal_calculate_Subsystem3 "autosar_swc_las/autosar_swc_las_Step_sys/las/LDW/LDWSignal_calculate/Subsystem3" /begin REF_CHARACTERISTIC P_LSS_LSMC_SampleTime /end REF_CHARACTERISTIC /end GROUP
/begin GROUP autosar_swc_las_autosar_swc_las_Step_sys_las_LDW_LDWSignal_calculate_Subsystem4 "autosar_swc_las/autosar_swc_las_Step_sys/las/LDW/LDWSignal_calculate/Subsystem4" /begin REF_CHARACTERISTIC P_LSS_LSMC_SampleTime /end REF_CHARACTERISTIC /end GROUP
/begin GROUP autosar_swc_las_autosar_swc_las_Step_sys_las_LDW_LDWSignal_calculate_Subsystem5 "autosar_swc_las/autosar_swc_las_Step_sys/las/LDW/LDWSignal_calculate/Subsystem5" /begin REF_CHARACTERISTIC P_LSS_LSMC_SampleTime /end REF_CHARACTERISTIC /end GROUP
/begin GROUP autosar_swc_las_autosar_swc_las_Step_sys_las_LDW_LDW_Condition_Subsystem "autosar_swc_las/autosar_swc_las_Step_sys/las/LDW/LDW_Condition/Subsystem" /begin REF_CHARACTERISTIC P_LSS_LSMC_SampleTime /end REF_CHARACTERISTIC /end GROUP
/begin GROUP autosar_swc_las_autosar_swc_las_Step_sys_las_LDW_LDW_Condition_Subsystem10 "autosar_swc_las/autosar_swc_las_Step_sys/las/LDW/LDW_Condition/Subsystem10" /begin REF_CHARACTERISTIC P_LSS_LSMC_SampleTime /end REF_CHARACTERISTIC /end GROUP
/begin GROUP autosar_swc_las_autosar_swc_las_Step_sys_las_LDW_LDW_Condition_Subsystem11 "autosar_swc_las/autosar_swc_las_Step_sys/las/LDW/LDW_Condition/Subsystem11" /begin REF_CHARACTERISTIC P_LSS_LSMC_SampleTime /end REF_CHARACTERISTIC /end GROUP
/begin GROUP autosar_swc_las_autosar_swc_las_Step_sys_las_LDW_LDW_Condition_Subsystem12 "autosar_swc_las/autosar_swc_las_Step_sys/las/LDW/LDW_Condition/Subsystem12" /begin REF_CHARACTERISTIC P_LSS_LSMC_SampleTime /end REF_CHARACTERISTIC /end GROUP
/begin GROUP autosar_swc_las_autosar_swc_las_Step_sys_las_LDW_LDW_Condition_Subsystem14 "autosar_swc_las/autosar_swc_las_Step_sys/las/LDW/LDW_Condition/Subsystem14" /begin REF_CHARACTERISTIC P_LSS_LSMC_SampleTime /end REF_CHARACTERISTIC /end GROUP
/begin GROUP autosar_swc_las_autosar_swc_las_Step_sys_las_LDW_LDW_Condition_Subsystem2 "autosar_swc_las/autosar_swc_las_Step_sys/las/LDW/LDW_Condition/Subsystem2" /begin REF_CHARACTERISTIC P_LSS_LSMC_SampleTime /end REF_CHARACTERISTIC /end GROUP
/begin GROUP autosar_swc_las_autosar_swc_las_Step_sys_las_LDW_LDW_Condition_Subsystem3 "autosar_swc_las/autosar_swc_las_Step_sys/las/LDW/LDW_Condition/Subsystem3" /begin REF_CHARACTERISTIC P_LSS_LSMC_SampleTime /end REF_CHARACTERISTIC /end GROUP
/begin GROUP autosar_swc_las_autosar_swc_las_Step_sys_las_LDW_LDW_Condition_Subsystem4 "autosar_swc_las/autosar_swc_las_Step_sys/las/LDW/LDW_Condition/Subsystem4" /begin REF_CHARACTERISTIC P_LSS_LSMC_SampleTime /end REF_CHARACTERISTIC /end GROUP
/begin GROUP autosar_swc_las_autosar_swc_las_Step_sys_las_LDW_LDW_Condition_Subsystem5 "autosar_swc_las/autosar_swc_las_Step_sys/las/LDW/LDW_Condition/Subsystem5" /begin REF_CHARACTERISTIC P_LSS_LSMC_SampleTime /end REF_CHARACTERISTIC /end GROUP
/begin GROUP autosar_swc_las_autosar_swc_las_Step_sys_las_LDW_LDW_Condition_Subsystem6 "autosar_swc_las/autosar_swc_las_Step_sys/las/LDW/LDW_Condition/Subsystem6" /begin REF_CHARACTERISTIC P_LSS_LSMC_SampleTime /end REF_CHARACTERISTIC /end GROUP
/begin GROUP autosar_swc_las_autosar_swc_las_Step_sys_las_LDW_LDW_Condition_Subsystem9 "autosar_swc_las/autosar_swc_las_Step_sys/las/LDW/LDW_Condition/Subsystem9" /begin REF_CHARACTERISTIC P_LSS_LSMC_SampleTime /end REF_CHARACTERISTIC /end GROUP
/begin GROUP autosar_swc_las_autosar_swc_las_Step_sys_las_LDW_LDW_StateMachine_Subsystem1_Subsystem2 "autosar_swc_las/autosar_swc_las_Step_sys/las/LDW/LDW_StateMachine/Subsystem1/Subsystem2" /begin REF_CHARACTERISTIC P_LSS_LSMC_SampleTime /end REF_CHARACTERISTIC /end GROUP
/begin GROUP autosar_swc_las_autosar_swc_las_Step_sys_las_LDW_LDW_StateMachine_Subsystem_Subsystem2 "autosar_swc_las/autosar_swc_las_Step_sys/las/LDW/LDW_StateMachine/Subsystem/Subsystem2" /begin REF_CHARACTERISTIC P_LSS_LSMC_SampleTime /end REF_CHARACTERISTIC /end GROUP
/begin GROUP autosar_swc_las_autosar_swc_las_Step_sys_las_LDW_LDW_StateMachine_TurnLightAffirm1_Subsystem9 "autosar_swc_las/autosar_swc_las_Step_sys/las/LDW/LDW_StateMachine/TurnLightAffirm1/Subsystem9" /begin REF_CHARACTERISTIC P_LSS_LSMC_SampleTime /end REF_CHARACTERISTIC /end GROUP
/begin GROUP autosar_swc_las_autosar_swc_las_Step_sys_las_LDW_LDW_StateMachine_TurnLightAffirm_Subsystem9 "autosar_swc_las/autosar_swc_las_Step_sys/las/LDW/LDW_StateMachine/TurnLightAffirm/Subsystem9" /begin REF_CHARACTERISTIC P_LSS_LSMC_SampleTime /end REF_CHARACTERISTIC /end GROUP
/begin GROUP autosar_swc_las_autosar_swc_las_Step_sys_las_LKA_LKA2 "autosar_swc_las/autosar_swc_las_Step_sys/las/LKA/LKA2"
 /begin REF_CHARACTERISTIC P_LSS_ELK_State_Param_LaneCurve P_LSS_ELK_State_Param_LaneCurve_Offset /end REF_CHARACTERISTIC
/end GROUP
/begin GROUP autosar_swc_las_autosar_swc_las_Step_sys_las_LKA_LKA2_Subsystem1 "autosar_swc_las/autosar_swc_las_Step_sys/las/LKA/LKA2/Subsystem1" /begin REF_CHARACTERISTIC P_LSS_LSMC_SampleTime /end REF_CHARACTERISTIC /end GROUP
/begin GROUP autosar_swc_las_autosar_swc_las_Step_sys_las_LKA_LKA2_Subsystem2 "autosar_swc_las/autosar_swc_las_Step_sys/las/LKA/LKA2/Subsystem2" /begin REF_CHARACTERISTIC P_LSS_LSMC_SampleTime /end REF_CHARACTERISTIC /end GROUP
/begin GROUP autosar_swc_las_autosar_swc_las_Step_sys_las_LKA_LKA2_Subsystem3 "autosar_swc_las/autosar_swc_las_Step_sys/las/LKA/LKA2/Subsystem3" /begin REF_CHARACTERISTIC P_LSS_LSMC_SampleTime /end REF_CHARACTERISTIC /end GROUP
/begin GROUP autosar_swc_las_autosar_swc_las_Step_sys_las_LKA_LKA2_Subsystem4 "autosar_swc_las/autosar_swc_las_Step_sys/las/LKA/LKA2/Subsystem4" /begin REF_CHARACTERISTIC P_LSS_LSMC_SampleTime /end REF_CHARACTERISTIC /end GROUP
/begin GROUP autosar_swc_las_autosar_swc_las_Step_sys_las_LKA_LKA2_Subsystem5 "autosar_swc_las/autosar_swc_las_Step_sys/las/LKA/LKA2/Subsystem5" /begin REF_CHARACTERISTIC P_LSS_LSMC_SampleTime /end REF_CHARACTERISTIC /end GROUP
/begin GROUP autosar_swc_las_autosar_swc_las_Step_sys_las_LKA_LKA2_Subsystem6 "autosar_swc_las/autosar_swc_las_Step_sys/las/LKA/LKA2/Subsystem6" /begin REF_CHARACTERISTIC P_LSS_LSMC_SampleTime /end REF_CHARACTERISTIC /end GROUP
/begin GROUP autosar_swc_las_autosar_swc_las_Step_sys_las_LKA_LKA_Condition "autosar_swc_las/autosar_swc_las_Step_sys/las/LKA/LKA_Condition"
 /begin REF_CHARACTERISTIC P_LSS_LKA_StateManMachineSharingSts_TIme P_LSS_LKA_StateManMachineSharingSts_enable /end REF_CHARACTERISTIC
/end GROUP
/begin GROUP autosar_swc_las_autosar_swc_las_Step_sys_las_LKA_LKA_Condition_Compare_To_Constant17 "autosar_swc_las/autosar_swc_las_Step_sys/las/LKA/LKA_Condition/Compare\nTo Constant17" /begin REF_MEASUREMENT autosar_swc_las_rtARID_DEF.nums /end REF_MEASUREMENT /end GROUP
/begin GROUP autosar_swc_las_autosar_swc_las_Step_sys_las_LKA_LKA_Condition_Compare_To_Constant19 "autosar_swc_las/autosar_swc_las_Step_sys/las/LKA/LKA_Condition/Compare\nTo Constant19" /begin REF_MEASUREMENT autosar_swc_las_rtARID_DEF.Cnt_HandsOff /end REF_MEASUREMENT /end GROUP
/begin GROUP autosar_swc_las_autosar_swc_las_Step_sys_las_LKA_LKA_Condition_Compare_To_Constant26 "autosar_swc_las/autosar_swc_las_Step_sys/las/LKA/LKA_Condition/Compare\nTo Constant26" /begin REF_MEASUREMENT autosar_swc_las_rtARID_DEF.nums /end REF_MEASUREMENT /end GROUP
/begin GROUP autosar_swc_las_autosar_swc_las_Step_sys_las_LKA_LKA_Condition_Compare_To_Constant6 "autosar_swc_las/autosar_swc_las_Step_sys/las/LKA/LKA_Condition/Compare\nTo Constant6" /begin REF_MEASUREMENT autosar_swc_las_rtARID_DEF.Cnt_HandsOff /end REF_MEASUREMENT /end GROUP
/begin GROUP autosar_swc_las_autosar_swc_las_Step_sys_las_LKA_LKA_Condition_Subsystem1 "autosar_swc_las/autosar_swc_las_Step_sys/las/LKA/LKA_Condition/Subsystem1" /begin REF_CHARACTERISTIC P_LSS_LSMC_SampleTime /end REF_CHARACTERISTIC /end GROUP
/begin GROUP autosar_swc_las_autosar_swc_las_Step_sys_las_LKA_LKA_Condition_Subsystem10 "autosar_swc_las/autosar_swc_las_Step_sys/las/LKA/LKA_Condition/Subsystem10" /begin REF_CHARACTERISTIC P_LSS_LSMC_SampleTime /end REF_CHARACTERISTIC /end GROUP
/begin GROUP autosar_swc_las_autosar_swc_las_Step_sys_las_LKA_LKA_Condition_Subsystem11 "autosar_swc_las/autosar_swc_las_Step_sys/las/LKA/LKA_Condition/Subsystem11" /begin REF_CHARACTERISTIC P_LSS_LSMC_SampleTime /end REF_CHARACTERISTIC /end GROUP
/begin GROUP autosar_swc_las_autosar_swc_las_Step_sys_las_LKA_LKA_Condition_Subsystem13 "autosar_swc_las/autosar_swc_las_Step_sys/las/LKA/LKA_Condition/Subsystem13" /begin REF_CHARACTERISTIC P_LSS_LSMC_SampleTime /end REF_CHARACTERISTIC /end GROUP
/begin GROUP autosar_swc_las_autosar_swc_las_Step_sys_las_LKA_LKA_Condition_Subsystem14 "autosar_swc_las/autosar_swc_las_Step_sys/las/LKA/LKA_Condition/Subsystem14" /begin REF_CHARACTERISTIC P_LSS_LSMC_SampleTime /end REF_CHARACTERISTIC /end GROUP
/begin GROUP autosar_swc_las_autosar_swc_las_Step_sys_las_LKA_LKA_Condition_Subsystem16 "autosar_swc_las/autosar_swc_las_Step_sys/las/LKA/LKA_Condition/Subsystem16" /begin REF_CHARACTERISTIC P_LSS_LSMC_SampleTime /end REF_CHARACTERISTIC /end GROUP
/begin GROUP autosar_swc_las_autosar_swc_las_Step_sys_las_LKA_LKA_Condition_Subsystem17 "autosar_swc_las/autosar_swc_las_Step_sys/las/LKA/LKA_Condition/Subsystem17" /begin REF_CHARACTERISTIC P_LSS_LSMC_SampleTime /end REF_CHARACTERISTIC /end GROUP
/begin GROUP autosar_swc_las_autosar_swc_las_Step_sys_las_LKA_LKA_Condition_Subsystem19 "autosar_swc_las/autosar_swc_las_Step_sys/las/LKA/LKA_Condition/Subsystem19" /begin REF_CHARACTERISTIC P_LSS_LSMC_SampleTime /end REF_CHARACTERISTIC /end GROUP
/begin GROUP autosar_swc_las_autosar_swc_las_Step_sys_las_LKA_LKA_Condition_Subsystem2 "autosar_swc_las/autosar_swc_las_Step_sys/las/LKA/LKA_Condition/Subsystem2" /begin REF_CHARACTERISTIC P_LSS_LSMC_SampleTime /end REF_CHARACTERISTIC /end GROUP
/begin GROUP autosar_swc_las_autosar_swc_las_Step_sys_las_LKA_LKA_Condition_Subsystem3 "autosar_swc_las/autosar_swc_las_Step_sys/las/LKA/LKA_Condition/Subsystem3" /begin REF_CHARACTERISTIC P_LSS_LSMC_SampleTime /end REF_CHARACTERISTIC /end GROUP
/begin GROUP autosar_swc_las_autosar_swc_las_Step_sys_las_LKA_LKA_Condition_Subsystem4 "autosar_swc_las/autosar_swc_las_Step_sys/las/LKA/LKA_Condition/Subsystem4" /begin REF_CHARACTERISTIC P_LSS_LSMC_SampleTime /end REF_CHARACTERISTIC /end GROUP
/begin GROUP autosar_swc_las_autosar_swc_las_Step_sys_las_LKA_LKA_Condition_Subsystem5 "autosar_swc_las/autosar_swc_las_Step_sys/las/LKA/LKA_Condition/Subsystem5" /begin REF_CHARACTERISTIC P_LSS_LSMC_SampleTime /end REF_CHARACTERISTIC /end GROUP
/begin GROUP autosar_swc_las_autosar_swc_las_Step_sys_las_LKA_LKA_Condition_Subsystem6 "autosar_swc_las/autosar_swc_las_Step_sys/las/LKA/LKA_Condition/Subsystem6" /begin REF_CHARACTERISTIC P_LSS_LSMC_SampleTime /end REF_CHARACTERISTIC /end GROUP
/begin GROUP autosar_swc_las_autosar_swc_las_Step_sys_las_LKA_LKA_Condition_Subsystem7 "autosar_swc_las/autosar_swc_las_Step_sys/las/LKA/LKA_Condition/Subsystem7" /begin REF_CHARACTERISTIC P_LSS_LSMC_SampleTime /end REF_CHARACTERISTIC /end GROUP
/begin GROUP autosar_swc_las_autosar_swc_las_Step_sys_las_LKA_LKA_StateMachine_Compare_To_Constant10 "autosar_swc_las/autosar_swc_las_Step_sys/las/LKA/LKA_StateMachine/Compare\nTo Constant10" /begin REF_MEASUREMENT autosar_swc_las_rtARID_DEF.state /end REF_MEASUREMENT /end GROUP
/begin GROUP autosar_swc_las_autosar_swc_las_Step_sys_las_LKA_LKA_StateMachine_Compare_To_Constant11 "autosar_swc_las/autosar_swc_las_Step_sys/las/LKA/LKA_StateMachine/Compare\nTo Constant11" /begin REF_MEASUREMENT autosar_swc_las_rtARID_DEF.state /end REF_MEASUREMENT /end GROUP
/begin GROUP autosar_swc_las_autosar_swc_las_Step_sys_las_LKA_LKA_StateMachine_Compare_To_Constant2 "autosar_swc_las/autosar_swc_las_Step_sys/las/LKA/LKA_StateMachine/Compare\nTo Constant2" /begin REF_MEASUREMENT autosar_swc_las_rtARID_DEF.state /end REF_MEASUREMENT /end GROUP
/begin GROUP autosar_swc_las_autosar_swc_las_Step_sys_las_LKA_LKA_StateMachine_Compare_To_Constant3 "autosar_swc_las/autosar_swc_las_Step_sys/las/LKA/LKA_StateMachine/Compare\nTo Constant3" /begin REF_MEASUREMENT autosar_swc_las_rtARID_DEF.state /end REF_MEASUREMENT /end GROUP
/begin GROUP autosar_swc_las_autosar_swc_las_Step_sys_las_LKA_LKA_StateMachine_Compare_To_Constant4 "autosar_swc_las/autosar_swc_las_Step_sys/las/LKA/LKA_StateMachine/Compare\nTo Constant4" /begin REF_MEASUREMENT autosar_swc_las_rtARID_DEF.state /end REF_MEASUREMENT /end GROUP
/begin GROUP autosar_swc_las_autosar_swc_las_Step_sys_las_LKA_LKA_StateMachine_Compare_To_Constant5 "autosar_swc_las/autosar_swc_las_Step_sys/las/LKA/LKA_StateMachine/Compare\nTo Constant5" /begin REF_MEASUREMENT autosar_swc_las_rtARID_DEF.state /end REF_MEASUREMENT /end GROUP
/begin GROUP autosar_swc_las_autosar_swc_las_Step_sys_las_LKA_LKA_StateMachine_Compare_To_Constant8 "autosar_swc_las/autosar_swc_las_Step_sys/las/LKA/LKA_StateMachine/Compare\nTo Constant8" /begin REF_MEASUREMENT autosar_swc_las_rtARID_DEF.state /end REF_MEASUREMENT /end GROUP
/begin GROUP autosar_swc_las_autosar_swc_las_Step_sys_las_LKA_LKA_StateMachine_Compare_To_Constant9 "autosar_swc_las/autosar_swc_las_Step_sys/las/LKA/LKA_StateMachine/Compare\nTo Constant9" /begin REF_MEASUREMENT autosar_swc_las_rtARID_DEF.state /end REF_MEASUREMENT /end GROUP
/begin GROUP autosar_swc_las_autosar_swc_las_Step_sys_las_LKA_LKA_StateMachine_ObsAffirm1_Subsystem9 "autosar_swc_las/autosar_swc_las_Step_sys/las/LKA/LKA_StateMachine/ObsAffirm1/Subsystem9" /begin REF_CHARACTERISTIC P_LSS_LSMC_SampleTime /end REF_CHARACTERISTIC /end GROUP
/begin GROUP autosar_swc_las_autosar_swc_las_Step_sys_las_LKA_LKA_StateMachine_ObsAffirm_Subsystem9 "autosar_swc_las/autosar_swc_las_Step_sys/las/LKA/LKA_StateMachine/ObsAffirm/Subsystem9" /begin REF_CHARACTERISTIC P_LSS_LSMC_SampleTime /end REF_CHARACTERISTIC /end GROUP
/begin GROUP autosar_swc_las_autosar_swc_las_Step_sys_las_LKA_LKA_StateMachine_Subsystem1_Subsystem2 "autosar_swc_las/autosar_swc_las_Step_sys/las/LKA/LKA_StateMachine/Subsystem1/Subsystem2" /begin REF_CHARACTERISTIC P_LSS_LSMC_SampleTime /end REF_CHARACTERISTIC /end GROUP
/begin GROUP autosar_swc_las_autosar_swc_las_Step_sys_las_LKA_LKA_StateMachine_Subsystem9 "autosar_swc_las/autosar_swc_las_Step_sys/las/LKA/LKA_StateMachine/Subsystem9" /begin REF_CHARACTERISTIC P_LSS_LSMC_SampleTime /end REF_CHARACTERISTIC /end GROUP
/begin GROUP autosar_swc_las_autosar_swc_las_Step_sys_las_LKA_LKA_StateMachine_Subsystem_Subsystem2 "autosar_swc_las/autosar_swc_las_Step_sys/las/LKA/LKA_StateMachine/Subsystem/Subsystem2" /begin REF_CHARACTERISTIC P_LSS_LSMC_SampleTime /end REF_CHARACTERISTIC /end GROUP
/begin GROUP autosar_swc_las_autosar_swc_las_Step_sys_las_LKA_LKA_StateMachine_TurnLightAffirm1_Subsystem9 "autosar_swc_las/autosar_swc_las_Step_sys/las/LKA/LKA_StateMachine/TurnLightAffirm1/Subsystem9" /begin REF_CHARACTERISTIC P_LSS_LSMC_SampleTime /end REF_CHARACTERISTIC /end GROUP
/begin GROUP autosar_swc_las_autosar_swc_las_Step_sys_las_LKA_LKA_StateMachine_TurnLightAffirm_Subsystem9 "autosar_swc_las/autosar_swc_las_Step_sys/las/LKA/LKA_StateMachine/TurnLightAffirm/Subsystem9" /begin REF_CHARACTERISTIC P_LSS_LSMC_SampleTime /end REF_CHARACTERISTIC /end GROUP
/begin GROUP autosar_swc_las_autosar_swc_las_Step_sys_las_OutPort "autosar_swc_las/autosar_swc_las_Step_sys/las/OutPort" /begin REF_MEASUREMENT autosar_swc_las_rtARID_DEF.state /end REF_MEASUREMENT /end GROUP
/begin GROUP autosar_swc_las_autosar_swc_las_Step_sys_las_OutPort_HandsOffWarningCal "autosar_swc_las/autosar_swc_las_Step_sys/las/OutPort/HandsOffWarningCal"
 /begin REF_MEASUREMENT autosar_swc_las_rtARID_DEF.Cnt_HandsOff autosar_swc_las_rtARID_DEF.nums /end REF_MEASUREMENT
/end GROUP
/begin GROUP autosar_swc_las_autosar_swc_las_Step_sys_las_OutPort_HandsOffWarningCal_Subsystem "autosar_swc_las/autosar_swc_las_Step_sys/las/OutPort/HandsOffWarningCal/Subsystem" /begin REF_MEASUREMENT autosar_swc_las_rtARID_DEF.state /end REF_MEASUREMENT /end GROUP
/begin GROUP autosar_swc_las_autosar_swc_las_Step_sys_las_SCM1_LaneAndRe_SignalProcess_RepaireRoadJudge_Subsystem2 "autosar_swc_las/autosar_swc_las_Step_sys/las/SCM1/LaneAndRe_SignalProcess/RepaireRoadJudge/Subsystem2" /begin REF_CHARACTERISTIC P_LSS_LSMC_SampleTime /end REF_CHARACTERISTIC /end GROUP
/begin RECORD_LAYOUT Record_BOOLEAN FNC_VALUES 1 UBYTE COLUMN_DIR DIRECT /end RECORD_LAYOUT
/begin RECORD_LAYOUT Record_FLOAT32_IEEE FNC_VALUES 1 FLOAT32_IEEE COLUMN_DIR DIRECT /end RECORD_LAYOUT
/begin RECORD_LAYOUT Record_FLOAT64_IEEE FNC_VALUES 1 FLOAT64_IEEE COLUMN_DIR DIRECT /end RECORD_LAYOUT
/begin RECORD_LAYOUT Record_UBYTE FNC_VALUES 1 UBYTE COLUMN_DIR DIRECT /end RECORD_LAYOUT
/begin RECORD_LAYOUT Record_ULONG FNC_VALUES 1 ULONG COLUMN_DIR DIRECT /end RECORD_LAYOUT
/begin RECORD_LAYOUT Record_UWORD FNC_VALUES 1 UWORD COLUMN_DIR DIRECT /end RECORD_LAYOUT
/begin RECORD_LAYOUT Axis_FLOAT32_IEEE AXIS_PTS_X 1 FLOAT32_IEEE INDEX_INCR DIRECT /end RECORD_LAYOUT
/begin GROUP ZDrive_BSW_Cal_Cal.ZDrive_BSW_Cal_VehicleInfomationTable ""
 /begin REF_CHARACTERISTIC ZDrive_BSW_Cal_Cal.ZDrive_BSW_Cal_VehicleInfomationTable.RADAR_MOUNT_PARAM_FRONT_X_POSITION ZDrive_BSW_Cal_Cal.ZDrive_BSW_Cal_VehicleInfomationTable.RADAR_MOUNT_PARAM_FRONT_Y_POSITION ZDrive_BSW_Cal_Cal.ZDrive_BSW_Cal_VehicleInfomationTable.RADAR_MOUNT_PARAM_FRONT_YAW_ANGLE ZDrive_BSW_Cal_Cal.ZDrive_BSW_Cal_VehicleInfomationTable.RADAR_MOUNT_PARAM_FL_X_POSITION ZDrive_BSW_Cal_Cal.ZDrive_BSW_Cal_VehicleInfomationTable.RADAR_MOUNT_PARAM_FL_Y_POSITION ZDrive_BSW_Cal_Cal.ZDrive_BSW_Cal_VehicleInfomationTable.RADAR_MOUNT_PARAM_FL_YAW_ANGLE ZDrive_BSW_Cal_Cal.ZDrive_BSW_Cal_VehicleInfomationTable.RADAR_MOUNT_PARAM_FR_X_POSITION ZDrive_BSW_Cal_Cal.ZDrive_BSW_Cal_VehicleInfomationTable.RADAR_MOUNT_PARAM_FR_Y_POSITION ZDrive_BSW_Cal_Cal.ZDrive_BSW_Cal_VehicleInfomationTable.RADAR_MOUNT_PARAM_FR_YAW_ANGLE ZDrive_BSW_Cal_Cal.ZDrive_BSW_Cal_VehicleInfomationTable.RADAR_MOUNT_PARAM_RL_X_POSITION ZDrive_BSW_Cal_Cal.ZDrive_BSW_Cal_VehicleInfomationTable.RADAR_MOUNT_PARAM_RL_Y_POSITION ZDrive_BSW_Cal_Cal.ZDrive_BSW_Cal_VehicleInfomationTable.RADAR_MOUNT_PARAM_RL_YAW_ANGLE ZDrive_BSW_Cal_Cal.ZDrive_BSW_Cal_VehicleInfomationTable.RADAR_MOUNT_PARAM_RR_X_POSITION ZDrive_BSW_Cal_Cal.ZDrive_BSW_Cal_VehicleInfomationTable.RADAR_MOUNT_PARAM_RR_Y_POSITION ZDrive_BSW_Cal_Cal.ZDrive_BSW_Cal_VehicleInfomationTable.RADAR_MOUNT_PARAM_RR_YAW_ANGLE ZDrive_BSW_Cal_Cal.ZDrive_BSW_Cal_VehicleInfomationTable.Vehicle_Information_Reserved_Line277 ZDrive_BSW_Cal_Cal.ZDrive_BSW_Cal_VehicleInfomationTable.Vehicle_Information_Reserved_Line278 ZDrive_BSW_Cal_Cal.ZDrive_BSW_Cal_VehicleInfomationTable.Vehicle_Information_Reserved_Line279 ZDrive_BSW_Cal_Cal.ZDrive_BSW_Cal_VehicleInfomationTable.Vehicle_Information_Reserved_Line280 ZDrive_BSW_Cal_Cal.ZDrive_BSW_Cal_VehicleInfomationTable.Vehicle_Information_Reserved_Line281 ZDrive_BSW_Cal_Cal.ZDrive_BSW_Cal_VehicleInfomationTable.Vehicle_Information_Reserved_Line282 ZDrive_BSW_Cal_Cal.ZDrive_BSW_Cal_VehicleInfomationTable.Vehicle_Information_Reserved_Line283 ZDrive_BSW_Cal_Cal.ZDrive_BSW_Cal_VehicleInfomationTable.Vehicle_Information_Reserved_Line284 ZDrive_BSW_Cal_Cal.ZDrive_BSW_Cal_VehicleInfomationTable.Vehicle_Information_Reserved_Line285 ZDrive_BSW_Cal_Cal.ZDrive_BSW_Cal_VehicleInfomationTable.Vehicle_Information_Reserved_Line286 ZDrive_BSW_Cal_Cal.ZDrive_BSW_Cal_VehicleInfomationTable.Vehicle_Information_Reserved_Line287 ZDrive_BSW_Cal_Cal.ZDrive_BSW_Cal_VehicleInfomationTable.Vehicle_Information_Reserved_Line288 ZDrive_BSW_Cal_Cal.ZDrive_BSW_Cal_VehicleInfomationTable.Vehicle_Information_Reserved_Line289 ZDrive_BSW_Cal_Cal.ZDrive_BSW_Cal_VehicleInfomationTable.Vehicle_Information_Reserved_Line290 ZDrive_BSW_Cal_Cal.ZDrive_BSW_Cal_VehicleInfomationTable.Vehicle_Information_Reserved_Line291 ZDrive_BSW_Cal_Cal.ZDrive_BSW_Cal_VehicleInfomationTable.Vehicle_Information_Reserved_Line292 ZDrive_BSW_Cal_Cal.ZDrive_BSW_Cal_VehicleInfomationTable.Vehicle_Information_Reserved_Line293 ZDrive_BSW_Cal_Cal.ZDrive_BSW_Cal_VehicleInfomationTable.Vehicle_Information_Reserved_Line294 ZDrive_BSW_Cal_Cal.ZDrive_BSW_Cal_VehicleInfomationTable.Vehicle_Information_Reserved_Line295 ZDrive_BSW_Cal_Cal.ZDrive_BSW_Cal_VehicleInfomationTable.Vehicle_Information_Reserved_Line296 ZDrive_BSW_Cal_Cal.ZDrive_BSW_Cal_VehicleInfomationTable.Vehicle_Information_Reserved_Line297 ZDrive_BSW_Cal_Cal.ZDrive_BSW_Cal_VehicleInfomationTable.Vehicle_Information_Reserved_Line298 ZDrive_BSW_Cal_Cal.ZDrive_BSW_Cal_VehicleInfomationTable.Vehicle_Information_Reserved_Line299 ZDrive_BSW_Cal_Cal.ZDrive_BSW_Cal_VehicleInfomationTable.Vehicle_Information_Reserved_Line300 ZDrive_BSW_Cal_Cal.ZDrive_BSW_Cal_VehicleInfomationTable.Vehicle_Information_Reserved_Line301 ZDrive_BSW_Cal_Cal.ZDrive_BSW_Cal_VehicleInfomationTable.Vehicle_Information_Reserved_Line302 ZDrive_BSW_Cal_Cal.ZDrive_BSW_Cal_VehicleInfomationTable.Vehicle_Information_Reserved_Line303 ZDrive_BSW_Cal_Cal.ZDrive_BSW_Cal_VehicleInfomationTable.Vehicle_Information_Reserved_Line304 ZDrive_BSW_Cal_Cal.ZDrive_BSW_Cal_VehicleInfomationTable.Vehicle_Information_Reserved_Line305 ZDrive_BSW_Cal_Cal.ZDrive_BSW_Cal_VehicleInfomationTable.Vehicle_Information_Reserved_Line306 ZDrive_BSW_Cal_Cal.ZDrive_BSW_Cal_VehicleInfomationTable.Vehicle_Information_Reserved_Line307 ZDrive_BSW_Cal_Cal.ZDrive_BSW_Cal_VehicleInfomationTable.Vehicle_Information_Reserved_Line308 ZDrive_BSW_Cal_Cal.ZDrive_BSW_Cal_VehicleInfomationTable.Vehicle_Information_Reserved_Line309 ZDrive_BSW_Cal_Cal.ZDrive_BSW_Cal_VehicleInfomationTable.Vehicle_Information_Reserved_Line310 ZDrive_BSW_Cal_Cal.ZDrive_BSW_Cal_VehicleInfomationTable.Vehicle_Information_Reserved_Line311 ZDrive_BSW_Cal_Cal.ZDrive_BSW_Cal_VehicleInfomationTable.Vehicle_Information_Reserved_Line312 ZDrive_BSW_Cal_Cal.ZDrive_BSW_Cal_VehicleInfomationTable.Vehicle_Information_Reserved_Line313 ZDrive_BSW_Cal_Cal.ZDrive_BSW_Cal_VehicleInfomationTable.Vehicle_Information_Reserved_Line314 ZDrive_BSW_Cal_Cal.ZDrive_BSW_Cal_VehicleInfomationTable.Vehicle_Information_Reserved_Line315 ZDrive_BSW_Cal_Cal.ZDrive_BSW_Cal_VehicleInfomationTable.Vehicle_Information_Reserved_Line316 ZDrive_BSW_Cal_Cal.ZDrive_BSW_Cal_VehicleInfomationTable.Vehicle_Information_Reserved_Line317 ZDrive_BSW_Cal_Cal.ZDrive_BSW_Cal_VehicleInfomationTable.Vehicle_Information_Reserved_Line318 ZDrive_BSW_Cal_Cal.ZDrive_BSW_Cal_VehicleInfomationTable.Vehicle_Information_Reserved_Line319 ZDrive_BSW_Cal_Cal.ZDrive_BSW_Cal_VehicleInfomationTable.Vehicle_Information_Reserved_Line320 ZDrive_BSW_Cal_Cal.ZDrive_BSW_Cal_VehicleInfomationTable.Vehicle_Information_Reserved_Line321 ZDrive_BSW_Cal_Cal.ZDrive_BSW_Cal_VehicleInfomationTable.Vehicle_Information_Reserved_Line322 ZDrive_BSW_Cal_Cal.ZDrive_BSW_Cal_VehicleInfomationTable.Vehicle_Information_Reserved_Line323 ZDrive_BSW_Cal_Cal.ZDrive_BSW_Cal_VehicleInfomationTable.Vehicle_Information_Reserved_Line324 ZDrive_BSW_Cal_Cal.ZDrive_BSW_Cal_VehicleInfomationTable.Vehicle_Information_Reserved_Line325 ZDrive_BSW_Cal_Cal.ZDrive_BSW_Cal_VehicleInfomationTable.Vehicle_Information_Reserved_Line326 ZDrive_BSW_Cal_Cal.ZDrive_BSW_Cal_VehicleInfomationTable.Vehicle_Information_Reserved_Line327 ZDrive_BSW_Cal_Cal.ZDrive_BSW_Cal_VehicleInfomationTable.Vehicle_Information_Reserved_Line328 ZDrive_BSW_Cal_Cal.ZDrive_BSW_Cal_VehicleInfomationTable.Vehicle_Information_Reserved_Line329 ZDrive_BSW_Cal_Cal.ZDrive_BSW_Cal_VehicleInfomationTable.Vehicle_Information_Reserved_Line330 ZDrive_BSW_Cal_Cal.ZDrive_BSW_Cal_VehicleInfomationTable.Vehicle_Information_Reserved_Line331 ZDrive_BSW_Cal_Cal.ZDrive_BSW_Cal_VehicleInfomationTable.Vehicle_Information_Reserved_Line332 ZDrive_BSW_Cal_Cal.ZDrive_BSW_Cal_VehicleInfomationTable.Vehicle_Information_Reserved_Line333 ZDrive_BSW_Cal_Cal.ZDrive_BSW_Cal_VehicleInfomationTable.Vehicle_Information_Reserved_Line334 ZDrive_BSW_Cal_Cal.ZDrive_BSW_Cal_VehicleInfomationTable.Vehicle_Information_Reserved_Line335 ZDrive_BSW_Cal_Cal.ZDrive_BSW_Cal_VehicleInfomationTable.Vehicle_Information_Reserved_Line336 ZDrive_BSW_Cal_Cal.ZDrive_BSW_Cal_VehicleInfomationTable.Vehicle_Information_Reserved_Line337 ZDrive_BSW_Cal_Cal.ZDrive_BSW_Cal_VehicleInfomationTable.Vehicle_Information_Reserved_Line338 ZDrive_BSW_Cal_Cal.ZDrive_BSW_Cal_VehicleInfomationTable.Vehicle_Information_Reserved_Line339 ZDrive_BSW_Cal_Cal.ZDrive_BSW_Cal_VehicleInfomationTable.Vehicle_Information_Reserved_Line340 ZDrive_BSW_Cal_Cal.ZDrive_BSW_Cal_VehicleInfomationTable.Vehicle_Information_Reserved_Line341 ZDrive_BSW_Cal_Cal.ZDrive_BSW_Cal_VehicleInfomationTable.Vehicle_Information_Reserved_Line342 ZDrive_BSW_Cal_Cal.ZDrive_BSW_Cal_VehicleInfomationTable.Vehicle_Information_Reserved_Line343 ZDrive_BSW_Cal_Cal.ZDrive_BSW_Cal_VehicleInfomationTable.Vehicle_Information_Reserved_Line344 ZDrive_BSW_Cal_Cal.ZDrive_BSW_Cal_VehicleInfomationTable.Vehicle_Information_Reserved_Line345 ZDrive_BSW_Cal_Cal.ZDrive_BSW_Cal_VehicleInfomationTable.Vehicle_Information_Reserved_Line346 ZDrive_BSW_Cal_Cal.ZDrive_BSW_Cal_VehicleInfomationTable.Vehicle_Information_Reserved_Line347 ZDrive_BSW_Cal_Cal.ZDrive_BSW_Cal_VehicleInfomationTable.Vehicle_Information_Reserved_Line348 ZDrive_BSW_Cal_Cal.ZDrive_BSW_Cal_VehicleInfomationTable.Vehicle_Information_Reserved_Line349 ZDrive_BSW_Cal_Cal.ZDrive_BSW_Cal_VehicleInfomationTable.Vehicle_Information_Reserved_Line350 ZDrive_BSW_Cal_Cal.ZDrive_BSW_Cal_VehicleInfomationTable.Vehicle_Information_Reserved_Line351 ZDrive_BSW_Cal_Cal.ZDrive_BSW_Cal_VehicleInfomationTable.Vehicle_Information_Reserved_Line352 ZDrive_BSW_Cal_Cal.ZDrive_BSW_Cal_VehicleInfomationTable.Vehicle_Information_Reserved_Line353 ZDrive_BSW_Cal_Cal.ZDrive_BSW_Cal_VehicleInfomationTable.Vehicle_Information_Reserved_Line354 ZDrive_BSW_Cal_Cal.ZDrive_BSW_Cal_VehicleInfomationTable.Vehicle_Information_End_Tag /end REF_CHARACTERISTIC
/end GROUP
/begin RECORD_LAYOUT Record_BOOLEAN FNC_VALUES 1 UBYTE COLUMN_DIR DIRECT /end RECORD_LAYOUT
/begin RECORD_LAYOUT Record_FLOAT32_IEEE FNC_VALUES 1 FLOAT32_IEEE COLUMN_DIR DIRECT /end RECORD_LAYOUT
/begin RECORD_LAYOUT Record_FLOAT64_IEEE FNC_VALUES 1 FLOAT64_IEEE COLUMN_DIR DIRECT /end RECORD_LAYOUT
/begin RECORD_LAYOUT Record_UBYTE FNC_VALUES 1 UBYTE COLUMN_DIR DIRECT /end RECORD_LAYOUT
/begin RECORD_LAYOUT Record_ULONG FNC_VALUES 1 ULONG COLUMN_DIR DIRECT /end RECORD_LAYOUT
/begin RECORD_LAYOUT Record_UWORD FNC_VALUES 1 UWORD COLUMN_DIR DIRECT /end RECORD_LAYOUT
/begin GROUP ZDrive_BSW_Cal_Cal.ZDrive_BSW_Cal_VehicleInfomationTable ""
 /begin REF_CHARACTERISTIC ZDrive_BSW_Cal_Cal.ZDrive_BSW_Cal_VehicleInfomationTable.RADAR_MOUNT_PARAM_FRONT_X_POSITION ZDrive_BSW_Cal_Cal.ZDrive_BSW_Cal_VehicleInfomationTable.RADAR_MOUNT_PARAM_FRONT_Y_POSITION ZDrive_BSW_Cal_Cal.ZDrive_BSW_Cal_VehicleInfomationTable.RADAR_MOUNT_PARAM_FRONT_YAW_ANGLE ZDrive_BSW_Cal_Cal.ZDrive_BSW_Cal_VehicleInfomationTable.RADAR_MOUNT_PARAM_FL_X_POSITION ZDrive_BSW_Cal_Cal.ZDrive_BSW_Cal_VehicleInfomationTable.RADAR_MOUNT_PARAM_FL_Y_POSITION ZDrive_BSW_Cal_Cal.ZDrive_BSW_Cal_VehicleInfomationTable.RADAR_MOUNT_PARAM_FL_YAW_ANGLE ZDrive_BSW_Cal_Cal.ZDrive_BSW_Cal_VehicleInfomationTable.RADAR_MOUNT_PARAM_FR_X_POSITION ZDrive_BSW_Cal_Cal.ZDrive_BSW_Cal_VehicleInfomationTable.RADAR_MOUNT_PARAM_FR_Y_POSITION ZDrive_BSW_Cal_Cal.ZDrive_BSW_Cal_VehicleInfomationTable.RADAR_MOUNT_PARAM_FR_YAW_ANGLE ZDrive_BSW_Cal_Cal.ZDrive_BSW_Cal_VehicleInfomationTable.RADAR_MOUNT_PARAM_RL_X_POSITION ZDrive_BSW_Cal_Cal.ZDrive_BSW_Cal_VehicleInfomationTable.RADAR_MOUNT_PARAM_RL_Y_POSITION ZDrive_BSW_Cal_Cal.ZDrive_BSW_Cal_VehicleInfomationTable.RADAR_MOUNT_PARAM_RL_YAW_ANGLE ZDrive_BSW_Cal_Cal.ZDrive_BSW_Cal_VehicleInfomationTable.RADAR_MOUNT_PARAM_RR_X_POSITION ZDrive_BSW_Cal_Cal.ZDrive_BSW_Cal_VehicleInfomationTable.RADAR_MOUNT_PARAM_RR_Y_POSITION ZDrive_BSW_Cal_Cal.ZDrive_BSW_Cal_VehicleInfomationTable.RADAR_MOUNT_PARAM_RR_YAW_ANGLE ZDrive_BSW_Cal_Cal.ZDrive_BSW_Cal_VehicleInfomationTable.Vehicle_Information_Reserved_Line277 ZDrive_BSW_Cal_Cal.ZDrive_BSW_Cal_VehicleInfomationTable.Vehicle_Information_Reserved_Line278 ZDrive_BSW_Cal_Cal.ZDrive_BSW_Cal_VehicleInfomationTable.Vehicle_Information_Reserved_Line279 ZDrive_BSW_Cal_Cal.ZDrive_BSW_Cal_VehicleInfomationTable.Vehicle_Information_Reserved_Line280 ZDrive_BSW_Cal_Cal.ZDrive_BSW_Cal_VehicleInfomationTable.Vehicle_Information_Reserved_Line281 ZDrive_BSW_Cal_Cal.ZDrive_BSW_Cal_VehicleInfomationTable.Vehicle_Information_Reserved_Line282 ZDrive_BSW_Cal_Cal.ZDrive_BSW_Cal_VehicleInfomationTable.Vehicle_Information_Reserved_Line283 ZDrive_BSW_Cal_Cal.ZDrive_BSW_Cal_VehicleInfomationTable.Vehicle_Information_Reserved_Line284 ZDrive_BSW_Cal_Cal.ZDrive_BSW_Cal_VehicleInfomationTable.Vehicle_Information_Reserved_Line285 ZDrive_BSW_Cal_Cal.ZDrive_BSW_Cal_VehicleInfomationTable.Vehicle_Information_Reserved_Line286 ZDrive_BSW_Cal_Cal.ZDrive_BSW_Cal_VehicleInfomationTable.Vehicle_Information_Reserved_Line287 ZDrive_BSW_Cal_Cal.ZDrive_BSW_Cal_VehicleInfomationTable.Vehicle_Information_Reserved_Line288 ZDrive_BSW_Cal_Cal.ZDrive_BSW_Cal_VehicleInfomationTable.Vehicle_Information_Reserved_Line289 ZDrive_BSW_Cal_Cal.ZDrive_BSW_Cal_VehicleInfomationTable.Vehicle_Information_Reserved_Line290 ZDrive_BSW_Cal_Cal.ZDrive_BSW_Cal_VehicleInfomationTable.Vehicle_Information_Reserved_Line291 ZDrive_BSW_Cal_Cal.ZDrive_BSW_Cal_VehicleInfomationTable.Vehicle_Information_Reserved_Line292 ZDrive_BSW_Cal_Cal.ZDrive_BSW_Cal_VehicleInfomationTable.Vehicle_Information_Reserved_Line293 ZDrive_BSW_Cal_Cal.ZDrive_BSW_Cal_VehicleInfomationTable.Vehicle_Information_Reserved_Line294 ZDrive_BSW_Cal_Cal.ZDrive_BSW_Cal_VehicleInfomationTable.Vehicle_Information_Reserved_Line295 ZDrive_BSW_Cal_Cal.ZDrive_BSW_Cal_VehicleInfomationTable.Vehicle_Information_Reserved_Line296 ZDrive_BSW_Cal_Cal.ZDrive_BSW_Cal_VehicleInfomationTable.Vehicle_Information_Reserved_Line297 ZDrive_BSW_Cal_Cal.ZDrive_BSW_Cal_VehicleInfomationTable.Vehicle_Information_Reserved_Line298 ZDrive_BSW_Cal_Cal.ZDrive_BSW_Cal_VehicleInfomationTable.Vehicle_Information_Reserved_Line299 ZDrive_BSW_Cal_Cal.ZDrive_BSW_Cal_VehicleInfomationTable.Vehicle_Information_Reserved_Line300 ZDrive_BSW_Cal_Cal.ZDrive_BSW_Cal_VehicleInfomationTable.Vehicle_Information_Reserved_Line301 ZDrive_BSW_Cal_Cal.ZDrive_BSW_Cal_VehicleInfomationTable.Vehicle_Information_Reserved_Line302 ZDrive_BSW_Cal_Cal.ZDrive_BSW_Cal_VehicleInfomationTable.Vehicle_Information_Reserved_Line303 ZDrive_BSW_Cal_Cal.ZDrive_BSW_Cal_VehicleInfomationTable.Vehicle_Information_Reserved_Line304 ZDrive_BSW_Cal_Cal.ZDrive_BSW_Cal_VehicleInfomationTable.Vehicle_Information_Reserved_Line305 ZDrive_BSW_Cal_Cal.ZDrive_BSW_Cal_VehicleInfomationTable.Vehicle_Information_Reserved_Line306 ZDrive_BSW_Cal_Cal.ZDrive_BSW_Cal_VehicleInfomationTable.Vehicle_Information_Reserved_Line307 ZDrive_BSW_Cal_Cal.ZDrive_BSW_Cal_VehicleInfomationTable.Vehicle_Information_Reserved_Line308 ZDrive_BSW_Cal_Cal.ZDrive_BSW_Cal_VehicleInfomationTable.Vehicle_Information_Reserved_Line309 ZDrive_BSW_Cal_Cal.ZDrive_BSW_Cal_VehicleInfomationTable.Vehicle_Information_Reserved_Line310 ZDrive_BSW_Cal_Cal.ZDrive_BSW_Cal_VehicleInfomationTable.Vehicle_Information_Reserved_Line311 ZDrive_BSW_Cal_Cal.ZDrive_BSW_Cal_VehicleInfomationTable.Vehicle_Information_Reserved_Line312 ZDrive_BSW_Cal_Cal.ZDrive_BSW_Cal_VehicleInfomationTable.Vehicle_Information_Reserved_Line313 ZDrive_BSW_Cal_Cal.ZDrive_BSW_Cal_VehicleInfomationTable.Vehicle_Information_Reserved_Line314 ZDrive_BSW_Cal_Cal.ZDrive_BSW_Cal_VehicleInfomationTable.Vehicle_Information_Reserved_Line315 ZDrive_BSW_Cal_Cal.ZDrive_BSW_Cal_VehicleInfomationTable.Vehicle_Information_Reserved_Line316 ZDrive_BSW_Cal_Cal.ZDrive_BSW_Cal_VehicleInfomationTable.Vehicle_Information_Reserved_Line317 ZDrive_BSW_Cal_Cal.ZDrive_BSW_Cal_VehicleInfomationTable.Vehicle_Information_Reserved_Line318 ZDrive_BSW_Cal_Cal.ZDrive_BSW_Cal_VehicleInfomationTable.Vehicle_Information_Reserved_Line319 ZDrive_BSW_Cal_Cal.ZDrive_BSW_Cal_VehicleInfomationTable.Vehicle_Information_Reserved_Line320 ZDrive_BSW_Cal_Cal.ZDrive_BSW_Cal_VehicleInfomationTable.Vehicle_Information_Reserved_Line321 ZDrive_BSW_Cal_Cal.ZDrive_BSW_Cal_VehicleInfomationTable.Vehicle_Information_Reserved_Line322 ZDrive_BSW_Cal_Cal.ZDrive_BSW_Cal_VehicleInfomationTable.Vehicle_Information_Reserved_Line323 ZDrive_BSW_Cal_Cal.ZDrive_BSW_Cal_VehicleInfomationTable.Vehicle_Information_Reserved_Line324 ZDrive_BSW_Cal_Cal.ZDrive_BSW_Cal_VehicleInfomationTable.Vehicle_Information_Reserved_Line325 ZDrive_BSW_Cal_Cal.ZDrive_BSW_Cal_VehicleInfomationTable.Vehicle_Information_Reserved_Line326 ZDrive_BSW_Cal_Cal.ZDrive_BSW_Cal_VehicleInfomationTable.Vehicle_Information_Reserved_Line327 ZDrive_BSW_Cal_Cal.ZDrive_BSW_Cal_VehicleInfomationTable.Vehicle_Information_Reserved_Line328 ZDrive_BSW_Cal_Cal.ZDrive_BSW_Cal_VehicleInfomationTable.Vehicle_Information_Reserved_Line329 ZDrive_BSW_Cal_Cal.ZDrive_BSW_Cal_VehicleInfomationTable.Vehicle_Information_Reserved_Line330 ZDrive_BSW_Cal_Cal.ZDrive_BSW_Cal_VehicleInfomationTable.Vehicle_Information_Reserved_Line331 ZDrive_BSW_Cal_Cal.ZDrive_BSW_Cal_VehicleInfomationTable.Vehicle_Information_Reserved_Line332 ZDrive_BSW_Cal_Cal.ZDrive_BSW_Cal_VehicleInfomationTable.Vehicle_Information_Reserved_Line333 ZDrive_BSW_Cal_Cal.ZDrive_BSW_Cal_VehicleInfomationTable.Vehicle_Information_Reserved_Line334 ZDrive_BSW_Cal_Cal.ZDrive_BSW_Cal_VehicleInfomationTable.Vehicle_Information_Reserved_Line335 ZDrive_BSW_Cal_Cal.ZDrive_BSW_Cal_VehicleInfomationTable.Vehicle_Information_Reserved_Line336 ZDrive_BSW_Cal_Cal.ZDrive_BSW_Cal_VehicleInfomationTable.Vehicle_Information_Reserved_Line337 ZDrive_BSW_Cal_Cal.ZDrive_BSW_Cal_VehicleInfomationTable.Vehicle_Information_Reserved_Line338 ZDrive_BSW_Cal_Cal.ZDrive_BSW_Cal_VehicleInfomationTable.Vehicle_Information_Reserved_Line339 ZDrive_BSW_Cal_Cal.ZDrive_BSW_Cal_VehicleInfomationTable.Vehicle_Information_Reserved_Line340 ZDrive_BSW_Cal_Cal.ZDrive_BSW_Cal_VehicleInfomationTable.Vehicle_Information_Reserved_Line341 ZDrive_BSW_Cal_Cal.ZDrive_BSW_Cal_VehicleInfomationTable.Vehicle_Information_Reserved_Line342 ZDrive_BSW_Cal_Cal.ZDrive_BSW_Cal_VehicleInfomationTable.Vehicle_Information_Reserved_Line343 ZDrive_BSW_Cal_Cal.ZDrive_BSW_Cal_VehicleInfomationTable.Vehicle_Information_Reserved_Line344 ZDrive_BSW_Cal_Cal.ZDrive_BSW_Cal_VehicleInfomationTable.Vehicle_Information_Reserved_Line345 ZDrive_BSW_Cal_Cal.ZDrive_BSW_Cal_VehicleInfomationTable.Vehicle_Information_Reserved_Line346 ZDrive_BSW_Cal_Cal.ZDrive_BSW_Cal_VehicleInfomationTable.Vehicle_Information_Reserved_Line347 ZDrive_BSW_Cal_Cal.ZDrive_BSW_Cal_VehicleInfomationTable.Vehicle_Information_Reserved_Line348 ZDrive_BSW_Cal_Cal.ZDrive_BSW_Cal_VehicleInfomationTable.Vehicle_Information_Reserved_Line349 ZDrive_BSW_Cal_Cal.ZDrive_BSW_Cal_VehicleInfomationTable.Vehicle_Information_Reserved_Line350 ZDrive_BSW_Cal_Cal.ZDrive_BSW_Cal_VehicleInfomationTable.Vehicle_Information_Reserved_Line351 ZDrive_BSW_Cal_Cal.ZDrive_BSW_Cal_VehicleInfomationTable.Vehicle_Information_Reserved_Line352 ZDrive_BSW_Cal_Cal.ZDrive_BSW_Cal_VehicleInfomationTable.Vehicle_Information_Reserved_Line353 ZDrive_BSW_Cal_Cal.ZDrive_BSW_Cal_VehicleInfomationTable.Vehicle_Information_Reserved_Line354 ZDrive_BSW_Cal_Cal.ZDrive_BSW_Cal_VehicleInfomationTable.Vehicle_Information_End_Tag /end REF_CHARACTERISTIC
/end GROUP
/begin RECORD_LAYOUT Record_BOOLEAN FNC_VALUES 1 UBYTE COLUMN_DIR DIRECT /end RECORD_LAYOUT
/begin RECORD_LAYOUT Record_FLOAT32_IEEE FNC_VALUES 1 FLOAT32_IEEE COLUMN_DIR DIRECT /end RECORD_LAYOUT
/begin RECORD_LAYOUT Record_FLOAT64_IEEE FNC_VALUES 1 FLOAT64_IEEE COLUMN_DIR DIRECT /end RECORD_LAYOUT
/begin RECORD_LAYOUT Record_UBYTE FNC_VALUES 1 UBYTE COLUMN_DIR DIRECT /end RECORD_LAYOUT
/begin RECORD_LAYOUT Record_ULONG FNC_VALUES 1 ULONG COLUMN_DIR DIRECT /end RECORD_LAYOUT
/begin RECORD_LAYOUT Record_UWORD FNC_VALUES 1 UWORD COLUMN_DIR DIRECT /end RECORD_LAYOUT
/begin RECORD_LAYOUT Axis_FLOAT32_IEEE AXIS_PTS_X 1 FLOAT32_IEEE INDEX_INCR DIRECT /end RECORD_LAYOUT
/begin GROUP ZDrive_BSW_Cal_Cal.ZDrive_BSW_Cal_VehicleInfomationTable ""
 /begin REF_CHARACTERISTIC ZDrive_BSW_Cal_Cal.ZDrive_BSW_Cal_VehicleInfomationTable.RADAR_MOUNT_PARAM_FRONT_X_POSITION ZDrive_BSW_Cal_Cal.ZDrive_BSW_Cal_VehicleInfomationTable.RADAR_MOUNT_PARAM_FRONT_Y_POSITION ZDrive_BSW_Cal_Cal.ZDrive_BSW_Cal_VehicleInfomationTable.RADAR_MOUNT_PARAM_FRONT_YAW_ANGLE ZDrive_BSW_Cal_Cal.ZDrive_BSW_Cal_VehicleInfomationTable.RADAR_MOUNT_PARAM_FL_X_POSITION ZDrive_BSW_Cal_Cal.ZDrive_BSW_Cal_VehicleInfomationTable.RADAR_MOUNT_PARAM_FL_Y_POSITION ZDrive_BSW_Cal_Cal.ZDrive_BSW_Cal_VehicleInfomationTable.RADAR_MOUNT_PARAM_FL_YAW_ANGLE ZDrive_BSW_Cal_Cal.ZDrive_BSW_Cal_VehicleInfomationTable.RADAR_MOUNT_PARAM_FR_X_POSITION ZDrive_BSW_Cal_Cal.ZDrive_BSW_Cal_VehicleInfomationTable.RADAR_MOUNT_PARAM_FR_Y_POSITION ZDrive_BSW_Cal_Cal.ZDrive_BSW_Cal_VehicleInfomationTable.RADAR_MOUNT_PARAM_FR_YAW_ANGLE ZDrive_BSW_Cal_Cal.ZDrive_BSW_Cal_VehicleInfomationTable.RADAR_MOUNT_PARAM_RL_X_POSITION ZDrive_BSW_Cal_Cal.ZDrive_BSW_Cal_VehicleInfomationTable.RADAR_MOUNT_PARAM_RL_Y_POSITION ZDrive_BSW_Cal_Cal.ZDrive_BSW_Cal_VehicleInfomationTable.RADAR_MOUNT_PARAM_RL_YAW_ANGLE ZDrive_BSW_Cal_Cal.ZDrive_BSW_Cal_VehicleInfomationTable.RADAR_MOUNT_PARAM_RR_X_POSITION ZDrive_BSW_Cal_Cal.ZDrive_BSW_Cal_VehicleInfomationTable.RADAR_MOUNT_PARAM_RR_Y_POSITION ZDrive_BSW_Cal_Cal.ZDrive_BSW_Cal_VehicleInfomationTable.RADAR_MOUNT_PARAM_RR_YAW_ANGLE ZDrive_BSW_Cal_Cal.ZDrive_BSW_Cal_VehicleInfomationTable.Vehicle_Information_Reserved_Line277 ZDrive_BSW_Cal_Cal.ZDrive_BSW_Cal_VehicleInfomationTable.Vehicle_Information_Reserved_Line278 ZDrive_BSW_Cal_Cal.ZDrive_BSW_Cal_VehicleInfomationTable.Vehicle_Information_Reserved_Line279 ZDrive_BSW_Cal_Cal.ZDrive_BSW_Cal_VehicleInfomationTable.Vehicle_Information_Reserved_Line280 ZDrive_BSW_Cal_Cal.ZDrive_BSW_Cal_VehicleInfomationTable.Vehicle_Information_Reserved_Line281 ZDrive_BSW_Cal_Cal.ZDrive_BSW_Cal_VehicleInfomationTable.Vehicle_Information_Reserved_Line282 ZDrive_BSW_Cal_Cal.ZDrive_BSW_Cal_VehicleInfomationTable.Vehicle_Information_Reserved_Line283 ZDrive_BSW_Cal_Cal.ZDrive_BSW_Cal_VehicleInfomationTable.Vehicle_Information_Reserved_Line284 ZDrive_BSW_Cal_Cal.ZDrive_BSW_Cal_VehicleInfomationTable.Vehicle_Information_Reserved_Line285 ZDrive_BSW_Cal_Cal.ZDrive_BSW_Cal_VehicleInfomationTable.Vehicle_Information_Reserved_Line286 ZDrive_BSW_Cal_Cal.ZDrive_BSW_Cal_VehicleInfomationTable.Vehicle_Information_Reserved_Line287 ZDrive_BSW_Cal_Cal.ZDrive_BSW_Cal_VehicleInfomationTable.Vehicle_Information_Reserved_Line288 ZDrive_BSW_Cal_Cal.ZDrive_BSW_Cal_VehicleInfomationTable.Vehicle_Information_Reserved_Line289 ZDrive_BSW_Cal_Cal.ZDrive_BSW_Cal_VehicleInfomationTable.Vehicle_Information_Reserved_Line290 ZDrive_BSW_Cal_Cal.ZDrive_BSW_Cal_VehicleInfomationTable.Vehicle_Information_Reserved_Line291 ZDrive_BSW_Cal_Cal.ZDrive_BSW_Cal_VehicleInfomationTable.Vehicle_Information_Reserved_Line292 ZDrive_BSW_Cal_Cal.ZDrive_BSW_Cal_VehicleInfomationTable.Vehicle_Information_Reserved_Line293 ZDrive_BSW_Cal_Cal.ZDrive_BSW_Cal_VehicleInfomationTable.Vehicle_Information_Reserved_Line294 ZDrive_BSW_Cal_Cal.ZDrive_BSW_Cal_VehicleInfomationTable.Vehicle_Information_Reserved_Line295 ZDrive_BSW_Cal_Cal.ZDrive_BSW_Cal_VehicleInfomationTable.Vehicle_Information_Reserved_Line296 ZDrive_BSW_Cal_Cal.ZDrive_BSW_Cal_VehicleInfomationTable.Vehicle_Information_Reserved_Line297 ZDrive_BSW_Cal_Cal.ZDrive_BSW_Cal_VehicleInfomationTable.Vehicle_Information_Reserved_Line298 ZDrive_BSW_Cal_Cal.ZDrive_BSW_Cal_VehicleInfomationTable.Vehicle_Information_Reserved_Line299 ZDrive_BSW_Cal_Cal.ZDrive_BSW_Cal_VehicleInfomationTable.Vehicle_Information_Reserved_Line300 ZDrive_BSW_Cal_Cal.ZDrive_BSW_Cal_VehicleInfomationTable.Vehicle_Information_Reserved_Line301 ZDrive_BSW_Cal_Cal.ZDrive_BSW_Cal_VehicleInfomationTable.Vehicle_Information_Reserved_Line302 ZDrive_BSW_Cal_Cal.ZDrive_BSW_Cal_VehicleInfomationTable.Vehicle_Information_Reserved_Line303 ZDrive_BSW_Cal_Cal.ZDrive_BSW_Cal_VehicleInfomationTable.Vehicle_Information_Reserved_Line304 ZDrive_BSW_Cal_Cal.ZDrive_BSW_Cal_VehicleInfomationTable.Vehicle_Information_Reserved_Line305 ZDrive_BSW_Cal_Cal.ZDrive_BSW_Cal_VehicleInfomationTable.Vehicle_Information_Reserved_Line306 ZDrive_BSW_Cal_Cal.ZDrive_BSW_Cal_VehicleInfomationTable.Vehicle_Information_Reserved_Line307 ZDrive_BSW_Cal_Cal.ZDrive_BSW_Cal_VehicleInfomationTable.Vehicle_Information_Reserved_Line308 ZDrive_BSW_Cal_Cal.ZDrive_BSW_Cal_VehicleInfomationTable.Vehicle_Information_Reserved_Line309 ZDrive_BSW_Cal_Cal.ZDrive_BSW_Cal_VehicleInfomationTable.Vehicle_Information_Reserved_Line310 ZDrive_BSW_Cal_Cal.ZDrive_BSW_Cal_VehicleInfomationTable.Vehicle_Information_Reserved_Line311 ZDrive_BSW_Cal_Cal.ZDrive_BSW_Cal_VehicleInfomationTable.Vehicle_Information_Reserved_Line312 ZDrive_BSW_Cal_Cal.ZDrive_BSW_Cal_VehicleInfomationTable.Vehicle_Information_Reserved_Line313 ZDrive_BSW_Cal_Cal.ZDrive_BSW_Cal_VehicleInfomationTable.Vehicle_Information_Reserved_Line314 ZDrive_BSW_Cal_Cal.ZDrive_BSW_Cal_VehicleInfomationTable.Vehicle_Information_Reserved_Line315 ZDrive_BSW_Cal_Cal.ZDrive_BSW_Cal_VehicleInfomationTable.Vehicle_Information_Reserved_Line316 ZDrive_BSW_Cal_Cal.ZDrive_BSW_Cal_VehicleInfomationTable.Vehicle_Information_Reserved_Line317 ZDrive_BSW_Cal_Cal.ZDrive_BSW_Cal_VehicleInfomationTable.Vehicle_Information_Reserved_Line318 ZDrive_BSW_Cal_Cal.ZDrive_BSW_Cal_VehicleInfomationTable.Vehicle_Information_Reserved_Line319 ZDrive_BSW_Cal_Cal.ZDrive_BSW_Cal_VehicleInfomationTable.Vehicle_Information_Reserved_Line320 ZDrive_BSW_Cal_Cal.ZDrive_BSW_Cal_VehicleInfomationTable.Vehicle_Information_Reserved_Line321 ZDrive_BSW_Cal_Cal.ZDrive_BSW_Cal_VehicleInfomationTable.Vehicle_Information_Reserved_Line322 ZDrive_BSW_Cal_Cal.ZDrive_BSW_Cal_VehicleInfomationTable.Vehicle_Information_Reserved_Line323 ZDrive_BSW_Cal_Cal.ZDrive_BSW_Cal_VehicleInfomationTable.Vehicle_Information_Reserved_Line324 ZDrive_BSW_Cal_Cal.ZDrive_BSW_Cal_VehicleInfomationTable.Vehicle_Information_Reserved_Line325 ZDrive_BSW_Cal_Cal.ZDrive_BSW_Cal_VehicleInfomationTable.Vehicle_Information_Reserved_Line326 ZDrive_BSW_Cal_Cal.ZDrive_BSW_Cal_VehicleInfomationTable.Vehicle_Information_Reserved_Line327 ZDrive_BSW_Cal_Cal.ZDrive_BSW_Cal_VehicleInfomationTable.Vehicle_Information_Reserved_Line328 ZDrive_BSW_Cal_Cal.ZDrive_BSW_Cal_VehicleInfomationTable.Vehicle_Information_Reserved_Line329 ZDrive_BSW_Cal_Cal.ZDrive_BSW_Cal_VehicleInfomationTable.Vehicle_Information_Reserved_Line330 ZDrive_BSW_Cal_Cal.ZDrive_BSW_Cal_VehicleInfomationTable.Vehicle_Information_Reserved_Line331 ZDrive_BSW_Cal_Cal.ZDrive_BSW_Cal_VehicleInfomationTable.Vehicle_Information_Reserved_Line332 ZDrive_BSW_Cal_Cal.ZDrive_BSW_Cal_VehicleInfomationTable.Vehicle_Information_Reserved_Line333 ZDrive_BSW_Cal_Cal.ZDrive_BSW_Cal_VehicleInfomationTable.Vehicle_Information_Reserved_Line334 ZDrive_BSW_Cal_Cal.ZDrive_BSW_Cal_VehicleInfomationTable.Vehicle_Information_Reserved_Line335 ZDrive_BSW_Cal_Cal.ZDrive_BSW_Cal_VehicleInfomationTable.Vehicle_Information_Reserved_Line336 ZDrive_BSW_Cal_Cal.ZDrive_BSW_Cal_VehicleInfomationTable.Vehicle_Information_Reserved_Line337 ZDrive_BSW_Cal_Cal.ZDrive_BSW_Cal_VehicleInfomationTable.Vehicle_Information_Reserved_Line338 ZDrive_BSW_Cal_Cal.ZDrive_BSW_Cal_VehicleInfomationTable.Vehicle_Information_Reserved_Line339 ZDrive_BSW_Cal_Cal.ZDrive_BSW_Cal_VehicleInfomationTable.Vehicle_Information_Reserved_Line340 ZDrive_BSW_Cal_Cal.ZDrive_BSW_Cal_VehicleInfomationTable.Vehicle_Information_Reserved_Line341 ZDrive_BSW_Cal_Cal.ZDrive_BSW_Cal_VehicleInfomationTable.Vehicle_Information_Reserved_Line342 ZDrive_BSW_Cal_Cal.ZDrive_BSW_Cal_VehicleInfomationTable.Vehicle_Information_Reserved_Line343 ZDrive_BSW_Cal_Cal.ZDrive_BSW_Cal_VehicleInfomationTable.Vehicle_Information_Reserved_Line344 ZDrive_BSW_Cal_Cal.ZDrive_BSW_Cal_VehicleInfomationTable.Vehicle_Information_Reserved_Line345 ZDrive_BSW_Cal_Cal.ZDrive_BSW_Cal_VehicleInfomationTable.Vehicle_Information_Reserved_Line346 ZDrive_BSW_Cal_Cal.ZDrive_BSW_Cal_VehicleInfomationTable.Vehicle_Information_Reserved_Line347 ZDrive_BSW_Cal_Cal.ZDrive_BSW_Cal_VehicleInfomationTable.Vehicle_Information_Reserved_Line348 ZDrive_BSW_Cal_Cal.ZDrive_BSW_Cal_VehicleInfomationTable.Vehicle_Information_Reserved_Line349 ZDrive_BSW_Cal_Cal.ZDrive_BSW_Cal_VehicleInfomationTable.Vehicle_Information_Reserved_Line350 ZDrive_BSW_Cal_Cal.ZDrive_BSW_Cal_VehicleInfomationTable.Vehicle_Information_Reserved_Line351 ZDrive_BSW_Cal_Cal.ZDrive_BSW_Cal_VehicleInfomationTable.Vehicle_Information_Reserved_Line352 ZDrive_BSW_Cal_Cal.ZDrive_BSW_Cal_VehicleInfomationTable.Vehicle_Information_Reserved_Line353 ZDrive_BSW_Cal_Cal.ZDrive_BSW_Cal_VehicleInfomationTable.Vehicle_Information_Reserved_Line354 ZDrive_BSW_Cal_Cal.ZDrive_BSW_Cal_VehicleInfomationTable.Vehicle_Information_End_Tag /end REF_CHARACTERISTIC
/end GROUP
/begin RECORD_LAYOUT Record_BOOLEAN FNC_VALUES 1 UBYTE COLUMN_DIR DIRECT /end RECORD_LAYOUT
/begin RECORD_LAYOUT Record_FLOAT32_IEEE FNC_VALUES 1 FLOAT32_IEEE COLUMN_DIR DIRECT /end RECORD_LAYOUT
/begin RECORD_LAYOUT Record_FLOAT64_IEEE FNC_VALUES 1 FLOAT64_IEEE COLUMN_DIR DIRECT /end RECORD_LAYOUT
/begin RECORD_LAYOUT Record_UBYTE FNC_VALUES 1 UBYTE COLUMN_DIR DIRECT /end RECORD_LAYOUT
/begin RECORD_LAYOUT Record_ULONG FNC_VALUES 1 ULONG COLUMN_DIR DIRECT /end RECORD_LAYOUT
/begin RECORD_LAYOUT Record_UWORD FNC_VALUES 1 UWORD COLUMN_DIR DIRECT /end RECORD_LAYOUT
/begin RECORD_LAYOUT Axis_FLOAT32_IEEE AXIS_PTS_X 1 FLOAT32_IEEE INDEX_INCR DIRECT /end RECORD_LAYOUT
/begin GROUP ZDrive_BSW_Cal_Cal.ZDrive_BSW_Cal_VehicleInfomationTable ""
 /begin REF_CHARACTERISTIC ZDrive_BSW_Cal_Cal.ZDrive_BSW_Cal_VehicleInfomationTable.RADAR_MOUNT_PARAM_FRONT_X_POSITION ZDrive_BSW_Cal_Cal.ZDrive_BSW_Cal_VehicleInfomationTable.RADAR_MOUNT_PARAM_FRONT_Y_POSITION ZDrive_BSW_Cal_Cal.ZDrive_BSW_Cal_VehicleInfomationTable.RADAR_MOUNT_PARAM_FRONT_YAW_ANGLE ZDrive_BSW_Cal_Cal.ZDrive_BSW_Cal_VehicleInfomationTable.RADAR_MOUNT_PARAM_FL_X_POSITION ZDrive_BSW_Cal_Cal.ZDrive_BSW_Cal_VehicleInfomationTable.RADAR_MOUNT_PARAM_FL_Y_POSITION ZDrive_BSW_Cal_Cal.ZDrive_BSW_Cal_VehicleInfomationTable.RADAR_MOUNT_PARAM_FL_YAW_ANGLE ZDrive_BSW_Cal_Cal.ZDrive_BSW_Cal_VehicleInfomationTable.RADAR_MOUNT_PARAM_FR_X_POSITION ZDrive_BSW_Cal_Cal.ZDrive_BSW_Cal_VehicleInfomationTable.RADAR_MOUNT_PARAM_FR_Y_POSITION ZDrive_BSW_Cal_Cal.ZDrive_BSW_Cal_VehicleInfomationTable.RADAR_MOUNT_PARAM_FR_YAW_ANGLE ZDrive_BSW_Cal_Cal.ZDrive_BSW_Cal_VehicleInfomationTable.RADAR_MOUNT_PARAM_RL_X_POSITION ZDrive_BSW_Cal_Cal.ZDrive_BSW_Cal_VehicleInfomationTable.RADAR_MOUNT_PARAM_RL_Y_POSITION ZDrive_BSW_Cal_Cal.ZDrive_BSW_Cal_VehicleInfomationTable.RADAR_MOUNT_PARAM_RL_YAW_ANGLE ZDrive_BSW_Cal_Cal.ZDrive_BSW_Cal_VehicleInfomationTable.RADAR_MOUNT_PARAM_RR_X_POSITION ZDrive_BSW_Cal_Cal.ZDrive_BSW_Cal_VehicleInfomationTable.RADAR_MOUNT_PARAM_RR_Y_POSITION ZDrive_BSW_Cal_Cal.ZDrive_BSW_Cal_VehicleInfomationTable.RADAR_MOUNT_PARAM_RR_YAW_ANGLE ZDrive_BSW_Cal_Cal.ZDrive_BSW_Cal_VehicleInfomationTable.Vehicle_Information_Reserved_Line277 ZDrive_BSW_Cal_Cal.ZDrive_BSW_Cal_VehicleInfomationTable.Vehicle_Information_Reserved_Line278 ZDrive_BSW_Cal_Cal.ZDrive_BSW_Cal_VehicleInfomationTable.Vehicle_Information_Reserved_Line279 ZDrive_BSW_Cal_Cal.ZDrive_BSW_Cal_VehicleInfomationTable.Vehicle_Information_Reserved_Line280 ZDrive_BSW_Cal_Cal.ZDrive_BSW_Cal_VehicleInfomationTable.Vehicle_Information_Reserved_Line281 ZDrive_BSW_Cal_Cal.ZDrive_BSW_Cal_VehicleInfomationTable.Vehicle_Information_Reserved_Line282 ZDrive_BSW_Cal_Cal.ZDrive_BSW_Cal_VehicleInfomationTable.Vehicle_Information_Reserved_Line283 ZDrive_BSW_Cal_Cal.ZDrive_BSW_Cal_VehicleInfomationTable.Vehicle_Information_Reserved_Line284 ZDrive_BSW_Cal_Cal.ZDrive_BSW_Cal_VehicleInfomationTable.Vehicle_Information_Reserved_Line285 ZDrive_BSW_Cal_Cal.ZDrive_BSW_Cal_VehicleInfomationTable.Vehicle_Information_Reserved_Line286 ZDrive_BSW_Cal_Cal.ZDrive_BSW_Cal_VehicleInfomationTable.Vehicle_Information_Reserved_Line287 ZDrive_BSW_Cal_Cal.ZDrive_BSW_Cal_VehicleInfomationTable.Vehicle_Information_Reserved_Line288 ZDrive_BSW_Cal_Cal.ZDrive_BSW_Cal_VehicleInfomationTable.Vehicle_Information_Reserved_Line289 ZDrive_BSW_Cal_Cal.ZDrive_BSW_Cal_VehicleInfomationTable.Vehicle_Information_Reserved_Line290 ZDrive_BSW_Cal_Cal.ZDrive_BSW_Cal_VehicleInfomationTable.Vehicle_Information_Reserved_Line291 ZDrive_BSW_Cal_Cal.ZDrive_BSW_Cal_VehicleInfomationTable.Vehicle_Information_Reserved_Line292 ZDrive_BSW_Cal_Cal.ZDrive_BSW_Cal_VehicleInfomationTable.Vehicle_Information_Reserved_Line293 ZDrive_BSW_Cal_Cal.ZDrive_BSW_Cal_VehicleInfomationTable.Vehicle_Information_Reserved_Line294 ZDrive_BSW_Cal_Cal.ZDrive_BSW_Cal_VehicleInfomationTable.Vehicle_Information_Reserved_Line295 ZDrive_BSW_Cal_Cal.ZDrive_BSW_Cal_VehicleInfomationTable.Vehicle_Information_Reserved_Line296 ZDrive_BSW_Cal_Cal.ZDrive_BSW_Cal_VehicleInfomationTable.Vehicle_Information_Reserved_Line297 ZDrive_BSW_Cal_Cal.ZDrive_BSW_Cal_VehicleInfomationTable.Vehicle_Information_Reserved_Line298 ZDrive_BSW_Cal_Cal.ZDrive_BSW_Cal_VehicleInfomationTable.Vehicle_Information_Reserved_Line299 ZDrive_BSW_Cal_Cal.ZDrive_BSW_Cal_VehicleInfomationTable.Vehicle_Information_Reserved_Line300 ZDrive_BSW_Cal_Cal.ZDrive_BSW_Cal_VehicleInfomationTable.Vehicle_Information_Reserved_Line301 ZDrive_BSW_Cal_Cal.ZDrive_BSW_Cal_VehicleInfomationTable.Vehicle_Information_Reserved_Line302 ZDrive_BSW_Cal_Cal.ZDrive_BSW_Cal_VehicleInfomationTable.Vehicle_Information_Reserved_Line303 ZDrive_BSW_Cal_Cal.ZDrive_BSW_Cal_VehicleInfomationTable.Vehicle_Information_Reserved_Line304 ZDrive_BSW_Cal_Cal.ZDrive_BSW_Cal_VehicleInfomationTable.Vehicle_Information_Reserved_Line305 ZDrive_BSW_Cal_Cal.ZDrive_BSW_Cal_VehicleInfomationTable.Vehicle_Information_Reserved_Line306 ZDrive_BSW_Cal_Cal.ZDrive_BSW_Cal_VehicleInfomationTable.Vehicle_Information_Reserved_Line307 ZDrive_BSW_Cal_Cal.ZDrive_BSW_Cal_VehicleInfomationTable.Vehicle_Information_Reserved_Line308 ZDrive_BSW_Cal_Cal.ZDrive_BSW_Cal_VehicleInfomationTable.Vehicle_Information_Reserved_Line309 ZDrive_BSW_Cal_Cal.ZDrive_BSW_Cal_VehicleInfomationTable.Vehicle_Information_Reserved_Line310 ZDrive_BSW_Cal_Cal.ZDrive_BSW_Cal_VehicleInfomationTable.Vehicle_Information_Reserved_Line311 ZDrive_BSW_Cal_Cal.ZDrive_BSW_Cal_VehicleInfomationTable.Vehicle_Information_Reserved_Line312 ZDrive_BSW_Cal_Cal.ZDrive_BSW_Cal_VehicleInfomationTable.Vehicle_Information_Reserved_Line313 ZDrive_BSW_Cal_Cal.ZDrive_BSW_Cal_VehicleInfomationTable.Vehicle_Information_Reserved_Line314 ZDrive_BSW_Cal_Cal.ZDrive_BSW_Cal_VehicleInfomationTable.Vehicle_Information_Reserved_Line315 ZDrive_BSW_Cal_Cal.ZDrive_BSW_Cal_VehicleInfomationTable.Vehicle_Information_Reserved_Line316 ZDrive_BSW_Cal_Cal.ZDrive_BSW_Cal_VehicleInfomationTable.Vehicle_Information_Reserved_Line317 ZDrive_BSW_Cal_Cal.ZDrive_BSW_Cal_VehicleInfomationTable.Vehicle_Information_Reserved_Line318 ZDrive_BSW_Cal_Cal.ZDrive_BSW_Cal_VehicleInfomationTable.Vehicle_Information_Reserved_Line319 ZDrive_BSW_Cal_Cal.ZDrive_BSW_Cal_VehicleInfomationTable.Vehicle_Information_Reserved_Line320 ZDrive_BSW_Cal_Cal.ZDrive_BSW_Cal_VehicleInfomationTable.Vehicle_Information_Reserved_Line321 ZDrive_BSW_Cal_Cal.ZDrive_BSW_Cal_VehicleInfomationTable.Vehicle_Information_Reserved_Line322 ZDrive_BSW_Cal_Cal.ZDrive_BSW_Cal_VehicleInfomationTable.Vehicle_Information_Reserved_Line323 ZDrive_BSW_Cal_Cal.ZDrive_BSW_Cal_VehicleInfomationTable.Vehicle_Information_Reserved_Line324 ZDrive_BSW_Cal_Cal.ZDrive_BSW_Cal_VehicleInfomationTable.Vehicle_Information_Reserved_Line325 ZDrive_BSW_Cal_Cal.ZDrive_BSW_Cal_VehicleInfomationTable.Vehicle_Information_Reserved_Line326 ZDrive_BSW_Cal_Cal.ZDrive_BSW_Cal_VehicleInfomationTable.Vehicle_Information_Reserved_Line327 ZDrive_BSW_Cal_Cal.ZDrive_BSW_Cal_VehicleInfomationTable.Vehicle_Information_Reserved_Line328 ZDrive_BSW_Cal_Cal.ZDrive_BSW_Cal_VehicleInfomationTable.Vehicle_Information_Reserved_Line329 ZDrive_BSW_Cal_Cal.ZDrive_BSW_Cal_VehicleInfomationTable.Vehicle_Information_Reserved_Line330 ZDrive_BSW_Cal_Cal.ZDrive_BSW_Cal_VehicleInfomationTable.Vehicle_Information_Reserved_Line331 ZDrive_BSW_Cal_Cal.ZDrive_BSW_Cal_VehicleInfomationTable.Vehicle_Information_Reserved_Line332 ZDrive_BSW_Cal_Cal.ZDrive_BSW_Cal_VehicleInfomationTable.Vehicle_Information_Reserved_Line333 ZDrive_BSW_Cal_Cal.ZDrive_BSW_Cal_VehicleInfomationTable.Vehicle_Information_Reserved_Line334 ZDrive_BSW_Cal_Cal.ZDrive_BSW_Cal_VehicleInfomationTable.Vehicle_Information_Reserved_Line335 ZDrive_BSW_Cal_Cal.ZDrive_BSW_Cal_VehicleInfomationTable.Vehicle_Information_Reserved_Line336 ZDrive_BSW_Cal_Cal.ZDrive_BSW_Cal_VehicleInfomationTable.Vehicle_Information_Reserved_Line337 ZDrive_BSW_Cal_Cal.ZDrive_BSW_Cal_VehicleInfomationTable.Vehicle_Information_Reserved_Line338 ZDrive_BSW_Cal_Cal.ZDrive_BSW_Cal_VehicleInfomationTable.Vehicle_Information_Reserved_Line339 ZDrive_BSW_Cal_Cal.ZDrive_BSW_Cal_VehicleInfomationTable.Vehicle_Information_Reserved_Line340 ZDrive_BSW_Cal_Cal.ZDrive_BSW_Cal_VehicleInfomationTable.Vehicle_Information_Reserved_Line341 ZDrive_BSW_Cal_Cal.ZDrive_BSW_Cal_VehicleInfomationTable.Vehicle_Information_Reserved_Line342 ZDrive_BSW_Cal_Cal.ZDrive_BSW_Cal_VehicleInfomationTable.Vehicle_Information_Reserved_Line343 ZDrive_BSW_Cal_Cal.ZDrive_BSW_Cal_VehicleInfomationTable.Vehicle_Information_Reserved_Line344 ZDrive_BSW_Cal_Cal.ZDrive_BSW_Cal_VehicleInfomationTable.Vehicle_Information_Reserved_Line345 ZDrive_BSW_Cal_Cal.ZDrive_BSW_Cal_VehicleInfomationTable.Vehicle_Information_Reserved_Line346 ZDrive_BSW_Cal_Cal.ZDrive_BSW_Cal_VehicleInfomationTable.Vehicle_Information_Reserved_Line347 ZDrive_BSW_Cal_Cal.ZDrive_BSW_Cal_VehicleInfomationTable.Vehicle_Information_Reserved_Line348 ZDrive_BSW_Cal_Cal.ZDrive_BSW_Cal_VehicleInfomationTable.Vehicle_Information_Reserved_Line349 ZDrive_BSW_Cal_Cal.ZDrive_BSW_Cal_VehicleInfomationTable.Vehicle_Information_Reserved_Line350 ZDrive_BSW_Cal_Cal.ZDrive_BSW_Cal_VehicleInfomationTable.Vehicle_Information_Reserved_Line351 ZDrive_BSW_Cal_Cal.ZDrive_BSW_Cal_VehicleInfomationTable.Vehicle_Information_Reserved_Line352 ZDrive_BSW_Cal_Cal.ZDrive_BSW_Cal_VehicleInfomationTable.Vehicle_Information_Reserved_Line353 ZDrive_BSW_Cal_Cal.ZDrive_BSW_Cal_VehicleInfomationTable.Vehicle_Information_Reserved_Line354 ZDrive_BSW_Cal_Cal.ZDrive_BSW_Cal_VehicleInfomationTable.Vehicle_Information_End_Tag /end REF_CHARACTERISTIC
/end GROUP
/begin RECORD_LAYOUT Record_BOOLEAN FNC_VALUES 1 UBYTE COLUMN_DIR DIRECT /end RECORD_LAYOUT
/begin RECORD_LAYOUT Record_FLOAT32_IEEE FNC_VALUES 1 FLOAT32_IEEE COLUMN_DIR DIRECT /end RECORD_LAYOUT
/begin RECORD_LAYOUT Record_FLOAT64_IEEE FNC_VALUES 1 FLOAT64_IEEE COLUMN_DIR DIRECT /end RECORD_LAYOUT
/begin RECORD_LAYOUT Record_UBYTE FNC_VALUES 1 UBYTE COLUMN_DIR DIRECT /end RECORD_LAYOUT
/begin RECORD_LAYOUT Record_ULONG FNC_VALUES 1 ULONG COLUMN_DIR DIRECT /end RECORD_LAYOUT
/begin RECORD_LAYOUT Record_UWORD FNC_VALUES 1 UWORD COLUMN_DIR DIRECT /end RECORD_LAYOUT
/begin RECORD_LAYOUT Axis_FLOAT32_IEEE AXIS_PTS_X 1 FLOAT32_IEEE INDEX_INCR DIRECT /end RECORD_LAYOUT
/begin GROUP ZDrive_BSW_Cal_Cal.ZDrive_BSW_Cal_VehicleInfomationTable ""
 /begin REF_CHARACTERISTIC ZDrive_BSW_Cal_Cal.ZDrive_BSW_Cal_VehicleInfomationTable.RADAR_MOUNT_PARAM_FRONT_X_POSITION ZDrive_BSW_Cal_Cal.ZDrive_BSW_Cal_VehicleInfomationTable.RADAR_MOUNT_PARAM_FRONT_Y_POSITION ZDrive_BSW_Cal_Cal.ZDrive_BSW_Cal_VehicleInfomationTable.RADAR_MOUNT_PARAM_FRONT_YAW_ANGLE ZDrive_BSW_Cal_Cal.ZDrive_BSW_Cal_VehicleInfomationTable.RADAR_MOUNT_PARAM_FL_X_POSITION ZDrive_BSW_Cal_Cal.ZDrive_BSW_Cal_VehicleInfomationTable.RADAR_MOUNT_PARAM_FL_Y_POSITION ZDrive_BSW_Cal_Cal.ZDrive_BSW_Cal_VehicleInfomationTable.RADAR_MOUNT_PARAM_FL_YAW_ANGLE ZDrive_BSW_Cal_Cal.ZDrive_BSW_Cal_VehicleInfomationTable.RADAR_MOUNT_PARAM_FR_X_POSITION ZDrive_BSW_Cal_Cal.ZDrive_BSW_Cal_VehicleInfomationTable.RADAR_MOUNT_PARAM_FR_Y_POSITION ZDrive_BSW_Cal_Cal.ZDrive_BSW_Cal_VehicleInfomationTable.RADAR_MOUNT_PARAM_FR_YAW_ANGLE ZDrive_BSW_Cal_Cal.ZDrive_BSW_Cal_VehicleInfomationTable.RADAR_MOUNT_PARAM_RL_X_POSITION ZDrive_BSW_Cal_Cal.ZDrive_BSW_Cal_VehicleInfomationTable.RADAR_MOUNT_PARAM_RL_Y_POSITION ZDrive_BSW_Cal_Cal.ZDrive_BSW_Cal_VehicleInfomationTable.RADAR_MOUNT_PARAM_RL_YAW_ANGLE ZDrive_BSW_Cal_Cal.ZDrive_BSW_Cal_VehicleInfomationTable.RADAR_MOUNT_PARAM_RR_X_POSITION ZDrive_BSW_Cal_Cal.ZDrive_BSW_Cal_VehicleInfomationTable.RADAR_MOUNT_PARAM_RR_Y_POSITION ZDrive_BSW_Cal_Cal.ZDrive_BSW_Cal_VehicleInfomationTable.RADAR_MOUNT_PARAM_RR_YAW_ANGLE ZDrive_BSW_Cal_Cal.ZDrive_BSW_Cal_VehicleInfomationTable.Vehicle_Information_Reserved_Line277 ZDrive_BSW_Cal_Cal.ZDrive_BSW_Cal_VehicleInfomationTable.Vehicle_Information_Reserved_Line278 ZDrive_BSW_Cal_Cal.ZDrive_BSW_Cal_VehicleInfomationTable.Vehicle_Information_Reserved_Line279 ZDrive_BSW_Cal_Cal.ZDrive_BSW_Cal_VehicleInfomationTable.Vehicle_Information_Reserved_Line280 ZDrive_BSW_Cal_Cal.ZDrive_BSW_Cal_VehicleInfomationTable.Vehicle_Information_Reserved_Line281 ZDrive_BSW_Cal_Cal.ZDrive_BSW_Cal_VehicleInfomationTable.Vehicle_Information_Reserved_Line282 ZDrive_BSW_Cal_Cal.ZDrive_BSW_Cal_VehicleInfomationTable.Vehicle_Information_Reserved_Line283 ZDrive_BSW_Cal_Cal.ZDrive_BSW_Cal_VehicleInfomationTable.Vehicle_Information_Reserved_Line284 ZDrive_BSW_Cal_Cal.ZDrive_BSW_Cal_VehicleInfomationTable.Vehicle_Information_Reserved_Line285 ZDrive_BSW_Cal_Cal.ZDrive_BSW_Cal_VehicleInfomationTable.Vehicle_Information_Reserved_Line286 ZDrive_BSW_Cal_Cal.ZDrive_BSW_Cal_VehicleInfomationTable.Vehicle_Information_Reserved_Line287 ZDrive_BSW_Cal_Cal.ZDrive_BSW_Cal_VehicleInfomationTable.Vehicle_Information_Reserved_Line288 ZDrive_BSW_Cal_Cal.ZDrive_BSW_Cal_VehicleInfomationTable.Vehicle_Information_Reserved_Line289 ZDrive_BSW_Cal_Cal.ZDrive_BSW_Cal_VehicleInfomationTable.Vehicle_Information_Reserved_Line290 ZDrive_BSW_Cal_Cal.ZDrive_BSW_Cal_VehicleInfomationTable.Vehicle_Information_Reserved_Line291 ZDrive_BSW_Cal_Cal.ZDrive_BSW_Cal_VehicleInfomationTable.Vehicle_Information_Reserved_Line292 ZDrive_BSW_Cal_Cal.ZDrive_BSW_Cal_VehicleInfomationTable.Vehicle_Information_Reserved_Line293 ZDrive_BSW_Cal_Cal.ZDrive_BSW_Cal_VehicleInfomationTable.Vehicle_Information_Reserved_Line294 ZDrive_BSW_Cal_Cal.ZDrive_BSW_Cal_VehicleInfomationTable.Vehicle_Information_Reserved_Line295 ZDrive_BSW_Cal_Cal.ZDrive_BSW_Cal_VehicleInfomationTable.Vehicle_Information_Reserved_Line296 ZDrive_BSW_Cal_Cal.ZDrive_BSW_Cal_VehicleInfomationTable.Vehicle_Information_Reserved_Line297 ZDrive_BSW_Cal_Cal.ZDrive_BSW_Cal_VehicleInfomationTable.Vehicle_Information_Reserved_Line298 ZDrive_BSW_Cal_Cal.ZDrive_BSW_Cal_VehicleInfomationTable.Vehicle_Information_Reserved_Line299 ZDrive_BSW_Cal_Cal.ZDrive_BSW_Cal_VehicleInfomationTable.Vehicle_Information_Reserved_Line300 ZDrive_BSW_Cal_Cal.ZDrive_BSW_Cal_VehicleInfomationTable.Vehicle_Information_Reserved_Line301 ZDrive_BSW_Cal_Cal.ZDrive_BSW_Cal_VehicleInfomationTable.Vehicle_Information_Reserved_Line302 ZDrive_BSW_Cal_Cal.ZDrive_BSW_Cal_VehicleInfomationTable.Vehicle_Information_Reserved_Line303 ZDrive_BSW_Cal_Cal.ZDrive_BSW_Cal_VehicleInfomationTable.Vehicle_Information_Reserved_Line304 ZDrive_BSW_Cal_Cal.ZDrive_BSW_Cal_VehicleInfomationTable.Vehicle_Information_Reserved_Line305 ZDrive_BSW_Cal_Cal.ZDrive_BSW_Cal_VehicleInfomationTable.Vehicle_Information_Reserved_Line306 ZDrive_BSW_Cal_Cal.ZDrive_BSW_Cal_VehicleInfomationTable.Vehicle_Information_Reserved_Line307 ZDrive_BSW_Cal_Cal.ZDrive_BSW_Cal_VehicleInfomationTable.Vehicle_Information_Reserved_Line308 ZDrive_BSW_Cal_Cal.ZDrive_BSW_Cal_VehicleInfomationTable.Vehicle_Information_Reserved_Line309 ZDrive_BSW_Cal_Cal.ZDrive_BSW_Cal_VehicleInfomationTable.Vehicle_Information_Reserved_Line310 ZDrive_BSW_Cal_Cal.ZDrive_BSW_Cal_VehicleInfomationTable.Vehicle_Information_Reserved_Line311 ZDrive_BSW_Cal_Cal.ZDrive_BSW_Cal_VehicleInfomationTable.Vehicle_Information_Reserved_Line312 ZDrive_BSW_Cal_Cal.ZDrive_BSW_Cal_VehicleInfomationTable.Vehicle_Information_Reserved_Line313 ZDrive_BSW_Cal_Cal.ZDrive_BSW_Cal_VehicleInfomationTable.Vehicle_Information_Reserved_Line314 ZDrive_BSW_Cal_Cal.ZDrive_BSW_Cal_VehicleInfomationTable.Vehicle_Information_Reserved_Line315 ZDrive_BSW_Cal_Cal.ZDrive_BSW_Cal_VehicleInfomationTable.Vehicle_Information_Reserved_Line316 ZDrive_BSW_Cal_Cal.ZDrive_BSW_Cal_VehicleInfomationTable.Vehicle_Information_Reserved_Line317 ZDrive_BSW_Cal_Cal.ZDrive_BSW_Cal_VehicleInfomationTable.Vehicle_Information_Reserved_Line318 ZDrive_BSW_Cal_Cal.ZDrive_BSW_Cal_VehicleInfomationTable.Vehicle_Information_Reserved_Line319 ZDrive_BSW_Cal_Cal.ZDrive_BSW_Cal_VehicleInfomationTable.Vehicle_Information_Reserved_Line320 ZDrive_BSW_Cal_Cal.ZDrive_BSW_Cal_VehicleInfomationTable.Vehicle_Information_Reserved_Line321 ZDrive_BSW_Cal_Cal.ZDrive_BSW_Cal_VehicleInfomationTable.Vehicle_Information_Reserved_Line322 ZDrive_BSW_Cal_Cal.ZDrive_BSW_Cal_VehicleInfomationTable.Vehicle_Information_Reserved_Line323 ZDrive_BSW_Cal_Cal.ZDrive_BSW_Cal_VehicleInfomationTable.Vehicle_Information_Reserved_Line324 ZDrive_BSW_Cal_Cal.ZDrive_BSW_Cal_VehicleInfomationTable.Vehicle_Information_Reserved_Line325 ZDrive_BSW_Cal_Cal.ZDrive_BSW_Cal_VehicleInfomationTable.Vehicle_Information_Reserved_Line326 ZDrive_BSW_Cal_Cal.ZDrive_BSW_Cal_VehicleInfomationTable.Vehicle_Information_Reserved_Line327 ZDrive_BSW_Cal_Cal.ZDrive_BSW_Cal_VehicleInfomationTable.Vehicle_Information_Reserved_Line328 ZDrive_BSW_Cal_Cal.ZDrive_BSW_Cal_VehicleInfomationTable.Vehicle_Information_Reserved_Line329 ZDrive_BSW_Cal_Cal.ZDrive_BSW_Cal_VehicleInfomationTable.Vehicle_Information_Reserved_Line330 ZDrive_BSW_Cal_Cal.ZDrive_BSW_Cal_VehicleInfomationTable.Vehicle_Information_Reserved_Line331 ZDrive_BSW_Cal_Cal.ZDrive_BSW_Cal_VehicleInfomationTable.Vehicle_Information_Reserved_Line332 ZDrive_BSW_Cal_Cal.ZDrive_BSW_Cal_VehicleInfomationTable.Vehicle_Information_Reserved_Line333 ZDrive_BSW_Cal_Cal.ZDrive_BSW_Cal_VehicleInfomationTable.Vehicle_Information_Reserved_Line334 ZDrive_BSW_Cal_Cal.ZDrive_BSW_Cal_VehicleInfomationTable.Vehicle_Information_Reserved_Line335 ZDrive_BSW_Cal_Cal.ZDrive_BSW_Cal_VehicleInfomationTable.Vehicle_Information_Reserved_Line336 ZDrive_BSW_Cal_Cal.ZDrive_BSW_Cal_VehicleInfomationTable.Vehicle_Information_Reserved_Line337 ZDrive_BSW_Cal_Cal.ZDrive_BSW_Cal_VehicleInfomationTable.Vehicle_Information_Reserved_Line338 ZDrive_BSW_Cal_Cal.ZDrive_BSW_Cal_VehicleInfomationTable.Vehicle_Information_Reserved_Line339 ZDrive_BSW_Cal_Cal.ZDrive_BSW_Cal_VehicleInfomationTable.Vehicle_Information_Reserved_Line340 ZDrive_BSW_Cal_Cal.ZDrive_BSW_Cal_VehicleInfomationTable.Vehicle_Information_Reserved_Line341 ZDrive_BSW_Cal_Cal.ZDrive_BSW_Cal_VehicleInfomationTable.Vehicle_Information_Reserved_Line342 ZDrive_BSW_Cal_Cal.ZDrive_BSW_Cal_VehicleInfomationTable.Vehicle_Information_Reserved_Line343 ZDrive_BSW_Cal_Cal.ZDrive_BSW_Cal_VehicleInfomationTable.Vehicle_Information_Reserved_Line344 ZDrive_BSW_Cal_Cal.ZDrive_BSW_Cal_VehicleInfomationTable.Vehicle_Information_Reserved_Line345 ZDrive_BSW_Cal_Cal.ZDrive_BSW_Cal_VehicleInfomationTable.Vehicle_Information_Reserved_Line346 ZDrive_BSW_Cal_Cal.ZDrive_BSW_Cal_VehicleInfomationTable.Vehicle_Information_Reserved_Line347 ZDrive_BSW_Cal_Cal.ZDrive_BSW_Cal_VehicleInfomationTable.Vehicle_Information_Reserved_Line348 ZDrive_BSW_Cal_Cal.ZDrive_BSW_Cal_VehicleInfomationTable.Vehicle_Information_Reserved_Line349 ZDrive_BSW_Cal_Cal.ZDrive_BSW_Cal_VehicleInfomationTable.Vehicle_Information_Reserved_Line350 ZDrive_BSW_Cal_Cal.ZDrive_BSW_Cal_VehicleInfomationTable.Vehicle_Information_Reserved_Line351 ZDrive_BSW_Cal_Cal.ZDrive_BSW_Cal_VehicleInfomationTable.Vehicle_Information_Reserved_Line352 ZDrive_BSW_Cal_Cal.ZDrive_BSW_Cal_VehicleInfomationTable.Vehicle_Information_Reserved_Line353 ZDrive_BSW_Cal_Cal.ZDrive_BSW_Cal_VehicleInfomationTable.Vehicle_Information_Reserved_Line354 ZDrive_BSW_Cal_Cal.ZDrive_BSW_Cal_VehicleInfomationTable.Vehicle_Information_End_Tag /end REF_CHARACTERISTIC
/end GROUP
/begin RECORD_LAYOUT Record_BOOLEAN FNC_VALUES 1 UBYTE COLUMN_DIR DIRECT /end RECORD_LAYOUT
/begin RECORD_LAYOUT Record_FLOAT32_IEEE FNC_VALUES 1 FLOAT32_IEEE COLUMN_DIR DIRECT /end RECORD_LAYOUT
/begin RECORD_LAYOUT Record_FLOAT64_IEEE FNC_VALUES 1 FLOAT64_IEEE COLUMN_DIR DIRECT /end RECORD_LAYOUT
/begin RECORD_LAYOUT Record_UBYTE FNC_VALUES 1 UBYTE COLUMN_DIR DIRECT /end RECORD_LAYOUT
/begin RECORD_LAYOUT Record_ULONG FNC_VALUES 1 ULONG COLUMN_DIR DIRECT /end RECORD_LAYOUT
/begin RECORD_LAYOUT Record_UWORD FNC_VALUES 1 UWORD COLUMN_DIR DIRECT /end RECORD_LAYOUT
/begin RECORD_LAYOUT Axis_FLOAT32_IEEE AXIS_PTS_X 1 FLOAT32_IEEE INDEX_INCR DIRECT /end RECORD_LAYOUT
/begin GROUP ZDrive_BSW_Cal_Cal.ZDrive_BSW_Cal_VehicleInfomationTable ""
 /begin REF_CHARACTERISTIC ZDrive_BSW_Cal_Cal.ZDrive_BSW_Cal_VehicleInfomationTable.RADAR_MOUNT_PARAM_FRONT_X_POSITION ZDrive_BSW_Cal_Cal.ZDrive_BSW_Cal_VehicleInfomationTable.RADAR_MOUNT_PARAM_FRONT_Y_POSITION ZDrive_BSW_Cal_Cal.ZDrive_BSW_Cal_VehicleInfomationTable.RADAR_MOUNT_PARAM_FRONT_YAW_ANGLE ZDrive_BSW_Cal_Cal.ZDrive_BSW_Cal_VehicleInfomationTable.RADAR_MOUNT_PARAM_FL_X_POSITION ZDrive_BSW_Cal_Cal.ZDrive_BSW_Cal_VehicleInfomationTable.RADAR_MOUNT_PARAM_FL_Y_POSITION ZDrive_BSW_Cal_Cal.ZDrive_BSW_Cal_VehicleInfomationTable.RADAR_MOUNT_PARAM_FL_YAW_ANGLE ZDrive_BSW_Cal_Cal.ZDrive_BSW_Cal_VehicleInfomationTable.RADAR_MOUNT_PARAM_FR_X_POSITION ZDrive_BSW_Cal_Cal.ZDrive_BSW_Cal_VehicleInfomationTable.RADAR_MOUNT_PARAM_FR_Y_POSITION ZDrive_BSW_Cal_Cal.ZDrive_BSW_Cal_VehicleInfomationTable.RADAR_MOUNT_PARAM_FR_YAW_ANGLE ZDrive_BSW_Cal_Cal.ZDrive_BSW_Cal_VehicleInfomationTable.RADAR_MOUNT_PARAM_RL_X_POSITION ZDrive_BSW_Cal_Cal.ZDrive_BSW_Cal_VehicleInfomationTable.RADAR_MOUNT_PARAM_RL_Y_POSITION ZDrive_BSW_Cal_Cal.ZDrive_BSW_Cal_VehicleInfomationTable.RADAR_MOUNT_PARAM_RL_YAW_ANGLE ZDrive_BSW_Cal_Cal.ZDrive_BSW_Cal_VehicleInfomationTable.RADAR_MOUNT_PARAM_RR_X_POSITION ZDrive_BSW_Cal_Cal.ZDrive_BSW_Cal_VehicleInfomationTable.RADAR_MOUNT_PARAM_RR_Y_POSITION ZDrive_BSW_Cal_Cal.ZDrive_BSW_Cal_VehicleInfomationTable.RADAR_MOUNT_PARAM_RR_YAW_ANGLE ZDrive_BSW_Cal_Cal.ZDrive_BSW_Cal_VehicleInfomationTable.Vehicle_Information_Reserved_Line277 ZDrive_BSW_Cal_Cal.ZDrive_BSW_Cal_VehicleInfomationTable.Vehicle_Information_Reserved_Line278 ZDrive_BSW_Cal_Cal.ZDrive_BSW_Cal_VehicleInfomationTable.Vehicle_Information_Reserved_Line279 ZDrive_BSW_Cal_Cal.ZDrive_BSW_Cal_VehicleInfomationTable.Vehicle_Information_Reserved_Line280 ZDrive_BSW_Cal_Cal.ZDrive_BSW_Cal_VehicleInfomationTable.Vehicle_Information_Reserved_Line281 ZDrive_BSW_Cal_Cal.ZDrive_BSW_Cal_VehicleInfomationTable.Vehicle_Information_Reserved_Line282 ZDrive_BSW_Cal_Cal.ZDrive_BSW_Cal_VehicleInfomationTable.Vehicle_Information_Reserved_Line283 ZDrive_BSW_Cal_Cal.ZDrive_BSW_Cal_VehicleInfomationTable.Vehicle_Information_Reserved_Line284 ZDrive_BSW_Cal_Cal.ZDrive_BSW_Cal_VehicleInfomationTable.Vehicle_Information_Reserved_Line285 ZDrive_BSW_Cal_Cal.ZDrive_BSW_Cal_VehicleInfomationTable.Vehicle_Information_Reserved_Line286 ZDrive_BSW_Cal_Cal.ZDrive_BSW_Cal_VehicleInfomationTable.Vehicle_Information_Reserved_Line287 ZDrive_BSW_Cal_Cal.ZDrive_BSW_Cal_VehicleInfomationTable.Vehicle_Information_Reserved_Line288 ZDrive_BSW_Cal_Cal.ZDrive_BSW_Cal_VehicleInfomationTable.Vehicle_Information_Reserved_Line289 ZDrive_BSW_Cal_Cal.ZDrive_BSW_Cal_VehicleInfomationTable.Vehicle_Information_Reserved_Line290 ZDrive_BSW_Cal_Cal.ZDrive_BSW_Cal_VehicleInfomationTable.Vehicle_Information_Reserved_Line291 ZDrive_BSW_Cal_Cal.ZDrive_BSW_Cal_VehicleInfomationTable.Vehicle_Information_Reserved_Line292 ZDrive_BSW_Cal_Cal.ZDrive_BSW_Cal_VehicleInfomationTable.Vehicle_Information_Reserved_Line293 ZDrive_BSW_Cal_Cal.ZDrive_BSW_Cal_VehicleInfomationTable.Vehicle_Information_Reserved_Line294 ZDrive_BSW_Cal_Cal.ZDrive_BSW_Cal_VehicleInfomationTable.Vehicle_Information_Reserved_Line295 ZDrive_BSW_Cal_Cal.ZDrive_BSW_Cal_VehicleInfomationTable.Vehicle_Information_Reserved_Line296 ZDrive_BSW_Cal_Cal.ZDrive_BSW_Cal_VehicleInfomationTable.Vehicle_Information_Reserved_Line297 ZDrive_BSW_Cal_Cal.ZDrive_BSW_Cal_VehicleInfomationTable.Vehicle_Information_Reserved_Line298 ZDrive_BSW_Cal_Cal.ZDrive_BSW_Cal_VehicleInfomationTable.Vehicle_Information_Reserved_Line299 ZDrive_BSW_Cal_Cal.ZDrive_BSW_Cal_VehicleInfomationTable.Vehicle_Information_Reserved_Line300 ZDrive_BSW_Cal_Cal.ZDrive_BSW_Cal_VehicleInfomationTable.Vehicle_Information_Reserved_Line301 ZDrive_BSW_Cal_Cal.ZDrive_BSW_Cal_VehicleInfomationTable.Vehicle_Information_Reserved_Line302 ZDrive_BSW_Cal_Cal.ZDrive_BSW_Cal_VehicleInfomationTable.Vehicle_Information_Reserved_Line303 ZDrive_BSW_Cal_Cal.ZDrive_BSW_Cal_VehicleInfomationTable.Vehicle_Information_Reserved_Line304 ZDrive_BSW_Cal_Cal.ZDrive_BSW_Cal_VehicleInfomationTable.Vehicle_Information_Reserved_Line305 ZDrive_BSW_Cal_Cal.ZDrive_BSW_Cal_VehicleInfomationTable.Vehicle_Information_Reserved_Line306 ZDrive_BSW_Cal_Cal.ZDrive_BSW_Cal_VehicleInfomationTable.Vehicle_Information_Reserved_Line307 ZDrive_BSW_Cal_Cal.ZDrive_BSW_Cal_VehicleInfomationTable.Vehicle_Information_Reserved_Line308 ZDrive_BSW_Cal_Cal.ZDrive_BSW_Cal_VehicleInfomationTable.Vehicle_Information_Reserved_Line309 ZDrive_BSW_Cal_Cal.ZDrive_BSW_Cal_VehicleInfomationTable.Vehicle_Information_Reserved_Line310 ZDrive_BSW_Cal_Cal.ZDrive_BSW_Cal_VehicleInfomationTable.Vehicle_Information_Reserved_Line311 ZDrive_BSW_Cal_Cal.ZDrive_BSW_Cal_VehicleInfomationTable.Vehicle_Information_Reserved_Line312 ZDrive_BSW_Cal_Cal.ZDrive_BSW_Cal_VehicleInfomationTable.Vehicle_Information_Reserved_Line313 ZDrive_BSW_Cal_Cal.ZDrive_BSW_Cal_VehicleInfomationTable.Vehicle_Information_Reserved_Line314 ZDrive_BSW_Cal_Cal.ZDrive_BSW_Cal_VehicleInfomationTable.Vehicle_Information_Reserved_Line315 ZDrive_BSW_Cal_Cal.ZDrive_BSW_Cal_VehicleInfomationTable.Vehicle_Information_Reserved_Line316 ZDrive_BSW_Cal_Cal.ZDrive_BSW_Cal_VehicleInfomationTable.Vehicle_Information_Reserved_Line317 ZDrive_BSW_Cal_Cal.ZDrive_BSW_Cal_VehicleInfomationTable.Vehicle_Information_Reserved_Line318 ZDrive_BSW_Cal_Cal.ZDrive_BSW_Cal_VehicleInfomationTable.Vehicle_Information_Reserved_Line319 ZDrive_BSW_Cal_Cal.ZDrive_BSW_Cal_VehicleInfomationTable.Vehicle_Information_Reserved_Line320 ZDrive_BSW_Cal_Cal.ZDrive_BSW_Cal_VehicleInfomationTable.Vehicle_Information_Reserved_Line321 ZDrive_BSW_Cal_Cal.ZDrive_BSW_Cal_VehicleInfomationTable.Vehicle_Information_Reserved_Line322 ZDrive_BSW_Cal_Cal.ZDrive_BSW_Cal_VehicleInfomationTable.Vehicle_Information_Reserved_Line323 ZDrive_BSW_Cal_Cal.ZDrive_BSW_Cal_VehicleInfomationTable.Vehicle_Information_Reserved_Line324 ZDrive_BSW_Cal_Cal.ZDrive_BSW_Cal_VehicleInfomationTable.Vehicle_Information_Reserved_Line325 ZDrive_BSW_Cal_Cal.ZDrive_BSW_Cal_VehicleInfomationTable.Vehicle_Information_Reserved_Line326 ZDrive_BSW_Cal_Cal.ZDrive_BSW_Cal_VehicleInfomationTable.Vehicle_Information_Reserved_Line327 ZDrive_BSW_Cal_Cal.ZDrive_BSW_Cal_VehicleInfomationTable.Vehicle_Information_Reserved_Line328 ZDrive_BSW_Cal_Cal.ZDrive_BSW_Cal_VehicleInfomationTable.Vehicle_Information_Reserved_Line329 ZDrive_BSW_Cal_Cal.ZDrive_BSW_Cal_VehicleInfomationTable.Vehicle_Information_Reserved_Line330 ZDrive_BSW_Cal_Cal.ZDrive_BSW_Cal_VehicleInfomationTable.Vehicle_Information_Reserved_Line331 ZDrive_BSW_Cal_Cal.ZDrive_BSW_Cal_VehicleInfomationTable.Vehicle_Information_Reserved_Line332 ZDrive_BSW_Cal_Cal.ZDrive_BSW_Cal_VehicleInfomationTable.Vehicle_Information_Reserved_Line333 ZDrive_BSW_Cal_Cal.ZDrive_BSW_Cal_VehicleInfomationTable.Vehicle_Information_Reserved_Line334 ZDrive_BSW_Cal_Cal.ZDrive_BSW_Cal_VehicleInfomationTable.Vehicle_Information_Reserved_Line335 ZDrive_BSW_Cal_Cal.ZDrive_BSW_Cal_VehicleInfomationTable.Vehicle_Information_Reserved_Line336 ZDrive_BSW_Cal_Cal.ZDrive_BSW_Cal_VehicleInfomationTable.Vehicle_Information_Reserved_Line337 ZDrive_BSW_Cal_Cal.ZDrive_BSW_Cal_VehicleInfomationTable.Vehicle_Information_Reserved_Line338 ZDrive_BSW_Cal_Cal.ZDrive_BSW_Cal_VehicleInfomationTable.Vehicle_Information_Reserved_Line339 ZDrive_BSW_Cal_Cal.ZDrive_BSW_Cal_VehicleInfomationTable.Vehicle_Information_Reserved_Line340 ZDrive_BSW_Cal_Cal.ZDrive_BSW_Cal_VehicleInfomationTable.Vehicle_Information_Reserved_Line341 ZDrive_BSW_Cal_Cal.ZDrive_BSW_Cal_VehicleInfomationTable.Vehicle_Information_Reserved_Line342 ZDrive_BSW_Cal_Cal.ZDrive_BSW_Cal_VehicleInfomationTable.Vehicle_Information_Reserved_Line343 ZDrive_BSW_Cal_Cal.ZDrive_BSW_Cal_VehicleInfomationTable.Vehicle_Information_Reserved_Line344 ZDrive_BSW_Cal_Cal.ZDrive_BSW_Cal_VehicleInfomationTable.Vehicle_Information_Reserved_Line345 ZDrive_BSW_Cal_Cal.ZDrive_BSW_Cal_VehicleInfomationTable.Vehicle_Information_Reserved_Line346 ZDrive_BSW_Cal_Cal.ZDrive_BSW_Cal_VehicleInfomationTable.Vehicle_Information_Reserved_Line347 ZDrive_BSW_Cal_Cal.ZDrive_BSW_Cal_VehicleInfomationTable.Vehicle_Information_Reserved_Line348 ZDrive_BSW_Cal_Cal.ZDrive_BSW_Cal_VehicleInfomationTable.Vehicle_Information_Reserved_Line349 ZDrive_BSW_Cal_Cal.ZDrive_BSW_Cal_VehicleInfomationTable.Vehicle_Information_Reserved_Line350 ZDrive_BSW_Cal_Cal.ZDrive_BSW_Cal_VehicleInfomationTable.Vehicle_Information_Reserved_Line351 ZDrive_BSW_Cal_Cal.ZDrive_BSW_Cal_VehicleInfomationTable.Vehicle_Information_Reserved_Line352 ZDrive_BSW_Cal_Cal.ZDrive_BSW_Cal_VehicleInfomationTable.Vehicle_Information_Reserved_Line353 ZDrive_BSW_Cal_Cal.ZDrive_BSW_Cal_VehicleInfomationTable.Vehicle_Information_Reserved_Line354 ZDrive_BSW_Cal_Cal.ZDrive_BSW_Cal_VehicleInfomationTable.Vehicle_Information_End_Tag /end REF_CHARACTERISTIC
/end GROUP
/end MODULE
/end PROJECT
