ASAP2_VERSION 1 71
/begin PROJECT ProjectName ""
/begin MODULE ModuleName ""
/begin MOD_COMMON "" BYTE_ORDER MSB_LAST ALIGNMENT_BYTE 1 ALIGNMENT_WORD 1 ALIGNMENT_LONG 1 ALIGNMENT_INT64 1 ALIGNMENT_FLOAT16_IEEE 1 ALIGNMENT_FLOAT32_IEEE 1 ALIGNMENT_FLOAT64_IEEE 1 /end MOD_COMMON
/begin RECORD_LAYOUT __UWORD_S FNC_VALUES 1 UWORD COLUMN_DIR DIRECT /end RECORD_LAYOUT
/begin MEASUREMENT autosar_swc_aeb_rtARID_DEF.ObjData_i[12].LongPredTime.A "" FLOAT32_IEEE autosar_swc_aeb_CM_single 0 0 -3.4E+38 3.4E+38 ECU_ADDRESS 0xfe4a5784 /* @ECU_Address@autosar_swc_aeb_rtARID_DEF.ObjData_i[12].LongPredTime.A@ */ /end MEASUREMENT
/begin MEASUREMENT autosar_swc_aeb_rtARID_DEF.ObjData_i[12].LongPredTime.ALat "" FLOAT32_IEEE autosar_swc_aeb_CM_single 0 0 -3.4E+38 3.4E+38 ECU_ADDRESS 0xfe4a5780 /* @ECU_Address@autosar_swc_aeb_rtARID_DEF.ObjData_i[12].LongPredTime.ALat@ */ /end MEASUREMENT
/begin MEASUREMENT autosar_swc_aeb_rtARID_DEF.ObjData_i[12].LongPredTime.ALgt "" FLOAT32_IEEE autosar_swc_aeb_CM_single 0 0 -3.4E+38 3.4E+38 ECU_ADDRESS 0xfe4a577c /* @ECU_Address@autosar_swc_aeb_rtARID_DEF.ObjData_i[12].LongPredTime.ALgt@ */ /end MEASUREMENT
/begin MEASUREMENT autosar_swc_aeb_rtARID_DEF.ObjData_i[12].LongPredTime.Crvt "" FLOAT32_IEEE autosar_swc_aeb_CM_single 0 0 -3.4E+38 3.4E+38 ECU_ADDRESS 0xfe4a5788 /* @ECU_Address@autosar_swc_aeb_rtARID_DEF.ObjData_i[12].LongPredTime.Crvt@ */ /end MEASUREMENT
/begin MEASUREMENT autosar_swc_aeb_rtARID_DEF.ObjData_i[12].LongPredTime.InPath "" UBYTE autosar_swc_aeb_CM_logical 0 0 0 1 ECU_ADDRESS 0xfe4a5779 /* @ECU_Address@autosar_swc_aeb_rtARID_DEF.ObjData_i[12].LongPredTime.InPath@ */ /end MEASUREMENT
/begin MEASUREMENT autosar_swc_aeb_rtARID_DEF.ObjData_i[12].LongPredTime.ObjOnCmngAndBrkg "" UBYTE autosar_swc_aeb_CM_logical 0 0 0 1 ECU_ADDRESS 0xfe4a577a /* @ECU_Address@autosar_swc_aeb_rtARID_DEF.ObjData_i[12].LongPredTime.ObjOnCmngAndBrkg@ */ /end MEASUREMENT
/begin MEASUREMENT autosar_swc_aeb_rtARID_DEF.ObjData_i[12].LongPredTime.TTMSelected "" UBYTE autosar_swc_aeb_CM_logical 0 0 0 1 ECU_ADDRESS 0xfe4a5778 /* @ECU_Address@autosar_swc_aeb_rtARID_DEF.ObjData_i[12].LongPredTime.TTMSelected@ */ /end MEASUREMENT
/begin MEASUREMENT autosar_swc_aeb_rtARID_DEF.ObjData_i[12].LongPredTime.TimeToMiddleLgt "" FLOAT32_IEEE autosar_swc_aeb_CM_single 0 0 -3.4E+38 3.4E+38 ECU_ADDRESS 0xfe4a5770 /* @ECU_Address@autosar_swc_aeb_rtARID_DEF.ObjData_i[12].LongPredTime.TimeToMiddleLgt@ */ /end MEASUREMENT
/begin MEASUREMENT autosar_swc_aeb_rtARID_DEF.ObjData_i[12].LongPredTime.TimeToPassLgt "" FLOAT32_IEEE autosar_swc_aeb_CM_single 0 0 -3.4E+38 3.4E+38 ECU_ADDRESS 0xfe4a5774 /* @ECU_Address@autosar_swc_aeb_rtARID_DEF.ObjData_i[12].LongPredTime.TimeToPassLgt@ */ /end MEASUREMENT
/begin MEASUREMENT autosar_swc_aeb_rtARID_DEF.ObjData_i[12].LongPredTime.TimeToReachLgt "" FLOAT32_IEEE autosar_swc_aeb_CM_single 0 0 -3.4E+38 3.4E+38 ECU_ADDRESS 0xfe4a576c /* @ECU_Address@autosar_swc_aeb_rtARID_DEF.ObjData_i[12].LongPredTime.TimeToReachLgt@ */ /end MEASUREMENT
/begin MEASUREMENT autosar_swc_aeb_rtARID_DEF.ObjData_i[12].MotionType.AbsHeading "" FLOAT32_IEEE autosar_swc_aeb_CM_single 0 0 -3.4E+38 3.4E+38 ECU_ADDRESS 0xfe4a5728 /* @ECU_Address@autosar_swc_aeb_rtARID_DEF.ObjData_i[12].MotionType.AbsHeading@ */ /end MEASUREMENT
/begin MEASUREMENT autosar_swc_aeb_rtARID_DEF.ObjData_i[12].MotionType.CurvedMotion "" UBYTE autosar_swc_aeb_CM_logical 0 0 0 1 ECU_ADDRESS 0xfe4a5726 /* @ECU_Address@autosar_swc_aeb_rtARID_DEF.ObjData_i[12].MotionType.CurvedMotion@ */ /end MEASUREMENT
/begin MEASUREMENT autosar_swc_aeb_rtARID_DEF.ObjData_i[12].MotionType.MovingOncoming "" UBYTE autosar_swc_aeb_CM_logical 0 0 0 1 ECU_ADDRESS 0xfe4a5721 /* @ECU_Address@autosar_swc_aeb_rtARID_DEF.ObjData_i[12].MotionType.MovingOncoming@ */ /end MEASUREMENT
/begin MEASUREMENT autosar_swc_aeb_rtARID_DEF.ObjData_i[12].MotionType.ObjectIsMotorVehicle "Object type is Car, Truck, Motorcycle or Vehicle Of Unkown Class." UBYTE autosar_swc_aeb_CM_logical 0 0 0 1 ECU_ADDRESS 0xfe4a5725 /* @ECU_Address@autosar_swc_aeb_rtARID_DEF.ObjData_i[12].MotionType.ObjectIsMotorVehicle@ */ /end MEASUREMENT
/begin MEASUREMENT autosar_swc_aeb_rtARID_DEF.ObjData_i[12].MotionType.ObjectIsVehicle "" UBYTE autosar_swc_aeb_CM_logical 0 0 0 1 ECU_ADDRESS 0xfe4a5724 /* @ECU_Address@autosar_swc_aeb_rtARID_DEF.ObjData_i[12].MotionType.ObjectIsVehicle@ */ /end MEASUREMENT
/begin MEASUREMENT autosar_swc_aeb_rtARID_DEF.ObjData_i[12].MotionType.ParallellVehicleLongPred "" UBYTE autosar_swc_aeb_CM_logical 0 0 0 1 ECU_ADDRESS 0xfe4a5722 /* @ECU_Address@autosar_swc_aeb_rtARID_DEF.ObjData_i[12].MotionType.ParallellVehicleLongPred@ */ /end MEASUREMENT
/begin MEASUREMENT autosar_swc_aeb_rtARID_DEF.ObjData_i[12].MotionType.ParallellVehicleShortPred "" UBYTE autosar_swc_aeb_CM_logical 0 0 0 1 ECU_ADDRESS 0xfe4a5723 /* @ECU_Address@autosar_swc_aeb_rtARID_DEF.ObjData_i[12].MotionType.ParallellVehicleShortPred@ */ /end MEASUREMENT
/begin MEASUREMENT autosar_swc_aeb_rtARID_DEF.ObjData_i[12].MotionType.SideIsClosest "" UBYTE autosar_swc_aeb_CM_logical 0 0 0 1 ECU_ADDRESS 0xfe4a5727 /* @ECU_Address@autosar_swc_aeb_rtARID_DEF.ObjData_i[12].MotionType.SideIsClosest@ */ /end MEASUREMENT
/begin MEASUREMENT autosar_swc_aeb_rtARID_DEF.ObjData_i[12].MotionType.Stationary "" UBYTE autosar_swc_aeb_CM_logical 0 0 0 1 ECU_ADDRESS 0xfe4a5720 /* @ECU_Address@autosar_swc_aeb_rtARID_DEF.ObjData_i[12].MotionType.Stationary@ */ /end MEASUREMENT
/begin MEASUREMENT autosar_swc_aeb_rtARID_DEF.ObjData_i[12].Offsets.OffsLatInPathCloseEdge "" FLOAT32_IEEE autosar_swc_aeb_CM_single 0 0 -3.4E+38 3.4E+38 ECU_ADDRESS 0xfe4a575c /* @ECU_Address@autosar_swc_aeb_rtARID_DEF.ObjData_i[12].Offsets.OffsLatInPathCloseEdge@ */ /end MEASUREMENT
/begin MEASUREMENT autosar_swc_aeb_rtARID_DEF.ObjData_i[12].Offsets.OffsLatInPathFarEdge "" FLOAT32_IEEE autosar_swc_aeb_CM_single 0 0 -3.4E+38 3.4E+38 ECU_ADDRESS 0xfe4a5760 /* @ECU_Address@autosar_swc_aeb_rtARID_DEF.ObjData_i[12].Offsets.OffsLatInPathFarEdge@ */ /end MEASUREMENT
/begin MEASUREMENT autosar_swc_aeb_rtARID_DEF.ObjData_i[12].Offsets.OffsLatInPathPrimaryTarget "" FLOAT32_IEEE autosar_swc_aeb_CM_single 0 0 -3.4E+38 3.4E+38 ECU_ADDRESS 0xfe4a5758 /* @ECU_Address@autosar_swc_aeb_rtARID_DEF.ObjData_i[12].Offsets.OffsLatInPathPrimaryTarget@ */ /end MEASUREMENT
/begin MEASUREMENT autosar_swc_aeb_rtARID_DEF.ObjData_i[12].Offsets.OffsLatIntersection "" FLOAT32_IEEE autosar_swc_aeb_CM_single 0 0 -3.4E+38 3.4E+38 ECU_ADDRESS 0xfe4a5764 /* @ECU_Address@autosar_swc_aeb_rtARID_DEF.ObjData_i[12].Offsets.OffsLatIntersection@ */ /end MEASUREMENT
/begin MEASUREMENT autosar_swc_aeb_rtARID_DEF.ObjData_i[12].Offsets.OffsLatLongPred "" FLOAT32_IEEE autosar_swc_aeb_CM_single 0 0 -3.4E+38 3.4E+38 ECU_ADDRESS 0xfe4a5748 /* @ECU_Address@autosar_swc_aeb_rtARID_DEF.ObjData_i[12].Offsets.OffsLatLongPred@ */ /end MEASUREMENT
/begin MEASUREMENT autosar_swc_aeb_rtARID_DEF.ObjData_i[12].Offsets.OffsLatManoeuvre "" FLOAT32_IEEE autosar_swc_aeb_CM_single 0 0 -3.4E+38 3.4E+38 ECU_ADDRESS 0xfe4a5754 /* @ECU_Address@autosar_swc_aeb_rtARID_DEF.ObjData_i[12].Offsets.OffsLatManoeuvre@ */ /end MEASUREMENT
/begin MEASUREMENT autosar_swc_aeb_rtARID_DEF.ObjData_i[12].Offsets.OffsLatMplTar "" FLOAT32_IEEE autosar_swc_aeb_CM_single 0 0 -3.4E+38 3.4E+38 ECU_ADDRESS 0xfe4a5768 /* @ECU_Address@autosar_swc_aeb_rtARID_DEF.ObjData_i[12].Offsets.OffsLatMplTar@ */ /end MEASUREMENT
/begin MEASUREMENT autosar_swc_aeb_rtARID_DEF.ObjData_i[12].Offsets.OffsLatShortPred "" FLOAT32_IEEE autosar_swc_aeb_CM_single 0 0 -3.4E+38 3.4E+38 ECU_ADDRESS 0xfe4a5750 /* @ECU_Address@autosar_swc_aeb_rtARID_DEF.ObjData_i[12].Offsets.OffsLatShortPred@ */ /end MEASUREMENT
/begin MEASUREMENT autosar_swc_aeb_rtARID_DEF.ObjData_i[12].Offsets.OffsLgtLongPred "" FLOAT32_IEEE autosar_swc_aeb_CM_single 0 0 -3.4E+38 3.4E+38 ECU_ADDRESS 0xfe4a5744 /* @ECU_Address@autosar_swc_aeb_rtARID_DEF.ObjData_i[12].Offsets.OffsLgtLongPred@ */ /end MEASUREMENT
/begin MEASUREMENT autosar_swc_aeb_rtARID_DEF.ObjData_i[12].Offsets.OffsLgtShortPred "" FLOAT32_IEEE autosar_swc_aeb_CM_single 0 0 -3.4E+38 3.4E+38 ECU_ADDRESS 0xfe4a574c /* @ECU_Address@autosar_swc_aeb_rtARID_DEF.ObjData_i[12].Offsets.OffsLgtShortPred@ */ /end MEASUREMENT
/begin MEASUREMENT autosar_swc_aeb_rtARID_DEF.ObjData_i[12].ShortPredTime.A "" FLOAT32_IEEE autosar_swc_aeb_CM_single 0 0 -3.4E+38 3.4E+38 ECU_ADDRESS 0xfe4a57a4 /* @ECU_Address@autosar_swc_aeb_rtARID_DEF.ObjData_i[12].ShortPredTime.A@ */ /end MEASUREMENT
/begin MEASUREMENT autosar_swc_aeb_rtARID_DEF.ObjData_i[12].ShortPredTime.ALat "" FLOAT32_IEEE autosar_swc_aeb_CM_single 0 0 -3.4E+38 3.4E+38 ECU_ADDRESS 0xfe4a57a0 /* @ECU_Address@autosar_swc_aeb_rtARID_DEF.ObjData_i[12].ShortPredTime.ALat@ */ /end MEASUREMENT
/begin MEASUREMENT autosar_swc_aeb_rtARID_DEF.ObjData_i[12].ShortPredTime.ALgt "" FLOAT32_IEEE autosar_swc_aeb_CM_single 0 0 -3.4E+38 3.4E+38 ECU_ADDRESS 0xfe4a579c /* @ECU_Address@autosar_swc_aeb_rtARID_DEF.ObjData_i[12].ShortPredTime.ALgt@ */ /end MEASUREMENT
/begin MEASUREMENT autosar_swc_aeb_rtARID_DEF.ObjData_i[12].ShortPredTime.Crvt "" FLOAT32_IEEE autosar_swc_aeb_CM_single 0 0 -3.4E+38 3.4E+38 ECU_ADDRESS 0xfe4a57a8 /* @ECU_Address@autosar_swc_aeb_rtARID_DEF.ObjData_i[12].ShortPredTime.Crvt@ */ /end MEASUREMENT
/begin MEASUREMENT autosar_swc_aeb_rtARID_DEF.ObjData_i[12].ShortPredTime.InPath "" UBYTE autosar_swc_aeb_CM_logical 0 0 0 1 ECU_ADDRESS 0xfe4a5799 /* @ECU_Address@autosar_swc_aeb_rtARID_DEF.ObjData_i[12].ShortPredTime.InPath@ */ /end MEASUREMENT
/begin MEASUREMENT autosar_swc_aeb_rtARID_DEF.ObjData_i[12].ShortPredTime.ObjOnCmngAndBrkg "" UBYTE autosar_swc_aeb_CM_logical 0 0 0 1 ECU_ADDRESS 0xfe4a579a /* @ECU_Address@autosar_swc_aeb_rtARID_DEF.ObjData_i[12].ShortPredTime.ObjOnCmngAndBrkg@ */ /end MEASUREMENT
/begin MEASUREMENT autosar_swc_aeb_rtARID_DEF.ObjData_i[12].ShortPredTime.TTMSelected "" UBYTE autosar_swc_aeb_CM_logical 0 0 0 1 ECU_ADDRESS 0xfe4a5798 /* @ECU_Address@autosar_swc_aeb_rtARID_DEF.ObjData_i[12].ShortPredTime.TTMSelected@ */ /end MEASUREMENT
/begin MEASUREMENT autosar_swc_aeb_rtARID_DEF.ObjData_i[12].ShortPredTime.TimeToMiddleLgt "" FLOAT32_IEEE autosar_swc_aeb_CM_single 0 0 -3.4E+38 3.4E+38 ECU_ADDRESS 0xfe4a5790 /* @ECU_Address@autosar_swc_aeb_rtARID_DEF.ObjData_i[12].ShortPredTime.TimeToMiddleLgt@ */ /end MEASUREMENT
/begin MEASUREMENT autosar_swc_aeb_rtARID_DEF.ObjData_i[12].ShortPredTime.TimeToPassLgt "" FLOAT32_IEEE autosar_swc_aeb_CM_single 0 0 -3.4E+38 3.4E+38 ECU_ADDRESS 0xfe4a5794 /* @ECU_Address@autosar_swc_aeb_rtARID_DEF.ObjData_i[12].ShortPredTime.TimeToPassLgt@ */ /end MEASUREMENT
/begin MEASUREMENT autosar_swc_aeb_rtARID_DEF.ObjData_i[12].ShortPredTime.TimeToReachLgt "" FLOAT32_IEEE autosar_swc_aeb_CM_single 0 0 -3.4E+38 3.4E+38 ECU_ADDRESS 0xfe4a578c /* @ECU_Address@autosar_swc_aeb_rtARID_DEF.ObjData_i[12].ShortPredTime.TimeToReachLgt@ */ /end MEASUREMENT
/begin MEASUREMENT autosar_swc_aeb_rtARID_DEF.ObjData_i[13].BoundingBox.CosRotation "" FLOAT32_IEEE autosar_swc_aeb_CM_single 0 0 -3.4E+38 3.4E+38 ECU_ADDRESS 0xfe4a57c8 /* @ECU_Address@autosar_swc_aeb_rtARID_DEF.ObjData_i[13].BoundingBox.CosRotation@ */ /end MEASUREMENT
/begin MEASUREMENT autosar_swc_aeb_rtARID_DEF.ObjData_i[13].BoundingBox.LengthSideLat "" FLOAT32_IEEE autosar_swc_aeb_CM_single 0 0 -3.4E+38 3.4E+38 ECU_ADDRESS 0xfe4a57bc /* @ECU_Address@autosar_swc_aeb_rtARID_DEF.ObjData_i[13].BoundingBox.LengthSideLat@ */ /end MEASUREMENT
/begin MEASUREMENT autosar_swc_aeb_rtARID_DEF.ObjData_i[13].BoundingBox.LengthSideLgt "" FLOAT32_IEEE autosar_swc_aeb_CM_single 0 0 -3.4E+38 3.4E+38 ECU_ADDRESS 0xfe4a57c0 /* @ECU_Address@autosar_swc_aeb_rtARID_DEF.ObjData_i[13].BoundingBox.LengthSideLgt@ */ /end MEASUREMENT
/begin MEASUREMENT autosar_swc_aeb_rtARID_DEF.ObjData_i[13].BoundingBox.RotationAngle "" FLOAT32_IEEE autosar_swc_aeb_CM_single 0 0 -3.4E+38 3.4E+38 ECU_ADDRESS 0xfe4a57cc /* @ECU_Address@autosar_swc_aeb_rtARID_DEF.ObjData_i[13].BoundingBox.RotationAngle@ */ /end MEASUREMENT
/begin MEASUREMENT autosar_swc_aeb_rtARID_DEF.ObjData_i[13].BoundingBox.SinRotation "" FLOAT32_IEEE autosar_swc_aeb_CM_single 0 0 -3.4E+38 3.4E+38 ECU_ADDRESS 0xfe4a57c4 /* @ECU_Address@autosar_swc_aeb_rtARID_DEF.ObjData_i[13].BoundingBox.SinRotation@ */ /end MEASUREMENT
/begin MEASUREMENT autosar_swc_aeb_rtARID_DEF.ObjData_i[13].Idn "" ULONG autosar_swc_aeb_CM_uint32 0 0 0 4294967295 ECU_ADDRESS 0xfe4a583c /* @ECU_Address@autosar_swc_aeb_rtARID_DEF.ObjData_i[13].Idn@ */ /end MEASUREMENT
/begin MEASUREMENT autosar_swc_aeb_rtARID_DEF.ObjData_i[13].InPathAtCurrentPosition "" UBYTE autosar_swc_aeb_CM_logical 0 0 0 1 ECU_ADDRESS 0xfe4a57d0 /* @ECU_Address@autosar_swc_aeb_rtARID_DEF.ObjData_i[13].InPathAtCurrentPosition@ */ /end MEASUREMENT
/begin MEASUREMENT autosar_swc_aeb_rtARID_DEF.ObjData_i[13].LongPredTime.A "" FLOAT32_IEEE autosar_swc_aeb_CM_single 0 0 -3.4E+38 3.4E+38 ECU_ADDRESS 0xfe4a5814 /* @ECU_Address@autosar_swc_aeb_rtARID_DEF.ObjData_i[13].LongPredTime.A@ */ /end MEASUREMENT
/begin MEASUREMENT autosar_swc_aeb_rtARID_DEF.ObjData_i[13].LongPredTime.ALat "" FLOAT32_IEEE autosar_swc_aeb_CM_single 0 0 -3.4E+38 3.4E+38 ECU_ADDRESS 0xfe4a5810 /* @ECU_Address@autosar_swc_aeb_rtARID_DEF.ObjData_i[13].LongPredTime.ALat@ */ /end MEASUREMENT
/begin MEASUREMENT autosar_swc_aeb_rtARID_DEF.ObjData_i[13].LongPredTime.ALgt "" FLOAT32_IEEE autosar_swc_aeb_CM_single 0 0 -3.4E+38 3.4E+38 ECU_ADDRESS 0xfe4a580c /* @ECU_Address@autosar_swc_aeb_rtARID_DEF.ObjData_i[13].LongPredTime.ALgt@ */ /end MEASUREMENT
/begin MEASUREMENT autosar_swc_aeb_rtARID_DEF.ObjData_i[13].LongPredTime.Crvt "" FLOAT32_IEEE autosar_swc_aeb_CM_single 0 0 -3.4E+38 3.4E+38 ECU_ADDRESS 0xfe4a5818 /* @ECU_Address@autosar_swc_aeb_rtARID_DEF.ObjData_i[13].LongPredTime.Crvt@ */ /end MEASUREMENT
/begin MEASUREMENT autosar_swc_aeb_rtARID_DEF.ObjData_i[13].LongPredTime.InPath "" UBYTE autosar_swc_aeb_CM_logical 0 0 0 1 ECU_ADDRESS 0xfe4a5809 /* @ECU_Address@autosar_swc_aeb_rtARID_DEF.ObjData_i[13].LongPredTime.InPath@ */ /end MEASUREMENT
/begin MEASUREMENT autosar_swc_aeb_rtARID_DEF.ObjData_i[13].LongPredTime.ObjOnCmngAndBrkg "" UBYTE autosar_swc_aeb_CM_logical 0 0 0 1 ECU_ADDRESS 0xfe4a580a /* @ECU_Address@autosar_swc_aeb_rtARID_DEF.ObjData_i[13].LongPredTime.ObjOnCmngAndBrkg@ */ /end MEASUREMENT
/begin MEASUREMENT autosar_swc_aeb_rtARID_DEF.ObjData_i[13].LongPredTime.TTMSelected "" UBYTE autosar_swc_aeb_CM_logical 0 0 0 1 ECU_ADDRESS 0xfe4a5808 /* @ECU_Address@autosar_swc_aeb_rtARID_DEF.ObjData_i[13].LongPredTime.TTMSelected@ */ /end MEASUREMENT
/begin MEASUREMENT autosar_swc_aeb_rtARID_DEF.ObjData_i[13].LongPredTime.TimeToMiddleLgt "" FLOAT32_IEEE autosar_swc_aeb_CM_single 0 0 -3.4E+38 3.4E+38 ECU_ADDRESS 0xfe4a5800 /* @ECU_Address@autosar_swc_aeb_rtARID_DEF.ObjData_i[13].LongPredTime.TimeToMiddleLgt@ */ /end MEASUREMENT
/begin MEASUREMENT autosar_swc_aeb_rtARID_DEF.ObjData_i[13].LongPredTime.TimeToPassLgt "" FLOAT32_IEEE autosar_swc_aeb_CM_single 0 0 -3.4E+38 3.4E+38 ECU_ADDRESS 0xfe4a5804 /* @ECU_Address@autosar_swc_aeb_rtARID_DEF.ObjData_i[13].LongPredTime.TimeToPassLgt@ */ /end MEASUREMENT
/begin MEASUREMENT autosar_swc_aeb_rtARID_DEF.ObjData_i[13].LongPredTime.TimeToReachLgt "" FLOAT32_IEEE autosar_swc_aeb_CM_single 0 0 -3.4E+38 3.4E+38 ECU_ADDRESS 0xfe4a57fc /* @ECU_Address@autosar_swc_aeb_rtARID_DEF.ObjData_i[13].LongPredTime.TimeToReachLgt@ */ /end MEASUREMENT
/begin MEASUREMENT autosar_swc_aeb_rtARID_DEF.ObjData_i[13].MotionType.AbsHeading "" FLOAT32_IEEE autosar_swc_aeb_CM_single 0 0 -3.4E+38 3.4E+38 ECU_ADDRESS 0xfe4a57b8 /* @ECU_Address@autosar_swc_aeb_rtARID_DEF.ObjData_i[13].MotionType.AbsHeading@ */ /end MEASUREMENT
/begin MEASUREMENT autosar_swc_aeb_rtARID_DEF.ObjData_i[13].MotionType.CurvedMotion "" UBYTE autosar_swc_aeb_CM_logical 0 0 0 1 ECU_ADDRESS 0xfe4a57b6 /* @ECU_Address@autosar_swc_aeb_rtARID_DEF.ObjData_i[13].MotionType.CurvedMotion@ */ /end MEASUREMENT
/begin MEASUREMENT autosar_swc_aeb_rtARID_DEF.ObjData_i[13].MotionType.MovingOncoming "" UBYTE autosar_swc_aeb_CM_logical 0 0 0 1 ECU_ADDRESS 0xfe4a57b1 /* @ECU_Address@autosar_swc_aeb_rtARID_DEF.ObjData_i[13].MotionType.MovingOncoming@ */ /end MEASUREMENT
/begin MEASUREMENT autosar_swc_aeb_rtARID_DEF.ObjData_i[13].MotionType.ObjectIsMotorVehicle "Object type is Car, Truck, Motorcycle or Vehicle Of Unkown Class." UBYTE autosar_swc_aeb_CM_logical 0 0 0 1 ECU_ADDRESS 0xfe4a57b5 /* @ECU_Address@autosar_swc_aeb_rtARID_DEF.ObjData_i[13].MotionType.ObjectIsMotorVehicle@ */ /end MEASUREMENT
/begin MEASUREMENT autosar_swc_aeb_rtARID_DEF.ObjData_i[13].MotionType.ObjectIsVehicle "" UBYTE autosar_swc_aeb_CM_logical 0 0 0 1 ECU_ADDRESS 0xfe4a57b4 /* @ECU_Address@autosar_swc_aeb_rtARID_DEF.ObjData_i[13].MotionType.ObjectIsVehicle@ */ /end MEASUREMENT
/begin MEASUREMENT autosar_swc_aeb_rtARID_DEF.ObjData_i[13].MotionType.ParallellVehicleLongPred "" UBYTE autosar_swc_aeb_CM_logical 0 0 0 1 ECU_ADDRESS 0xfe4a57b2 /* @ECU_Address@autosar_swc_aeb_rtARID_DEF.ObjData_i[13].MotionType.ParallellVehicleLongPred@ */ /end MEASUREMENT
/begin MEASUREMENT autosar_swc_aeb_rtARID_DEF.ObjData_i[13].MotionType.ParallellVehicleShortPred "" UBYTE autosar_swc_aeb_CM_logical 0 0 0 1 ECU_ADDRESS 0xfe4a57b3 /* @ECU_Address@autosar_swc_aeb_rtARID_DEF.ObjData_i[13].MotionType.ParallellVehicleShortPred@ */ /end MEASUREMENT
/begin MEASUREMENT autosar_swc_aeb_rtARID_DEF.ObjData_i[13].MotionType.SideIsClosest "" UBYTE autosar_swc_aeb_CM_logical 0 0 0 1 ECU_ADDRESS 0xfe4a57b7 /* @ECU_Address@autosar_swc_aeb_rtARID_DEF.ObjData_i[13].MotionType.SideIsClosest@ */ /end MEASUREMENT
/begin MEASUREMENT autosar_swc_aeb_rtARID_DEF.ObjData_i[13].MotionType.Stationary "" UBYTE autosar_swc_aeb_CM_logical 0 0 0 1 ECU_ADDRESS 0xfe4a57b0 /* @ECU_Address@autosar_swc_aeb_rtARID_DEF.ObjData_i[13].MotionType.Stationary@ */ /end MEASUREMENT
/begin MEASUREMENT autosar_swc_aeb_rtARID_DEF.ObjData_i[13].Offsets.OffsLatInPathCloseEdge "" FLOAT32_IEEE autosar_swc_aeb_CM_single 0 0 -3.4E+38 3.4E+38 ECU_ADDRESS 0xfe4a57ec /* @ECU_Address@autosar_swc_aeb_rtARID_DEF.ObjData_i[13].Offsets.OffsLatInPathCloseEdge@ */ /end MEASUREMENT
/begin MEASUREMENT autosar_swc_aeb_rtARID_DEF.ObjData_i[13].Offsets.OffsLatInPathFarEdge "" FLOAT32_IEEE autosar_swc_aeb_CM_single 0 0 -3.4E+38 3.4E+38 ECU_ADDRESS 0xfe4a57f0 /* @ECU_Address@autosar_swc_aeb_rtARID_DEF.ObjData_i[13].Offsets.OffsLatInPathFarEdge@ */ /end MEASUREMENT
/begin MEASUREMENT autosar_swc_aeb_rtARID_DEF.ObjData_i[13].Offsets.OffsLatInPathPrimaryTarget "" FLOAT32_IEEE autosar_swc_aeb_CM_single 0 0 -3.4E+38 3.4E+38 ECU_ADDRESS 0xfe4a57e8 /* @ECU_Address@autosar_swc_aeb_rtARID_DEF.ObjData_i[13].Offsets.OffsLatInPathPrimaryTarget@ */ /end MEASUREMENT
/begin MEASUREMENT autosar_swc_aeb_rtARID_DEF.ObjData_i[13].Offsets.OffsLatIntersection "" FLOAT32_IEEE autosar_swc_aeb_CM_single 0 0 -3.4E+38 3.4E+38 ECU_ADDRESS 0xfe4a57f4 /* @ECU_Address@autosar_swc_aeb_rtARID_DEF.ObjData_i[13].Offsets.OffsLatIntersection@ */ /end MEASUREMENT
/begin MEASUREMENT autosar_swc_aeb_rtARID_DEF.ObjData_i[13].Offsets.OffsLatLongPred "" FLOAT32_IEEE autosar_swc_aeb_CM_single 0 0 -3.4E+38 3.4E+38 ECU_ADDRESS 0xfe4a57d8 /* @ECU_Address@autosar_swc_aeb_rtARID_DEF.ObjData_i[13].Offsets.OffsLatLongPred@ */ /end MEASUREMENT
/begin MEASUREMENT autosar_swc_aeb_rtARID_DEF.ObjData_i[13].Offsets.OffsLatManoeuvre "" FLOAT32_IEEE autosar_swc_aeb_CM_single 0 0 -3.4E+38 3.4E+38 ECU_ADDRESS 0xfe4a57e4 /* @ECU_Address@autosar_swc_aeb_rtARID_DEF.ObjData_i[13].Offsets.OffsLatManoeuvre@ */ /end MEASUREMENT
/begin MEASUREMENT autosar_swc_aeb_rtARID_DEF.ObjData_i[13].Offsets.OffsLatMplTar "" FLOAT32_IEEE autosar_swc_aeb_CM_single 0 0 -3.4E+38 3.4E+38 ECU_ADDRESS 0xfe4a57f8 /* @ECU_Address@autosar_swc_aeb_rtARID_DEF.ObjData_i[13].Offsets.OffsLatMplTar@ */ /end MEASUREMENT
/begin MEASUREMENT autosar_swc_aeb_rtARID_DEF.ObjData_i[13].Offsets.OffsLatShortPred "" FLOAT32_IEEE autosar_swc_aeb_CM_single 0 0 -3.4E+38 3.4E+38 ECU_ADDRESS 0xfe4a57e0 /* @ECU_Address@autosar_swc_aeb_rtARID_DEF.ObjData_i[13].Offsets.OffsLatShortPred@ */ /end MEASUREMENT
/begin MEASUREMENT autosar_swc_aeb_rtARID_DEF.ObjData_i[13].Offsets.OffsLgtLongPred "" FLOAT32_IEEE autosar_swc_aeb_CM_single 0 0 -3.4E+38 3.4E+38 ECU_ADDRESS 0xfe4a57d4 /* @ECU_Address@autosar_swc_aeb_rtARID_DEF.ObjData_i[13].Offsets.OffsLgtLongPred@ */ /end MEASUREMENT
/begin MEASUREMENT autosar_swc_aeb_rtARID_DEF.ObjData_i[13].Offsets.OffsLgtShortPred "" FLOAT32_IEEE autosar_swc_aeb_CM_single 0 0 -3.4E+38 3.4E+38 ECU_ADDRESS 0xfe4a57dc /* @ECU_Address@autosar_swc_aeb_rtARID_DEF.ObjData_i[13].Offsets.OffsLgtShortPred@ */ /end MEASUREMENT
/begin MEASUREMENT autosar_swc_aeb_rtARID_DEF.ObjData_i[13].PredictionValid "" UBYTE autosar_swc_aeb_CM_logical 0 0 0 1 ECU_ADDRESS 0xfe4a57d1 /* @ECU_Address@autosar_swc_aeb_rtARID_DEF.ObjData_i[13].PredictionValid@ */ /end MEASUREMENT
/begin MEASUREMENT autosar_swc_aeb_rtARID_DEF.ObjData_i[13].ShortPredTime.A "" FLOAT32_IEEE autosar_swc_aeb_CM_single 0 0 -3.4E+38 3.4E+38 ECU_ADDRESS 0xfe4a5834 /* @ECU_Address@autosar_swc_aeb_rtARID_DEF.ObjData_i[13].ShortPredTime.A@ */ /end MEASUREMENT
/begin MEASUREMENT autosar_swc_aeb_rtARID_DEF.ObjData_i[13].ShortPredTime.ALat "" FLOAT32_IEEE autosar_swc_aeb_CM_single 0 0 -3.4E+38 3.4E+38 ECU_ADDRESS 0xfe4a5830 /* @ECU_Address@autosar_swc_aeb_rtARID_DEF.ObjData_i[13].ShortPredTime.ALat@ */ /end MEASUREMENT
/begin MEASUREMENT autosar_swc_aeb_rtARID_DEF.ObjData_i[13].ShortPredTime.ALgt "" FLOAT32_IEEE autosar_swc_aeb_CM_single 0 0 -3.4E+38 3.4E+38 ECU_ADDRESS 0xfe4a582c /* @ECU_Address@autosar_swc_aeb_rtARID_DEF.ObjData_i[13].ShortPredTime.ALgt@ */ /end MEASUREMENT
/begin MEASUREMENT autosar_swc_aeb_rtARID_DEF.ObjData_i[13].ShortPredTime.Crvt "" FLOAT32_IEEE autosar_swc_aeb_CM_single 0 0 -3.4E+38 3.4E+38 ECU_ADDRESS 0xfe4a5838 /* @ECU_Address@autosar_swc_aeb_rtARID_DEF.ObjData_i[13].ShortPredTime.Crvt@ */ /end MEASUREMENT
/begin MEASUREMENT autosar_swc_aeb_rtARID_DEF.ObjData_i[13].ShortPredTime.InPath "" UBYTE autosar_swc_aeb_CM_logical 0 0 0 1 ECU_ADDRESS 0xfe4a5829 /* @ECU_Address@autosar_swc_aeb_rtARID_DEF.ObjData_i[13].ShortPredTime.InPath@ */ /end MEASUREMENT
/begin MEASUREMENT autosar_swc_aeb_rtARID_DEF.ObjData_i[13].ShortPredTime.ObjOnCmngAndBrkg "" UBYTE autosar_swc_aeb_CM_logical 0 0 0 1 ECU_ADDRESS 0xfe4a582a /* @ECU_Address@autosar_swc_aeb_rtARID_DEF.ObjData_i[13].ShortPredTime.ObjOnCmngAndBrkg@ */ /end MEASUREMENT
/begin MEASUREMENT autosar_swc_aeb_rtARID_DEF.ObjData_i[13].ShortPredTime.TTMSelected "" UBYTE autosar_swc_aeb_CM_logical 0 0 0 1 ECU_ADDRESS 0xfe4a5828 /* @ECU_Address@autosar_swc_aeb_rtARID_DEF.ObjData_i[13].ShortPredTime.TTMSelected@ */ /end MEASUREMENT
/begin MEASUREMENT autosar_swc_aeb_rtARID_DEF.ObjData_i[13].ShortPredTime.TimeToMiddleLgt "" FLOAT32_IEEE autosar_swc_aeb_CM_single 0 0 -3.4E+38 3.4E+38 ECU_ADDRESS 0xfe4a5820 /* @ECU_Address@autosar_swc_aeb_rtARID_DEF.ObjData_i[13].ShortPredTime.TimeToMiddleLgt@ */ /end MEASUREMENT
/begin MEASUREMENT autosar_swc_aeb_rtARID_DEF.ObjData_i[13].ShortPredTime.TimeToPassLgt "" FLOAT32_IEEE autosar_swc_aeb_CM_single 0 0 -3.4E+38 3.4E+38 ECU_ADDRESS 0xfe4a5824 /* @ECU_Address@autosar_swc_aeb_rtARID_DEF.ObjData_i[13].ShortPredTime.TimeToPassLgt@ */ /end MEASUREMENT
/begin MEASUREMENT autosar_swc_aeb_rtARID_DEF.ObjData_i[13].ShortPredTime.TimeToReachLgt "" FLOAT32_IEEE autosar_swc_aeb_CM_single 0 0 -3.4E+38 3.4E+38 ECU_ADDRESS 0xfe4a581c /* @ECU_Address@autosar_swc_aeb_rtARID_DEF.ObjData_i[13].ShortPredTime.TimeToReachLgt@ */ /end MEASUREMENT
/begin MEASUREMENT autosar_swc_aeb_rtARID_DEF.ObjData_i[14].BoundingBox.CosRotation "" FLOAT32_IEEE autosar_swc_aeb_CM_single 0 0 -3.4E+38 3.4E+38 ECU_ADDRESS 0xfe4a5858 /* @ECU_Address@autosar_swc_aeb_rtARID_DEF.ObjData_i[14].BoundingBox.CosRotation@ */ /end MEASUREMENT
/begin MEASUREMENT autosar_swc_aeb_rtARID_DEF.ObjData_i[14].BoundingBox.LengthSideLat "" FLOAT32_IEEE autosar_swc_aeb_CM_single 0 0 -3.4E+38 3.4E+38 ECU_ADDRESS 0xfe4a584c /* @ECU_Address@autosar_swc_aeb_rtARID_DEF.ObjData_i[14].BoundingBox.LengthSideLat@ */ /end MEASUREMENT
/begin MEASUREMENT autosar_swc_aeb_rtARID_DEF.ObjData_i[14].BoundingBox.LengthSideLgt "" FLOAT32_IEEE autosar_swc_aeb_CM_single 0 0 -3.4E+38 3.4E+38 ECU_ADDRESS 0xfe4a5850 /* @ECU_Address@autosar_swc_aeb_rtARID_DEF.ObjData_i[14].BoundingBox.LengthSideLgt@ */ /end MEASUREMENT
/begin MEASUREMENT autosar_swc_aeb_rtARID_DEF.ObjData_i[14].BoundingBox.RotationAngle "" FLOAT32_IEEE autosar_swc_aeb_CM_single 0 0 -3.4E+38 3.4E+38 ECU_ADDRESS 0xfe4a585c /* @ECU_Address@autosar_swc_aeb_rtARID_DEF.ObjData_i[14].BoundingBox.RotationAngle@ */ /end MEASUREMENT
/begin MEASUREMENT autosar_swc_aeb_rtARID_DEF.ObjData_i[14].BoundingBox.SinRotation "" FLOAT32_IEEE autosar_swc_aeb_CM_single 0 0 -3.4E+38 3.4E+38 ECU_ADDRESS 0xfe4a5854 /* @ECU_Address@autosar_swc_aeb_rtARID_DEF.ObjData_i[14].BoundingBox.SinRotation@ */ /end MEASUREMENT
/begin MEASUREMENT autosar_swc_aeb_rtARID_DEF.ObjData_i[14].Idn "" ULONG autosar_swc_aeb_CM_uint32 0 0 0 4294967295 ECU_ADDRESS 0xfe4a58cc /* @ECU_Address@autosar_swc_aeb_rtARID_DEF.ObjData_i[14].Idn@ */ /end MEASUREMENT
/begin MEASUREMENT autosar_swc_aeb_rtARID_DEF.ObjData_i[14].InPathAtCurrentPosition "" UBYTE autosar_swc_aeb_CM_logical 0 0 0 1 ECU_ADDRESS 0xfe4a5860 /* @ECU_Address@autosar_swc_aeb_rtARID_DEF.ObjData_i[14].InPathAtCurrentPosition@ */ /end MEASUREMENT
/begin MEASUREMENT autosar_swc_aeb_rtARID_DEF.ObjData_i[14].LongPredTime.A "" FLOAT32_IEEE autosar_swc_aeb_CM_single 0 0 -3.4E+38 3.4E+38 ECU_ADDRESS 0xfe4a58a4 /* @ECU_Address@autosar_swc_aeb_rtARID_DEF.ObjData_i[14].LongPredTime.A@ */ /end MEASUREMENT
/begin MEASUREMENT autosar_swc_aeb_rtARID_DEF.ObjData_i[14].LongPredTime.ALat "" FLOAT32_IEEE autosar_swc_aeb_CM_single 0 0 -3.4E+38 3.4E+38 ECU_ADDRESS 0xfe4a58a0 /* @ECU_Address@autosar_swc_aeb_rtARID_DEF.ObjData_i[14].LongPredTime.ALat@ */ /end MEASUREMENT
/begin MEASUREMENT autosar_swc_aeb_rtARID_DEF.ObjData_i[14].LongPredTime.ALgt "" FLOAT32_IEEE autosar_swc_aeb_CM_single 0 0 -3.4E+38 3.4E+38 ECU_ADDRESS 0xfe4a589c /* @ECU_Address@autosar_swc_aeb_rtARID_DEF.ObjData_i[14].LongPredTime.ALgt@ */ /end MEASUREMENT
/begin MEASUREMENT autosar_swc_aeb_rtARID_DEF.ObjData_i[14].LongPredTime.Crvt "" FLOAT32_IEEE autosar_swc_aeb_CM_single 0 0 -3.4E+38 3.4E+38 ECU_ADDRESS 0xfe4a58a8 /* @ECU_Address@autosar_swc_aeb_rtARID_DEF.ObjData_i[14].LongPredTime.Crvt@ */ /end MEASUREMENT
/begin MEASUREMENT autosar_swc_aeb_rtARID_DEF.ObjData_i[14].LongPredTime.InPath "" UBYTE autosar_swc_aeb_CM_logical 0 0 0 1 ECU_ADDRESS 0xfe4a5899 /* @ECU_Address@autosar_swc_aeb_rtARID_DEF.ObjData_i[14].LongPredTime.InPath@ */ /end MEASUREMENT
/begin MEASUREMENT autosar_swc_aeb_rtARID_DEF.ObjData_i[14].LongPredTime.ObjOnCmngAndBrkg "" UBYTE autosar_swc_aeb_CM_logical 0 0 0 1 ECU_ADDRESS 0xfe4a589a /* @ECU_Address@autosar_swc_aeb_rtARID_DEF.ObjData_i[14].LongPredTime.ObjOnCmngAndBrkg@ */ /end MEASUREMENT
/begin MEASUREMENT autosar_swc_aeb_rtARID_DEF.ObjData_i[14].LongPredTime.TTMSelected "" UBYTE autosar_swc_aeb_CM_logical 0 0 0 1 ECU_ADDRESS 0xfe4a5898 /* @ECU_Address@autosar_swc_aeb_rtARID_DEF.ObjData_i[14].LongPredTime.TTMSelected@ */ /end MEASUREMENT
/begin MEASUREMENT autosar_swc_aeb_rtARID_DEF.ObjData_i[14].LongPredTime.TimeToMiddleLgt "" FLOAT32_IEEE autosar_swc_aeb_CM_single 0 0 -3.4E+38 3.4E+38 ECU_ADDRESS 0xfe4a5890 /* @ECU_Address@autosar_swc_aeb_rtARID_DEF.ObjData_i[14].LongPredTime.TimeToMiddleLgt@ */ /end MEASUREMENT
/begin MEASUREMENT autosar_swc_aeb_rtARID_DEF.ObjData_i[14].LongPredTime.TimeToPassLgt "" FLOAT32_IEEE autosar_swc_aeb_CM_single 0 0 -3.4E+38 3.4E+38 ECU_ADDRESS 0xfe4a5894 /* @ECU_Address@autosar_swc_aeb_rtARID_DEF.ObjData_i[14].LongPredTime.TimeToPassLgt@ */ /end MEASUREMENT
/begin MEASUREMENT autosar_swc_aeb_rtARID_DEF.ObjData_i[14].LongPredTime.TimeToReachLgt "" FLOAT32_IEEE autosar_swc_aeb_CM_single 0 0 -3.4E+38 3.4E+38 ECU_ADDRESS 0xfe4a588c /* @ECU_Address@autosar_swc_aeb_rtARID_DEF.ObjData_i[14].LongPredTime.TimeToReachLgt@ */ /end MEASUREMENT
/begin MEASUREMENT autosar_swc_aeb_rtARID_DEF.ObjData_i[14].MotionType.AbsHeading "" FLOAT32_IEEE autosar_swc_aeb_CM_single 0 0 -3.4E+38 3.4E+38 ECU_ADDRESS 0xfe4a5848 /* @ECU_Address@autosar_swc_aeb_rtARID_DEF.ObjData_i[14].MotionType.AbsHeading@ */ /end MEASUREMENT
/begin MEASUREMENT autosar_swc_aeb_rtARID_DEF.ObjData_i[14].MotionType.CurvedMotion "" UBYTE autosar_swc_aeb_CM_logical 0 0 0 1 ECU_ADDRESS 0xfe4a5846 /* @ECU_Address@autosar_swc_aeb_rtARID_DEF.ObjData_i[14].MotionType.CurvedMotion@ */ /end MEASUREMENT
/begin MEASUREMENT autosar_swc_aeb_rtARID_DEF.ObjData_i[14].MotionType.MovingOncoming "" UBYTE autosar_swc_aeb_CM_logical 0 0 0 1 ECU_ADDRESS 0xfe4a5841 /* @ECU_Address@autosar_swc_aeb_rtARID_DEF.ObjData_i[14].MotionType.MovingOncoming@ */ /end MEASUREMENT
/begin MEASUREMENT autosar_swc_aeb_rtARID_DEF.ObjData_i[14].MotionType.ObjectIsMotorVehicle "Object type is Car, Truck, Motorcycle or Vehicle Of Unkown Class." UBYTE autosar_swc_aeb_CM_logical 0 0 0 1 ECU_ADDRESS 0xfe4a5845 /* @ECU_Address@autosar_swc_aeb_rtARID_DEF.ObjData_i[14].MotionType.ObjectIsMotorVehicle@ */ /end MEASUREMENT
/begin MEASUREMENT autosar_swc_aeb_rtARID_DEF.ObjData_i[14].MotionType.ObjectIsVehicle "" UBYTE autosar_swc_aeb_CM_logical 0 0 0 1 ECU_ADDRESS 0xfe4a5844 /* @ECU_Address@autosar_swc_aeb_rtARID_DEF.ObjData_i[14].MotionType.ObjectIsVehicle@ */ /end MEASUREMENT
/begin MEASUREMENT autosar_swc_aeb_rtARID_DEF.ObjData_i[14].MotionType.ParallellVehicleLongPred "" UBYTE autosar_swc_aeb_CM_logical 0 0 0 1 ECU_ADDRESS 0xfe4a5842 /* @ECU_Address@autosar_swc_aeb_rtARID_DEF.ObjData_i[14].MotionType.ParallellVehicleLongPred@ */ /end MEASUREMENT
/begin MEASUREMENT autosar_swc_aeb_rtARID_DEF.ObjData_i[14].MotionType.ParallellVehicleShortPred "" UBYTE autosar_swc_aeb_CM_logical 0 0 0 1 ECU_ADDRESS 0xfe4a5843 /* @ECU_Address@autosar_swc_aeb_rtARID_DEF.ObjData_i[14].MotionType.ParallellVehicleShortPred@ */ /end MEASUREMENT
/begin MEASUREMENT autosar_swc_aeb_rtARID_DEF.ObjData_i[14].MotionType.SideIsClosest "" UBYTE autosar_swc_aeb_CM_logical 0 0 0 1 ECU_ADDRESS 0xfe4a5847 /* @ECU_Address@autosar_swc_aeb_rtARID_DEF.ObjData_i[14].MotionType.SideIsClosest@ */ /end MEASUREMENT
/begin MEASUREMENT autosar_swc_aeb_rtARID_DEF.ObjData_i[14].MotionType.Stationary "" UBYTE autosar_swc_aeb_CM_logical 0 0 0 1 ECU_ADDRESS 0xfe4a5840 /* @ECU_Address@autosar_swc_aeb_rtARID_DEF.ObjData_i[14].MotionType.Stationary@ */ /end MEASUREMENT
/begin MEASUREMENT autosar_swc_aeb_rtARID_DEF.ObjData_i[14].Offsets.OffsLatInPathCloseEdge "" FLOAT32_IEEE autosar_swc_aeb_CM_single 0 0 -3.4E+38 3.4E+38 ECU_ADDRESS 0xfe4a587c /* @ECU_Address@autosar_swc_aeb_rtARID_DEF.ObjData_i[14].Offsets.OffsLatInPathCloseEdge@ */ /end MEASUREMENT
/begin MEASUREMENT autosar_swc_aeb_rtARID_DEF.ObjData_i[14].Offsets.OffsLatInPathFarEdge "" FLOAT32_IEEE autosar_swc_aeb_CM_single 0 0 -3.4E+38 3.4E+38 ECU_ADDRESS 0xfe4a5880 /* @ECU_Address@autosar_swc_aeb_rtARID_DEF.ObjData_i[14].Offsets.OffsLatInPathFarEdge@ */ /end MEASUREMENT
/begin MEASUREMENT autosar_swc_aeb_rtARID_DEF.ObjData_i[14].Offsets.OffsLatInPathPrimaryTarget "" FLOAT32_IEEE autosar_swc_aeb_CM_single 0 0 -3.4E+38 3.4E+38 ECU_ADDRESS 0xfe4a5878 /* @ECU_Address@autosar_swc_aeb_rtARID_DEF.ObjData_i[14].Offsets.OffsLatInPathPrimaryTarget@ */ /end MEASUREMENT
/begin MEASUREMENT autosar_swc_aeb_rtARID_DEF.ObjData_i[14].Offsets.OffsLatIntersection "" FLOAT32_IEEE autosar_swc_aeb_CM_single 0 0 -3.4E+38 3.4E+38 ECU_ADDRESS 0xfe4a5884 /* @ECU_Address@autosar_swc_aeb_rtARID_DEF.ObjData_i[14].Offsets.OffsLatIntersection@ */ /end MEASUREMENT
/begin MEASUREMENT autosar_swc_aeb_rtARID_DEF.ObjData_i[14].Offsets.OffsLatLongPred "" FLOAT32_IEEE autosar_swc_aeb_CM_single 0 0 -3.4E+38 3.4E+38 ECU_ADDRESS 0xfe4a5868 /* @ECU_Address@autosar_swc_aeb_rtARID_DEF.ObjData_i[14].Offsets.OffsLatLongPred@ */ /end MEASUREMENT
/begin MEASUREMENT autosar_swc_aeb_rtARID_DEF.ObjData_i[14].Offsets.OffsLatManoeuvre "" FLOAT32_IEEE autosar_swc_aeb_CM_single 0 0 -3.4E+38 3.4E+38 ECU_ADDRESS 0xfe4a5874 /* @ECU_Address@autosar_swc_aeb_rtARID_DEF.ObjData_i[14].Offsets.OffsLatManoeuvre@ */ /end MEASUREMENT
/begin MEASUREMENT autosar_swc_aeb_rtARID_DEF.ObjData_i[14].Offsets.OffsLatMplTar "" FLOAT32_IEEE autosar_swc_aeb_CM_single 0 0 -3.4E+38 3.4E+38 ECU_ADDRESS 0xfe4a5888 /* @ECU_Address@autosar_swc_aeb_rtARID_DEF.ObjData_i[14].Offsets.OffsLatMplTar@ */ /end MEASUREMENT
/begin MEASUREMENT autosar_swc_aeb_rtARID_DEF.ObjData_i[14].Offsets.OffsLatShortPred "" FLOAT32_IEEE autosar_swc_aeb_CM_single 0 0 -3.4E+38 3.4E+38 ECU_ADDRESS 0xfe4a5870 /* @ECU_Address@autosar_swc_aeb_rtARID_DEF.ObjData_i[14].Offsets.OffsLatShortPred@ */ /end MEASUREMENT
/begin MEASUREMENT autosar_swc_aeb_rtARID_DEF.ObjData_i[14].Offsets.OffsLgtLongPred "" FLOAT32_IEEE autosar_swc_aeb_CM_single 0 0 -3.4E+38 3.4E+38 ECU_ADDRESS 0xfe4a5864 /* @ECU_Address@autosar_swc_aeb_rtARID_DEF.ObjData_i[14].Offsets.OffsLgtLongPred@ */ /end MEASUREMENT
/begin MEASUREMENT autosar_swc_aeb_rtARID_DEF.ObjData_i[14].Offsets.OffsLgtShortPred "" FLOAT32_IEEE autosar_swc_aeb_CM_single 0 0 -3.4E+38 3.4E+38 ECU_ADDRESS 0xfe4a586c /* @ECU_Address@autosar_swc_aeb_rtARID_DEF.ObjData_i[14].Offsets.OffsLgtShortPred@ */ /end MEASUREMENT
/begin MEASUREMENT autosar_swc_aeb_rtARID_DEF.ObjData_i[14].PredictionValid "" UBYTE autosar_swc_aeb_CM_logical 0 0 0 1 ECU_ADDRESS 0xfe4a5861 /* @ECU_Address@autosar_swc_aeb_rtARID_DEF.ObjData_i[14].PredictionValid@ */ /end MEASUREMENT
/begin MEASUREMENT autosar_swc_aeb_rtARID_DEF.ObjData_i[14].ShortPredTime.A "" FLOAT32_IEEE autosar_swc_aeb_CM_single 0 0 -3.4E+38 3.4E+38 ECU_ADDRESS 0xfe4a58c4 /* @ECU_Address@autosar_swc_aeb_rtARID_DEF.ObjData_i[14].ShortPredTime.A@ */ /end MEASUREMENT
/begin MEASUREMENT autosar_swc_aeb_rtARID_DEF.ObjData_i[14].ShortPredTime.ALat "" FLOAT32_IEEE autosar_swc_aeb_CM_single 0 0 -3.4E+38 3.4E+38 ECU_ADDRESS 0xfe4a58c0 /* @ECU_Address@autosar_swc_aeb_rtARID_DEF.ObjData_i[14].ShortPredTime.ALat@ */ /end MEASUREMENT
/begin MEASUREMENT autosar_swc_aeb_rtARID_DEF.ObjData_i[14].ShortPredTime.ALgt "" FLOAT32_IEEE autosar_swc_aeb_CM_single 0 0 -3.4E+38 3.4E+38 ECU_ADDRESS 0xfe4a58bc /* @ECU_Address@autosar_swc_aeb_rtARID_DEF.ObjData_i[14].ShortPredTime.ALgt@ */ /end MEASUREMENT
/begin MEASUREMENT autosar_swc_aeb_rtARID_DEF.ObjData_i[14].ShortPredTime.Crvt "" FLOAT32_IEEE autosar_swc_aeb_CM_single 0 0 -3.4E+38 3.4E+38 ECU_ADDRESS 0xfe4a58c8 /* @ECU_Address@autosar_swc_aeb_rtARID_DEF.ObjData_i[14].ShortPredTime.Crvt@ */ /end MEASUREMENT
/begin MEASUREMENT autosar_swc_aeb_rtARID_DEF.ObjData_i[14].ShortPredTime.InPath "" UBYTE autosar_swc_aeb_CM_logical 0 0 0 1 ECU_ADDRESS 0xfe4a58b9 /* @ECU_Address@autosar_swc_aeb_rtARID_DEF.ObjData_i[14].ShortPredTime.InPath@ */ /end MEASUREMENT
/begin MEASUREMENT autosar_swc_aeb_rtARID_DEF.ObjData_i[14].ShortPredTime.ObjOnCmngAndBrkg "" UBYTE autosar_swc_aeb_CM_logical 0 0 0 1 ECU_ADDRESS 0xfe4a58ba /* @ECU_Address@autosar_swc_aeb_rtARID_DEF.ObjData_i[14].ShortPredTime.ObjOnCmngAndBrkg@ */ /end MEASUREMENT
/begin MEASUREMENT autosar_swc_aeb_rtARID_DEF.ObjData_i[14].ShortPredTime.TTMSelected "" UBYTE autosar_swc_aeb_CM_logical 0 0 0 1 ECU_ADDRESS 0xfe4a58b8 /* @ECU_Address@autosar_swc_aeb_rtARID_DEF.ObjData_i[14].ShortPredTime.TTMSelected@ */ /end MEASUREMENT
/begin MEASUREMENT autosar_swc_aeb_rtARID_DEF.ObjData_i[14].ShortPredTime.TimeToMiddleLgt "" FLOAT32_IEEE autosar_swc_aeb_CM_single 0 0 -3.4E+38 3.4E+38 ECU_ADDRESS 0xfe4a58b0 /* @ECU_Address@autosar_swc_aeb_rtARID_DEF.ObjData_i[14].ShortPredTime.TimeToMiddleLgt@ */ /end MEASUREMENT
/begin MEASUREMENT autosar_swc_aeb_rtARID_DEF.ObjData_i[14].ShortPredTime.TimeToPassLgt "" FLOAT32_IEEE autosar_swc_aeb_CM_single 0 0 -3.4E+38 3.4E+38 ECU_ADDRESS 0xfe4a58b4 /* @ECU_Address@autosar_swc_aeb_rtARID_DEF.ObjData_i[14].ShortPredTime.TimeToPassLgt@ */ /end MEASUREMENT
/begin MEASUREMENT autosar_swc_aeb_rtARID_DEF.ObjData_i[14].ShortPredTime.TimeToReachLgt "" FLOAT32_IEEE autosar_swc_aeb_CM_single 0 0 -3.4E+38 3.4E+38 ECU_ADDRESS 0xfe4a58ac /* @ECU_Address@autosar_swc_aeb_rtARID_DEF.ObjData_i[14].ShortPredTime.TimeToReachLgt@ */ /end MEASUREMENT
/begin MEASUREMENT autosar_swc_aeb_rtARID_DEF.ObjData_i[15].BoundingBox.CosRotation "" FLOAT32_IEEE autosar_swc_aeb_CM_single 0 0 -3.4E+38 3.4E+38 ECU_ADDRESS 0xfe4a58e8 /* @ECU_Address@autosar_swc_aeb_rtARID_DEF.ObjData_i[15].BoundingBox.CosRotation@ */ /end MEASUREMENT
/begin MEASUREMENT autosar_swc_aeb_rtARID_DEF.ObjData_i[15].BoundingBox.LengthSideLat "" FLOAT32_IEEE autosar_swc_aeb_CM_single 0 0 -3.4E+38 3.4E+38 ECU_ADDRESS 0xfe4a58dc /* @ECU_Address@autosar_swc_aeb_rtARID_DEF.ObjData_i[15].BoundingBox.LengthSideLat@ */ /end MEASUREMENT
/begin MEASUREMENT autosar_swc_aeb_rtARID_DEF.ObjData_i[15].BoundingBox.LengthSideLgt "" FLOAT32_IEEE autosar_swc_aeb_CM_single 0 0 -3.4E+38 3.4E+38 ECU_ADDRESS 0xfe4a58e0 /* @ECU_Address@autosar_swc_aeb_rtARID_DEF.ObjData_i[15].BoundingBox.LengthSideLgt@ */ /end MEASUREMENT
/begin MEASUREMENT autosar_swc_aeb_rtARID_DEF.ObjData_i[15].BoundingBox.RotationAngle "" FLOAT32_IEEE autosar_swc_aeb_CM_single 0 0 -3.4E+38 3.4E+38 ECU_ADDRESS 0xfe4a58ec /* @ECU_Address@autosar_swc_aeb_rtARID_DEF.ObjData_i[15].BoundingBox.RotationAngle@ */ /end MEASUREMENT
/begin MEASUREMENT autosar_swc_aeb_rtARID_DEF.ObjData_i[15].BoundingBox.SinRotation "" FLOAT32_IEEE autosar_swc_aeb_CM_single 0 0 -3.4E+38 3.4E+38 ECU_ADDRESS 0xfe4a58e4 /* @ECU_Address@autosar_swc_aeb_rtARID_DEF.ObjData_i[15].BoundingBox.SinRotation@ */ /end MEASUREMENT
/begin MEASUREMENT autosar_swc_aeb_rtARID_DEF.ObjData_i[15].Idn "" ULONG autosar_swc_aeb_CM_uint32 0 0 0 4294967295 ECU_ADDRESS 0xfe4a595c /* @ECU_Address@autosar_swc_aeb_rtARID_DEF.ObjData_i[15].Idn@ */ /end MEASUREMENT
/begin MEASUREMENT autosar_swc_aeb_rtARID_DEF.ObjData_i[15].InPathAtCurrentPosition "" UBYTE autosar_swc_aeb_CM_logical 0 0 0 1 ECU_ADDRESS 0xfe4a58f0 /* @ECU_Address@autosar_swc_aeb_rtARID_DEF.ObjData_i[15].InPathAtCurrentPosition@ */ /end MEASUREMENT
/begin MEASUREMENT autosar_swc_aeb_rtARID_DEF.ObjData_i[15].LongPredTime.A "" FLOAT32_IEEE autosar_swc_aeb_CM_single 0 0 -3.4E+38 3.4E+38 ECU_ADDRESS 0xfe4a5934 /* @ECU_Address@autosar_swc_aeb_rtARID_DEF.ObjData_i[15].LongPredTime.A@ */ /end MEASUREMENT
/begin MEASUREMENT autosar_swc_aeb_rtARID_DEF.ObjData_i[15].LongPredTime.ALat "" FLOAT32_IEEE autosar_swc_aeb_CM_single 0 0 -3.4E+38 3.4E+38 ECU_ADDRESS 0xfe4a5930 /* @ECU_Address@autosar_swc_aeb_rtARID_DEF.ObjData_i[15].LongPredTime.ALat@ */ /end MEASUREMENT
/begin MEASUREMENT autosar_swc_aeb_rtARID_DEF.ObjData_i[15].LongPredTime.ALgt "" FLOAT32_IEEE autosar_swc_aeb_CM_single 0 0 -3.4E+38 3.4E+38 ECU_ADDRESS 0xfe4a592c /* @ECU_Address@autosar_swc_aeb_rtARID_DEF.ObjData_i[15].LongPredTime.ALgt@ */ /end MEASUREMENT
/begin MEASUREMENT autosar_swc_aeb_rtARID_DEF.ObjData_i[15].LongPredTime.Crvt "" FLOAT32_IEEE autosar_swc_aeb_CM_single 0 0 -3.4E+38 3.4E+38 ECU_ADDRESS 0xfe4a5938 /* @ECU_Address@autosar_swc_aeb_rtARID_DEF.ObjData_i[15].LongPredTime.Crvt@ */ /end MEASUREMENT
/begin MEASUREMENT autosar_swc_aeb_rtARID_DEF.ObjData_i[15].LongPredTime.InPath "" UBYTE autosar_swc_aeb_CM_logical 0 0 0 1 ECU_ADDRESS 0xfe4a5929 /* @ECU_Address@autosar_swc_aeb_rtARID_DEF.ObjData_i[15].LongPredTime.InPath@ */ /end MEASUREMENT
/begin MEASUREMENT autosar_swc_aeb_rtARID_DEF.ObjData_i[15].LongPredTime.ObjOnCmngAndBrkg "" UBYTE autosar_swc_aeb_CM_logical 0 0 0 1 ECU_ADDRESS 0xfe4a592a /* @ECU_Address@autosar_swc_aeb_rtARID_DEF.ObjData_i[15].LongPredTime.ObjOnCmngAndBrkg@ */ /end MEASUREMENT
/begin MEASUREMENT autosar_swc_aeb_rtARID_DEF.ObjData_i[15].LongPredTime.TTMSelected "" UBYTE autosar_swc_aeb_CM_logical 0 0 0 1 ECU_ADDRESS 0xfe4a5928 /* @ECU_Address@autosar_swc_aeb_rtARID_DEF.ObjData_i[15].LongPredTime.TTMSelected@ */ /end MEASUREMENT
/begin MEASUREMENT autosar_swc_aeb_rtARID_DEF.ObjData_i[15].LongPredTime.TimeToMiddleLgt "" FLOAT32_IEEE autosar_swc_aeb_CM_single 0 0 -3.4E+38 3.4E+38 ECU_ADDRESS 0xfe4a5920 /* @ECU_Address@autosar_swc_aeb_rtARID_DEF.ObjData_i[15].LongPredTime.TimeToMiddleLgt@ */ /end MEASUREMENT
/begin MEASUREMENT autosar_swc_aeb_rtARID_DEF.ObjData_i[15].LongPredTime.TimeToPassLgt "" FLOAT32_IEEE autosar_swc_aeb_CM_single 0 0 -3.4E+38 3.4E+38 ECU_ADDRESS 0xfe4a5924 /* @ECU_Address@autosar_swc_aeb_rtARID_DEF.ObjData_i[15].LongPredTime.TimeToPassLgt@ */ /end MEASUREMENT
/begin MEASUREMENT autosar_swc_aeb_rtARID_DEF.ObjData_i[15].LongPredTime.TimeToReachLgt "" FLOAT32_IEEE autosar_swc_aeb_CM_single 0 0 -3.4E+38 3.4E+38 ECU_ADDRESS 0xfe4a591c /* @ECU_Address@autosar_swc_aeb_rtARID_DEF.ObjData_i[15].LongPredTime.TimeToReachLgt@ */ /end MEASUREMENT
/begin MEASUREMENT autosar_swc_aeb_rtARID_DEF.ObjData_i[15].MotionType.AbsHeading "" FLOAT32_IEEE autosar_swc_aeb_CM_single 0 0 -3.4E+38 3.4E+38 ECU_ADDRESS 0xfe4a58d8 /* @ECU_Address@autosar_swc_aeb_rtARID_DEF.ObjData_i[15].MotionType.AbsHeading@ */ /end MEASUREMENT
/begin MEASUREMENT autosar_swc_aeb_rtARID_DEF.ObjData_i[15].MotionType.CurvedMotion "" UBYTE autosar_swc_aeb_CM_logical 0 0 0 1 ECU_ADDRESS 0xfe4a58d6 /* @ECU_Address@autosar_swc_aeb_rtARID_DEF.ObjData_i[15].MotionType.CurvedMotion@ */ /end MEASUREMENT
/begin MEASUREMENT autosar_swc_aeb_rtARID_DEF.ObjData_i[15].MotionType.MovingOncoming "" UBYTE autosar_swc_aeb_CM_logical 0 0 0 1 ECU_ADDRESS 0xfe4a58d1 /* @ECU_Address@autosar_swc_aeb_rtARID_DEF.ObjData_i[15].MotionType.MovingOncoming@ */ /end MEASUREMENT
/begin MEASUREMENT autosar_swc_aeb_rtARID_DEF.ObjData_i[15].MotionType.ObjectIsMotorVehicle "Object type is Car, Truck, Motorcycle or Vehicle Of Unkown Class." UBYTE autosar_swc_aeb_CM_logical 0 0 0 1 ECU_ADDRESS 0xfe4a58d5 /* @ECU_Address@autosar_swc_aeb_rtARID_DEF.ObjData_i[15].MotionType.ObjectIsMotorVehicle@ */ /end MEASUREMENT
/begin MEASUREMENT autosar_swc_aeb_rtARID_DEF.ObjData_i[15].MotionType.ObjectIsVehicle "" UBYTE autosar_swc_aeb_CM_logical 0 0 0 1 ECU_ADDRESS 0xfe4a58d4 /* @ECU_Address@autosar_swc_aeb_rtARID_DEF.ObjData_i[15].MotionType.ObjectIsVehicle@ */ /end MEASUREMENT
/begin MEASUREMENT autosar_swc_aeb_rtARID_DEF.ObjData_i[15].MotionType.ParallellVehicleLongPred "" UBYTE autosar_swc_aeb_CM_logical 0 0 0 1 ECU_ADDRESS 0xfe4a58d2 /* @ECU_Address@autosar_swc_aeb_rtARID_DEF.ObjData_i[15].MotionType.ParallellVehicleLongPred@ */ /end MEASUREMENT
/begin MEASUREMENT autosar_swc_aeb_rtARID_DEF.ObjData_i[15].MotionType.ParallellVehicleShortPred "" UBYTE autosar_swc_aeb_CM_logical 0 0 0 1 ECU_ADDRESS 0xfe4a58d3 /* @ECU_Address@autosar_swc_aeb_rtARID_DEF.ObjData_i[15].MotionType.ParallellVehicleShortPred@ */ /end MEASUREMENT
/begin MEASUREMENT autosar_swc_aeb_rtARID_DEF.ObjData_i[15].MotionType.SideIsClosest "" UBYTE autosar_swc_aeb_CM_logical 0 0 0 1 ECU_ADDRESS 0xfe4a58d7 /* @ECU_Address@autosar_swc_aeb_rtARID_DEF.ObjData_i[15].MotionType.SideIsClosest@ */ /end MEASUREMENT
/begin MEASUREMENT autosar_swc_aeb_rtARID_DEF.ObjData_i[15].MotionType.Stationary "" UBYTE autosar_swc_aeb_CM_logical 0 0 0 1 ECU_ADDRESS 0xfe4a58d0 /* @ECU_Address@autosar_swc_aeb_rtARID_DEF.ObjData_i[15].MotionType.Stationary@ */ /end MEASUREMENT
/begin MEASUREMENT autosar_swc_aeb_rtARID_DEF.ObjData_i[15].Offsets.OffsLatInPathCloseEdge "" FLOAT32_IEEE autosar_swc_aeb_CM_single 0 0 -3.4E+38 3.4E+38 ECU_ADDRESS 0xfe4a590c /* @ECU_Address@autosar_swc_aeb_rtARID_DEF.ObjData_i[15].Offsets.OffsLatInPathCloseEdge@ */ /end MEASUREMENT
/begin MEASUREMENT autosar_swc_aeb_rtARID_DEF.ObjData_i[15].Offsets.OffsLatInPathFarEdge "" FLOAT32_IEEE autosar_swc_aeb_CM_single 0 0 -3.4E+38 3.4E+38 ECU_ADDRESS 0xfe4a5910 /* @ECU_Address@autosar_swc_aeb_rtARID_DEF.ObjData_i[15].Offsets.OffsLatInPathFarEdge@ */ /end MEASUREMENT
/begin MEASUREMENT autosar_swc_aeb_rtARID_DEF.ObjData_i[15].Offsets.OffsLatInPathPrimaryTarget "" FLOAT32_IEEE autosar_swc_aeb_CM_single 0 0 -3.4E+38 3.4E+38 ECU_ADDRESS 0xfe4a5908 /* @ECU_Address@autosar_swc_aeb_rtARID_DEF.ObjData_i[15].Offsets.OffsLatInPathPrimaryTarget@ */ /end MEASUREMENT
/begin MEASUREMENT autosar_swc_aeb_rtARID_DEF.ObjData_i[15].Offsets.OffsLatIntersection "" FLOAT32_IEEE autosar_swc_aeb_CM_single 0 0 -3.4E+38 3.4E+38 ECU_ADDRESS 0xfe4a5914 /* @ECU_Address@autosar_swc_aeb_rtARID_DEF.ObjData_i[15].Offsets.OffsLatIntersection@ */ /end MEASUREMENT
/begin MEASUREMENT autosar_swc_aeb_rtARID_DEF.ObjData_i[15].Offsets.OffsLatLongPred "" FLOAT32_IEEE autosar_swc_aeb_CM_single 0 0 -3.4E+38 3.4E+38 ECU_ADDRESS 0xfe4a58f8 /* @ECU_Address@autosar_swc_aeb_rtARID_DEF.ObjData_i[15].Offsets.OffsLatLongPred@ */ /end MEASUREMENT
/begin MEASUREMENT autosar_swc_aeb_rtARID_DEF.ObjData_i[15].Offsets.OffsLatManoeuvre "" FLOAT32_IEEE autosar_swc_aeb_CM_single 0 0 -3.4E+38 3.4E+38 ECU_ADDRESS 0xfe4a5904 /* @ECU_Address@autosar_swc_aeb_rtARID_DEF.ObjData_i[15].Offsets.OffsLatManoeuvre@ */ /end MEASUREMENT
/begin MEASUREMENT autosar_swc_aeb_rtARID_DEF.ObjData_i[15].Offsets.OffsLatMplTar "" FLOAT32_IEEE autosar_swc_aeb_CM_single 0 0 -3.4E+38 3.4E+38 ECU_ADDRESS 0xfe4a5918 /* @ECU_Address@autosar_swc_aeb_rtARID_DEF.ObjData_i[15].Offsets.OffsLatMplTar@ */ /end MEASUREMENT
/begin MEASUREMENT autosar_swc_aeb_rtARID_DEF.ObjData_i[15].Offsets.OffsLatShortPred "" FLOAT32_IEEE autosar_swc_aeb_CM_single 0 0 -3.4E+38 3.4E+38 ECU_ADDRESS 0xfe4a5900 /* @ECU_Address@autosar_swc_aeb_rtARID_DEF.ObjData_i[15].Offsets.OffsLatShortPred@ */ /end MEASUREMENT
/begin MEASUREMENT autosar_swc_aeb_rtARID_DEF.ObjData_i[15].Offsets.OffsLgtLongPred "" FLOAT32_IEEE autosar_swc_aeb_CM_single 0 0 -3.4E+38 3.4E+38 ECU_ADDRESS 0xfe4a58f4 /* @ECU_Address@autosar_swc_aeb_rtARID_DEF.ObjData_i[15].Offsets.OffsLgtLongPred@ */ /end MEASUREMENT
/begin MEASUREMENT autosar_swc_aeb_rtARID_DEF.ObjData_i[15].Offsets.OffsLgtShortPred "" FLOAT32_IEEE autosar_swc_aeb_CM_single 0 0 -3.4E+38 3.4E+38 ECU_ADDRESS 0xfe4a58fc /* @ECU_Address@autosar_swc_aeb_rtARID_DEF.ObjData_i[15].Offsets.OffsLgtShortPred@ */ /end MEASUREMENT
/begin MEASUREMENT autosar_swc_aeb_rtARID_DEF.ObjData_i[15].PredictionValid "" UBYTE autosar_swc_aeb_CM_logical 0 0 0 1 ECU_ADDRESS 0xfe4a58f1 /* @ECU_Address@autosar_swc_aeb_rtARID_DEF.ObjData_i[15].PredictionValid@ */ /end MEASUREMENT
/begin MEASUREMENT autosar_swc_aeb_rtARID_DEF.ObjData_i[15].ShortPredTime.A "" FLOAT32_IEEE autosar_swc_aeb_CM_single 0 0 -3.4E+38 3.4E+38 ECU_ADDRESS 0xfe4a5954 /* @ECU_Address@autosar_swc_aeb_rtARID_DEF.ObjData_i[15].ShortPredTime.A@ */ /end MEASUREMENT
/begin MEASUREMENT autosar_swc_aeb_rtARID_DEF.ObjData_i[15].ShortPredTime.ALat "" FLOAT32_IEEE autosar_swc_aeb_CM_single 0 0 -3.4E+38 3.4E+38 ECU_ADDRESS 0xfe4a5950 /* @ECU_Address@autosar_swc_aeb_rtARID_DEF.ObjData_i[15].ShortPredTime.ALat@ */ /end MEASUREMENT
/begin MEASUREMENT autosar_swc_aeb_rtARID_DEF.ObjData_i[15].ShortPredTime.ALgt "" FLOAT32_IEEE autosar_swc_aeb_CM_single 0 0 -3.4E+38 3.4E+38 ECU_ADDRESS 0xfe4a594c /* @ECU_Address@autosar_swc_aeb_rtARID_DEF.ObjData_i[15].ShortPredTime.ALgt@ */ /end MEASUREMENT
/begin MEASUREMENT autosar_swc_aeb_rtARID_DEF.ObjData_i[15].ShortPredTime.Crvt "" FLOAT32_IEEE autosar_swc_aeb_CM_single 0 0 -3.4E+38 3.4E+38 ECU_ADDRESS 0xfe4a5958 /* @ECU_Address@autosar_swc_aeb_rtARID_DEF.ObjData_i[15].ShortPredTime.Crvt@ */ /end MEASUREMENT
/begin MEASUREMENT autosar_swc_aeb_rtARID_DEF.ObjData_i[15].ShortPredTime.InPath "" UBYTE autosar_swc_aeb_CM_logical 0 0 0 1 ECU_ADDRESS 0xfe4a5949 /* @ECU_Address@autosar_swc_aeb_rtARID_DEF.ObjData_i[15].ShortPredTime.InPath@ */ /end MEASUREMENT
/begin MEASUREMENT autosar_swc_aeb_rtARID_DEF.ObjData_i[15].ShortPredTime.ObjOnCmngAndBrkg "" UBYTE autosar_swc_aeb_CM_logical 0 0 0 1 ECU_ADDRESS 0xfe4a594a /* @ECU_Address@autosar_swc_aeb_rtARID_DEF.ObjData_i[15].ShortPredTime.ObjOnCmngAndBrkg@ */ /end MEASUREMENT
/begin MEASUREMENT autosar_swc_aeb_rtARID_DEF.ObjData_i[15].ShortPredTime.TTMSelected "" UBYTE autosar_swc_aeb_CM_logical 0 0 0 1 ECU_ADDRESS 0xfe4a5948 /* @ECU_Address@autosar_swc_aeb_rtARID_DEF.ObjData_i[15].ShortPredTime.TTMSelected@ */ /end MEASUREMENT
/begin MEASUREMENT autosar_swc_aeb_rtARID_DEF.ObjData_i[15].ShortPredTime.TimeToMiddleLgt "" FLOAT32_IEEE autosar_swc_aeb_CM_single 0 0 -3.4E+38 3.4E+38 ECU_ADDRESS 0xfe4a5940 /* @ECU_Address@autosar_swc_aeb_rtARID_DEF.ObjData_i[15].ShortPredTime.TimeToMiddleLgt@ */ /end MEASUREMENT
/begin MEASUREMENT autosar_swc_aeb_rtARID_DEF.ObjData_i[15].ShortPredTime.TimeToPassLgt "" FLOAT32_IEEE autosar_swc_aeb_CM_single 0 0 -3.4E+38 3.4E+38 ECU_ADDRESS 0xfe4a5944 /* @ECU_Address@autosar_swc_aeb_rtARID_DEF.ObjData_i[15].ShortPredTime.TimeToPassLgt@ */ /end MEASUREMENT
/begin MEASUREMENT autosar_swc_aeb_rtARID_DEF.ObjData_i[15].ShortPredTime.TimeToReachLgt "" FLOAT32_IEEE autosar_swc_aeb_CM_single 0 0 -3.4E+38 3.4E+38 ECU_ADDRESS 0xfe4a593c /* @ECU_Address@autosar_swc_aeb_rtARID_DEF.ObjData_i[15].ShortPredTime.TimeToReachLgt@ */ /end MEASUREMENT
/begin MEASUREMENT autosar_swc_aeb_rtARID_DEF.ObjData_i[16].BoundingBox.CosRotation "" FLOAT32_IEEE autosar_swc_aeb_CM_single 0 0 -3.4E+38 3.4E+38 ECU_ADDRESS 0xfe4a5978 /* @ECU_Address@autosar_swc_aeb_rtARID_DEF.ObjData_i[16].BoundingBox.CosRotation@ */ /end MEASUREMENT
/begin MEASUREMENT autosar_swc_aeb_rtARID_DEF.ObjData_i[16].BoundingBox.LengthSideLat "" FLOAT32_IEEE autosar_swc_aeb_CM_single 0 0 -3.4E+38 3.4E+38 ECU_ADDRESS 0xfe4a596c /* @ECU_Address@autosar_swc_aeb_rtARID_DEF.ObjData_i[16].BoundingBox.LengthSideLat@ */ /end MEASUREMENT
/begin MEASUREMENT autosar_swc_aeb_rtARID_DEF.ObjData_i[16].BoundingBox.LengthSideLgt "" FLOAT32_IEEE autosar_swc_aeb_CM_single 0 0 -3.4E+38 3.4E+38 ECU_ADDRESS 0xfe4a5970 /* @ECU_Address@autosar_swc_aeb_rtARID_DEF.ObjData_i[16].BoundingBox.LengthSideLgt@ */ /end MEASUREMENT
/begin MEASUREMENT autosar_swc_aeb_rtARID_DEF.ObjData_i[16].BoundingBox.RotationAngle "" FLOAT32_IEEE autosar_swc_aeb_CM_single 0 0 -3.4E+38 3.4E+38 ECU_ADDRESS 0xfe4a597c /* @ECU_Address@autosar_swc_aeb_rtARID_DEF.ObjData_i[16].BoundingBox.RotationAngle@ */ /end MEASUREMENT
/begin MEASUREMENT autosar_swc_aeb_rtARID_DEF.ObjData_i[16].BoundingBox.SinRotation "" FLOAT32_IEEE autosar_swc_aeb_CM_single 0 0 -3.4E+38 3.4E+38 ECU_ADDRESS 0xfe4a5974 /* @ECU_Address@autosar_swc_aeb_rtARID_DEF.ObjData_i[16].BoundingBox.SinRotation@ */ /end MEASUREMENT
/begin MEASUREMENT autosar_swc_aeb_rtARID_DEF.ObjData_i[16].Idn "" ULONG autosar_swc_aeb_CM_uint32 0 0 0 4294967295 ECU_ADDRESS 0xfe4a59ec /* @ECU_Address@autosar_swc_aeb_rtARID_DEF.ObjData_i[16].Idn@ */ /end MEASUREMENT
/begin MEASUREMENT autosar_swc_aeb_rtARID_DEF.ObjData_i[16].InPathAtCurrentPosition "" UBYTE autosar_swc_aeb_CM_logical 0 0 0 1 ECU_ADDRESS 0xfe4a5980 /* @ECU_Address@autosar_swc_aeb_rtARID_DEF.ObjData_i[16].InPathAtCurrentPosition@ */ /end MEASUREMENT
/begin MEASUREMENT autosar_swc_aeb_rtARID_DEF.ObjData_i[16].LongPredTime.A "" FLOAT32_IEEE autosar_swc_aeb_CM_single 0 0 -3.4E+38 3.4E+38 ECU_ADDRESS 0xfe4a59c4 /* @ECU_Address@autosar_swc_aeb_rtARID_DEF.ObjData_i[16].LongPredTime.A@ */ /end MEASUREMENT
/begin MEASUREMENT autosar_swc_aeb_rtARID_DEF.ObjData_i[16].LongPredTime.ALat "" FLOAT32_IEEE autosar_swc_aeb_CM_single 0 0 -3.4E+38 3.4E+38 ECU_ADDRESS 0xfe4a59c0 /* @ECU_Address@autosar_swc_aeb_rtARID_DEF.ObjData_i[16].LongPredTime.ALat@ */ /end MEASUREMENT
/begin MEASUREMENT autosar_swc_aeb_rtARID_DEF.ObjData_i[16].LongPredTime.ALgt "" FLOAT32_IEEE autosar_swc_aeb_CM_single 0 0 -3.4E+38 3.4E+38 ECU_ADDRESS 0xfe4a59bc /* @ECU_Address@autosar_swc_aeb_rtARID_DEF.ObjData_i[16].LongPredTime.ALgt@ */ /end MEASUREMENT
/begin MEASUREMENT autosar_swc_aeb_rtARID_DEF.ObjData_i[16].LongPredTime.Crvt "" FLOAT32_IEEE autosar_swc_aeb_CM_single 0 0 -3.4E+38 3.4E+38 ECU_ADDRESS 0xfe4a59c8 /* @ECU_Address@autosar_swc_aeb_rtARID_DEF.ObjData_i[16].LongPredTime.Crvt@ */ /end MEASUREMENT
/begin MEASUREMENT autosar_swc_aeb_rtARID_DEF.ObjData_i[16].LongPredTime.InPath "" UBYTE autosar_swc_aeb_CM_logical 0 0 0 1 ECU_ADDRESS 0xfe4a59b9 /* @ECU_Address@autosar_swc_aeb_rtARID_DEF.ObjData_i[16].LongPredTime.InPath@ */ /end MEASUREMENT
/begin MEASUREMENT autosar_swc_aeb_rtARID_DEF.ObjData_i[16].LongPredTime.ObjOnCmngAndBrkg "" UBYTE autosar_swc_aeb_CM_logical 0 0 0 1 ECU_ADDRESS 0xfe4a59ba /* @ECU_Address@autosar_swc_aeb_rtARID_DEF.ObjData_i[16].LongPredTime.ObjOnCmngAndBrkg@ */ /end MEASUREMENT
/begin MEASUREMENT autosar_swc_aeb_rtARID_DEF.ObjData_i[16].LongPredTime.TTMSelected "" UBYTE autosar_swc_aeb_CM_logical 0 0 0 1 ECU_ADDRESS 0xfe4a59b8 /* @ECU_Address@autosar_swc_aeb_rtARID_DEF.ObjData_i[16].LongPredTime.TTMSelected@ */ /end MEASUREMENT
/begin MEASUREMENT autosar_swc_aeb_rtARID_DEF.ObjData_i[16].LongPredTime.TimeToMiddleLgt "" FLOAT32_IEEE autosar_swc_aeb_CM_single 0 0 -3.4E+38 3.4E+38 ECU_ADDRESS 0xfe4a59b0 /* @ECU_Address@autosar_swc_aeb_rtARID_DEF.ObjData_i[16].LongPredTime.TimeToMiddleLgt@ */ /end MEASUREMENT
/begin MEASUREMENT autosar_swc_aeb_rtARID_DEF.ObjData_i[16].LongPredTime.TimeToPassLgt "" FLOAT32_IEEE autosar_swc_aeb_CM_single 0 0 -3.4E+38 3.4E+38 ECU_ADDRESS 0xfe4a59b4 /* @ECU_Address@autosar_swc_aeb_rtARID_DEF.ObjData_i[16].LongPredTime.TimeToPassLgt@ */ /end MEASUREMENT
/begin MEASUREMENT autosar_swc_aeb_rtARID_DEF.ObjData_i[16].LongPredTime.TimeToReachLgt "" FLOAT32_IEEE autosar_swc_aeb_CM_single 0 0 -3.4E+38 3.4E+38 ECU_ADDRESS 0xfe4a59ac /* @ECU_Address@autosar_swc_aeb_rtARID_DEF.ObjData_i[16].LongPredTime.TimeToReachLgt@ */ /end MEASUREMENT
/begin MEASUREMENT autosar_swc_aeb_rtARID_DEF.ObjData_i[16].MotionType.AbsHeading "" FLOAT32_IEEE autosar_swc_aeb_CM_single 0 0 -3.4E+38 3.4E+38 ECU_ADDRESS 0xfe4a5968 /* @ECU_Address@autosar_swc_aeb_rtARID_DEF.ObjData_i[16].MotionType.AbsHeading@ */ /end MEASUREMENT
/begin MEASUREMENT autosar_swc_aeb_rtARID_DEF.ObjData_i[16].MotionType.CurvedMotion "" UBYTE autosar_swc_aeb_CM_logical 0 0 0 1 ECU_ADDRESS 0xfe4a5966 /* @ECU_Address@autosar_swc_aeb_rtARID_DEF.ObjData_i[16].MotionType.CurvedMotion@ */ /end MEASUREMENT
/begin MEASUREMENT autosar_swc_aeb_rtARID_DEF.ObjData_i[16].MotionType.MovingOncoming "" UBYTE autosar_swc_aeb_CM_logical 0 0 0 1 ECU_ADDRESS 0xfe4a5961 /* @ECU_Address@autosar_swc_aeb_rtARID_DEF.ObjData_i[16].MotionType.MovingOncoming@ */ /end MEASUREMENT
/begin MEASUREMENT autosar_swc_aeb_rtARID_DEF.ObjData_i[16].MotionType.ObjectIsMotorVehicle "Object type is Car, Truck, Motorcycle or Vehicle Of Unkown Class." UBYTE autosar_swc_aeb_CM_logical 0 0 0 1 ECU_ADDRESS 0xfe4a5965 /* @ECU_Address@autosar_swc_aeb_rtARID_DEF.ObjData_i[16].MotionType.ObjectIsMotorVehicle@ */ /end MEASUREMENT
/begin MEASUREMENT autosar_swc_aeb_rtARID_DEF.ObjData_i[16].MotionType.ObjectIsVehicle "" UBYTE autosar_swc_aeb_CM_logical 0 0 0 1 ECU_ADDRESS 0xfe4a5964 /* @ECU_Address@autosar_swc_aeb_rtARID_DEF.ObjData_i[16].MotionType.ObjectIsVehicle@ */ /end MEASUREMENT
/begin MEASUREMENT autosar_swc_aeb_rtARID_DEF.ObjData_i[16].MotionType.ParallellVehicleLongPred "" UBYTE autosar_swc_aeb_CM_logical 0 0 0 1 ECU_ADDRESS 0xfe4a5962 /* @ECU_Address@autosar_swc_aeb_rtARID_DEF.ObjData_i[16].MotionType.ParallellVehicleLongPred@ */ /end MEASUREMENT
/begin MEASUREMENT autosar_swc_aeb_rtARID_DEF.ObjData_i[16].MotionType.ParallellVehicleShortPred "" UBYTE autosar_swc_aeb_CM_logical 0 0 0 1 ECU_ADDRESS 0xfe4a5963 /* @ECU_Address@autosar_swc_aeb_rtARID_DEF.ObjData_i[16].MotionType.ParallellVehicleShortPred@ */ /end MEASUREMENT
/begin MEASUREMENT autosar_swc_aeb_rtARID_DEF.ObjData_i[16].MotionType.SideIsClosest "" UBYTE autosar_swc_aeb_CM_logical 0 0 0 1 ECU_ADDRESS 0xfe4a5967 /* @ECU_Address@autosar_swc_aeb_rtARID_DEF.ObjData_i[16].MotionType.SideIsClosest@ */ /end MEASUREMENT
/begin MEASUREMENT autosar_swc_aeb_rtARID_DEF.ObjData_i[16].MotionType.Stationary "" UBYTE autosar_swc_aeb_CM_logical 0 0 0 1 ECU_ADDRESS 0xfe4a5960 /* @ECU_Address@autosar_swc_aeb_rtARID_DEF.ObjData_i[16].MotionType.Stationary@ */ /end MEASUREMENT
/begin MEASUREMENT autosar_swc_aeb_rtARID_DEF.ObjData_i[16].Offsets.OffsLatInPathCloseEdge "" FLOAT32_IEEE autosar_swc_aeb_CM_single 0 0 -3.4E+38 3.4E+38 ECU_ADDRESS 0xfe4a599c /* @ECU_Address@autosar_swc_aeb_rtARID_DEF.ObjData_i[16].Offsets.OffsLatInPathCloseEdge@ */ /end MEASUREMENT
/begin MEASUREMENT autosar_swc_aeb_rtARID_DEF.ObjData_i[16].Offsets.OffsLatInPathFarEdge "" FLOAT32_IEEE autosar_swc_aeb_CM_single 0 0 -3.4E+38 3.4E+38 ECU_ADDRESS 0xfe4a59a0 /* @ECU_Address@autosar_swc_aeb_rtARID_DEF.ObjData_i[16].Offsets.OffsLatInPathFarEdge@ */ /end MEASUREMENT
/begin MEASUREMENT autosar_swc_aeb_rtARID_DEF.ObjData_i[16].Offsets.OffsLatInPathPrimaryTarget "" FLOAT32_IEEE autosar_swc_aeb_CM_single 0 0 -3.4E+38 3.4E+38 ECU_ADDRESS 0xfe4a5998 /* @ECU_Address@autosar_swc_aeb_rtARID_DEF.ObjData_i[16].Offsets.OffsLatInPathPrimaryTarget@ */ /end MEASUREMENT
/begin MEASUREMENT autosar_swc_aeb_rtARID_DEF.ObjData_i[16].Offsets.OffsLatIntersection "" FLOAT32_IEEE autosar_swc_aeb_CM_single 0 0 -3.4E+38 3.4E+38 ECU_ADDRESS 0xfe4a59a4 /* @ECU_Address@autosar_swc_aeb_rtARID_DEF.ObjData_i[16].Offsets.OffsLatIntersection@ */ /end MEASUREMENT
/begin MEASUREMENT autosar_swc_aeb_rtARID_DEF.ObjData_i[16].Offsets.OffsLatLongPred "" FLOAT32_IEEE autosar_swc_aeb_CM_single 0 0 -3.4E+38 3.4E+38 ECU_ADDRESS 0xfe4a5988 /* @ECU_Address@autosar_swc_aeb_rtARID_DEF.ObjData_i[16].Offsets.OffsLatLongPred@ */ /end MEASUREMENT
/begin MEASUREMENT autosar_swc_aeb_rtARID_DEF.ObjData_i[16].Offsets.OffsLatManoeuvre "" FLOAT32_IEEE autosar_swc_aeb_CM_single 0 0 -3.4E+38 3.4E+38 ECU_ADDRESS 0xfe4a5994 /* @ECU_Address@autosar_swc_aeb_rtARID_DEF.ObjData_i[16].Offsets.OffsLatManoeuvre@ */ /end MEASUREMENT
/begin MEASUREMENT autosar_swc_aeb_rtARID_DEF.ObjData_i[16].Offsets.OffsLatMplTar "" FLOAT32_IEEE autosar_swc_aeb_CM_single 0 0 -3.4E+38 3.4E+38 ECU_ADDRESS 0xfe4a59a8 /* @ECU_Address@autosar_swc_aeb_rtARID_DEF.ObjData_i[16].Offsets.OffsLatMplTar@ */ /end MEASUREMENT
/begin MEASUREMENT autosar_swc_aeb_rtARID_DEF.ObjData_i[16].Offsets.OffsLatShortPred "" FLOAT32_IEEE autosar_swc_aeb_CM_single 0 0 -3.4E+38 3.4E+38 ECU_ADDRESS 0xfe4a5990 /* @ECU_Address@autosar_swc_aeb_rtARID_DEF.ObjData_i[16].Offsets.OffsLatShortPred@ */ /end MEASUREMENT
/begin MEASUREMENT autosar_swc_aeb_rtARID_DEF.ObjData_i[16].Offsets.OffsLgtLongPred "" FLOAT32_IEEE autosar_swc_aeb_CM_single 0 0 -3.4E+38 3.4E+38 ECU_ADDRESS 0xfe4a5984 /* @ECU_Address@autosar_swc_aeb_rtARID_DEF.ObjData_i[16].Offsets.OffsLgtLongPred@ */ /end MEASUREMENT
/begin MEASUREMENT autosar_swc_aeb_rtARID_DEF.ObjData_i[16].Offsets.OffsLgtShortPred "" FLOAT32_IEEE autosar_swc_aeb_CM_single 0 0 -3.4E+38 3.4E+38 ECU_ADDRESS 0xfe4a598c /* @ECU_Address@autosar_swc_aeb_rtARID_DEF.ObjData_i[16].Offsets.OffsLgtShortPred@ */ /end MEASUREMENT
/begin MEASUREMENT autosar_swc_aeb_rtARID_DEF.ObjData_i[16].PredictionValid "" UBYTE autosar_swc_aeb_CM_logical 0 0 0 1 ECU_ADDRESS 0xfe4a5981 /* @ECU_Address@autosar_swc_aeb_rtARID_DEF.ObjData_i[16].PredictionValid@ */ /end MEASUREMENT
/begin MEASUREMENT autosar_swc_aeb_rtARID_DEF.ObjData_i[16].ShortPredTime.A "" FLOAT32_IEEE autosar_swc_aeb_CM_single 0 0 -3.4E+38 3.4E+38 ECU_ADDRESS 0xfe4a59e4 /* @ECU_Address@autosar_swc_aeb_rtARID_DEF.ObjData_i[16].ShortPredTime.A@ */ /end MEASUREMENT
/begin MEASUREMENT autosar_swc_aeb_rtARID_DEF.ObjData_i[16].ShortPredTime.ALat "" FLOAT32_IEEE autosar_swc_aeb_CM_single 0 0 -3.4E+38 3.4E+38 ECU_ADDRESS 0xfe4a59e0 /* @ECU_Address@autosar_swc_aeb_rtARID_DEF.ObjData_i[16].ShortPredTime.ALat@ */ /end MEASUREMENT
/begin MEASUREMENT autosar_swc_aeb_rtARID_DEF.ObjData_i[16].ShortPredTime.ALgt "" FLOAT32_IEEE autosar_swc_aeb_CM_single 0 0 -3.4E+38 3.4E+38 ECU_ADDRESS 0xfe4a59dc /* @ECU_Address@autosar_swc_aeb_rtARID_DEF.ObjData_i[16].ShortPredTime.ALgt@ */ /end MEASUREMENT
/begin MEASUREMENT autosar_swc_aeb_rtARID_DEF.ObjData_i[16].ShortPredTime.Crvt "" FLOAT32_IEEE autosar_swc_aeb_CM_single 0 0 -3.4E+38 3.4E+38 ECU_ADDRESS 0xfe4a59e8 /* @ECU_Address@autosar_swc_aeb_rtARID_DEF.ObjData_i[16].ShortPredTime.Crvt@ */ /end MEASUREMENT
/begin MEASUREMENT autosar_swc_aeb_rtARID_DEF.ObjData_i[16].ShortPredTime.InPath "" UBYTE autosar_swc_aeb_CM_logical 0 0 0 1 ECU_ADDRESS 0xfe4a59d9 /* @ECU_Address@autosar_swc_aeb_rtARID_DEF.ObjData_i[16].ShortPredTime.InPath@ */ /end MEASUREMENT
/begin MEASUREMENT autosar_swc_aeb_rtARID_DEF.ObjData_i[16].ShortPredTime.ObjOnCmngAndBrkg "" UBYTE autosar_swc_aeb_CM_logical 0 0 0 1 ECU_ADDRESS 0xfe4a59da /* @ECU_Address@autosar_swc_aeb_rtARID_DEF.ObjData_i[16].ShortPredTime.ObjOnCmngAndBrkg@ */ /end MEASUREMENT
/begin MEASUREMENT autosar_swc_aeb_rtARID_DEF.ObjData_i[16].ShortPredTime.TTMSelected "" UBYTE autosar_swc_aeb_CM_logical 0 0 0 1 ECU_ADDRESS 0xfe4a59d8 /* @ECU_Address@autosar_swc_aeb_rtARID_DEF.ObjData_i[16].ShortPredTime.TTMSelected@ */ /end MEASUREMENT
/begin MEASUREMENT autosar_swc_aeb_rtARID_DEF.ObjData_i[16].ShortPredTime.TimeToMiddleLgt "" FLOAT32_IEEE autosar_swc_aeb_CM_single 0 0 -3.4E+38 3.4E+38 ECU_ADDRESS 0xfe4a59d0 /* @ECU_Address@autosar_swc_aeb_rtARID_DEF.ObjData_i[16].ShortPredTime.TimeToMiddleLgt@ */ /end MEASUREMENT
/begin MEASUREMENT autosar_swc_aeb_rtARID_DEF.ObjData_i[16].ShortPredTime.TimeToPassLgt "" FLOAT32_IEEE autosar_swc_aeb_CM_single 0 0 -3.4E+38 3.4E+38 ECU_ADDRESS 0xfe4a59d4 /* @ECU_Address@autosar_swc_aeb_rtARID_DEF.ObjData_i[16].ShortPredTime.TimeToPassLgt@ */ /end MEASUREMENT
/begin MEASUREMENT autosar_swc_aeb_rtARID_DEF.ObjData_i[16].ShortPredTime.TimeToReachLgt "" FLOAT32_IEEE autosar_swc_aeb_CM_single 0 0 -3.4E+38 3.4E+38 ECU_ADDRESS 0xfe4a59cc /* @ECU_Address@autosar_swc_aeb_rtARID_DEF.ObjData_i[16].ShortPredTime.TimeToReachLgt@ */ /end MEASUREMENT
/begin MEASUREMENT autosar_swc_aeb_rtARID_DEF.ObjData_i[17].BoundingBox.CosRotation "" FLOAT32_IEEE autosar_swc_aeb_CM_single 0 0 -3.4E+38 3.4E+38 ECU_ADDRESS 0xfe4a5a08 /* @ECU_Address@autosar_swc_aeb_rtARID_DEF.ObjData_i[17].BoundingBox.CosRotation@ */ /end MEASUREMENT
/begin MEASUREMENT autosar_swc_aeb_rtARID_DEF.ObjData_i[17].BoundingBox.LengthSideLat "" FLOAT32_IEEE autosar_swc_aeb_CM_single 0 0 -3.4E+38 3.4E+38 ECU_ADDRESS 0xfe4a59fc /* @ECU_Address@autosar_swc_aeb_rtARID_DEF.ObjData_i[17].BoundingBox.LengthSideLat@ */ /end MEASUREMENT
/begin MEASUREMENT autosar_swc_aeb_rtARID_DEF.ObjData_i[17].BoundingBox.LengthSideLgt "" FLOAT32_IEEE autosar_swc_aeb_CM_single 0 0 -3.4E+38 3.4E+38 ECU_ADDRESS 0xfe4a5a00 /* @ECU_Address@autosar_swc_aeb_rtARID_DEF.ObjData_i[17].BoundingBox.LengthSideLgt@ */ /end MEASUREMENT
/begin MEASUREMENT autosar_swc_aeb_rtARID_DEF.ObjData_i[17].BoundingBox.RotationAngle "" FLOAT32_IEEE autosar_swc_aeb_CM_single 0 0 -3.4E+38 3.4E+38 ECU_ADDRESS 0xfe4a5a0c /* @ECU_Address@autosar_swc_aeb_rtARID_DEF.ObjData_i[17].BoundingBox.RotationAngle@ */ /end MEASUREMENT
/begin MEASUREMENT autosar_swc_aeb_rtARID_DEF.ObjData_i[17].BoundingBox.SinRotation "" FLOAT32_IEEE autosar_swc_aeb_CM_single 0 0 -3.4E+38 3.4E+38 ECU_ADDRESS 0xfe4a5a04 /* @ECU_Address@autosar_swc_aeb_rtARID_DEF.ObjData_i[17].BoundingBox.SinRotation@ */ /end MEASUREMENT
/begin MEASUREMENT autosar_swc_aeb_rtARID_DEF.ObjData_i[17].Idn "" ULONG autosar_swc_aeb_CM_uint32 0 0 0 4294967295 ECU_ADDRESS 0xfe4a5a7c /* @ECU_Address@autosar_swc_aeb_rtARID_DEF.ObjData_i[17].Idn@ */ /end MEASUREMENT
/begin MEASUREMENT autosar_swc_aeb_rtARID_DEF.ObjData_i[17].InPathAtCurrentPosition "" UBYTE autosar_swc_aeb_CM_logical 0 0 0 1 ECU_ADDRESS 0xfe4a5a10 /* @ECU_Address@autosar_swc_aeb_rtARID_DEF.ObjData_i[17].InPathAtCurrentPosition@ */ /end MEASUREMENT
/begin MEASUREMENT autosar_swc_aeb_rtARID_DEF.ObjData_i[17].LongPredTime.A "" FLOAT32_IEEE autosar_swc_aeb_CM_single 0 0 -3.4E+38 3.4E+38 ECU_ADDRESS 0xfe4a5a54 /* @ECU_Address@autosar_swc_aeb_rtARID_DEF.ObjData_i[17].LongPredTime.A@ */ /end MEASUREMENT
/begin MEASUREMENT autosar_swc_aeb_rtARID_DEF.ObjData_i[17].LongPredTime.ALat "" FLOAT32_IEEE autosar_swc_aeb_CM_single 0 0 -3.4E+38 3.4E+38 ECU_ADDRESS 0xfe4a5a50 /* @ECU_Address@autosar_swc_aeb_rtARID_DEF.ObjData_i[17].LongPredTime.ALat@ */ /end MEASUREMENT
/begin MEASUREMENT autosar_swc_aeb_rtARID_DEF.ObjData_i[17].LongPredTime.ALgt "" FLOAT32_IEEE autosar_swc_aeb_CM_single 0 0 -3.4E+38 3.4E+38 ECU_ADDRESS 0xfe4a5a4c /* @ECU_Address@autosar_swc_aeb_rtARID_DEF.ObjData_i[17].LongPredTime.ALgt@ */ /end MEASUREMENT
/begin MEASUREMENT autosar_swc_aeb_rtARID_DEF.ObjData_i[17].LongPredTime.Crvt "" FLOAT32_IEEE autosar_swc_aeb_CM_single 0 0 -3.4E+38 3.4E+38 ECU_ADDRESS 0xfe4a5a58 /* @ECU_Address@autosar_swc_aeb_rtARID_DEF.ObjData_i[17].LongPredTime.Crvt@ */ /end MEASUREMENT
/begin MEASUREMENT autosar_swc_aeb_rtARID_DEF.ObjData_i[17].LongPredTime.InPath "" UBYTE autosar_swc_aeb_CM_logical 0 0 0 1 ECU_ADDRESS 0xfe4a5a49 /* @ECU_Address@autosar_swc_aeb_rtARID_DEF.ObjData_i[17].LongPredTime.InPath@ */ /end MEASUREMENT
/begin MEASUREMENT autosar_swc_aeb_rtARID_DEF.ObjData_i[17].LongPredTime.ObjOnCmngAndBrkg "" UBYTE autosar_swc_aeb_CM_logical 0 0 0 1 ECU_ADDRESS 0xfe4a5a4a /* @ECU_Address@autosar_swc_aeb_rtARID_DEF.ObjData_i[17].LongPredTime.ObjOnCmngAndBrkg@ */ /end MEASUREMENT
/begin MEASUREMENT autosar_swc_aeb_rtARID_DEF.ObjData_i[17].LongPredTime.TTMSelected "" UBYTE autosar_swc_aeb_CM_logical 0 0 0 1 ECU_ADDRESS 0xfe4a5a48 /* @ECU_Address@autosar_swc_aeb_rtARID_DEF.ObjData_i[17].LongPredTime.TTMSelected@ */ /end MEASUREMENT
/begin MEASUREMENT autosar_swc_aeb_rtARID_DEF.ObjData_i[17].LongPredTime.TimeToMiddleLgt "" FLOAT32_IEEE autosar_swc_aeb_CM_single 0 0 -3.4E+38 3.4E+38 ECU_ADDRESS 0xfe4a5a40 /* @ECU_Address@autosar_swc_aeb_rtARID_DEF.ObjData_i[17].LongPredTime.TimeToMiddleLgt@ */ /end MEASUREMENT
/begin MEASUREMENT autosar_swc_aeb_rtARID_DEF.ObjData_i[17].LongPredTime.TimeToPassLgt "" FLOAT32_IEEE autosar_swc_aeb_CM_single 0 0 -3.4E+38 3.4E+38 ECU_ADDRESS 0xfe4a5a44 /* @ECU_Address@autosar_swc_aeb_rtARID_DEF.ObjData_i[17].LongPredTime.TimeToPassLgt@ */ /end MEASUREMENT
/begin MEASUREMENT autosar_swc_aeb_rtARID_DEF.ObjData_i[17].LongPredTime.TimeToReachLgt "" FLOAT32_IEEE autosar_swc_aeb_CM_single 0 0 -3.4E+38 3.4E+38 ECU_ADDRESS 0xfe4a5a3c /* @ECU_Address@autosar_swc_aeb_rtARID_DEF.ObjData_i[17].LongPredTime.TimeToReachLgt@ */ /end MEASUREMENT
/begin MEASUREMENT autosar_swc_aeb_rtARID_DEF.ObjData_i[17].MotionType.AbsHeading "" FLOAT32_IEEE autosar_swc_aeb_CM_single 0 0 -3.4E+38 3.4E+38 ECU_ADDRESS 0xfe4a59f8 /* @ECU_Address@autosar_swc_aeb_rtARID_DEF.ObjData_i[17].MotionType.AbsHeading@ */ /end MEASUREMENT
/begin MEASUREMENT autosar_swc_aeb_rtARID_DEF.ObjData_i[17].MotionType.CurvedMotion "" UBYTE autosar_swc_aeb_CM_logical 0 0 0 1 ECU_ADDRESS 0xfe4a59f6 /* @ECU_Address@autosar_swc_aeb_rtARID_DEF.ObjData_i[17].MotionType.CurvedMotion@ */ /end MEASUREMENT
/begin MEASUREMENT autosar_swc_aeb_rtARID_DEF.ObjData_i[17].MotionType.MovingOncoming "" UBYTE autosar_swc_aeb_CM_logical 0 0 0 1 ECU_ADDRESS 0xfe4a59f1 /* @ECU_Address@autosar_swc_aeb_rtARID_DEF.ObjData_i[17].MotionType.MovingOncoming@ */ /end MEASUREMENT
/begin MEASUREMENT autosar_swc_aeb_rtARID_DEF.ObjData_i[17].MotionType.ObjectIsMotorVehicle "Object type is Car, Truck, Motorcycle or Vehicle Of Unkown Class." UBYTE autosar_swc_aeb_CM_logical 0 0 0 1 ECU_ADDRESS 0xfe4a59f5 /* @ECU_Address@autosar_swc_aeb_rtARID_DEF.ObjData_i[17].MotionType.ObjectIsMotorVehicle@ */ /end MEASUREMENT
/begin MEASUREMENT autosar_swc_aeb_rtARID_DEF.ObjData_i[17].MotionType.ObjectIsVehicle "" UBYTE autosar_swc_aeb_CM_logical 0 0 0 1 ECU_ADDRESS 0xfe4a59f4 /* @ECU_Address@autosar_swc_aeb_rtARID_DEF.ObjData_i[17].MotionType.ObjectIsVehicle@ */ /end MEASUREMENT
/begin MEASUREMENT autosar_swc_aeb_rtARID_DEF.ObjData_i[17].MotionType.ParallellVehicleLongPred "" UBYTE autosar_swc_aeb_CM_logical 0 0 0 1 ECU_ADDRESS 0xfe4a59f2 /* @ECU_Address@autosar_swc_aeb_rtARID_DEF.ObjData_i[17].MotionType.ParallellVehicleLongPred@ */ /end MEASUREMENT
/begin MEASUREMENT autosar_swc_aeb_rtARID_DEF.ObjData_i[17].MotionType.ParallellVehicleShortPred "" UBYTE autosar_swc_aeb_CM_logical 0 0 0 1 ECU_ADDRESS 0xfe4a59f3 /* @ECU_Address@autosar_swc_aeb_rtARID_DEF.ObjData_i[17].MotionType.ParallellVehicleShortPred@ */ /end MEASUREMENT
/begin MEASUREMENT autosar_swc_aeb_rtARID_DEF.ObjData_i[17].MotionType.SideIsClosest "" UBYTE autosar_swc_aeb_CM_logical 0 0 0 1 ECU_ADDRESS 0xfe4a59f7 /* @ECU_Address@autosar_swc_aeb_rtARID_DEF.ObjData_i[17].MotionType.SideIsClosest@ */ /end MEASUREMENT
/begin MEASUREMENT autosar_swc_aeb_rtARID_DEF.ObjData_i[17].MotionType.Stationary "" UBYTE autosar_swc_aeb_CM_logical 0 0 0 1 ECU_ADDRESS 0xfe4a59f0 /* @ECU_Address@autosar_swc_aeb_rtARID_DEF.ObjData_i[17].MotionType.Stationary@ */ /end MEASUREMENT
/begin MEASUREMENT autosar_swc_aeb_rtARID_DEF.ObjData_i[17].Offsets.OffsLatInPathCloseEdge "" FLOAT32_IEEE autosar_swc_aeb_CM_single 0 0 -3.4E+38 3.4E+38 ECU_ADDRESS 0xfe4a5a2c /* @ECU_Address@autosar_swc_aeb_rtARID_DEF.ObjData_i[17].Offsets.OffsLatInPathCloseEdge@ */ /end MEASUREMENT
/begin MEASUREMENT autosar_swc_aeb_rtARID_DEF.ObjData_i[17].Offsets.OffsLatInPathFarEdge "" FLOAT32_IEEE autosar_swc_aeb_CM_single 0 0 -3.4E+38 3.4E+38 ECU_ADDRESS 0xfe4a5a30 /* @ECU_Address@autosar_swc_aeb_rtARID_DEF.ObjData_i[17].Offsets.OffsLatInPathFarEdge@ */ /end MEASUREMENT
/begin MEASUREMENT autosar_swc_aeb_rtARID_DEF.ObjData_i[17].Offsets.OffsLatInPathPrimaryTarget "" FLOAT32_IEEE autosar_swc_aeb_CM_single 0 0 -3.4E+38 3.4E+38 ECU_ADDRESS 0xfe4a5a28 /* @ECU_Address@autosar_swc_aeb_rtARID_DEF.ObjData_i[17].Offsets.OffsLatInPathPrimaryTarget@ */ /end MEASUREMENT
/begin MEASUREMENT autosar_swc_aeb_rtARID_DEF.ObjData_i[17].Offsets.OffsLatIntersection "" FLOAT32_IEEE autosar_swc_aeb_CM_single 0 0 -3.4E+38 3.4E+38 ECU_ADDRESS 0xfe4a5a34 /* @ECU_Address@autosar_swc_aeb_rtARID_DEF.ObjData_i[17].Offsets.OffsLatIntersection@ */ /end MEASUREMENT
/begin MEASUREMENT autosar_swc_aeb_rtARID_DEF.ObjData_i[17].Offsets.OffsLatLongPred "" FLOAT32_IEEE autosar_swc_aeb_CM_single 0 0 -3.4E+38 3.4E+38 ECU_ADDRESS 0xfe4a5a18 /* @ECU_Address@autosar_swc_aeb_rtARID_DEF.ObjData_i[17].Offsets.OffsLatLongPred@ */ /end MEASUREMENT
/begin MEASUREMENT autosar_swc_aeb_rtARID_DEF.ObjData_i[17].Offsets.OffsLatManoeuvre "" FLOAT32_IEEE autosar_swc_aeb_CM_single 0 0 -3.4E+38 3.4E+38 ECU_ADDRESS 0xfe4a5a24 /* @ECU_Address@autosar_swc_aeb_rtARID_DEF.ObjData_i[17].Offsets.OffsLatManoeuvre@ */ /end MEASUREMENT
/begin MEASUREMENT autosar_swc_aeb_rtARID_DEF.ObjData_i[17].Offsets.OffsLatMplTar "" FLOAT32_IEEE autosar_swc_aeb_CM_single 0 0 -3.4E+38 3.4E+38 ECU_ADDRESS 0xfe4a5a38 /* @ECU_Address@autosar_swc_aeb_rtARID_DEF.ObjData_i[17].Offsets.OffsLatMplTar@ */ /end MEASUREMENT
/begin MEASUREMENT autosar_swc_aeb_rtARID_DEF.ObjData_i[17].Offsets.OffsLatShortPred "" FLOAT32_IEEE autosar_swc_aeb_CM_single 0 0 -3.4E+38 3.4E+38 ECU_ADDRESS 0xfe4a5a20 /* @ECU_Address@autosar_swc_aeb_rtARID_DEF.ObjData_i[17].Offsets.OffsLatShortPred@ */ /end MEASUREMENT
/begin MEASUREMENT autosar_swc_aeb_rtARID_DEF.ObjData_i[17].Offsets.OffsLgtLongPred "" FLOAT32_IEEE autosar_swc_aeb_CM_single 0 0 -3.4E+38 3.4E+38 ECU_ADDRESS 0xfe4a5a14 /* @ECU_Address@autosar_swc_aeb_rtARID_DEF.ObjData_i[17].Offsets.OffsLgtLongPred@ */ /end MEASUREMENT
/begin MEASUREMENT autosar_swc_aeb_rtARID_DEF.ObjData_i[17].Offsets.OffsLgtShortPred "" FLOAT32_IEEE autosar_swc_aeb_CM_single 0 0 -3.4E+38 3.4E+38 ECU_ADDRESS 0xfe4a5a1c /* @ECU_Address@autosar_swc_aeb_rtARID_DEF.ObjData_i[17].Offsets.OffsLgtShortPred@ */ /end MEASUREMENT
/begin MEASUREMENT autosar_swc_aeb_rtARID_DEF.ObjData_i[17].PredictionValid "" UBYTE autosar_swc_aeb_CM_logical 0 0 0 1 ECU_ADDRESS 0xfe4a5a11 /* @ECU_Address@autosar_swc_aeb_rtARID_DEF.ObjData_i[17].PredictionValid@ */ /end MEASUREMENT
/begin MEASUREMENT autosar_swc_aeb_rtARID_DEF.ObjData_i[17].ShortPredTime.A "" FLOAT32_IEEE autosar_swc_aeb_CM_single 0 0 -3.4E+38 3.4E+38 ECU_ADDRESS 0xfe4a5a74 /* @ECU_Address@autosar_swc_aeb_rtARID_DEF.ObjData_i[17].ShortPredTime.A@ */ /end MEASUREMENT
/begin MEASUREMENT autosar_swc_aeb_rtARID_DEF.ObjData_i[17].ShortPredTime.ALat "" FLOAT32_IEEE autosar_swc_aeb_CM_single 0 0 -3.4E+38 3.4E+38 ECU_ADDRESS 0xfe4a5a70 /* @ECU_Address@autosar_swc_aeb_rtARID_DEF.ObjData_i[17].ShortPredTime.ALat@ */ /end MEASUREMENT
/begin MEASUREMENT autosar_swc_aeb_rtARID_DEF.ObjData_i[17].ShortPredTime.ALgt "" FLOAT32_IEEE autosar_swc_aeb_CM_single 0 0 -3.4E+38 3.4E+38 ECU_ADDRESS 0xfe4a5a6c /* @ECU_Address@autosar_swc_aeb_rtARID_DEF.ObjData_i[17].ShortPredTime.ALgt@ */ /end MEASUREMENT
/begin MEASUREMENT autosar_swc_aeb_rtARID_DEF.ObjData_i[17].ShortPredTime.Crvt "" FLOAT32_IEEE autosar_swc_aeb_CM_single 0 0 -3.4E+38 3.4E+38 ECU_ADDRESS 0xfe4a5a78 /* @ECU_Address@autosar_swc_aeb_rtARID_DEF.ObjData_i[17].ShortPredTime.Crvt@ */ /end MEASUREMENT
/begin MEASUREMENT autosar_swc_aeb_rtARID_DEF.ObjData_i[17].ShortPredTime.InPath "" UBYTE autosar_swc_aeb_CM_logical 0 0 0 1 ECU_ADDRESS 0xfe4a5a69 /* @ECU_Address@autosar_swc_aeb_rtARID_DEF.ObjData_i[17].ShortPredTime.InPath@ */ /end MEASUREMENT
/begin MEASUREMENT autosar_swc_aeb_rtARID_DEF.ObjData_i[17].ShortPredTime.ObjOnCmngAndBrkg "" UBYTE autosar_swc_aeb_CM_logical 0 0 0 1 ECU_ADDRESS 0xfe4a5a6a /* @ECU_Address@autosar_swc_aeb_rtARID_DEF.ObjData_i[17].ShortPredTime.ObjOnCmngAndBrkg@ */ /end MEASUREMENT
/begin MEASUREMENT autosar_swc_aeb_rtARID_DEF.ObjData_i[17].ShortPredTime.TTMSelected "" UBYTE autosar_swc_aeb_CM_logical 0 0 0 1 ECU_ADDRESS 0xfe4a5a68 /* @ECU_Address@autosar_swc_aeb_rtARID_DEF.ObjData_i[17].ShortPredTime.TTMSelected@ */ /end MEASUREMENT
/begin MEASUREMENT autosar_swc_aeb_rtARID_DEF.ObjData_i[17].ShortPredTime.TimeToMiddleLgt "" FLOAT32_IEEE autosar_swc_aeb_CM_single 0 0 -3.4E+38 3.4E+38 ECU_ADDRESS 0xfe4a5a60 /* @ECU_Address@autosar_swc_aeb_rtARID_DEF.ObjData_i[17].ShortPredTime.TimeToMiddleLgt@ */ /end MEASUREMENT
/begin MEASUREMENT autosar_swc_aeb_rtARID_DEF.ObjData_i[17].ShortPredTime.TimeToPassLgt "" FLOAT32_IEEE autosar_swc_aeb_CM_single 0 0 -3.4E+38 3.4E+38 ECU_ADDRESS 0xfe4a5a64 /* @ECU_Address@autosar_swc_aeb_rtARID_DEF.ObjData_i[17].ShortPredTime.TimeToPassLgt@ */ /end MEASUREMENT
/begin MEASUREMENT autosar_swc_aeb_rtARID_DEF.ObjData_i[17].ShortPredTime.TimeToReachLgt "" FLOAT32_IEEE autosar_swc_aeb_CM_single 0 0 -3.4E+38 3.4E+38 ECU_ADDRESS 0xfe4a5a5c /* @ECU_Address@autosar_swc_aeb_rtARID_DEF.ObjData_i[17].ShortPredTime.TimeToReachLgt@ */ /end MEASUREMENT
/begin MEASUREMENT autosar_swc_aeb_rtARID_DEF.ObjData_i[18].BoundingBox.CosRotation "" FLOAT32_IEEE autosar_swc_aeb_CM_single 0 0 -3.4E+38 3.4E+38 ECU_ADDRESS 0xfe4a5a98 /* @ECU_Address@autosar_swc_aeb_rtARID_DEF.ObjData_i[18].BoundingBox.CosRotation@ */ /end MEASUREMENT
/begin MEASUREMENT autosar_swc_aeb_rtARID_DEF.ObjData_i[18].BoundingBox.LengthSideLat "" FLOAT32_IEEE autosar_swc_aeb_CM_single 0 0 -3.4E+38 3.4E+38 ECU_ADDRESS 0xfe4a5a8c /* @ECU_Address@autosar_swc_aeb_rtARID_DEF.ObjData_i[18].BoundingBox.LengthSideLat@ */ /end MEASUREMENT
/begin MEASUREMENT autosar_swc_aeb_rtARID_DEF.ObjData_i[18].BoundingBox.LengthSideLgt "" FLOAT32_IEEE autosar_swc_aeb_CM_single 0 0 -3.4E+38 3.4E+38 ECU_ADDRESS 0xfe4a5a90 /* @ECU_Address@autosar_swc_aeb_rtARID_DEF.ObjData_i[18].BoundingBox.LengthSideLgt@ */ /end MEASUREMENT
/begin MEASUREMENT autosar_swc_aeb_rtARID_DEF.ObjData_i[18].BoundingBox.RotationAngle "" FLOAT32_IEEE autosar_swc_aeb_CM_single 0 0 -3.4E+38 3.4E+38 ECU_ADDRESS 0xfe4a5a9c /* @ECU_Address@autosar_swc_aeb_rtARID_DEF.ObjData_i[18].BoundingBox.RotationAngle@ */ /end MEASUREMENT
/begin MEASUREMENT autosar_swc_aeb_rtARID_DEF.ObjData_i[18].BoundingBox.SinRotation "" FLOAT32_IEEE autosar_swc_aeb_CM_single 0 0 -3.4E+38 3.4E+38 ECU_ADDRESS 0xfe4a5a94 /* @ECU_Address@autosar_swc_aeb_rtARID_DEF.ObjData_i[18].BoundingBox.SinRotation@ */ /end MEASUREMENT
/begin MEASUREMENT autosar_swc_aeb_rtARID_DEF.ObjData_i[18].Idn "" ULONG autosar_swc_aeb_CM_uint32 0 0 0 4294967295 ECU_ADDRESS 0xfe4a5b0c /* @ECU_Address@autosar_swc_aeb_rtARID_DEF.ObjData_i[18].Idn@ */ /end MEASUREMENT
/begin MEASUREMENT autosar_swc_aeb_rtARID_DEF.ObjData_i[18].InPathAtCurrentPosition "" UBYTE autosar_swc_aeb_CM_logical 0 0 0 1 ECU_ADDRESS 0xfe4a5aa0 /* @ECU_Address@autosar_swc_aeb_rtARID_DEF.ObjData_i[18].InPathAtCurrentPosition@ */ /end MEASUREMENT
/begin MEASUREMENT autosar_swc_aeb_rtARID_DEF.ObjData_i[18].LongPredTime.A "" FLOAT32_IEEE autosar_swc_aeb_CM_single 0 0 -3.4E+38 3.4E+38 ECU_ADDRESS 0xfe4a5ae4 /* @ECU_Address@autosar_swc_aeb_rtARID_DEF.ObjData_i[18].LongPredTime.A@ */ /end MEASUREMENT
/begin MEASUREMENT autosar_swc_aeb_rtARID_DEF.ObjData_i[18].LongPredTime.ALat "" FLOAT32_IEEE autosar_swc_aeb_CM_single 0 0 -3.4E+38 3.4E+38 ECU_ADDRESS 0xfe4a5ae0 /* @ECU_Address@autosar_swc_aeb_rtARID_DEF.ObjData_i[18].LongPredTime.ALat@ */ /end MEASUREMENT
/begin MEASUREMENT autosar_swc_aeb_rtARID_DEF.ObjData_i[18].LongPredTime.ALgt "" FLOAT32_IEEE autosar_swc_aeb_CM_single 0 0 -3.4E+38 3.4E+38 ECU_ADDRESS 0xfe4a5adc /* @ECU_Address@autosar_swc_aeb_rtARID_DEF.ObjData_i[18].LongPredTime.ALgt@ */ /end MEASUREMENT
/begin MEASUREMENT autosar_swc_aeb_rtARID_DEF.ObjData_i[18].LongPredTime.Crvt "" FLOAT32_IEEE autosar_swc_aeb_CM_single 0 0 -3.4E+38 3.4E+38 ECU_ADDRESS 0xfe4a5ae8 /* @ECU_Address@autosar_swc_aeb_rtARID_DEF.ObjData_i[18].LongPredTime.Crvt@ */ /end MEASUREMENT
/begin MEASUREMENT autosar_swc_aeb_rtARID_DEF.ObjData_i[18].LongPredTime.InPath "" UBYTE autosar_swc_aeb_CM_logical 0 0 0 1 ECU_ADDRESS 0xfe4a5ad9 /* @ECU_Address@autosar_swc_aeb_rtARID_DEF.ObjData_i[18].LongPredTime.InPath@ */ /end MEASUREMENT
/begin MEASUREMENT autosar_swc_aeb_rtARID_DEF.ObjData_i[18].LongPredTime.ObjOnCmngAndBrkg "" UBYTE autosar_swc_aeb_CM_logical 0 0 0 1 ECU_ADDRESS 0xfe4a5ada /* @ECU_Address@autosar_swc_aeb_rtARID_DEF.ObjData_i[18].LongPredTime.ObjOnCmngAndBrkg@ */ /end MEASUREMENT
/begin MEASUREMENT autosar_swc_aeb_rtARID_DEF.ObjData_i[18].LongPredTime.TTMSelected "" UBYTE autosar_swc_aeb_CM_logical 0 0 0 1 ECU_ADDRESS 0xfe4a5ad8 /* @ECU_Address@autosar_swc_aeb_rtARID_DEF.ObjData_i[18].LongPredTime.TTMSelected@ */ /end MEASUREMENT
/begin MEASUREMENT autosar_swc_aeb_rtARID_DEF.ObjData_i[18].LongPredTime.TimeToMiddleLgt "" FLOAT32_IEEE autosar_swc_aeb_CM_single 0 0 -3.4E+38 3.4E+38 ECU_ADDRESS 0xfe4a5ad0 /* @ECU_Address@autosar_swc_aeb_rtARID_DEF.ObjData_i[18].LongPredTime.TimeToMiddleLgt@ */ /end MEASUREMENT
/begin MEASUREMENT autosar_swc_aeb_rtARID_DEF.ObjData_i[18].LongPredTime.TimeToPassLgt "" FLOAT32_IEEE autosar_swc_aeb_CM_single 0 0 -3.4E+38 3.4E+38 ECU_ADDRESS 0xfe4a5ad4 /* @ECU_Address@autosar_swc_aeb_rtARID_DEF.ObjData_i[18].LongPredTime.TimeToPassLgt@ */ /end MEASUREMENT
/begin MEASUREMENT autosar_swc_aeb_rtARID_DEF.ObjData_i[18].LongPredTime.TimeToReachLgt "" FLOAT32_IEEE autosar_swc_aeb_CM_single 0 0 -3.4E+38 3.4E+38 ECU_ADDRESS 0xfe4a5acc /* @ECU_Address@autosar_swc_aeb_rtARID_DEF.ObjData_i[18].LongPredTime.TimeToReachLgt@ */ /end MEASUREMENT
/begin MEASUREMENT autosar_swc_aeb_rtARID_DEF.ObjData_i[18].MotionType.AbsHeading "" FLOAT32_IEEE autosar_swc_aeb_CM_single 0 0 -3.4E+38 3.4E+38 ECU_ADDRESS 0xfe4a5a88 /* @ECU_Address@autosar_swc_aeb_rtARID_DEF.ObjData_i[18].MotionType.AbsHeading@ */ /end MEASUREMENT
/begin MEASUREMENT autosar_swc_aeb_rtARID_DEF.ObjData_i[18].MotionType.CurvedMotion "" UBYTE autosar_swc_aeb_CM_logical 0 0 0 1 ECU_ADDRESS 0xfe4a5a86 /* @ECU_Address@autosar_swc_aeb_rtARID_DEF.ObjData_i[18].MotionType.CurvedMotion@ */ /end MEASUREMENT
/begin MEASUREMENT autosar_swc_aeb_rtARID_DEF.ObjData_i[18].MotionType.MovingOncoming "" UBYTE autosar_swc_aeb_CM_logical 0 0 0 1 ECU_ADDRESS 0xfe4a5a81 /* @ECU_Address@autosar_swc_aeb_rtARID_DEF.ObjData_i[18].MotionType.MovingOncoming@ */ /end MEASUREMENT
/begin MEASUREMENT autosar_swc_aeb_rtARID_DEF.ObjData_i[18].MotionType.ObjectIsMotorVehicle "Object type is Car, Truck, Motorcycle or Vehicle Of Unkown Class." UBYTE autosar_swc_aeb_CM_logical 0 0 0 1 ECU_ADDRESS 0xfe4a5a85 /* @ECU_Address@autosar_swc_aeb_rtARID_DEF.ObjData_i[18].MotionType.ObjectIsMotorVehicle@ */ /end MEASUREMENT
/begin MEASUREMENT autosar_swc_aeb_rtARID_DEF.ObjData_i[18].MotionType.ObjectIsVehicle "" UBYTE autosar_swc_aeb_CM_logical 0 0 0 1 ECU_ADDRESS 0xfe4a5a84 /* @ECU_Address@autosar_swc_aeb_rtARID_DEF.ObjData_i[18].MotionType.ObjectIsVehicle@ */ /end MEASUREMENT
/begin MEASUREMENT autosar_swc_aeb_rtARID_DEF.ObjData_i[18].MotionType.ParallellVehicleLongPred "" UBYTE autosar_swc_aeb_CM_logical 0 0 0 1 ECU_ADDRESS 0xfe4a5a82 /* @ECU_Address@autosar_swc_aeb_rtARID_DEF.ObjData_i[18].MotionType.ParallellVehicleLongPred@ */ /end MEASUREMENT
/begin MEASUREMENT autosar_swc_aeb_rtARID_DEF.ObjData_i[18].MotionType.ParallellVehicleShortPred "" UBYTE autosar_swc_aeb_CM_logical 0 0 0 1 ECU_ADDRESS 0xfe4a5a83 /* @ECU_Address@autosar_swc_aeb_rtARID_DEF.ObjData_i[18].MotionType.ParallellVehicleShortPred@ */ /end MEASUREMENT
/begin MEASUREMENT autosar_swc_aeb_rtARID_DEF.ObjData_i[18].MotionType.SideIsClosest "" UBYTE autosar_swc_aeb_CM_logical 0 0 0 1 ECU_ADDRESS 0xfe4a5a87 /* @ECU_Address@autosar_swc_aeb_rtARID_DEF.ObjData_i[18].MotionType.SideIsClosest@ */ /end MEASUREMENT
/begin MEASUREMENT autosar_swc_aeb_rtARID_DEF.ObjData_i[18].MotionType.Stationary "" UBYTE autosar_swc_aeb_CM_logical 0 0 0 1 ECU_ADDRESS 0xfe4a5a80 /* @ECU_Address@autosar_swc_aeb_rtARID_DEF.ObjData_i[18].MotionType.Stationary@ */ /end MEASUREMENT
/begin MEASUREMENT autosar_swc_aeb_rtARID_DEF.ObjData_i[18].Offsets.OffsLatInPathCloseEdge "" FLOAT32_IEEE autosar_swc_aeb_CM_single 0 0 -3.4E+38 3.4E+38 ECU_ADDRESS 0xfe4a5abc /* @ECU_Address@autosar_swc_aeb_rtARID_DEF.ObjData_i[18].Offsets.OffsLatInPathCloseEdge@ */ /end MEASUREMENT
/begin MEASUREMENT autosar_swc_aeb_rtARID_DEF.ObjData_i[18].Offsets.OffsLatInPathFarEdge "" FLOAT32_IEEE autosar_swc_aeb_CM_single 0 0 -3.4E+38 3.4E+38 ECU_ADDRESS 0xfe4a5ac0 /* @ECU_Address@autosar_swc_aeb_rtARID_DEF.ObjData_i[18].Offsets.OffsLatInPathFarEdge@ */ /end MEASUREMENT
/begin MEASUREMENT autosar_swc_aeb_rtARID_DEF.ObjData_i[18].Offsets.OffsLatInPathPrimaryTarget "" FLOAT32_IEEE autosar_swc_aeb_CM_single 0 0 -3.4E+38 3.4E+38 ECU_ADDRESS 0xfe4a5ab8 /* @ECU_Address@autosar_swc_aeb_rtARID_DEF.ObjData_i[18].Offsets.OffsLatInPathPrimaryTarget@ */ /end MEASUREMENT
/begin MEASUREMENT autosar_swc_aeb_rtARID_DEF.ObjData_i[18].Offsets.OffsLatIntersection "" FLOAT32_IEEE autosar_swc_aeb_CM_single 0 0 -3.4E+38 3.4E+38 ECU_ADDRESS 0xfe4a5ac4 /* @ECU_Address@autosar_swc_aeb_rtARID_DEF.ObjData_i[18].Offsets.OffsLatIntersection@ */ /end MEASUREMENT
/begin MEASUREMENT autosar_swc_aeb_rtARID_DEF.ObjData_i[18].Offsets.OffsLatLongPred "" FLOAT32_IEEE autosar_swc_aeb_CM_single 0 0 -3.4E+38 3.4E+38 ECU_ADDRESS 0xfe4a5aa8 /* @ECU_Address@autosar_swc_aeb_rtARID_DEF.ObjData_i[18].Offsets.OffsLatLongPred@ */ /end MEASUREMENT
/begin MEASUREMENT autosar_swc_aeb_rtARID_DEF.ObjData_i[18].Offsets.OffsLatManoeuvre "" FLOAT32_IEEE autosar_swc_aeb_CM_single 0 0 -3.4E+38 3.4E+38 ECU_ADDRESS 0xfe4a5ab4 /* @ECU_Address@autosar_swc_aeb_rtARID_DEF.ObjData_i[18].Offsets.OffsLatManoeuvre@ */ /end MEASUREMENT
/begin MEASUREMENT autosar_swc_aeb_rtARID_DEF.ObjData_i[18].Offsets.OffsLatMplTar "" FLOAT32_IEEE autosar_swc_aeb_CM_single 0 0 -3.4E+38 3.4E+38 ECU_ADDRESS 0xfe4a5ac8 /* @ECU_Address@autosar_swc_aeb_rtARID_DEF.ObjData_i[18].Offsets.OffsLatMplTar@ */ /end MEASUREMENT
/begin MEASUREMENT autosar_swc_aeb_rtARID_DEF.ObjData_i[18].Offsets.OffsLatShortPred "" FLOAT32_IEEE autosar_swc_aeb_CM_single 0 0 -3.4E+38 3.4E+38 ECU_ADDRESS 0xfe4a5ab0 /* @ECU_Address@autosar_swc_aeb_rtARID_DEF.ObjData_i[18].Offsets.OffsLatShortPred@ */ /end MEASUREMENT
/begin MEASUREMENT autosar_swc_aeb_rtARID_DEF.ObjData_i[18].Offsets.OffsLgtLongPred "" FLOAT32_IEEE autosar_swc_aeb_CM_single 0 0 -3.4E+38 3.4E+38 ECU_ADDRESS 0xfe4a5aa4 /* @ECU_Address@autosar_swc_aeb_rtARID_DEF.ObjData_i[18].Offsets.OffsLgtLongPred@ */ /end MEASUREMENT
/begin MEASUREMENT autosar_swc_aeb_rtARID_DEF.ObjData_i[18].Offsets.OffsLgtShortPred "" FLOAT32_IEEE autosar_swc_aeb_CM_single 0 0 -3.4E+38 3.4E+38 ECU_ADDRESS 0xfe4a5aac /* @ECU_Address@autosar_swc_aeb_rtARID_DEF.ObjData_i[18].Offsets.OffsLgtShortPred@ */ /end MEASUREMENT
/begin MEASUREMENT autosar_swc_aeb_rtARID_DEF.ObjData_i[18].PredictionValid "" UBYTE autosar_swc_aeb_CM_logical 0 0 0 1 ECU_ADDRESS 0xfe4a5aa1 /* @ECU_Address@autosar_swc_aeb_rtARID_DEF.ObjData_i[18].PredictionValid@ */ /end MEASUREMENT
/begin MEASUREMENT autosar_swc_aeb_rtARID_DEF.ObjData_i[18].ShortPredTime.A "" FLOAT32_IEEE autosar_swc_aeb_CM_single 0 0 -3.4E+38 3.4E+38 ECU_ADDRESS 0xfe4a5b04 /* @ECU_Address@autosar_swc_aeb_rtARID_DEF.ObjData_i[18].ShortPredTime.A@ */ /end MEASUREMENT
/begin MEASUREMENT autosar_swc_aeb_rtARID_DEF.ObjData_i[18].ShortPredTime.ALat "" FLOAT32_IEEE autosar_swc_aeb_CM_single 0 0 -3.4E+38 3.4E+38 ECU_ADDRESS 0xfe4a5b00 /* @ECU_Address@autosar_swc_aeb_rtARID_DEF.ObjData_i[18].ShortPredTime.ALat@ */ /end MEASUREMENT
/begin MEASUREMENT autosar_swc_aeb_rtARID_DEF.ObjData_i[18].ShortPredTime.ALgt "" FLOAT32_IEEE autosar_swc_aeb_CM_single 0 0 -3.4E+38 3.4E+38 ECU_ADDRESS 0xfe4a5afc /* @ECU_Address@autosar_swc_aeb_rtARID_DEF.ObjData_i[18].ShortPredTime.ALgt@ */ /end MEASUREMENT
/begin MEASUREMENT autosar_swc_aeb_rtARID_DEF.ObjData_i[18].ShortPredTime.Crvt "" FLOAT32_IEEE autosar_swc_aeb_CM_single 0 0 -3.4E+38 3.4E+38 ECU_ADDRESS 0xfe4a5b08 /* @ECU_Address@autosar_swc_aeb_rtARID_DEF.ObjData_i[18].ShortPredTime.Crvt@ */ /end MEASUREMENT
/begin MEASUREMENT autosar_swc_aeb_rtARID_DEF.ObjData_i[18].ShortPredTime.InPath "" UBYTE autosar_swc_aeb_CM_logical 0 0 0 1 ECU_ADDRESS 0xfe4a5af9 /* @ECU_Address@autosar_swc_aeb_rtARID_DEF.ObjData_i[18].ShortPredTime.InPath@ */ /end MEASUREMENT
/begin MEASUREMENT autosar_swc_aeb_rtARID_DEF.ObjData_i[18].ShortPredTime.ObjOnCmngAndBrkg "" UBYTE autosar_swc_aeb_CM_logical 0 0 0 1 ECU_ADDRESS 0xfe4a5afa /* @ECU_Address@autosar_swc_aeb_rtARID_DEF.ObjData_i[18].ShortPredTime.ObjOnCmngAndBrkg@ */ /end MEASUREMENT
/begin MEASUREMENT autosar_swc_aeb_rtARID_DEF.ObjData_i[18].ShortPredTime.TTMSelected "" UBYTE autosar_swc_aeb_CM_logical 0 0 0 1 ECU_ADDRESS 0xfe4a5af8 /* @ECU_Address@autosar_swc_aeb_rtARID_DEF.ObjData_i[18].ShortPredTime.TTMSelected@ */ /end MEASUREMENT
/begin MEASUREMENT autosar_swc_aeb_rtARID_DEF.ObjData_i[18].ShortPredTime.TimeToMiddleLgt "" FLOAT32_IEEE autosar_swc_aeb_CM_single 0 0 -3.4E+38 3.4E+38 ECU_ADDRESS 0xfe4a5af0 /* @ECU_Address@autosar_swc_aeb_rtARID_DEF.ObjData_i[18].ShortPredTime.TimeToMiddleLgt@ */ /end MEASUREMENT
/begin MEASUREMENT autosar_swc_aeb_rtARID_DEF.ObjData_i[18].ShortPredTime.TimeToPassLgt "" FLOAT32_IEEE autosar_swc_aeb_CM_single 0 0 -3.4E+38 3.4E+38 ECU_ADDRESS 0xfe4a5af4 /* @ECU_Address@autosar_swc_aeb_rtARID_DEF.ObjData_i[18].ShortPredTime.TimeToPassLgt@ */ /end MEASUREMENT
/begin MEASUREMENT autosar_swc_aeb_rtARID_DEF.ObjData_i[18].ShortPredTime.TimeToReachLgt "" FLOAT32_IEEE autosar_swc_aeb_CM_single 0 0 -3.4E+38 3.4E+38 ECU_ADDRESS 0xfe4a5aec /* @ECU_Address@autosar_swc_aeb_rtARID_DEF.ObjData_i[18].ShortPredTime.TimeToReachLgt@ */ /end MEASUREMENT
/begin MEASUREMENT autosar_swc_aeb_rtARID_DEF.ObjData_i[19].BoundingBox.CosRotation "" FLOAT32_IEEE autosar_swc_aeb_CM_single 0 0 -3.4E+38 3.4E+38 ECU_ADDRESS 0xfe4a5b28 /* @ECU_Address@autosar_swc_aeb_rtARID_DEF.ObjData_i[19].BoundingBox.CosRotation@ */ /end MEASUREMENT
/begin MEASUREMENT autosar_swc_aeb_rtARID_DEF.ObjData_i[19].BoundingBox.LengthSideLat "" FLOAT32_IEEE autosar_swc_aeb_CM_single 0 0 -3.4E+38 3.4E+38 ECU_ADDRESS 0xfe4a5b1c /* @ECU_Address@autosar_swc_aeb_rtARID_DEF.ObjData_i[19].BoundingBox.LengthSideLat@ */ /end MEASUREMENT
/begin MEASUREMENT autosar_swc_aeb_rtARID_DEF.ObjData_i[19].BoundingBox.LengthSideLgt "" FLOAT32_IEEE autosar_swc_aeb_CM_single 0 0 -3.4E+38 3.4E+38 ECU_ADDRESS 0xfe4a5b20 /* @ECU_Address@autosar_swc_aeb_rtARID_DEF.ObjData_i[19].BoundingBox.LengthSideLgt@ */ /end MEASUREMENT
/begin MEASUREMENT autosar_swc_aeb_rtARID_DEF.ObjData_i[19].BoundingBox.RotationAngle "" FLOAT32_IEEE autosar_swc_aeb_CM_single 0 0 -3.4E+38 3.4E+38 ECU_ADDRESS 0xfe4a5b2c /* @ECU_Address@autosar_swc_aeb_rtARID_DEF.ObjData_i[19].BoundingBox.RotationAngle@ */ /end MEASUREMENT
/begin MEASUREMENT autosar_swc_aeb_rtARID_DEF.ObjData_i[19].BoundingBox.SinRotation "" FLOAT32_IEEE autosar_swc_aeb_CM_single 0 0 -3.4E+38 3.4E+38 ECU_ADDRESS 0xfe4a5b24 /* @ECU_Address@autosar_swc_aeb_rtARID_DEF.ObjData_i[19].BoundingBox.SinRotation@ */ /end MEASUREMENT
/begin MEASUREMENT autosar_swc_aeb_rtARID_DEF.ObjData_i[19].Idn "" ULONG autosar_swc_aeb_CM_uint32 0 0 0 4294967295 ECU_ADDRESS 0xfe4a5b9c /* @ECU_Address@autosar_swc_aeb_rtARID_DEF.ObjData_i[19].Idn@ */ /end MEASUREMENT
/begin MEASUREMENT autosar_swc_aeb_rtARID_DEF.ObjData_i[19].InPathAtCurrentPosition "" UBYTE autosar_swc_aeb_CM_logical 0 0 0 1 ECU_ADDRESS 0xfe4a5b30 /* @ECU_Address@autosar_swc_aeb_rtARID_DEF.ObjData_i[19].InPathAtCurrentPosition@ */ /end MEASUREMENT
/begin MEASUREMENT autosar_swc_aeb_rtARID_DEF.ObjData_i[19].LongPredTime.A "" FLOAT32_IEEE autosar_swc_aeb_CM_single 0 0 -3.4E+38 3.4E+38 ECU_ADDRESS 0xfe4a5b74 /* @ECU_Address@autosar_swc_aeb_rtARID_DEF.ObjData_i[19].LongPredTime.A@ */ /end MEASUREMENT
/begin MEASUREMENT autosar_swc_aeb_rtARID_DEF.ObjData_i[19].LongPredTime.ALat "" FLOAT32_IEEE autosar_swc_aeb_CM_single 0 0 -3.4E+38 3.4E+38 ECU_ADDRESS 0xfe4a5b70 /* @ECU_Address@autosar_swc_aeb_rtARID_DEF.ObjData_i[19].LongPredTime.ALat@ */ /end MEASUREMENT
/begin MEASUREMENT autosar_swc_aeb_rtARID_DEF.ObjData_i[19].LongPredTime.ALgt "" FLOAT32_IEEE autosar_swc_aeb_CM_single 0 0 -3.4E+38 3.4E+38 ECU_ADDRESS 0xfe4a5b6c /* @ECU_Address@autosar_swc_aeb_rtARID_DEF.ObjData_i[19].LongPredTime.ALgt@ */ /end MEASUREMENT
/begin MEASUREMENT autosar_swc_aeb_rtARID_DEF.ObjData_i[19].LongPredTime.Crvt "" FLOAT32_IEEE autosar_swc_aeb_CM_single 0 0 -3.4E+38 3.4E+38 ECU_ADDRESS 0xfe4a5b78 /* @ECU_Address@autosar_swc_aeb_rtARID_DEF.ObjData_i[19].LongPredTime.Crvt@ */ /end MEASUREMENT
/begin MEASUREMENT autosar_swc_aeb_rtARID_DEF.ObjData_i[19].LongPredTime.InPath "" UBYTE autosar_swc_aeb_CM_logical 0 0 0 1 ECU_ADDRESS 0xfe4a5b69 /* @ECU_Address@autosar_swc_aeb_rtARID_DEF.ObjData_i[19].LongPredTime.InPath@ */ /end MEASUREMENT
/begin MEASUREMENT autosar_swc_aeb_rtARID_DEF.ObjData_i[19].LongPredTime.ObjOnCmngAndBrkg "" UBYTE autosar_swc_aeb_CM_logical 0 0 0 1 ECU_ADDRESS 0xfe4a5b6a /* @ECU_Address@autosar_swc_aeb_rtARID_DEF.ObjData_i[19].LongPredTime.ObjOnCmngAndBrkg@ */ /end MEASUREMENT
/begin MEASUREMENT autosar_swc_aeb_rtARID_DEF.ObjData_i[19].LongPredTime.TTMSelected "" UBYTE autosar_swc_aeb_CM_logical 0 0 0 1 ECU_ADDRESS 0xfe4a5b68 /* @ECU_Address@autosar_swc_aeb_rtARID_DEF.ObjData_i[19].LongPredTime.TTMSelected@ */ /end MEASUREMENT
/begin MEASUREMENT autosar_swc_aeb_rtARID_DEF.ObjData_i[19].LongPredTime.TimeToMiddleLgt "" FLOAT32_IEEE autosar_swc_aeb_CM_single 0 0 -3.4E+38 3.4E+38 ECU_ADDRESS 0xfe4a5b60 /* @ECU_Address@autosar_swc_aeb_rtARID_DEF.ObjData_i[19].LongPredTime.TimeToMiddleLgt@ */ /end MEASUREMENT
/begin MEASUREMENT autosar_swc_aeb_rtARID_DEF.ObjData_i[19].LongPredTime.TimeToPassLgt "" FLOAT32_IEEE autosar_swc_aeb_CM_single 0 0 -3.4E+38 3.4E+38 ECU_ADDRESS 0xfe4a5b64 /* @ECU_Address@autosar_swc_aeb_rtARID_DEF.ObjData_i[19].LongPredTime.TimeToPassLgt@ */ /end MEASUREMENT
/begin MEASUREMENT autosar_swc_aeb_rtARID_DEF.ObjData_i[19].LongPredTime.TimeToReachLgt "" FLOAT32_IEEE autosar_swc_aeb_CM_single 0 0 -3.4E+38 3.4E+38 ECU_ADDRESS 0xfe4a5b5c /* @ECU_Address@autosar_swc_aeb_rtARID_DEF.ObjData_i[19].LongPredTime.TimeToReachLgt@ */ /end MEASUREMENT
/begin MEASUREMENT autosar_swc_aeb_rtARID_DEF.ObjData_i[19].MotionType.AbsHeading "" FLOAT32_IEEE autosar_swc_aeb_CM_single 0 0 -3.4E+38 3.4E+38 ECU_ADDRESS 0xfe4a5b18 /* @ECU_Address@autosar_swc_aeb_rtARID_DEF.ObjData_i[19].MotionType.AbsHeading@ */ /end MEASUREMENT
/begin MEASUREMENT autosar_swc_aeb_rtARID_DEF.ObjData_i[19].MotionType.CurvedMotion "" UBYTE autosar_swc_aeb_CM_logical 0 0 0 1 ECU_ADDRESS 0xfe4a5b16 /* @ECU_Address@autosar_swc_aeb_rtARID_DEF.ObjData_i[19].MotionType.CurvedMotion@ */ /end MEASUREMENT
/begin MEASUREMENT autosar_swc_aeb_rtARID_DEF.ObjData_i[19].MotionType.MovingOncoming "" UBYTE autosar_swc_aeb_CM_logical 0 0 0 1 ECU_ADDRESS 0xfe4a5b11 /* @ECU_Address@autosar_swc_aeb_rtARID_DEF.ObjData_i[19].MotionType.MovingOncoming@ */ /end MEASUREMENT
/begin MEASUREMENT autosar_swc_aeb_rtARID_DEF.ObjData_i[19].MotionType.ObjectIsMotorVehicle "Object type is Car, Truck, Motorcycle or Vehicle Of Unkown Class." UBYTE autosar_swc_aeb_CM_logical 0 0 0 1 ECU_ADDRESS 0xfe4a5b15 /* @ECU_Address@autosar_swc_aeb_rtARID_DEF.ObjData_i[19].MotionType.ObjectIsMotorVehicle@ */ /end MEASUREMENT
/begin MEASUREMENT autosar_swc_aeb_rtARID_DEF.ObjData_i[19].MotionType.ObjectIsVehicle "" UBYTE autosar_swc_aeb_CM_logical 0 0 0 1 ECU_ADDRESS 0xfe4a5b14 /* @ECU_Address@autosar_swc_aeb_rtARID_DEF.ObjData_i[19].MotionType.ObjectIsVehicle@ */ /end MEASUREMENT
/begin MEASUREMENT autosar_swc_aeb_rtARID_DEF.ObjData_i[19].MotionType.ParallellVehicleLongPred "" UBYTE autosar_swc_aeb_CM_logical 0 0 0 1 ECU_ADDRESS 0xfe4a5b12 /* @ECU_Address@autosar_swc_aeb_rtARID_DEF.ObjData_i[19].MotionType.ParallellVehicleLongPred@ */ /end MEASUREMENT
/begin MEASUREMENT autosar_swc_aeb_rtARID_DEF.ObjData_i[19].MotionType.ParallellVehicleShortPred "" UBYTE autosar_swc_aeb_CM_logical 0 0 0 1 ECU_ADDRESS 0xfe4a5b13 /* @ECU_Address@autosar_swc_aeb_rtARID_DEF.ObjData_i[19].MotionType.ParallellVehicleShortPred@ */ /end MEASUREMENT
/begin MEASUREMENT autosar_swc_aeb_rtARID_DEF.ObjData_i[19].MotionType.SideIsClosest "" UBYTE autosar_swc_aeb_CM_logical 0 0 0 1 ECU_ADDRESS 0xfe4a5b17 /* @ECU_Address@autosar_swc_aeb_rtARID_DEF.ObjData_i[19].MotionType.SideIsClosest@ */ /end MEASUREMENT
/begin MEASUREMENT autosar_swc_aeb_rtARID_DEF.ObjData_i[19].MotionType.Stationary "" UBYTE autosar_swc_aeb_CM_logical 0 0 0 1 ECU_ADDRESS 0xfe4a5b10 /* @ECU_Address@autosar_swc_aeb_rtARID_DEF.ObjData_i[19].MotionType.Stationary@ */ /end MEASUREMENT
/begin MEASUREMENT autosar_swc_aeb_rtARID_DEF.ObjData_i[19].Offsets.OffsLatInPathCloseEdge "" FLOAT32_IEEE autosar_swc_aeb_CM_single 0 0 -3.4E+38 3.4E+38 ECU_ADDRESS 0xfe4a5b4c /* @ECU_Address@autosar_swc_aeb_rtARID_DEF.ObjData_i[19].Offsets.OffsLatInPathCloseEdge@ */ /end MEASUREMENT
/begin MEASUREMENT autosar_swc_aeb_rtARID_DEF.ObjData_i[19].Offsets.OffsLatInPathFarEdge "" FLOAT32_IEEE autosar_swc_aeb_CM_single 0 0 -3.4E+38 3.4E+38 ECU_ADDRESS 0xfe4a5b50 /* @ECU_Address@autosar_swc_aeb_rtARID_DEF.ObjData_i[19].Offsets.OffsLatInPathFarEdge@ */ /end MEASUREMENT
/begin MEASUREMENT autosar_swc_aeb_rtARID_DEF.ObjData_i[19].Offsets.OffsLatInPathPrimaryTarget "" FLOAT32_IEEE autosar_swc_aeb_CM_single 0 0 -3.4E+38 3.4E+38 ECU_ADDRESS 0xfe4a5b48 /* @ECU_Address@autosar_swc_aeb_rtARID_DEF.ObjData_i[19].Offsets.OffsLatInPathPrimaryTarget@ */ /end MEASUREMENT
/begin MEASUREMENT autosar_swc_aeb_rtARID_DEF.ObjData_i[19].Offsets.OffsLatIntersection "" FLOAT32_IEEE autosar_swc_aeb_CM_single 0 0 -3.4E+38 3.4E+38 ECU_ADDRESS 0xfe4a5b54 /* @ECU_Address@autosar_swc_aeb_rtARID_DEF.ObjData_i[19].Offsets.OffsLatIntersection@ */ /end MEASUREMENT
/begin MEASUREMENT autosar_swc_aeb_rtARID_DEF.ObjData_i[19].Offsets.OffsLatLongPred "" FLOAT32_IEEE autosar_swc_aeb_CM_single 0 0 -3.4E+38 3.4E+38 ECU_ADDRESS 0xfe4a5b38 /* @ECU_Address@autosar_swc_aeb_rtARID_DEF.ObjData_i[19].Offsets.OffsLatLongPred@ */ /end MEASUREMENT
/begin MEASUREMENT autosar_swc_aeb_rtARID_DEF.ObjData_i[19].Offsets.OffsLatManoeuvre "" FLOAT32_IEEE autosar_swc_aeb_CM_single 0 0 -3.4E+38 3.4E+38 ECU_ADDRESS 0xfe4a5b44 /* @ECU_Address@autosar_swc_aeb_rtARID_DEF.ObjData_i[19].Offsets.OffsLatManoeuvre@ */ /end MEASUREMENT
/begin MEASUREMENT autosar_swc_aeb_rtARID_DEF.ObjData_i[19].Offsets.OffsLatMplTar "" FLOAT32_IEEE autosar_swc_aeb_CM_single 0 0 -3.4E+38 3.4E+38 ECU_ADDRESS 0xfe4a5b58 /* @ECU_Address@autosar_swc_aeb_rtARID_DEF.ObjData_i[19].Offsets.OffsLatMplTar@ */ /end MEASUREMENT
/begin MEASUREMENT autosar_swc_aeb_rtARID_DEF.ObjData_i[19].Offsets.OffsLatShortPred "" FLOAT32_IEEE autosar_swc_aeb_CM_single 0 0 -3.4E+38 3.4E+38 ECU_ADDRESS 0xfe4a5b40 /* @ECU_Address@autosar_swc_aeb_rtARID_DEF.ObjData_i[19].Offsets.OffsLatShortPred@ */ /end MEASUREMENT
/begin MEASUREMENT autosar_swc_aeb_rtARID_DEF.ObjData_i[19].Offsets.OffsLgtLongPred "" FLOAT32_IEEE autosar_swc_aeb_CM_single 0 0 -3.4E+38 3.4E+38 ECU_ADDRESS 0xfe4a5b34 /* @ECU_Address@autosar_swc_aeb_rtARID_DEF.ObjData_i[19].Offsets.OffsLgtLongPred@ */ /end MEASUREMENT
/begin MEASUREMENT autosar_swc_aeb_rtARID_DEF.ObjData_i[19].Offsets.OffsLgtShortPred "" FLOAT32_IEEE autosar_swc_aeb_CM_single 0 0 -3.4E+38 3.4E+38 ECU_ADDRESS 0xfe4a5b3c /* @ECU_Address@autosar_swc_aeb_rtARID_DEF.ObjData_i[19].Offsets.OffsLgtShortPred@ */ /end MEASUREMENT
/begin MEASUREMENT autosar_swc_aeb_rtARID_DEF.ObjData_i[19].PredictionValid "" UBYTE autosar_swc_aeb_CM_logical 0 0 0 1 ECU_ADDRESS 0xfe4a5b31 /* @ECU_Address@autosar_swc_aeb_rtARID_DEF.ObjData_i[19].PredictionValid@ */ /end MEASUREMENT
/begin MEASUREMENT autosar_swc_aeb_rtARID_DEF.ObjData_i[19].ShortPredTime.A "" FLOAT32_IEEE autosar_swc_aeb_CM_single 0 0 -3.4E+38 3.4E+38 ECU_ADDRESS 0xfe4a5b94 /* @ECU_Address@autosar_swc_aeb_rtARID_DEF.ObjData_i[19].ShortPredTime.A@ */ /end MEASUREMENT
/begin MEASUREMENT autosar_swc_aeb_rtARID_DEF.ObjData_i[19].ShortPredTime.ALat "" FLOAT32_IEEE autosar_swc_aeb_CM_single 0 0 -3.4E+38 3.4E+38 ECU_ADDRESS 0xfe4a5b90 /* @ECU_Address@autosar_swc_aeb_rtARID_DEF.ObjData_i[19].ShortPredTime.ALat@ */ /end MEASUREMENT
/begin MEASUREMENT autosar_swc_aeb_rtARID_DEF.ObjData_i[19].ShortPredTime.ALgt "" FLOAT32_IEEE autosar_swc_aeb_CM_single 0 0 -3.4E+38 3.4E+38 ECU_ADDRESS 0xfe4a5b8c /* @ECU_Address@autosar_swc_aeb_rtARID_DEF.ObjData_i[19].ShortPredTime.ALgt@ */ /end MEASUREMENT
/begin MEASUREMENT autosar_swc_aeb_rtARID_DEF.ObjData_i[19].ShortPredTime.Crvt "" FLOAT32_IEEE autosar_swc_aeb_CM_single 0 0 -3.4E+38 3.4E+38 ECU_ADDRESS 0xfe4a5b98 /* @ECU_Address@autosar_swc_aeb_rtARID_DEF.ObjData_i[19].ShortPredTime.Crvt@ */ /end MEASUREMENT
/begin MEASUREMENT autosar_swc_aeb_rtARID_DEF.ObjData_i[19].ShortPredTime.InPath "" UBYTE autosar_swc_aeb_CM_logical 0 0 0 1 ECU_ADDRESS 0xfe4a5b89 /* @ECU_Address@autosar_swc_aeb_rtARID_DEF.ObjData_i[19].ShortPredTime.InPath@ */ /end MEASUREMENT
/begin MEASUREMENT autosar_swc_aeb_rtARID_DEF.ObjData_i[19].ShortPredTime.ObjOnCmngAndBrkg "" UBYTE autosar_swc_aeb_CM_logical 0 0 0 1 ECU_ADDRESS 0xfe4a5b8a /* @ECU_Address@autosar_swc_aeb_rtARID_DEF.ObjData_i[19].ShortPredTime.ObjOnCmngAndBrkg@ */ /end MEASUREMENT
/begin MEASUREMENT autosar_swc_aeb_rtARID_DEF.ObjData_i[19].ShortPredTime.TTMSelected "" UBYTE autosar_swc_aeb_CM_logical 0 0 0 1 ECU_ADDRESS 0xfe4a5b88 /* @ECU_Address@autosar_swc_aeb_rtARID_DEF.ObjData_i[19].ShortPredTime.TTMSelected@ */ /end MEASUREMENT
/begin MEASUREMENT autosar_swc_aeb_rtARID_DEF.ObjData_i[19].ShortPredTime.TimeToMiddleLgt "" FLOAT32_IEEE autosar_swc_aeb_CM_single 0 0 -3.4E+38 3.4E+38 ECU_ADDRESS 0xfe4a5b80 /* @ECU_Address@autosar_swc_aeb_rtARID_DEF.ObjData_i[19].ShortPredTime.TimeToMiddleLgt@ */ /end MEASUREMENT
/begin MEASUREMENT autosar_swc_aeb_rtARID_DEF.ObjData_i[19].ShortPredTime.TimeToPassLgt "" FLOAT32_IEEE autosar_swc_aeb_CM_single 0 0 -3.4E+38 3.4E+38 ECU_ADDRESS 0xfe4a5b84 /* @ECU_Address@autosar_swc_aeb_rtARID_DEF.ObjData_i[19].ShortPredTime.TimeToPassLgt@ */ /end MEASUREMENT
/begin MEASUREMENT autosar_swc_aeb_rtARID_DEF.ObjData_i[19].ShortPredTime.TimeToReachLgt "" FLOAT32_IEEE autosar_swc_aeb_CM_single 0 0 -3.4E+38 3.4E+38 ECU_ADDRESS 0xfe4a5b7c /* @ECU_Address@autosar_swc_aeb_rtARID_DEF.ObjData_i[19].ShortPredTime.TimeToReachLgt@ */ /end MEASUREMENT
/begin MEASUREMENT autosar_swc_aeb_rtARID_DEF.ObjData_i[1].BoundingBox.CosRotation "" FLOAT32_IEEE autosar_swc_aeb_CM_single 0 0 -3.4E+38 3.4E+38 ECU_ADDRESS 0xfe4a5108 /* @ECU_Address@autosar_swc_aeb_rtARID_DEF.ObjData_i[1].BoundingBox.CosRotation@ */ /end MEASUREMENT
/begin MEASUREMENT autosar_swc_aeb_rtARID_DEF.ObjData_i[1].BoundingBox.LengthSideLat "" FLOAT32_IEEE autosar_swc_aeb_CM_single 0 0 -3.4E+38 3.4E+38 ECU_ADDRESS 0xfe4a50fc /* @ECU_Address@autosar_swc_aeb_rtARID_DEF.ObjData_i[1].BoundingBox.LengthSideLat@ */ /end MEASUREMENT
/begin MEASUREMENT autosar_swc_aeb_rtARID_DEF.ObjData_i[1].BoundingBox.LengthSideLgt "" FLOAT32_IEEE autosar_swc_aeb_CM_single 0 0 -3.4E+38 3.4E+38 ECU_ADDRESS 0xfe4a5100 /* @ECU_Address@autosar_swc_aeb_rtARID_DEF.ObjData_i[1].BoundingBox.LengthSideLgt@ */ /end MEASUREMENT
/begin MEASUREMENT autosar_swc_aeb_rtARID_DEF.ObjData_i[1].BoundingBox.RotationAngle "" FLOAT32_IEEE autosar_swc_aeb_CM_single 0 0 -3.4E+38 3.4E+38 ECU_ADDRESS 0xfe4a510c /* @ECU_Address@autosar_swc_aeb_rtARID_DEF.ObjData_i[1].BoundingBox.RotationAngle@ */ /end MEASUREMENT
/begin MEASUREMENT autosar_swc_aeb_rtARID_DEF.ObjData_i[1].BoundingBox.SinRotation "" FLOAT32_IEEE autosar_swc_aeb_CM_single 0 0 -3.4E+38 3.4E+38 ECU_ADDRESS 0xfe4a5104 /* @ECU_Address@autosar_swc_aeb_rtARID_DEF.ObjData_i[1].BoundingBox.SinRotation@ */ /end MEASUREMENT
/begin MEASUREMENT autosar_swc_aeb_rtARID_DEF.ObjData_i[1].Idn "" ULONG autosar_swc_aeb_CM_uint32 0 0 0 4294967295 ECU_ADDRESS 0xfe4a517c /* @ECU_Address@autosar_swc_aeb_rtARID_DEF.ObjData_i[1].Idn@ */ /end MEASUREMENT
/begin MEASUREMENT autosar_swc_aeb_rtARID_DEF.ObjData_i[1].InPathAtCurrentPosition "" UBYTE autosar_swc_aeb_CM_logical 0 0 0 1 ECU_ADDRESS 0xfe4a5110 /* @ECU_Address@autosar_swc_aeb_rtARID_DEF.ObjData_i[1].InPathAtCurrentPosition@ */ /end MEASUREMENT
/begin MEASUREMENT autosar_swc_aeb_rtARID_DEF.ObjData_i[1].LongPredTime.A "" FLOAT32_IEEE autosar_swc_aeb_CM_single 0 0 -3.4E+38 3.4E+38 ECU_ADDRESS 0xfe4a5154 /* @ECU_Address@autosar_swc_aeb_rtARID_DEF.ObjData_i[1].LongPredTime.A@ */ /end MEASUREMENT
/begin MEASUREMENT autosar_swc_aeb_rtARID_DEF.ObjData_i[1].LongPredTime.ALat "" FLOAT32_IEEE autosar_swc_aeb_CM_single 0 0 -3.4E+38 3.4E+38 ECU_ADDRESS 0xfe4a5150 /* @ECU_Address@autosar_swc_aeb_rtARID_DEF.ObjData_i[1].LongPredTime.ALat@ */ /end MEASUREMENT
/begin MEASUREMENT autosar_swc_aeb_rtARID_DEF.ObjData_i[1].LongPredTime.ALgt "" FLOAT32_IEEE autosar_swc_aeb_CM_single 0 0 -3.4E+38 3.4E+38 ECU_ADDRESS 0xfe4a514c /* @ECU_Address@autosar_swc_aeb_rtARID_DEF.ObjData_i[1].LongPredTime.ALgt@ */ /end MEASUREMENT
/begin MEASUREMENT autosar_swc_aeb_rtARID_DEF.ObjData_i[1].LongPredTime.Crvt "" FLOAT32_IEEE autosar_swc_aeb_CM_single 0 0 -3.4E+38 3.4E+38 ECU_ADDRESS 0xfe4a5158 /* @ECU_Address@autosar_swc_aeb_rtARID_DEF.ObjData_i[1].LongPredTime.Crvt@ */ /end MEASUREMENT
/begin MEASUREMENT autosar_swc_aeb_rtARID_DEF.ObjData_i[1].LongPredTime.InPath "" UBYTE autosar_swc_aeb_CM_logical 0 0 0 1 ECU_ADDRESS 0xfe4a5149 /* @ECU_Address@autosar_swc_aeb_rtARID_DEF.ObjData_i[1].LongPredTime.InPath@ */ /end MEASUREMENT
/begin MEASUREMENT autosar_swc_aeb_rtARID_DEF.ObjData_i[1].LongPredTime.ObjOnCmngAndBrkg "" UBYTE autosar_swc_aeb_CM_logical 0 0 0 1 ECU_ADDRESS 0xfe4a514a /* @ECU_Address@autosar_swc_aeb_rtARID_DEF.ObjData_i[1].LongPredTime.ObjOnCmngAndBrkg@ */ /end MEASUREMENT
/begin MEASUREMENT autosar_swc_aeb_rtARID_DEF.ObjData_i[1].LongPredTime.TTMSelected "" UBYTE autosar_swc_aeb_CM_logical 0 0 0 1 ECU_ADDRESS 0xfe4a5148 /* @ECU_Address@autosar_swc_aeb_rtARID_DEF.ObjData_i[1].LongPredTime.TTMSelected@ */ /end MEASUREMENT
/begin MEASUREMENT autosar_swc_aeb_rtARID_DEF.ObjData_i[1].LongPredTime.TimeToMiddleLgt "" FLOAT32_IEEE autosar_swc_aeb_CM_single 0 0 -3.4E+38 3.4E+38 ECU_ADDRESS 0xfe4a5140 /* @ECU_Address@autosar_swc_aeb_rtARID_DEF.ObjData_i[1].LongPredTime.TimeToMiddleLgt@ */ /end MEASUREMENT
/begin MEASUREMENT autosar_swc_aeb_rtARID_DEF.ObjData_i[1].LongPredTime.TimeToPassLgt "" FLOAT32_IEEE autosar_swc_aeb_CM_single 0 0 -3.4E+38 3.4E+38 ECU_ADDRESS 0xfe4a5144 /* @ECU_Address@autosar_swc_aeb_rtARID_DEF.ObjData_i[1].LongPredTime.TimeToPassLgt@ */ /end MEASUREMENT
/begin MEASUREMENT autosar_swc_aeb_rtARID_DEF.ObjData_i[1].LongPredTime.TimeToReachLgt "" FLOAT32_IEEE autosar_swc_aeb_CM_single 0 0 -3.4E+38 3.4E+38 ECU_ADDRESS 0xfe4a513c /* @ECU_Address@autosar_swc_aeb_rtARID_DEF.ObjData_i[1].LongPredTime.TimeToReachLgt@ */ /end MEASUREMENT
/begin MEASUREMENT autosar_swc_aeb_rtARID_DEF.ObjData_i[1].MotionType.AbsHeading "" FLOAT32_IEEE autosar_swc_aeb_CM_single 0 0 -3.4E+38 3.4E+38 ECU_ADDRESS 0xfe4a50f8 /* @ECU_Address@autosar_swc_aeb_rtARID_DEF.ObjData_i[1].MotionType.AbsHeading@ */ /end MEASUREMENT
/begin MEASUREMENT autosar_swc_aeb_rtARID_DEF.ObjData_i[1].MotionType.CurvedMotion "" UBYTE autosar_swc_aeb_CM_logical 0 0 0 1 ECU_ADDRESS 0xfe4a50f6 /* @ECU_Address@autosar_swc_aeb_rtARID_DEF.ObjData_i[1].MotionType.CurvedMotion@ */ /end MEASUREMENT
/begin MEASUREMENT autosar_swc_aeb_rtARID_DEF.ObjData_i[1].MotionType.MovingOncoming "" UBYTE autosar_swc_aeb_CM_logical 0 0 0 1 ECU_ADDRESS 0xfe4a50f1 /* @ECU_Address@autosar_swc_aeb_rtARID_DEF.ObjData_i[1].MotionType.MovingOncoming@ */ /end MEASUREMENT
/begin MEASUREMENT autosar_swc_aeb_rtARID_DEF.ObjData_i[1].MotionType.ObjectIsMotorVehicle "Object type is Car, Truck, Motorcycle or Vehicle Of Unkown Class." UBYTE autosar_swc_aeb_CM_logical 0 0 0 1 ECU_ADDRESS 0xfe4a50f5 /* @ECU_Address@autosar_swc_aeb_rtARID_DEF.ObjData_i[1].MotionType.ObjectIsMotorVehicle@ */ /end MEASUREMENT
/begin MEASUREMENT autosar_swc_aeb_rtARID_DEF.ObjData_i[1].MotionType.ObjectIsVehicle "" UBYTE autosar_swc_aeb_CM_logical 0 0 0 1 ECU_ADDRESS 0xfe4a50f4 /* @ECU_Address@autosar_swc_aeb_rtARID_DEF.ObjData_i[1].MotionType.ObjectIsVehicle@ */ /end MEASUREMENT
/begin MEASUREMENT autosar_swc_aeb_rtARID_DEF.ObjData_i[1].MotionType.ParallellVehicleLongPred "" UBYTE autosar_swc_aeb_CM_logical 0 0 0 1 ECU_ADDRESS 0xfe4a50f2 /* @ECU_Address@autosar_swc_aeb_rtARID_DEF.ObjData_i[1].MotionType.ParallellVehicleLongPred@ */ /end MEASUREMENT
/begin MEASUREMENT autosar_swc_aeb_rtARID_DEF.ObjData_i[1].MotionType.ParallellVehicleShortPred "" UBYTE autosar_swc_aeb_CM_logical 0 0 0 1 ECU_ADDRESS 0xfe4a50f3 /* @ECU_Address@autosar_swc_aeb_rtARID_DEF.ObjData_i[1].MotionType.ParallellVehicleShortPred@ */ /end MEASUREMENT
/begin MEASUREMENT autosar_swc_aeb_rtARID_DEF.ObjData_i[1].MotionType.SideIsClosest "" UBYTE autosar_swc_aeb_CM_logical 0 0 0 1 ECU_ADDRESS 0xfe4a50f7 /* @ECU_Address@autosar_swc_aeb_rtARID_DEF.ObjData_i[1].MotionType.SideIsClosest@ */ /end MEASUREMENT
/begin MEASUREMENT autosar_swc_aeb_rtARID_DEF.ObjData_i[1].MotionType.Stationary "" UBYTE autosar_swc_aeb_CM_logical 0 0 0 1 ECU_ADDRESS 0xfe4a50f0 /* @ECU_Address@autosar_swc_aeb_rtARID_DEF.ObjData_i[1].MotionType.Stationary@ */ /end MEASUREMENT
/begin MEASUREMENT autosar_swc_aeb_rtARID_DEF.ObjData_i[1].Offsets.OffsLatInPathCloseEdge "" FLOAT32_IEEE autosar_swc_aeb_CM_single 0 0 -3.4E+38 3.4E+38 ECU_ADDRESS 0xfe4a512c /* @ECU_Address@autosar_swc_aeb_rtARID_DEF.ObjData_i[1].Offsets.OffsLatInPathCloseEdge@ */ /end MEASUREMENT
/begin MEASUREMENT autosar_swc_aeb_rtARID_DEF.ObjData_i[1].Offsets.OffsLatInPathFarEdge "" FLOAT32_IEEE autosar_swc_aeb_CM_single 0 0 -3.4E+38 3.4E+38 ECU_ADDRESS 0xfe4a5130 /* @ECU_Address@autosar_swc_aeb_rtARID_DEF.ObjData_i[1].Offsets.OffsLatInPathFarEdge@ */ /end MEASUREMENT
/begin MEASUREMENT autosar_swc_aeb_rtARID_DEF.ObjData_i[1].Offsets.OffsLatInPathPrimaryTarget "" FLOAT32_IEEE autosar_swc_aeb_CM_single 0 0 -3.4E+38 3.4E+38 ECU_ADDRESS 0xfe4a5128 /* @ECU_Address@autosar_swc_aeb_rtARID_DEF.ObjData_i[1].Offsets.OffsLatInPathPrimaryTarget@ */ /end MEASUREMENT
/begin MEASUREMENT autosar_swc_aeb_rtARID_DEF.ObjData_i[1].Offsets.OffsLatIntersection "" FLOAT32_IEEE autosar_swc_aeb_CM_single 0 0 -3.4E+38 3.4E+38 ECU_ADDRESS 0xfe4a5134 /* @ECU_Address@autosar_swc_aeb_rtARID_DEF.ObjData_i[1].Offsets.OffsLatIntersection@ */ /end MEASUREMENT
/begin MEASUREMENT autosar_swc_aeb_rtARID_DEF.ObjData_i[1].Offsets.OffsLatLongPred "" FLOAT32_IEEE autosar_swc_aeb_CM_single 0 0 -3.4E+38 3.4E+38 ECU_ADDRESS 0xfe4a5118 /* @ECU_Address@autosar_swc_aeb_rtARID_DEF.ObjData_i[1].Offsets.OffsLatLongPred@ */ /end MEASUREMENT
/begin MEASUREMENT autosar_swc_aeb_rtARID_DEF.ObjData_i[1].Offsets.OffsLatManoeuvre "" FLOAT32_IEEE autosar_swc_aeb_CM_single 0 0 -3.4E+38 3.4E+38 ECU_ADDRESS 0xfe4a5124 /* @ECU_Address@autosar_swc_aeb_rtARID_DEF.ObjData_i[1].Offsets.OffsLatManoeuvre@ */ /end MEASUREMENT
/begin MEASUREMENT autosar_swc_aeb_rtARID_DEF.ObjData_i[1].Offsets.OffsLatMplTar "" FLOAT32_IEEE autosar_swc_aeb_CM_single 0 0 -3.4E+38 3.4E+38 ECU_ADDRESS 0xfe4a5138 /* @ECU_Address@autosar_swc_aeb_rtARID_DEF.ObjData_i[1].Offsets.OffsLatMplTar@ */ /end MEASUREMENT
/begin MEASUREMENT autosar_swc_aeb_rtARID_DEF.ObjData_i[1].Offsets.OffsLatShortPred "" FLOAT32_IEEE autosar_swc_aeb_CM_single 0 0 -3.4E+38 3.4E+38 ECU_ADDRESS 0xfe4a5120 /* @ECU_Address@autosar_swc_aeb_rtARID_DEF.ObjData_i[1].Offsets.OffsLatShortPred@ */ /end MEASUREMENT
/begin MEASUREMENT autosar_swc_aeb_rtARID_DEF.ObjData_i[1].Offsets.OffsLgtLongPred "" FLOAT32_IEEE autosar_swc_aeb_CM_single 0 0 -3.4E+38 3.4E+38 ECU_ADDRESS 0xfe4a5114 /* @ECU_Address@autosar_swc_aeb_rtARID_DEF.ObjData_i[1].Offsets.OffsLgtLongPred@ */ /end MEASUREMENT
/begin MEASUREMENT autosar_swc_aeb_rtARID_DEF.ObjData_i[1].Offsets.OffsLgtShortPred "" FLOAT32_IEEE autosar_swc_aeb_CM_single 0 0 -3.4E+38 3.4E+38 ECU_ADDRESS 0xfe4a511c /* @ECU_Address@autosar_swc_aeb_rtARID_DEF.ObjData_i[1].Offsets.OffsLgtShortPred@ */ /end MEASUREMENT
/begin MEASUREMENT autosar_swc_aeb_rtARID_DEF.ObjData_i[1].PredictionValid "" UBYTE autosar_swc_aeb_CM_logical 0 0 0 1 ECU_ADDRESS 0xfe4a5111 /* @ECU_Address@autosar_swc_aeb_rtARID_DEF.ObjData_i[1].PredictionValid@ */ /end MEASUREMENT
/begin MEASUREMENT autosar_swc_aeb_rtARID_DEF.ObjData_i[1].ShortPredTime.A "" FLOAT32_IEEE autosar_swc_aeb_CM_single 0 0 -3.4E+38 3.4E+38 ECU_ADDRESS 0xfe4a5174 /* @ECU_Address@autosar_swc_aeb_rtARID_DEF.ObjData_i[1].ShortPredTime.A@ */ /end MEASUREMENT
/begin MEASUREMENT autosar_swc_aeb_rtARID_DEF.ObjData_i[1].ShortPredTime.ALat "" FLOAT32_IEEE autosar_swc_aeb_CM_single 0 0 -3.4E+38 3.4E+38 ECU_ADDRESS 0xfe4a5170 /* @ECU_Address@autosar_swc_aeb_rtARID_DEF.ObjData_i[1].ShortPredTime.ALat@ */ /end MEASUREMENT
/begin MEASUREMENT autosar_swc_aeb_rtARID_DEF.ObjData_i[1].ShortPredTime.ALgt "" FLOAT32_IEEE autosar_swc_aeb_CM_single 0 0 -3.4E+38 3.4E+38 ECU_ADDRESS 0xfe4a516c /* @ECU_Address@autosar_swc_aeb_rtARID_DEF.ObjData_i[1].ShortPredTime.ALgt@ */ /end MEASUREMENT
/begin MEASUREMENT autosar_swc_aeb_rtARID_DEF.ObjData_i[1].ShortPredTime.Crvt "" FLOAT32_IEEE autosar_swc_aeb_CM_single 0 0 -3.4E+38 3.4E+38 ECU_ADDRESS 0xfe4a5178 /* @ECU_Address@autosar_swc_aeb_rtARID_DEF.ObjData_i[1].ShortPredTime.Crvt@ */ /end MEASUREMENT
/begin MEASUREMENT autosar_swc_aeb_rtARID_DEF.ObjData_i[1].ShortPredTime.InPath "" UBYTE autosar_swc_aeb_CM_logical 0 0 0 1 ECU_ADDRESS 0xfe4a5169 /* @ECU_Address@autosar_swc_aeb_rtARID_DEF.ObjData_i[1].ShortPredTime.InPath@ */ /end MEASUREMENT
/begin MEASUREMENT autosar_swc_aeb_rtARID_DEF.ObjData_i[1].ShortPredTime.ObjOnCmngAndBrkg "" UBYTE autosar_swc_aeb_CM_logical 0 0 0 1 ECU_ADDRESS 0xfe4a516a /* @ECU_Address@autosar_swc_aeb_rtARID_DEF.ObjData_i[1].ShortPredTime.ObjOnCmngAndBrkg@ */ /end MEASUREMENT
/begin MEASUREMENT autosar_swc_aeb_rtARID_DEF.ObjData_i[1].ShortPredTime.TTMSelected "" UBYTE autosar_swc_aeb_CM_logical 0 0 0 1 ECU_ADDRESS 0xfe4a5168 /* @ECU_Address@autosar_swc_aeb_rtARID_DEF.ObjData_i[1].ShortPredTime.TTMSelected@ */ /end MEASUREMENT
/begin MEASUREMENT autosar_swc_aeb_rtARID_DEF.ObjData_i[1].ShortPredTime.TimeToMiddleLgt "" FLOAT32_IEEE autosar_swc_aeb_CM_single 0 0 -3.4E+38 3.4E+38 ECU_ADDRESS 0xfe4a5160 /* @ECU_Address@autosar_swc_aeb_rtARID_DEF.ObjData_i[1].ShortPredTime.TimeToMiddleLgt@ */ /end MEASUREMENT
/begin MEASUREMENT autosar_swc_aeb_rtARID_DEF.ObjData_i[1].ShortPredTime.TimeToPassLgt "" FLOAT32_IEEE autosar_swc_aeb_CM_single 0 0 -3.4E+38 3.4E+38 ECU_ADDRESS 0xfe4a5164 /* @ECU_Address@autosar_swc_aeb_rtARID_DEF.ObjData_i[1].ShortPredTime.TimeToPassLgt@ */ /end MEASUREMENT
/begin MEASUREMENT autosar_swc_aeb_rtARID_DEF.ObjData_i[1].ShortPredTime.TimeToReachLgt "" FLOAT32_IEEE autosar_swc_aeb_CM_single 0 0 -3.4E+38 3.4E+38 ECU_ADDRESS 0xfe4a515c /* @ECU_Address@autosar_swc_aeb_rtARID_DEF.ObjData_i[1].ShortPredTime.TimeToReachLgt@ */ /end MEASUREMENT
/begin MEASUREMENT autosar_swc_aeb_rtARID_DEF.ObjData_i[2].BoundingBox.CosRotation "" FLOAT32_IEEE autosar_swc_aeb_CM_single 0 0 -3.4E+38 3.4E+38 ECU_ADDRESS 0xfe4a5198 /* @ECU_Address@autosar_swc_aeb_rtARID_DEF.ObjData_i[2].BoundingBox.CosRotation@ */ /end MEASUREMENT
/begin MEASUREMENT autosar_swc_aeb_rtARID_DEF.ObjData_i[2].BoundingBox.LengthSideLat "" FLOAT32_IEEE autosar_swc_aeb_CM_single 0 0 -3.4E+38 3.4E+38 ECU_ADDRESS 0xfe4a518c /* @ECU_Address@autosar_swc_aeb_rtARID_DEF.ObjData_i[2].BoundingBox.LengthSideLat@ */ /end MEASUREMENT
/begin MEASUREMENT autosar_swc_aeb_rtARID_DEF.ObjData_i[2].BoundingBox.LengthSideLgt "" FLOAT32_IEEE autosar_swc_aeb_CM_single 0 0 -3.4E+38 3.4E+38 ECU_ADDRESS 0xfe4a5190 /* @ECU_Address@autosar_swc_aeb_rtARID_DEF.ObjData_i[2].BoundingBox.LengthSideLgt@ */ /end MEASUREMENT
/begin MEASUREMENT autosar_swc_aeb_rtARID_DEF.ObjData_i[2].BoundingBox.RotationAngle "" FLOAT32_IEEE autosar_swc_aeb_CM_single 0 0 -3.4E+38 3.4E+38 ECU_ADDRESS 0xfe4a519c /* @ECU_Address@autosar_swc_aeb_rtARID_DEF.ObjData_i[2].BoundingBox.RotationAngle@ */ /end MEASUREMENT
/begin MEASUREMENT autosar_swc_aeb_rtARID_DEF.ObjData_i[2].BoundingBox.SinRotation "" FLOAT32_IEEE autosar_swc_aeb_CM_single 0 0 -3.4E+38 3.4E+38 ECU_ADDRESS 0xfe4a5194 /* @ECU_Address@autosar_swc_aeb_rtARID_DEF.ObjData_i[2].BoundingBox.SinRotation@ */ /end MEASUREMENT
/begin MEASUREMENT autosar_swc_aeb_rtARID_DEF.ObjData_i[2].Idn "" ULONG autosar_swc_aeb_CM_uint32 0 0 0 4294967295 ECU_ADDRESS 0xfe4a520c /* @ECU_Address@autosar_swc_aeb_rtARID_DEF.ObjData_i[2].Idn@ */ /end MEASUREMENT
/begin MEASUREMENT autosar_swc_aeb_rtARID_DEF.ObjData_i[2].InPathAtCurrentPosition "" UBYTE autosar_swc_aeb_CM_logical 0 0 0 1 ECU_ADDRESS 0xfe4a51a0 /* @ECU_Address@autosar_swc_aeb_rtARID_DEF.ObjData_i[2].InPathAtCurrentPosition@ */ /end MEASUREMENT
/begin MEASUREMENT autosar_swc_aeb_rtARID_DEF.ObjData_i[2].LongPredTime.A "" FLOAT32_IEEE autosar_swc_aeb_CM_single 0 0 -3.4E+38 3.4E+38 ECU_ADDRESS 0xfe4a51e4 /* @ECU_Address@autosar_swc_aeb_rtARID_DEF.ObjData_i[2].LongPredTime.A@ */ /end MEASUREMENT
/begin MEASUREMENT autosar_swc_aeb_rtARID_DEF.ObjData_i[2].LongPredTime.ALat "" FLOAT32_IEEE autosar_swc_aeb_CM_single 0 0 -3.4E+38 3.4E+38 ECU_ADDRESS 0xfe4a51e0 /* @ECU_Address@autosar_swc_aeb_rtARID_DEF.ObjData_i[2].LongPredTime.ALat@ */ /end MEASUREMENT
/begin MEASUREMENT autosar_swc_aeb_rtARID_DEF.ObjData_i[2].LongPredTime.ALgt "" FLOAT32_IEEE autosar_swc_aeb_CM_single 0 0 -3.4E+38 3.4E+38 ECU_ADDRESS 0xfe4a51dc /* @ECU_Address@autosar_swc_aeb_rtARID_DEF.ObjData_i[2].LongPredTime.ALgt@ */ /end MEASUREMENT
/begin MEASUREMENT autosar_swc_aeb_rtARID_DEF.ObjData_i[2].LongPredTime.Crvt "" FLOAT32_IEEE autosar_swc_aeb_CM_single 0 0 -3.4E+38 3.4E+38 ECU_ADDRESS 0xfe4a51e8 /* @ECU_Address@autosar_swc_aeb_rtARID_DEF.ObjData_i[2].LongPredTime.Crvt@ */ /end MEASUREMENT
/begin MEASUREMENT autosar_swc_aeb_rtARID_DEF.ObjData_i[2].LongPredTime.InPath "" UBYTE autosar_swc_aeb_CM_logical 0 0 0 1 ECU_ADDRESS 0xfe4a51d9 /* @ECU_Address@autosar_swc_aeb_rtARID_DEF.ObjData_i[2].LongPredTime.InPath@ */ /end MEASUREMENT
/begin MEASUREMENT autosar_swc_aeb_rtARID_DEF.ObjData_i[2].LongPredTime.ObjOnCmngAndBrkg "" UBYTE autosar_swc_aeb_CM_logical 0 0 0 1 ECU_ADDRESS 0xfe4a51da /* @ECU_Address@autosar_swc_aeb_rtARID_DEF.ObjData_i[2].LongPredTime.ObjOnCmngAndBrkg@ */ /end MEASUREMENT
/begin MEASUREMENT autosar_swc_aeb_rtARID_DEF.ObjData_i[2].LongPredTime.TTMSelected "" UBYTE autosar_swc_aeb_CM_logical 0 0 0 1 ECU_ADDRESS 0xfe4a51d8 /* @ECU_Address@autosar_swc_aeb_rtARID_DEF.ObjData_i[2].LongPredTime.TTMSelected@ */ /end MEASUREMENT
/begin MEASUREMENT autosar_swc_aeb_rtARID_DEF.ObjData_i[2].LongPredTime.TimeToMiddleLgt "" FLOAT32_IEEE autosar_swc_aeb_CM_single 0 0 -3.4E+38 3.4E+38 ECU_ADDRESS 0xfe4a51d0 /* @ECU_Address@autosar_swc_aeb_rtARID_DEF.ObjData_i[2].LongPredTime.TimeToMiddleLgt@ */ /end MEASUREMENT
/begin MEASUREMENT autosar_swc_aeb_rtARID_DEF.ObjData_i[2].LongPredTime.TimeToPassLgt "" FLOAT32_IEEE autosar_swc_aeb_CM_single 0 0 -3.4E+38 3.4E+38 ECU_ADDRESS 0xfe4a51d4 /* @ECU_Address@autosar_swc_aeb_rtARID_DEF.ObjData_i[2].LongPredTime.TimeToPassLgt@ */ /end MEASUREMENT
/begin MEASUREMENT autosar_swc_aeb_rtARID_DEF.ObjData_i[2].LongPredTime.TimeToReachLgt "" FLOAT32_IEEE autosar_swc_aeb_CM_single 0 0 -3.4E+38 3.4E+38 ECU_ADDRESS 0xfe4a51cc /* @ECU_Address@autosar_swc_aeb_rtARID_DEF.ObjData_i[2].LongPredTime.TimeToReachLgt@ */ /end MEASUREMENT
/begin MEASUREMENT autosar_swc_aeb_rtARID_DEF.ObjData_i[2].MotionType.AbsHeading "" FLOAT32_IEEE autosar_swc_aeb_CM_single 0 0 -3.4E+38 3.4E+38 ECU_ADDRESS 0xfe4a5188 /* @ECU_Address@autosar_swc_aeb_rtARID_DEF.ObjData_i[2].MotionType.AbsHeading@ */ /end MEASUREMENT
/begin MEASUREMENT autosar_swc_aeb_rtARID_DEF.ObjData_i[2].MotionType.CurvedMotion "" UBYTE autosar_swc_aeb_CM_logical 0 0 0 1 ECU_ADDRESS 0xfe4a5186 /* @ECU_Address@autosar_swc_aeb_rtARID_DEF.ObjData_i[2].MotionType.CurvedMotion@ */ /end MEASUREMENT
/begin MEASUREMENT autosar_swc_aeb_rtARID_DEF.ObjData_i[2].MotionType.MovingOncoming "" UBYTE autosar_swc_aeb_CM_logical 0 0 0 1 ECU_ADDRESS 0xfe4a5181 /* @ECU_Address@autosar_swc_aeb_rtARID_DEF.ObjData_i[2].MotionType.MovingOncoming@ */ /end MEASUREMENT
/begin MEASUREMENT autosar_swc_aeb_rtARID_DEF.ObjData_i[2].MotionType.ObjectIsMotorVehicle "Object type is Car, Truck, Motorcycle or Vehicle Of Unkown Class." UBYTE autosar_swc_aeb_CM_logical 0 0 0 1 ECU_ADDRESS 0xfe4a5185 /* @ECU_Address@autosar_swc_aeb_rtARID_DEF.ObjData_i[2].MotionType.ObjectIsMotorVehicle@ */ /end MEASUREMENT
/begin MEASUREMENT autosar_swc_aeb_rtARID_DEF.ObjData_i[2].MotionType.ObjectIsVehicle "" UBYTE autosar_swc_aeb_CM_logical 0 0 0 1 ECU_ADDRESS 0xfe4a5184 /* @ECU_Address@autosar_swc_aeb_rtARID_DEF.ObjData_i[2].MotionType.ObjectIsVehicle@ */ /end MEASUREMENT
/begin MEASUREMENT autosar_swc_aeb_rtARID_DEF.ObjData_i[2].MotionType.ParallellVehicleLongPred "" UBYTE autosar_swc_aeb_CM_logical 0 0 0 1 ECU_ADDRESS 0xfe4a5182 /* @ECU_Address@autosar_swc_aeb_rtARID_DEF.ObjData_i[2].MotionType.ParallellVehicleLongPred@ */ /end MEASUREMENT
/begin MEASUREMENT autosar_swc_aeb_rtARID_DEF.ObjData_i[2].MotionType.ParallellVehicleShortPred "" UBYTE autosar_swc_aeb_CM_logical 0 0 0 1 ECU_ADDRESS 0xfe4a5183 /* @ECU_Address@autosar_swc_aeb_rtARID_DEF.ObjData_i[2].MotionType.ParallellVehicleShortPred@ */ /end MEASUREMENT
/begin MEASUREMENT autosar_swc_aeb_rtARID_DEF.ObjData_i[2].MotionType.SideIsClosest "" UBYTE autosar_swc_aeb_CM_logical 0 0 0 1 ECU_ADDRESS 0xfe4a5187 /* @ECU_Address@autosar_swc_aeb_rtARID_DEF.ObjData_i[2].MotionType.SideIsClosest@ */ /end MEASUREMENT
/begin MEASUREMENT autosar_swc_aeb_rtARID_DEF.ObjData_i[2].MotionType.Stationary "" UBYTE autosar_swc_aeb_CM_logical 0 0 0 1 ECU_ADDRESS 0xfe4a5180 /* @ECU_Address@autosar_swc_aeb_rtARID_DEF.ObjData_i[2].MotionType.Stationary@ */ /end MEASUREMENT
/begin MEASUREMENT autosar_swc_aeb_rtARID_DEF.ObjData_i[2].Offsets.OffsLatInPathCloseEdge "" FLOAT32_IEEE autosar_swc_aeb_CM_single 0 0 -3.4E+38 3.4E+38 ECU_ADDRESS 0xfe4a51bc /* @ECU_Address@autosar_swc_aeb_rtARID_DEF.ObjData_i[2].Offsets.OffsLatInPathCloseEdge@ */ /end MEASUREMENT
/begin MEASUREMENT autosar_swc_aeb_rtARID_DEF.ObjData_i[2].Offsets.OffsLatInPathFarEdge "" FLOAT32_IEEE autosar_swc_aeb_CM_single 0 0 -3.4E+38 3.4E+38 ECU_ADDRESS 0xfe4a51c0 /* @ECU_Address@autosar_swc_aeb_rtARID_DEF.ObjData_i[2].Offsets.OffsLatInPathFarEdge@ */ /end MEASUREMENT
/begin MEASUREMENT autosar_swc_aeb_rtARID_DEF.ObjData_i[2].Offsets.OffsLatInPathPrimaryTarget "" FLOAT32_IEEE autosar_swc_aeb_CM_single 0 0 -3.4E+38 3.4E+38 ECU_ADDRESS 0xfe4a51b8 /* @ECU_Address@autosar_swc_aeb_rtARID_DEF.ObjData_i[2].Offsets.OffsLatInPathPrimaryTarget@ */ /end MEASUREMENT
/begin MEASUREMENT autosar_swc_aeb_rtARID_DEF.ObjData_i[2].Offsets.OffsLatIntersection "" FLOAT32_IEEE autosar_swc_aeb_CM_single 0 0 -3.4E+38 3.4E+38 ECU_ADDRESS 0xfe4a51c4 /* @ECU_Address@autosar_swc_aeb_rtARID_DEF.ObjData_i[2].Offsets.OffsLatIntersection@ */ /end MEASUREMENT
/begin MEASUREMENT autosar_swc_aeb_rtARID_DEF.ObjData_i[2].Offsets.OffsLatLongPred "" FLOAT32_IEEE autosar_swc_aeb_CM_single 0 0 -3.4E+38 3.4E+38 ECU_ADDRESS 0xfe4a51a8 /* @ECU_Address@autosar_swc_aeb_rtARID_DEF.ObjData_i[2].Offsets.OffsLatLongPred@ */ /end MEASUREMENT
/begin MEASUREMENT autosar_swc_aeb_rtARID_DEF.ObjData_i[2].Offsets.OffsLatManoeuvre "" FLOAT32_IEEE autosar_swc_aeb_CM_single 0 0 -3.4E+38 3.4E+38 ECU_ADDRESS 0xfe4a51b4 /* @ECU_Address@autosar_swc_aeb_rtARID_DEF.ObjData_i[2].Offsets.OffsLatManoeuvre@ */ /end MEASUREMENT
/begin MEASUREMENT autosar_swc_aeb_rtARID_DEF.ObjData_i[2].Offsets.OffsLatMplTar "" FLOAT32_IEEE autosar_swc_aeb_CM_single 0 0 -3.4E+38 3.4E+38 ECU_ADDRESS 0xfe4a51c8 /* @ECU_Address@autosar_swc_aeb_rtARID_DEF.ObjData_i[2].Offsets.OffsLatMplTar@ */ /end MEASUREMENT
/begin MEASUREMENT autosar_swc_aeb_rtARID_DEF.ObjData_i[2].Offsets.OffsLatShortPred "" FLOAT32_IEEE autosar_swc_aeb_CM_single 0 0 -3.4E+38 3.4E+38 ECU_ADDRESS 0xfe4a51b0 /* @ECU_Address@autosar_swc_aeb_rtARID_DEF.ObjData_i[2].Offsets.OffsLatShortPred@ */ /end MEASUREMENT
/begin MEASUREMENT autosar_swc_aeb_rtARID_DEF.ObjData_i[2].Offsets.OffsLgtLongPred "" FLOAT32_IEEE autosar_swc_aeb_CM_single 0 0 -3.4E+38 3.4E+38 ECU_ADDRESS 0xfe4a51a4 /* @ECU_Address@autosar_swc_aeb_rtARID_DEF.ObjData_i[2].Offsets.OffsLgtLongPred@ */ /end MEASUREMENT
/begin MEASUREMENT autosar_swc_aeb_rtARID_DEF.ObjData_i[2].Offsets.OffsLgtShortPred "" FLOAT32_IEEE autosar_swc_aeb_CM_single 0 0 -3.4E+38 3.4E+38 ECU_ADDRESS 0xfe4a51ac /* @ECU_Address@autosar_swc_aeb_rtARID_DEF.ObjData_i[2].Offsets.OffsLgtShortPred@ */ /end MEASUREMENT
/begin MEASUREMENT autosar_swc_aeb_rtARID_DEF.ObjData_i[2].PredictionValid "" UBYTE autosar_swc_aeb_CM_logical 0 0 0 1 ECU_ADDRESS 0xfe4a51a1 /* @ECU_Address@autosar_swc_aeb_rtARID_DEF.ObjData_i[2].PredictionValid@ */ /end MEASUREMENT
/begin MEASUREMENT autosar_swc_aeb_rtARID_DEF.ObjData_i[2].ShortPredTime.A "" FLOAT32_IEEE autosar_swc_aeb_CM_single 0 0 -3.4E+38 3.4E+38 ECU_ADDRESS 0xfe4a5204 /* @ECU_Address@autosar_swc_aeb_rtARID_DEF.ObjData_i[2].ShortPredTime.A@ */ /end MEASUREMENT
/begin MEASUREMENT autosar_swc_aeb_rtARID_DEF.ObjData_i[2].ShortPredTime.ALat "" FLOAT32_IEEE autosar_swc_aeb_CM_single 0 0 -3.4E+38 3.4E+38 ECU_ADDRESS 0xfe4a5200 /* @ECU_Address@autosar_swc_aeb_rtARID_DEF.ObjData_i[2].ShortPredTime.ALat@ */ /end MEASUREMENT
/begin MEASUREMENT autosar_swc_aeb_rtARID_DEF.ObjData_i[2].ShortPredTime.ALgt "" FLOAT32_IEEE autosar_swc_aeb_CM_single 0 0 -3.4E+38 3.4E+38 ECU_ADDRESS 0xfe4a51fc /* @ECU_Address@autosar_swc_aeb_rtARID_DEF.ObjData_i[2].ShortPredTime.ALgt@ */ /end MEASUREMENT
/begin MEASUREMENT autosar_swc_aeb_rtARID_DEF.ObjData_i[2].ShortPredTime.Crvt "" FLOAT32_IEEE autosar_swc_aeb_CM_single 0 0 -3.4E+38 3.4E+38 ECU_ADDRESS 0xfe4a5208 /* @ECU_Address@autosar_swc_aeb_rtARID_DEF.ObjData_i[2].ShortPredTime.Crvt@ */ /end MEASUREMENT
/begin MEASUREMENT autosar_swc_aeb_rtARID_DEF.ObjData_i[2].ShortPredTime.InPath "" UBYTE autosar_swc_aeb_CM_logical 0 0 0 1 ECU_ADDRESS 0xfe4a51f9 /* @ECU_Address@autosar_swc_aeb_rtARID_DEF.ObjData_i[2].ShortPredTime.InPath@ */ /end MEASUREMENT
/begin MEASUREMENT autosar_swc_aeb_rtARID_DEF.ObjData_i[2].ShortPredTime.ObjOnCmngAndBrkg "" UBYTE autosar_swc_aeb_CM_logical 0 0 0 1 ECU_ADDRESS 0xfe4a51fa /* @ECU_Address@autosar_swc_aeb_rtARID_DEF.ObjData_i[2].ShortPredTime.ObjOnCmngAndBrkg@ */ /end MEASUREMENT
/begin MEASUREMENT autosar_swc_aeb_rtARID_DEF.ObjData_i[2].ShortPredTime.TTMSelected "" UBYTE autosar_swc_aeb_CM_logical 0 0 0 1 ECU_ADDRESS 0xfe4a51f8 /* @ECU_Address@autosar_swc_aeb_rtARID_DEF.ObjData_i[2].ShortPredTime.TTMSelected@ */ /end MEASUREMENT
/begin MEASUREMENT autosar_swc_aeb_rtARID_DEF.ObjData_i[2].ShortPredTime.TimeToMiddleLgt "" FLOAT32_IEEE autosar_swc_aeb_CM_single 0 0 -3.4E+38 3.4E+38 ECU_ADDRESS 0xfe4a51f0 /* @ECU_Address@autosar_swc_aeb_rtARID_DEF.ObjData_i[2].ShortPredTime.TimeToMiddleLgt@ */ /end MEASUREMENT
/begin MEASUREMENT autosar_swc_aeb_rtARID_DEF.ObjData_i[2].ShortPredTime.TimeToPassLgt "" FLOAT32_IEEE autosar_swc_aeb_CM_single 0 0 -3.4E+38 3.4E+38 ECU_ADDRESS 0xfe4a51f4 /* @ECU_Address@autosar_swc_aeb_rtARID_DEF.ObjData_i[2].ShortPredTime.TimeToPassLgt@ */ /end MEASUREMENT
/begin MEASUREMENT autosar_swc_aeb_rtARID_DEF.ObjData_i[2].ShortPredTime.TimeToReachLgt "" FLOAT32_IEEE autosar_swc_aeb_CM_single 0 0 -3.4E+38 3.4E+38 ECU_ADDRESS 0xfe4a51ec /* @ECU_Address@autosar_swc_aeb_rtARID_DEF.ObjData_i[2].ShortPredTime.TimeToReachLgt@ */ /end MEASUREMENT
/begin MEASUREMENT autosar_swc_aeb_rtARID_DEF.ObjData_i[3].BoundingBox.CosRotation "" FLOAT32_IEEE autosar_swc_aeb_CM_single 0 0 -3.4E+38 3.4E+38 ECU_ADDRESS 0xfe4a5228 /* @ECU_Address@autosar_swc_aeb_rtARID_DEF.ObjData_i[3].BoundingBox.CosRotation@ */ /end MEASUREMENT
/begin MEASUREMENT autosar_swc_aeb_rtARID_DEF.ObjData_i[3].BoundingBox.LengthSideLat "" FLOAT32_IEEE autosar_swc_aeb_CM_single 0 0 -3.4E+38 3.4E+38 ECU_ADDRESS 0xfe4a521c /* @ECU_Address@autosar_swc_aeb_rtARID_DEF.ObjData_i[3].BoundingBox.LengthSideLat@ */ /end MEASUREMENT
/begin MEASUREMENT autosar_swc_aeb_rtARID_DEF.ObjData_i[3].BoundingBox.LengthSideLgt "" FLOAT32_IEEE autosar_swc_aeb_CM_single 0 0 -3.4E+38 3.4E+38 ECU_ADDRESS 0xfe4a5220 /* @ECU_Address@autosar_swc_aeb_rtARID_DEF.ObjData_i[3].BoundingBox.LengthSideLgt@ */ /end MEASUREMENT
/begin MEASUREMENT autosar_swc_aeb_rtARID_DEF.ObjData_i[3].BoundingBox.RotationAngle "" FLOAT32_IEEE autosar_swc_aeb_CM_single 0 0 -3.4E+38 3.4E+38 ECU_ADDRESS 0xfe4a522c /* @ECU_Address@autosar_swc_aeb_rtARID_DEF.ObjData_i[3].BoundingBox.RotationAngle@ */ /end MEASUREMENT
/begin MEASUREMENT autosar_swc_aeb_rtARID_DEF.ObjData_i[3].BoundingBox.SinRotation "" FLOAT32_IEEE autosar_swc_aeb_CM_single 0 0 -3.4E+38 3.4E+38 ECU_ADDRESS 0xfe4a5224 /* @ECU_Address@autosar_swc_aeb_rtARID_DEF.ObjData_i[3].BoundingBox.SinRotation@ */ /end MEASUREMENT
/begin MEASUREMENT autosar_swc_aeb_rtARID_DEF.ObjData_i[3].Idn "" ULONG autosar_swc_aeb_CM_uint32 0 0 0 4294967295 ECU_ADDRESS 0xfe4a529c /* @ECU_Address@autosar_swc_aeb_rtARID_DEF.ObjData_i[3].Idn@ */ /end MEASUREMENT
/begin MEASUREMENT autosar_swc_aeb_rtARID_DEF.ObjData_i[3].InPathAtCurrentPosition "" UBYTE autosar_swc_aeb_CM_logical 0 0 0 1 ECU_ADDRESS 0xfe4a5230 /* @ECU_Address@autosar_swc_aeb_rtARID_DEF.ObjData_i[3].InPathAtCurrentPosition@ */ /end MEASUREMENT
/begin MEASUREMENT autosar_swc_aeb_rtARID_DEF.ObjData_i[3].LongPredTime.A "" FLOAT32_IEEE autosar_swc_aeb_CM_single 0 0 -3.4E+38 3.4E+38 ECU_ADDRESS 0xfe4a5274 /* @ECU_Address@autosar_swc_aeb_rtARID_DEF.ObjData_i[3].LongPredTime.A@ */ /end MEASUREMENT
/begin MEASUREMENT autosar_swc_aeb_rtARID_DEF.ObjData_i[3].LongPredTime.ALat "" FLOAT32_IEEE autosar_swc_aeb_CM_single 0 0 -3.4E+38 3.4E+38 ECU_ADDRESS 0xfe4a5270 /* @ECU_Address@autosar_swc_aeb_rtARID_DEF.ObjData_i[3].LongPredTime.ALat@ */ /end MEASUREMENT
/begin MEASUREMENT autosar_swc_aeb_rtARID_DEF.ObjData_i[3].LongPredTime.ALgt "" FLOAT32_IEEE autosar_swc_aeb_CM_single 0 0 -3.4E+38 3.4E+38 ECU_ADDRESS 0xfe4a526c /* @ECU_Address@autosar_swc_aeb_rtARID_DEF.ObjData_i[3].LongPredTime.ALgt@ */ /end MEASUREMENT
/begin MEASUREMENT autosar_swc_aeb_rtARID_DEF.ObjData_i[3].LongPredTime.Crvt "" FLOAT32_IEEE autosar_swc_aeb_CM_single 0 0 -3.4E+38 3.4E+38 ECU_ADDRESS 0xfe4a5278 /* @ECU_Address@autosar_swc_aeb_rtARID_DEF.ObjData_i[3].LongPredTime.Crvt@ */ /end MEASUREMENT
/begin MEASUREMENT autosar_swc_aeb_rtARID_DEF.ObjData_i[3].LongPredTime.InPath "" UBYTE autosar_swc_aeb_CM_logical 0 0 0 1 ECU_ADDRESS 0xfe4a5269 /* @ECU_Address@autosar_swc_aeb_rtARID_DEF.ObjData_i[3].LongPredTime.InPath@ */ /end MEASUREMENT
/begin MEASUREMENT autosar_swc_aeb_rtARID_DEF.ObjData_i[3].LongPredTime.ObjOnCmngAndBrkg "" UBYTE autosar_swc_aeb_CM_logical 0 0 0 1 ECU_ADDRESS 0xfe4a526a /* @ECU_Address@autosar_swc_aeb_rtARID_DEF.ObjData_i[3].LongPredTime.ObjOnCmngAndBrkg@ */ /end MEASUREMENT
/begin MEASUREMENT autosar_swc_aeb_rtARID_DEF.ObjData_i[3].LongPredTime.TTMSelected "" UBYTE autosar_swc_aeb_CM_logical 0 0 0 1 ECU_ADDRESS 0xfe4a5268 /* @ECU_Address@autosar_swc_aeb_rtARID_DEF.ObjData_i[3].LongPredTime.TTMSelected@ */ /end MEASUREMENT
/begin MEASUREMENT autosar_swc_aeb_rtARID_DEF.ObjData_i[3].LongPredTime.TimeToMiddleLgt "" FLOAT32_IEEE autosar_swc_aeb_CM_single 0 0 -3.4E+38 3.4E+38 ECU_ADDRESS 0xfe4a5260 /* @ECU_Address@autosar_swc_aeb_rtARID_DEF.ObjData_i[3].LongPredTime.TimeToMiddleLgt@ */ /end MEASUREMENT
/begin MEASUREMENT autosar_swc_aeb_rtARID_DEF.ObjData_i[3].LongPredTime.TimeToPassLgt "" FLOAT32_IEEE autosar_swc_aeb_CM_single 0 0 -3.4E+38 3.4E+38 ECU_ADDRESS 0xfe4a5264 /* @ECU_Address@autosar_swc_aeb_rtARID_DEF.ObjData_i[3].LongPredTime.TimeToPassLgt@ */ /end MEASUREMENT
/begin MEASUREMENT autosar_swc_aeb_rtARID_DEF.ObjData_i[3].LongPredTime.TimeToReachLgt "" FLOAT32_IEEE autosar_swc_aeb_CM_single 0 0 -3.4E+38 3.4E+38 ECU_ADDRESS 0xfe4a525c /* @ECU_Address@autosar_swc_aeb_rtARID_DEF.ObjData_i[3].LongPredTime.TimeToReachLgt@ */ /end MEASUREMENT
/begin MEASUREMENT autosar_swc_aeb_rtARID_DEF.ObjData_i[3].MotionType.AbsHeading "" FLOAT32_IEEE autosar_swc_aeb_CM_single 0 0 -3.4E+38 3.4E+38 ECU_ADDRESS 0xfe4a5218 /* @ECU_Address@autosar_swc_aeb_rtARID_DEF.ObjData_i[3].MotionType.AbsHeading@ */ /end MEASUREMENT
/begin MEASUREMENT autosar_swc_aeb_rtARID_DEF.ObjData_i[3].MotionType.CurvedMotion "" UBYTE autosar_swc_aeb_CM_logical 0 0 0 1 ECU_ADDRESS 0xfe4a5216 /* @ECU_Address@autosar_swc_aeb_rtARID_DEF.ObjData_i[3].MotionType.CurvedMotion@ */ /end MEASUREMENT
/begin MEASUREMENT autosar_swc_aeb_rtARID_DEF.ObjData_i[3].MotionType.MovingOncoming "" UBYTE autosar_swc_aeb_CM_logical 0 0 0 1 ECU_ADDRESS 0xfe4a5211 /* @ECU_Address@autosar_swc_aeb_rtARID_DEF.ObjData_i[3].MotionType.MovingOncoming@ */ /end MEASUREMENT
/begin MEASUREMENT autosar_swc_aeb_rtARID_DEF.ObjData_i[3].MotionType.ObjectIsMotorVehicle "Object type is Car, Truck, Motorcycle or Vehicle Of Unkown Class." UBYTE autosar_swc_aeb_CM_logical 0 0 0 1 ECU_ADDRESS 0xfe4a5215 /* @ECU_Address@autosar_swc_aeb_rtARID_DEF.ObjData_i[3].MotionType.ObjectIsMotorVehicle@ */ /end MEASUREMENT
/begin MEASUREMENT autosar_swc_aeb_rtARID_DEF.ObjData_i[3].MotionType.ObjectIsVehicle "" UBYTE autosar_swc_aeb_CM_logical 0 0 0 1 ECU_ADDRESS 0xfe4a5214 /* @ECU_Address@autosar_swc_aeb_rtARID_DEF.ObjData_i[3].MotionType.ObjectIsVehicle@ */ /end MEASUREMENT
/begin MEASUREMENT autosar_swc_aeb_rtARID_DEF.ObjData_i[3].MotionType.ParallellVehicleLongPred "" UBYTE autosar_swc_aeb_CM_logical 0 0 0 1 ECU_ADDRESS 0xfe4a5212 /* @ECU_Address@autosar_swc_aeb_rtARID_DEF.ObjData_i[3].MotionType.ParallellVehicleLongPred@ */ /end MEASUREMENT
/begin MEASUREMENT autosar_swc_aeb_rtARID_DEF.ObjData_i[3].MotionType.ParallellVehicleShortPred "" UBYTE autosar_swc_aeb_CM_logical 0 0 0 1 ECU_ADDRESS 0xfe4a5213 /* @ECU_Address@autosar_swc_aeb_rtARID_DEF.ObjData_i[3].MotionType.ParallellVehicleShortPred@ */ /end MEASUREMENT
/begin MEASUREMENT autosar_swc_aeb_rtARID_DEF.ObjData_i[3].MotionType.SideIsClosest "" UBYTE autosar_swc_aeb_CM_logical 0 0 0 1 ECU_ADDRESS 0xfe4a5217 /* @ECU_Address@autosar_swc_aeb_rtARID_DEF.ObjData_i[3].MotionType.SideIsClosest@ */ /end MEASUREMENT
/begin MEASUREMENT autosar_swc_aeb_rtARID_DEF.ObjData_i[3].MotionType.Stationary "" UBYTE autosar_swc_aeb_CM_logical 0 0 0 1 ECU_ADDRESS 0xfe4a5210 /* @ECU_Address@autosar_swc_aeb_rtARID_DEF.ObjData_i[3].MotionType.Stationary@ */ /end MEASUREMENT
/begin MEASUREMENT autosar_swc_aeb_rtARID_DEF.ObjData_i[3].Offsets.OffsLatInPathCloseEdge "" FLOAT32_IEEE autosar_swc_aeb_CM_single 0 0 -3.4E+38 3.4E+38 ECU_ADDRESS 0xfe4a524c /* @ECU_Address@autosar_swc_aeb_rtARID_DEF.ObjData_i[3].Offsets.OffsLatInPathCloseEdge@ */ /end MEASUREMENT
/begin MEASUREMENT autosar_swc_aeb_rtARID_DEF.ObjData_i[3].Offsets.OffsLatInPathFarEdge "" FLOAT32_IEEE autosar_swc_aeb_CM_single 0 0 -3.4E+38 3.4E+38 ECU_ADDRESS 0xfe4a5250 /* @ECU_Address@autosar_swc_aeb_rtARID_DEF.ObjData_i[3].Offsets.OffsLatInPathFarEdge@ */ /end MEASUREMENT
/begin MEASUREMENT autosar_swc_aeb_rtARID_DEF.ObjData_i[3].Offsets.OffsLatInPathPrimaryTarget "" FLOAT32_IEEE autosar_swc_aeb_CM_single 0 0 -3.4E+38 3.4E+38 ECU_ADDRESS 0xfe4a5248 /* @ECU_Address@autosar_swc_aeb_rtARID_DEF.ObjData_i[3].Offsets.OffsLatInPathPrimaryTarget@ */ /end MEASUREMENT
/begin MEASUREMENT autosar_swc_aeb_rtARID_DEF.ObjData_i[3].Offsets.OffsLatIntersection "" FLOAT32_IEEE autosar_swc_aeb_CM_single 0 0 -3.4E+38 3.4E+38 ECU_ADDRESS 0xfe4a5254 /* @ECU_Address@autosar_swc_aeb_rtARID_DEF.ObjData_i[3].Offsets.OffsLatIntersection@ */ /end MEASUREMENT
/begin MEASUREMENT autosar_swc_aeb_rtARID_DEF.ObjData_i[3].Offsets.OffsLatLongPred "" FLOAT32_IEEE autosar_swc_aeb_CM_single 0 0 -3.4E+38 3.4E+38 ECU_ADDRESS 0xfe4a5238 /* @ECU_Address@autosar_swc_aeb_rtARID_DEF.ObjData_i[3].Offsets.OffsLatLongPred@ */ /end MEASUREMENT
/begin MEASUREMENT autosar_swc_aeb_rtARID_DEF.ObjData_i[3].Offsets.OffsLatManoeuvre "" FLOAT32_IEEE autosar_swc_aeb_CM_single 0 0 -3.4E+38 3.4E+38 ECU_ADDRESS 0xfe4a5244 /* @ECU_Address@autosar_swc_aeb_rtARID_DEF.ObjData_i[3].Offsets.OffsLatManoeuvre@ */ /end MEASUREMENT
/begin MEASUREMENT autosar_swc_aeb_rtARID_DEF.ObjData_i[3].Offsets.OffsLatMplTar "" FLOAT32_IEEE autosar_swc_aeb_CM_single 0 0 -3.4E+38 3.4E+38 ECU_ADDRESS 0xfe4a5258 /* @ECU_Address@autosar_swc_aeb_rtARID_DEF.ObjData_i[3].Offsets.OffsLatMplTar@ */ /end MEASUREMENT
/begin MEASUREMENT autosar_swc_aeb_rtARID_DEF.ObjData_i[3].Offsets.OffsLatShortPred "" FLOAT32_IEEE autosar_swc_aeb_CM_single 0 0 -3.4E+38 3.4E+38 ECU_ADDRESS 0xfe4a5240 /* @ECU_Address@autosar_swc_aeb_rtARID_DEF.ObjData_i[3].Offsets.OffsLatShortPred@ */ /end MEASUREMENT
/begin MEASUREMENT autosar_swc_aeb_rtARID_DEF.ObjData_i[3].Offsets.OffsLgtLongPred "" FLOAT32_IEEE autosar_swc_aeb_CM_single 0 0 -3.4E+38 3.4E+38 ECU_ADDRESS 0xfe4a5234 /* @ECU_Address@autosar_swc_aeb_rtARID_DEF.ObjData_i[3].Offsets.OffsLgtLongPred@ */ /end MEASUREMENT
/begin MEASUREMENT autosar_swc_aeb_rtARID_DEF.ObjData_i[3].Offsets.OffsLgtShortPred "" FLOAT32_IEEE autosar_swc_aeb_CM_single 0 0 -3.4E+38 3.4E+38 ECU_ADDRESS 0xfe4a523c /* @ECU_Address@autosar_swc_aeb_rtARID_DEF.ObjData_i[3].Offsets.OffsLgtShortPred@ */ /end MEASUREMENT
/begin MEASUREMENT autosar_swc_aeb_rtARID_DEF.ObjData_i[3].PredictionValid "" UBYTE autosar_swc_aeb_CM_logical 0 0 0 1 ECU_ADDRESS 0xfe4a5231 /* @ECU_Address@autosar_swc_aeb_rtARID_DEF.ObjData_i[3].PredictionValid@ */ /end MEASUREMENT
/begin MEASUREMENT autosar_swc_aeb_rtARID_DEF.ObjData_i[3].ShortPredTime.A "" FLOAT32_IEEE autosar_swc_aeb_CM_single 0 0 -3.4E+38 3.4E+38 ECU_ADDRESS 0xfe4a5294 /* @ECU_Address@autosar_swc_aeb_rtARID_DEF.ObjData_i[3].ShortPredTime.A@ */ /end MEASUREMENT
/begin MEASUREMENT autosar_swc_aeb_rtARID_DEF.ObjData_i[3].ShortPredTime.ALat "" FLOAT32_IEEE autosar_swc_aeb_CM_single 0 0 -3.4E+38 3.4E+38 ECU_ADDRESS 0xfe4a5290 /* @ECU_Address@autosar_swc_aeb_rtARID_DEF.ObjData_i[3].ShortPredTime.ALat@ */ /end MEASUREMENT
/begin MEASUREMENT autosar_swc_aeb_rtARID_DEF.ObjData_i[3].ShortPredTime.ALgt "" FLOAT32_IEEE autosar_swc_aeb_CM_single 0 0 -3.4E+38 3.4E+38 ECU_ADDRESS 0xfe4a528c /* @ECU_Address@autosar_swc_aeb_rtARID_DEF.ObjData_i[3].ShortPredTime.ALgt@ */ /end MEASUREMENT
/begin MEASUREMENT autosar_swc_aeb_rtARID_DEF.ObjData_i[3].ShortPredTime.Crvt "" FLOAT32_IEEE autosar_swc_aeb_CM_single 0 0 -3.4E+38 3.4E+38 ECU_ADDRESS 0xfe4a5298 /* @ECU_Address@autosar_swc_aeb_rtARID_DEF.ObjData_i[3].ShortPredTime.Crvt@ */ /end MEASUREMENT
/begin MEASUREMENT autosar_swc_aeb_rtARID_DEF.ObjData_i[3].ShortPredTime.InPath "" UBYTE autosar_swc_aeb_CM_logical 0 0 0 1 ECU_ADDRESS 0xfe4a5289 /* @ECU_Address@autosar_swc_aeb_rtARID_DEF.ObjData_i[3].ShortPredTime.InPath@ */ /end MEASUREMENT
/begin MEASUREMENT autosar_swc_aeb_rtARID_DEF.ObjData_i[3].ShortPredTime.ObjOnCmngAndBrkg "" UBYTE autosar_swc_aeb_CM_logical 0 0 0 1 ECU_ADDRESS 0xfe4a528a /* @ECU_Address@autosar_swc_aeb_rtARID_DEF.ObjData_i[3].ShortPredTime.ObjOnCmngAndBrkg@ */ /end MEASUREMENT
/begin MEASUREMENT autosar_swc_aeb_rtARID_DEF.ObjData_i[3].ShortPredTime.TTMSelected "" UBYTE autosar_swc_aeb_CM_logical 0 0 0 1 ECU_ADDRESS 0xfe4a5288 /* @ECU_Address@autosar_swc_aeb_rtARID_DEF.ObjData_i[3].ShortPredTime.TTMSelected@ */ /end MEASUREMENT
/begin MEASUREMENT autosar_swc_aeb_rtARID_DEF.ObjData_i[3].ShortPredTime.TimeToMiddleLgt "" FLOAT32_IEEE autosar_swc_aeb_CM_single 0 0 -3.4E+38 3.4E+38 ECU_ADDRESS 0xfe4a5280 /* @ECU_Address@autosar_swc_aeb_rtARID_DEF.ObjData_i[3].ShortPredTime.TimeToMiddleLgt@ */ /end MEASUREMENT
/begin MEASUREMENT autosar_swc_aeb_rtARID_DEF.ObjData_i[3].ShortPredTime.TimeToPassLgt "" FLOAT32_IEEE autosar_swc_aeb_CM_single 0 0 -3.4E+38 3.4E+38 ECU_ADDRESS 0xfe4a5284 /* @ECU_Address@autosar_swc_aeb_rtARID_DEF.ObjData_i[3].ShortPredTime.TimeToPassLgt@ */ /end MEASUREMENT
/begin MEASUREMENT autosar_swc_aeb_rtARID_DEF.ObjData_i[3].ShortPredTime.TimeToReachLgt "" FLOAT32_IEEE autosar_swc_aeb_CM_single 0 0 -3.4E+38 3.4E+38 ECU_ADDRESS 0xfe4a527c /* @ECU_Address@autosar_swc_aeb_rtARID_DEF.ObjData_i[3].ShortPredTime.TimeToReachLgt@ */ /end MEASUREMENT
/begin MEASUREMENT autosar_swc_aeb_rtARID_DEF.ObjData_i[4].BoundingBox.CosRotation "" FLOAT32_IEEE autosar_swc_aeb_CM_single 0 0 -3.4E+38 3.4E+38 ECU_ADDRESS 0xfe4a52b8 /* @ECU_Address@autosar_swc_aeb_rtARID_DEF.ObjData_i[4].BoundingBox.CosRotation@ */ /end MEASUREMENT
/begin MEASUREMENT autosar_swc_aeb_rtARID_DEF.ObjData_i[4].BoundingBox.LengthSideLat "" FLOAT32_IEEE autosar_swc_aeb_CM_single 0 0 -3.4E+38 3.4E+38 ECU_ADDRESS 0xfe4a52ac /* @ECU_Address@autosar_swc_aeb_rtARID_DEF.ObjData_i[4].BoundingBox.LengthSideLat@ */ /end MEASUREMENT
/begin MEASUREMENT autosar_swc_aeb_rtARID_DEF.ObjData_i[4].BoundingBox.LengthSideLgt "" FLOAT32_IEEE autosar_swc_aeb_CM_single 0 0 -3.4E+38 3.4E+38 ECU_ADDRESS 0xfe4a52b0 /* @ECU_Address@autosar_swc_aeb_rtARID_DEF.ObjData_i[4].BoundingBox.LengthSideLgt@ */ /end MEASUREMENT
/begin MEASUREMENT autosar_swc_aeb_rtARID_DEF.ObjData_i[4].BoundingBox.RotationAngle "" FLOAT32_IEEE autosar_swc_aeb_CM_single 0 0 -3.4E+38 3.4E+38 ECU_ADDRESS 0xfe4a52bc /* @ECU_Address@autosar_swc_aeb_rtARID_DEF.ObjData_i[4].BoundingBox.RotationAngle@ */ /end MEASUREMENT
/begin MEASUREMENT autosar_swc_aeb_rtARID_DEF.ObjData_i[4].BoundingBox.SinRotation "" FLOAT32_IEEE autosar_swc_aeb_CM_single 0 0 -3.4E+38 3.4E+38 ECU_ADDRESS 0xfe4a52b4 /* @ECU_Address@autosar_swc_aeb_rtARID_DEF.ObjData_i[4].BoundingBox.SinRotation@ */ /end MEASUREMENT
/begin MEASUREMENT autosar_swc_aeb_rtARID_DEF.ObjData_i[4].Idn "" ULONG autosar_swc_aeb_CM_uint32 0 0 0 4294967295 ECU_ADDRESS 0xfe4a532c /* @ECU_Address@autosar_swc_aeb_rtARID_DEF.ObjData_i[4].Idn@ */ /end MEASUREMENT
/begin MEASUREMENT autosar_swc_aeb_rtARID_DEF.ObjData_i[4].InPathAtCurrentPosition "" UBYTE autosar_swc_aeb_CM_logical 0 0 0 1 ECU_ADDRESS 0xfe4a52c0 /* @ECU_Address@autosar_swc_aeb_rtARID_DEF.ObjData_i[4].InPathAtCurrentPosition@ */ /end MEASUREMENT
/begin MEASUREMENT autosar_swc_aeb_rtARID_DEF.ObjData_i[4].LongPredTime.A "" FLOAT32_IEEE autosar_swc_aeb_CM_single 0 0 -3.4E+38 3.4E+38 ECU_ADDRESS 0xfe4a5304 /* @ECU_Address@autosar_swc_aeb_rtARID_DEF.ObjData_i[4].LongPredTime.A@ */ /end MEASUREMENT
/begin MEASUREMENT autosar_swc_aeb_rtARID_DEF.ObjData_i[4].LongPredTime.ALat "" FLOAT32_IEEE autosar_swc_aeb_CM_single 0 0 -3.4E+38 3.4E+38 ECU_ADDRESS 0xfe4a5300 /* @ECU_Address@autosar_swc_aeb_rtARID_DEF.ObjData_i[4].LongPredTime.ALat@ */ /end MEASUREMENT
/begin MEASUREMENT autosar_swc_aeb_rtARID_DEF.ObjData_i[4].LongPredTime.ALgt "" FLOAT32_IEEE autosar_swc_aeb_CM_single 0 0 -3.4E+38 3.4E+38 ECU_ADDRESS 0xfe4a52fc /* @ECU_Address@autosar_swc_aeb_rtARID_DEF.ObjData_i[4].LongPredTime.ALgt@ */ /end MEASUREMENT
/begin MEASUREMENT autosar_swc_aeb_rtARID_DEF.ObjData_i[4].LongPredTime.Crvt "" FLOAT32_IEEE autosar_swc_aeb_CM_single 0 0 -3.4E+38 3.4E+38 ECU_ADDRESS 0xfe4a5308 /* @ECU_Address@autosar_swc_aeb_rtARID_DEF.ObjData_i[4].LongPredTime.Crvt@ */ /end MEASUREMENT
/begin MEASUREMENT autosar_swc_aeb_rtARID_DEF.ObjData_i[4].LongPredTime.InPath "" UBYTE autosar_swc_aeb_CM_logical 0 0 0 1 ECU_ADDRESS 0xfe4a52f9 /* @ECU_Address@autosar_swc_aeb_rtARID_DEF.ObjData_i[4].LongPredTime.InPath@ */ /end MEASUREMENT
/begin MEASUREMENT autosar_swc_aeb_rtARID_DEF.ObjData_i[4].LongPredTime.ObjOnCmngAndBrkg "" UBYTE autosar_swc_aeb_CM_logical 0 0 0 1 ECU_ADDRESS 0xfe4a52fa /* @ECU_Address@autosar_swc_aeb_rtARID_DEF.ObjData_i[4].LongPredTime.ObjOnCmngAndBrkg@ */ /end MEASUREMENT
/begin MEASUREMENT autosar_swc_aeb_rtARID_DEF.ObjData_i[4].LongPredTime.TTMSelected "" UBYTE autosar_swc_aeb_CM_logical 0 0 0 1 ECU_ADDRESS 0xfe4a52f8 /* @ECU_Address@autosar_swc_aeb_rtARID_DEF.ObjData_i[4].LongPredTime.TTMSelected@ */ /end MEASUREMENT
/begin MEASUREMENT autosar_swc_aeb_rtARID_DEF.ObjData_i[4].LongPredTime.TimeToMiddleLgt "" FLOAT32_IEEE autosar_swc_aeb_CM_single 0 0 -3.4E+38 3.4E+38 ECU_ADDRESS 0xfe4a52f0 /* @ECU_Address@autosar_swc_aeb_rtARID_DEF.ObjData_i[4].LongPredTime.TimeToMiddleLgt@ */ /end MEASUREMENT
/begin MEASUREMENT autosar_swc_aeb_rtARID_DEF.ObjData_i[4].LongPredTime.TimeToPassLgt "" FLOAT32_IEEE autosar_swc_aeb_CM_single 0 0 -3.4E+38 3.4E+38 ECU_ADDRESS 0xfe4a52f4 /* @ECU_Address@autosar_swc_aeb_rtARID_DEF.ObjData_i[4].LongPredTime.TimeToPassLgt@ */ /end MEASUREMENT
/begin MEASUREMENT autosar_swc_aeb_rtARID_DEF.ObjData_i[4].LongPredTime.TimeToReachLgt "" FLOAT32_IEEE autosar_swc_aeb_CM_single 0 0 -3.4E+38 3.4E+38 ECU_ADDRESS 0xfe4a52ec /* @ECU_Address@autosar_swc_aeb_rtARID_DEF.ObjData_i[4].LongPredTime.TimeToReachLgt@ */ /end MEASUREMENT
/begin MEASUREMENT autosar_swc_aeb_rtARID_DEF.ObjData_i[4].MotionType.AbsHeading "" FLOAT32_IEEE autosar_swc_aeb_CM_single 0 0 -3.4E+38 3.4E+38 ECU_ADDRESS 0xfe4a52a8 /* @ECU_Address@autosar_swc_aeb_rtARID_DEF.ObjData_i[4].MotionType.AbsHeading@ */ /end MEASUREMENT
/begin MEASUREMENT autosar_swc_aeb_rtARID_DEF.ObjData_i[4].MotionType.CurvedMotion "" UBYTE autosar_swc_aeb_CM_logical 0 0 0 1 ECU_ADDRESS 0xfe4a52a6 /* @ECU_Address@autosar_swc_aeb_rtARID_DEF.ObjData_i[4].MotionType.CurvedMotion@ */ /end MEASUREMENT
/begin MEASUREMENT autosar_swc_aeb_rtARID_DEF.ObjData_i[4].MotionType.MovingOncoming "" UBYTE autosar_swc_aeb_CM_logical 0 0 0 1 ECU_ADDRESS 0xfe4a52a1 /* @ECU_Address@autosar_swc_aeb_rtARID_DEF.ObjData_i[4].MotionType.MovingOncoming@ */ /end MEASUREMENT
/begin MEASUREMENT autosar_swc_aeb_rtARID_DEF.ObjData_i[4].MotionType.ObjectIsMotorVehicle "Object type is Car, Truck, Motorcycle or Vehicle Of Unkown Class." UBYTE autosar_swc_aeb_CM_logical 0 0 0 1 ECU_ADDRESS 0xfe4a52a5 /* @ECU_Address@autosar_swc_aeb_rtARID_DEF.ObjData_i[4].MotionType.ObjectIsMotorVehicle@ */ /end MEASUREMENT
/begin MEASUREMENT autosar_swc_aeb_rtARID_DEF.ObjData_i[4].MotionType.ObjectIsVehicle "" UBYTE autosar_swc_aeb_CM_logical 0 0 0 1 ECU_ADDRESS 0xfe4a52a4 /* @ECU_Address@autosar_swc_aeb_rtARID_DEF.ObjData_i[4].MotionType.ObjectIsVehicle@ */ /end MEASUREMENT
/begin MEASUREMENT autosar_swc_aeb_rtARID_DEF.ObjData_i[4].MotionType.ParallellVehicleLongPred "" UBYTE autosar_swc_aeb_CM_logical 0 0 0 1 ECU_ADDRESS 0xfe4a52a2 /* @ECU_Address@autosar_swc_aeb_rtARID_DEF.ObjData_i[4].MotionType.ParallellVehicleLongPred@ */ /end MEASUREMENT
/begin MEASUREMENT autosar_swc_aeb_rtARID_DEF.ObjData_i[4].MotionType.ParallellVehicleShortPred "" UBYTE autosar_swc_aeb_CM_logical 0 0 0 1 ECU_ADDRESS 0xfe4a52a3 /* @ECU_Address@autosar_swc_aeb_rtARID_DEF.ObjData_i[4].MotionType.ParallellVehicleShortPred@ */ /end MEASUREMENT
/begin MEASUREMENT autosar_swc_aeb_rtARID_DEF.ObjData_i[4].MotionType.SideIsClosest "" UBYTE autosar_swc_aeb_CM_logical 0 0 0 1 ECU_ADDRESS 0xfe4a52a7 /* @ECU_Address@autosar_swc_aeb_rtARID_DEF.ObjData_i[4].MotionType.SideIsClosest@ */ /end MEASUREMENT
/begin MEASUREMENT autosar_swc_aeb_rtARID_DEF.ObjData_i[4].MotionType.Stationary "" UBYTE autosar_swc_aeb_CM_logical 0 0 0 1 ECU_ADDRESS 0xfe4a52a0 /* @ECU_Address@autosar_swc_aeb_rtARID_DEF.ObjData_i[4].MotionType.Stationary@ */ /end MEASUREMENT
/begin MEASUREMENT autosar_swc_aeb_rtARID_DEF.ObjData_i[4].PredictionValid "" UBYTE autosar_swc_aeb_CM_logical 0 0 0 1 ECU_ADDRESS 0xfe4a52c1 /* @ECU_Address@autosar_swc_aeb_rtARID_DEF.ObjData_i[4].PredictionValid@ */ /end MEASUREMENT
/begin COMPU_METHOD autosar_swc_aeb_CM_logical "Q = V" IDENTICAL "%1.0" "" /end COMPU_METHOD
/begin COMPU_METHOD autosar_swc_aeb_CM_single "Q = V" IDENTICAL "%8.6" "" /end COMPU_METHOD
/begin COMPU_METHOD autosar_swc_aeb_CM_uint32 "Q = V" IDENTICAL "%10.0" "" /end COMPU_METHOD
/begin GROUP autosar_swc_aeb_rtARID_DEF.ObjData_i[12].LongPredTime ""
 /begin REF_MEASUREMENT autosar_swc_aeb_rtARID_DEF.ObjData_i[12].LongPredTime.TimeToReachLgt autosar_swc_aeb_rtARID_DEF.ObjData_i[12].LongPredTime.TimeToMiddleLgt autosar_swc_aeb_rtARID_DEF.ObjData_i[12].LongPredTime.TimeToPassLgt autosar_swc_aeb_rtARID_DEF.ObjData_i[12].LongPredTime.TTMSelected autosar_swc_aeb_rtARID_DEF.ObjData_i[12].LongPredTime.InPath autosar_swc_aeb_rtARID_DEF.ObjData_i[12].LongPredTime.ObjOnCmngAndBrkg autosar_swc_aeb_rtARID_DEF.ObjData_i[12].LongPredTime.ALgt autosar_swc_aeb_rtARID_DEF.ObjData_i[12].LongPredTime.ALat autosar_swc_aeb_rtARID_DEF.ObjData_i[12].LongPredTime.A autosar_swc_aeb_rtARID_DEF.ObjData_i[12].LongPredTime.Crvt /end REF_MEASUREMENT
/end GROUP
/begin GROUP autosar_swc_aeb_rtARID_DEF.ObjData_i[12].MotionType ""
 /begin REF_MEASUREMENT autosar_swc_aeb_rtARID_DEF.ObjData_i[12].MotionType.Stationary autosar_swc_aeb_rtARID_DEF.ObjData_i[12].MotionType.MovingOncoming autosar_swc_aeb_rtARID_DEF.ObjData_i[12].MotionType.ParallellVehicleLongPred autosar_swc_aeb_rtARID_DEF.ObjData_i[12].MotionType.ParallellVehicleShortPred autosar_swc_aeb_rtARID_DEF.ObjData_i[12].MotionType.ObjectIsVehicle autosar_swc_aeb_rtARID_DEF.ObjData_i[12].MotionType.ObjectIsMotorVehicle autosar_swc_aeb_rtARID_DEF.ObjData_i[12].MotionType.CurvedMotion autosar_swc_aeb_rtARID_DEF.ObjData_i[12].MotionType.SideIsClosest autosar_swc_aeb_rtARID_DEF.ObjData_i[12].MotionType.AbsHeading /end REF_MEASUREMENT
/end GROUP
/begin GROUP autosar_swc_aeb_rtARID_DEF.ObjData_i[12].Offsets ""
 /begin REF_MEASUREMENT autosar_swc_aeb_rtARID_DEF.ObjData_i[12].Offsets.OffsLgtLongPred autosar_swc_aeb_rtARID_DEF.ObjData_i[12].Offsets.OffsLatLongPred autosar_swc_aeb_rtARID_DEF.ObjData_i[12].Offsets.OffsLgtShortPred autosar_swc_aeb_rtARID_DEF.ObjData_i[12].Offsets.OffsLatShortPred autosar_swc_aeb_rtARID_DEF.ObjData_i[12].Offsets.OffsLatManoeuvre autosar_swc_aeb_rtARID_DEF.ObjData_i[12].Offsets.OffsLatInPathPrimaryTarget autosar_swc_aeb_rtARID_DEF.ObjData_i[12].Offsets.OffsLatInPathCloseEdge autosar_swc_aeb_rtARID_DEF.ObjData_i[12].Offsets.OffsLatInPathFarEdge autosar_swc_aeb_rtARID_DEF.ObjData_i[12].Offsets.OffsLatIntersection autosar_swc_aeb_rtARID_DEF.ObjData_i[12].Offsets.OffsLatMplTar /end REF_MEASUREMENT
/end GROUP
/begin GROUP autosar_swc_aeb_rtARID_DEF.ObjData_i[12].ShortPredTime ""
 /begin REF_MEASUREMENT autosar_swc_aeb_rtARID_DEF.ObjData_i[12].ShortPredTime.TimeToReachLgt autosar_swc_aeb_rtARID_DEF.ObjData_i[12].ShortPredTime.TimeToMiddleLgt autosar_swc_aeb_rtARID_DEF.ObjData_i[12].ShortPredTime.TimeToPassLgt autosar_swc_aeb_rtARID_DEF.ObjData_i[12].ShortPredTime.TTMSelected autosar_swc_aeb_rtARID_DEF.ObjData_i[12].ShortPredTime.InPath autosar_swc_aeb_rtARID_DEF.ObjData_i[12].ShortPredTime.ObjOnCmngAndBrkg autosar_swc_aeb_rtARID_DEF.ObjData_i[12].ShortPredTime.ALgt autosar_swc_aeb_rtARID_DEF.ObjData_i[12].ShortPredTime.ALat autosar_swc_aeb_rtARID_DEF.ObjData_i[12].ShortPredTime.A autosar_swc_aeb_rtARID_DEF.ObjData_i[12].ShortPredTime.Crvt /end REF_MEASUREMENT
/end GROUP
/begin GROUP autosar_swc_aeb_rtARID_DEF.ObjData_i[13] ""
 /begin SUB_GROUP autosar_swc_aeb_rtARID_DEF.ObjData_i[13].MotionType autosar_swc_aeb_rtARID_DEF.ObjData_i[13].BoundingBox autosar_swc_aeb_rtARID_DEF.ObjData_i[13].Offsets autosar_swc_aeb_rtARID_DEF.ObjData_i[13].LongPredTime autosar_swc_aeb_rtARID_DEF.ObjData_i[13].ShortPredTime /end SUB_GROUP
 /begin REF_MEASUREMENT autosar_swc_aeb_rtARID_DEF.ObjData_i[13].InPathAtCurrentPosition autosar_swc_aeb_rtARID_DEF.ObjData_i[13].PredictionValid autosar_swc_aeb_rtARID_DEF.ObjData_i[13].Idn /end REF_MEASUREMENT
/end GROUP
/begin GROUP autosar_swc_aeb_rtARID_DEF.ObjData_i[13].BoundingBox ""
 /begin REF_MEASUREMENT autosar_swc_aeb_rtARID_DEF.ObjData_i[13].BoundingBox.LengthSideLat autosar_swc_aeb_rtARID_DEF.ObjData_i[13].BoundingBox.LengthSideLgt autosar_swc_aeb_rtARID_DEF.ObjData_i[13].BoundingBox.SinRotation autosar_swc_aeb_rtARID_DEF.ObjData_i[13].BoundingBox.CosRotation autosar_swc_aeb_rtARID_DEF.ObjData_i[13].BoundingBox.RotationAngle /end REF_MEASUREMENT
/end GROUP
/begin GROUP autosar_swc_aeb_rtARID_DEF.ObjData_i[13].LongPredTime ""
 /begin REF_MEASUREMENT autosar_swc_aeb_rtARID_DEF.ObjData_i[13].LongPredTime.TimeToReachLgt autosar_swc_aeb_rtARID_DEF.ObjData_i[13].LongPredTime.TimeToMiddleLgt autosar_swc_aeb_rtARID_DEF.ObjData_i[13].LongPredTime.TimeToPassLgt autosar_swc_aeb_rtARID_DEF.ObjData_i[13].LongPredTime.TTMSelected autosar_swc_aeb_rtARID_DEF.ObjData_i[13].LongPredTime.InPath autosar_swc_aeb_rtARID_DEF.ObjData_i[13].LongPredTime.ObjOnCmngAndBrkg autosar_swc_aeb_rtARID_DEF.ObjData_i[13].LongPredTime.ALgt autosar_swc_aeb_rtARID_DEF.ObjData_i[13].LongPredTime.ALat autosar_swc_aeb_rtARID_DEF.ObjData_i[13].LongPredTime.A autosar_swc_aeb_rtARID_DEF.ObjData_i[13].LongPredTime.Crvt /end REF_MEASUREMENT
/end GROUP
/begin GROUP autosar_swc_aeb_rtARID_DEF.ObjData_i[13].MotionType ""
 /begin REF_MEASUREMENT autosar_swc_aeb_rtARID_DEF.ObjData_i[13].MotionType.Stationary autosar_swc_aeb_rtARID_DEF.ObjData_i[13].MotionType.MovingOncoming autosar_swc_aeb_rtARID_DEF.ObjData_i[13].MotionType.ParallellVehicleLongPred autosar_swc_aeb_rtARID_DEF.ObjData_i[13].MotionType.ParallellVehicleShortPred autosar_swc_aeb_rtARID_DEF.ObjData_i[13].MotionType.ObjectIsVehicle autosar_swc_aeb_rtARID_DEF.ObjData_i[13].MotionType.ObjectIsMotorVehicle autosar_swc_aeb_rtARID_DEF.ObjData_i[13].MotionType.CurvedMotion autosar_swc_aeb_rtARID_DEF.ObjData_i[13].MotionType.SideIsClosest autosar_swc_aeb_rtARID_DEF.ObjData_i[13].MotionType.AbsHeading /end REF_MEASUREMENT
/end GROUP
/begin GROUP autosar_swc_aeb_rtARID_DEF.ObjData_i[13].Offsets ""
 /begin REF_MEASUREMENT autosar_swc_aeb_rtARID_DEF.ObjData_i[13].Offsets.OffsLgtLongPred autosar_swc_aeb_rtARID_DEF.ObjData_i[13].Offsets.OffsLatLongPred autosar_swc_aeb_rtARID_DEF.ObjData_i[13].Offsets.OffsLgtShortPred autosar_swc_aeb_rtARID_DEF.ObjData_i[13].Offsets.OffsLatShortPred autosar_swc_aeb_rtARID_DEF.ObjData_i[13].Offsets.OffsLatManoeuvre autosar_swc_aeb_rtARID_DEF.ObjData_i[13].Offsets.OffsLatInPathPrimaryTarget autosar_swc_aeb_rtARID_DEF.ObjData_i[13].Offsets.OffsLatInPathCloseEdge autosar_swc_aeb_rtARID_DEF.ObjData_i[13].Offsets.OffsLatInPathFarEdge autosar_swc_aeb_rtARID_DEF.ObjData_i[13].Offsets.OffsLatIntersection autosar_swc_aeb_rtARID_DEF.ObjData_i[13].Offsets.OffsLatMplTar /end REF_MEASUREMENT
/end GROUP
/begin GROUP autosar_swc_aeb_rtARID_DEF.ObjData_i[13].ShortPredTime ""
 /begin REF_MEASUREMENT autosar_swc_aeb_rtARID_DEF.ObjData_i[13].ShortPredTime.TimeToReachLgt autosar_swc_aeb_rtARID_DEF.ObjData_i[13].ShortPredTime.TimeToMiddleLgt autosar_swc_aeb_rtARID_DEF.ObjData_i[13].ShortPredTime.TimeToPassLgt autosar_swc_aeb_rtARID_DEF.ObjData_i[13].ShortPredTime.TTMSelected autosar_swc_aeb_rtARID_DEF.ObjData_i[13].ShortPredTime.InPath autosar_swc_aeb_rtARID_DEF.ObjData_i[13].ShortPredTime.ObjOnCmngAndBrkg autosar_swc_aeb_rtARID_DEF.ObjData_i[13].ShortPredTime.ALgt autosar_swc_aeb_rtARID_DEF.ObjData_i[13].ShortPredTime.ALat autosar_swc_aeb_rtARID_DEF.ObjData_i[13].ShortPredTime.A autosar_swc_aeb_rtARID_DEF.ObjData_i[13].ShortPredTime.Crvt /end REF_MEASUREMENT
/end GROUP
/begin GROUP autosar_swc_aeb_rtARID_DEF.ObjData_i[14] ""
 /begin SUB_GROUP autosar_swc_aeb_rtARID_DEF.ObjData_i[14].MotionType autosar_swc_aeb_rtARID_DEF.ObjData_i[14].BoundingBox autosar_swc_aeb_rtARID_DEF.ObjData_i[14].Offsets autosar_swc_aeb_rtARID_DEF.ObjData_i[14].LongPredTime autosar_swc_aeb_rtARID_DEF.ObjData_i[14].ShortPredTime /end SUB_GROUP
 /begin REF_MEASUREMENT autosar_swc_aeb_rtARID_DEF.ObjData_i[14].InPathAtCurrentPosition autosar_swc_aeb_rtARID_DEF.ObjData_i[14].PredictionValid autosar_swc_aeb_rtARID_DEF.ObjData_i[14].Idn /end REF_MEASUREMENT
/end GROUP
/begin GROUP autosar_swc_aeb_rtARID_DEF.ObjData_i[14].BoundingBox ""
 /begin REF_MEASUREMENT autosar_swc_aeb_rtARID_DEF.ObjData_i[14].BoundingBox.LengthSideLat autosar_swc_aeb_rtARID_DEF.ObjData_i[14].BoundingBox.LengthSideLgt autosar_swc_aeb_rtARID_DEF.ObjData_i[14].BoundingBox.SinRotation autosar_swc_aeb_rtARID_DEF.ObjData_i[14].BoundingBox.CosRotation autosar_swc_aeb_rtARID_DEF.ObjData_i[14].BoundingBox.RotationAngle /end REF_MEASUREMENT
/end GROUP
/begin GROUP autosar_swc_aeb_rtARID_DEF.ObjData_i[14].LongPredTime ""
 /begin REF_MEASUREMENT autosar_swc_aeb_rtARID_DEF.ObjData_i[14].LongPredTime.TimeToReachLgt autosar_swc_aeb_rtARID_DEF.ObjData_i[14].LongPredTime.TimeToMiddleLgt autosar_swc_aeb_rtARID_DEF.ObjData_i[14].LongPredTime.TimeToPassLgt autosar_swc_aeb_rtARID_DEF.ObjData_i[14].LongPredTime.TTMSelected autosar_swc_aeb_rtARID_DEF.ObjData_i[14].LongPredTime.InPath autosar_swc_aeb_rtARID_DEF.ObjData_i[14].LongPredTime.ObjOnCmngAndBrkg autosar_swc_aeb_rtARID_DEF.ObjData_i[14].LongPredTime.ALgt autosar_swc_aeb_rtARID_DEF.ObjData_i[14].LongPredTime.ALat autosar_swc_aeb_rtARID_DEF.ObjData_i[14].LongPredTime.A autosar_swc_aeb_rtARID_DEF.ObjData_i[14].LongPredTime.Crvt /end REF_MEASUREMENT
/end GROUP
/begin GROUP autosar_swc_aeb_rtARID_DEF.ObjData_i[14].MotionType ""
 /begin REF_MEASUREMENT autosar_swc_aeb_rtARID_DEF.ObjData_i[14].MotionType.Stationary autosar_swc_aeb_rtARID_DEF.ObjData_i[14].MotionType.MovingOncoming autosar_swc_aeb_rtARID_DEF.ObjData_i[14].MotionType.ParallellVehicleLongPred autosar_swc_aeb_rtARID_DEF.ObjData_i[14].MotionType.ParallellVehicleShortPred autosar_swc_aeb_rtARID_DEF.ObjData_i[14].MotionType.ObjectIsVehicle autosar_swc_aeb_rtARID_DEF.ObjData_i[14].MotionType.ObjectIsMotorVehicle autosar_swc_aeb_rtARID_DEF.ObjData_i[14].MotionType.CurvedMotion autosar_swc_aeb_rtARID_DEF.ObjData_i[14].MotionType.SideIsClosest autosar_swc_aeb_rtARID_DEF.ObjData_i[14].MotionType.AbsHeading /end REF_MEASUREMENT
/end GROUP
/begin GROUP autosar_swc_aeb_rtARID_DEF.ObjData_i[14].Offsets ""
 /begin REF_MEASUREMENT autosar_swc_aeb_rtARID_DEF.ObjData_i[14].Offsets.OffsLgtLongPred autosar_swc_aeb_rtARID_DEF.ObjData_i[14].Offsets.OffsLatLongPred autosar_swc_aeb_rtARID_DEF.ObjData_i[14].Offsets.OffsLgtShortPred autosar_swc_aeb_rtARID_DEF.ObjData_i[14].Offsets.OffsLatShortPred autosar_swc_aeb_rtARID_DEF.ObjData_i[14].Offsets.OffsLatManoeuvre autosar_swc_aeb_rtARID_DEF.ObjData_i[14].Offsets.OffsLatInPathPrimaryTarget autosar_swc_aeb_rtARID_DEF.ObjData_i[14].Offsets.OffsLatInPathCloseEdge autosar_swc_aeb_rtARID_DEF.ObjData_i[14].Offsets.OffsLatInPathFarEdge autosar_swc_aeb_rtARID_DEF.ObjData_i[14].Offsets.OffsLatIntersection autosar_swc_aeb_rtARID_DEF.ObjData_i[14].Offsets.OffsLatMplTar /end REF_MEASUREMENT
/end GROUP
/begin GROUP autosar_swc_aeb_rtARID_DEF.ObjData_i[14].ShortPredTime ""
 /begin REF_MEASUREMENT autosar_swc_aeb_rtARID_DEF.ObjData_i[14].ShortPredTime.TimeToReachLgt autosar_swc_aeb_rtARID_DEF.ObjData_i[14].ShortPredTime.TimeToMiddleLgt autosar_swc_aeb_rtARID_DEF.ObjData_i[14].ShortPredTime.TimeToPassLgt autosar_swc_aeb_rtARID_DEF.ObjData_i[14].ShortPredTime.TTMSelected autosar_swc_aeb_rtARID_DEF.ObjData_i[14].ShortPredTime.InPath autosar_swc_aeb_rtARID_DEF.ObjData_i[14].ShortPredTime.ObjOnCmngAndBrkg autosar_swc_aeb_rtARID_DEF.ObjData_i[14].ShortPredTime.ALgt autosar_swc_aeb_rtARID_DEF.ObjData_i[14].ShortPredTime.ALat autosar_swc_aeb_rtARID_DEF.ObjData_i[14].ShortPredTime.A autosar_swc_aeb_rtARID_DEF.ObjData_i[14].ShortPredTime.Crvt /end REF_MEASUREMENT
/end GROUP
/begin GROUP autosar_swc_aeb_rtARID_DEF.ObjData_i[15] ""
 /begin SUB_GROUP autosar_swc_aeb_rtARID_DEF.ObjData_i[15].MotionType autosar_swc_aeb_rtARID_DEF.ObjData_i[15].BoundingBox autosar_swc_aeb_rtARID_DEF.ObjData_i[15].Offsets autosar_swc_aeb_rtARID_DEF.ObjData_i[15].LongPredTime autosar_swc_aeb_rtARID_DEF.ObjData_i[15].ShortPredTime /end SUB_GROUP
 /begin REF_MEASUREMENT autosar_swc_aeb_rtARID_DEF.ObjData_i[15].InPathAtCurrentPosition autosar_swc_aeb_rtARID_DEF.ObjData_i[15].PredictionValid autosar_swc_aeb_rtARID_DEF.ObjData_i[15].Idn /end REF_MEASUREMENT
/end GROUP
/begin GROUP autosar_swc_aeb_rtARID_DEF.ObjData_i[15].BoundingBox ""
 /begin REF_MEASUREMENT autosar_swc_aeb_rtARID_DEF.ObjData_i[15].BoundingBox.LengthSideLat autosar_swc_aeb_rtARID_DEF.ObjData_i[15].BoundingBox.LengthSideLgt autosar_swc_aeb_rtARID_DEF.ObjData_i[15].BoundingBox.SinRotation autosar_swc_aeb_rtARID_DEF.ObjData_i[15].BoundingBox.CosRotation autosar_swc_aeb_rtARID_DEF.ObjData_i[15].BoundingBox.RotationAngle /end REF_MEASUREMENT
/end GROUP
/begin GROUP autosar_swc_aeb_rtARID_DEF.ObjData_i[15].LongPredTime ""
 /begin REF_MEASUREMENT autosar_swc_aeb_rtARID_DEF.ObjData_i[15].LongPredTime.TimeToReachLgt autosar_swc_aeb_rtARID_DEF.ObjData_i[15].LongPredTime.TimeToMiddleLgt autosar_swc_aeb_rtARID_DEF.ObjData_i[15].LongPredTime.TimeToPassLgt autosar_swc_aeb_rtARID_DEF.ObjData_i[15].LongPredTime.TTMSelected autosar_swc_aeb_rtARID_DEF.ObjData_i[15].LongPredTime.InPath autosar_swc_aeb_rtARID_DEF.ObjData_i[15].LongPredTime.ObjOnCmngAndBrkg autosar_swc_aeb_rtARID_DEF.ObjData_i[15].LongPredTime.ALgt autosar_swc_aeb_rtARID_DEF.ObjData_i[15].LongPredTime.ALat autosar_swc_aeb_rtARID_DEF.ObjData_i[15].LongPredTime.A autosar_swc_aeb_rtARID_DEF.ObjData_i[15].LongPredTime.Crvt /end REF_MEASUREMENT
/end GROUP
/begin GROUP autosar_swc_aeb_rtARID_DEF.ObjData_i[15].MotionType ""
 /begin REF_MEASUREMENT autosar_swc_aeb_rtARID_DEF.ObjData_i[15].MotionType.Stationary autosar_swc_aeb_rtARID_DEF.ObjData_i[15].MotionType.MovingOncoming autosar_swc_aeb_rtARID_DEF.ObjData_i[15].MotionType.ParallellVehicleLongPred autosar_swc_aeb_rtARID_DEF.ObjData_i[15].MotionType.ParallellVehicleShortPred autosar_swc_aeb_rtARID_DEF.ObjData_i[15].MotionType.ObjectIsVehicle autosar_swc_aeb_rtARID_DEF.ObjData_i[15].MotionType.ObjectIsMotorVehicle autosar_swc_aeb_rtARID_DEF.ObjData_i[15].MotionType.CurvedMotion autosar_swc_aeb_rtARID_DEF.ObjData_i[15].MotionType.SideIsClosest autosar_swc_aeb_rtARID_DEF.ObjData_i[15].MotionType.AbsHeading /end REF_MEASUREMENT
/end GROUP
/begin GROUP autosar_swc_aeb_rtARID_DEF.ObjData_i[15].Offsets ""
 /begin REF_MEASUREMENT autosar_swc_aeb_rtARID_DEF.ObjData_i[15].Offsets.OffsLgtLongPred autosar_swc_aeb_rtARID_DEF.ObjData_i[15].Offsets.OffsLatLongPred autosar_swc_aeb_rtARID_DEF.ObjData_i[15].Offsets.OffsLgtShortPred autosar_swc_aeb_rtARID_DEF.ObjData_i[15].Offsets.OffsLatShortPred autosar_swc_aeb_rtARID_DEF.ObjData_i[15].Offsets.OffsLatManoeuvre autosar_swc_aeb_rtARID_DEF.ObjData_i[15].Offsets.OffsLatInPathPrimaryTarget autosar_swc_aeb_rtARID_DEF.ObjData_i[15].Offsets.OffsLatInPathCloseEdge autosar_swc_aeb_rtARID_DEF.ObjData_i[15].Offsets.OffsLatInPathFarEdge autosar_swc_aeb_rtARID_DEF.ObjData_i[15].Offsets.OffsLatIntersection autosar_swc_aeb_rtARID_DEF.ObjData_i[15].Offsets.OffsLatMplTar /end REF_MEASUREMENT
/end GROUP
/begin GROUP autosar_swc_aeb_rtARID_DEF.ObjData_i[15].ShortPredTime ""
 /begin REF_MEASUREMENT autosar_swc_aeb_rtARID_DEF.ObjData_i[15].ShortPredTime.TimeToReachLgt autosar_swc_aeb_rtARID_DEF.ObjData_i[15].ShortPredTime.TimeToMiddleLgt autosar_swc_aeb_rtARID_DEF.ObjData_i[15].ShortPredTime.TimeToPassLgt autosar_swc_aeb_rtARID_DEF.ObjData_i[15].ShortPredTime.TTMSelected autosar_swc_aeb_rtARID_DEF.ObjData_i[15].ShortPredTime.InPath autosar_swc_aeb_rtARID_DEF.ObjData_i[15].ShortPredTime.ObjOnCmngAndBrkg autosar_swc_aeb_rtARID_DEF.ObjData_i[15].ShortPredTime.ALgt autosar_swc_aeb_rtARID_DEF.ObjData_i[15].ShortPredTime.ALat autosar_swc_aeb_rtARID_DEF.ObjData_i[15].ShortPredTime.A autosar_swc_aeb_rtARID_DEF.ObjData_i[15].ShortPredTime.Crvt /end REF_MEASUREMENT
/end GROUP
/begin GROUP autosar_swc_aeb_rtARID_DEF.ObjData_i[16] ""
 /begin SUB_GROUP autosar_swc_aeb_rtARID_DEF.ObjData_i[16].MotionType autosar_swc_aeb_rtARID_DEF.ObjData_i[16].BoundingBox autosar_swc_aeb_rtARID_DEF.ObjData_i[16].Offsets autosar_swc_aeb_rtARID_DEF.ObjData_i[16].LongPredTime autosar_swc_aeb_rtARID_DEF.ObjData_i[16].ShortPredTime /end SUB_GROUP
 /begin REF_MEASUREMENT autosar_swc_aeb_rtARID_DEF.ObjData_i[16].InPathAtCurrentPosition autosar_swc_aeb_rtARID_DEF.ObjData_i[16].PredictionValid autosar_swc_aeb_rtARID_DEF.ObjData_i[16].Idn /end REF_MEASUREMENT
/end GROUP
/begin GROUP autosar_swc_aeb_rtARID_DEF.ObjData_i[16].BoundingBox ""
 /begin REF_MEASUREMENT autosar_swc_aeb_rtARID_DEF.ObjData_i[16].BoundingBox.LengthSideLat autosar_swc_aeb_rtARID_DEF.ObjData_i[16].BoundingBox.LengthSideLgt autosar_swc_aeb_rtARID_DEF.ObjData_i[16].BoundingBox.SinRotation autosar_swc_aeb_rtARID_DEF.ObjData_i[16].BoundingBox.CosRotation autosar_swc_aeb_rtARID_DEF.ObjData_i[16].BoundingBox.RotationAngle /end REF_MEASUREMENT
/end GROUP
/begin GROUP autosar_swc_aeb_rtARID_DEF.ObjData_i[16].LongPredTime ""
 /begin REF_MEASUREMENT autosar_swc_aeb_rtARID_DEF.ObjData_i[16].LongPredTime.TimeToReachLgt autosar_swc_aeb_rtARID_DEF.ObjData_i[16].LongPredTime.TimeToMiddleLgt autosar_swc_aeb_rtARID_DEF.ObjData_i[16].LongPredTime.TimeToPassLgt autosar_swc_aeb_rtARID_DEF.ObjData_i[16].LongPredTime.TTMSelected autosar_swc_aeb_rtARID_DEF.ObjData_i[16].LongPredTime.InPath autosar_swc_aeb_rtARID_DEF.ObjData_i[16].LongPredTime.ObjOnCmngAndBrkg autosar_swc_aeb_rtARID_DEF.ObjData_i[16].LongPredTime.ALgt autosar_swc_aeb_rtARID_DEF.ObjData_i[16].LongPredTime.ALat autosar_swc_aeb_rtARID_DEF.ObjData_i[16].LongPredTime.A autosar_swc_aeb_rtARID_DEF.ObjData_i[16].LongPredTime.Crvt /end REF_MEASUREMENT
/end GROUP
/begin GROUP autosar_swc_aeb_rtARID_DEF.ObjData_i[16].MotionType ""
 /begin REF_MEASUREMENT autosar_swc_aeb_rtARID_DEF.ObjData_i[16].MotionType.Stationary autosar_swc_aeb_rtARID_DEF.ObjData_i[16].MotionType.MovingOncoming autosar_swc_aeb_rtARID_DEF.ObjData_i[16].MotionType.ParallellVehicleLongPred autosar_swc_aeb_rtARID_DEF.ObjData_i[16].MotionType.ParallellVehicleShortPred autosar_swc_aeb_rtARID_DEF.ObjData_i[16].MotionType.ObjectIsVehicle autosar_swc_aeb_rtARID_DEF.ObjData_i[16].MotionType.ObjectIsMotorVehicle autosar_swc_aeb_rtARID_DEF.ObjData_i[16].MotionType.CurvedMotion autosar_swc_aeb_rtARID_DEF.ObjData_i[16].MotionType.SideIsClosest autosar_swc_aeb_rtARID_DEF.ObjData_i[16].MotionType.AbsHeading /end REF_MEASUREMENT
/end GROUP
/begin GROUP autosar_swc_aeb_rtARID_DEF.ObjData_i[16].Offsets ""
 /begin REF_MEASUREMENT autosar_swc_aeb_rtARID_DEF.ObjData_i[16].Offsets.OffsLgtLongPred autosar_swc_aeb_rtARID_DEF.ObjData_i[16].Offsets.OffsLatLongPred autosar_swc_aeb_rtARID_DEF.ObjData_i[16].Offsets.OffsLgtShortPred autosar_swc_aeb_rtARID_DEF.ObjData_i[16].Offsets.OffsLatShortPred autosar_swc_aeb_rtARID_DEF.ObjData_i[16].Offsets.OffsLatManoeuvre autosar_swc_aeb_rtARID_DEF.ObjData_i[16].Offsets.OffsLatInPathPrimaryTarget autosar_swc_aeb_rtARID_DEF.ObjData_i[16].Offsets.OffsLatInPathCloseEdge autosar_swc_aeb_rtARID_DEF.ObjData_i[16].Offsets.OffsLatInPathFarEdge autosar_swc_aeb_rtARID_DEF.ObjData_i[16].Offsets.OffsLatIntersection autosar_swc_aeb_rtARID_DEF.ObjData_i[16].Offsets.OffsLatMplTar /end REF_MEASUREMENT
/end GROUP
/begin GROUP autosar_swc_aeb_rtARID_DEF.ObjData_i[16].ShortPredTime ""
 /begin REF_MEASUREMENT autosar_swc_aeb_rtARID_DEF.ObjData_i[16].ShortPredTime.TimeToReachLgt autosar_swc_aeb_rtARID_DEF.ObjData_i[16].ShortPredTime.TimeToMiddleLgt autosar_swc_aeb_rtARID_DEF.ObjData_i[16].ShortPredTime.TimeToPassLgt autosar_swc_aeb_rtARID_DEF.ObjData_i[16].ShortPredTime.TTMSelected autosar_swc_aeb_rtARID_DEF.ObjData_i[16].ShortPredTime.InPath autosar_swc_aeb_rtARID_DEF.ObjData_i[16].ShortPredTime.ObjOnCmngAndBrkg autosar_swc_aeb_rtARID_DEF.ObjData_i[16].ShortPredTime.ALgt autosar_swc_aeb_rtARID_DEF.ObjData_i[16].ShortPredTime.ALat autosar_swc_aeb_rtARID_DEF.ObjData_i[16].ShortPredTime.A autosar_swc_aeb_rtARID_DEF.ObjData_i[16].ShortPredTime.Crvt /end REF_MEASUREMENT
/end GROUP
/begin GROUP autosar_swc_aeb_rtARID_DEF.ObjData_i[17] ""
 /begin SUB_GROUP autosar_swc_aeb_rtARID_DEF.ObjData_i[17].MotionType autosar_swc_aeb_rtARID_DEF.ObjData_i[17].BoundingBox autosar_swc_aeb_rtARID_DEF.ObjData_i[17].Offsets autosar_swc_aeb_rtARID_DEF.ObjData_i[17].LongPredTime autosar_swc_aeb_rtARID_DEF.ObjData_i[17].ShortPredTime /end SUB_GROUP
 /begin REF_MEASUREMENT autosar_swc_aeb_rtARID_DEF.ObjData_i[17].InPathAtCurrentPosition autosar_swc_aeb_rtARID_DEF.ObjData_i[17].PredictionValid autosar_swc_aeb_rtARID_DEF.ObjData_i[17].Idn /end REF_MEASUREMENT
/end GROUP
/begin GROUP autosar_swc_aeb_rtARID_DEF.ObjData_i[17].BoundingBox ""
 /begin REF_MEASUREMENT autosar_swc_aeb_rtARID_DEF.ObjData_i[17].BoundingBox.LengthSideLat autosar_swc_aeb_rtARID_DEF.ObjData_i[17].BoundingBox.LengthSideLgt autosar_swc_aeb_rtARID_DEF.ObjData_i[17].BoundingBox.SinRotation autosar_swc_aeb_rtARID_DEF.ObjData_i[17].BoundingBox.CosRotation autosar_swc_aeb_rtARID_DEF.ObjData_i[17].BoundingBox.RotationAngle /end REF_MEASUREMENT
/end GROUP
/begin GROUP autosar_swc_aeb_rtARID_DEF.ObjData_i[17].LongPredTime ""
 /begin REF_MEASUREMENT autosar_swc_aeb_rtARID_DEF.ObjData_i[17].LongPredTime.TimeToReachLgt autosar_swc_aeb_rtARID_DEF.ObjData_i[17].LongPredTime.TimeToMiddleLgt autosar_swc_aeb_rtARID_DEF.ObjData_i[17].LongPredTime.TimeToPassLgt autosar_swc_aeb_rtARID_DEF.ObjData_i[17].LongPredTime.TTMSelected autosar_swc_aeb_rtARID_DEF.ObjData_i[17].LongPredTime.InPath autosar_swc_aeb_rtARID_DEF.ObjData_i[17].LongPredTime.ObjOnCmngAndBrkg autosar_swc_aeb_rtARID_DEF.ObjData_i[17].LongPredTime.ALgt autosar_swc_aeb_rtARID_DEF.ObjData_i[17].LongPredTime.ALat autosar_swc_aeb_rtARID_DEF.ObjData_i[17].LongPredTime.A autosar_swc_aeb_rtARID_DEF.ObjData_i[17].LongPredTime.Crvt /end REF_MEASUREMENT
/end GROUP
/begin GROUP autosar_swc_aeb_rtARID_DEF.ObjData_i[17].MotionType ""
 /begin REF_MEASUREMENT autosar_swc_aeb_rtARID_DEF.ObjData_i[17].MotionType.Stationary autosar_swc_aeb_rtARID_DEF.ObjData_i[17].MotionType.MovingOncoming autosar_swc_aeb_rtARID_DEF.ObjData_i[17].MotionType.ParallellVehicleLongPred autosar_swc_aeb_rtARID_DEF.ObjData_i[17].MotionType.ParallellVehicleShortPred autosar_swc_aeb_rtARID_DEF.ObjData_i[17].MotionType.ObjectIsVehicle autosar_swc_aeb_rtARID_DEF.ObjData_i[17].MotionType.ObjectIsMotorVehicle autosar_swc_aeb_rtARID_DEF.ObjData_i[17].MotionType.CurvedMotion autosar_swc_aeb_rtARID_DEF.ObjData_i[17].MotionType.SideIsClosest autosar_swc_aeb_rtARID_DEF.ObjData_i[17].MotionType.AbsHeading /end REF_MEASUREMENT
/end GROUP
/begin GROUP autosar_swc_aeb_rtARID_DEF.ObjData_i[17].Offsets ""
 /begin REF_MEASUREMENT autosar_swc_aeb_rtARID_DEF.ObjData_i[17].Offsets.OffsLgtLongPred autosar_swc_aeb_rtARID_DEF.ObjData_i[17].Offsets.OffsLatLongPred autosar_swc_aeb_rtARID_DEF.ObjData_i[17].Offsets.OffsLgtShortPred autosar_swc_aeb_rtARID_DEF.ObjData_i[17].Offsets.OffsLatShortPred autosar_swc_aeb_rtARID_DEF.ObjData_i[17].Offsets.OffsLatManoeuvre autosar_swc_aeb_rtARID_DEF.ObjData_i[17].Offsets.OffsLatInPathPrimaryTarget autosar_swc_aeb_rtARID_DEF.ObjData_i[17].Offsets.OffsLatInPathCloseEdge autosar_swc_aeb_rtARID_DEF.ObjData_i[17].Offsets.OffsLatInPathFarEdge autosar_swc_aeb_rtARID_DEF.ObjData_i[17].Offsets.OffsLatIntersection autosar_swc_aeb_rtARID_DEF.ObjData_i[17].Offsets.OffsLatMplTar /end REF_MEASUREMENT
/end GROUP
/begin GROUP autosar_swc_aeb_rtARID_DEF.ObjData_i[17].ShortPredTime ""
 /begin REF_MEASUREMENT autosar_swc_aeb_rtARID_DEF.ObjData_i[17].ShortPredTime.TimeToReachLgt autosar_swc_aeb_rtARID_DEF.ObjData_i[17].ShortPredTime.TimeToMiddleLgt autosar_swc_aeb_rtARID_DEF.ObjData_i[17].ShortPredTime.TimeToPassLgt autosar_swc_aeb_rtARID_DEF.ObjData_i[17].ShortPredTime.TTMSelected autosar_swc_aeb_rtARID_DEF.ObjData_i[17].ShortPredTime.InPath autosar_swc_aeb_rtARID_DEF.ObjData_i[17].ShortPredTime.ObjOnCmngAndBrkg autosar_swc_aeb_rtARID_DEF.ObjData_i[17].ShortPredTime.ALgt autosar_swc_aeb_rtARID_DEF.ObjData_i[17].ShortPredTime.ALat autosar_swc_aeb_rtARID_DEF.ObjData_i[17].ShortPredTime.A autosar_swc_aeb_rtARID_DEF.ObjData_i[17].ShortPredTime.Crvt /end REF_MEASUREMENT
/end GROUP
/begin GROUP autosar_swc_aeb_rtARID_DEF.ObjData_i[18] ""
 /begin SUB_GROUP autosar_swc_aeb_rtARID_DEF.ObjData_i[18].MotionType autosar_swc_aeb_rtARID_DEF.ObjData_i[18].BoundingBox autosar_swc_aeb_rtARID_DEF.ObjData_i[18].Offsets autosar_swc_aeb_rtARID_DEF.ObjData_i[18].LongPredTime autosar_swc_aeb_rtARID_DEF.ObjData_i[18].ShortPredTime /end SUB_GROUP
 /begin REF_MEASUREMENT autosar_swc_aeb_rtARID_DEF.ObjData_i[18].InPathAtCurrentPosition autosar_swc_aeb_rtARID_DEF.ObjData_i[18].PredictionValid autosar_swc_aeb_rtARID_DEF.ObjData_i[18].Idn /end REF_MEASUREMENT
/end GROUP
/begin GROUP autosar_swc_aeb_rtARID_DEF.ObjData_i[18].BoundingBox ""
 /begin REF_MEASUREMENT autosar_swc_aeb_rtARID_DEF.ObjData_i[18].BoundingBox.LengthSideLat autosar_swc_aeb_rtARID_DEF.ObjData_i[18].BoundingBox.LengthSideLgt autosar_swc_aeb_rtARID_DEF.ObjData_i[18].BoundingBox.SinRotation autosar_swc_aeb_rtARID_DEF.ObjData_i[18].BoundingBox.CosRotation autosar_swc_aeb_rtARID_DEF.ObjData_i[18].BoundingBox.RotationAngle /end REF_MEASUREMENT
/end GROUP
/begin GROUP autosar_swc_aeb_rtARID_DEF.ObjData_i[18].LongPredTime ""
 /begin REF_MEASUREMENT autosar_swc_aeb_rtARID_DEF.ObjData_i[18].LongPredTime.TimeToReachLgt autosar_swc_aeb_rtARID_DEF.ObjData_i[18].LongPredTime.TimeToMiddleLgt autosar_swc_aeb_rtARID_DEF.ObjData_i[18].LongPredTime.TimeToPassLgt autosar_swc_aeb_rtARID_DEF.ObjData_i[18].LongPredTime.TTMSelected autosar_swc_aeb_rtARID_DEF.ObjData_i[18].LongPredTime.InPath autosar_swc_aeb_rtARID_DEF.ObjData_i[18].LongPredTime.ObjOnCmngAndBrkg autosar_swc_aeb_rtARID_DEF.ObjData_i[18].LongPredTime.ALgt autosar_swc_aeb_rtARID_DEF.ObjData_i[18].LongPredTime.ALat autosar_swc_aeb_rtARID_DEF.ObjData_i[18].LongPredTime.A autosar_swc_aeb_rtARID_DEF.ObjData_i[18].LongPredTime.Crvt /end REF_MEASUREMENT
/end GROUP
/begin GROUP autosar_swc_aeb_rtARID_DEF.ObjData_i[18].MotionType ""
 /begin REF_MEASUREMENT autosar_swc_aeb_rtARID_DEF.ObjData_i[18].MotionType.Stationary autosar_swc_aeb_rtARID_DEF.ObjData_i[18].MotionType.MovingOncoming autosar_swc_aeb_rtARID_DEF.ObjData_i[18].MotionType.ParallellVehicleLongPred autosar_swc_aeb_rtARID_DEF.ObjData_i[18].MotionType.ParallellVehicleShortPred autosar_swc_aeb_rtARID_DEF.ObjData_i[18].MotionType.ObjectIsVehicle autosar_swc_aeb_rtARID_DEF.ObjData_i[18].MotionType.ObjectIsMotorVehicle autosar_swc_aeb_rtARID_DEF.ObjData_i[18].MotionType.CurvedMotion autosar_swc_aeb_rtARID_DEF.ObjData_i[18].MotionType.SideIsClosest autosar_swc_aeb_rtARID_DEF.ObjData_i[18].MotionType.AbsHeading /end REF_MEASUREMENT
/end GROUP
/begin GROUP autosar_swc_aeb_rtARID_DEF.ObjData_i[18].Offsets ""
 /begin REF_MEASUREMENT autosar_swc_aeb_rtARID_DEF.ObjData_i[18].Offsets.OffsLgtLongPred autosar_swc_aeb_rtARID_DEF.ObjData_i[18].Offsets.OffsLatLongPred autosar_swc_aeb_rtARID_DEF.ObjData_i[18].Offsets.OffsLgtShortPred autosar_swc_aeb_rtARID_DEF.ObjData_i[18].Offsets.OffsLatShortPred autosar_swc_aeb_rtARID_DEF.ObjData_i[18].Offsets.OffsLatManoeuvre autosar_swc_aeb_rtARID_DEF.ObjData_i[18].Offsets.OffsLatInPathPrimaryTarget autosar_swc_aeb_rtARID_DEF.ObjData_i[18].Offsets.OffsLatInPathCloseEdge autosar_swc_aeb_rtARID_DEF.ObjData_i[18].Offsets.OffsLatInPathFarEdge autosar_swc_aeb_rtARID_DEF.ObjData_i[18].Offsets.OffsLatIntersection autosar_swc_aeb_rtARID_DEF.ObjData_i[18].Offsets.OffsLatMplTar /end REF_MEASUREMENT
/end GROUP
/begin GROUP autosar_swc_aeb_rtARID_DEF.ObjData_i[18].ShortPredTime ""
 /begin REF_MEASUREMENT autosar_swc_aeb_rtARID_DEF.ObjData_i[18].ShortPredTime.TimeToReachLgt autosar_swc_aeb_rtARID_DEF.ObjData_i[18].ShortPredTime.TimeToMiddleLgt autosar_swc_aeb_rtARID_DEF.ObjData_i[18].ShortPredTime.TimeToPassLgt autosar_swc_aeb_rtARID_DEF.ObjData_i[18].ShortPredTime.TTMSelected autosar_swc_aeb_rtARID_DEF.ObjData_i[18].ShortPredTime.InPath autosar_swc_aeb_rtARID_DEF.ObjData_i[18].ShortPredTime.ObjOnCmngAndBrkg autosar_swc_aeb_rtARID_DEF.ObjData_i[18].ShortPredTime.ALgt autosar_swc_aeb_rtARID_DEF.ObjData_i[18].ShortPredTime.ALat autosar_swc_aeb_rtARID_DEF.ObjData_i[18].ShortPredTime.A autosar_swc_aeb_rtARID_DEF.ObjData_i[18].ShortPredTime.Crvt /end REF_MEASUREMENT
/end GROUP
/begin GROUP autosar_swc_aeb_rtARID_DEF.ObjData_i[19] ""
 /begin SUB_GROUP autosar_swc_aeb_rtARID_DEF.ObjData_i[19].MotionType autosar_swc_aeb_rtARID_DEF.ObjData_i[19].BoundingBox autosar_swc_aeb_rtARID_DEF.ObjData_i[19].Offsets autosar_swc_aeb_rtARID_DEF.ObjData_i[19].LongPredTime autosar_swc_aeb_rtARID_DEF.ObjData_i[19].ShortPredTime /end SUB_GROUP
 /begin REF_MEASUREMENT autosar_swc_aeb_rtARID_DEF.ObjData_i[19].InPathAtCurrentPosition autosar_swc_aeb_rtARID_DEF.ObjData_i[19].PredictionValid autosar_swc_aeb_rtARID_DEF.ObjData_i[19].Idn /end REF_MEASUREMENT
/end GROUP
/begin GROUP autosar_swc_aeb_rtARID_DEF.ObjData_i[19].BoundingBox ""
 /begin REF_MEASUREMENT autosar_swc_aeb_rtARID_DEF.ObjData_i[19].BoundingBox.LengthSideLat autosar_swc_aeb_rtARID_DEF.ObjData_i[19].BoundingBox.LengthSideLgt autosar_swc_aeb_rtARID_DEF.ObjData_i[19].BoundingBox.SinRotation autosar_swc_aeb_rtARID_DEF.ObjData_i[19].BoundingBox.CosRotation autosar_swc_aeb_rtARID_DEF.ObjData_i[19].BoundingBox.RotationAngle /end REF_MEASUREMENT
/end GROUP
/begin GROUP autosar_swc_aeb_rtARID_DEF.ObjData_i[19].LongPredTime ""
 /begin REF_MEASUREMENT autosar_swc_aeb_rtARID_DEF.ObjData_i[19].LongPredTime.TimeToReachLgt autosar_swc_aeb_rtARID_DEF.ObjData_i[19].LongPredTime.TimeToMiddleLgt autosar_swc_aeb_rtARID_DEF.ObjData_i[19].LongPredTime.TimeToPassLgt autosar_swc_aeb_rtARID_DEF.ObjData_i[19].LongPredTime.TTMSelected autosar_swc_aeb_rtARID_DEF.ObjData_i[19].LongPredTime.InPath autosar_swc_aeb_rtARID_DEF.ObjData_i[19].LongPredTime.ObjOnCmngAndBrkg autosar_swc_aeb_rtARID_DEF.ObjData_i[19].LongPredTime.ALgt autosar_swc_aeb_rtARID_DEF.ObjData_i[19].LongPredTime.ALat autosar_swc_aeb_rtARID_DEF.ObjData_i[19].LongPredTime.A autosar_swc_aeb_rtARID_DEF.ObjData_i[19].LongPredTime.Crvt /end REF_MEASUREMENT
/end GROUP
/begin GROUP autosar_swc_aeb_rtARID_DEF.ObjData_i[19].MotionType ""
 /begin REF_MEASUREMENT autosar_swc_aeb_rtARID_DEF.ObjData_i[19].MotionType.Stationary autosar_swc_aeb_rtARID_DEF.ObjData_i[19].MotionType.MovingOncoming autosar_swc_aeb_rtARID_DEF.ObjData_i[19].MotionType.ParallellVehicleLongPred autosar_swc_aeb_rtARID_DEF.ObjData_i[19].MotionType.ParallellVehicleShortPred autosar_swc_aeb_rtARID_DEF.ObjData_i[19].MotionType.ObjectIsVehicle autosar_swc_aeb_rtARID_DEF.ObjData_i[19].MotionType.ObjectIsMotorVehicle autosar_swc_aeb_rtARID_DEF.ObjData_i[19].MotionType.CurvedMotion autosar_swc_aeb_rtARID_DEF.ObjData_i[19].MotionType.SideIsClosest autosar_swc_aeb_rtARID_DEF.ObjData_i[19].MotionType.AbsHeading /end REF_MEASUREMENT
/end GROUP
/begin GROUP autosar_swc_aeb_rtARID_DEF.ObjData_i[19].Offsets ""
 /begin REF_MEASUREMENT autosar_swc_aeb_rtARID_DEF.ObjData_i[19].Offsets.OffsLgtLongPred autosar_swc_aeb_rtARID_DEF.ObjData_i[19].Offsets.OffsLatLongPred autosar_swc_aeb_rtARID_DEF.ObjData_i[19].Offsets.OffsLgtShortPred autosar_swc_aeb_rtARID_DEF.ObjData_i[19].Offsets.OffsLatShortPred autosar_swc_aeb_rtARID_DEF.ObjData_i[19].Offsets.OffsLatManoeuvre autosar_swc_aeb_rtARID_DEF.ObjData_i[19].Offsets.OffsLatInPathPrimaryTarget autosar_swc_aeb_rtARID_DEF.ObjData_i[19].Offsets.OffsLatInPathCloseEdge autosar_swc_aeb_rtARID_DEF.ObjData_i[19].Offsets.OffsLatInPathFarEdge autosar_swc_aeb_rtARID_DEF.ObjData_i[19].Offsets.OffsLatIntersection autosar_swc_aeb_rtARID_DEF.ObjData_i[19].Offsets.OffsLatMplTar /end REF_MEASUREMENT
/end GROUP
/begin GROUP autosar_swc_aeb_rtARID_DEF.ObjData_i[19].ShortPredTime ""
 /begin REF_MEASUREMENT autosar_swc_aeb_rtARID_DEF.ObjData_i[19].ShortPredTime.TimeToReachLgt autosar_swc_aeb_rtARID_DEF.ObjData_i[19].ShortPredTime.TimeToMiddleLgt autosar_swc_aeb_rtARID_DEF.ObjData_i[19].ShortPredTime.TimeToPassLgt autosar_swc_aeb_rtARID_DEF.ObjData_i[19].ShortPredTime.TTMSelected autosar_swc_aeb_rtARID_DEF.ObjData_i[19].ShortPredTime.InPath autosar_swc_aeb_rtARID_DEF.ObjData_i[19].ShortPredTime.ObjOnCmngAndBrkg autosar_swc_aeb_rtARID_DEF.ObjData_i[19].ShortPredTime.ALgt autosar_swc_aeb_rtARID_DEF.ObjData_i[19].ShortPredTime.ALat autosar_swc_aeb_rtARID_DEF.ObjData_i[19].ShortPredTime.A autosar_swc_aeb_rtARID_DEF.ObjData_i[19].ShortPredTime.Crvt /end REF_MEASUREMENT
/end GROUP
/begin GROUP autosar_swc_aeb_rtARID_DEF.ObjData_i[1] ""
 /begin SUB_GROUP autosar_swc_aeb_rtARID_DEF.ObjData_i[1].MotionType autosar_swc_aeb_rtARID_DEF.ObjData_i[1].BoundingBox autosar_swc_aeb_rtARID_DEF.ObjData_i[1].Offsets autosar_swc_aeb_rtARID_DEF.ObjData_i[1].LongPredTime autosar_swc_aeb_rtARID_DEF.ObjData_i[1].ShortPredTime /end SUB_GROUP
 /begin REF_MEASUREMENT autosar_swc_aeb_rtARID_DEF.ObjData_i[1].InPathAtCurrentPosition autosar_swc_aeb_rtARID_DEF.ObjData_i[1].PredictionValid autosar_swc_aeb_rtARID_DEF.ObjData_i[1].Idn /end REF_MEASUREMENT
/end GROUP
/begin GROUP autosar_swc_aeb_rtARID_DEF.ObjData_i[1].BoundingBox ""
 /begin REF_MEASUREMENT autosar_swc_aeb_rtARID_DEF.ObjData_i[1].BoundingBox.LengthSideLat autosar_swc_aeb_rtARID_DEF.ObjData_i[1].BoundingBox.LengthSideLgt autosar_swc_aeb_rtARID_DEF.ObjData_i[1].BoundingBox.SinRotation autosar_swc_aeb_rtARID_DEF.ObjData_i[1].BoundingBox.CosRotation autosar_swc_aeb_rtARID_DEF.ObjData_i[1].BoundingBox.RotationAngle /end REF_MEASUREMENT
/end GROUP
/begin GROUP autosar_swc_aeb_rtARID_DEF.ObjData_i[1].LongPredTime ""
 /begin REF_MEASUREMENT autosar_swc_aeb_rtARID_DEF.ObjData_i[1].LongPredTime.TimeToReachLgt autosar_swc_aeb_rtARID_DEF.ObjData_i[1].LongPredTime.TimeToMiddleLgt autosar_swc_aeb_rtARID_DEF.ObjData_i[1].LongPredTime.TimeToPassLgt autosar_swc_aeb_rtARID_DEF.ObjData_i[1].LongPredTime.TTMSelected autosar_swc_aeb_rtARID_DEF.ObjData_i[1].LongPredTime.InPath autosar_swc_aeb_rtARID_DEF.ObjData_i[1].LongPredTime.ObjOnCmngAndBrkg autosar_swc_aeb_rtARID_DEF.ObjData_i[1].LongPredTime.ALgt autosar_swc_aeb_rtARID_DEF.ObjData_i[1].LongPredTime.ALat autosar_swc_aeb_rtARID_DEF.ObjData_i[1].LongPredTime.A autosar_swc_aeb_rtARID_DEF.ObjData_i[1].LongPredTime.Crvt /end REF_MEASUREMENT
/end GROUP
/begin GROUP autosar_swc_aeb_rtARID_DEF.ObjData_i[1].MotionType ""
 /begin REF_MEASUREMENT autosar_swc_aeb_rtARID_DEF.ObjData_i[1].MotionType.Stationary autosar_swc_aeb_rtARID_DEF.ObjData_i[1].MotionType.MovingOncoming autosar_swc_aeb_rtARID_DEF.ObjData_i[1].MotionType.ParallellVehicleLongPred autosar_swc_aeb_rtARID_DEF.ObjData_i[1].MotionType.ParallellVehicleShortPred autosar_swc_aeb_rtARID_DEF.ObjData_i[1].MotionType.ObjectIsVehicle autosar_swc_aeb_rtARID_DEF.ObjData_i[1].MotionType.ObjectIsMotorVehicle autosar_swc_aeb_rtARID_DEF.ObjData_i[1].MotionType.CurvedMotion autosar_swc_aeb_rtARID_DEF.ObjData_i[1].MotionType.SideIsClosest autosar_swc_aeb_rtARID_DEF.ObjData_i[1].MotionType.AbsHeading /end REF_MEASUREMENT
/end GROUP
/begin GROUP autosar_swc_aeb_rtARID_DEF.ObjData_i[1].Offsets ""
 /begin REF_MEASUREMENT autosar_swc_aeb_rtARID_DEF.ObjData_i[1].Offsets.OffsLgtLongPred autosar_swc_aeb_rtARID_DEF.ObjData_i[1].Offsets.OffsLatLongPred autosar_swc_aeb_rtARID_DEF.ObjData_i[1].Offsets.OffsLgtShortPred autosar_swc_aeb_rtARID_DEF.ObjData_i[1].Offsets.OffsLatShortPred autosar_swc_aeb_rtARID_DEF.ObjData_i[1].Offsets.OffsLatManoeuvre autosar_swc_aeb_rtARID_DEF.ObjData_i[1].Offsets.OffsLatInPathPrimaryTarget autosar_swc_aeb_rtARID_DEF.ObjData_i[1].Offsets.OffsLatInPathCloseEdge autosar_swc_aeb_rtARID_DEF.ObjData_i[1].Offsets.OffsLatInPathFarEdge autosar_swc_aeb_rtARID_DEF.ObjData_i[1].Offsets.OffsLatIntersection autosar_swc_aeb_rtARID_DEF.ObjData_i[1].Offsets.OffsLatMplTar /end REF_MEASUREMENT
/end GROUP
/begin GROUP autosar_swc_aeb_rtARID_DEF.ObjData_i[1].ShortPredTime ""
 /begin REF_MEASUREMENT autosar_swc_aeb_rtARID_DEF.ObjData_i[1].ShortPredTime.TimeToReachLgt autosar_swc_aeb_rtARID_DEF.ObjData_i[1].ShortPredTime.TimeToMiddleLgt autosar_swc_aeb_rtARID_DEF.ObjData_i[1].ShortPredTime.TimeToPassLgt autosar_swc_aeb_rtARID_DEF.ObjData_i[1].ShortPredTime.TTMSelected autosar_swc_aeb_rtARID_DEF.ObjData_i[1].ShortPredTime.InPath autosar_swc_aeb_rtARID_DEF.ObjData_i[1].ShortPredTime.ObjOnCmngAndBrkg autosar_swc_aeb_rtARID_DEF.ObjData_i[1].ShortPredTime.ALgt autosar_swc_aeb_rtARID_DEF.ObjData_i[1].ShortPredTime.ALat autosar_swc_aeb_rtARID_DEF.ObjData_i[1].ShortPredTime.A autosar_swc_aeb_rtARID_DEF.ObjData_i[1].ShortPredTime.Crvt /end REF_MEASUREMENT
/end GROUP
/begin GROUP autosar_swc_aeb_rtARID_DEF.ObjData_i[2] ""
 /begin SUB_GROUP autosar_swc_aeb_rtARID_DEF.ObjData_i[2].MotionType autosar_swc_aeb_rtARID_DEF.ObjData_i[2].BoundingBox autosar_swc_aeb_rtARID_DEF.ObjData_i[2].Offsets autosar_swc_aeb_rtARID_DEF.ObjData_i[2].LongPredTime autosar_swc_aeb_rtARID_DEF.ObjData_i[2].ShortPredTime /end SUB_GROUP
 /begin REF_MEASUREMENT autosar_swc_aeb_rtARID_DEF.ObjData_i[2].InPathAtCurrentPosition autosar_swc_aeb_rtARID_DEF.ObjData_i[2].PredictionValid autosar_swc_aeb_rtARID_DEF.ObjData_i[2].Idn /end REF_MEASUREMENT
/end GROUP
/begin GROUP autosar_swc_aeb_rtARID_DEF.ObjData_i[2].BoundingBox ""
 /begin REF_MEASUREMENT autosar_swc_aeb_rtARID_DEF.ObjData_i[2].BoundingBox.LengthSideLat autosar_swc_aeb_rtARID_DEF.ObjData_i[2].BoundingBox.LengthSideLgt autosar_swc_aeb_rtARID_DEF.ObjData_i[2].BoundingBox.SinRotation autosar_swc_aeb_rtARID_DEF.ObjData_i[2].BoundingBox.CosRotation autosar_swc_aeb_rtARID_DEF.ObjData_i[2].BoundingBox.RotationAngle /end REF_MEASUREMENT
/end GROUP
/begin GROUP autosar_swc_aeb_rtARID_DEF.ObjData_i[2].LongPredTime ""
 /begin REF_MEASUREMENT autosar_swc_aeb_rtARID_DEF.ObjData_i[2].LongPredTime.TimeToReachLgt autosar_swc_aeb_rtARID_DEF.ObjData_i[2].LongPredTime.TimeToMiddleLgt autosar_swc_aeb_rtARID_DEF.ObjData_i[2].LongPredTime.TimeToPassLgt autosar_swc_aeb_rtARID_DEF.ObjData_i[2].LongPredTime.TTMSelected autosar_swc_aeb_rtARID_DEF.ObjData_i[2].LongPredTime.InPath autosar_swc_aeb_rtARID_DEF.ObjData_i[2].LongPredTime.ObjOnCmngAndBrkg autosar_swc_aeb_rtARID_DEF.ObjData_i[2].LongPredTime.ALgt autosar_swc_aeb_rtARID_DEF.ObjData_i[2].LongPredTime.ALat autosar_swc_aeb_rtARID_DEF.ObjData_i[2].LongPredTime.A autosar_swc_aeb_rtARID_DEF.ObjData_i[2].LongPredTime.Crvt /end REF_MEASUREMENT
/end GROUP
/begin GROUP autosar_swc_aeb_rtARID_DEF.ObjData_i[2].MotionType ""
 /begin REF_MEASUREMENT autosar_swc_aeb_rtARID_DEF.ObjData_i[2].MotionType.Stationary autosar_swc_aeb_rtARID_DEF.ObjData_i[2].MotionType.MovingOncoming autosar_swc_aeb_rtARID_DEF.ObjData_i[2].MotionType.ParallellVehicleLongPred autosar_swc_aeb_rtARID_DEF.ObjData_i[2].MotionType.ParallellVehicleShortPred autosar_swc_aeb_rtARID_DEF.ObjData_i[2].MotionType.ObjectIsVehicle autosar_swc_aeb_rtARID_DEF.ObjData_i[2].MotionType.ObjectIsMotorVehicle autosar_swc_aeb_rtARID_DEF.ObjData_i[2].MotionType.CurvedMotion autosar_swc_aeb_rtARID_DEF.ObjData_i[2].MotionType.SideIsClosest autosar_swc_aeb_rtARID_DEF.ObjData_i[2].MotionType.AbsHeading /end REF_MEASUREMENT
/end GROUP
/begin GROUP autosar_swc_aeb_rtARID_DEF.ObjData_i[2].Offsets ""
 /begin REF_MEASUREMENT autosar_swc_aeb_rtARID_DEF.ObjData_i[2].Offsets.OffsLgtLongPred autosar_swc_aeb_rtARID_DEF.ObjData_i[2].Offsets.OffsLatLongPred autosar_swc_aeb_rtARID_DEF.ObjData_i[2].Offsets.OffsLgtShortPred autosar_swc_aeb_rtARID_DEF.ObjData_i[2].Offsets.OffsLatShortPred autosar_swc_aeb_rtARID_DEF.ObjData_i[2].Offsets.OffsLatManoeuvre autosar_swc_aeb_rtARID_DEF.ObjData_i[2].Offsets.OffsLatInPathPrimaryTarget autosar_swc_aeb_rtARID_DEF.ObjData_i[2].Offsets.OffsLatInPathCloseEdge autosar_swc_aeb_rtARID_DEF.ObjData_i[2].Offsets.OffsLatInPathFarEdge autosar_swc_aeb_rtARID_DEF.ObjData_i[2].Offsets.OffsLatIntersection autosar_swc_aeb_rtARID_DEF.ObjData_i[2].Offsets.OffsLatMplTar /end REF_MEASUREMENT
/end GROUP
/begin GROUP autosar_swc_aeb_rtARID_DEF.ObjData_i[2].ShortPredTime ""
 /begin REF_MEASUREMENT autosar_swc_aeb_rtARID_DEF.ObjData_i[2].ShortPredTime.TimeToReachLgt autosar_swc_aeb_rtARID_DEF.ObjData_i[2].ShortPredTime.TimeToMiddleLgt autosar_swc_aeb_rtARID_DEF.ObjData_i[2].ShortPredTime.TimeToPassLgt autosar_swc_aeb_rtARID_DEF.ObjData_i[2].ShortPredTime.TTMSelected autosar_swc_aeb_rtARID_DEF.ObjData_i[2].ShortPredTime.InPath autosar_swc_aeb_rtARID_DEF.ObjData_i[2].ShortPredTime.ObjOnCmngAndBrkg autosar_swc_aeb_rtARID_DEF.ObjData_i[2].ShortPredTime.ALgt autosar_swc_aeb_rtARID_DEF.ObjData_i[2].ShortPredTime.ALat autosar_swc_aeb_rtARID_DEF.ObjData_i[2].ShortPredTime.A autosar_swc_aeb_rtARID_DEF.ObjData_i[2].ShortPredTime.Crvt /end REF_MEASUREMENT
/end GROUP
/begin GROUP autosar_swc_aeb_rtARID_DEF.ObjData_i[3] ""
 /begin SUB_GROUP autosar_swc_aeb_rtARID_DEF.ObjData_i[3].MotionType autosar_swc_aeb_rtARID_DEF.ObjData_i[3].BoundingBox autosar_swc_aeb_rtARID_DEF.ObjData_i[3].Offsets autosar_swc_aeb_rtARID_DEF.ObjData_i[3].LongPredTime autosar_swc_aeb_rtARID_DEF.ObjData_i[3].ShortPredTime /end SUB_GROUP
 /begin REF_MEASUREMENT autosar_swc_aeb_rtARID_DEF.ObjData_i[3].InPathAtCurrentPosition autosar_swc_aeb_rtARID_DEF.ObjData_i[3].PredictionValid autosar_swc_aeb_rtARID_DEF.ObjData_i[3].Idn /end REF_MEASUREMENT
/end GROUP
/begin GROUP autosar_swc_aeb_rtARID_DEF.ObjData_i[3].BoundingBox ""
 /begin REF_MEASUREMENT autosar_swc_aeb_rtARID_DEF.ObjData_i[3].BoundingBox.LengthSideLat autosar_swc_aeb_rtARID_DEF.ObjData_i[3].BoundingBox.LengthSideLgt autosar_swc_aeb_rtARID_DEF.ObjData_i[3].BoundingBox.SinRotation autosar_swc_aeb_rtARID_DEF.ObjData_i[3].BoundingBox.CosRotation autosar_swc_aeb_rtARID_DEF.ObjData_i[3].BoundingBox.RotationAngle /end REF_MEASUREMENT
/end GROUP
/begin GROUP autosar_swc_aeb_rtARID_DEF.ObjData_i[3].LongPredTime ""
 /begin REF_MEASUREMENT autosar_swc_aeb_rtARID_DEF.ObjData_i[3].LongPredTime.TimeToReachLgt autosar_swc_aeb_rtARID_DEF.ObjData_i[3].LongPredTime.TimeToMiddleLgt autosar_swc_aeb_rtARID_DEF.ObjData_i[3].LongPredTime.TimeToPassLgt autosar_swc_aeb_rtARID_DEF.ObjData_i[3].LongPredTime.TTMSelected autosar_swc_aeb_rtARID_DEF.ObjData_i[3].LongPredTime.InPath autosar_swc_aeb_rtARID_DEF.ObjData_i[3].LongPredTime.ObjOnCmngAndBrkg autosar_swc_aeb_rtARID_DEF.ObjData_i[3].LongPredTime.ALgt autosar_swc_aeb_rtARID_DEF.ObjData_i[3].LongPredTime.ALat autosar_swc_aeb_rtARID_DEF.ObjData_i[3].LongPredTime.A autosar_swc_aeb_rtARID_DEF.ObjData_i[3].LongPredTime.Crvt /end REF_MEASUREMENT
/end GROUP
/begin GROUP autosar_swc_aeb_rtARID_DEF.ObjData_i[3].MotionType ""
 /begin REF_MEASUREMENT autosar_swc_aeb_rtARID_DEF.ObjData_i[3].MotionType.Stationary autosar_swc_aeb_rtARID_DEF.ObjData_i[3].MotionType.MovingOncoming autosar_swc_aeb_rtARID_DEF.ObjData_i[3].MotionType.ParallellVehicleLongPred autosar_swc_aeb_rtARID_DEF.ObjData_i[3].MotionType.ParallellVehicleShortPred autosar_swc_aeb_rtARID_DEF.ObjData_i[3].MotionType.ObjectIsVehicle autosar_swc_aeb_rtARID_DEF.ObjData_i[3].MotionType.ObjectIsMotorVehicle autosar_swc_aeb_rtARID_DEF.ObjData_i[3].MotionType.CurvedMotion autosar_swc_aeb_rtARID_DEF.ObjData_i[3].MotionType.SideIsClosest autosar_swc_aeb_rtARID_DEF.ObjData_i[3].MotionType.AbsHeading /end REF_MEASUREMENT
/end GROUP
/begin GROUP autosar_swc_aeb_rtARID_DEF.ObjData_i[3].Offsets ""
 /begin REF_MEASUREMENT autosar_swc_aeb_rtARID_DEF.ObjData_i[3].Offsets.OffsLgtLongPred autosar_swc_aeb_rtARID_DEF.ObjData_i[3].Offsets.OffsLatLongPred autosar_swc_aeb_rtARID_DEF.ObjData_i[3].Offsets.OffsLgtShortPred autosar_swc_aeb_rtARID_DEF.ObjData_i[3].Offsets.OffsLatShortPred autosar_swc_aeb_rtARID_DEF.ObjData_i[3].Offsets.OffsLatManoeuvre autosar_swc_aeb_rtARID_DEF.ObjData_i[3].Offsets.OffsLatInPathPrimaryTarget autosar_swc_aeb_rtARID_DEF.ObjData_i[3].Offsets.OffsLatInPathCloseEdge autosar_swc_aeb_rtARID_DEF.ObjData_i[3].Offsets.OffsLatInPathFarEdge autosar_swc_aeb_rtARID_DEF.ObjData_i[3].Offsets.OffsLatIntersection autosar_swc_aeb_rtARID_DEF.ObjData_i[3].Offsets.OffsLatMplTar /end REF_MEASUREMENT
/end GROUP
/begin GROUP autosar_swc_aeb_rtARID_DEF.ObjData_i[3].ShortPredTime ""
 /begin REF_MEASUREMENT autosar_swc_aeb_rtARID_DEF.ObjData_i[3].ShortPredTime.TimeToReachLgt autosar_swc_aeb_rtARID_DEF.ObjData_i[3].ShortPredTime.TimeToMiddleLgt autosar_swc_aeb_rtARID_DEF.ObjData_i[3].ShortPredTime.TimeToPassLgt autosar_swc_aeb_rtARID_DEF.ObjData_i[3].ShortPredTime.TTMSelected autosar_swc_aeb_rtARID_DEF.ObjData_i[3].ShortPredTime.InPath autosar_swc_aeb_rtARID_DEF.ObjData_i[3].ShortPredTime.ObjOnCmngAndBrkg autosar_swc_aeb_rtARID_DEF.ObjData_i[3].ShortPredTime.ALgt autosar_swc_aeb_rtARID_DEF.ObjData_i[3].ShortPredTime.ALat autosar_swc_aeb_rtARID_DEF.ObjData_i[3].ShortPredTime.A autosar_swc_aeb_rtARID_DEF.ObjData_i[3].ShortPredTime.Crvt /end REF_MEASUREMENT
/end GROUP
/begin GROUP autosar_swc_aeb_rtARID_DEF.ObjData_i[4] ""
 /begin SUB_GROUP autosar_swc_aeb_rtARID_DEF.ObjData_i[4].MotionType autosar_swc_aeb_rtARID_DEF.ObjData_i[4].BoundingBox autosar_swc_aeb_rtARID_DEF.ObjData_i[4].Offsets autosar_swc_aeb_rtARID_DEF.ObjData_i[4].LongPredTime autosar_swc_aeb_rtARID_DEF.ObjData_i[4].ShortPredTime /end SUB_GROUP
 /begin REF_MEASUREMENT autosar_swc_aeb_rtARID_DEF.ObjData_i[4].InPathAtCurrentPosition autosar_swc_aeb_rtARID_DEF.ObjData_i[4].PredictionValid autosar_swc_aeb_rtARID_DEF.ObjData_i[4].Idn /end REF_MEASUREMENT
/end GROUP
/begin GROUP autosar_swc_aeb_rtARID_DEF.ObjData_i[4].BoundingBox ""
 /begin REF_MEASUREMENT autosar_swc_aeb_rtARID_DEF.ObjData_i[4].BoundingBox.LengthSideLat autosar_swc_aeb_rtARID_DEF.ObjData_i[4].BoundingBox.LengthSideLgt autosar_swc_aeb_rtARID_DEF.ObjData_i[4].BoundingBox.SinRotation autosar_swc_aeb_rtARID_DEF.ObjData_i[4].BoundingBox.CosRotation autosar_swc_aeb_rtARID_DEF.ObjData_i[4].BoundingBox.RotationAngle /end REF_MEASUREMENT
/end GROUP
/begin GROUP autosar_swc_aeb_rtARID_DEF.ObjData_i[4].LongPredTime ""
 /begin REF_MEASUREMENT autosar_swc_aeb_rtARID_DEF.ObjData_i[4].LongPredTime.TimeToReachLgt autosar_swc_aeb_rtARID_DEF.ObjData_i[4].LongPredTime.TimeToMiddleLgt autosar_swc_aeb_rtARID_DEF.ObjData_i[4].LongPredTime.TimeToPassLgt autosar_swc_aeb_rtARID_DEF.ObjData_i[4].LongPredTime.TTMSelected autosar_swc_aeb_rtARID_DEF.ObjData_i[4].LongPredTime.InPath autosar_swc_aeb_rtARID_DEF.ObjData_i[4].LongPredTime.ObjOnCmngAndBrkg autosar_swc_aeb_rtARID_DEF.ObjData_i[4].LongPredTime.ALgt autosar_swc_aeb_rtARID_DEF.ObjData_i[4].LongPredTime.ALat autosar_swc_aeb_rtARID_DEF.ObjData_i[4].LongPredTime.A autosar_swc_aeb_rtARID_DEF.ObjData_i[4].LongPredTime.Crvt /end REF_MEASUREMENT
/end GROUP
/begin GROUP autosar_swc_aeb_rtARID_DEF.ObjData_i[4].MotionType ""
 /begin REF_MEASUREMENT autosar_swc_aeb_rtARID_DEF.ObjData_i[4].MotionType.Stationary autosar_swc_aeb_rtARID_DEF.ObjData_i[4].MotionType.MovingOncoming autosar_swc_aeb_rtARID_DEF.ObjData_i[4].MotionType.ParallellVehicleLongPred autosar_swc_aeb_rtARID_DEF.ObjData_i[4].MotionType.ParallellVehicleShortPred autosar_swc_aeb_rtARID_DEF.ObjData_i[4].MotionType.ObjectIsVehicle autosar_swc_aeb_rtARID_DEF.ObjData_i[4].MotionType.ObjectIsMotorVehicle autosar_swc_aeb_rtARID_DEF.ObjData_i[4].MotionType.CurvedMotion autosar_swc_aeb_rtARID_DEF.ObjData_i[4].MotionType.SideIsClosest autosar_swc_aeb_rtARID_DEF.ObjData_i[4].MotionType.AbsHeading /end REF_MEASUREMENT
/end GROUP
/end MODULE
/end PROJECT
