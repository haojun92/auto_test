ASAP2_VERSION 1 71
/begin PROJECT ProjectName ""
/begin MODULE ModuleName ""
/begin MOD_COMMON "" BYTE_ORDER MSB_LAST ALIGNMENT_BYTE 1 ALIGNMENT_WORD 1 ALIGNMENT_LONG 1 ALIGNMENT_INT64 1 ALIGNMENT_FLOAT16_IEEE 1 ALIGNMENT_FLOAT32_IEEE 1 ALIGNMENT_FLOAT64_IEEE 1 /end MOD_COMMON
/begin RECORD_LAYOUT SSV__A_INT64_S AXIS_PTS_X 1 A_INT64 INDEX_INCR DIRECT /end RECORD_LAYOUT
/begin RECORD_LAYOUT Record_BOOLEAN FNC_VALUES 1 UBYTE COLUMN_DIR DIRECT /end RECORD_LAYOUT
/begin RECORD_LAYOUT Record_FLOAT32_IEEE FNC_VALUES 1 FLOAT32_IEEE COLUMN_DIR DIRECT /end RECORD_LAYOUT
/begin RECORD_LAYOUT Record_UBYTE FNC_VALUES 1 UBYTE COLUMN_DIR DIRECT /end RECORD_LAYOUT
/begin RECORD_LAYOUT Axis_FLOAT32_IEEE AXIS_PTS_X 1 FLOAT32_IEEE INDEX_INCR DIRECT /end RECORD_LAYOUT
/begin RECORD_LAYOUT Record_BOOLEAN FNC_VALUES 1 UBYTE COLUMN_DIR DIRECT /end RECORD_LAYOUT
/begin RECORD_LAYOUT Record_FLOAT32_IEEE FNC_VALUES 1 FLOAT32_IEEE COLUMN_DIR DIRECT /end RECORD_LAYOUT
/begin RECORD_LAYOUT Record_UBYTE FNC_VALUES 1 UBYTE COLUMN_DIR DIRECT /end RECORD_LAYOUT
/begin RECORD_LAYOUT Axis_FLOAT32_IEEE AXIS_PTS_X 1 FLOAT32_IEEE INDEX_INCR DIRECT /end RECORD_LAYOUT
/begin RECORD_LAYOUT Record_BOOLEAN FNC_VALUES 1 UBYTE COLUMN_DIR DIRECT /end RECORD_LAYOUT
/begin RECORD_LAYOUT Record_FLOAT32_IEEE FNC_VALUES 1 FLOAT32_IEEE COLUMN_DIR DIRECT /end RECORD_LAYOUT
/begin RECORD_LAYOUT Record_UBYTE FNC_VALUES 1 UBYTE COLUMN_DIR DIRECT /end RECORD_LAYOUT
/begin RECORD_LAYOUT Record_BOOLEAN FNC_VALUES 1 UBYTE COLUMN_DIR DIRECT /end RECORD_LAYOUT
/begin RECORD_LAYOUT Record_FLOAT32_IEEE FNC_VALUES 1 FLOAT32_IEEE COLUMN_DIR DIRECT /end RECORD_LAYOUT
/begin RECORD_LAYOUT Record_UBYTE FNC_VALUES 1 UBYTE COLUMN_DIR DIRECT /end RECORD_LAYOUT
/begin RECORD_LAYOUT Axis_FLOAT32_IEEE AXIS_PTS_X 1 FLOAT32_IEEE INDEX_INCR DIRECT /end RECORD_LAYOUT
/begin RECORD_LAYOUT Record_BOOLEAN FNC_VALUES 1 UBYTE COLUMN_DIR DIRECT /end RECORD_LAYOUT
/begin RECORD_LAYOUT Record_FLOAT32_IEEE FNC_VALUES 1 FLOAT32_IEEE COLUMN_DIR DIRECT /end RECORD_LAYOUT
/begin RECORD_LAYOUT Record_UBYTE FNC_VALUES 1 UBYTE COLUMN_DIR DIRECT /end RECORD_LAYOUT
/begin RECORD_LAYOUT Axis_FLOAT32_IEEE AXIS_PTS_X 1 FLOAT32_IEEE INDEX_INCR DIRECT /end RECORD_LAYOUT
/begin RECORD_LAYOUT Record_BOOLEAN FNC_VALUES 1 UBYTE COLUMN_DIR DIRECT /end RECORD_LAYOUT
/begin RECORD_LAYOUT Record_FLOAT32_IEEE FNC_VALUES 1 FLOAT32_IEEE COLUMN_DIR DIRECT /end RECORD_LAYOUT
/begin RECORD_LAYOUT Record_UBYTE FNC_VALUES 1 UBYTE COLUMN_DIR DIRECT /end RECORD_LAYOUT
/begin RECORD_LAYOUT Axis_FLOAT32_IEEE AXIS_PTS_X 1 FLOAT32_IEEE INDEX_INCR DIRECT /end RECORD_LAYOUT
/begin RECORD_LAYOUT Record_BOOLEAN FNC_VALUES 1 UBYTE COLUMN_DIR DIRECT /end RECORD_LAYOUT
/begin RECORD_LAYOUT Record_FLOAT32_IEEE FNC_VALUES 1 FLOAT32_IEEE COLUMN_DIR DIRECT /end RECORD_LAYOUT
/begin RECORD_LAYOUT Record_UBYTE FNC_VALUES 1 UBYTE COLUMN_DIR DIRECT /end RECORD_LAYOUT
/begin MEASUREMENT autosar_swc_vmc_rtARID_DEF.VMP_TRAJ_K1.xy_poly.end "" FLOAT32_IEEE autosar_swc_vmc_CM_single 0 0 -3.4E+38 3.4E+38 ECU_ADDRESS 0xfe4cd114 /* @ECU_Address@autosar_swc_vmc_rtARID_DEF.VMP_TRAJ_K1.xy_poly.end@ */ /end MEASUREMENT
/begin MEASUREMENT autosar_swc_vmc_rtARID_DEF.VMP_TRAJ_K1.xy_poly.poly_vec "" FLOAT32_IEEE autosar_swc_vmc_CM_single 0 0 -3.4E+38 3.4E+38 LAYOUT COLUMN_DIR MATRIX_DIM 6 ECU_ADDRESS 0xfe4cd118 /* @ECU_Address@autosar_swc_vmc_rtARID_DEF.VMP_TRAJ_K1.xy_poly.poly_vec@ */ /end MEASUREMENT
/begin MEASUREMENT autosar_swc_vmc_rtARID_DEF.VMP_TRAJ_K1.xy_poly.start "" FLOAT32_IEEE autosar_swc_vmc_CM_single 0 0 -3.4E+38 3.4E+38 ECU_ADDRESS 0xfe4cd110 /* @ECU_Address@autosar_swc_vmc_rtARID_DEF.VMP_TRAJ_K1.xy_poly.start@ */ /end MEASUREMENT
/begin COMPU_METHOD autosar_swc_vmc_CM_single "Q = V" IDENTICAL "%8.6" "" /end COMPU_METHOD
/begin RECORD_LAYOUT Record_BOOLEAN FNC_VALUES 1 UBYTE COLUMN_DIR DIRECT /end RECORD_LAYOUT
/begin RECORD_LAYOUT Record_FLOAT32_IEEE FNC_VALUES 1 FLOAT32_IEEE COLUMN_DIR DIRECT /end RECORD_LAYOUT
/begin RECORD_LAYOUT Record_UBYTE FNC_VALUES 1 UBYTE COLUMN_DIR DIRECT /end RECORD_LAYOUT
/begin RECORD_LAYOUT Axis_FLOAT32_IEEE AXIS_PTS_X 1 FLOAT32_IEEE INDEX_INCR DIRECT /end RECORD_LAYOUT
/begin GROUP autosar_swc_vmc_rtARID_DEF.VMP_TRAJ_K1.xy_poly ""
 /begin REF_MEASUREMENT autosar_swc_vmc_rtARID_DEF.VMP_TRAJ_K1.xy_poly.start autosar_swc_vmc_rtARID_DEF.VMP_TRAJ_K1.xy_poly.end autosar_swc_vmc_rtARID_DEF.VMP_TRAJ_K1.xy_poly.poly_vec /end REF_MEASUREMENT
/end GROUP
/begin CHARACTERISTIC P_VIE_RollingBackSpd "" VALUE 0xfe828ff0 /* @ECU_Address@P_VIE_RollingBackSpd@ */ Record_FLOAT32_IEEE 0 autosar_swc_vme_CM_single -3.4E+38 3.4E+38 /end CHARACTERISTIC
/begin CHARACTERISTIC P_VME_FiltaxvRoadSlopeData "" CURVE 0xfe828ff8 /* @ECU_Address@P_VME_FiltaxvRoadSlopeData@ */ Record_FLOAT32_IEEE 0 autosar_swc_vme_CM_single -3.4E+38 3.4E+38
 /begin AXIS_DESCR COM_AXIS autosar_swc_vme_rtARID_DEF.VxvRef_ms autosar_swc_vme_CM_single 4 -3.4E+38 3.4E+38 AXIS_PTS_REF P_VME_FiltaxvRoadSlopebreakpoint /end AXIS_DESCR
/end CHARACTERISTIC
/begin CHARACTERISTIC P_VME_axvRoadSlopeSaturation "" VALUE 0xfe828ff4 /* @ECU_Address@P_VME_axvRoadSlopeSaturation@ */ Record_FLOAT32_IEEE 0 autosar_swc_vme_CM_single -3.4E+38 3.4E+38 /end CHARACTERISTIC
/begin MEASUREMENT SwcOut_VME_Herbeat_Info.inner_error "" ULONG autosar_swc_vme_CM_uint32 0 0 0 4294967295 ECU_ADDRESS 0xfe4cd79c /* @ECU_Address@SwcOut_VME_Herbeat_Info.inner_error@ */ /end MEASUREMENT
/begin MEASUREMENT SwcOut_VME_Herbeat_Info.module_status "" UBYTE autosar_swc_vme_CM_SM_MODULE_STATUS 0 0 0 3 ECU_ADDRESS 0xfe4cd7a0 /* @ECU_Address@SwcOut_VME_Herbeat_Info.module_status@ */ /end MEASUREMENT
/begin MEASUREMENT SwcOut_VME_Herbeat_Info.sequence_num "" UBYTE autosar_swc_vme_CM_uint8 0 0 0 255 ECU_ADDRESS 0xfe4cd799 /* @ECU_Address@SwcOut_VME_Herbeat_Info.sequence_num@ */ /end MEASUREMENT
/begin MEASUREMENT SwcOut_VME_Herbeat_Info.swc_id "" UBYTE autosar_swc_vme_CM_uint8 0 0 0 255 ECU_ADDRESS 0xfe4cd798 /* @ECU_Address@SwcOut_VME_Herbeat_Info.swc_id@ */ /end MEASUREMENT
/begin MEASUREMENT SwcOut_VME_NvM_Set_SteerAngOffsetInit "" FLOAT32_IEEE autosar_swc_vme_CM_single 0 0 -3.4E+38 3.4E+38 ECU_ADDRESS 0xfe4cd7a4 /* @ECU_Address@SwcOut_VME_NvM_Set_SteerAngOffsetInit@ */ /end MEASUREMENT
/begin MEASUREMENT SwcOut_VME_SteerAngleOffset_deg "" FLOAT32_IEEE autosar_swc_vme_CM_single 0 0 -3.4E+38 3.4E+38 ECU_ADDRESS 0xfe4cd7a8 /* @ECU_Address@SwcOut_VME_SteerAngleOffset_deg@ */ /end MEASUREMENT
/begin MEASUREMENT SwcOut_VME_alpSideSlipAngle "" FLOAT32_IEEE autosar_swc_vme_CM_single 0 0 -3.4E+38 3.4E+38 ECU_ADDRESS 0xfe4cd7ac /* @ECU_Address@SwcOut_VME_alpSideSlipAngle@ */ /end MEASUREMENT
/begin MEASUREMENT SwcOut_VME_alpSumSlideCurveness "" FLOAT32_IEEE autosar_swc_vme_CM_single 0 0 -3.4E+38 3.4E+38 ECU_ADDRESS 0xfe4cd7b0 /* @ECU_Address@SwcOut_VME_alpSumSlideCurveness@ */ /end MEASUREMENT
/begin MEASUREMENT SwcOut_VME_axRefDt "" FLOAT32_IEEE autosar_swc_vme_CM_single 0 0 -3.4E+38 3.4E+38 ECU_ADDRESS 0xfe4cd7b4 /* @ECU_Address@SwcOut_VME_axRefDt@ */ /end MEASUREMENT
/begin MEASUREMENT SwcOut_VME_axRefMs2 "" FLOAT32_IEEE autosar_swc_vme_CM_single 0 0 -3.4E+38 3.4E+38 ECU_ADDRESS 0xfe4cd7b8 /* @ECU_Address@SwcOut_VME_axRefMs2@ */ /end MEASUREMENT
/begin MEASUREMENT SwcOut_VME_axvRefMs2 "" FLOAT32_IEEE autosar_swc_vme_CM_single 0 0 -3.4E+38 3.4E+38 ECU_ADDRESS 0xfe4cd7bc /* @ECU_Address@SwcOut_VME_axvRefMs2@ */ /end MEASUREMENT
/begin MEASUREMENT SwcOut_VME_axvRoadSlopeMs2 "" FLOAT32_IEEE autosar_swc_vme_CM_single 0 0 -3.4E+38 3.4E+38 ECU_ADDRESS 0xfe4cd7c0 /* @ECU_Address@SwcOut_VME_axvRoadSlopeMs2@ */ /end MEASUREMENT
/begin MEASUREMENT SwcOut_VME_ayvRefMs2 "" FLOAT32_IEEE autosar_swc_vme_CM_single 0 0 -3.4E+38 3.4E+38 ECU_ADDRESS 0xfe4cd7c4 /* @ECU_Address@SwcOut_VME_ayvRefMs2@ */ /end MEASUREMENT
/begin MEASUREMENT SwcOut_VME_jerkxMs3 "" FLOAT32_IEEE autosar_swc_vme_CM_single 0 0 -3.4E+38 3.4E+38 ECU_ADDRESS 0xfe4cd7c8 /* @ECU_Address@SwcOut_VME_jerkxMs3@ */ /end MEASUREMENT
/begin MEASUREMENT SwcOut_VME_jerkyMs3 "" FLOAT32_IEEE autosar_swc_vme_CM_single 0 0 -3.4E+38 3.4E+38 ECU_ADDRESS 0xfe4cd7cc /* @ECU_Address@SwcOut_VME_jerkyMs3@ */ /end MEASUREMENT
/begin MEASUREMENT SwcOut_VME_kapTraj "" FLOAT32_IEEE autosar_swc_vme_CM_single 0 0 -3.4E+38 3.4E+38 ECU_ADDRESS 0xfe4cd7d0 /* @ECU_Address@SwcOut_VME_kapTraj@ */ /end MEASUREMENT
/begin MEASUREMENT SwcOut_VME_psiDtOpt "" FLOAT32_IEEE autosar_swc_vme_CM_single 0 0 -3.4E+38 3.4E+38 ECU_ADDRESS 0xfe4cd7d4 /* @ECU_Address@SwcOut_VME_psiDtOpt@ */ /end MEASUREMENT
/begin MEASUREMENT SwcOut_VME_rollingBackSts "" FLOAT32_IEEE autosar_swc_vme_CM_single 0 0 -3.4E+38 3.4E+38 MATRIX_DIM 1 1 ECU_ADDRESS 0xfe4cd7d8 /* @ECU_Address@SwcOut_VME_rollingBackSts@ */ /end MEASUREMENT
/begin MEASUREMENT SwcOut_VME_vxvRefMs "" FLOAT32_IEEE autosar_swc_vme_CM_single 0 0 -3.4E+38 3.4E+38 ECU_ADDRESS 0xfe4cd7dc /* @ECU_Address@SwcOut_VME_vxvRefMs@ */ /end MEASUREMENT
/begin MEASUREMENT VME_Branch_VIE "" ULONG autosar_swc_vme_CM_uint32 0 0 0 4294967295 ECU_ADDRESS 0xfe4cd7e0 /* @ECU_Address@VME_Branch_VIE@ */ /end MEASUREMENT
/begin MEASUREMENT VME_ExecTimestamp.nanoseconds "" ULONG autosar_swc_vme_CM_uint32 0 0 0 4294967295 ECU_ADDRESS 0xfe4cd58c /* @ECU_Address@VME_ExecTimestamp.nanoseconds@ */ /end MEASUREMENT
/begin MEASUREMENT VME_ExecTimestamp.seconds "" A_UINT64 autosar_swc_vme_CM_uint64 0 0 0 18446744073709551615 ECU_ADDRESS 0xfe4cd590 /* @ECU_Address@VME_ExecTimestamp.seconds@ */ /end MEASUREMENT
/begin MEASUREMENT VME_ExecTimestamp.timeBaseStatus "" UBYTE autosar_swc_vme_CM_uint8 0 0 0 255 ECU_ADDRESS 0xfe4cd588 /* @ECU_Address@VME_ExecTimestamp.timeBaseStatus@ */ /end MEASUREMENT
/begin MEASUREMENT VME_NvM_Get_SteerAngOffsetInit "" FLOAT32_IEEE autosar_swc_vme_CM_single 0 0 -3.4E+38 3.4E+38 ECU_ADDRESS 0xfe4cd7e4 /* @ECU_Address@VME_NvM_Get_SteerAngOffsetInit@ */ /end MEASUREMENT
/begin MEASUREMENT VME_UpdateCnt "" UBYTE autosar_swc_vme_CM_uint8 0 0 0 255 ECU_ADDRESS 0xfe4cd7f0 /* @ECU_Address@VME_UpdateCnt@ */ /end MEASUREMENT
/begin MEASUREMENT VME_UpdateCnt_VIE "" UBYTE autosar_swc_vme_CM_uint8 0 0 0 255 ECU_ADDRESS 0xfe4cd7f1 /* @ECU_Address@VME_UpdateCnt_VIE@ */ /end MEASUREMENT
/begin MEASUREMENT VME_Version "" ULONG autosar_swc_vme_CM_uint32 0 0 0 4294967295 ECU_ADDRESS 0xfe4cd7e8 /* @ECU_Address@VME_Version@ */ /end MEASUREMENT
/begin MEASUREMENT VME_Version_VIE "" ULONG autosar_swc_vme_CM_uint32 0 0 0 4294967295 ECU_ADDRESS 0xfe4cd7ec /* @ECU_Address@VME_Version_VIE@ */ /end MEASUREMENT
/begin MEASUREMENT autosar_swc_vme_rtARID_DEF.AND "" UBYTE autosar_swc_vme_CM_logical 0 0 0 1 MATRIX_DIM 1 1 ECU_ADDRESS 0xfe4cd795 /* @ECU_Address@autosar_swc_vme_rtARID_DEF.AND@ */ /end MEASUREMENT
/begin MEASUREMENT autosar_swc_vme_rtARID_DEF.AlpSideSlipAngle "" FLOAT32_IEEE autosar_swc_vme_CM_single 0 0 -3.4E+38 3.4E+38 ECU_ADDRESS 0xfe4cd6f4 /* @ECU_Address@autosar_swc_vme_rtARID_DEF.AlpSideSlipAngle@ */ /end MEASUREMENT
/begin MEASUREMENT autosar_swc_vme_rtARID_DEF.Ax "" FLOAT32_IEEE autosar_swc_vme_CM_single 0 0 -3.4E+38 3.4E+38 ECU_ADDRESS 0xfe4cd704 /* @ECU_Address@autosar_swc_vme_rtARID_DEF.Ax@ */ /end MEASUREMENT
/begin MEASUREMENT autosar_swc_vme_rtARID_DEF.AxRefDt "" FLOAT32_IEEE autosar_swc_vme_CM_single 0 0 -3.4E+38 3.4E+38 ECU_ADDRESS 0xfe4cd6ec /* @ECU_Address@autosar_swc_vme_rtARID_DEF.AxRefDt@ */ /end MEASUREMENT
/begin MEASUREMENT autosar_swc_vme_rtARID_DEF.Cnt "" UBYTE autosar_swc_vme_CM_uint8 0 0 0 255 ECU_ADDRESS 0xfe4cd792 /* @ECU_Address@autosar_swc_vme_rtARID_DEF.Cnt@ */ /end MEASUREMENT
/begin MEASUREMENT autosar_swc_vme_rtARID_DEF.DataTypeConversion "" FLOAT32_IEEE autosar_swc_vme_CM_single 0 0 -3.4E+38 3.4E+38 MATRIX_DIM 1 1 ECU_ADDRESS 0xfe4cd6dc /* @ECU_Address@autosar_swc_vme_rtARID_DEF.DataTypeConversion@ */ /end MEASUREMENT
/begin MEASUREMENT autosar_swc_vme_rtARID_DEF.DelayInput1_DSTATE "" A_UINT64 autosar_swc_vme_CM_uint64 0 0 0 18446744073709551615 ECU_ADDRESS 0xfe4cd640 /* @ECU_Address@autosar_swc_vme_rtARID_DEF.DelayInput1_DSTATE@ */ /end MEASUREMENT
/begin MEASUREMENT autosar_swc_vme_rtARID_DEF.Memory1_PreviousInput "" FLOAT32_IEEE autosar_swc_vme_CM_single 0 0 -3.4E+38 3.4E+38 ECU_ADDRESS 0xfe4cd744 /* @ECU_Address@autosar_swc_vme_rtARID_DEF.Memory1_PreviousInput@ */ /end MEASUREMENT
/begin MEASUREMENT autosar_swc_vme_rtARID_DEF.Memory1_PreviousInput_e "" FLOAT32_IEEE autosar_swc_vme_CM_single 0 0 -3.4E+38 3.4E+38 ECU_ADDRESS 0xfe4cd77c /* @ECU_Address@autosar_swc_vme_rtARID_DEF.Memory1_PreviousInput_e@ */ /end MEASUREMENT
/begin MEASUREMENT autosar_swc_vme_rtARID_DEF.Memory21_PreviousInput "" FLOAT32_IEEE autosar_swc_vme_CM_single 0 0 -3.4E+38 3.4E+38 ECU_ADDRESS 0xfe4cd73c /* @ECU_Address@autosar_swc_vme_rtARID_DEF.Memory21_PreviousInput@ */ /end MEASUREMENT
/begin MEASUREMENT autosar_swc_vme_rtARID_DEF.Memory22_PreviousInput "" FLOAT32_IEEE autosar_swc_vme_CM_single 0 0 -3.4E+38 3.4E+38 ECU_ADDRESS 0xfe4cd734 /* @ECU_Address@autosar_swc_vme_rtARID_DEF.Memory22_PreviousInput@ */ /end MEASUREMENT
/begin MEASUREMENT autosar_swc_vme_rtARID_DEF.Memory23_PreviousInput "" FLOAT32_IEEE autosar_swc_vme_CM_single 0 0 -3.4E+38 3.4E+38 ECU_ADDRESS 0xfe4cd72c /* @ECU_Address@autosar_swc_vme_rtARID_DEF.Memory23_PreviousInput@ */ /end MEASUREMENT
/begin MEASUREMENT autosar_swc_vme_rtARID_DEF.Memory24_PreviousInput "" FLOAT32_IEEE autosar_swc_vme_CM_single 0 0 -3.4E+38 3.4E+38 ECU_ADDRESS 0xfe4cd75c /* @ECU_Address@autosar_swc_vme_rtARID_DEF.Memory24_PreviousInput@ */ /end MEASUREMENT
/begin MEASUREMENT autosar_swc_vme_rtARID_DEF.Memory25_PreviousInput "" FLOAT32_IEEE autosar_swc_vme_CM_single 0 0 -3.4E+38 3.4E+38 ECU_ADDRESS 0xfe4cd760 /* @ECU_Address@autosar_swc_vme_rtARID_DEF.Memory25_PreviousInput@ */ /end MEASUREMENT
/begin MEASUREMENT autosar_swc_vme_rtARID_DEF.Memory26_PreviousInput "" FLOAT32_IEEE autosar_swc_vme_CM_single 0 0 -3.4E+38 3.4E+38 ECU_ADDRESS 0xfe4cd764 /* @ECU_Address@autosar_swc_vme_rtARID_DEF.Memory26_PreviousInput@ */ /end MEASUREMENT
/begin MEASUREMENT autosar_swc_vme_rtARID_DEF.Memory27_PreviousInput "" FLOAT32_IEEE autosar_swc_vme_CM_single 0 0 -3.4E+38 3.4E+38 ECU_ADDRESS 0xfe4cd768 /* @ECU_Address@autosar_swc_vme_rtARID_DEF.Memory27_PreviousInput@ */ /end MEASUREMENT
/begin MEASUREMENT autosar_swc_vme_rtARID_DEF.Memory28_PreviousInput "" FLOAT32_IEEE autosar_swc_vme_CM_single 0 0 -3.4E+38 3.4E+38 ECU_ADDRESS 0xfe4cd76c /* @ECU_Address@autosar_swc_vme_rtARID_DEF.Memory28_PreviousInput@ */ /end MEASUREMENT
/begin MEASUREMENT autosar_swc_vme_rtARID_DEF.Memory29_PreviousInput "" FLOAT32_IEEE autosar_swc_vme_CM_single 0 0 -3.4E+38 3.4E+38 ECU_ADDRESS 0xfe4cd738 /* @ECU_Address@autosar_swc_vme_rtARID_DEF.Memory29_PreviousInput@ */ /end MEASUREMENT
/begin MEASUREMENT autosar_swc_vme_rtARID_DEF.Memory2_PreviousInput "" FLOAT32_IEEE autosar_swc_vme_CM_single 0 0 -3.4E+38 3.4E+38 ECU_ADDRESS 0xfe4cd71c /* @ECU_Address@autosar_swc_vme_rtARID_DEF.Memory2_PreviousInput@ */ /end MEASUREMENT
/begin MEASUREMENT autosar_swc_vme_rtARID_DEF.Memory2_PreviousInput_a "" FLOAT32_IEEE autosar_swc_vme_CM_single 0 0 -3.4E+38 3.4E+38 ECU_ADDRESS 0xfe4cd754 /* @ECU_Address@autosar_swc_vme_rtARID_DEF.Memory2_PreviousInput_a@ */ /end MEASUREMENT
/begin MEASUREMENT autosar_swc_vme_rtARID_DEF.Memory2_PreviousInput_g "" FLOAT32_IEEE autosar_swc_vme_CM_single 0 0 -3.4E+38 3.4E+38 ECU_ADDRESS 0xfe4cd720 /* @ECU_Address@autosar_swc_vme_rtARID_DEF.Memory2_PreviousInput_g@ */ /end MEASUREMENT
/begin MEASUREMENT autosar_swc_vme_rtARID_DEF.Memory30_PreviousInput "" FLOAT32_IEEE autosar_swc_vme_CM_single 0 0 -3.4E+38 3.4E+38 ECU_ADDRESS 0xfe4cd774 /* @ECU_Address@autosar_swc_vme_rtARID_DEF.Memory30_PreviousInput@ */ /end MEASUREMENT
/begin MEASUREMENT autosar_swc_vme_rtARID_DEF.Memory31_PreviousInput "" FLOAT32_IEEE autosar_swc_vme_CM_single 0 0 -3.4E+38 3.4E+38 ECU_ADDRESS 0xfe4cd710 /* @ECU_Address@autosar_swc_vme_rtARID_DEF.Memory31_PreviousInput@ */ /end MEASUREMENT
/begin MEASUREMENT autosar_swc_vme_rtARID_DEF.Memory33_PreviousInput "" FLOAT32_IEEE autosar_swc_vme_CM_single 0 0 -3.4E+38 3.4E+38 ECU_ADDRESS 0xfe4cd740 /* @ECU_Address@autosar_swc_vme_rtARID_DEF.Memory33_PreviousInput@ */ /end MEASUREMENT
/begin MEASUREMENT autosar_swc_vme_rtARID_DEF.Memory34_PreviousInput "" FLOAT32_IEEE autosar_swc_vme_CM_single 0 0 -3.4E+38 3.4E+38 ECU_ADDRESS 0xfe4cd714 /* @ECU_Address@autosar_swc_vme_rtARID_DEF.Memory34_PreviousInput@ */ /end MEASUREMENT
/begin MEASUREMENT autosar_swc_vme_rtARID_DEF.Memory36_PreviousInput "" FLOAT32_IEEE autosar_swc_vme_CM_single 0 0 -3.4E+38 3.4E+38 ECU_ADDRESS 0xfe4cd718 /* @ECU_Address@autosar_swc_vme_rtARID_DEF.Memory36_PreviousInput@ */ /end MEASUREMENT
/begin MEASUREMENT autosar_swc_vme_rtARID_DEF.Memory38_PreviousInput "" FLOAT32_IEEE autosar_swc_vme_CM_single 0 0 -3.4E+38 3.4E+38 ECU_ADDRESS 0xfe4cd728 /* @ECU_Address@autosar_swc_vme_rtARID_DEF.Memory38_PreviousInput@ */ /end MEASUREMENT
/begin MEASUREMENT autosar_swc_vme_rtARID_DEF.Memory39_PreviousInput "" FLOAT32_IEEE autosar_swc_vme_CM_single 0 0 -3.4E+38 3.4E+38 ECU_ADDRESS 0xfe4cd724 /* @ECU_Address@autosar_swc_vme_rtARID_DEF.Memory39_PreviousInput@ */ /end MEASUREMENT
/begin MEASUREMENT autosar_swc_vme_rtARID_DEF.Memory3_PreviousInput "" FLOAT32_IEEE autosar_swc_vme_CM_single 0 0 -3.4E+38 3.4E+38 ECU_ADDRESS 0xfe4cd758 /* @ECU_Address@autosar_swc_vme_rtARID_DEF.Memory3_PreviousInput@ */ /end MEASUREMENT
/begin MEASUREMENT autosar_swc_vme_rtARID_DEF.Memory3_PreviousInput_g "" FLOAT32_IEEE autosar_swc_vme_CM_single 0 0 -3.4E+38 3.4E+38 ECU_ADDRESS 0xfe4cd788 /* @ECU_Address@autosar_swc_vme_rtARID_DEF.Memory3_PreviousInput_g@ */ /end MEASUREMENT
/begin MEASUREMENT autosar_swc_vme_rtARID_DEF.Memory4_PreviousInput "" FLOAT32_IEEE autosar_swc_vme_CM_single 0 0 -3.4E+38 3.4E+38 ECU_ADDRESS 0xfe4cd74c /* @ECU_Address@autosar_swc_vme_rtARID_DEF.Memory4_PreviousInput@ */ /end MEASUREMENT
/begin MEASUREMENT autosar_swc_vme_rtARID_DEF.Memory4_PreviousInput_p "" FLOAT32_IEEE autosar_swc_vme_CM_single 0 0 -3.4E+38 3.4E+38 ECU_ADDRESS 0xfe4cd780 /* @ECU_Address@autosar_swc_vme_rtARID_DEF.Memory4_PreviousInput_p@ */ /end MEASUREMENT
/begin MEASUREMENT autosar_swc_vme_rtARID_DEF.Memory52_PreviousInput "" FLOAT32_IEEE autosar_swc_vme_CM_single 0 0 -3.4E+38 3.4E+38 ECU_ADDRESS 0xfe4cd770 /* @ECU_Address@autosar_swc_vme_rtARID_DEF.Memory52_PreviousInput@ */ /end MEASUREMENT
/begin MEASUREMENT autosar_swc_vme_rtARID_DEF.Memory5_PreviousInput "" FLOAT32_IEEE autosar_swc_vme_CM_single 0 0 -3.4E+38 3.4E+38 ECU_ADDRESS 0xfe4cd750 /* @ECU_Address@autosar_swc_vme_rtARID_DEF.Memory5_PreviousInput@ */ /end MEASUREMENT
/begin MEASUREMENT autosar_swc_vme_rtARID_DEF.Memory5_PreviousInput_p "" FLOAT32_IEEE autosar_swc_vme_CM_single 0 0 -3.4E+38 3.4E+38 ECU_ADDRESS 0xfe4cd784 /* @ECU_Address@autosar_swc_vme_rtARID_DEF.Memory5_PreviousInput_p@ */ /end MEASUREMENT
/begin MEASUREMENT autosar_swc_vme_rtARID_DEF.Memory6_PreviousInput "" FLOAT32_IEEE autosar_swc_vme_CM_single 0 0 -3.4E+38 3.4E+38 ECU_ADDRESS 0xfe4cd730 /* @ECU_Address@autosar_swc_vme_rtARID_DEF.Memory6_PreviousInput@ */ /end MEASUREMENT
/begin MEASUREMENT autosar_swc_vme_rtARID_DEF.Memory_PreviousInput "" FLOAT32_IEEE autosar_swc_vme_CM_single 0 0 -3.4E+38 3.4E+38 ECU_ADDRESS 0xfe4cd748 /* @ECU_Address@autosar_swc_vme_rtARID_DEF.Memory_PreviousInput@ */ /end MEASUREMENT
/begin MEASUREMENT autosar_swc_vme_rtARID_DEF.Memory_PreviousInput_e "" FLOAT32_IEEE autosar_swc_vme_CM_single 0 0 -3.4E+38 3.4E+38 ECU_ADDRESS 0xfe4cd778 /* @ECU_Address@autosar_swc_vme_rtARID_DEF.Memory_PreviousInput_e@ */ /end MEASUREMENT
/begin MEASUREMENT autosar_swc_vme_rtARID_DEF.NvM_Set_SteerAngOffsetInit "" FLOAT32_IEEE autosar_swc_vme_CM_single 0 0 -3.4E+38 3.4E+38 ECU_ADDRESS 0xfe4cd6fc /* @ECU_Address@autosar_swc_vme_rtARID_DEF.NvM_Set_SteerAngOffsetInit@ */ /end MEASUREMENT
/begin MEASUREMENT autosar_swc_vme_rtARID_DEF.Output_DSTATE "" UBYTE autosar_swc_vme_CM_uint8 0 0 0 255 ECU_ADDRESS 0xfe4cd790 /* @ECU_Address@autosar_swc_vme_rtARID_DEF.Output_DSTATE@ */ /end MEASUREMENT
/begin MEASUREMENT autosar_swc_vme_rtARID_DEF.Output_DSTATE_h "" UBYTE autosar_swc_vme_CM_uint8 0 0 0 255 ECU_ADDRESS 0xfe4cd791 /* @ECU_Address@autosar_swc_vme_rtARID_DEF.Output_DSTATE_h@ */ /end MEASUREMENT
/begin MEASUREMENT autosar_swc_vme_rtARID_DEF.PsiDtOpt "" FLOAT32_IEEE autosar_swc_vme_CM_single 0 0 -3.4E+38 3.4E+38 ECU_ADDRESS 0xfe4cd6e0 /* @ECU_Address@autosar_swc_vme_rtARID_DEF.PsiDtOpt@ */ /end MEASUREMENT
/begin MEASUREMENT autosar_swc_vme_rtARID_DEF.Switch "" FLOAT32_IEEE autosar_swc_vme_CM_single 0 0 -3.4E+38 3.4E+38 ECU_ADDRESS 0xfe4cd6e8 /* @ECU_Address@autosar_swc_vme_rtARID_DEF.Switch@ */ /end MEASUREMENT
/begin MEASUREMENT autosar_swc_vme_rtARID_DEF.T "" FLOAT32_IEEE autosar_swc_vme_CM_single 0 0 -3.4E+38 3.4E+38 ECU_ADDRESS 0xfe4cd78c /* @ECU_Address@autosar_swc_vme_rtARID_DEF.T@ */ /end MEASUREMENT
/begin MEASUREMENT autosar_swc_vme_rtARID_DEF.TappedDelay1_X "" FLOAT32_IEEE autosar_swc_vme_CM_single 0 0 -3.4E+38 3.4E+38 LAYOUT COLUMN_DIR MATRIX_DIM 4 ECU_ADDRESS 0xfe4cd67c /* @ECU_Address@autosar_swc_vme_rtARID_DEF.TappedDelay1_X@ */ /end MEASUREMENT
/begin MEASUREMENT autosar_swc_vme_rtARID_DEF.TappedDelay2_X "" FLOAT32_IEEE autosar_swc_vme_CM_single 0 0 -3.4E+38 3.4E+38 LAYOUT COLUMN_DIR MATRIX_DIM 4 ECU_ADDRESS 0xfe4cd68c /* @ECU_Address@autosar_swc_vme_rtARID_DEF.TappedDelay2_X@ */ /end MEASUREMENT
/begin MEASUREMENT autosar_swc_vme_rtARID_DEF.TappedDelay3_X "" FLOAT32_IEEE autosar_swc_vme_CM_single 0 0 -3.4E+38 3.4E+38 LAYOUT COLUMN_DIR MATRIX_DIM 4 ECU_ADDRESS 0xfe4cd69c /* @ECU_Address@autosar_swc_vme_rtARID_DEF.TappedDelay3_X@ */ /end MEASUREMENT
/begin MEASUREMENT autosar_swc_vme_rtARID_DEF.TappedDelay4_X "" FLOAT32_IEEE autosar_swc_vme_CM_single 0 0 -3.4E+38 3.4E+38 LAYOUT COLUMN_DIR MATRIX_DIM 9 ECU_ADDRESS 0xfe4cd648 /* @ECU_Address@autosar_swc_vme_rtARID_DEF.TappedDelay4_X@ */ /end MEASUREMENT
/begin MEASUREMENT autosar_swc_vme_rtARID_DEF.TappedDelay8_X "" FLOAT32_IEEE autosar_swc_vme_CM_single 0 0 -3.4E+38 3.4E+38 LAYOUT COLUMN_DIR MATRIX_DIM 4 ECU_ADDRESS 0xfe4cd6bc /* @ECU_Address@autosar_swc_vme_rtARID_DEF.TappedDelay8_X@ */ /end MEASUREMENT
/begin MEASUREMENT autosar_swc_vme_rtARID_DEF.TappedDelay_X "" FLOAT32_IEEE autosar_swc_vme_CM_single 0 0 -3.4E+38 3.4E+38 LAYOUT COLUMN_DIR MATRIX_DIM 4 ECU_ADDRESS 0xfe4cd66c /* @ECU_Address@autosar_swc_vme_rtARID_DEF.TappedDelay_X@ */ /end MEASUREMENT
/begin MEASUREMENT autosar_swc_vme_rtARID_DEF.TappedDelay_X_c "" FLOAT32_IEEE autosar_swc_vme_CM_single 0 0 -3.4E+38 3.4E+38 LAYOUT COLUMN_DIR MATRIX_DIM 4 ECU_ADDRESS 0xfe4cd6cc /* @ECU_Address@autosar_swc_vme_rtARID_DEF.TappedDelay_X_c@ */ /end MEASUREMENT
/begin MEASUREMENT autosar_swc_vme_rtARID_DEF.TappedDelay_X_o "" FLOAT32_IEEE autosar_swc_vme_CM_single 0 0 -3.4E+38 3.4E+38 LAYOUT COLUMN_DIR MATRIX_DIM 4 ECU_ADDRESS 0xfe4cd6ac /* @ECU_Address@autosar_swc_vme_rtARID_DEF.TappedDelay_X_o@ */ /end MEASUREMENT
/begin MEASUREMENT autosar_swc_vme_rtARID_DEF.TmpSignalConversionAtVAL_VEHICLE_STATEOutport1.BlindTemp "" UBYTE autosar_swc_vme_CM_logical 0 0 0 1 ECU_ADDRESS 0xfe4cd59e /* @ECU_Address@autosar_swc_vme_rtARID_DEF.TmpSignalConversionAtVAL_VEHICLE_STATEOutport1.BlindTemp@ */ /end MEASUREMENT
/begin MEASUREMENT autosar_swc_vme_rtARID_DEF.TmpSignalConversionAtVAL_VEHICLE_STATEOutport1.CurrentGear "" UBYTE autosar_swc_vme_CM_uint8 0 0 0 255 ECU_ADDRESS 0xfe4cd5a0 /* @ECU_Address@autosar_swc_vme_rtARID_DEF.TmpSignalConversionAtVAL_VEHICLE_STATEOutport1.CurrentGear@ */ /end MEASUREMENT
/begin MEASUREMENT autosar_swc_vme_rtARID_DEF.TmpSignalConversionAtVAL_VEHICLE_STATEOutport1.EngSpd "" FLOAT32_IEEE autosar_swc_vme_CM_single 0 0 -3.4E+38 3.4E+38 ECU_ADDRESS 0xfe4cd5e8 /* @ECU_Address@autosar_swc_vme_rtARID_DEF.TmpSignalConversionAtVAL_VEHICLE_STATEOutport1.EngSpd@ */ /end MEASUREMENT
/begin MEASUREMENT autosar_swc_vme_rtARID_DEF.TmpSignalConversionAtVAL_VEHICLE_STATEOutport1.EngTrqMinAct "" FLOAT32_IEEE autosar_swc_vme_CM_single 0 0 -3.4E+38 3.4E+38 ECU_ADDRESS 0xfe4cd5e4 /* @ECU_Address@autosar_swc_vme_rtARID_DEF.TmpSignalConversionAtVAL_VEHICLE_STATEOutport1.EngTrqMinAct@ */ /end MEASUREMENT
/begin MEASUREMENT autosar_swc_vme_rtARID_DEF.TmpSignalConversionAtVAL_VEHICLE_STATEOutport1.EngTrqMinNm "" FLOAT32_IEEE autosar_swc_vme_CM_single 0 0 -3.4E+38 3.4E+38 ECU_ADDRESS 0xfe4cd5d8 /* @ECU_Address@autosar_swc_vme_rtARID_DEF.TmpSignalConversionAtVAL_VEHICLE_STATEOutport1.EngTrqMinNm@ */ /end MEASUREMENT
/begin MEASUREMENT autosar_swc_vme_rtARID_DEF.TmpSignalConversionAtVAL_VEHICLE_STATEOutport1.EngTrqNm "" FLOAT32_IEEE autosar_swc_vme_CM_single 0 0 -3.4E+38 3.4E+38 ECU_ADDRESS 0xfe4cd5d4 /* @ECU_Address@autosar_swc_vme_rtARID_DEF.TmpSignalConversionAtVAL_VEHICLE_STATEOutport1.EngTrqNm@ */ /end MEASUREMENT
/begin MEASUREMENT autosar_swc_vme_rtARID_DEF.TmpSignalConversionAtVAL_VEHICLE_STATEOutport1.EngineOn "" UBYTE autosar_swc_vme_CM_logical 0 0 0 1 ECU_ADDRESS 0xfe4cd599 /* @ECU_Address@autosar_swc_vme_rtARID_DEF.TmpSignalConversionAtVAL_VEHICLE_STATEOutport1.EngineOn@ */ /end MEASUREMENT
/begin MEASUREMENT autosar_swc_vme_rtARID_DEF.TmpSignalConversionAtVAL_VEHICLE_STATEOutport1.FAShiftInProgress "" UBYTE autosar_swc_vme_CM_logical 0 0 0 1 ECU_ADDRESS 0xfe4cd59a /* @ECU_Address@autosar_swc_vme_rtARID_DEF.TmpSignalConversionAtVAL_VEHICLE_STATEOutport1.FAShiftInProgress@ */ /end MEASUREMENT
/begin MEASUREMENT autosar_swc_vme_rtARID_DEF.TmpSignalConversionAtVAL_VEHICLE_STATEOutport1.FLWheelPulseCounter "" ULONG autosar_swc_vme_CM_uint32 0 0 0 4294967295 ECU_ADDRESS 0xfe4cd610 /* @ECU_Address@autosar_swc_vme_rtARID_DEF.TmpSignalConversionAtVAL_VEHICLE_STATEOutport1.FLWheelPulseCounter@ */ /end MEASUREMENT
/begin MEASUREMENT autosar_swc_vme_rtARID_DEF.TmpSignalConversionAtVAL_VEHICLE_STATEOutport1.FLWheelSpdMps "" FLOAT32_IEEE autosar_swc_vme_CM_single 0 0 -3.4E+38 3.4E+38 ECU_ADDRESS 0xfe4cd5ec /* @ECU_Address@autosar_swc_vme_rtARID_DEF.TmpSignalConversionAtVAL_VEHICLE_STATEOutport1.FLWheelSpdMps@ */ /end MEASUREMENT
/begin MEASUREMENT autosar_swc_vme_rtARID_DEF.TmpSignalConversionAtVAL_VEHICLE_STATEOutport1.FRWheelPulseCounter "" ULONG autosar_swc_vme_CM_uint32 0 0 0 4294967295 ECU_ADDRESS 0xfe4cd614 /* @ECU_Address@autosar_swc_vme_rtARID_DEF.TmpSignalConversionAtVAL_VEHICLE_STATEOutport1.FRWheelPulseCounter@ */ /end MEASUREMENT
/begin MEASUREMENT autosar_swc_vme_rtARID_DEF.TmpSignalConversionAtVAL_VEHICLE_STATEOutport1.FRWheelSpdMps "" FLOAT32_IEEE autosar_swc_vme_CM_single 0 0 -3.4E+38 3.4E+38 ECU_ADDRESS 0xfe4cd5f0 /* @ECU_Address@autosar_swc_vme_rtARID_DEF.TmpSignalConversionAtVAL_VEHICLE_STATEOutport1.FRWheelSpdMps@ */ /end MEASUREMENT
/begin MEASUREMENT autosar_swc_vme_rtARID_DEF.TmpSignalConversionAtVAL_VEHICLE_STATEOutport1.FourWhlsBrkTrq "" UWORD autosar_swc_vme_CM_uint16 0 0 0 65535 ECU_ADDRESS 0xfe4cd5aa /* @ECU_Address@autosar_swc_vme_rtARID_DEF.TmpSignalConversionAtVAL_VEHICLE_STATEOutport1.FourWhlsBrkTrq@ */ /end MEASUREMENT
/begin MEASUREMENT autosar_swc_vme_rtARID_DEF.TmpSignalConversionAtVAL_VEHICLE_STATEOutport1.GearSts "" UBYTE autosar_swc_vme_CM_uint8 0 0 0 255 ECU_ADDRESS 0xfe4cd5a2 /* @ECU_Address@autosar_swc_vme_rtARID_DEF.TmpSignalConversionAtVAL_VEHICLE_STATEOutport1.GearSts@ */ /end MEASUREMENT
/begin MEASUREMENT autosar_swc_vme_rtARID_DEF.TmpSignalConversionAtVAL_VEHICLE_STATEOutport1.IPVehSpdDispKph "" UWORD autosar_swc_vme_CM_uint16 0 0 0 65535 ECU_ADDRESS 0xfe4cd5a6 /* @ECU_Address@autosar_swc_vme_rtARID_DEF.TmpSignalConversionAtVAL_VEHICLE_STATEOutport1.IPVehSpdDispKph@ */ /end MEASUREMENT
/begin MEASUREMENT autosar_swc_vme_rtARID_DEF.TmpSignalConversionAtVAL_VEHICLE_STATEOutport1.IPVehSpdDispKphFloat "" FLOAT32_IEEE autosar_swc_vme_CM_single 0 0 -3.4E+38 3.4E+38 ECU_ADDRESS 0xfe4cd5b4 /* @ECU_Address@autosar_swc_vme_rtARID_DEF.TmpSignalConversionAtVAL_VEHICLE_STATEOutport1.IPVehSpdDispKphFloat@ */ /end MEASUREMENT
/begin MEASUREMENT autosar_swc_vme_rtARID_DEF.TmpSignalConversionAtVAL_VEHICLE_STATEOutport1.IPVehSpdDispMph "" UWORD autosar_swc_vme_CM_uint16 0 0 0 65535 ECU_ADDRESS 0xfe4cd5a8 /* @ECU_Address@autosar_swc_vme_rtARID_DEF.TmpSignalConversionAtVAL_VEHICLE_STATEOutport1.IPVehSpdDispMph@ */ /end MEASUREMENT
/begin MEASUREMENT autosar_swc_vme_rtARID_DEF.TmpSignalConversionAtVAL_VEHICLE_STATEOutport1.IPVehSpdUnit "" UBYTE autosar_swc_vme_CM_uint8 0 0 0 255 ECU_ADDRESS 0xfe4cd5a4 /* @ECU_Address@autosar_swc_vme_rtARID_DEF.TmpSignalConversionAtVAL_VEHICLE_STATEOutport1.IPVehSpdUnit@ */ /end MEASUREMENT
/begin MEASUREMENT autosar_swc_vme_rtARID_DEF.TmpSignalConversionAtVAL_VEHICLE_STATEOutport1.LKACtrDlvdValue "" FLOAT32_IEEE autosar_swc_vme_CM_single 0 0 -3.4E+38 3.4E+38 ECU_ADDRESS 0xfe4cd5dc /* @ECU_Address@autosar_swc_vme_rtARID_DEF.TmpSignalConversionAtVAL_VEHICLE_STATEOutport1.LKACtrDlvdValue@ */ /end MEASUREMENT
/begin MEASUREMENT autosar_swc_vme_rtARID_DEF.TmpSignalConversionAtVAL_VEHICLE_STATEOutport1.MasterCylBrkPress "" FLOAT32_IEEE autosar_swc_vme_CM_single 0 0 -3.4E+38 3.4E+38 ECU_ADDRESS 0xfe4cd5c4 /* @ECU_Address@autosar_swc_vme_rtARID_DEF.TmpSignalConversionAtVAL_VEHICLE_STATEOutport1.MasterCylBrkPress@ */ /end MEASUREMENT
/begin MEASUREMENT autosar_swc_vme_rtARID_DEF.TmpSignalConversionAtVAL_VEHICLE_STATEOutport1.MaxEngTrqNorm "" UWORD autosar_swc_vme_CM_uint16 0 0 0 65535 ECU_ADDRESS 0xfe4cd5ac /* @ECU_Address@autosar_swc_vme_rtARID_DEF.TmpSignalConversionAtVAL_VEHICLE_STATEOutport1.MaxEngTrqNorm@ */ /end MEASUREMENT
/begin MEASUREMENT autosar_swc_vme_rtARID_DEF.TmpSignalConversionAtVAL_VEHICLE_STATEOutport1.NetEngTrq "" FLOAT32_IEEE autosar_swc_vme_CM_single 0 0 -3.4E+38 3.4E+38 ECU_ADDRESS 0xfe4cd5e0 /* @ECU_Address@autosar_swc_vme_rtARID_DEF.TmpSignalConversionAtVAL_VEHICLE_STATEOutport1.NetEngTrq@ */ /end MEASUREMENT
/begin MEASUREMENT autosar_swc_vme_rtARID_DEF.TmpSignalConversionAtVAL_VEHICLE_STATEOutport1.NoBrakeForce "" UBYTE autosar_swc_vme_CM_logical 0 0 0 1 ECU_ADDRESS 0xfe4cd59c /* @ECU_Address@autosar_swc_vme_rtARID_DEF.TmpSignalConversionAtVAL_VEHICLE_STATEOutport1.NoBrakeForce@ */ /end MEASUREMENT
/begin MEASUREMENT autosar_swc_vme_rtARID_DEF.TmpSignalConversionAtVAL_VEHICLE_STATEOutport1.RAShiftInProgress "" UBYTE autosar_swc_vme_CM_logical 0 0 0 1 ECU_ADDRESS 0xfe4cd59b /* @ECU_Address@autosar_swc_vme_rtARID_DEF.TmpSignalConversionAtVAL_VEHICLE_STATEOutport1.RAShiftInProgress@ */ /end MEASUREMENT
/begin MEASUREMENT autosar_swc_vme_rtARID_DEF.TmpSignalConversionAtVAL_VEHICLE_STATEOutport1.RLWheelPulseCounter "" ULONG autosar_swc_vme_CM_uint32 0 0 0 4294967295 ECU_ADDRESS 0xfe4cd618 /* @ECU_Address@autosar_swc_vme_rtARID_DEF.TmpSignalConversionAtVAL_VEHICLE_STATEOutport1.RLWheelPulseCounter@ */ /end MEASUREMENT
/begin MEASUREMENT autosar_swc_vme_rtARID_DEF.TmpSignalConversionAtVAL_VEHICLE_STATEOutport1.RLWheelSpdMps "" FLOAT32_IEEE autosar_swc_vme_CM_single 0 0 -3.4E+38 3.4E+38 ECU_ADDRESS 0xfe4cd5f4 /* @ECU_Address@autosar_swc_vme_rtARID_DEF.TmpSignalConversionAtVAL_VEHICLE_STATEOutport1.RLWheelSpdMps@ */ /end MEASUREMENT
/begin MEASUREMENT autosar_swc_vme_rtARID_DEF.TmpSignalConversionAtVAL_VEHICLE_STATEOutport1.RRWheelPulseCounter "" ULONG autosar_swc_vme_CM_uint32 0 0 0 4294967295 ECU_ADDRESS 0xfe4cd61c /* @ECU_Address@autosar_swc_vme_rtARID_DEF.TmpSignalConversionAtVAL_VEHICLE_STATEOutport1.RRWheelPulseCounter@ */ /end MEASUREMENT
/begin MEASUREMENT autosar_swc_vme_rtARID_DEF.TmpSignalConversionAtVAL_VEHICLE_STATEOutport1.RRWheelSpdMps "" FLOAT32_IEEE autosar_swc_vme_CM_single 0 0 -3.4E+38 3.4E+38 ECU_ADDRESS 0xfe4cd5f8 /* @ECU_Address@autosar_swc_vme_rtARID_DEF.TmpSignalConversionAtVAL_VEHICLE_STATEOutport1.RRWheelSpdMps@ */ /end MEASUREMENT
/begin MEASUREMENT autosar_swc_vme_rtARID_DEF.TmpSignalConversionAtVAL_VEHICLE_STATEOutport1.SensorVehLatAccelMps2 "" FLOAT32_IEEE autosar_swc_vme_CM_single 0 0 -3.4E+38 3.4E+38 ECU_ADDRESS 0xfe4cd604 /* @ECU_Address@autosar_swc_vme_rtARID_DEF.TmpSignalConversionAtVAL_VEHICLE_STATEOutport1.SensorVehLatAccelMps2@ */ /end MEASUREMENT
/begin MEASUREMENT autosar_swc_vme_rtARID_DEF.TmpSignalConversionAtVAL_VEHICLE_STATEOutport1.SensorVehLonAccelMps2 "" FLOAT32_IEEE autosar_swc_vme_CM_single 0 0 -3.4E+38 3.4E+38 ECU_ADDRESS 0xfe4cd600 /* @ECU_Address@autosar_swc_vme_rtARID_DEF.TmpSignalConversionAtVAL_VEHICLE_STATEOutport1.SensorVehLonAccelMps2@ */ /end MEASUREMENT
/begin MEASUREMENT autosar_swc_vme_rtARID_DEF.TmpSignalConversionAtVAL_VEHICLE_STATEOutport1.SensorVehYawRateRadps "" FLOAT32_IEEE autosar_swc_vme_CM_single 0 0 -3.4E+38 3.4E+38 ECU_ADDRESS 0xfe4cd5fc /* @ECU_Address@autosar_swc_vme_rtARID_DEF.TmpSignalConversionAtVAL_VEHICLE_STATEOutport1.SensorVehYawRateRadps@ */ /end MEASUREMENT
/begin MEASUREMENT autosar_swc_vme_rtARID_DEF.TmpSignalConversionAtVAL_VEHICLE_STATEOutport1.SteerWheelAngle "" FLOAT32_IEEE autosar_swc_vme_CM_single 0 0 -3.4E+38 3.4E+38 ECU_ADDRESS 0xfe4cd5b8 /* @ECU_Address@autosar_swc_vme_rtARID_DEF.TmpSignalConversionAtVAL_VEHICLE_STATEOutport1.SteerWheelAngle@ */ /end MEASUREMENT
/begin MEASUREMENT autosar_swc_vme_rtARID_DEF.TmpSignalConversionAtVAL_VEHICLE_STATEOutport1.SteerWheelSpd "" FLOAT32_IEEE autosar_swc_vme_CM_single 0 0 -3.4E+38 3.4E+38 ECU_ADDRESS 0xfe4cd5bc /* @ECU_Address@autosar_swc_vme_rtARID_DEF.TmpSignalConversionAtVAL_VEHICLE_STATEOutport1.SteerWheelSpd@ */ /end MEASUREMENT
/begin MEASUREMENT autosar_swc_vme_rtARID_DEF.TmpSignalConversionAtVAL_VEHICLE_STATEOutport1.SteerWheelTor "" FLOAT32_IEEE autosar_swc_vme_CM_single 0 0 -3.4E+38 3.4E+38 ECU_ADDRESS 0xfe4cd5c0 /* @ECU_Address@autosar_swc_vme_rtARID_DEF.TmpSignalConversionAtVAL_VEHICLE_STATEOutport1.SteerWheelTor@ */ /end MEASUREMENT
/begin MEASUREMENT autosar_swc_vme_rtARID_DEF.TmpSignalConversionAtVAL_VEHICLE_STATEOutport1.SysPowerMod "" UBYTE autosar_swc_vme_CM_uint8 0 0 0 255 ECU_ADDRESS 0xfe4cd5a3 /* @ECU_Address@autosar_swc_vme_rtARID_DEF.TmpSignalConversionAtVAL_VEHICLE_STATEOutport1.SysPowerMod@ */ /end MEASUREMENT
/begin MEASUREMENT autosar_swc_vme_rtARID_DEF.TmpSignalConversionAtVAL_VEHICLE_STATEOutport1.TargetGear "" UBYTE autosar_swc_vme_CM_uint8 0 0 0 255 ECU_ADDRESS 0xfe4cd5a1 /* @ECU_Address@autosar_swc_vme_rtARID_DEF.TmpSignalConversionAtVAL_VEHICLE_STATEOutport1.TargetGear@ */ /end MEASUREMENT
/begin MEASUREMENT autosar_swc_vme_rtARID_DEF.TmpSignalConversionAtVAL_VEHICLE_STATEOutport1.TimeStampMs "" A_UINT64 autosar_swc_vme_CM_uint64 0 0 0 18446744073709551615 ECU_ADDRESS 0xfe4cd620 /* @ECU_Address@autosar_swc_vme_rtARID_DEF.TmpSignalConversionAtVAL_VEHICLE_STATEOutport1.TimeStampMs@ */ /end MEASUREMENT
/begin MEASUREMENT autosar_swc_vme_rtARID_DEF.TmpSignalConversionAtVAL_VEHICLE_STATEOutport1.TotalOdometer_km "" ULONG autosar_swc_vme_CM_uint32 0 0 0 4294967295 ECU_ADDRESS 0xfe4cd60c /* @ECU_Address@autosar_swc_vme_rtARID_DEF.TmpSignalConversionAtVAL_VEHICLE_STATEOutport1.TotalOdometer_km@ */ /end MEASUREMENT
/begin MEASUREMENT autosar_swc_vme_rtARID_DEF.TmpSignalConversionAtVAL_VEHICLE_STATEOutport1.VCUTrqNm "" FLOAT32_IEEE autosar_swc_vme_CM_single 0 0 -3.4E+38 3.4E+38 ECU_ADDRESS 0xfe4cd5d0 /* @ECU_Address@autosar_swc_vme_rtARID_DEF.TmpSignalConversionAtVAL_VEHICLE_STATEOutport1.VCUTrqNm@ */ /end MEASUREMENT
/begin MEASUREMENT autosar_swc_vme_rtARID_DEF.TmpSignalConversionAtVAL_VEHICLE_STATEOutport1.VLC_InternalTargetAcceleration "" FLOAT32_IEEE autosar_swc_vme_CM_single 0 0 -3.4E+38 3.4E+38 ECU_ADDRESS 0xfe4cd608 /* @ECU_Address@autosar_swc_vme_rtARID_DEF.TmpSignalConversionAtVAL_VEHICLE_STATEOutport1.VLC_InternalTargetAcceleration@ */ /end MEASUREMENT
/begin MEASUREMENT autosar_swc_vme_rtARID_DEF.TmpSignalConversionAtVAL_VEHICLE_STATEOutport1.VLC_InternalTargetAccelerationValid "" UBYTE autosar_swc_vme_CM_logical 0 0 0 1 ECU_ADDRESS 0xfe4cd59d /* @ECU_Address@autosar_swc_vme_rtARID_DEF.TmpSignalConversionAtVAL_VEHICLE_STATEOutport1.VLC_InternalTargetAccelerationValid@ */ /end MEASUREMENT
/begin MEASUREMENT autosar_swc_vme_rtARID_DEF.TmpSignalConversionAtVAL_VEHICLE_STATEOutport1.VehSpdKph "" FLOAT32_IEEE autosar_swc_vme_CM_single 0 0 -3.4E+38 3.4E+38 ECU_ADDRESS 0xfe4cd5b0 /* @ECU_Address@autosar_swc_vme_rtARID_DEF.TmpSignalConversionAtVAL_VEHICLE_STATEOutport1.VehSpdKph@ */ /end MEASUREMENT
/begin MEASUREMENT autosar_swc_vme_rtARID_DEF.TmpSignalConversionAtVAL_VEHICLE_STATEOutport1.VehStandstill "" UBYTE autosar_swc_vme_CM_logical 0 0 0 1 ECU_ADDRESS 0xfe4cd598 /* @ECU_Address@autosar_swc_vme_rtARID_DEF.TmpSignalConversionAtVAL_VEHICLE_STATEOutport1.VehStandstill@ */ /end MEASUREMENT
/begin MEASUREMENT autosar_swc_vme_rtARID_DEF.TmpSignalConversionAtVAL_VEHICLE_STATEOutport1.WheelPulseCounterValid "" UBYTE autosar_swc_vme_CM_logical 0 0 0 1 ECU_ADDRESS 0xfe4cd59f /* @ECU_Address@autosar_swc_vme_rtARID_DEF.TmpSignalConversionAtVAL_VEHICLE_STATEOutport1.WheelPulseCounterValid@ */ /end MEASUREMENT
/begin MEASUREMENT autosar_swc_vme_rtARID_DEF.TmpSignalConversionAtVAL_VEHICLE_STATEOutport1.WheelTrqMinNm "" FLOAT32_IEEE autosar_swc_vme_CM_single 0 0 -3.4E+38 3.4E+38 ECU_ADDRESS 0xfe4cd5cc /* @ECU_Address@autosar_swc_vme_rtARID_DEF.TmpSignalConversionAtVAL_VEHICLE_STATEOutport1.WheelTrqMinNm@ */ /end MEASUREMENT
/begin MEASUREMENT autosar_swc_vme_rtARID_DEF.TmpSignalConversionAtVAL_VEHICLE_STATEOutport1.WheelTrqNm "" FLOAT32_IEEE autosar_swc_vme_CM_single 0 0 -3.4E+38 3.4E+38 ECU_ADDRESS 0xfe4cd5c8 /* @ECU_Address@autosar_swc_vme_rtARID_DEF.TmpSignalConversionAtVAL_VEHICLE_STATEOutport1.WheelTrqNm@ */ /end MEASUREMENT
/begin MEASUREMENT autosar_swc_vme_rtARID_DEF.Trigger "" UBYTE autosar_swc_vme_CM_logical 0 0 0 1 ECU_ADDRESS 0xfe4cd796 /* @ECU_Address@autosar_swc_vme_rtARID_DEF.Trigger@ */ /end MEASUREMENT
/begin MEASUREMENT autosar_swc_vme_rtARID_DEF.UnitDelay1_DSTATE "" FLOAT32_IEEE autosar_swc_vme_CM_single 0 0 -3.4E+38 3.4E+38 ECU_ADDRESS 0xfe4cd708 /* @ECU_Address@autosar_swc_vme_rtARID_DEF.UnitDelay1_DSTATE@ */ /end MEASUREMENT
/begin MEASUREMENT autosar_swc_vme_rtARID_DEF.UnitDelay_DSTATE "" FLOAT64_IEEE autosar_swc_vme_CM_double 0 0 -1.7E+308 1.7E+308 ECU_ADDRESS 0xfe4cd638 /* @ECU_Address@autosar_swc_vme_rtARID_DEF.UnitDelay_DSTATE@ */ /end MEASUREMENT
/begin MEASUREMENT autosar_swc_vme_rtARID_DEF.UnitDelay_DSTATE_e "" FLOAT32_IEEE autosar_swc_vme_CM_single 0 0 -3.4E+38 3.4E+38 ECU_ADDRESS 0xfe4cd70c /* @ECU_Address@autosar_swc_vme_rtARID_DEF.UnitDelay_DSTATE_e@ */ /end MEASUREMENT
/begin MEASUREMENT autosar_swc_vme_rtARID_DEF.VxvRef_ms "" FLOAT32_IEEE autosar_swc_vme_CM_single 0 0 -3.4E+38 3.4E+38 ECU_ADDRESS 0xfe4cd6e4 /* @ECU_Address@autosar_swc_vme_rtARID_DEF.VxvRef_ms@ */ /end MEASUREMENT
/begin MEASUREMENT autosar_swc_vme_rtARID_DEF.ayvRef_ms2 "" FLOAT32_IEEE autosar_swc_vme_CM_single 0 0 -3.4E+38 3.4E+38 ECU_ADDRESS 0xfe4cd6f0 /* @ECU_Address@autosar_swc_vme_rtARID_DEF.ayvRef_ms2@ */ /end MEASUREMENT
/begin MEASUREMENT autosar_swc_vme_rtARID_DEF.is_active_c14_autosar_swc_vme "" UBYTE autosar_swc_vme_CM_uint8 0 0 0 255 ECU_ADDRESS 0xfe4cd793 /* @ECU_Address@autosar_swc_vme_rtARID_DEF.is_active_c14_autosar_swc_vme@ */ /end MEASUREMENT
/begin MEASUREMENT autosar_swc_vme_rtARID_DEF.is_c14_autosar_swc_vme "" UBYTE autosar_swc_vme_CM_uint8 0 0 0 255 ECU_ADDRESS 0xfe4cd794 /* @ECU_Address@autosar_swc_vme_rtARID_DEF.is_c14_autosar_swc_vme@ */ /end MEASUREMENT
/begin MEASUREMENT autosar_swc_vme_rtARID_DEF.kapTraj "µ±Ç°Î»ÖÃµãÇúÂÊ" FLOAT32_IEEE autosar_swc_vme_CM_single 0 0 -3.4E+38 3.4E+38 ECU_ADDRESS 0xfe4cd6f8 /* @ECU_Address@autosar_swc_vme_rtARID_DEF.kapTraj@ */ /end MEASUREMENT
/begin MEASUREMENT autosar_swc_vme_rtARID_DEF.vxvRefRaw "" FLOAT32_IEEE autosar_swc_vme_CM_single 0 0 -3.4E+38 3.4E+38 ECU_ADDRESS 0xfe4cd700 /* @ECU_Address@autosar_swc_vme_rtARID_DEF.vxvRefRaw@ */ /end MEASUREMENT
/begin AXIS_PTS P_VME_FiltaxvRoadSlopebreakpoint "" 0xfe829008 /* @ECU_Address@P_VME_FiltaxvRoadSlopebreakpoint@ */ NO_INPUT_QUANTITY Axis_FLOAT32_IEEE 0 autosar_swc_vme_CM_single 4 -3.4E+38 3.4E+38 /end AXIS_PTS
/begin COMPU_METHOD autosar_swc_vme_CM_SM_MODULE_STATUS "Enumerated data type: SM_MODULE_STATUS" TAB_VERB "%0.6" "" COMPU_TAB_REF VTAB_FOR_autosar_swc_vme_CM_SM_MODULE_STATUS /end COMPU_METHOD
/begin COMPU_VTAB VTAB_FOR_autosar_swc_vme_CM_SM_MODULE_STATUS "Enumerated data type: SM_MODULE_STATUS" TAB_VERB 4 0 "STATUS_NORMAL" 1 "STATUS_NOT_CONNECTED" 2 "STATUS_HEARTBEAT_MISSED" 3 "STATUS_ABNORMAL" /end COMPU_VTAB
/begin COMPU_METHOD autosar_swc_vme_CM_double "Q = V" IDENTICAL "%15.10" "" /end COMPU_METHOD
/begin COMPU_METHOD autosar_swc_vme_CM_logical "Q = V" IDENTICAL "%1.0" "" /end COMPU_METHOD
/begin COMPU_METHOD autosar_swc_vme_CM_single "Q = V" IDENTICAL "%8.6" "" /end COMPU_METHOD
/begin COMPU_METHOD autosar_swc_vme_CM_uint16 "Q = V" IDENTICAL "%5.0" "" /end COMPU_METHOD
/begin COMPU_METHOD autosar_swc_vme_CM_uint32 "Q = V" IDENTICAL "%10.0" "" /end COMPU_METHOD
/begin COMPU_METHOD autosar_swc_vme_CM_uint64 "Q = V" IDENTICAL "%20.0" "" /end COMPU_METHOD
/begin COMPU_METHOD autosar_swc_vme_CM_uint8 "Q = V" IDENTICAL "%3.0" "" /end COMPU_METHOD
/begin RECORD_LAYOUT Record_BOOLEAN FNC_VALUES 1 UBYTE COLUMN_DIR DIRECT /end RECORD_LAYOUT
/begin RECORD_LAYOUT Record_FLOAT32_IEEE FNC_VALUES 1 FLOAT32_IEEE COLUMN_DIR DIRECT /end RECORD_LAYOUT
/begin RECORD_LAYOUT Record_UBYTE FNC_VALUES 1 UBYTE COLUMN_DIR DIRECT /end RECORD_LAYOUT
/begin RECORD_LAYOUT Axis_FLOAT32_IEEE AXIS_PTS_X 1 FLOAT32_IEEE INDEX_INCR DIRECT /end RECORD_LAYOUT
/begin GROUP SwcOut_VME_Herbeat_Info ""
 /begin REF_MEASUREMENT SwcOut_VME_Herbeat_Info.swc_id SwcOut_VME_Herbeat_Info.sequence_num SwcOut_VME_Herbeat_Info.inner_error SwcOut_VME_Herbeat_Info.module_status /end REF_MEASUREMENT
/end GROUP
/begin GROUP VME_ExecTimestamp ""
 /begin REF_MEASUREMENT VME_ExecTimestamp.timeBaseStatus VME_ExecTimestamp.nanoseconds VME_ExecTimestamp.seconds /end REF_MEASUREMENT
/end GROUP
/begin GROUP ZDrive_BSW_Cal_Cal "" /begin SUB_GROUP ZDrive_BSW_Cal_Cal.ZDrive_BSW_Cal_VehicleInfomationTable /end SUB_GROUP /end GROUP
/begin GROUP autosar_swc_vme "autosar_swc_vme" ROOT
 /begin SUB_GROUP VME_ExecTimestamp autosar_swc_vme_rtARID_DEF.TmpSignalConversionAtVAL_VEHICLE_STATEOutport1 autosar_swc_vme_autosar_swc_vme_Step_sys /end SUB_GROUP
/end GROUP
/begin GROUP autosar_swc_vme_autosar_swc_vme_Step_sys "autosar_swc_vme/autosar_swc_vme_Step_sys"
 /begin SUB_GROUP autosar_swc_vme_autosar_swc_vme_Step_sys_Enabled_Subsystem autosar_swc_vme_autosar_swc_vme_Step_sys_Subsystem /end SUB_GROUP
/end GROUP
/begin GROUP autosar_swc_vme_autosar_swc_vme_Step_sys_Enabled_Subsystem "autosar_swc_vme/autosar_swc_vme_Step_sys/Enabled\nSubsystem"
 /begin SUB_GROUP autosar_swc_vme_autosar_swc_vme_Step_sys_Enabled_Subsystem_Counter_Limited autosar_swc_vme_autosar_swc_vme_Step_sys_Enabled_Subsystem_Subsystem /end SUB_GROUP
 /begin REF_MEASUREMENT VME_UpdateCnt VME_Version autosar_swc_vme_rtARID_DEF.AND autosar_swc_vme_rtARID_DEF.AlpSideSlipAngle autosar_swc_vme_rtARID_DEF.Ax autosar_swc_vme_rtARID_DEF.AxRefDt autosar_swc_vme_rtARID_DEF.Cnt autosar_swc_vme_rtARID_DEF.PsiDtOpt autosar_swc_vme_rtARID_DEF.Switch autosar_swc_vme_rtARID_DEF.Trigger autosar_swc_vme_rtARID_DEF.VxvRef_ms autosar_swc_vme_rtARID_DEF.ayvRef_ms2 autosar_swc_vme_rtARID_DEF.is_active_c14_autosar_swc_vme autosar_swc_vme_rtARID_DEF.is_c14_autosar_swc_vme autosar_swc_vme_rtARID_DEF.kapTraj /end REF_MEASUREMENT
/end GROUP
/begin GROUP autosar_swc_vme_autosar_swc_vme_Step_sys_Enabled_Subsystem_Counter_Limited "autosar_swc_vme/autosar_swc_vme_Step_sys/Enabled\nSubsystem/Counter\nLimited"
 /begin SUB_GROUP autosar_swc_vme_autosar_swc_vme_Step_sys_Enabled_Subsystem_Counter_Limited_Increment_Real_World /end SUB_GROUP
 /begin REF_MEASUREMENT VME_UpdateCnt autosar_swc_vme_rtARID_DEF.Output_DSTATE /end REF_MEASUREMENT
/end GROUP
/begin GROUP autosar_swc_vme_autosar_swc_vme_Step_sys_Enabled_Subsystem_Counter_Limited_Increment_Real_World "autosar_swc_vme/autosar_swc_vme_Step_sys/Enabled\nSubsystem/Counter\nLimited/Increment\nReal World" /begin REF_MEASUREMENT VME_UpdateCnt /end REF_MEASUREMENT /end GROUP
/begin GROUP autosar_swc_vme_autosar_swc_vme_Step_sys_Enabled_Subsystem_Subsystem "autosar_swc_vme/autosar_swc_vme_Step_sys/Enabled\nSubsystem/Subsystem"
 /begin SUB_GROUP autosar_swc_vme_autosar_swc_vme_Step_sys_Enabled_Subsystem_Subsystem_vie /end SUB_GROUP
/end GROUP
/begin GROUP autosar_swc_vme_autosar_swc_vme_Step_sys_Enabled_Subsystem_Subsystem_vie "autosar_swc_vme/autosar_swc_vme_Step_sys/Enabled\nSubsystem/Subsystem/vie"
 /begin SUB_GROUP autosar_swc_vme_autosar_swc_vme_Step_sys_Enabled_Subsystem_Subsystem_vie_Counter_Limited autosar_swc_vme_autosar_swc_vme_Step_sys_Enabled_Subsystem_Subsystem_vie_Subsystem autosar_swc_vme_autosar_swc_vme_Step_sys_Enabled_Subsystem_Subsystem_vie_vie_axRef autosar_swc_vme_autosar_swc_vme_Step_sys_Enabled_Subsystem_Subsystem_vie_vie_kapTraj autosar_swc_vme_autosar_swc_vme_Step_sys_Enabled_Subsystem_Subsystem_vie_vie_latCalc autosar_swc_vme_autosar_swc_vme_Step_sys_Enabled_Subsystem_Subsystem_vie_vie_steerAngleDeg autosar_swc_vme_autosar_swc_vme_Step_sys_Enabled_Subsystem_Subsystem_vie_vie_vxvRefCalc /end SUB_GROUP
 /begin REF_MEASUREMENT SwcOut_VME_NvM_Set_SteerAngOffsetInit SwcOut_VME_SteerAngleOffset_deg SwcOut_VME_alpSideSlipAngle SwcOut_VME_alpSumSlideCurveness SwcOut_VME_axRefDt SwcOut_VME_axRefMs2 SwcOut_VME_axvRefMs2 SwcOut_VME_axvRoadSlopeMs2 SwcOut_VME_ayvRefMs2 SwcOut_VME_jerkxMs3 SwcOut_VME_jerkyMs3 SwcOut_VME_kapTraj SwcOut_VME_psiDtOpt SwcOut_VME_rollingBackSts SwcOut_VME_vxvRefMs VME_Branch_VIE VME_NvM_Get_SteerAngOffsetInit VME_Version_VIE autosar_swc_vme_rtARID_DEF.AND autosar_swc_vme_rtARID_DEF.AlpSideSlipAngle autosar_swc_vme_rtARID_DEF.Ax autosar_swc_vme_rtARID_DEF.AxRefDt autosar_swc_vme_rtARID_DEF.NvM_Set_SteerAngOffsetInit autosar_swc_vme_rtARID_DEF.PsiDtOpt autosar_swc_vme_rtARID_DEF.Switch autosar_swc_vme_rtARID_DEF.VxvRef_ms autosar_swc_vme_rtARID_DEF.ayvRef_ms2 autosar_swc_vme_rtARID_DEF.kapTraj /end REF_MEASUREMENT
/end GROUP
/begin GROUP autosar_swc_vme_autosar_swc_vme_Step_sys_Enabled_Subsystem_Subsystem_vie_Counter_Limited "autosar_swc_vme/autosar_swc_vme_Step_sys/Enabled\nSubsystem/Subsystem/vie/Counter\nLimited"
 /begin SUB_GROUP autosar_swc_vme_autosar_swc_vme_Step_sys_Enabled_Subsystem_Subsystem_vie_Counter_Limited_Increment_Real_World /end SUB_GROUP
 /begin REF_MEASUREMENT VME_UpdateCnt_VIE autosar_swc_vme_rtARID_DEF.Output_DSTATE_h /end REF_MEASUREMENT
/end GROUP
/begin GROUP autosar_swc_vme_autosar_swc_vme_Step_sys_Enabled_Subsystem_Subsystem_vie_Counter_Limited_Increment_Real_World "autosar_swc_vme/autosar_swc_vme_Step_sys/Enabled\nSubsystem/Subsystem/vie/Counter\nLimited/Increment\nReal World" /begin REF_MEASUREMENT VME_UpdateCnt_VIE /end REF_MEASUREMENT /end GROUP
/begin GROUP autosar_swc_vme_autosar_swc_vme_Step_sys_Enabled_Subsystem_Subsystem_vie_Subsystem "autosar_swc_vme/autosar_swc_vme_Step_sys/Enabled\nSubsystem/Subsystem/vie/Subsystem"
 /begin SUB_GROUP autosar_swc_vme_autosar_swc_vme_Step_sys_Enabled_Subsystem_Subsystem_vie_Subsystem_Compare_To_Constant3 /end SUB_GROUP
 /begin REF_MEASUREMENT autosar_swc_vme_rtARID_DEF.AND /end REF_MEASUREMENT
/end GROUP
/begin GROUP autosar_swc_vme_autosar_swc_vme_Step_sys_Enabled_Subsystem_Subsystem_vie_Subsystem_Compare_To_Constant3 "autosar_swc_vme/autosar_swc_vme_Step_sys/Enabled\nSubsystem/Subsystem/vie/Subsystem/Compare\nTo Constant3" /begin REF_CHARACTERISTIC P_VIE_RollingBackSpd /end REF_CHARACTERISTIC /end GROUP
/begin GROUP autosar_swc_vme_autosar_swc_vme_Step_sys_Enabled_Subsystem_Subsystem_vie_vie_axRef "autosar_swc_vme/autosar_swc_vme_Step_sys/Enabled\nSubsystem/Subsystem/vie/vie_axRef"
 /begin SUB_GROUP autosar_swc_vme_autosar_swc_vme_Step_sys_Enabled_Subsystem_Subsystem_vie_vie_axRef_Compare_To_Constant /end SUB_GROUP
 /begin REF_CHARACTERISTIC P_VME_FiltaxvRoadSlopeData P_VME_FiltaxvRoadSlopebreakpoint P_VME_axvRoadSlopeSaturation /end REF_CHARACTERISTIC
 /begin REF_MEASUREMENT autosar_swc_vme_rtARID_DEF.Ax autosar_swc_vme_rtARID_DEF.AxRefDt autosar_swc_vme_rtARID_DEF.Memory2_PreviousInput_a autosar_swc_vme_rtARID_DEF.Memory3_PreviousInput autosar_swc_vme_rtARID_DEF.Memory4_PreviousInput autosar_swc_vme_rtARID_DEF.Memory5_PreviousInput autosar_swc_vme_rtARID_DEF.Memory6_PreviousInput autosar_swc_vme_rtARID_DEF.Memory_PreviousInput autosar_swc_vme_rtARID_DEF.PsiDtOpt autosar_swc_vme_rtARID_DEF.Switch autosar_swc_vme_rtARID_DEF.TappedDelay_X_c autosar_swc_vme_rtARID_DEF.VxvRef_ms /end REF_MEASUREMENT
/end GROUP
/begin GROUP autosar_swc_vme_autosar_swc_vme_Step_sys_Enabled_Subsystem_Subsystem_vie_vie_axRef_Compare_To_Constant "autosar_swc_vme/autosar_swc_vme_Step_sys/Enabled\nSubsystem/Subsystem/vie/vie_axRef/Compare\nTo Constant" /begin REF_CHARACTERISTIC P_VME_axvRoadSlopeSaturation /end REF_CHARACTERISTIC /end GROUP
/begin GROUP autosar_swc_vme_autosar_swc_vme_Step_sys_Enabled_Subsystem_Subsystem_vie_vie_kapTraj "autosar_swc_vme/autosar_swc_vme_Step_sys/Enabled\nSubsystem/Subsystem/vie/vie_kapTraj"
 /begin REF_MEASUREMENT autosar_swc_vme_rtARID_DEF.PsiDtOpt autosar_swc_vme_rtARID_DEF.VxvRef_ms autosar_swc_vme_rtARID_DEF.kapTraj /end REF_MEASUREMENT
/end GROUP
/begin GROUP autosar_swc_vme_autosar_swc_vme_Step_sys_Enabled_Subsystem_Subsystem_vie_vie_latCalc "autosar_swc_vme/autosar_swc_vme_Step_sys/Enabled\nSubsystem/Subsystem/vie/vie_latCalc"
 /begin REF_MEASUREMENT autosar_swc_vme_rtARID_DEF.AlpSideSlipAngle autosar_swc_vme_rtARID_DEF.Memory1_PreviousInput_e autosar_swc_vme_rtARID_DEF.Memory2_PreviousInput autosar_swc_vme_rtARID_DEF.Memory3_PreviousInput_g autosar_swc_vme_rtARID_DEF.Memory4_PreviousInput_p autosar_swc_vme_rtARID_DEF.Memory5_PreviousInput_p autosar_swc_vme_rtARID_DEF.Memory_PreviousInput_e autosar_swc_vme_rtARID_DEF.PsiDtOpt autosar_swc_vme_rtARID_DEF.TappedDelay_X_o autosar_swc_vme_rtARID_DEF.VxvRef_ms autosar_swc_vme_rtARID_DEF.ayvRef_ms2 /end REF_MEASUREMENT
/end GROUP
/begin GROUP autosar_swc_vme_autosar_swc_vme_Step_sys_Enabled_Subsystem_Subsystem_vie_vie_steerAngleDeg "autosar_swc_vme/autosar_swc_vme_Step_sys/Enabled\nSubsystem/Subsystem/vie/vie_steerAngleDeg"
 /begin SUB_GROUP autosar_swc_vme_autosar_swc_vme_Step_sys_Enabled_Subsystem_Subsystem_vie_vie_steerAngleDeg_Compare_To_Constant4 autosar_swc_vme_autosar_swc_vme_Step_sys_Enabled_Subsystem_Subsystem_vie_vie_steerAngleDeg_Compare_To_Constant5 /end SUB_GROUP
 /begin REF_MEASUREMENT autosar_swc_vme_rtARID_DEF.DataTypeConversion autosar_swc_vme_rtARID_DEF.Memory52_PreviousInput autosar_swc_vme_rtARID_DEF.PsiDtOpt autosar_swc_vme_rtARID_DEF.T autosar_swc_vme_rtARID_DEF.TappedDelay4_X autosar_swc_vme_rtARID_DEF.UnitDelay1_DSTATE autosar_swc_vme_rtARID_DEF.UnitDelay_DSTATE_e autosar_swc_vme_rtARID_DEF.VxvRef_ms /end REF_MEASUREMENT
/end GROUP
/begin GROUP autosar_swc_vme_autosar_swc_vme_Step_sys_Enabled_Subsystem_Subsystem_vie_vie_steerAngleDeg_Compare_To_Constant4 "autosar_swc_vme/autosar_swc_vme_Step_sys/Enabled\nSubsystem/Subsystem/vie/vie_steerAngleDeg/Compare\nTo Constant4" /begin REF_MEASUREMENT autosar_swc_vme_rtARID_DEF.VxvRef_ms /end REF_MEASUREMENT /end GROUP
/begin GROUP autosar_swc_vme_autosar_swc_vme_Step_sys_Enabled_Subsystem_Subsystem_vie_vie_steerAngleDeg_Compare_To_Constant5 "autosar_swc_vme/autosar_swc_vme_Step_sys/Enabled\nSubsystem/Subsystem/vie/vie_steerAngleDeg/Compare\nTo Constant5" /begin REF_MEASUREMENT autosar_swc_vme_rtARID_DEF.VxvRef_ms /end REF_MEASUREMENT /end GROUP
/begin GROUP autosar_swc_vme_autosar_swc_vme_Step_sys_Enabled_Subsystem_Subsystem_vie_vie_vxvRefCalc "autosar_swc_vme/autosar_swc_vme_Step_sys/Enabled\nSubsystem/Subsystem/vie/vie_vxvRefCalc"
 /begin REF_MEASUREMENT autosar_swc_vme_rtARID_DEF.Memory1_PreviousInput autosar_swc_vme_rtARID_DEF.Memory21_PreviousInput autosar_swc_vme_rtARID_DEF.Memory22_PreviousInput autosar_swc_vme_rtARID_DEF.Memory23_PreviousInput autosar_swc_vme_rtARID_DEF.Memory24_PreviousInput autosar_swc_vme_rtARID_DEF.Memory25_PreviousInput autosar_swc_vme_rtARID_DEF.Memory26_PreviousInput autosar_swc_vme_rtARID_DEF.Memory27_PreviousInput autosar_swc_vme_rtARID_DEF.Memory28_PreviousInput autosar_swc_vme_rtARID_DEF.Memory29_PreviousInput autosar_swc_vme_rtARID_DEF.Memory2_PreviousInput_g autosar_swc_vme_rtARID_DEF.Memory30_PreviousInput autosar_swc_vme_rtARID_DEF.Memory31_PreviousInput autosar_swc_vme_rtARID_DEF.Memory33_PreviousInput autosar_swc_vme_rtARID_DEF.Memory34_PreviousInput autosar_swc_vme_rtARID_DEF.Memory36_PreviousInput autosar_swc_vme_rtARID_DEF.Memory38_PreviousInput autosar_swc_vme_rtARID_DEF.Memory39_PreviousInput autosar_swc_vme_rtARID_DEF.PsiDtOpt autosar_swc_vme_rtARID_DEF.TappedDelay1_X autosar_swc_vme_rtARID_DEF.TappedDelay2_X autosar_swc_vme_rtARID_DEF.TappedDelay3_X autosar_swc_vme_rtARID_DEF.TappedDelay8_X autosar_swc_vme_rtARID_DEF.TappedDelay_X autosar_swc_vme_rtARID_DEF.UnitDelay_DSTATE autosar_swc_vme_rtARID_DEF.VxvRef_ms autosar_swc_vme_rtARID_DEF.vxvRefRaw /end REF_MEASUREMENT
/end GROUP
/begin GROUP autosar_swc_vme_autosar_swc_vme_Step_sys_Subsystem "autosar_swc_vme/autosar_swc_vme_Step_sys/Subsystem"
 /begin SUB_GROUP autosar_swc_vme_autosar_swc_vme_Step_sys_Subsystem_Detect_Change /end SUB_GROUP
/end GROUP
/begin GROUP autosar_swc_vme_autosar_swc_vme_Step_sys_Subsystem_Detect_Change "autosar_swc_vme/autosar_swc_vme_Step_sys/Subsystem/Detect\nChange" /begin REF_MEASUREMENT autosar_swc_vme_rtARID_DEF.DelayInput1_DSTATE /end REF_MEASUREMENT /end GROUP
/begin GROUP autosar_swc_vme_rtARID_DEF.TmpSignalConversionAtVAL_VEHICLE_STATEOutport1 ""
 /begin REF_MEASUREMENT autosar_swc_vme_rtARID_DEF.TmpSignalConversionAtVAL_VEHICLE_STATEOutport1.VehStandstill autosar_swc_vme_rtARID_DEF.TmpSignalConversionAtVAL_VEHICLE_STATEOutport1.EngineOn autosar_swc_vme_rtARID_DEF.TmpSignalConversionAtVAL_VEHICLE_STATEOutport1.FAShiftInProgress autosar_swc_vme_rtARID_DEF.TmpSignalConversionAtVAL_VEHICLE_STATEOutport1.RAShiftInProgress autosar_swc_vme_rtARID_DEF.TmpSignalConversionAtVAL_VEHICLE_STATEOutport1.NoBrakeForce autosar_swc_vme_rtARID_DEF.TmpSignalConversionAtVAL_VEHICLE_STATEOutport1.VLC_InternalTargetAccelerationValid autosar_swc_vme_rtARID_DEF.TmpSignalConversionAtVAL_VEHICLE_STATEOutport1.BlindTemp autosar_swc_vme_rtARID_DEF.TmpSignalConversionAtVAL_VEHICLE_STATEOutport1.WheelPulseCounterValid autosar_swc_vme_rtARID_DEF.TmpSignalConversionAtVAL_VEHICLE_STATEOutport1.CurrentGear autosar_swc_vme_rtARID_DEF.TmpSignalConversionAtVAL_VEHICLE_STATEOutport1.TargetGear autosar_swc_vme_rtARID_DEF.TmpSignalConversionAtVAL_VEHICLE_STATEOutport1.GearSts autosar_swc_vme_rtARID_DEF.TmpSignalConversionAtVAL_VEHICLE_STATEOutport1.SysPowerMod autosar_swc_vme_rtARID_DEF.TmpSignalConversionAtVAL_VEHICLE_STATEOutport1.IPVehSpdUnit autosar_swc_vme_rtARID_DEF.TmpSignalConversionAtVAL_VEHICLE_STATEOutport1.IPVehSpdDispKph autosar_swc_vme_rtARID_DEF.TmpSignalConversionAtVAL_VEHICLE_STATEOutport1.IPVehSpdDispMph autosar_swc_vme_rtARID_DEF.TmpSignalConversionAtVAL_VEHICLE_STATEOutport1.FourWhlsBrkTrq autosar_swc_vme_rtARID_DEF.TmpSignalConversionAtVAL_VEHICLE_STATEOutport1.MaxEngTrqNorm autosar_swc_vme_rtARID_DEF.TmpSignalConversionAtVAL_VEHICLE_STATEOutport1.VehSpdKph autosar_swc_vme_rtARID_DEF.TmpSignalConversionAtVAL_VEHICLE_STATEOutport1.IPVehSpdDispKphFloat autosar_swc_vme_rtARID_DEF.TmpSignalConversionAtVAL_VEHICLE_STATEOutport1.SteerWheelAngle autosar_swc_vme_rtARID_DEF.TmpSignalConversionAtVAL_VEHICLE_STATEOutport1.SteerWheelSpd autosar_swc_vme_rtARID_DEF.TmpSignalConversionAtVAL_VEHICLE_STATEOutport1.SteerWheelTor autosar_swc_vme_rtARID_DEF.TmpSignalConversionAtVAL_VEHICLE_STATEOutport1.MasterCylBrkPress autosar_swc_vme_rtARID_DEF.TmpSignalConversionAtVAL_VEHICLE_STATEOutport1.WheelTrqNm autosar_swc_vme_rtARID_DEF.TmpSignalConversionAtVAL_VEHICLE_STATEOutport1.WheelTrqMinNm autosar_swc_vme_rtARID_DEF.TmpSignalConversionAtVAL_VEHICLE_STATEOutport1.VCUTrqNm autosar_swc_vme_rtARID_DEF.TmpSignalConversionAtVAL_VEHICLE_STATEOutport1.EngTrqNm autosar_swc_vme_rtARID_DEF.TmpSignalConversionAtVAL_VEHICLE_STATEOutport1.EngTrqMinNm autosar_swc_vme_rtARID_DEF.TmpSignalConversionAtVAL_VEHICLE_STATEOutport1.LKACtrDlvdValue autosar_swc_vme_rtARID_DEF.TmpSignalConversionAtVAL_VEHICLE_STATEOutport1.NetEngTrq autosar_swc_vme_rtARID_DEF.TmpSignalConversionAtVAL_VEHICLE_STATEOutport1.EngTrqMinAct autosar_swc_vme_rtARID_DEF.TmpSignalConversionAtVAL_VEHICLE_STATEOutport1.EngSpd autosar_swc_vme_rtARID_DEF.TmpSignalConversionAtVAL_VEHICLE_STATEOutport1.FLWheelSpdMps autosar_swc_vme_rtARID_DEF.TmpSignalConversionAtVAL_VEHICLE_STATEOutport1.FRWheelSpdMps autosar_swc_vme_rtARID_DEF.TmpSignalConversionAtVAL_VEHICLE_STATEOutport1.RLWheelSpdMps autosar_swc_vme_rtARID_DEF.TmpSignalConversionAtVAL_VEHICLE_STATEOutport1.RRWheelSpdMps autosar_swc_vme_rtARID_DEF.TmpSignalConversionAtVAL_VEHICLE_STATEOutport1.SensorVehYawRateRadps autosar_swc_vme_rtARID_DEF.TmpSignalConversionAtVAL_VEHICLE_STATEOutport1.SensorVehLonAccelMps2 autosar_swc_vme_rtARID_DEF.TmpSignalConversionAtVAL_VEHICLE_STATEOutport1.SensorVehLatAccelMps2 autosar_swc_vme_rtARID_DEF.TmpSignalConversionAtVAL_VEHICLE_STATEOutport1.VLC_InternalTargetAcceleration autosar_swc_vme_rtARID_DEF.TmpSignalConversionAtVAL_VEHICLE_STATEOutport1.TotalOdometer_km autosar_swc_vme_rtARID_DEF.TmpSignalConversionAtVAL_VEHICLE_STATEOutport1.FLWheelPulseCounter autosar_swc_vme_rtARID_DEF.TmpSignalConversionAtVAL_VEHICLE_STATEOutport1.FRWheelPulseCounter autosar_swc_vme_rtARID_DEF.TmpSignalConversionAtVAL_VEHICLE_STATEOutport1.RLWheelPulseCounter autosar_swc_vme_rtARID_DEF.TmpSignalConversionAtVAL_VEHICLE_STATEOutport1.RRWheelPulseCounter autosar_swc_vme_rtARID_DEF.TmpSignalConversionAtVAL_VEHICLE_STATEOutport1.TimeStampMs /end REF_MEASUREMENT
/end GROUP
/begin CHARACTERISTIC C_LongCtrl_0_Single "" VALUE 0xfe505598 /* @ECU_Address@C_LongCtrl_0_Single@ */ Record_FLOAT32_IEEE 0 autosar_swc_vmp_CM_single -3.4E+38 3.4E+38 /end CHARACTERISTIC
/begin CHARACTERISTIC P_LONP_ACCStsValue "" VALUE 0xfe829504 /* @ECU_Address@P_LONP_ACCStsValue@ */ Record_UBYTE 0 autosar_swc_vmp_CM_uint8 0 255 /end CHARACTERISTIC
/begin CHARACTERISTIC P_LONP_AccJerkDriveLimit "" VALUE 0xfe829170 /* @ECU_Address@P_LONP_AccJerkDriveLimit@ */ Record_FLOAT32_IEEE 0 autosar_swc_vmp_CM_single -3.4E+38 3.4E+38 /end CHARACTERISTIC
/begin CHARACTERISTIC P_LONP_AccJerkDriveOffLimit "" VALUE 0xfe829174 /* @ECU_Address@P_LONP_AccJerkDriveOffLimit@ */ Record_FLOAT32_IEEE 0 autosar_swc_vmp_CM_single -3.4E+38 3.4E+38 /end CHARACTERISTIC
/begin CHARACTERISTIC P_LONP_DecelJerkByvxvRefYAxis "" CURVE 0xfe829574 /* @ECU_Address@P_LONP_DecelJerkByvxvRefYAxis@ */ Record_FLOAT32_IEEE 0 autosar_swc_vmp_CM_single -3.4E+38 3.4E+38
 /begin AXIS_DESCR COM_AXIS autosar_swc_vmp_rtARID_DEF.TmpSignalConversionAtvxvRefMsOutport1 autosar_swc_vmp_CM_single 4 -3.4E+38 3.4E+38 AXIS_PTS_REF P_LONP_vxvRefFordecelJerkXAxis /end AXIS_DESCR
/end CHARACTERISTIC
/begin CHARACTERISTIC P_LONP_DelayTime "" VALUE 0xfe82922c /* @ECU_Address@P_LONP_DelayTime@ */ Record_FLOAT32_IEEE 0 autosar_swc_vmp_CM_single_s 0.000000 5.000000 /end CHARACTERISTIC
/begin CHARACTERISTIC P_LONP_FailureEnable "" VALUE 0xfe829509 /* @ECU_Address@P_LONP_FailureEnable@ */ Record_BOOLEAN 0 autosar_swc_vmp_CM_boolean 0 1 /end CHARACTERISTIC
/begin CHARACTERISTIC P_LONP_Filter_SW "" VALUE 0xfe82950a /* @ECU_Address@P_LONP_Filter_SW@ */ Record_UBYTE 0 autosar_swc_vmp_CM_uint8 0 255 /end CHARACTERISTIC
/begin CHARACTERISTIC P_LONP_StepTime "" VALUE 0xfe829420 /* @ECU_Address@P_LONP_StepTime@ */ Record_FLOAT32_IEEE 0 autosar_swc_vmp_CM_single_s 0.000000 0.100000 /end CHARACTERISTIC
/begin CHARACTERISTIC P_LONP_WaitTimeValue "" VALUE 0xfe82951b /* @ECU_Address@P_LONP_WaitTimeValue@ */ Record_UBYTE 0 autosar_swc_vmp_CM_uint8 0 255 /end CHARACTERISTIC
/begin CHARACTERISTIC P_VMP_BfObjCorrectThresholdDX "" VALUE 0xfe82948c /* @ECU_Address@P_VMP_BfObjCorrectThresholdDX@ */ Record_FLOAT32_IEEE 0 autosar_swc_vmp_CM_single 0.000000 200.000000 /end CHARACTERISTIC
/begin CHARACTERISTIC P_VMP_ConstrainCheckTime "" VALUE 0xfe829490 /* @ECU_Address@P_VMP_ConstrainCheckTime@ */ Record_FLOAT32_IEEE 0 autosar_swc_vmp_CM_single 0.000000 200.000000 /end CHARACTERISTIC
/begin CHARACTERISTIC P_VMP_CurveLaneActiveMaxOffsetDy "" VALUE 0xfe829494 /* @ECU_Address@P_VMP_CurveLaneActiveMaxOffsetDy@ */ Record_FLOAT32_IEEE 0 autosar_swc_vmp_CM_single 0.000000 200.000000 /end CHARACTERISTIC
/begin CHARACTERISTIC P_VMP_DOPCheckExitSwitch "" VALUE 0xfe829521 /* @ECU_Address@P_VMP_DOPCheckExitSwitch@ */ Record_BOOLEAN 0 autosar_swc_vmp_CM_boolean 0 1 /end CHARACTERISTIC
/begin CHARACTERISTIC P_VMP_DOPDyOffset "" VALUE 0xfe829498 /* @ECU_Address@P_VMP_DOPDyOffset@ */ Record_FLOAT32_IEEE 0 autosar_swc_vmp_CM_single 0.000000 10.000000 /end CHARACTERISTIC
/begin CHARACTERISTIC P_VMP_DOPDyOffsetChangeLim "" VALUE 0xfe82949c /* @ECU_Address@P_VMP_DOPDyOffsetChangeLim@ */ Record_FLOAT32_IEEE 0 autosar_swc_vmp_CM_single 0.000000 10.000000 /end CHARACTERISTIC
/begin CHARACTERISTIC P_VMP_DOPPredictTime "" VALUE 0xfe8294a0 /* @ECU_Address@P_VMP_DOPPredictTime@ */ Record_FLOAT32_IEEE 0 autosar_swc_vmp_CM_single_s 0.000000 5.000000 /end CHARACTERISTIC
/begin CHARACTERISTIC P_VMP_DOPThetaOffset "" VALUE 0xfe8294a4 /* @ECU_Address@P_VMP_DOPThetaOffset@ */ Record_FLOAT32_IEEE 0 autosar_swc_vmp_CM_single 0.000000 5.000000 /end CHARACTERISTIC
/begin CHARACTERISTIC P_VMP_DPC_DPCValue2DX "" CURVE 0xfe829954 /* @ECU_Address@P_VMP_DPC_DPCValue2DX@ */ Record_FLOAT32_IEEE 0 autosar_swc_vmp_CM_single 0.000000 200.000000
 /begin AXIS_DESCR COM_AXIS VMP_obj_select_front_Min_Dx autosar_swc_vmp_CM_single 4 0.000000 200.000000 AXIS_PTS_REF P_VMP_DPC_DXValue /end AXIS_DESCR
/end CHARACTERISTIC
/begin CHARACTERISTIC P_VMP_DPC_DPCValue2DX_After "" CURVE 0xfe829964 /* @ECU_Address@P_VMP_DPC_DPCValue2DX_After@ */ Record_FLOAT32_IEEE 0 autosar_swc_vmp_CM_single 0.000000 200.000000
 /begin AXIS_DESCR COM_AXIS NO_INPUT_QUANTITY autosar_swc_vmp_CM_single 4 0.000000 200.000000 AXIS_PTS_REF P_VMP_DPC_DXValue /end AXIS_DESCR
/end CHARACTERISTIC
/begin CHARACTERISTIC P_VMP_DPC_DPCValue2TTC "" CURVE 0xfe829974 /* @ECU_Address@P_VMP_DPC_DPCValue2TTC@ */ Record_FLOAT32_IEEE 0 autosar_swc_vmp_CM_single 0.000000 200.000000
 /begin AXIS_DESCR COM_AXIS VMP_obj_select_front_Min_TTC autosar_swc_vmp_CM_single 4 0.000000 200.000000 AXIS_PTS_REF P_VMP_DPC_TTCValue /end AXIS_DESCR
/end CHARACTERISTIC
/begin CHARACTERISTIC P_VMP_DPC_DPCValue2TTC_After "" CURVE 0xfe829984 /* @ECU_Address@P_VMP_DPC_DPCValue2TTC_After@ */ Record_FLOAT32_IEEE 0 autosar_swc_vmp_CM_single 0.000000 200.000000
 /begin AXIS_DESCR COM_AXIS VMP_obj_select_back_Min_TTC autosar_swc_vmp_CM_single 4 0.000000 200.000000 AXIS_PTS_REF P_VMP_DPC_TTCValue /end AXIS_DESCR
/end CHARACTERISTIC
/begin CHARACTERISTIC P_VMP_DPC_VehpresictTime "" VALUE 0xfe8294a8 /* @ECU_Address@P_VMP_DPC_VehpresictTime@ */ Record_FLOAT32_IEEE 0 autosar_swc_vmp_CM_single 0.000000 200.000000 /end CHARACTERISTIC
/begin CHARACTERISTIC P_VMP_DriveOffCount "" VALUE 0xfe829522 /* @ECU_Address@P_VMP_DriveOffCount@ */ Record_UBYTE 0 autosar_swc_vmp_CM_uint8 0.000000 255.000000 /end CHARACTERISTIC
/begin CHARACTERISTIC P_VMP_DriveOffaxvlim "" VALUE 0xfe8294ac /* @ECU_Address@P_VMP_DriveOffaxvlim@ */ Record_FLOAT32_IEEE 0 autosar_swc_vmp_CM_single -5.000000 5.000000 /end CHARACTERISTIC
/begin CHARACTERISTIC P_VMP_DriveOffspeed "" VALUE 0xfe8294b0 /* @ECU_Address@P_VMP_DriveOffspeed@ */ Record_FLOAT32_IEEE 0 autosar_swc_vmp_CM_single 0.000000 10.000000 /end CHARACTERISTIC
/begin CHARACTERISTIC P_VMP_LCInsReadTime "" VALUE 0xfe8294b4 /* @ECU_Address@P_VMP_LCInsReadTime@ */ Record_FLOAT32_IEEE 0 autosar_swc_vmp_CM_single 0.000000 200.000000 /end CHARACTERISTIC
/begin CHARACTERISTIC P_VMP_LCReadTime "" VALUE 0xfe8294b8 /* @ECU_Address@P_VMP_LCReadTime@ */ Record_FLOAT32_IEEE 0 autosar_swc_vmp_CM_single 0.000000 200.000000 /end CHARACTERISTIC
/begin CHARACTERISTIC P_VMP_LaneCheckActiveCenterDyTime "" VALUE 0xfe8294bc /* @ECU_Address@P_VMP_LaneCheckActiveCenterDyTime@ */ Record_FLOAT32_IEEE 0 autosar_swc_vmp_CM_single 0.000000 10.000000 /end CHARACTERISTIC
/begin CHARACTERISTIC P_VMP_LaneCheckActiveCenterDyValue "" VALUE 0xfe8294c0 /* @ECU_Address@P_VMP_LaneCheckActiveCenterDyValue@ */ Record_FLOAT32_IEEE 0 autosar_swc_vmp_CM_single -10.000000 10.000000 /end CHARACTERISTIC
/begin CHARACTERISTIC P_VMP_LaneCheckActiveFLWhelDyTime "" VALUE 0xfe8294c4 /* @ECU_Address@P_VMP_LaneCheckActiveFLWhelDyTime@ */ Record_FLOAT32_IEEE 0 autosar_swc_vmp_CM_single 0.000000 10.000000 /end CHARACTERISTIC
/begin CHARACTERISTIC P_VMP_LaneCheckActiveFLWhelDyValue "" VALUE 0xfe8294c8 /* @ECU_Address@P_VMP_LaneCheckActiveFLWhelDyValue@ */ Record_FLOAT32_IEEE 0 autosar_swc_vmp_CM_single -10.000000 10.000000 /end CHARACTERISTIC
/begin CHARACTERISTIC P_VMP_LaneCheckActiveFRWhelDyTime "" VALUE 0xfe8294cc /* @ECU_Address@P_VMP_LaneCheckActiveFRWhelDyTime@ */ Record_FLOAT32_IEEE 0 autosar_swc_vmp_CM_single 0.000000 10.000000 /end CHARACTERISTIC
/begin CHARACTERISTIC P_VMP_LaneCheckActiveFRWhelDyValue "" VALUE 0xfe8294d0 /* @ECU_Address@P_VMP_LaneCheckActiveFRWhelDyValue@ */ Record_FLOAT32_IEEE 0 autosar_swc_vmp_CM_single -10.000000 10.000000 /end CHARACTERISTIC
/begin CHARACTERISTIC P_VMP_LaneCheckActiveKapCPDisVldTime "" VALUE 0xfe8294d4 /* @ECU_Address@P_VMP_LaneCheckActiveKapCPDisVldTime@ */ Record_FLOAT32_IEEE 0 autosar_swc_vmp_CM_single 0.000000 10.000000 /end CHARACTERISTIC
/begin CHARACTERISTIC P_VMP_LaneCheckActiveTarLineC1ValidTime "" VALUE 0xfe8294d8 /* @ECU_Address@P_VMP_LaneCheckActiveTarLineC1ValidTime@ */ Record_FLOAT32_IEEE 0 autosar_swc_vmp_CM_single 0.000000 10.000000 /end CHARACTERISTIC
/begin CHARACTERISTIC P_VMP_LaneCheckActiveTarLineC1Value "" VALUE 0xfe8294dc /* @ECU_Address@P_VMP_LaneCheckActiveTarLineC1Value@ */ Record_FLOAT32_IEEE 0 autosar_swc_vmp_CM_single -10.000000 100.000000 /end CHARACTERISTIC
/begin CHARACTERISTIC P_VMP_LaneCheckActiveTarLineVldTime "" VALUE 0xfe8294e0 /* @ECU_Address@P_VMP_LaneCheckActiveTarLineVldTime@ */ Record_FLOAT32_IEEE 0 autosar_swc_vmp_CM_single 0.000000 10.000000 /end CHARACTERISTIC
/begin CHARACTERISTIC P_VMP_LaneCheckActiveTarLineWidthTime "" VALUE 0xfe8294e4 /* @ECU_Address@P_VMP_LaneCheckActiveTarLineWidthTime@ */ Record_FLOAT32_IEEE 0 autosar_swc_vmp_CM_single 0.000000 10.000000 /end CHARACTERISTIC
/begin CHARACTERISTIC P_VMP_LaneCheckExitFLWhelDyValue "" VALUE 0xfe8294e8 /* @ECU_Address@P_VMP_LaneCheckExitFLWhelDyValue@ */ Record_FLOAT32_IEEE 0 autosar_swc_vmp_CM_single -10.000000 10.000000 /end CHARACTERISTIC
/begin CHARACTERISTIC P_VMP_LaneCheckExitFRWhelDyValue "" VALUE 0xfe8294ec /* @ECU_Address@P_VMP_LaneCheckExitFRWhelDyValue@ */ Record_FLOAT32_IEEE 0 autosar_swc_vmp_CM_single -10.000000 10.000000 /end CHARACTERISTIC
/begin CHARACTERISTIC P_VMP_LaneJumpCheckLimValue "" VALUE 0xfe8294f0 /* @ECU_Address@P_VMP_LaneJumpCheckLimValue@ */ Record_FLOAT32_IEEE 0 autosar_swc_vmp_CM_single 0.000000 10.000000 /end CHARACTERISTIC
/begin CHARACTERISTIC P_VMP_OverridelowspeedLim "" VALUE 0xfe8294f4 /* @ECU_Address@P_VMP_OverridelowspeedLim@ */ Record_FLOAT32_IEEE 0 autosar_swc_vmp_CM_single 0.000000 10.000000 /end CHARACTERISTIC
/begin CHARACTERISTIC P_VMP_SafeStopDebounceTime "" VALUE 0xfe8294f8 /* @ECU_Address@P_VMP_SafeStopDebounceTime@ */ Record_FLOAT32_IEEE 0 autosar_swc_vmp_CM_single 0.000000 200.000000 /end CHARACTERISTIC
/begin CHARACTERISTIC P_VMP_SafeStopEndDistLim "" VALUE 0xfe8294fc /* @ECU_Address@P_VMP_SafeStopEndDistLim@ */ Record_FLOAT32_IEEE 0 autosar_swc_vmp_CM_single 0.000000 200.000000 /end CHARACTERISTIC
/begin CHARACTERISTIC P_VMP_afterObjCorrectThresholdDX "" VALUE 0xfe829500 /* @ECU_Address@P_VMP_afterObjCorrectThresholdDX@ */ Record_FLOAT32_IEEE 0 autosar_swc_vmp_CM_single 0.000000 200.000000 /end CHARACTERISTIC
/begin MEASUREMENT LONP_FollowUpdate "" UBYTE autosar_swc_vmp_CM_boolean 0 0 0 1 ECU_ADDRESS 0xfe4cdb31 /* @ECU_Address@LONP_FollowUpdate@ */ /end MEASUREMENT
/begin MEASUREMENT LONP_accelAL "" FLOAT32_IEEE autosar_swc_vmp_CM_single 0 0 -3.4E+38 3.4E+38 ECU_ADDRESS 0xfe4cd85c /* @ECU_Address@LONP_accelAL@ */ /end MEASUREMENT
/begin MEASUREMENT SwcOut_LATP_HMI.InfoDispHMI "" UBYTE autosar_swc_vmp_CM_uint8 0 0 0 255 ECU_ADDRESS 0xfe4cd864 /* @ECU_Address@SwcOut_LATP_HMI.InfoDispHMI@ */ /end MEASUREMENT
/begin MEASUREMENT SwcOut_LATP_HMI.LcHazObjDangerLevel "" UBYTE autosar_swc_vmp_CM_uint8 0 0 0 255 LAYOUT COLUMN_DIR MATRIX_DIM 2 ECU_ADDRESS 0xfe4cd874 /* @ECU_Address@SwcOut_LATP_HMI.LcHazObjDangerLevel@ */ /end MEASUREMENT
/begin MEASUREMENT SwcOut_LATP_HMI.LcHazObjId "" ULONG autosar_swc_vmp_CM_uint32 0 0 0 4294967295 LAYOUT COLUMN_DIR MATRIX_DIM 2 ECU_ADDRESS 0xfe4cda78 /* @ECU_Address@SwcOut_LATP_HMI.LcHazObjId@ */ /end MEASUREMENT
/begin MEASUREMENT SwcOut_LATP_HMI.LcTarLocationDx "" FLOAT32_IEEE autosar_swc_vmp_CM_single 0 0 -3.4E+38 3.4E+38 ECU_ADDRESS 0xfe4cd868 /* @ECU_Address@SwcOut_LATP_HMI.LcTarLocationDx@ */ /end MEASUREMENT
/begin MEASUREMENT SwcOut_LATP_HMI.LcTarLocationDy "" FLOAT32_IEEE autosar_swc_vmp_CM_single 0 0 -3.4E+38 3.4E+38 ECU_ADDRESS 0xfe4cd86c /* @ECU_Address@SwcOut_LATP_HMI.LcTarLocationDy@ */ /end MEASUREMENT
/begin MEASUREMENT SwcOut_LATP_HMI.LcTarLocationHead "" FLOAT32_IEEE autosar_swc_vmp_CM_single 0 0 -3.4E+38 3.4E+38 ECU_ADDRESS 0xfe4cd870 /* @ECU_Address@SwcOut_LATP_HMI.LcTarLocationHead@ */ /end MEASUREMENT
/begin MEASUREMENT SwcOut_LATP_HMI.LcTarPathPointX "" FLOAT32_IEEE autosar_swc_vmp_CM_single 0 0 -3.4E+38 3.4E+38 LAYOUT COLUMN_DIR MATRIX_DIM 64 ECU_ADDRESS 0xfe4cd878 /* @ECU_Address@SwcOut_LATP_HMI.LcTarPathPointX@ */ /end MEASUREMENT
/begin MEASUREMENT SwcOut_LATP_HMI.LcTarPathPointY "" FLOAT32_IEEE autosar_swc_vmp_CM_single 0 0 -3.4E+38 3.4E+38 LAYOUT COLUMN_DIR MATRIX_DIM 64 ECU_ADDRESS 0xfe4cd978 /* @ECU_Address@SwcOut_LATP_HMI.LcTarPathPointY@ */ /end MEASUREMENT
/begin MEASUREMENT SwcOut_LONP_ACCPLAN.ACC_AccelerateJerk "" FLOAT32_IEEE autosar_swc_vmp_CM_single 0 0 -3.4E+38 3.4E+38 ECU_ADDRESS 0xfe4cda94 /* @ECU_Address@SwcOut_LONP_ACCPLAN.ACC_AccelerateJerk@ */ /end MEASUREMENT
/begin MEASUREMENT SwcOut_LONP_ACCPLAN.ACC_BrakePrefer "" UBYTE autosar_swc_vmp_CM_boolean 0 0 0 1 ECU_ADDRESS 0xfe4cda80 /* @ECU_Address@SwcOut_LONP_ACCPLAN.ACC_BrakePrefer@ */ /end MEASUREMENT
/begin MEASUREMENT SwcOut_LONP_ACCPLAN.ACC_DecelerateJerk "" FLOAT32_IEEE autosar_swc_vmp_CM_single 0 0 -3.4E+38 3.4E+38 ECU_ADDRESS 0xfe4cda90 /* @ECU_Address@SwcOut_LONP_ACCPLAN.ACC_DecelerateJerk@ */ /end MEASUREMENT
/begin MEASUREMENT SwcOut_LONP_ACCPLAN.ACC_axvCvAim "" FLOAT32_IEEE autosar_swc_vmp_CM_single 0 0 -3.4E+38 3.4E+38 ECU_ADDRESS 0xfe4cda84 /* @ECU_Address@SwcOut_LONP_ACCPLAN.ACC_axvCvAim@ */ /end MEASUREMENT
/begin MEASUREMENT SwcOut_LONP_ACCPLAN.ACC_axv_ComfortBandLowerValue "" FLOAT32_IEEE autosar_swc_vmp_CM_single 0 0 -3.4E+38 3.4E+38 ECU_ADDRESS 0xfe4cda88 /* @ECU_Address@SwcOut_LONP_ACCPLAN.ACC_axv_ComfortBandLowerValue@ */ /end MEASUREMENT
/begin MEASUREMENT SwcOut_LONP_ACCPLAN.ACC_axv_ComfortBandUpperValue "" FLOAT32_IEEE autosar_swc_vmp_CM_single 0 0 -3.4E+38 3.4E+38 ECU_ADDRESS 0xfe4cda8c /* @ECU_Address@SwcOut_LONP_ACCPLAN.ACC_axv_ComfortBandUpperValue@ */ /end MEASUREMENT
/begin MEASUREMENT SwcOut_LONP_ACCPLAN.CurvSpdLim "" FLOAT32_IEEE autosar_swc_vmp_CM_single 0 0 -3.4E+38 3.4E+38 ECU_ADDRESS 0xfe4cda98 /* @ECU_Address@SwcOut_LONP_ACCPLAN.CurvSpdLim@ */ /end MEASUREMENT
/begin MEASUREMENT SwcOut_LONP_ArbFlag "" UBYTE autosar_swc_vmp_CM_uint8 0 0 0 255 ECU_ADDRESS 0xfe4cdb33 /* @ECU_Address@SwcOut_LONP_ArbFlag@ */ /end MEASUREMENT
/begin MEASUREMENT SwcOut_LONP_DecelToStopReq "" UBYTE autosar_swc_vmp_CM_boolean 0 0 0 1 ECU_ADDRESS 0xfe4cdb34 /* @ECU_Address@SwcOut_LONP_DecelToStopReq@ */ /end MEASUREMENT
/begin MEASUREMENT SwcOut_LONP_HMI.ACC_LeTgtObjBarDisp "" UBYTE autosar_swc_vmp_CM_uint8 0 0 0 255 ECU_ADDRESS 0xfe4cda9f /* @ECU_Address@SwcOut_LONP_HMI.ACC_LeTgtObjBarDisp@ */ /end MEASUREMENT
/begin MEASUREMENT SwcOut_LONP_HMI.ACC_RiTgtObjBarDisp "" UBYTE autosar_swc_vmp_CM_uint8 0 0 0 255 ECU_ADDRESS 0xfe4cdaa0 /* @ECU_Address@SwcOut_LONP_HMI.ACC_RiTgtObjBarDisp@ */ /end MEASUREMENT
/begin MEASUREMENT SwcOut_LONP_HMI.ACC_TgtObjBarDisp "" UBYTE autosar_swc_vmp_CM_uint8 0 0 0 255 ECU_ADDRESS 0xfe4cda9e /* @ECU_Address@SwcOut_LONP_HMI.ACC_TgtObjBarDisp@ */ /end MEASUREMENT
/begin MEASUREMENT SwcOut_LONP_HMI.FollowGapPX "" FLOAT32_IEEE autosar_swc_vmp_CM_single 0 0 -3.4E+38 3.4E+38 ECU_ADDRESS 0xfe4cdab0 /* @ECU_Address@SwcOut_LONP_HMI.FollowGapPX@ */ /end MEASUREMENT
/begin MEASUREMENT SwcOut_LONP_HMI.FollowNumMatrix "" FLOAT32_IEEE autosar_swc_vmp_CM_single 0 0 -3.4E+38 3.4E+38 ECU_ADDRESS 0xfe4cdaac /* @ECU_Address@SwcOut_LONP_HMI.FollowNumMatrix@ */ /end MEASUREMENT
/begin MEASUREMENT SwcOut_LONP_HMI.FollowTTC "" FLOAT32_IEEE autosar_swc_vmp_CM_single 0 0 -3.4E+38 3.4E+38 ECU_ADDRESS 0xfe4cdaa8 /* @ECU_Address@SwcOut_LONP_HMI.FollowTTC@ */ /end MEASUREMENT
/begin MEASUREMENT SwcOut_LONP_HMI.FollowTTCAccel "" FLOAT32_IEEE autosar_swc_vmp_CM_single 0 0 -3.4E+38 3.4E+38 ECU_ADDRESS 0xfe4cdab4 /* @ECU_Address@SwcOut_LONP_HMI.FollowTTCAccel@ */ /end MEASUREMENT
/begin MEASUREMENT SwcOut_LONP_HMI.IDP0 "" UBYTE autosar_swc_vmp_CM_uint8 0 0 0 255 ECU_ADDRESS 0xfe4cdaa1 /* @ECU_Address@SwcOut_LONP_HMI.IDP0@ */ /end MEASUREMENT
/begin MEASUREMENT SwcOut_LONP_HMI.IDP1 "" UBYTE autosar_swc_vmp_CM_uint8 0 0 0 255 ECU_ADDRESS 0xfe4cdaa2 /* @ECU_Address@SwcOut_LONP_HMI.IDP1@ */ /end MEASUREMENT
/begin MEASUREMENT SwcOut_LONP_HMI.InsertSpceNum "" FLOAT32_IEEE autosar_swc_vmp_CM_single 0 0 -3.4E+38 3.4E+38 ECU_ADDRESS 0xfe4cdac0 /* @ECU_Address@SwcOut_LONP_HMI.InsertSpceNum@ */ /end MEASUREMENT
/begin MEASUREMENT SwcOut_LONP_HMI.InsertSpceNumLetgo "" FLOAT32_IEEE autosar_swc_vmp_CM_single 0 0 -3.4E+38 3.4E+38 ECU_ADDRESS 0xfe4cdabc /* @ECU_Address@SwcOut_LONP_HMI.InsertSpceNumLetgo@ */ /end MEASUREMENT
/begin MEASUREMENT SwcOut_LONP_HMI.InsertSpceSEnd "" FLOAT32_IEEE autosar_swc_vmp_CM_single 0 0 -3.4E+38 3.4E+38 ECU_ADDRESS 0xfe4cdac8 /* @ECU_Address@SwcOut_LONP_HMI.InsertSpceSEnd@ */ /end MEASUREMENT
/begin MEASUREMENT SwcOut_LONP_HMI.InsertSpceTEnd "" FLOAT32_IEEE autosar_swc_vmp_CM_single 0 0 -3.4E+38 3.4E+38 ECU_ADDRESS 0xfe4cdac4 /* @ECU_Address@SwcOut_LONP_HMI.InsertSpceTEnd@ */ /end MEASUREMENT
/begin MEASUREMENT SwcOut_LONP_HMI.InsertSpceVEnd "" FLOAT32_IEEE autosar_swc_vmp_CM_single 0 0 -3.4E+38 3.4E+38 ECU_ADDRESS 0xfe4cdacc /* @ECU_Address@SwcOut_LONP_HMI.InsertSpceVEnd@ */ /end MEASUREMENT
/begin MEASUREMENT SwcOut_LONP_HMI.IntelligentCurveActive "" UBYTE autosar_swc_vmp_CM_boolean 0 0 0 1 ECU_ADDRESS 0xfe4cda9d /* @ECU_Address@SwcOut_LONP_HMI.IntelligentCurveActive@ */ /end MEASUREMENT
/begin MEASUREMENT SwcOut_LONP_HMI.TakeoverReq "" UBYTE autosar_swc_vmp_CM_boolean 0 0 0 1 ECU_ADDRESS 0xfe4cda9c /* @ECU_Address@SwcOut_LONP_HMI.TakeoverReq@ */ /end MEASUREMENT
/begin MEASUREMENT SwcOut_LONP_HMI.TargetIDSwitch "" FLOAT32_IEEE autosar_swc_vmp_CM_single 0 0 -3.4E+38 3.4E+38 ECU_ADDRESS 0xfe4cdab8 /* @ECU_Address@SwcOut_LONP_HMI.TargetIDSwitch@ */ /end MEASUREMENT
/begin MEASUREMENT SwcOut_LONP_HMI.VehVelReqKap "" FLOAT32_IEEE autosar_swc_vmp_CM_single 0 0 -3.4E+38 3.4E+38 ECU_ADDRESS 0xfe4cdaa4 /* @ECU_Address@SwcOut_LONP_HMI.VehVelReqKap@ */ /end MEASUREMENT
/begin MEASUREMENT SwcOut_VMP_Herbeat_Info.inner_error "" ULONG autosar_swc_vmp_CM_uint32 0 0 0 4294967295 ECU_ADDRESS 0xfe4cdad4 /* @ECU_Address@SwcOut_VMP_Herbeat_Info.inner_error@ */ /end MEASUREMENT
/begin MEASUREMENT SwcOut_VMP_Herbeat_Info.module_status "" UBYTE autosar_swc_vmp_CM_SM_MODULE_STATUS 0 0 0 3 ECU_ADDRESS 0xfe4cdad8 /* @ECU_Address@SwcOut_VMP_Herbeat_Info.module_status@ */ /end MEASUREMENT
/begin MEASUREMENT SwcOut_VMP_Herbeat_Info.sequence_num "" UBYTE autosar_swc_vmp_CM_uint8 0 0 0 255 ECU_ADDRESS 0xfe4cdad1 /* @ECU_Address@SwcOut_VMP_Herbeat_Info.sequence_num@ */ /end MEASUREMENT
/begin MEASUREMENT SwcOut_VMP_Herbeat_Info.swc_id "" UBYTE autosar_swc_vmp_CM_uint8 0 0 0 255 ECU_ADDRESS 0xfe4cdad0 /* @ECU_Address@SwcOut_VMP_Herbeat_Info.swc_id@ */ /end MEASUREMENT
/begin MEASUREMENT SwcOut_VMP_STS.lat_ctrl_mod "" UBYTE autosar_swc_vmp_CM_uint8 0 0 0 255 ECU_ADDRESS 0xfe4cdae1 /* @ECU_Address@SwcOut_VMP_STS.lat_ctrl_mod@ */ /end MEASUREMENT
/begin MEASUREMENT SwcOut_VMP_STS.lat_pln_sts "" UBYTE autosar_swc_vmp_CM_uint8 0 0 0 255 ECU_ADDRESS 0xfe4cdade /* @ECU_Address@SwcOut_VMP_STS.lat_pln_sts@ */ /end MEASUREMENT
/begin MEASUREMENT SwcOut_VMP_STS.lc_exec_sts "" UBYTE autosar_swc_vmp_CM_uint8 0 0 0 255 ECU_ADDRESS 0xfe4cdae0 /* @ECU_Address@SwcOut_VMP_STS.lc_exec_sts@ */ /end MEASUREMENT
/begin MEASUREMENT SwcOut_VMP_STS.lc_failed_reason "" ULONG autosar_swc_vmp_CM_uint32 0 0 0 4294967295 ECU_ADDRESS 0xfe4cdae8 /* @ECU_Address@SwcOut_VMP_STS.lc_failed_reason@ */ /end MEASUREMENT
/begin MEASUREMENT SwcOut_VMP_STS.lc_feasibility_conds "" ULONG autosar_swc_vmp_CM_uint32 0 0 0 4294967295 ECU_ADDRESS 0xfe4cdaec /* @ECU_Address@SwcOut_VMP_STS.lc_feasibility_conds@ */ /end MEASUREMENT
/begin MEASUREMENT SwcOut_VMP_STS.lc_req_sync_id "" ULONG autosar_swc_vmp_CM_uint32 0 0 0 4294967295 ECU_ADDRESS 0xfe4cdae4 /* @ECU_Address@SwcOut_VMP_STS.lc_req_sync_id@ */ /end MEASUREMENT
/begin MEASUREMENT SwcOut_VMP_STS.lgt_drive_sts "" UBYTE autosar_swc_vmp_CM_uint8 0 0 0 255 ECU_ADDRESS 0xfe4cdadf /* @ECU_Address@SwcOut_VMP_STS.lgt_drive_sts@ */ /end MEASUREMENT
/begin MEASUREMENT SwcOut_VMP_STS.lgt_pln_sts "" UBYTE autosar_swc_vmp_CM_uint8 0 0 0 255 ECU_ADDRESS 0xfe4cdadd /* @ECU_Address@SwcOut_VMP_STS.lgt_pln_sts@ */ /end MEASUREMENT
/begin MEASUREMENT SwcOut_VMP_STS.nudge_exec_sts "" UBYTE autosar_swc_vmp_CM_uint8 0 0 0 255 ECU_ADDRESS 0xfe4cdae2 /* @ECU_Address@SwcOut_VMP_STS.nudge_exec_sts@ */ /end MEASUREMENT
/begin MEASUREMENT SwcOut_VMP_STS.pln_failed_reason "" ULONG autosar_swc_vmp_CM_uint32 0 0 0 4294967295 ECU_ADDRESS 0xfe4cdaf4 /* @ECU_Address@SwcOut_VMP_STS.pln_failed_reason@ */ /end MEASUREMENT
/begin MEASUREMENT SwcOut_VMP_STS.pln_inhibited_reason "" ULONG autosar_swc_vmp_CM_uint32 0 0 0 4294967295 ECU_ADDRESS 0xfe4cdaf0 /* @ECU_Address@SwcOut_VMP_STS.pln_inhibited_reason@ */ /end MEASUREMENT
/begin MEASUREMENT SwcOut_VMP_STS.pln_run_sts "" UBYTE autosar_swc_vmp_CM_uint8 0 0 0 255 ECU_ADDRESS 0xfe4cdadc /* @ECU_Address@SwcOut_VMP_STS.pln_run_sts@ */ /end MEASUREMENT
/begin MEASUREMENT SwcOut_VMP_TRAJ.ref_lane_id "" ULONG autosar_swc_vmp_CM_uint32 0 0 0 4294967295 ECU_ADDRESS 0xfe4cd7fc /* @ECU_Address@SwcOut_VMP_TRAJ.ref_lane_id@ */ /end MEASUREMENT
/begin MEASUREMENT SwcOut_VMP_TRAJ.st_poly.end "" FLOAT32_IEEE autosar_swc_vmp_CM_single 0 0 -3.4E+38 3.4E+38 ECU_ADDRESS 0xfe4cd804 /* @ECU_Address@SwcOut_VMP_TRAJ.st_poly.end@ */ /end MEASUREMENT
/begin MEASUREMENT SwcOut_VMP_TRAJ.st_poly.poly_vec "" FLOAT32_IEEE autosar_swc_vmp_CM_single 0 0 -3.4E+38 3.4E+38 LAYOUT COLUMN_DIR MATRIX_DIM 6 ECU_ADDRESS 0xfe4cd808 /* @ECU_Address@SwcOut_VMP_TRAJ.st_poly.poly_vec@ */ /end MEASUREMENT
/begin MEASUREMENT SwcOut_VMP_TRAJ.st_poly.start "" FLOAT32_IEEE autosar_swc_vmp_CM_single 0 0 -3.4E+38 3.4E+38 ECU_ADDRESS 0xfe4cd800 /* @ECU_Address@SwcOut_VMP_TRAJ.st_poly.start@ */ /end MEASUREMENT
/begin MEASUREMENT SwcOut_VMP_TRAJ.st_poly_valid "" UBYTE autosar_swc_vmp_CM_boolean 0 0 0 1 ECU_ADDRESS 0xfe4cd7f8 /* @ECU_Address@SwcOut_VMP_TRAJ.st_poly_valid@ */ /end MEASUREMENT
/begin MEASUREMENT SwcOut_VMP_TRAJ.updateCnt "" UBYTE autosar_swc_vmp_CM_uint8 0 0 0 255 ECU_ADDRESS 0xfe4cd7fa /* @ECU_Address@SwcOut_VMP_TRAJ.updateCnt@ */ /end MEASUREMENT
/begin MEASUREMENT SwcOut_VMP_TRAJ.xy_poly.end "" FLOAT32_IEEE autosar_swc_vmp_CM_single 0 0 -3.4E+38 3.4E+38 ECU_ADDRESS 0xfe4cd824 /* @ECU_Address@SwcOut_VMP_TRAJ.xy_poly.end@ */ /end MEASUREMENT
/begin MEASUREMENT SwcOut_VMP_TRAJ.xy_poly.poly_vec "" FLOAT32_IEEE autosar_swc_vmp_CM_single 0 0 -3.4E+38 3.4E+38 LAYOUT COLUMN_DIR MATRIX_DIM 6 ECU_ADDRESS 0xfe4cd828 /* @ECU_Address@SwcOut_VMP_TRAJ.xy_poly.poly_vec@ */ /end MEASUREMENT
/begin MEASUREMENT SwcOut_VMP_TRAJ.xy_poly.start "" FLOAT32_IEEE autosar_swc_vmp_CM_single 0 0 -3.4E+38 3.4E+38 ECU_ADDRESS 0xfe4cd820 /* @ECU_Address@SwcOut_VMP_TRAJ.xy_poly.start@ */ /end MEASUREMENT
/begin MEASUREMENT SwcOut_VMP_TRAJ.xy_poly_valid "" UBYTE autosar_swc_vmp_CM_boolean 0 0 0 1 ECU_ADDRESS 0xfe4cd7f9 /* @ECU_Address@SwcOut_VMP_TRAJ.xy_poly_valid@ */ /end MEASUREMENT
/begin MEASUREMENT VMP_ExecTimestamp.nanoseconds "" ULONG autosar_swc_vmp_CM_uint32 0 0 0 4294967295 ECU_ADDRESS 0xfe4cd844 /* @ECU_Address@VMP_ExecTimestamp.nanoseconds@ */ /end MEASUREMENT
/begin MEASUREMENT VMP_ExecTimestamp.seconds "" A_UINT64 autosar_swc_vmp_CM_uint64 0 0 0 18446744073709551615 ECU_ADDRESS 0xfe4cd848 /* @ECU_Address@VMP_ExecTimestamp.seconds@ */ /end MEASUREMENT
/begin MEASUREMENT VMP_ExecTimestamp.timeBaseStatus "" UBYTE autosar_swc_vmp_CM_uint8 0 0 0 255 ECU_ADDRESS 0xfe4cd840 /* @ECU_Address@VMP_ExecTimestamp.timeBaseStatus@ */ /end MEASUREMENT
/begin MEASUREMENT VMP_Nudge_Dis "" FLOAT32_IEEE autosar_swc_vmp_CM_single 0 0 -3.4E+38 3.4E+38 ECU_ADDRESS 0xfe4cdaf8 /* @ECU_Address@VMP_Nudge_Dis@ */ /end MEASUREMENT
/begin MEASUREMENT VMP_TarPathResk_F "" FLOAT32_IEEE autosar_swc_vmp_CM_single 0 0 -3.4E+38 3.4E+38 ECU_ADDRESS 0xfe4cdafc /* @ECU_Address@VMP_TarPathResk_F@ */ /end MEASUREMENT
/begin MEASUREMENT VMP_TarPathResk_R "" FLOAT32_IEEE autosar_swc_vmp_CM_single 0 0 -3.4E+38 3.4E+38 ECU_ADDRESS 0xfe4cdb00 /* @ECU_Address@VMP_TarPathResk_R@ */ /end MEASUREMENT
/begin MEASUREMENT VMP_UpdateCnt "" UBYTE autosar_swc_vmp_CM_uint8 0 0 0 255 ECU_ADDRESS 0xfe4cdb35 /* @ECU_Address@VMP_UpdateCnt@ */ /end MEASUREMENT
/begin MEASUREMENT VMP_Version "" ULONG autosar_swc_vmp_CM_uint32 0 0 0 4294967295 ECU_ADDRESS 0xfe4cdb04 /* @ECU_Address@VMP_Version@ */ /end MEASUREMENT
/begin MEASUREMENT VMP_forceCancelPathIndex "" UBYTE autosar_swc_vmp_CM_uint8 0 0 0 255 ECU_ADDRESS 0xfe4cdb36 /* @ECU_Address@VMP_forceCancelPathIndex@ */ /end MEASUREMENT
/begin MEASUREMENT VMP_lane_force_cancel_pass "" UBYTE autosar_swc_vmp_CM_boolean 0 0 0 1 ECU_ADDRESS 0xfe4cdb37 /* @ECU_Address@VMP_lane_force_cancel_pass@ */ /end MEASUREMENT
/begin MEASUREMENT VMP_lane_force_cancel_reason "" ULONG autosar_swc_vmp_CM_uint32 0 0 0 4294967295 ECU_ADDRESS 0xfe4cdb08 /* @ECU_Address@VMP_lane_force_cancel_reason@ */ /end MEASUREMENT
/begin MEASUREMENT VMP_lc_lane_cancel_pass "" UBYTE autosar_swc_vmp_CM_boolean 0 0 0 1 ECU_ADDRESS 0xfe4cdb38 /* @ECU_Address@VMP_lc_lane_cancel_pass@ */ /end MEASUREMENT
/begin MEASUREMENT VMP_lc_lane_cancel_reason "" ULONG autosar_swc_vmp_CM_uint32 0 0 0 4294967295 ECU_ADDRESS 0xfe4cdb0c /* @ECU_Address@VMP_lc_lane_cancel_reason@ */ /end MEASUREMENT
/begin MEASUREMENT VMP_lc_lane_chk_lm_pass "" UBYTE autosar_swc_vmp_CM_boolean 0 0 0 1 ECU_ADDRESS 0xfe4cdb39 /* @ECU_Address@VMP_lc_lane_chk_lm_pass@ */ /end MEASUREMENT
/begin MEASUREMENT VMP_lc_lane_chk_lm_reason "" ULONG autosar_swc_vmp_CM_uint32 0 0 0 4294967295 ECU_ADDRESS 0xfe4cdb10 /* @ECU_Address@VMP_lc_lane_chk_lm_reason@ */ /end MEASUREMENT
/begin MEASUREMENT VMP_lc_lane_chk_loose_pass "" UBYTE autosar_swc_vmp_CM_boolean 0 0 0 1 ECU_ADDRESS 0xfe4cdb3a /* @ECU_Address@VMP_lc_lane_chk_loose_pass@ */ /end MEASUREMENT
/begin MEASUREMENT VMP_lc_lane_chk_loose_reason "" ULONG autosar_swc_vmp_CM_uint32 0 0 0 4294967295 ECU_ADDRESS 0xfe4cdb14 /* @ECU_Address@VMP_lc_lane_chk_loose_reason@ */ /end MEASUREMENT
/begin MEASUREMENT VMP_obj_back_risk_id "" ULONG autosar_swc_vmp_CM_uint32 0 0 0 4294967295 ECU_ADDRESS 0xfe4cdb18 /* @ECU_Address@VMP_obj_back_risk_id@ */ /end MEASUREMENT
/begin MEASUREMENT VMP_obj_front_risk_id "" ULONG autosar_swc_vmp_CM_uint32 0 0 0 4294967295 ECU_ADDRESS 0xfe4cdb1c /* @ECU_Address@VMP_obj_front_risk_id@ */ /end MEASUREMENT
/begin MEASUREMENT VMP_obj_select_back_Max_Dx "" FLOAT32_IEEE autosar_swc_vmp_CM_single 0 0 -3.4E+38 3.4E+38 ECU_ADDRESS 0xfe4cdb20 /* @ECU_Address@VMP_obj_select_back_Max_Dx@ */ /end MEASUREMENT
/begin MEASUREMENT VMP_obj_select_back_Min_TTC "" FLOAT32_IEEE autosar_swc_vmp_CM_single 0 0 -3.4E+38 3.4E+38 ECU_ADDRESS 0xfe4cdb24 /* @ECU_Address@VMP_obj_select_back_Min_TTC@ */ /end MEASUREMENT
/begin MEASUREMENT VMP_obj_select_front_Min_Dx "" FLOAT32_IEEE autosar_swc_vmp_CM_single 0 0 -3.4E+38 3.4E+38 ECU_ADDRESS 0xfe4cdb28 /* @ECU_Address@VMP_obj_select_front_Min_Dx@ */ /end MEASUREMENT
/begin MEASUREMENT VMP_obj_select_front_Min_TTC "" FLOAT32_IEEE autosar_swc_vmp_CM_single 0 0 -3.4E+38 3.4E+38 ECU_ADDRESS 0xfe4cdb2c /* @ECU_Address@VMP_obj_select_front_Min_TTC@ */ /end MEASUREMENT
/begin MEASUREMENT VMP_veh_in_force_cancel_lane "" UBYTE autosar_swc_vmp_CM_uint8 0 0 0 255 ECU_ADDRESS 0xfe4cdb3b /* @ECU_Address@VMP_veh_in_force_cancel_lane@ */ /end MEASUREMENT
/begin MEASUREMENT VMP_veh_lc_pos "" UBYTE autosar_swc_vmp_CM_uint8 0 0 0 255 ECU_ADDRESS 0xfe4cdb3c /* @ECU_Address@VMP_veh_lc_pos@ */ /end MEASUREMENT
/begin MEASUREMENT autosar_swc_vmp_rtARID_DEF.ACCModeSts "" UBYTE autosar_swc_vmp_CM_uint8 0 0 0 255 ECU_ADDRESS 0xfe4d4234 /* @ECU_Address@autosar_swc_vmp_rtARID_DEF.ACCModeSts@ */ /end MEASUREMENT
/begin MEASUREMENT autosar_swc_vmp_rtARID_DEF.Cnt_m "" FLOAT64_IEEE autosar_swc_vmp_CM_double 0 0 -1.7E+308 1.7E+308 ECU_ADDRESS 0xfe4ce650 /* @ECU_Address@autosar_swc_vmp_rtARID_DEF.Cnt_m@ */ /end MEASUREMENT
/begin MEASUREMENT autosar_swc_vmp_rtARID_DEF.Compare_d "" UBYTE autosar_swc_vmp_CM_logical 0 0 0 1 MATRIX_DIM 1 1 ECU_ADDRESS 0xfe4d426c /* @ECU_Address@autosar_swc_vmp_rtARID_DEF.Compare_d@ */ /end MEASUREMENT
/begin MEASUREMENT autosar_swc_vmp_rtARID_DEF.FLWhelDyst "" FLOAT32_IEEE autosar_swc_vmp_CM_single 0 0 -3.4E+38 3.4E+38 ECU_ADDRESS 0xfe4d416c /* @ECU_Address@autosar_swc_vmp_rtARID_DEF.FLWhelDyst@ */ /end MEASUREMENT
/begin MEASUREMENT autosar_swc_vmp_rtARID_DEF.FRWhelDyst "" FLOAT32_IEEE autosar_swc_vmp_CM_single 0 0 -3.4E+38 3.4E+38 ECU_ADDRESS 0xfe4d4170 /* @ECU_Address@autosar_swc_vmp_rtARID_DEF.FRWhelDyst@ */ /end MEASUREMENT
/begin MEASUREMENT autosar_swc_vmp_rtARID_DEF.Memory5_PreviousInput "" FLOAT32_IEEE autosar_swc_vmp_CM_single 0 0 -3.4E+38 3.4E+38 ECU_ADDRESS 0xfe4d4120 /* @ECU_Address@autosar_swc_vmp_rtARID_DEF.Memory5_PreviousInput@ */ /end MEASUREMENT
/begin MEASUREMENT autosar_swc_vmp_rtARID_DEF.Output_DSTATE "" UBYTE autosar_swc_vmp_CM_uint8 0 0 0 255 ECU_ADDRESS 0xfe4d4237 /* @ECU_Address@autosar_swc_vmp_rtARID_DEF.Output_DSTATE@ */ /end MEASUREMENT
/begin MEASUREMENT autosar_swc_vmp_rtARID_DEF.Output_DSTATE_b "" UBYTE autosar_swc_vmp_CM_uint8 0 0 0 255 ECU_ADDRESS 0xfe4d423d /* @ECU_Address@autosar_swc_vmp_rtARID_DEF.Output_DSTATE_b@ */ /end MEASUREMENT
/begin MEASUREMENT autosar_swc_vmp_rtARID_DEF.SelectLaneIdx "" UBYTE autosar_swc_vmp_CM_uint8 0 0 0 255 ECU_ADDRESS 0xfe4d4236 /* @ECU_Address@autosar_swc_vmp_rtARID_DEF.SelectLaneIdx@ */ /end MEASUREMENT
/begin MEASUREMENT autosar_swc_vmp_rtARID_DEF.TappedDelay1_X_f "" UBYTE autosar_swc_vmp_CM_uint8 0 0 0 255 ECU_ADDRESS 0xfe4d423f /* @ECU_Address@autosar_swc_vmp_rtARID_DEF.TappedDelay1_X_f@ */ /end MEASUREMENT
/begin MEASUREMENT autosar_swc_vmp_rtARID_DEF.TappedDelay4_X_l "" UBYTE autosar_swc_vmp_CM_logical 0 0 0 1 ECU_ADDRESS 0xfe4d429d /* @ECU_Address@autosar_swc_vmp_rtARID_DEF.TappedDelay4_X_l@ */ /end MEASUREMENT
/begin MEASUREMENT autosar_swc_vmp_rtARID_DEF.TappedDelay_X_l "" UBYTE autosar_swc_vmp_CM_uint8 0 0 0 255 ECU_ADDRESS 0xfe4d4239 /* @ECU_Address@autosar_swc_vmp_rtARID_DEF.TappedDelay_X_l@ */ /end MEASUREMENT
/begin MEASUREMENT autosar_swc_vmp_rtARID_DEF.TarLine_lane_sourcek1 "" UBYTE autosar_swc_vmp_CM_uint8 0 0 0 255 ECU_ADDRESS 0xfe4d426b /* @ECU_Address@autosar_swc_vmp_rtARID_DEF.TarLine_lane_sourcek1@ */ /end MEASUREMENT
/begin MEASUREMENT autosar_swc_vmp_rtARID_DEF.TmpSignalConversionAtaxvRefMs2Outport1 "" FLOAT32_IEEE autosar_swc_vmp_CM_single 0 0 -3.4E+38 3.4E+38 ECU_ADDRESS 0xfe4d3fc0 /* @ECU_Address@autosar_swc_vmp_rtARID_DEF.TmpSignalConversionAtaxvRefMs2Outport1@ */ /end MEASUREMENT
/begin MEASUREMENT autosar_swc_vmp_rtARID_DEF.TmpSignalConversionAtvxvRefMsOutport1 "" FLOAT32_IEEE autosar_swc_vmp_CM_single 0 0 -3.4E+38 3.4E+38 ECU_ADDRESS 0xfe4d3fbc /* @ECU_Address@autosar_swc_vmp_rtARID_DEF.TmpSignalConversionAtvxvRefMsOutport1@ */ /end MEASUREMENT
/begin MEASUREMENT autosar_swc_vmp_rtARID_DEF.UnitDelay1 "" FLOAT32_IEEE autosar_swc_vmp_CM_single 0 0 -3.4E+38 3.4E+38 MATRIX_DIM 1 1 ECU_ADDRESS 0xfe4d3fc4 /* @ECU_Address@autosar_swc_vmp_rtARID_DEF.UnitDelay1@ */ /end MEASUREMENT
/begin MEASUREMENT autosar_swc_vmp_rtARID_DEF.UnitDelay1_DSTATE_am "" UWORD autosar_swc_vmp_CM_uint16 0 0 0 65535 ECU_ADDRESS 0xfe4d4210 /* @ECU_Address@autosar_swc_vmp_rtARID_DEF.UnitDelay1_DSTATE_am@ */ /end MEASUREMENT
/begin MEASUREMENT autosar_swc_vmp_rtARID_DEF.UnitDelay1_DSTATE_ao "" UWORD autosar_swc_vmp_CM_uint16 0 0 0 65535 ECU_ADDRESS 0xfe4d41fe /* @ECU_Address@autosar_swc_vmp_rtARID_DEF.UnitDelay1_DSTATE_ao@ */ /end MEASUREMENT
/begin MEASUREMENT autosar_swc_vmp_rtARID_DEF.UnitDelay1_DSTATE_bd "" UWORD autosar_swc_vmp_CM_uint16 0 0 0 65535 ECU_ADDRESS 0xfe4d4222 /* @ECU_Address@autosar_swc_vmp_rtARID_DEF.UnitDelay1_DSTATE_bd@ */ /end MEASUREMENT
/begin MEASUREMENT autosar_swc_vmp_rtARID_DEF.UnitDelay1_DSTATE_c5 "" UWORD autosar_swc_vmp_CM_uint16 0 0 0 65535 ECU_ADDRESS 0xfe4d422c /* @ECU_Address@autosar_swc_vmp_rtARID_DEF.UnitDelay1_DSTATE_c5@ */ /end MEASUREMENT
/begin MEASUREMENT autosar_swc_vmp_rtARID_DEF.UnitDelay1_DSTATE_cf "" UWORD autosar_swc_vmp_CM_uint16 0 0 0 65535 ECU_ADDRESS 0xfe4d41f4 /* @ECU_Address@autosar_swc_vmp_rtARID_DEF.UnitDelay1_DSTATE_cf@ */ /end MEASUREMENT
/begin MEASUREMENT autosar_swc_vmp_rtARID_DEF.UnitDelay1_DSTATE_cfn "" UWORD autosar_swc_vmp_CM_uint16 0 0 0 65535 ECU_ADDRESS 0xfe4d4218 /* @ECU_Address@autosar_swc_vmp_rtARID_DEF.UnitDelay1_DSTATE_cfn@ */ /end MEASUREMENT
/begin MEASUREMENT autosar_swc_vmp_rtARID_DEF.UnitDelay1_DSTATE_cv "" UWORD autosar_swc_vmp_CM_uint16 0 0 0 65535 ECU_ADDRESS 0xfe4d41dc /* @ECU_Address@autosar_swc_vmp_rtARID_DEF.UnitDelay1_DSTATE_cv@ */ /end MEASUREMENT
/begin MEASUREMENT autosar_swc_vmp_rtARID_DEF.UnitDelay1_DSTATE_e "" UWORD autosar_swc_vmp_CM_uint16 0 0 0 65535 ECU_ADDRESS 0xfe4d41e8 /* @ECU_Address@autosar_swc_vmp_rtARID_DEF.UnitDelay1_DSTATE_e@ */ /end MEASUREMENT
/begin MEASUREMENT autosar_swc_vmp_rtARID_DEF.UnitDelay1_DSTATE_ed "" UWORD autosar_swc_vmp_CM_uint16 0 0 0 65535 ECU_ADDRESS 0xfe4d4206 /* @ECU_Address@autosar_swc_vmp_rtARID_DEF.UnitDelay1_DSTATE_ed@ */ /end MEASUREMENT
/begin MEASUREMENT autosar_swc_vmp_rtARID_DEF.UnitDelay1_DSTATE_f "" UWORD autosar_swc_vmp_CM_uint16 0 0 0 65535 ECU_ADDRESS 0xfe4d420a /* @ECU_Address@autosar_swc_vmp_rtARID_DEF.UnitDelay1_DSTATE_f@ */ /end MEASUREMENT
/begin MEASUREMENT autosar_swc_vmp_rtARID_DEF.UnitDelay1_DSTATE_f2 "" UWORD autosar_swc_vmp_CM_uint16 0 0 0 65535 ECU_ADDRESS 0xfe4d4212 /* @ECU_Address@autosar_swc_vmp_rtARID_DEF.UnitDelay1_DSTATE_f2@ */ /end MEASUREMENT
/begin MEASUREMENT autosar_swc_vmp_rtARID_DEF.UnitDelay1_DSTATE_h "" UWORD autosar_swc_vmp_CM_uint16 0 0 0 65535 ECU_ADDRESS 0xfe4d4216 /* @ECU_Address@autosar_swc_vmp_rtARID_DEF.UnitDelay1_DSTATE_h@ */ /end MEASUREMENT
/begin MEASUREMENT autosar_swc_vmp_rtARID_DEF.UnitDelay1_DSTATE_hj "" UWORD autosar_swc_vmp_CM_uint16 0 0 0 65535 ECU_ADDRESS 0xfe4d422a /* @ECU_Address@autosar_swc_vmp_rtARID_DEF.UnitDelay1_DSTATE_hj@ */ /end MEASUREMENT
/begin MEASUREMENT autosar_swc_vmp_rtARID_DEF.UnitDelay1_DSTATE_hn "" UBYTE autosar_swc_vmp_CM_logical 0 0 0 1 ECU_ADDRESS 0xfe4d429b /* @ECU_Address@autosar_swc_vmp_rtARID_DEF.UnitDelay1_DSTATE_hn@ */ /end MEASUREMENT
/begin MEASUREMENT autosar_swc_vmp_rtARID_DEF.UnitDelay1_DSTATE_i "" FLOAT32_IEEE autosar_swc_vmp_CM_single 0 0 -3.4E+38 3.4E+38 ECU_ADDRESS 0xfe4d40bc /* @ECU_Address@autosar_swc_vmp_rtARID_DEF.UnitDelay1_DSTATE_i@ */ /end MEASUREMENT
/begin MEASUREMENT autosar_swc_vmp_rtARID_DEF.UnitDelay1_DSTATE_i3 "" UWORD autosar_swc_vmp_CM_uint16 0 0 0 65535 ECU_ADDRESS 0xfe4d41fa /* @ECU_Address@autosar_swc_vmp_rtARID_DEF.UnitDelay1_DSTATE_i3@ */ /end MEASUREMENT
/begin MEASUREMENT autosar_swc_vmp_rtARID_DEF.UnitDelay1_DSTATE_ie "" UWORD autosar_swc_vmp_CM_uint16 0 0 0 65535 ECU_ADDRESS 0xfe4d4200 /* @ECU_Address@autosar_swc_vmp_rtARID_DEF.UnitDelay1_DSTATE_ie@ */ /end MEASUREMENT
/begin MEASUREMENT autosar_swc_vmp_rtARID_DEF.UnitDelay1_DSTATE_ik "" UWORD autosar_swc_vmp_CM_uint16 0 0 0 65535 ECU_ADDRESS 0xfe4d4226 /* @ECU_Address@autosar_swc_vmp_rtARID_DEF.UnitDelay1_DSTATE_ik@ */ /end MEASUREMENT
/begin MEASUREMENT autosar_swc_vmp_rtARID_DEF.UnitDelay1_DSTATE_it "" UWORD autosar_swc_vmp_CM_uint16 0 0 0 65535 ECU_ADDRESS 0xfe4d41de /* @ECU_Address@autosar_swc_vmp_rtARID_DEF.UnitDelay1_DSTATE_it@ */ /end MEASUREMENT
/begin MEASUREMENT autosar_swc_vmp_rtARID_DEF.UnitDelay1_DSTATE_iw "" UWORD autosar_swc_vmp_CM_uint16 0 0 0 65535 ECU_ADDRESS 0xfe4d422e /* @ECU_Address@autosar_swc_vmp_rtARID_DEF.UnitDelay1_DSTATE_iw@ */ /end MEASUREMENT
/begin MEASUREMENT autosar_swc_vmp_rtARID_DEF.UnitDelay1_DSTATE_iy "" UWORD autosar_swc_vmp_CM_uint16 0 0 0 65535 ECU_ADDRESS 0xfe4d420e /* @ECU_Address@autosar_swc_vmp_rtARID_DEF.UnitDelay1_DSTATE_iy@ */ /end MEASUREMENT
/begin MEASUREMENT autosar_swc_vmp_rtARID_DEF.UnitDelay1_DSTATE_j "" UWORD autosar_swc_vmp_CM_uint16 0 0 0 65535 ECU_ADDRESS 0xfe4d41f0 /* @ECU_Address@autosar_swc_vmp_rtARID_DEF.UnitDelay1_DSTATE_j@ */ /end MEASUREMENT
/begin MEASUREMENT autosar_swc_vmp_rtARID_DEF.UnitDelay1_DSTATE_j1 "" UWORD autosar_swc_vmp_CM_uint16 0 0 0 65535 ECU_ADDRESS 0xfe4d4224 /* @ECU_Address@autosar_swc_vmp_rtARID_DEF.UnitDelay1_DSTATE_j1@ */ /end MEASUREMENT
/begin MEASUREMENT autosar_swc_vmp_rtARID_DEF.UnitDelay1_DSTATE_jd "" UWORD autosar_swc_vmp_CM_uint16 0 0 0 65535 ECU_ADDRESS 0xfe4d4214 /* @ECU_Address@autosar_swc_vmp_rtARID_DEF.UnitDelay1_DSTATE_jd@ */ /end MEASUREMENT
/begin MEASUREMENT autosar_swc_vmp_rtARID_DEF.UnitDelay1_DSTATE_ji "" UWORD autosar_swc_vmp_CM_uint16 0 0 0 65535 ECU_ADDRESS 0xfe4d41f8 /* @ECU_Address@autosar_swc_vmp_rtARID_DEF.UnitDelay1_DSTATE_ji@ */ /end MEASUREMENT
/begin MEASUREMENT autosar_swc_vmp_rtARID_DEF.UnitDelay1_DSTATE_jr "" UWORD autosar_swc_vmp_CM_uint16 0 0 0 65535 ECU_ADDRESS 0xfe4d4208 /* @ECU_Address@autosar_swc_vmp_rtARID_DEF.UnitDelay1_DSTATE_jr@ */ /end MEASUREMENT
/begin MEASUREMENT autosar_swc_vmp_rtARID_DEF.UnitDelay1_DSTATE_k3 "" UWORD autosar_swc_vmp_CM_uint16 0 0 0 65535 ECU_ADDRESS 0xfe4d421e /* @ECU_Address@autosar_swc_vmp_rtARID_DEF.UnitDelay1_DSTATE_k3@ */ /end MEASUREMENT
/begin MEASUREMENT autosar_swc_vmp_rtARID_DEF.UnitDelay1_DSTATE_k3y "" UWORD autosar_swc_vmp_CM_uint16 0 0 0 65535 ECU_ADDRESS 0xfe4d4228 /* @ECU_Address@autosar_swc_vmp_rtARID_DEF.UnitDelay1_DSTATE_k3y@ */ /end MEASUREMENT
/begin MEASUREMENT autosar_swc_vmp_rtARID_DEF.UnitDelay1_DSTATE_lc "" UWORD autosar_swc_vmp_CM_uint16 0 0 0 65535 ECU_ADDRESS 0xfe4d4202 /* @ECU_Address@autosar_swc_vmp_rtARID_DEF.UnitDelay1_DSTATE_lc@ */ /end MEASUREMENT
/begin MEASUREMENT autosar_swc_vmp_rtARID_DEF.UnitDelay1_DSTATE_m "" UWORD autosar_swc_vmp_CM_uint16 0 0 0 65535 ECU_ADDRESS 0xfe4d41e2 /* @ECU_Address@autosar_swc_vmp_rtARID_DEF.UnitDelay1_DSTATE_m@ */ /end MEASUREMENT
/begin MEASUREMENT autosar_swc_vmp_rtARID_DEF.UnitDelay1_DSTATE_m2 "" UWORD autosar_swc_vmp_CM_uint16 0 0 0 65535 ECU_ADDRESS 0xfe4d41fc /* @ECU_Address@autosar_swc_vmp_rtARID_DEF.UnitDelay1_DSTATE_m2@ */ /end MEASUREMENT
/begin MEASUREMENT autosar_swc_vmp_rtARID_DEF.UnitDelay1_DSTATE_mb "" UWORD autosar_swc_vmp_CM_uint16 0 0 0 65535 ECU_ADDRESS 0xfe4d41f2 /* @ECU_Address@autosar_swc_vmp_rtARID_DEF.UnitDelay1_DSTATE_mb@ */ /end MEASUREMENT
/begin MEASUREMENT autosar_swc_vmp_rtARID_DEF.UnitDelay1_DSTATE_mj "" UWORD autosar_swc_vmp_CM_uint16 0 0 0 65535 ECU_ADDRESS 0xfe4d421a /* @ECU_Address@autosar_swc_vmp_rtARID_DEF.UnitDelay1_DSTATE_mj@ */ /end MEASUREMENT
/begin MEASUREMENT autosar_swc_vmp_rtARID_DEF.UnitDelay1_DSTATE_mk "" UWORD autosar_swc_vmp_CM_uint16 0 0 0 65535 ECU_ADDRESS 0xfe4d421c /* @ECU_Address@autosar_swc_vmp_rtARID_DEF.UnitDelay1_DSTATE_mk@ */ /end MEASUREMENT
/begin MEASUREMENT autosar_swc_vmp_rtARID_DEF.UnitDelay1_DSTATE_mo "" UWORD autosar_swc_vmp_CM_uint16 0 0 0 65535 ECU_ADDRESS 0xfe4d41f6 /* @ECU_Address@autosar_swc_vmp_rtARID_DEF.UnitDelay1_DSTATE_mo@ */ /end MEASUREMENT
/begin MEASUREMENT autosar_swc_vmp_rtARID_DEF.UnitDelay1_DSTATE_n "" UWORD autosar_swc_vmp_CM_uint16 0 0 0 65535 ECU_ADDRESS 0xfe4d41e0 /* @ECU_Address@autosar_swc_vmp_rtARID_DEF.UnitDelay1_DSTATE_n@ */ /end MEASUREMENT
/begin MEASUREMENT autosar_swc_vmp_rtARID_DEF.UnitDelay1_DSTATE_nd "" UWORD autosar_swc_vmp_CM_uint16 0 0 0 65535 ECU_ADDRESS 0xfe4d41ea /* @ECU_Address@autosar_swc_vmp_rtARID_DEF.UnitDelay1_DSTATE_nd@ */ /end MEASUREMENT
/begin MEASUREMENT autosar_swc_vmp_rtARID_DEF.UnitDelay1_DSTATE_o "" UWORD autosar_swc_vmp_CM_uint16 0 0 0 65535 ECU_ADDRESS 0xfe4d41e4 /* @ECU_Address@autosar_swc_vmp_rtARID_DEF.UnitDelay1_DSTATE_o@ */ /end MEASUREMENT
/begin MEASUREMENT autosar_swc_vmp_rtARID_DEF.UnitDelay1_DSTATE_o3 "" UWORD autosar_swc_vmp_CM_uint16 0 0 0 65535 ECU_ADDRESS 0xfe4d4220 /* @ECU_Address@autosar_swc_vmp_rtARID_DEF.UnitDelay1_DSTATE_o3@ */ /end MEASUREMENT
/begin MEASUREMENT autosar_swc_vmp_rtARID_DEF.UnitDelay1_DSTATE_p "" UWORD autosar_swc_vmp_CM_uint16 0 0 0 65535 ECU_ADDRESS 0xfe4d41e6 /* @ECU_Address@autosar_swc_vmp_rtARID_DEF.UnitDelay1_DSTATE_p@ */ /end MEASUREMENT
/begin MEASUREMENT autosar_swc_vmp_rtARID_DEF.UnitDelay1_DSTATE_pd "" UWORD autosar_swc_vmp_CM_uint16 0 0 0 65535 ECU_ADDRESS 0xfe4d4204 /* @ECU_Address@autosar_swc_vmp_rtARID_DEF.UnitDelay1_DSTATE_pd@ */ /end MEASUREMENT
/begin MEASUREMENT autosar_swc_vmp_rtARID_DEF.UnitDelay1_DSTATE_pf "" UWORD autosar_swc_vmp_CM_uint16 0 0 0 65535 ECU_ADDRESS 0xfe4d41ec /* @ECU_Address@autosar_swc_vmp_rtARID_DEF.UnitDelay1_DSTATE_pf@ */ /end MEASUREMENT
/begin MEASUREMENT autosar_swc_vmp_rtARID_DEF.UnitDelay1_DSTATE_pfa "" UWORD autosar_swc_vmp_CM_uint16 0 0 0 65535 ECU_ADDRESS 0xfe4d41ee /* @ECU_Address@autosar_swc_vmp_rtARID_DEF.UnitDelay1_DSTATE_pfa@ */ /end MEASUREMENT
/begin MEASUREMENT autosar_swc_vmp_rtARID_DEF.UnitDelay1_DSTATE_pi "" UWORD autosar_swc_vmp_CM_uint16 0 0 0 65535 ECU_ADDRESS 0xfe4d420c /* @ECU_Address@autosar_swc_vmp_rtARID_DEF.UnitDelay1_DSTATE_pi@ */ /end MEASUREMENT
/begin MEASUREMENT autosar_swc_vmp_rtARID_DEF.UnitDelay2_DSTATE_a0 "" UBYTE autosar_swc_vmp_CM_logical 0 0 0 1 ECU_ADDRESS 0xfe4d4295 /* @ECU_Address@autosar_swc_vmp_rtARID_DEF.UnitDelay2_DSTATE_a0@ */ /end MEASUREMENT
/begin MEASUREMENT autosar_swc_vmp_rtARID_DEF.UnitDelay2_DSTATE_af "" UBYTE autosar_swc_vmp_CM_logical 0 0 0 1 ECU_ADDRESS 0xfe4d4293 /* @ECU_Address@autosar_swc_vmp_rtARID_DEF.UnitDelay2_DSTATE_af@ */ /end MEASUREMENT
/begin MEASUREMENT autosar_swc_vmp_rtARID_DEF.UnitDelay2_DSTATE_av "" UBYTE autosar_swc_vmp_CM_logical 0 0 0 1 ECU_ADDRESS 0xfe4d4276 /* @ECU_Address@autosar_swc_vmp_rtARID_DEF.UnitDelay2_DSTATE_av@ */ /end MEASUREMENT
/begin MEASUREMENT autosar_swc_vmp_rtARID_DEF.UnitDelay2_DSTATE_az "" UBYTE autosar_swc_vmp_CM_logical 0 0 0 1 ECU_ADDRESS 0xfe4d4292 /* @ECU_Address@autosar_swc_vmp_rtARID_DEF.UnitDelay2_DSTATE_az@ */ /end MEASUREMENT
/begin MEASUREMENT autosar_swc_vmp_rtARID_DEF.UnitDelay2_DSTATE_b "" UBYTE autosar_swc_vmp_CM_logical 0 0 0 1 ECU_ADDRESS 0xfe4d4272 /* @ECU_Address@autosar_swc_vmp_rtARID_DEF.UnitDelay2_DSTATE_b@ */ /end MEASUREMENT
/begin MEASUREMENT autosar_swc_vmp_rtARID_DEF.UnitDelay2_DSTATE_bu "" UBYTE autosar_swc_vmp_CM_logical 0 0 0 1 ECU_ADDRESS 0xfe4d4294 /* @ECU_Address@autosar_swc_vmp_rtARID_DEF.UnitDelay2_DSTATE_bu@ */ /end MEASUREMENT
/begin MEASUREMENT autosar_swc_vmp_rtARID_DEF.UnitDelay2_DSTATE_bx "" UBYTE autosar_swc_vmp_CM_logical 0 0 0 1 ECU_ADDRESS 0xfe4d4286 /* @ECU_Address@autosar_swc_vmp_rtARID_DEF.UnitDelay2_DSTATE_bx@ */ /end MEASUREMENT
/begin MEASUREMENT autosar_swc_vmp_rtARID_DEF.UnitDelay2_DSTATE_c "" UBYTE autosar_swc_vmp_CM_logical 0 0 0 1 ECU_ADDRESS 0xfe4d427a /* @ECU_Address@autosar_swc_vmp_rtARID_DEF.UnitDelay2_DSTATE_c@ */ /end MEASUREMENT
/begin MEASUREMENT autosar_swc_vmp_rtARID_DEF.UnitDelay2_DSTATE_c4 "" UBYTE autosar_swc_vmp_CM_logical 0 0 0 1 ECU_ADDRESS 0xfe4d4288 /* @ECU_Address@autosar_swc_vmp_rtARID_DEF.UnitDelay2_DSTATE_c4@ */ /end MEASUREMENT
/begin MEASUREMENT autosar_swc_vmp_rtARID_DEF.UnitDelay2_DSTATE_d "" UBYTE autosar_swc_vmp_CM_logical 0 0 0 1 ECU_ADDRESS 0xfe4d4271 /* @ECU_Address@autosar_swc_vmp_rtARID_DEF.UnitDelay2_DSTATE_d@ */ /end MEASUREMENT
/begin MEASUREMENT autosar_swc_vmp_rtARID_DEF.UnitDelay2_DSTATE_dk "" UBYTE autosar_swc_vmp_CM_logical 0 0 0 1 ECU_ADDRESS 0xfe4d4284 /* @ECU_Address@autosar_swc_vmp_rtARID_DEF.UnitDelay2_DSTATE_dk@ */ /end MEASUREMENT
/begin MEASUREMENT autosar_swc_vmp_rtARID_DEF.UnitDelay2_DSTATE_dm "" UBYTE autosar_swc_vmp_CM_logical 0 0 0 1 ECU_ADDRESS 0xfe4d4285 /* @ECU_Address@autosar_swc_vmp_rtARID_DEF.UnitDelay2_DSTATE_dm@ */ /end MEASUREMENT
/begin MEASUREMENT autosar_swc_vmp_rtARID_DEF.UnitDelay2_DSTATE_e "" UBYTE autosar_swc_vmp_CM_logical 0 0 0 1 ECU_ADDRESS 0xfe4d427b /* @ECU_Address@autosar_swc_vmp_rtARID_DEF.UnitDelay2_DSTATE_e@ */ /end MEASUREMENT
/begin MEASUREMENT autosar_swc_vmp_rtARID_DEF.UnitDelay2_DSTATE_fb "" UBYTE autosar_swc_vmp_CM_logical 0 0 0 1 ECU_ADDRESS 0xfe4d428e /* @ECU_Address@autosar_swc_vmp_rtARID_DEF.UnitDelay2_DSTATE_fb@ */ /end MEASUREMENT
/begin MEASUREMENT autosar_swc_vmp_rtARID_DEF.UnitDelay2_DSTATE_fj "" UBYTE autosar_swc_vmp_CM_logical 0 0 0 1 ECU_ADDRESS 0xfe4d426f /* @ECU_Address@autosar_swc_vmp_rtARID_DEF.UnitDelay2_DSTATE_fj@ */ /end MEASUREMENT
/begin MEASUREMENT autosar_swc_vmp_rtARID_DEF.UnitDelay2_DSTATE_fw "" UBYTE autosar_swc_vmp_CM_logical 0 0 0 1 ECU_ADDRESS 0xfe4d4274 /* @ECU_Address@autosar_swc_vmp_rtARID_DEF.UnitDelay2_DSTATE_fw@ */ /end MEASUREMENT
/begin MEASUREMENT autosar_swc_vmp_rtARID_DEF.UnitDelay2_DSTATE_g "" UBYTE autosar_swc_vmp_CM_logical 0 0 0 1 ECU_ADDRESS 0xfe4d4281 /* @ECU_Address@autosar_swc_vmp_rtARID_DEF.UnitDelay2_DSTATE_g@ */ /end MEASUREMENT
/begin MEASUREMENT autosar_swc_vmp_rtARID_DEF.UnitDelay2_DSTATE_gj "" UBYTE autosar_swc_vmp_CM_logical 0 0 0 1 ECU_ADDRESS 0xfe4d4289 /* @ECU_Address@autosar_swc_vmp_rtARID_DEF.UnitDelay2_DSTATE_gj@ */ /end MEASUREMENT
/begin MEASUREMENT autosar_swc_vmp_rtARID_DEF.UnitDelay2_DSTATE_gs "" UBYTE autosar_swc_vmp_CM_logical 0 0 0 1 ECU_ADDRESS 0xfe4d428b /* @ECU_Address@autosar_swc_vmp_rtARID_DEF.UnitDelay2_DSTATE_gs@ */ /end MEASUREMENT
/begin MEASUREMENT autosar_swc_vmp_rtARID_DEF.UnitDelay2_DSTATE_gw "" UBYTE autosar_swc_vmp_CM_logical 0 0 0 1 ECU_ADDRESS 0xfe4d4290 /* @ECU_Address@autosar_swc_vmp_rtARID_DEF.UnitDelay2_DSTATE_gw@ */ /end MEASUREMENT
/begin MEASUREMENT autosar_swc_vmp_rtARID_DEF.UnitDelay2_DSTATE_h "" UBYTE autosar_swc_vmp_CM_logical 0 0 0 1 ECU_ADDRESS 0xfe4d4273 /* @ECU_Address@autosar_swc_vmp_rtARID_DEF.UnitDelay2_DSTATE_h@ */ /end MEASUREMENT
/begin MEASUREMENT autosar_swc_vmp_rtARID_DEF.UnitDelay2_DSTATE_h5 "" UBYTE autosar_swc_vmp_CM_logical 0 0 0 1 ECU_ADDRESS 0xfe4d4278 /* @ECU_Address@autosar_swc_vmp_rtARID_DEF.UnitDelay2_DSTATE_h5@ */ /end MEASUREMENT
/begin MEASUREMENT autosar_swc_vmp_rtARID_DEF.UnitDelay2_DSTATE_h5l "" UBYTE autosar_swc_vmp_CM_logical 0 0 0 1 ECU_ADDRESS 0xfe4d427f /* @ECU_Address@autosar_swc_vmp_rtARID_DEF.UnitDelay2_DSTATE_h5l@ */ /end MEASUREMENT
/begin MEASUREMENT autosar_swc_vmp_rtARID_DEF.UnitDelay2_DSTATE_hh "" UBYTE autosar_swc_vmp_CM_logical 0 0 0 1 ECU_ADDRESS 0xfe4d428a /* @ECU_Address@autosar_swc_vmp_rtARID_DEF.UnitDelay2_DSTATE_hh@ */ /end MEASUREMENT
/begin MEASUREMENT autosar_swc_vmp_rtARID_DEF.UnitDelay2_DSTATE_i "" UBYTE autosar_swc_vmp_CM_logical 0 0 0 1 ECU_ADDRESS 0xfe4d426d /* @ECU_Address@autosar_swc_vmp_rtARID_DEF.UnitDelay2_DSTATE_i@ */ /end MEASUREMENT
/begin MEASUREMENT autosar_swc_vmp_rtARID_DEF.UnitDelay2_DSTATE_ib "" UBYTE autosar_swc_vmp_CM_logical 0 0 0 1 ECU_ADDRESS 0xfe4d4279 /* @ECU_Address@autosar_swc_vmp_rtARID_DEF.UnitDelay2_DSTATE_ib@ */ /end MEASUREMENT
/begin MEASUREMENT autosar_swc_vmp_rtARID_DEF.UnitDelay2_DSTATE_ie "" UBYTE autosar_swc_vmp_CM_logical 0 0 0 1 ECU_ADDRESS 0xfe4d4282 /* @ECU_Address@autosar_swc_vmp_rtARID_DEF.UnitDelay2_DSTATE_ie@ */ /end MEASUREMENT
/begin MEASUREMENT autosar_swc_vmp_rtARID_DEF.UnitDelay2_DSTATE_j "" UBYTE autosar_swc_vmp_CM_logical 0 0 0 1 ECU_ADDRESS 0xfe4d4287 /* @ECU_Address@autosar_swc_vmp_rtARID_DEF.UnitDelay2_DSTATE_j@ */ /end MEASUREMENT
/begin MEASUREMENT autosar_swc_vmp_rtARID_DEF.UnitDelay2_DSTATE_jx "" UBYTE autosar_swc_vmp_CM_logical 0 0 0 1 ECU_ADDRESS 0xfe4d428f /* @ECU_Address@autosar_swc_vmp_rtARID_DEF.UnitDelay2_DSTATE_jx@ */ /end MEASUREMENT
/begin MEASUREMENT autosar_swc_vmp_rtARID_DEF.UnitDelay2_DSTATE_k "" UBYTE autosar_swc_vmp_CM_logical 0 0 0 1 ECU_ADDRESS 0xfe4d428d /* @ECU_Address@autosar_swc_vmp_rtARID_DEF.UnitDelay2_DSTATE_k@ */ /end MEASUREMENT
/begin MEASUREMENT autosar_swc_vmp_rtARID_DEF.UnitDelay2_DSTATE_l "" UBYTE autosar_swc_vmp_CM_logical 0 0 0 1 ECU_ADDRESS 0xfe4d427e /* @ECU_Address@autosar_swc_vmp_rtARID_DEF.UnitDelay2_DSTATE_l@ */ /end MEASUREMENT
/begin MEASUREMENT autosar_swc_vmp_rtARID_DEF.UnitDelay2_DSTATE_m "" UBYTE autosar_swc_vmp_CM_logical 0 0 0 1 ECU_ADDRESS 0xfe4d4270 /* @ECU_Address@autosar_swc_vmp_rtARID_DEF.UnitDelay2_DSTATE_m@ */ /end MEASUREMENT
/begin MEASUREMENT autosar_swc_vmp_rtARID_DEF.UnitDelay2_DSTATE_mo "" UBYTE autosar_swc_vmp_CM_logical 0 0 0 1 ECU_ADDRESS 0xfe4d4277 /* @ECU_Address@autosar_swc_vmp_rtARID_DEF.UnitDelay2_DSTATE_mo@ */ /end MEASUREMENT
/begin MEASUREMENT autosar_swc_vmp_rtARID_DEF.UnitDelay2_DSTATE_n "" UBYTE autosar_swc_vmp_CM_logical 0 0 0 1 ECU_ADDRESS 0xfe4d4280 /* @ECU_Address@autosar_swc_vmp_rtARID_DEF.UnitDelay2_DSTATE_n@ */ /end MEASUREMENT
/begin MEASUREMENT autosar_swc_vmp_rtARID_DEF.UnitDelay2_DSTATE_n4 "" UBYTE autosar_swc_vmp_CM_logical 0 0 0 1 ECU_ADDRESS 0xfe4d4291 /* @ECU_Address@autosar_swc_vmp_rtARID_DEF.UnitDelay2_DSTATE_n4@ */ /end MEASUREMENT
/begin MEASUREMENT autosar_swc_vmp_rtARID_DEF.UnitDelay2_DSTATE_nb "" UBYTE autosar_swc_vmp_CM_logical 0 0 0 1 ECU_ADDRESS 0xfe4d428c /* @ECU_Address@autosar_swc_vmp_rtARID_DEF.UnitDelay2_DSTATE_nb@ */ /end MEASUREMENT
/begin MEASUREMENT autosar_swc_vmp_rtARID_DEF.UnitDelay2_DSTATE_o "" UBYTE autosar_swc_vmp_CM_logical 0 0 0 1 ECU_ADDRESS 0xfe4d427c /* @ECU_Address@autosar_swc_vmp_rtARID_DEF.UnitDelay2_DSTATE_o@ */ /end MEASUREMENT
/begin MEASUREMENT autosar_swc_vmp_rtARID_DEF.UnitDelay2_DSTATE_o1 "" UBYTE autosar_swc_vmp_CM_logical 0 0 0 1 ECU_ADDRESS 0xfe4d4283 /* @ECU_Address@autosar_swc_vmp_rtARID_DEF.UnitDelay2_DSTATE_o1@ */ /end MEASUREMENT
/begin MEASUREMENT autosar_swc_vmp_rtARID_DEF.UnitDelay2_DSTATE_o1t "" UBYTE autosar_swc_vmp_CM_logical 0 0 0 1 ECU_ADDRESS 0xfe4d4296 /* @ECU_Address@autosar_swc_vmp_rtARID_DEF.UnitDelay2_DSTATE_o1t@ */ /end MEASUREMENT
/begin MEASUREMENT autosar_swc_vmp_rtARID_DEF.UnitDelay2_DSTATE_p2 "" UBYTE autosar_swc_vmp_CM_logical 0 0 0 1 ECU_ADDRESS 0xfe4d429a /* @ECU_Address@autosar_swc_vmp_rtARID_DEF.UnitDelay2_DSTATE_p2@ */ /end MEASUREMENT
/begin MEASUREMENT autosar_swc_vmp_rtARID_DEF.UnitDelay2_DSTATE_p3 "" UBYTE autosar_swc_vmp_CM_logical 0 0 0 1 ECU_ADDRESS 0xfe4d427d /* @ECU_Address@autosar_swc_vmp_rtARID_DEF.UnitDelay2_DSTATE_p3@ */ /end MEASUREMENT
/begin MEASUREMENT autosar_swc_vmp_rtARID_DEF.UnitDelay2_DSTATE_pa "" UBYTE autosar_swc_vmp_CM_logical 0 0 0 1 ECU_ADDRESS 0xfe4d4275 /* @ECU_Address@autosar_swc_vmp_rtARID_DEF.UnitDelay2_DSTATE_pa@ */ /end MEASUREMENT
/begin MEASUREMENT autosar_swc_vmp_rtARID_DEF.UnitDelay2_DSTATE_pg "" UBYTE autosar_swc_vmp_CM_logical 0 0 0 1 ECU_ADDRESS 0xfe4d426e /* @ECU_Address@autosar_swc_vmp_rtARID_DEF.UnitDelay2_DSTATE_pg@ */ /end MEASUREMENT
/begin MEASUREMENT autosar_swc_vmp_rtARID_DEF.UnitDelay_DSTATE_fd "" UBYTE autosar_swc_vmp_CM_uint8 0 0 0 255 ECU_ADDRESS 0xfe4d4238 /* @ECU_Address@autosar_swc_vmp_rtARID_DEF.UnitDelay_DSTATE_fd@ */ /end MEASUREMENT
/begin MEASUREMENT autosar_swc_vmp_rtARID_DEF.UnitDelay_DSTATE_gw "" UBYTE autosar_swc_vmp_CM_logical 0 0 0 1 ECU_ADDRESS 0xfe4d429c /* @ECU_Address@autosar_swc_vmp_rtARID_DEF.UnitDelay_DSTATE_gw@ */ /end MEASUREMENT
/begin MEASUREMENT autosar_swc_vmp_rtARID_DEF.UnitDelay_DSTATE_ig "" FLOAT32_IEEE autosar_swc_vmp_CM_single 0 0 -3.4E+38 3.4E+38 ECU_ADDRESS 0xfe4d40f8 /* @ECU_Address@autosar_swc_vmp_rtARID_DEF.UnitDelay_DSTATE_ig@ */ /end MEASUREMENT
/begin MEASUREMENT autosar_swc_vmp_rtARID_DEF.UnitDelay_DSTATE_k "" UBYTE autosar_swc_vmp_CM_uint8 0 0 0 255 ECU_ADDRESS 0xfe4d4241 /* @ECU_Address@autosar_swc_vmp_rtARID_DEF.UnitDelay_DSTATE_k@ */ /end MEASUREMENT
/begin MEASUREMENT autosar_swc_vmp_rtARID_DEF.VariantMergeForOutportInsertSpace_St "" UBYTE autosar_swc_vmp_CM_uint8 0 0 0 255 ECU_ADDRESS 0xfe4d4233 /* @ECU_Address@autosar_swc_vmp_rtARID_DEF.VariantMergeForOutportInsertSpace_St@ */ /end MEASUREMENT
/begin MEASUREMENT autosar_swc_vmp_rtARID_DEF.VariantMergeForOutportSelect_STResult "" FLOAT32_IEEE autosar_swc_vmp_CM_single 0 0 -3.4E+38 3.4E+38 LAYOUT COLUMN_DIR MATRIX_DIM 6 1 ECU_ADDRESS 0xfe4ce6a8 /* @ECU_Address@autosar_swc_vmp_rtARID_DEF.VariantMergeForOutportSelect_STResult@ */ /end MEASUREMENT
/begin MEASUREMENT autosar_swc_vmp_rtARID_DEF.count "" UBYTE autosar_swc_vmp_CM_uint8 0 0 0 255 ECU_ADDRESS 0xfe4d425d /* @ECU_Address@autosar_swc_vmp_rtARID_DEF.count@ */ /end MEASUREMENT
/begin MEASUREMENT autosar_swc_vmp_rtARID_DEF.id_k1 "" ULONG autosar_swc_vmp_CM_uint32 0 0 0 4294967295 ECU_ADDRESS 0xfe4d41d8 /* @ECU_Address@autosar_swc_vmp_rtARID_DEF.id_k1@ */ /end MEASUREMENT
/begin MEASUREMENT autosar_swc_vmp_rtARID_DEF.is_active "" UBYTE autosar_swc_vmp_CM_uint8 0 0 0 255 ECU_ADDRESS 0xfe4d4267 /* @ECU_Address@autosar_swc_vmp_rtARID_DEF.is_active@ */ /end MEASUREMENT
/begin MEASUREMENT autosar_swc_vmp_rtARID_DEF.is_active_c502_autosar_swc_vmp "" UBYTE autosar_swc_vmp_CM_uint8 0 0 0 255 ECU_ADDRESS 0xfe4d4265 /* @ECU_Address@autosar_swc_vmp_rtARID_DEF.is_active_c502_autosar_swc_vmp@ */ /end MEASUREMENT
/begin MEASUREMENT autosar_swc_vmp_rtARID_DEF.is_active_c505_autosar_swc_vmp "" UBYTE autosar_swc_vmp_CM_uint8 0 0 0 255 ECU_ADDRESS 0xfe4d425e /* @ECU_Address@autosar_swc_vmp_rtARID_DEF.is_active_c505_autosar_swc_vmp@ */ /end MEASUREMENT
/begin MEASUREMENT autosar_swc_vmp_rtARID_DEF.is_active_c506_autosar_swc_vmp "" UBYTE autosar_swc_vmp_CM_uint8 0 0 0 255 ECU_ADDRESS 0xfe4d425b /* @ECU_Address@autosar_swc_vmp_rtARID_DEF.is_active_c506_autosar_swc_vmp@ */ /end MEASUREMENT
/begin MEASUREMENT autosar_swc_vmp_rtARID_DEF.is_c502_autosar_swc_vmp "" UBYTE autosar_swc_vmp_CM_uint8 0 0 0 255 ECU_ADDRESS 0xfe4d4266 /* @ECU_Address@autosar_swc_vmp_rtARID_DEF.is_c502_autosar_swc_vmp@ */ /end MEASUREMENT
/begin MEASUREMENT autosar_swc_vmp_rtARID_DEF.is_c505_autosar_swc_vmp "" UBYTE autosar_swc_vmp_CM_uint8 0 0 0 255 ECU_ADDRESS 0xfe4d425f /* @ECU_Address@autosar_swc_vmp_rtARID_DEF.is_c505_autosar_swc_vmp@ */ /end MEASUREMENT
/begin MEASUREMENT autosar_swc_vmp_rtARID_DEF.is_c506_autosar_swc_vmp "" UBYTE autosar_swc_vmp_CM_uint8 0 0 0 255 ECU_ADDRESS 0xfe4d425c /* @ECU_Address@autosar_swc_vmp_rtARID_DEF.is_c506_autosar_swc_vmp@ */ /end MEASUREMENT
/begin MEASUREMENT autosar_swc_vmp_rtARID_DEF.is_cruise_in_center "" UBYTE autosar_swc_vmp_CM_uint8 0 0 0 255 ECU_ADDRESS 0xfe4d4268 /* @ECU_Address@autosar_swc_vmp_rtARID_DEF.is_cruise_in_center@ */ /end MEASUREMENT
/begin MEASUREMENT autosar_swc_vmp_rtARID_DEF.is_lanechanging "" UBYTE autosar_swc_vmp_CM_uint8 0 0 0 255 ECU_ADDRESS 0xfe4d426a /* @ECU_Address@autosar_swc_vmp_rtARID_DEF.is_lanechanging@ */ /end MEASUREMENT
/begin MEASUREMENT autosar_swc_vmp_rtARID_DEF.is_run "" UBYTE autosar_swc_vmp_CM_uint8 0 0 0 255 ECU_ADDRESS 0xfe4d4260 /* @ECU_Address@autosar_swc_vmp_rtARID_DEF.is_run@ */ /end MEASUREMENT
/begin MEASUREMENT autosar_swc_vmp_rtARID_DEF.lc_dir "" UBYTE autosar_swc_vmp_CM_uint8 0 0 0 255 ECU_ADDRESS 0xfe4d4263 /* @ECU_Address@autosar_swc_vmp_rtARID_DEF.lc_dir@ */ /end MEASUREMENT
/begin MEASUREMENT autosar_swc_vmp_rtARID_DEF.lc_exec_sts "" UBYTE autosar_swc_vmp_CM_uint8 0 0 0 255 ECU_ADDRESS 0xfe4d4235 /* @ECU_Address@autosar_swc_vmp_rtARID_DEF.lc_exec_sts@ */ /end MEASUREMENT
/begin MEASUREMENT autosar_swc_vmp_rtARID_DEF.lc_failed_reason "" ULONG autosar_swc_vmp_CM_uint32 0 0 0 4294967295 MATRIX_DIM 1 1 ECU_ADDRESS 0xfe4d418c /* @ECU_Address@autosar_swc_vmp_rtARID_DEF.lc_failed_reason@ */ /end MEASUREMENT
/begin MEASUREMENT autosar_swc_vmp_rtARID_DEF.lc_feasibility_conds "" ULONG autosar_swc_vmp_CM_uint32 0 0 0 4294967295 MATRIX_DIM 1 1 ECU_ADDRESS 0xfe4d4188 /* @ECU_Address@autosar_swc_vmp_rtARID_DEF.lc_feasibility_conds@ */ /end MEASUREMENT
/begin MEASUREMENT autosar_swc_vmp_rtARID_DEF.lc_req_sync_id_exec "" ULONG autosar_swc_vmp_CM_uint32 0 0 0 4294967295 MATRIX_DIM 1 1 ECU_ADDRESS 0xfe4d4190 /* @ECU_Address@autosar_swc_vmp_rtARID_DEF.lc_req_sync_id_exec@ */ /end MEASUREMENT
/begin MEASUREMENT autosar_swc_vmp_rtARID_DEF.overtime "" UBYTE autosar_swc_vmp_CM_uint8 0 0 0 255 ECU_ADDRESS 0xfe4d4264 /* @ECU_Address@autosar_swc_vmp_rtARID_DEF.overtime@ */ /end MEASUREMENT
/begin MEASUREMENT autosar_swc_vmp_rtARID_DEF.readtime "" FLOAT32_IEEE autosar_swc_vmp_CM_single 0 0 -3.4E+38 3.4E+38 ECU_ADDRESS 0xfe4d4174 /* @ECU_Address@autosar_swc_vmp_rtARID_DEF.readtime@ */ /end MEASUREMENT
/begin MEASUREMENT autosar_swc_vmp_rtARID_DEF.safestop "" UBYTE autosar_swc_vmp_CM_uint8 0 0 0 255 ECU_ADDRESS 0xfe4d4261 /* @ECU_Address@autosar_swc_vmp_rtARID_DEF.safestop@ */ /end MEASUREMENT
/begin MEASUREMENT autosar_swc_vmp_rtARID_DEF.tp_lanechanging "" UBYTE autosar_swc_vmp_CM_uint8 0 0 0 255 ECU_ADDRESS 0xfe4d4269 /* @ECU_Address@autosar_swc_vmp_rtARID_DEF.tp_lanechanging@ */ /end MEASUREMENT
/begin MEASUREMENT autosar_swc_vmp_rtARID_DEF.vaild_end_dist "" FLOAT32_IEEE autosar_swc_vmp_CM_single 0 0 -3.4E+38 3.4E+38 ECU_ADDRESS 0xfe4d4094 /* @ECU_Address@autosar_swc_vmp_rtARID_DEF.vaild_end_dist@ */ /end MEASUREMENT
/begin MEASUREMENT autosar_swc_vmp_rtARID_DEF.veh_lc_pos "" UBYTE autosar_swc_vmp_CM_uint8 0 0 0 255 ECU_ADDRESS 0xfe4d4262 /* @ECU_Address@autosar_swc_vmp_rtARID_DEF.veh_lc_pos@ */ /end MEASUREMENT
/begin MEASUREMENT autosar_swc_vmp_rtARID_DEF.vehdyoffset "" FLOAT32_IEEE autosar_swc_vmp_CM_single 0 0 -3.4E+38 3.4E+38 ECU_ADDRESS 0xfe4d4178 /* @ECU_Address@autosar_swc_vmp_rtARID_DEF.vehdyoffset@ */ /end MEASUREMENT
/begin MEASUREMENT autosar_swc_vmp_rtARID_DEF.vehdyoffsetmin "" FLOAT32_IEEE autosar_swc_vmp_CM_single 0 0 -3.4E+38 3.4E+38 ECU_ADDRESS 0xfe4d4180 /* @ECU_Address@autosar_swc_vmp_rtARID_DEF.vehdyoffsetmin@ */ /end MEASUREMENT
/begin MEASUREMENT autosar_swc_vmp_rtARID_DEF.vehthetaoffset "" FLOAT32_IEEE autosar_swc_vmp_CM_single 0 0 -3.4E+38 3.4E+38 ECU_ADDRESS 0xfe4d417c /* @ECU_Address@autosar_swc_vmp_rtARID_DEF.vehthetaoffset@ */ /end MEASUREMENT
/begin MEASUREMENT autosar_swc_vmp_rtARID_DEF.vx_fd "" FLOAT32_IEEE autosar_swc_vmp_CM_single 0 0 -3.4E+38 3.4E+38 ECU_ADDRESS 0xfe4d4168 /* @ECU_Address@autosar_swc_vmp_rtARID_DEF.vx_fd@ */ /end MEASUREMENT
/begin MEASUREMENT autosar_swc_vmp_rtARID_DEF.vx_fd_not_empty "" UBYTE autosar_swc_vmp_CM_logical 0 0 0 1 ECU_ADDRESS 0xfe4d42a1 /* @ECU_Address@autosar_swc_vmp_rtARID_DEF.vx_fd_not_empty@ */ /end MEASUREMENT
/begin AXIS_PTS P_LONP_vxvRefFordecelJerkXAxis "" 0xfe829944 /* @ECU_Address@P_LONP_vxvRefFordecelJerkXAxis@ */ NO_INPUT_QUANTITY Axis_FLOAT32_IEEE 0 autosar_swc_vmp_CM_single 4 -3.4E+38 3.4E+38 /end AXIS_PTS
/begin AXIS_PTS P_VMP_DPC_DXValue "" 0xfe829994 /* @ECU_Address@P_VMP_DPC_DXValue@ */ NO_INPUT_QUANTITY Axis_FLOAT32_IEEE 0 autosar_swc_vmp_CM_single 4 0.000000 200.000000 /end AXIS_PTS
/begin AXIS_PTS P_VMP_DPC_TTCValue "" 0xfe8299a4 /* @ECU_Address@P_VMP_DPC_TTCValue@ */ NO_INPUT_QUANTITY Axis_FLOAT32_IEEE 0 autosar_swc_vmp_CM_single 4 0.000000 200.000000 /end AXIS_PTS
/begin COMPU_METHOD autosar_swc_vmp_CM_SM_MODULE_STATUS "Enumerated data type: SM_MODULE_STATUS" TAB_VERB "%0.6" "" COMPU_TAB_REF VTAB_FOR_autosar_swc_vmp_CM_SM_MODULE_STATUS /end COMPU_METHOD
/begin COMPU_VTAB VTAB_FOR_autosar_swc_vmp_CM_SM_MODULE_STATUS "Enumerated data type: SM_MODULE_STATUS" TAB_VERB 4 0 "STATUS_NORMAL" 1 "STATUS_NOT_CONNECTED" 2 "STATUS_HEARTBEAT_MISSED" 3 "STATUS_ABNORMAL" /end COMPU_VTAB
/begin COMPU_METHOD autosar_swc_vmp_CM_boolean "Q = V" IDENTICAL "%1.0" "" /end COMPU_METHOD
/begin COMPU_METHOD autosar_swc_vmp_CM_double "Q = V" IDENTICAL "%15.10" "" /end COMPU_METHOD
/begin COMPU_METHOD autosar_swc_vmp_CM_logical "Q = V" IDENTICAL "%1.0" "" /end COMPU_METHOD
/begin COMPU_METHOD autosar_swc_vmp_CM_single "Q = V" IDENTICAL "%8.6" "" /end COMPU_METHOD
/begin COMPU_METHOD autosar_swc_vmp_CM_single_s "Q = V" IDENTICAL "%8.6" "s" /end COMPU_METHOD
/begin COMPU_METHOD autosar_swc_vmp_CM_uint16 "Q = V" IDENTICAL "%5.0" "" /end COMPU_METHOD
/begin COMPU_METHOD autosar_swc_vmp_CM_uint32 "Q = V" IDENTICAL "%10.0" "" /end COMPU_METHOD
/begin COMPU_METHOD autosar_swc_vmp_CM_uint64 "Q = V" IDENTICAL "%20.0" "" /end COMPU_METHOD
/begin COMPU_METHOD autosar_swc_vmp_CM_uint8 "Q = V" IDENTICAL "%3.0" "" /end COMPU_METHOD
/begin RECORD_LAYOUT Record_BOOLEAN FNC_VALUES 1 UBYTE COLUMN_DIR DIRECT /end RECORD_LAYOUT
/begin RECORD_LAYOUT Record_FLOAT32_IEEE FNC_VALUES 1 FLOAT32_IEEE COLUMN_DIR DIRECT /end RECORD_LAYOUT
/begin RECORD_LAYOUT Record_UBYTE FNC_VALUES 1 UBYTE COLUMN_DIR DIRECT /end RECORD_LAYOUT
/begin RECORD_LAYOUT Axis_FLOAT32_IEEE AXIS_PTS_X 1 FLOAT32_IEEE INDEX_INCR DIRECT /end RECORD_LAYOUT
/begin GROUP SwcOut_LATP_HMI ""
 /begin REF_MEASUREMENT SwcOut_LATP_HMI.InfoDispHMI SwcOut_LATP_HMI.LcTarLocationDx SwcOut_LATP_HMI.LcTarLocationDy SwcOut_LATP_HMI.LcTarLocationHead SwcOut_LATP_HMI.LcHazObjDangerLevel SwcOut_LATP_HMI.LcTarPathPointX SwcOut_LATP_HMI.LcTarPathPointY SwcOut_LATP_HMI.LcHazObjId /end REF_MEASUREMENT
/end GROUP
/begin GROUP SwcOut_LONP_ACCPLAN ""
 /begin REF_MEASUREMENT SwcOut_LONP_ACCPLAN.ACC_BrakePrefer SwcOut_LONP_ACCPLAN.ACC_axvCvAim SwcOut_LONP_ACCPLAN.ACC_axv_ComfortBandLowerValue SwcOut_LONP_ACCPLAN.ACC_axv_ComfortBandUpperValue SwcOut_LONP_ACCPLAN.ACC_DecelerateJerk SwcOut_LONP_ACCPLAN.ACC_AccelerateJerk SwcOut_LONP_ACCPLAN.CurvSpdLim /end REF_MEASUREMENT
/end GROUP
/begin GROUP SwcOut_LONP_HMI ""
 /begin REF_MEASUREMENT SwcOut_LONP_HMI.TakeoverReq SwcOut_LONP_HMI.IntelligentCurveActive SwcOut_LONP_HMI.ACC_TgtObjBarDisp SwcOut_LONP_HMI.ACC_LeTgtObjBarDisp SwcOut_LONP_HMI.ACC_RiTgtObjBarDisp SwcOut_LONP_HMI.IDP0 SwcOut_LONP_HMI.IDP1 SwcOut_LONP_HMI.VehVelReqKap SwcOut_LONP_HMI.FollowTTC SwcOut_LONP_HMI.FollowNumMatrix SwcOut_LONP_HMI.FollowGapPX SwcOut_LONP_HMI.FollowTTCAccel SwcOut_LONP_HMI.TargetIDSwitch SwcOut_LONP_HMI.InsertSpceNumLetgo SwcOut_LONP_HMI.InsertSpceNum SwcOut_LONP_HMI.InsertSpceTEnd SwcOut_LONP_HMI.InsertSpceSEnd SwcOut_LONP_HMI.InsertSpceVEnd /end REF_MEASUREMENT
/end GROUP
/begin GROUP SwcOut_VMP_Herbeat_Info ""
 /begin REF_MEASUREMENT SwcOut_VMP_Herbeat_Info.swc_id SwcOut_VMP_Herbeat_Info.sequence_num SwcOut_VMP_Herbeat_Info.inner_error SwcOut_VMP_Herbeat_Info.module_status /end REF_MEASUREMENT
/end GROUP
/begin GROUP SwcOut_VMP_STS ""
 /begin REF_MEASUREMENT SwcOut_VMP_STS.pln_run_sts SwcOut_VMP_STS.lgt_pln_sts SwcOut_VMP_STS.lat_pln_sts SwcOut_VMP_STS.lgt_drive_sts SwcOut_VMP_STS.lc_exec_sts SwcOut_VMP_STS.lat_ctrl_mod SwcOut_VMP_STS.nudge_exec_sts SwcOut_VMP_STS.lc_req_sync_id SwcOut_VMP_STS.lc_failed_reason SwcOut_VMP_STS.lc_feasibility_conds SwcOut_VMP_STS.pln_inhibited_reason SwcOut_VMP_STS.pln_failed_reason /end REF_MEASUREMENT
/end GROUP
/begin GROUP SwcOut_VMP_TRAJ "" /begin SUB_GROUP SwcOut_VMP_TRAJ.st_poly SwcOut_VMP_TRAJ.xy_poly /end SUB_GROUP
 /begin REF_MEASUREMENT SwcOut_VMP_TRAJ.st_poly_valid SwcOut_VMP_TRAJ.xy_poly_valid SwcOut_VMP_TRAJ.updateCnt SwcOut_VMP_TRAJ.ref_lane_id /end REF_MEASUREMENT
/end GROUP
/begin GROUP SwcOut_VMP_TRAJ.st_poly ""
 /begin REF_MEASUREMENT SwcOut_VMP_TRAJ.st_poly.start SwcOut_VMP_TRAJ.st_poly.end SwcOut_VMP_TRAJ.st_poly.poly_vec /end REF_MEASUREMENT
/end GROUP
/begin GROUP SwcOut_VMP_TRAJ.xy_poly ""
 /begin REF_MEASUREMENT SwcOut_VMP_TRAJ.xy_poly.start SwcOut_VMP_TRAJ.xy_poly.end SwcOut_VMP_TRAJ.xy_poly.poly_vec /end REF_MEASUREMENT
/end GROUP
/begin GROUP VMP_ExecTimestamp ""
 /begin REF_MEASUREMENT VMP_ExecTimestamp.timeBaseStatus VMP_ExecTimestamp.nanoseconds VMP_ExecTimestamp.seconds /end REF_MEASUREMENT
/end GROUP
/begin GROUP ZDrive_BSW_Cal_Cal "" /begin SUB_GROUP ZDrive_BSW_Cal_Cal.ZDrive_BSW_Cal_VehicleInfomationTable /end SUB_GROUP /end GROUP
/begin GROUP autosar_swc_vmp "autosar_swc_vmp" ROOT
 /begin SUB_GROUP SwcOut_LONP_ACCPLAN SwcOut_LONP_HMI SwcOut_VMP_Herbeat_Info SwcOut_VMP_STS SwcOut_VMP_TRAJ VMP_ExecTimestamp autosar_swc_vmp_rtARID_DEF.BusAssignment autosar_swc_vmp_rtARID_DEF.ICAS_STATEOut autosar_swc_vmp_rtARID_DEF.TmpSignalConversionAtCSM_CTRLOutport1 autosar_swc_vmp_rtARID_DEF.UnitDelay1_DSTATE autosar_swc_vmp_autosar_swc_vmp_Step_sys /end SUB_GROUP
/end GROUP
/begin GROUP autosar_swc_vmp_autosar_swc_vmp_Step_sys "autosar_swc_vmp/autosar_swc_vmp_Step_sys"
 /begin SUB_GROUP autosar_swc_vmp_autosar_swc_vmp_Step_sys_Counter_Limited autosar_swc_vmp_autosar_swc_vmp_Step_sys_Counter_Limited1 autosar_swc_vmp_autosar_swc_vmp_Step_sys_lat_pln autosar_swc_vmp_autosar_swc_vmp_Step_sys_lc_pln autosar_swc_vmp_autosar_swc_vmp_Step_sys_lgt_pln /end SUB_GROUP
 /begin REF_MEASUREMENT LONP_FollowUpdate SwcOut_LONP_ArbFlag VMP_UpdateCnt VMP_Version autosar_swc_vmp_rtARID_DEF.lc_exec_sts autosar_swc_vmp_rtARID_DEF.lc_failed_reason autosar_swc_vmp_rtARID_DEF.lc_feasibility_conds autosar_swc_vmp_rtARID_DEF.lc_req_sync_id_exec /end REF_MEASUREMENT
/end GROUP
/begin GROUP autosar_swc_vmp_autosar_swc_vmp_Step_sys_Counter_Limited "autosar_swc_vmp/autosar_swc_vmp_Step_sys/Counter\nLimited"
 /begin SUB_GROUP autosar_swc_vmp_autosar_swc_vmp_Step_sys_Counter_Limited_Increment_Real_World /end SUB_GROUP
 /begin REF_MEASUREMENT VMP_UpdateCnt autosar_swc_vmp_rtARID_DEF.Output_DSTATE /end REF_MEASUREMENT
/end GROUP
/begin GROUP autosar_swc_vmp_autosar_swc_vmp_Step_sys_Counter_Limited1 "autosar_swc_vmp/autosar_swc_vmp_Step_sys/Counter\nLimited1" /begin REF_MEASUREMENT autosar_swc_vmp_rtARID_DEF.Output_DSTATE_b /end REF_MEASUREMENT /end GROUP
/begin GROUP autosar_swc_vmp_autosar_swc_vmp_Step_sys_Counter_Limited_Increment_Real_World "autosar_swc_vmp/autosar_swc_vmp_Step_sys/Counter\nLimited/Increment\nReal World" /begin REF_MEASUREMENT VMP_UpdateCnt /end REF_MEASUREMENT /end GROUP
/begin GROUP autosar_swc_vmp_autosar_swc_vmp_Step_sys_lat_pln "autosar_swc_vmp/autosar_swc_vmp_Step_sys/lat_pln"
 /begin SUB_GROUP autosar_swc_vmp_autosar_swc_vmp_Step_sys_lat_pln_latp_lat_pln autosar_swc_vmp_autosar_swc_vmp_Step_sys_lat_pln_latp_refline_arb /end SUB_GROUP
/end GROUP
/begin GROUP autosar_swc_vmp_autosar_swc_vmp_Step_sys_lat_pln_latp_lat_pln "autosar_swc_vmp/autosar_swc_vmp_Step_sys/lat_pln/latp_lat_pln"
 /begin SUB_GROUP autosar_swc_vmp_autosar_swc_vmp_Step_sys_lat_pln_latp_lat_pln_latp_tarline_pln /end SUB_GROUP
 /begin REF_CHARACTERISTIC P_LONP_StepTime P_VMP_DOPCheckExitSwitch P_VMP_DOPDyOffset P_VMP_DOPDyOffsetChangeLim P_VMP_DOPPredictTime P_VMP_DOPThetaOffset /end REF_CHARACTERISTIC
 /begin REF_MEASUREMENT autosar_swc_vmp_rtARID_DEF.TmpSignalConversionAtvxvRefMsOutport1 autosar_swc_vmp_rtARID_DEF.lc_exec_sts autosar_swc_vmp_rtARID_DEF.vehdyoffset autosar_swc_vmp_rtARID_DEF.vehdyoffsetmin autosar_swc_vmp_rtARID_DEF.vehthetaoffset /end REF_MEASUREMENT
/end GROUP
/begin GROUP autosar_swc_vmp_autosar_swc_vmp_Step_sys_lat_pln_latp_lat_pln_latp_tarline_pln "autosar_swc_vmp/autosar_swc_vmp_Step_sys/lat_pln/latp_lat_pln/latp_tarline_pln" /begin REF_CHARACTERISTIC P_VMP_LaneJumpCheckLimValue /end REF_CHARACTERISTIC /begin REF_MEASUREMENT autosar_swc_vmp_rtARID_DEF.TarLine_lane_sourcek1 /end REF_MEASUREMENT /end GROUP
/begin GROUP autosar_swc_vmp_autosar_swc_vmp_Step_sys_lat_pln_latp_refline_arb "autosar_swc_vmp/autosar_swc_vmp_Step_sys/lat_pln/latp_refline_arb" /begin REF_MEASUREMENT VMP_Nudge_Dis autosar_swc_vmp_rtARID_DEF.lc_exec_sts /end REF_MEASUREMENT /end GROUP
/begin GROUP autosar_swc_vmp_autosar_swc_vmp_Step_sys_lc_pln "autosar_swc_vmp/autosar_swc_vmp_Step_sys/lc_pln"
 /begin SUB_GROUP autosar_swc_vmp_autosar_swc_vmp_Step_sys_lc_pln_lc_cipv_prechk autosar_swc_vmp_autosar_swc_vmp_Step_sys_lc_pln_lc_lane_input autosar_swc_vmp_autosar_swc_vmp_Step_sys_lc_pln_lc_lane_prechk autosar_swc_vmp_autosar_swc_vmp_Step_sys_lc_pln_lc_veh_pos autosar_swc_vmp_autosar_swc_vmp_Step_sys_lc_pln_lcc_lane_check autosar_swc_vmp_autosar_swc_vmp_Step_sys_lc_pln_lgt_veh_sts /end SUB_GROUP
 /begin REF_CHARACTERISTIC P_LONP_StepTime P_VMP_DriveOffCount P_VMP_DriveOffaxvlim P_VMP_DriveOffspeed P_VMP_LCInsReadTime P_VMP_LCReadTime P_VMP_OverridelowspeedLim /end REF_CHARACTERISTIC
 /begin REF_MEASUREMENT SwcOut_LONP_DecelToStopReq VMP_forceCancelPathIndex VMP_lane_force_cancel_pass VMP_lane_force_cancel_reason VMP_lc_lane_cancel_pass VMP_lc_lane_cancel_reason VMP_lc_lane_chk_lm_pass VMP_lc_lane_chk_lm_reason VMP_lc_lane_chk_loose_pass VMP_lc_lane_chk_loose_reason VMP_veh_in_force_cancel_lane VMP_veh_lc_pos autosar_swc_vmp_rtARID_DEF.ACCModeSts autosar_swc_vmp_rtARID_DEF.SelectLaneIdx autosar_swc_vmp_rtARID_DEF.TmpSignalConversionAtvxvRefMsOutport1 autosar_swc_vmp_rtARID_DEF.UnitDelay1_DSTATE_hn autosar_swc_vmp_rtARID_DEF.UnitDelay_DSTATE_gw autosar_swc_vmp_rtARID_DEF.count autosar_swc_vmp_rtARID_DEF.is_active autosar_swc_vmp_rtARID_DEF.is_active_c502_autosar_swc_vmp autosar_swc_vmp_rtARID_DEF.is_active_c505_autosar_swc_vmp autosar_swc_vmp_rtARID_DEF.is_c502_autosar_swc_vmp autosar_swc_vmp_rtARID_DEF.is_c505_autosar_swc_vmp autosar_swc_vmp_rtARID_DEF.is_cruise_in_center autosar_swc_vmp_rtARID_DEF.is_lanechanging autosar_swc_vmp_rtARID_DEF.is_run autosar_swc_vmp_rtARID_DEF.lc_dir autosar_swc_vmp_rtARID_DEF.lc_exec_sts autosar_swc_vmp_rtARID_DEF.lc_failed_reason autosar_swc_vmp_rtARID_DEF.lc_feasibility_conds autosar_swc_vmp_rtARID_DEF.lc_req_sync_id_exec autosar_swc_vmp_rtARID_DEF.overtime autosar_swc_vmp_rtARID_DEF.readtime autosar_swc_vmp_rtARID_DEF.tp_lanechanging /end REF_MEASUREMENT
/end GROUP
/begin GROUP autosar_swc_vmp_autosar_swc_vmp_Step_sys_lc_pln_lc_cipv_prechk "autosar_swc_vmp/autosar_swc_vmp_Step_sys/lc_pln/lc_cipv_prechk"
 /begin SUB_GROUP autosar_swc_vmp_autosar_swc_vmp_Step_sys_lc_pln_lc_cipv_prechk_Compare_To_Constant2 autosar_swc_vmp_autosar_swc_vmp_Step_sys_lc_pln_lc_cipv_prechk_Compare_To_Constant3 /end SUB_GROUP
 /begin REF_CHARACTERISTIC P_VMP_BfObjCorrectThresholdDX P_VMP_DPC_DPCValue2DX P_VMP_DPC_DPCValue2DX_After P_VMP_DPC_DPCValue2TTC P_VMP_DPC_DPCValue2TTC_After P_VMP_DPC_DXValue P_VMP_DPC_TTCValue P_VMP_DPC_VehpresictTime P_VMP_afterObjCorrectThresholdDX /end REF_CHARACTERISTIC
 /begin REF_MEASUREMENT VMP_TarPathResk_F VMP_TarPathResk_R VMP_obj_back_risk_id VMP_obj_front_risk_id VMP_obj_select_back_Max_Dx VMP_obj_select_back_Min_TTC VMP_obj_select_front_Min_Dx VMP_obj_select_front_Min_TTC autosar_swc_vmp_rtARID_DEF.TmpSignalConversionAtaxvRefMs2Outport1 autosar_swc_vmp_rtARID_DEF.TmpSignalConversionAtvxvRefMsOutport1 /end REF_MEASUREMENT
/end GROUP
/begin GROUP autosar_swc_vmp_autosar_swc_vmp_Step_sys_lc_pln_lc_cipv_prechk_Compare_To_Constant2 "autosar_swc_vmp/autosar_swc_vmp_Step_sys/lc_pln/lc_cipv_prechk/Compare\nTo Constant2" /begin REF_MEASUREMENT VMP_TarPathResk_F /end REF_MEASUREMENT /end GROUP
/begin GROUP autosar_swc_vmp_autosar_swc_vmp_Step_sys_lc_pln_lc_cipv_prechk_Compare_To_Constant3 "autosar_swc_vmp/autosar_swc_vmp_Step_sys/lc_pln/lc_cipv_prechk/Compare\nTo Constant3" /begin REF_MEASUREMENT VMP_TarPathResk_R /end REF_MEASUREMENT /end GROUP
/begin GROUP autosar_swc_vmp_autosar_swc_vmp_Step_sys_lc_pln_lc_lane_input "autosar_swc_vmp/autosar_swc_vmp_Step_sys/lc_pln/lc_lane_input"
 /begin REF_MEASUREMENT VMP_forceCancelPathIndex autosar_swc_vmp_rtARID_DEF.TmpSignalConversionAtvxvRefMsOutport1 /end REF_MEASUREMENT
/end GROUP
/begin GROUP autosar_swc_vmp_autosar_swc_vmp_Step_sys_lc_pln_lc_lane_prechk "autosar_swc_vmp/autosar_swc_vmp_Step_sys/lc_pln/lc_lane_prechk"
 /begin SUB_GROUP autosar_swc_vmp_autosar_swc_vmp_Step_sys_lc_pln_lc_lane_prechk_TrueDurationTime1 autosar_swc_vmp_autosar_swc_vmp_Step_sys_lc_pln_lc_lane_prechk_TrueDurationTime10 autosar_swc_vmp_autosar_swc_vmp_Step_sys_lc_pln_lc_lane_prechk_TrueDurationTime11 autosar_swc_vmp_autosar_swc_vmp_Step_sys_lc_pln_lc_lane_prechk_TrueDurationTime12 autosar_swc_vmp_autosar_swc_vmp_Step_sys_lc_pln_lc_lane_prechk_TrueDurationTime13 autosar_swc_vmp_autosar_swc_vmp_Step_sys_lc_pln_lc_lane_prechk_TrueDurationTime14 autosar_swc_vmp_autosar_swc_vmp_Step_sys_lc_pln_lc_lane_prechk_TrueDurationTime15 autosar_swc_vmp_autosar_swc_vmp_Step_sys_lc_pln_lc_lane_prechk_TrueDurationTime16 autosar_swc_vmp_autosar_swc_vmp_Step_sys_lc_pln_lc_lane_prechk_TrueDurationTime17 autosar_swc_vmp_autosar_swc_vmp_Step_sys_lc_pln_lc_lane_prechk_TrueDurationTime18 autosar_swc_vmp_autosar_swc_vmp_Step_sys_lc_pln_lc_lane_prechk_TrueDurationTime19 autosar_swc_vmp_autosar_swc_vmp_Step_sys_lc_pln_lc_lane_prechk_TrueDurationTime2 autosar_swc_vmp_autosar_swc_vmp_Step_sys_lc_pln_lc_lane_prechk_TrueDurationTime20 autosar_swc_vmp_autosar_swc_vmp_Step_sys_lc_pln_lc_lane_prechk_TrueDurationTime21 autosar_swc_vmp_autosar_swc_vmp_Step_sys_lc_pln_lc_lane_prechk_TrueDurationTime22 autosar_swc_vmp_autosar_swc_vmp_Step_sys_lc_pln_lc_lane_prechk_TrueDurationTime23 autosar_swc_vmp_autosar_swc_vmp_Step_sys_lc_pln_lc_lane_prechk_TrueDurationTime24 autosar_swc_vmp_autosar_swc_vmp_Step_sys_lc_pln_lc_lane_prechk_TrueDurationTime25 autosar_swc_vmp_autosar_swc_vmp_Step_sys_lc_pln_lc_lane_prechk_TrueDurationTime26 autosar_swc_vmp_autosar_swc_vmp_Step_sys_lc_pln_lc_lane_prechk_TrueDurationTime27 autosar_swc_vmp_autosar_swc_vmp_Step_sys_lc_pln_lc_lane_prechk_TrueDurationTime29 autosar_swc_vmp_autosar_swc_vmp_Step_sys_lc_pln_lc_lane_prechk_TrueDurationTime3 autosar_swc_vmp_autosar_swc_vmp_Step_sys_lc_pln_lc_lane_prechk_TrueDurationTime30 autosar_swc_vmp_autosar_swc_vmp_Step_sys_lc_pln_lc_lane_prechk_TrueDurationTime32 autosar_swc_vmp_autosar_swc_vmp_Step_sys_lc_pln_lc_lane_prechk_TrueDurationTime5 autosar_swc_vmp_autosar_swc_vmp_Step_sys_lc_pln_lc_lane_prechk_TrueDurationTime6 autosar_swc_vmp_autosar_swc_vmp_Step_sys_lc_pln_lc_lane_prechk_TrueDurationTime7 autosar_swc_vmp_autosar_swc_vmp_Step_sys_lc_pln_lc_lane_prechk_TrueDurationTime8 autosar_swc_vmp_autosar_swc_vmp_Step_sys_lc_pln_lc_lane_prechk_TrueDurationTime9 /end SUB_GROUP
 /begin REF_CHARACTERISTIC P_VMP_ConstrainCheckTime /end REF_CHARACTERISTIC
 /begin REF_MEASUREMENT VMP_lane_force_cancel_pass VMP_lane_force_cancel_reason VMP_lc_lane_cancel_pass VMP_lc_lane_cancel_reason VMP_lc_lane_chk_lm_pass VMP_lc_lane_chk_lm_reason VMP_lc_lane_chk_loose_pass VMP_lc_lane_chk_loose_reason autosar_swc_vmp_rtARID_DEF.TmpSignalConversionAtvxvRefMsOutport1 autosar_swc_vmp_rtARID_DEF.UnitDelay_DSTATE_fd autosar_swc_vmp_rtARID_DEF.lc_exec_sts /end REF_MEASUREMENT
/end GROUP
/begin GROUP autosar_swc_vmp_autosar_swc_vmp_Step_sys_lc_pln_lc_lane_prechk_TrueDurationTime1 "autosar_swc_vmp/autosar_swc_vmp_Step_sys/lc_pln/lc_lane_prechk/TrueDurationTime1" /begin REF_CHARACTERISTIC P_LONP_StepTime /end REF_CHARACTERISTIC
 /begin REF_MEASUREMENT autosar_swc_vmp_rtARID_DEF.UnitDelay1_DSTATE_n autosar_swc_vmp_rtARID_DEF.UnitDelay2_DSTATE_fj /end REF_MEASUREMENT
/end GROUP
/begin GROUP autosar_swc_vmp_autosar_swc_vmp_Step_sys_lc_pln_lc_lane_prechk_TrueDurationTime10 "autosar_swc_vmp/autosar_swc_vmp_Step_sys/lc_pln/lc_lane_prechk/TrueDurationTime10" /begin REF_CHARACTERISTIC P_LONP_StepTime /end REF_CHARACTERISTIC
 /begin REF_MEASUREMENT autosar_swc_vmp_rtARID_DEF.UnitDelay1_DSTATE_nd autosar_swc_vmp_rtARID_DEF.UnitDelay2_DSTATE_fw /end REF_MEASUREMENT
/end GROUP
/begin GROUP autosar_swc_vmp_autosar_swc_vmp_Step_sys_lc_pln_lc_lane_prechk_TrueDurationTime11 "autosar_swc_vmp/autosar_swc_vmp_Step_sys/lc_pln/lc_lane_prechk/TrueDurationTime11" /begin REF_CHARACTERISTIC P_LONP_StepTime /end REF_CHARACTERISTIC
 /begin REF_MEASUREMENT autosar_swc_vmp_rtARID_DEF.UnitDelay1_DSTATE_pf autosar_swc_vmp_rtARID_DEF.UnitDelay2_DSTATE_pa /end REF_MEASUREMENT
/end GROUP
/begin GROUP autosar_swc_vmp_autosar_swc_vmp_Step_sys_lc_pln_lc_lane_prechk_TrueDurationTime12 "autosar_swc_vmp/autosar_swc_vmp_Step_sys/lc_pln/lc_lane_prechk/TrueDurationTime12" /begin REF_CHARACTERISTIC P_LONP_StepTime /end REF_CHARACTERISTIC
 /begin REF_MEASUREMENT autosar_swc_vmp_rtARID_DEF.UnitDelay1_DSTATE_pfa autosar_swc_vmp_rtARID_DEF.UnitDelay2_DSTATE_av /end REF_MEASUREMENT
/end GROUP
/begin GROUP autosar_swc_vmp_autosar_swc_vmp_Step_sys_lc_pln_lc_lane_prechk_TrueDurationTime13 "autosar_swc_vmp/autosar_swc_vmp_Step_sys/lc_pln/lc_lane_prechk/TrueDurationTime13" /begin REF_CHARACTERISTIC P_LONP_StepTime /end REF_CHARACTERISTIC
 /begin REF_MEASUREMENT autosar_swc_vmp_rtARID_DEF.UnitDelay1_DSTATE_j autosar_swc_vmp_rtARID_DEF.UnitDelay2_DSTATE_mo /end REF_MEASUREMENT
/end GROUP
/begin GROUP autosar_swc_vmp_autosar_swc_vmp_Step_sys_lc_pln_lc_lane_prechk_TrueDurationTime14 "autosar_swc_vmp/autosar_swc_vmp_Step_sys/lc_pln/lc_lane_prechk/TrueDurationTime14" /begin REF_CHARACTERISTIC P_LONP_StepTime /end REF_CHARACTERISTIC
 /begin REF_MEASUREMENT autosar_swc_vmp_rtARID_DEF.UnitDelay1_DSTATE_lc autosar_swc_vmp_rtARID_DEF.UnitDelay2_DSTATE_n /end REF_MEASUREMENT
/end GROUP
/begin GROUP autosar_swc_vmp_autosar_swc_vmp_Step_sys_lc_pln_lc_lane_prechk_TrueDurationTime15 "autosar_swc_vmp/autosar_swc_vmp_Step_sys/lc_pln/lc_lane_prechk/TrueDurationTime15" /begin REF_CHARACTERISTIC P_LONP_StepTime /end REF_CHARACTERISTIC
 /begin REF_MEASUREMENT autosar_swc_vmp_rtARID_DEF.UnitDelay1_DSTATE_pi autosar_swc_vmp_rtARID_DEF.UnitDelay2_DSTATE_dm /end REF_MEASUREMENT
/end GROUP
/begin GROUP autosar_swc_vmp_autosar_swc_vmp_Step_sys_lc_pln_lc_lane_prechk_TrueDurationTime16 "autosar_swc_vmp/autosar_swc_vmp_Step_sys/lc_pln/lc_lane_prechk/TrueDurationTime16" /begin REF_CHARACTERISTIC P_LONP_StepTime /end REF_CHARACTERISTIC
 /begin REF_MEASUREMENT autosar_swc_vmp_rtARID_DEF.UnitDelay1_DSTATE_iy autosar_swc_vmp_rtARID_DEF.UnitDelay2_DSTATE_bx /end REF_MEASUREMENT
/end GROUP
/begin GROUP autosar_swc_vmp_autosar_swc_vmp_Step_sys_lc_pln_lc_lane_prechk_TrueDurationTime17 "autosar_swc_vmp/autosar_swc_vmp_Step_sys/lc_pln/lc_lane_prechk/TrueDurationTime17" /begin REF_CHARACTERISTIC P_LONP_StepTime /end REF_CHARACTERISTIC
 /begin REF_MEASUREMENT autosar_swc_vmp_rtARID_DEF.UnitDelay1_DSTATE_am autosar_swc_vmp_rtARID_DEF.UnitDelay2_DSTATE_j /end REF_MEASUREMENT
/end GROUP
/begin GROUP autosar_swc_vmp_autosar_swc_vmp_Step_sys_lc_pln_lc_lane_prechk_TrueDurationTime18 "autosar_swc_vmp/autosar_swc_vmp_Step_sys/lc_pln/lc_lane_prechk/TrueDurationTime18" /begin REF_CHARACTERISTIC P_LONP_StepTime /end REF_CHARACTERISTIC
 /begin REF_MEASUREMENT autosar_swc_vmp_rtARID_DEF.UnitDelay1_DSTATE_f2 autosar_swc_vmp_rtARID_DEF.UnitDelay2_DSTATE_c4 /end REF_MEASUREMENT
/end GROUP
/begin GROUP autosar_swc_vmp_autosar_swc_vmp_Step_sys_lc_pln_lc_lane_prechk_TrueDurationTime19 "autosar_swc_vmp/autosar_swc_vmp_Step_sys/lc_pln/lc_lane_prechk/TrueDurationTime19" /begin REF_CHARACTERISTIC P_LONP_StepTime /end REF_CHARACTERISTIC
 /begin REF_MEASUREMENT autosar_swc_vmp_rtARID_DEF.UnitDelay1_DSTATE_pd autosar_swc_vmp_rtARID_DEF.UnitDelay2_DSTATE_g /end REF_MEASUREMENT
/end GROUP
/begin GROUP autosar_swc_vmp_autosar_swc_vmp_Step_sys_lc_pln_lc_lane_prechk_TrueDurationTime2 "autosar_swc_vmp/autosar_swc_vmp_Step_sys/lc_pln/lc_lane_prechk/TrueDurationTime2" /begin REF_CHARACTERISTIC P_LONP_StepTime /end REF_CHARACTERISTIC
 /begin REF_MEASUREMENT autosar_swc_vmp_rtARID_DEF.UnitDelay1_DSTATE_m autosar_swc_vmp_rtARID_DEF.UnitDelay2_DSTATE_m /end REF_MEASUREMENT
/end GROUP
/begin GROUP autosar_swc_vmp_autosar_swc_vmp_Step_sys_lc_pln_lc_lane_prechk_TrueDurationTime20 "autosar_swc_vmp/autosar_swc_vmp_Step_sys/lc_pln/lc_lane_prechk/TrueDurationTime20" /begin REF_CHARACTERISTIC P_LONP_StepTime /end REF_CHARACTERISTIC
 /begin REF_MEASUREMENT autosar_swc_vmp_rtARID_DEF.UnitDelay1_DSTATE_ie autosar_swc_vmp_rtARID_DEF.UnitDelay2_DSTATE_h5l /end REF_MEASUREMENT
/end GROUP
/begin GROUP autosar_swc_vmp_autosar_swc_vmp_Step_sys_lc_pln_lc_lane_prechk_TrueDurationTime21 "autosar_swc_vmp/autosar_swc_vmp_Step_sys/lc_pln/lc_lane_prechk/TrueDurationTime21" /begin REF_CHARACTERISTIC P_LONP_StepTime /end REF_CHARACTERISTIC
 /begin REF_MEASUREMENT autosar_swc_vmp_rtARID_DEF.UnitDelay1_DSTATE_ed autosar_swc_vmp_rtARID_DEF.UnitDelay2_DSTATE_ie /end REF_MEASUREMENT
/end GROUP
/begin GROUP autosar_swc_vmp_autosar_swc_vmp_Step_sys_lc_pln_lc_lane_prechk_TrueDurationTime22 "autosar_swc_vmp/autosar_swc_vmp_Step_sys/lc_pln/lc_lane_prechk/TrueDurationTime22" /begin REF_CHARACTERISTIC P_LONP_StepTime /end REF_CHARACTERISTIC
 /begin REF_MEASUREMENT autosar_swc_vmp_rtARID_DEF.UnitDelay1_DSTATE_jr autosar_swc_vmp_rtARID_DEF.UnitDelay2_DSTATE_o1 /end REF_MEASUREMENT
/end GROUP
/begin GROUP autosar_swc_vmp_autosar_swc_vmp_Step_sys_lc_pln_lc_lane_prechk_TrueDurationTime23 "autosar_swc_vmp/autosar_swc_vmp_Step_sys/lc_pln/lc_lane_prechk/TrueDurationTime23" /begin REF_CHARACTERISTIC P_LONP_StepTime /end REF_CHARACTERISTIC
 /begin REF_MEASUREMENT autosar_swc_vmp_rtARID_DEF.UnitDelay1_DSTATE_f autosar_swc_vmp_rtARID_DEF.UnitDelay2_DSTATE_dk /end REF_MEASUREMENT
/end GROUP
/begin GROUP autosar_swc_vmp_autosar_swc_vmp_Step_sys_lc_pln_lc_lane_prechk_TrueDurationTime24 "autosar_swc_vmp/autosar_swc_vmp_Step_sys/lc_pln/lc_lane_prechk/TrueDurationTime24" /begin REF_CHARACTERISTIC P_LONP_StepTime /end REF_CHARACTERISTIC
 /begin REF_MEASUREMENT autosar_swc_vmp_rtARID_DEF.UnitDelay1_DSTATE_ji autosar_swc_vmp_rtARID_DEF.UnitDelay2_DSTATE_e /end REF_MEASUREMENT
/end GROUP
/begin GROUP autosar_swc_vmp_autosar_swc_vmp_Step_sys_lc_pln_lc_lane_prechk_TrueDurationTime25 "autosar_swc_vmp/autosar_swc_vmp_Step_sys/lc_pln/lc_lane_prechk/TrueDurationTime25" /begin REF_CHARACTERISTIC P_LONP_StepTime /end REF_CHARACTERISTIC
 /begin REF_MEASUREMENT autosar_swc_vmp_rtARID_DEF.UnitDelay1_DSTATE_i3 autosar_swc_vmp_rtARID_DEF.UnitDelay2_DSTATE_o /end REF_MEASUREMENT
/end GROUP
/begin GROUP autosar_swc_vmp_autosar_swc_vmp_Step_sys_lc_pln_lc_lane_prechk_TrueDurationTime26 "autosar_swc_vmp/autosar_swc_vmp_Step_sys/lc_pln/lc_lane_prechk/TrueDurationTime26" /begin REF_CHARACTERISTIC P_LONP_StepTime /end REF_CHARACTERISTIC
 /begin REF_MEASUREMENT autosar_swc_vmp_rtARID_DEF.UnitDelay1_DSTATE_m2 autosar_swc_vmp_rtARID_DEF.UnitDelay2_DSTATE_p3 /end REF_MEASUREMENT
/end GROUP
/begin GROUP autosar_swc_vmp_autosar_swc_vmp_Step_sys_lc_pln_lc_lane_prechk_TrueDurationTime27 "autosar_swc_vmp/autosar_swc_vmp_Step_sys/lc_pln/lc_lane_prechk/TrueDurationTime27" /begin REF_CHARACTERISTIC P_LONP_StepTime /end REF_CHARACTERISTIC
 /begin REF_MEASUREMENT autosar_swc_vmp_rtARID_DEF.UnitDelay1_DSTATE_ao autosar_swc_vmp_rtARID_DEF.UnitDelay2_DSTATE_l /end REF_MEASUREMENT
/end GROUP
/begin GROUP autosar_swc_vmp_autosar_swc_vmp_Step_sys_lc_pln_lc_lane_prechk_TrueDurationTime29 "autosar_swc_vmp/autosar_swc_vmp_Step_sys/lc_pln/lc_lane_prechk/TrueDurationTime29" /begin REF_CHARACTERISTIC P_LONP_StepTime /end REF_CHARACTERISTIC
 /begin REF_MEASUREMENT autosar_swc_vmp_rtARID_DEF.UnitDelay1_DSTATE_mb autosar_swc_vmp_rtARID_DEF.UnitDelay2_DSTATE_h5 /end REF_MEASUREMENT
/end GROUP
/begin GROUP autosar_swc_vmp_autosar_swc_vmp_Step_sys_lc_pln_lc_lane_prechk_TrueDurationTime3 "autosar_swc_vmp/autosar_swc_vmp_Step_sys/lc_pln/lc_lane_prechk/TrueDurationTime3" /begin REF_CHARACTERISTIC P_LONP_StepTime /end REF_CHARACTERISTIC
 /begin REF_MEASUREMENT autosar_swc_vmp_rtARID_DEF.UnitDelay1_DSTATE_cv autosar_swc_vmp_rtARID_DEF.UnitDelay2_DSTATE_i /end REF_MEASUREMENT
/end GROUP
/begin GROUP autosar_swc_vmp_autosar_swc_vmp_Step_sys_lc_pln_lc_lane_prechk_TrueDurationTime30 "autosar_swc_vmp/autosar_swc_vmp_Step_sys/lc_pln/lc_lane_prechk/TrueDurationTime30" /begin REF_CHARACTERISTIC P_LONP_StepTime /end REF_CHARACTERISTIC
 /begin REF_MEASUREMENT autosar_swc_vmp_rtARID_DEF.UnitDelay1_DSTATE_cf autosar_swc_vmp_rtARID_DEF.UnitDelay2_DSTATE_ib /end REF_MEASUREMENT
/end GROUP
/begin GROUP autosar_swc_vmp_autosar_swc_vmp_Step_sys_lc_pln_lc_lane_prechk_TrueDurationTime32 "autosar_swc_vmp/autosar_swc_vmp_Step_sys/lc_pln/lc_lane_prechk/TrueDurationTime32" /begin REF_CHARACTERISTIC P_LONP_StepTime /end REF_CHARACTERISTIC
 /begin REF_MEASUREMENT autosar_swc_vmp_rtARID_DEF.UnitDelay1_DSTATE_mo autosar_swc_vmp_rtARID_DEF.UnitDelay2_DSTATE_c /end REF_MEASUREMENT
/end GROUP
/begin GROUP autosar_swc_vmp_autosar_swc_vmp_Step_sys_lc_pln_lc_lane_prechk_TrueDurationTime5 "autosar_swc_vmp/autosar_swc_vmp_Step_sys/lc_pln/lc_lane_prechk/TrueDurationTime5" /begin REF_CHARACTERISTIC P_LONP_StepTime /end REF_CHARACTERISTIC
 /begin REF_MEASUREMENT autosar_swc_vmp_rtARID_DEF.UnitDelay1_DSTATE_it autosar_swc_vmp_rtARID_DEF.UnitDelay2_DSTATE_pg /end REF_MEASUREMENT
/end GROUP
/begin GROUP autosar_swc_vmp_autosar_swc_vmp_Step_sys_lc_pln_lc_lane_prechk_TrueDurationTime6 "autosar_swc_vmp/autosar_swc_vmp_Step_sys/lc_pln/lc_lane_prechk/TrueDurationTime6" /begin REF_CHARACTERISTIC P_LONP_StepTime /end REF_CHARACTERISTIC
 /begin REF_MEASUREMENT autosar_swc_vmp_rtARID_DEF.UnitDelay1_DSTATE_jd autosar_swc_vmp_rtARID_DEF.UnitDelay2_DSTATE_gj /end REF_MEASUREMENT
/end GROUP
/begin GROUP autosar_swc_vmp_autosar_swc_vmp_Step_sys_lc_pln_lc_lane_prechk_TrueDurationTime7 "autosar_swc_vmp/autosar_swc_vmp_Step_sys/lc_pln/lc_lane_prechk/TrueDurationTime7" /begin REF_CHARACTERISTIC P_LONP_StepTime /end REF_CHARACTERISTIC
 /begin REF_MEASUREMENT autosar_swc_vmp_rtARID_DEF.UnitDelay1_DSTATE_o autosar_swc_vmp_rtARID_DEF.UnitDelay2_DSTATE_d /end REF_MEASUREMENT
/end GROUP
/begin GROUP autosar_swc_vmp_autosar_swc_vmp_Step_sys_lc_pln_lc_lane_prechk_TrueDurationTime8 "autosar_swc_vmp/autosar_swc_vmp_Step_sys/lc_pln/lc_lane_prechk/TrueDurationTime8" /begin REF_CHARACTERISTIC P_LONP_StepTime /end REF_CHARACTERISTIC
 /begin REF_MEASUREMENT autosar_swc_vmp_rtARID_DEF.UnitDelay1_DSTATE_p autosar_swc_vmp_rtARID_DEF.UnitDelay2_DSTATE_b /end REF_MEASUREMENT
/end GROUP
/begin GROUP autosar_swc_vmp_autosar_swc_vmp_Step_sys_lc_pln_lc_lane_prechk_TrueDurationTime9 "autosar_swc_vmp/autosar_swc_vmp_Step_sys/lc_pln/lc_lane_prechk/TrueDurationTime9" /begin REF_CHARACTERISTIC P_LONP_StepTime /end REF_CHARACTERISTIC
 /begin REF_MEASUREMENT autosar_swc_vmp_rtARID_DEF.UnitDelay1_DSTATE_e autosar_swc_vmp_rtARID_DEF.UnitDelay2_DSTATE_h /end REF_MEASUREMENT
/end GROUP
/begin GROUP autosar_swc_vmp_autosar_swc_vmp_Step_sys_lc_pln_lc_veh_pos "autosar_swc_vmp/autosar_swc_vmp_Step_sys/lc_pln/lc_veh_pos"
 /begin REF_MEASUREMENT VMP_veh_in_force_cancel_lane VMP_veh_lc_pos autosar_swc_vmp_rtARID_DEF.TmpSignalConversionAtvxvRefMsOutport1 autosar_swc_vmp_rtARID_DEF.veh_lc_pos /end REF_MEASUREMENT
/end GROUP
/begin GROUP autosar_swc_vmp_autosar_swc_vmp_Step_sys_lc_pln_lcc_lane_check "autosar_swc_vmp/autosar_swc_vmp_Step_sys/lc_pln/lcc_lane_check"
 /begin SUB_GROUP autosar_swc_vmp_autosar_swc_vmp_Step_sys_lc_pln_lcc_lane_check_Compare_To_Constant15 autosar_swc_vmp_autosar_swc_vmp_Step_sys_lc_pln_lcc_lane_check_Compare_To_Constant2 autosar_swc_vmp_autosar_swc_vmp_Step_sys_lc_pln_lcc_lane_check_Compare_To_Constant3 autosar_swc_vmp_autosar_swc_vmp_Step_sys_lc_pln_lcc_lane_check_Compare_To_Constant9 autosar_swc_vmp_autosar_swc_vmp_Step_sys_lc_pln_lcc_lane_check_Subsystem autosar_swc_vmp_autosar_swc_vmp_Step_sys_lc_pln_lcc_lane_check_TrueDurationTime1 autosar_swc_vmp_autosar_swc_vmp_Step_sys_lc_pln_lcc_lane_check_TrueDurationTime2 autosar_swc_vmp_autosar_swc_vmp_Step_sys_lc_pln_lcc_lane_check_TrueDurationTime3 autosar_swc_vmp_autosar_swc_vmp_Step_sys_lc_pln_lcc_lane_check_TrueDurationTime4 autosar_swc_vmp_autosar_swc_vmp_Step_sys_lc_pln_lcc_lane_check_TrueDurationTime5 autosar_swc_vmp_autosar_swc_vmp_Step_sys_lc_pln_lcc_lane_check_TrueDurationTime6 autosar_swc_vmp_autosar_swc_vmp_Step_sys_lc_pln_lcc_lane_check_TrueDurationTime7 autosar_swc_vmp_autosar_swc_vmp_Step_sys_lc_pln_lcc_lane_check_TrueDurationTime8 autosar_swc_vmp_autosar_swc_vmp_Step_sys_lc_pln_lcc_lane_check_system /end SUB_GROUP
 /begin REF_CHARACTERISTIC P_VMP_CurveLaneActiveMaxOffsetDy P_VMP_SafeStopEndDistLim /end REF_CHARACTERISTIC
 /begin REF_MEASUREMENT autosar_swc_vmp_rtARID_DEF.FLWhelDyst autosar_swc_vmp_rtARID_DEF.FRWhelDyst autosar_swc_vmp_rtARID_DEF.TmpSignalConversionAtvxvRefMsOutport1 autosar_swc_vmp_rtARID_DEF.lc_exec_sts autosar_swc_vmp_rtARID_DEF.safestop /end REF_MEASUREMENT
/end GROUP
/begin GROUP autosar_swc_vmp_autosar_swc_vmp_Step_sys_lc_pln_lcc_lane_check_Compare_To_Constant15 "autosar_swc_vmp/autosar_swc_vmp_Step_sys/lc_pln/lcc_lane_check/Compare\nTo Constant15" /begin REF_MEASUREMENT autosar_swc_vmp_rtARID_DEF.lc_exec_sts /end REF_MEASUREMENT /end GROUP
/begin GROUP autosar_swc_vmp_autosar_swc_vmp_Step_sys_lc_pln_lcc_lane_check_Compare_To_Constant2 "autosar_swc_vmp/autosar_swc_vmp_Step_sys/lc_pln/lcc_lane_check/Compare To Constant2" /begin REF_CHARACTERISTIC P_VMP_LaneCheckActiveTarLineVldTime /end REF_CHARACTERISTIC /end GROUP
/begin GROUP autosar_swc_vmp_autosar_swc_vmp_Step_sys_lc_pln_lcc_lane_check_Compare_To_Constant3 "autosar_swc_vmp/autosar_swc_vmp_Step_sys/lc_pln/lcc_lane_check/Compare To Constant3" /begin REF_CHARACTERISTIC P_VMP_LaneCheckActiveTarLineWidthTime /end REF_CHARACTERISTIC /end GROUP
/begin GROUP autosar_swc_vmp_autosar_swc_vmp_Step_sys_lc_pln_lcc_lane_check_Compare_To_Constant9 "autosar_swc_vmp/autosar_swc_vmp_Step_sys/lc_pln/lcc_lane_check/Compare\nTo Constant9" /begin REF_CHARACTERISTIC P_VMP_SafeStopDebounceTime /end REF_CHARACTERISTIC /end GROUP
/begin GROUP autosar_swc_vmp_autosar_swc_vmp_Step_sys_lc_pln_lcc_lane_check_Subsystem "autosar_swc_vmp/autosar_swc_vmp_Step_sys/lc_pln/lcc_lane_check/Subsystem"
 /begin REF_MEASUREMENT autosar_swc_vmp_rtARID_DEF.TmpSignalConversionAtvxvRefMsOutport1 /end REF_MEASUREMENT
/end GROUP
/begin GROUP autosar_swc_vmp_autosar_swc_vmp_Step_sys_lc_pln_lcc_lane_check_TrueDurationTime1 "autosar_swc_vmp/autosar_swc_vmp_Step_sys/lc_pln/lcc_lane_check/TrueDurationTime1" /begin REF_CHARACTERISTIC P_LONP_StepTime /end REF_CHARACTERISTIC
 /begin REF_MEASUREMENT autosar_swc_vmp_rtARID_DEF.UnitDelay1_DSTATE_j1 autosar_swc_vmp_rtARID_DEF.UnitDelay2_DSTATE_n4 /end REF_MEASUREMENT
/end GROUP
/begin GROUP autosar_swc_vmp_autosar_swc_vmp_Step_sys_lc_pln_lcc_lane_check_TrueDurationTime2 "autosar_swc_vmp/autosar_swc_vmp_Step_sys/lc_pln/lcc_lane_check/TrueDurationTime2" /begin REF_CHARACTERISTIC P_LONP_StepTime /end REF_CHARACTERISTIC
 /begin REF_MEASUREMENT autosar_swc_vmp_rtARID_DEF.UnitDelay1_DSTATE_iw autosar_swc_vmp_rtARID_DEF.UnitDelay2_DSTATE_o1t /end REF_MEASUREMENT
/end GROUP
/begin GROUP autosar_swc_vmp_autosar_swc_vmp_Step_sys_lc_pln_lcc_lane_check_TrueDurationTime3 "autosar_swc_vmp/autosar_swc_vmp_Step_sys/lc_pln/lcc_lane_check/TrueDurationTime3" /begin REF_CHARACTERISTIC P_LONP_StepTime /end REF_CHARACTERISTIC
 /begin REF_MEASUREMENT autosar_swc_vmp_rtARID_DEF.UnitDelay1_DSTATE_hj autosar_swc_vmp_rtARID_DEF.UnitDelay2_DSTATE_bu /end REF_MEASUREMENT
/end GROUP
/begin GROUP autosar_swc_vmp_autosar_swc_vmp_Step_sys_lc_pln_lcc_lane_check_TrueDurationTime4 "autosar_swc_vmp/autosar_swc_vmp_Step_sys/lc_pln/lcc_lane_check/TrueDurationTime4"
 /begin REF_MEASUREMENT autosar_swc_vmp_rtARID_DEF.UnitDelay1_DSTATE_o3 autosar_swc_vmp_rtARID_DEF.UnitDelay2_DSTATE_jx /end REF_MEASUREMENT
/end GROUP
/begin GROUP autosar_swc_vmp_autosar_swc_vmp_Step_sys_lc_pln_lcc_lane_check_TrueDurationTime5 "autosar_swc_vmp/autosar_swc_vmp_Step_sys/lc_pln/lcc_lane_check/TrueDurationTime5" /begin REF_CHARACTERISTIC P_LONP_StepTime /end REF_CHARACTERISTIC
 /begin REF_MEASUREMENT autosar_swc_vmp_rtARID_DEF.UnitDelay1_DSTATE_bd autosar_swc_vmp_rtARID_DEF.UnitDelay2_DSTATE_gw /end REF_MEASUREMENT
/end GROUP
/begin GROUP autosar_swc_vmp_autosar_swc_vmp_Step_sys_lc_pln_lcc_lane_check_TrueDurationTime6 "autosar_swc_vmp/autosar_swc_vmp_Step_sys/lc_pln/lcc_lane_check/TrueDurationTime6" /begin REF_CHARACTERISTIC P_LONP_StepTime /end REF_CHARACTERISTIC
 /begin REF_MEASUREMENT autosar_swc_vmp_rtARID_DEF.UnitDelay1_DSTATE_c5 autosar_swc_vmp_rtARID_DEF.UnitDelay2_DSTATE_a0 /end REF_MEASUREMENT
/end GROUP
/begin GROUP autosar_swc_vmp_autosar_swc_vmp_Step_sys_lc_pln_lcc_lane_check_TrueDurationTime7 "autosar_swc_vmp/autosar_swc_vmp_Step_sys/lc_pln/lcc_lane_check/TrueDurationTime7" /begin REF_CHARACTERISTIC P_LONP_StepTime /end REF_CHARACTERISTIC
 /begin REF_MEASUREMENT autosar_swc_vmp_rtARID_DEF.UnitDelay1_DSTATE_k3y autosar_swc_vmp_rtARID_DEF.UnitDelay2_DSTATE_af /end REF_MEASUREMENT
/end GROUP
/begin GROUP autosar_swc_vmp_autosar_swc_vmp_Step_sys_lc_pln_lcc_lane_check_TrueDurationTime8 "autosar_swc_vmp/autosar_swc_vmp_Step_sys/lc_pln/lcc_lane_check/TrueDurationTime8" /begin REF_CHARACTERISTIC P_LONP_StepTime /end REF_CHARACTERISTIC
 /begin REF_MEASUREMENT autosar_swc_vmp_rtARID_DEF.UnitDelay1_DSTATE_ik autosar_swc_vmp_rtARID_DEF.UnitDelay2_DSTATE_az /end REF_MEASUREMENT
/end GROUP
/begin GROUP autosar_swc_vmp_autosar_swc_vmp_Step_sys_lc_pln_lcc_lane_check_system "autosar_swc_vmp/autosar_swc_vmp_Step_sys/lc_pln/lcc_lane_check/system"
 /begin SUB_GROUP autosar_swc_vmp_autosar_swc_vmp_Step_sys_lc_pln_lcc_lane_check_system_Compare_To_Constant autosar_swc_vmp_autosar_swc_vmp_Step_sys_lc_pln_lcc_lane_check_system_Compare_To_Constant1 autosar_swc_vmp_autosar_swc_vmp_Step_sys_lc_pln_lcc_lane_check_system_Compare_To_Constant2 autosar_swc_vmp_autosar_swc_vmp_Step_sys_lc_pln_lcc_lane_check_system_Compare_To_Constant3 autosar_swc_vmp_autosar_swc_vmp_Step_sys_lc_pln_lcc_lane_check_system_Compare_To_Constant4 autosar_swc_vmp_autosar_swc_vmp_Step_sys_lc_pln_lcc_lane_check_system_Compare_To_Constant5 autosar_swc_vmp_autosar_swc_vmp_Step_sys_lc_pln_lcc_lane_check_system_Compare_To_Constant6 autosar_swc_vmp_autosar_swc_vmp_Step_sys_lc_pln_lcc_lane_check_system_Compare_To_Constant7 autosar_swc_vmp_autosar_swc_vmp_Step_sys_lc_pln_lcc_lane_check_system_Compare_To_Constant9 autosar_swc_vmp_autosar_swc_vmp_Step_sys_lc_pln_lcc_lane_check_system_TrueDurationTime1 autosar_swc_vmp_autosar_swc_vmp_Step_sys_lc_pln_lcc_lane_check_system_TrueDurationTime2 autosar_swc_vmp_autosar_swc_vmp_Step_sys_lc_pln_lcc_lane_check_system_TrueDurationTime3 autosar_swc_vmp_autosar_swc_vmp_Step_sys_lc_pln_lcc_lane_check_system_TrueDurationTime4 autosar_swc_vmp_autosar_swc_vmp_Step_sys_lc_pln_lcc_lane_check_system_TrueDurationTime5 /end SUB_GROUP
 /begin REF_CHARACTERISTIC P_VMP_LaneCheckActiveCenterDyValue P_VMP_LaneCheckActiveTarLineC1Value /end REF_CHARACTERISTIC
/end GROUP
/begin GROUP autosar_swc_vmp_autosar_swc_vmp_Step_sys_lc_pln_lcc_lane_check_system_Compare_To_Constant "autosar_swc_vmp/autosar_swc_vmp_Step_sys/lc_pln/lcc_lane_check/system/Compare\nTo Constant" /begin REF_CHARACTERISTIC P_VMP_LaneCheckActiveFLWhelDyValue /end REF_CHARACTERISTIC /end GROUP
/begin GROUP autosar_swc_vmp_autosar_swc_vmp_Step_sys_lc_pln_lcc_lane_check_system_Compare_To_Constant1 "autosar_swc_vmp/autosar_swc_vmp_Step_sys/lc_pln/lcc_lane_check/system/Compare\nTo Constant1" /begin REF_CHARACTERISTIC P_VMP_LaneCheckActiveFRWhelDyValue /end REF_CHARACTERISTIC /end GROUP
/begin GROUP autosar_swc_vmp_autosar_swc_vmp_Step_sys_lc_pln_lcc_lane_check_system_Compare_To_Constant2 "autosar_swc_vmp/autosar_swc_vmp_Step_sys/lc_pln/lcc_lane_check/system/Compare\nTo Constant2" /begin REF_CHARACTERISTIC P_VMP_LaneCheckExitFLWhelDyValue /end REF_CHARACTERISTIC /end GROUP
/begin GROUP autosar_swc_vmp_autosar_swc_vmp_Step_sys_lc_pln_lcc_lane_check_system_Compare_To_Constant3 "autosar_swc_vmp/autosar_swc_vmp_Step_sys/lc_pln/lcc_lane_check/system/Compare\nTo Constant3" /begin REF_CHARACTERISTIC P_VMP_LaneCheckExitFRWhelDyValue /end REF_CHARACTERISTIC /end GROUP
/begin GROUP autosar_swc_vmp_autosar_swc_vmp_Step_sys_lc_pln_lcc_lane_check_system_Compare_To_Constant4 "autosar_swc_vmp/autosar_swc_vmp_Step_sys/lc_pln/lcc_lane_check/system/Compare To Constant4" /begin REF_CHARACTERISTIC P_VMP_LaneCheckActiveTarLineC1ValidTime /end REF_CHARACTERISTIC /end GROUP
/begin GROUP autosar_swc_vmp_autosar_swc_vmp_Step_sys_lc_pln_lcc_lane_check_system_Compare_To_Constant5 "autosar_swc_vmp/autosar_swc_vmp_Step_sys/lc_pln/lcc_lane_check/system/Compare To Constant5" /begin REF_CHARACTERISTIC P_VMP_LaneCheckActiveKapCPDisVldTime /end REF_CHARACTERISTIC /end GROUP
/begin GROUP autosar_swc_vmp_autosar_swc_vmp_Step_sys_lc_pln_lcc_lane_check_system_Compare_To_Constant6 "autosar_swc_vmp/autosar_swc_vmp_Step_sys/lc_pln/lcc_lane_check/system/Compare To Constant6" /begin REF_CHARACTERISTIC P_VMP_LaneCheckActiveFLWhelDyTime /end REF_CHARACTERISTIC /end GROUP
/begin GROUP autosar_swc_vmp_autosar_swc_vmp_Step_sys_lc_pln_lcc_lane_check_system_Compare_To_Constant7 "autosar_swc_vmp/autosar_swc_vmp_Step_sys/lc_pln/lcc_lane_check/system/Compare To Constant7" /begin REF_CHARACTERISTIC P_VMP_LaneCheckActiveFRWhelDyTime /end REF_CHARACTERISTIC /end GROUP
/begin GROUP autosar_swc_vmp_autosar_swc_vmp_Step_sys_lc_pln_lcc_lane_check_system_Compare_To_Constant9 "autosar_swc_vmp/autosar_swc_vmp_Step_sys/lc_pln/lcc_lane_check/system/Compare To Constant9" /begin REF_CHARACTERISTIC P_VMP_LaneCheckActiveCenterDyTime /end REF_CHARACTERISTIC /end GROUP
/begin GROUP autosar_swc_vmp_autosar_swc_vmp_Step_sys_lc_pln_lcc_lane_check_system_TrueDurationTime1 "autosar_swc_vmp/autosar_swc_vmp_Step_sys/lc_pln/lcc_lane_check/system/TrueDurationTime1"
 /begin REF_MEASUREMENT autosar_swc_vmp_rtARID_DEF.UnitDelay1_DSTATE_cfn autosar_swc_vmp_rtARID_DEF.UnitDelay2_DSTATE_gs /end REF_MEASUREMENT
/end GROUP
/begin GROUP autosar_swc_vmp_autosar_swc_vmp_Step_sys_lc_pln_lcc_lane_check_system_TrueDurationTime2 "autosar_swc_vmp/autosar_swc_vmp_Step_sys/lc_pln/lcc_lane_check/system/TrueDurationTime2"
 /begin REF_MEASUREMENT autosar_swc_vmp_rtARID_DEF.UnitDelay1_DSTATE_h autosar_swc_vmp_rtARID_DEF.UnitDelay2_DSTATE_hh /end REF_MEASUREMENT
/end GROUP
/begin GROUP autosar_swc_vmp_autosar_swc_vmp_Step_sys_lc_pln_lcc_lane_check_system_TrueDurationTime3 "autosar_swc_vmp/autosar_swc_vmp_Step_sys/lc_pln/lcc_lane_check/system/TrueDurationTime3"
 /begin REF_MEASUREMENT autosar_swc_vmp_rtARID_DEF.UnitDelay1_DSTATE_mj autosar_swc_vmp_rtARID_DEF.UnitDelay2_DSTATE_nb /end REF_MEASUREMENT
/end GROUP
/begin GROUP autosar_swc_vmp_autosar_swc_vmp_Step_sys_lc_pln_lcc_lane_check_system_TrueDurationTime4 "autosar_swc_vmp/autosar_swc_vmp_Step_sys/lc_pln/lcc_lane_check/system/TrueDurationTime4"
 /begin REF_MEASUREMENT autosar_swc_vmp_rtARID_DEF.UnitDelay1_DSTATE_mk autosar_swc_vmp_rtARID_DEF.UnitDelay2_DSTATE_k /end REF_MEASUREMENT
/end GROUP
/begin GROUP autosar_swc_vmp_autosar_swc_vmp_Step_sys_lc_pln_lcc_lane_check_system_TrueDurationTime5 "autosar_swc_vmp/autosar_swc_vmp_Step_sys/lc_pln/lcc_lane_check/system/TrueDurationTime5"
 /begin REF_MEASUREMENT autosar_swc_vmp_rtARID_DEF.UnitDelay1_DSTATE_k3 autosar_swc_vmp_rtARID_DEF.UnitDelay2_DSTATE_fb /end REF_MEASUREMENT
/end GROUP
/begin GROUP autosar_swc_vmp_autosar_swc_vmp_Step_sys_lc_pln_lgt_veh_sts "autosar_swc_vmp/autosar_swc_vmp_Step_sys/lc_pln/lgt_veh_sts"
 /begin REF_CHARACTERISTIC P_LONP_ACCStsValue P_LONP_FailureEnable P_LONP_WaitTimeValue /end REF_CHARACTERISTIC
 /begin REF_MEASUREMENT autosar_swc_vmp_rtARID_DEF.ACCModeSts autosar_swc_vmp_rtARID_DEF.Cnt_m autosar_swc_vmp_rtARID_DEF.Memory5_PreviousInput autosar_swc_vmp_rtARID_DEF.TappedDelay_X_l autosar_swc_vmp_rtARID_DEF.UnitDelay_DSTATE_k autosar_swc_vmp_rtARID_DEF.is_active_c506_autosar_swc_vmp autosar_swc_vmp_rtARID_DEF.is_c506_autosar_swc_vmp /end REF_MEASUREMENT
/end GROUP
/begin GROUP autosar_swc_vmp_autosar_swc_vmp_Step_sys_lgt_pln "autosar_swc_vmp/autosar_swc_vmp_Step_sys/lgt_pln"
 /begin SUB_GROUP autosar_swc_vmp_autosar_swc_vmp_Step_sys_lgt_pln_Compare_To_Constant autosar_swc_vmp_autosar_swc_vmp_Step_sys_lgt_pln_Subsystem autosar_swc_vmp_autosar_swc_vmp_Step_sys_lgt_pln_Subsystem1 autosar_swc_vmp_autosar_swc_vmp_Step_sys_lgt_pln_Subsystem2 autosar_swc_vmp_autosar_swc_vmp_Step_sys_lgt_pln_Subsystem3 autosar_swc_vmp_autosar_swc_vmp_Step_sys_lgt_pln_Subsystem_Reference autosar_swc_vmp_autosar_swc_vmp_Step_sys_lgt_pln_lonap_accelCruiseCtrlJerkCalc1 autosar_swc_vmp_autosar_swc_vmp_Step_sys_lgt_pln_lonap_accelerationLimition autosar_swc_vmp_autosar_swc_vmp_Step_sys_lgt_pln_lonap_grp_arbitrate autosar_swc_vmp_autosar_swc_vmp_Step_sys_lgt_pln_lonap_grp_cruiseCtrl autosar_swc_vmp_autosar_swc_vmp_Step_sys_lgt_pln_lonap_grp_intelligenceCurve autosar_swc_vmp_autosar_swc_vmp_Step_sys_lgt_pln_lonap_grp_objectCtrl autosar_swc_vmp_autosar_swc_vmp_Step_sys_lgt_pln_lonap_grp_offRampDistance autosar_swc_vmp_autosar_swc_vmp_Step_sys_lgt_pln_lonap_grp_offRampDistance1 autosar_swc_vmp_autosar_swc_vmp_Step_sys_lgt_pln_lonap_grp_offRampDistance2 autosar_swc_vmp_autosar_swc_vmp_Step_sys_lgt_pln_lonap_grp_stateJudge autosar_swc_vmp_autosar_swc_vmp_Step_sys_lgt_pln_lonap_vlcInternalAccCalc /end SUB_GROUP
 /begin REF_CHARACTERISTIC C_LongCtrl_0_Single P_LONP_DelayTime P_LONP_Filter_SW P_LONP_StepTime /end REF_CHARACTERISTIC
 /begin REF_MEASUREMENT LONP_accelAL autosar_swc_vmp_rtARID_DEF.ACCModeSts autosar_swc_vmp_rtARID_DEF.Compare_d autosar_swc_vmp_rtARID_DEF.TappedDelay1_X_f autosar_swc_vmp_rtARID_DEF.TappedDelay4_X_l autosar_swc_vmp_rtARID_DEF.TmpSignalConversionAtaxvRefMs2Outport1 autosar_swc_vmp_rtARID_DEF.UnitDelay1 autosar_swc_vmp_rtARID_DEF.UnitDelay1_DSTATE_i autosar_swc_vmp_rtARID_DEF.UnitDelay2_DSTATE_p2 autosar_swc_vmp_rtARID_DEF.UnitDelay_DSTATE_ig autosar_swc_vmp_rtARID_DEF.VariantMergeForOutportInsertSpace_St autosar_swc_vmp_rtARID_DEF.VariantMergeForOutportSelect_STResult autosar_swc_vmp_rtARID_DEF.id_k1 autosar_swc_vmp_rtARID_DEF.lc_exec_sts autosar_swc_vmp_rtARID_DEF.vaild_end_dist autosar_swc_vmp_rtARID_DEF.vx_fd autosar_swc_vmp_rtARID_DEF.vx_fd_not_empty /end REF_MEASUREMENT
/end GROUP
/begin GROUP autosar_swc_vmp_autosar_swc_vmp_Step_sys_lgt_pln_Compare_To_Constant "autosar_swc_vmp/autosar_swc_vmp_Step_sys/lgt_pln/Compare\nTo Constant" /begin REF_MEASUREMENT autosar_swc_vmp_rtARID_DEF.Compare_d /end REF_MEASUREMENT /end GROUP
/begin GROUP autosar_swc_vmp_autosar_swc_vmp_Step_sys_lgt_pln_Subsystem "autosar_swc_vmp/autosar_swc_vmp_Step_sys/lgt_pln/Subsystem" /begin REF_CHARACTERISTIC P_LONP_AccJerkDriveLimit P_LONP_AccJerkDriveOffLimit /end REF_CHARACTERISTIC /end GROUP
/begin GROUP autosar_swc_vmp_autosar_swc_vmp_Step_sys_lgt_pln_Subsystem1 "autosar_swc_vmp/autosar_swc_vmp_Step_sys/lgt_pln/Subsystem1"
 /begin REF_CHARACTERISTIC P_LONP_DecelJerkByvxvRefYAxis P_LONP_vxvRefFordecelJerkXAxis /end REF_CHARACTERISTIC
 /begin REF_MEASUREMENT autosar_swc_vmp_rtARID_DEF.TmpSignalConversionAtvxvRefMsOutport1 /end REF_MEASUREMENT
/end GROUP
/begin GROUP autosar_swc_vmp_autosar_swc_vmp_Step_sys_lgt_pln_Subsystem2 "autosar_swc_vmp/autosar_swc_vmp_Step_sys/lgt_pln/Subsystem2"
 /begin REF_MEASUREMENT autosar_swc_vmp_rtARID_DEF.TmpSignalConversionAtvxvRefMsOutport1 /end REF_MEASUREMENT
/end GROUP
/begin GROUP autosar_swc_vmp_autosar_swc_vmp_Step_sys_lgt_pln_Subsystem_Reference_Subsystem "autosar_swc_vmp/autosar_swc_vmp_Step_sys/lgt_pln/Subsystem Reference/Subsystem"
 /begin REF_MEASUREMENT autosar_swc_vmp_rtARID_DEF.VariantMergeForOutportInsertSpace_St autosar_swc_vmp_rtARID_DEF.VariantMergeForOutportSelect_STResult /end REF_MEASUREMENT
/end GROUP
/begin GROUP autosar_swc_vmp_autosar_swc_vmp_Step_sys_lgt_pln_Subsystem_Reference_Subsystem_Reference "autosar_swc_vmp/autosar_swc_vmp_Step_sys/lgt_pln/Subsystem Reference/Subsystem Reference"
 /begin REF_MEASUREMENT autosar_swc_vmp_rtARID_DEF.VariantMergeForOutportInsertSpace_St /end REF_MEASUREMENT
/end GROUP
/begin GROUP autosar_swc_vmp_autosar_swc_vmp_Step_sys_lgt_pln_Subsystem_Reference_Subsystem_Reference_Subsystem "autosar_swc_vmp/autosar_swc_vmp_Step_sys/lgt_pln/Subsystem Reference/Subsystem Reference/Subsystem" /begin REF_CHARACTERISTIC P_LONP_StepTime /end REF_CHARACTERISTIC
 /begin REF_MEASUREMENT autosar_swc_vmp_rtARID_DEF.TmpSignalConversionAtaxvRefMs2Outport1 autosar_swc_vmp_rtARID_DEF.TmpSignalConversionAtvxvRefMsOutport1 autosar_swc_vmp_rtARID_DEF.VariantMergeForOutportInsertSpace_St autosar_swc_vmp_rtARID_DEF.VariantMergeForOutportSelect_STResult autosar_swc_vmp_rtARID_DEF.vaild_end_dist /end REF_MEASUREMENT
/end GROUP
/begin GROUP autosar_swc_vmp_autosar_swc_vmp_Step_sys_lgt_pln_Subsystem_Reference_Subsystem_Reference_Subsystem_Compare_To_Constant1 "autosar_swc_vmp/autosar_swc_vmp_Step_sys/lgt_pln/Subsystem Reference/Subsystem Reference/Subsystem/Compare\nTo Constant1" /begin REF_MEASUREMENT autosar_swc_vmp_rtARID_DEF.lc_exec_sts /end REF_MEASUREMENT /end GROUP
/begin GROUP autosar_swc_vmp_autosar_swc_vmp_Step_sys_lgt_pln_Subsystem_Reference_Subsystem_Reference_Subsystem_Compare_To_Constant2 "autosar_swc_vmp/autosar_swc_vmp_Step_sys/lgt_pln/Subsystem Reference/Subsystem Reference/Subsystem/Compare\nTo Constant2" /begin REF_MEASUREMENT autosar_swc_vmp_rtARID_DEF.lc_exec_sts /end REF_MEASUREMENT /end GROUP
/begin GROUP autosar_swc_vmp_autosar_swc_vmp_Step_sys_lgt_pln_Subsystem_Reference_Subsystem_Reference_Subsystem_Compare_To_Constant3 "autosar_swc_vmp/autosar_swc_vmp_Step_sys/lgt_pln/Subsystem Reference/Subsystem Reference/Subsystem/Compare\nTo Constant3" /begin REF_MEASUREMENT autosar_swc_vmp_rtARID_DEF.lc_exec_sts /end REF_MEASUREMENT /end GROUP
/begin GROUP autosar_swc_vmp_autosar_swc_vmp_Step_sys_lgt_pln_lonap_accelCruiseCtrlJerkCalc1 "autosar_swc_vmp/autosar_swc_vmp_Step_sys/lgt_pln/lonap_accelCruiseCtrlJerkCalc1" /begin REF_MEASUREMENT autosar_swc_vmp_rtARID_DEF.ACCModeSts /end REF_MEASUREMENT /end GROUP
/begin GROUP autosar_swc_vmp_autosar_swc_vmp_Step_sys_lgt_pln_lonap_accelCruiseCtrlJerkCalc1_Compare_To_Constant2 "autosar_swc_vmp/autosar_swc_vmp_Step_sys/lgt_pln/lonap_accelCruiseCtrlJerkCalc1/Compare\nTo Constant2" /begin REF_MEASUREMENT autosar_swc_vmp_rtARID_DEF.ACCModeSts /end REF_MEASUREMENT /end GROUP
/begin GROUP autosar_swc_vmp_autosar_swc_vmp_Step_sys_lgt_pln_lonap_accelCruiseCtrlJerkCalc1_Compare_To_Constant3 "autosar_swc_vmp/autosar_swc_vmp_Step_sys/lgt_pln/lonap_accelCruiseCtrlJerkCalc1/Compare\nTo Constant3" /begin REF_MEASUREMENT SwcOut_LONP_ArbFlag /end REF_MEASUREMENT /end GROUP
/begin GROUP autosar_swc_vmp_autosar_swc_vmp_Step_sys_lgt_pln_lonap_accelerationLimition "autosar_swc_vmp/autosar_swc_vmp_Step_sys/lgt_pln/lonap_accelerationLimition"
 /begin REF_MEASUREMENT LONP_accelAL autosar_swc_vmp_rtARID_DEF.TmpSignalConversionAtvxvRefMsOutport1 /end REF_MEASUREMENT
/end GROUP
/begin GROUP autosar_swc_vmp_autosar_swc_vmp_Step_sys_lgt_pln_lonap_grp_arbitrate_lonap_accelAibitrate "autosar_swc_vmp/autosar_swc_vmp_Step_sys/lgt_pln/lonap_grp_arbitrate/lonap_accelAibitrate" /begin REF_CHARACTERISTIC C_LongCtrl_0_Single /end REF_CHARACTERISTIC
 /begin REF_MEASUREMENT SwcOut_LONP_ArbFlag autosar_swc_vmp_rtARID_DEF.ACCModeSts autosar_swc_vmp_rtARID_DEF.VariantMergeForOutportSelect_STResult /end REF_MEASUREMENT
/end GROUP
/begin GROUP autosar_swc_vmp_autosar_swc_vmp_Step_sys_lgt_pln_lonap_grp_arbitrate_lonap_ctrlTargetIndex_Compare_To_Constant "autosar_swc_vmp/autosar_swc_vmp_Step_sys/lgt_pln/lonap_grp_arbitrate/lonap_ctrlTargetIndex/Compare\nTo Constant" /begin REF_MEASUREMENT SwcOut_LONP_ArbFlag /end REF_MEASUREMENT /end GROUP
/begin GROUP autosar_swc_vmp_autosar_swc_vmp_Step_sys_lgt_pln_lonap_grp_cruiseCtrl_lonap_accelCruiseCtrlCalc "autosar_swc_vmp/autosar_swc_vmp_Step_sys/lgt_pln/lonap_grp_cruiseCtrl/lonap_accelCruiseCtrlCalc" /begin REF_CHARACTERISTIC C_LongCtrl_0_Single /end REF_CHARACTERISTIC /begin REF_MEASUREMENT autosar_swc_vmp_rtARID_DEF.ACCModeSts /end REF_MEASUREMENT /end GROUP
/begin GROUP autosar_swc_vmp_autosar_swc_vmp_Step_sys_lgt_pln_lonap_grp_cruiseCtrl_lonap_accelCruiseCtrlJerkCalc1 "autosar_swc_vmp/autosar_swc_vmp_Step_sys/lgt_pln/lonap_grp_cruiseCtrl/lonap_accelCruiseCtrlJerkCalc1" /begin REF_MEASUREMENT autosar_swc_vmp_rtARID_DEF.UnitDelay1 /end REF_MEASUREMENT /end GROUP
/begin GROUP autosar_swc_vmp_autosar_swc_vmp_Step_sys_lgt_pln_lonap_grp_cruiseCtrl_lonap_accelCruiseCtrlJerkSelect_Compare_To_Constant "autosar_swc_vmp/autosar_swc_vmp_Step_sys/lgt_pln/lonap_grp_cruiseCtrl/lonap_accelCruiseCtrlJerkSelect/Compare\nTo Constant" /begin REF_MEASUREMENT autosar_swc_vmp_rtARID_DEF.UnitDelay1 /end REF_MEASUREMENT /end GROUP
/begin GROUP autosar_swc_vmp_autosar_swc_vmp_Step_sys_lgt_pln_lonap_grp_cruiseCtrl_lonap_accelCruiseCtrlJerkSelect_Compare_To_Constant1 "autosar_swc_vmp/autosar_swc_vmp_Step_sys/lgt_pln/lonap_grp_cruiseCtrl/lonap_accelCruiseCtrlJerkSelect/Compare\nTo Constant1" /begin REF_MEASUREMENT autosar_swc_vmp_rtARID_DEF.UnitDelay1 /end REF_MEASUREMENT /end GROUP
/begin GROUP autosar_swc_vmp_autosar_swc_vmp_Step_sys_lgt_pln_lonap_grp_cruiseCtrl_lonap_accelCruiseCtrlLimit_TrueDurationTime "autosar_swc_vmp/autosar_swc_vmp_Step_sys/lgt_pln/lonap_grp_cruiseCtrl/lonap_accelCruiseCtrlLimit/TrueDurationTime" /begin REF_CHARACTERISTIC P_LONP_StepTime /end REF_CHARACTERISTIC /end GROUP
/begin GROUP autosar_swc_vmp_autosar_swc_vmp_Step_sys_lgt_pln_lonap_grp_cruiseCtrl_lonap_acceleBandCruiseCtrl "autosar_swc_vmp/autosar_swc_vmp_Step_sys/lgt_pln/lonap_grp_cruiseCtrl/lonap_acceleBandCruiseCtrl" /begin REF_CHARACTERISTIC C_LongCtrl_0_Single /end REF_CHARACTERISTIC /end GROUP
/begin GROUP autosar_swc_vmp_autosar_swc_vmp_Step_sys_lgt_pln_lonap_grp_cruiseCtrl_lonap_velPlanCruiseCtrl "autosar_swc_vmp/autosar_swc_vmp_Step_sys/lgt_pln/lonap_grp_cruiseCtrl/lonap_velPlanCruiseCtrl"
 /begin REF_MEASUREMENT autosar_swc_vmp_rtARID_DEF.TmpSignalConversionAtvxvRefMsOutport1 autosar_swc_vmp_rtARID_DEF.UnitDelay1 /end REF_MEASUREMENT
/end GROUP
/begin GROUP autosar_swc_vmp_autosar_swc_vmp_Step_sys_lgt_pln_lonap_grp_intelligenceCurve_lonap_accelBandIntelIigenceCurve_lonap_AccelBandHDMap "autosar_swc_vmp/autosar_swc_vmp_Step_sys/lgt_pln/lonap_grp_intelligenceCurve/lonap_accelBandIntelIigenceCurve/lonap_AccelBandHDMap" /begin REF_CHARACTERISTIC C_LongCtrl_0_Single /end REF_CHARACTERISTIC /end GROUP
/begin GROUP autosar_swc_vmp_autosar_swc_vmp_Step_sys_lgt_pln_lonap_grp_intelligenceCurve_lonap_accelCurvature1 "autosar_swc_vmp/autosar_swc_vmp_Step_sys/lgt_pln/lonap_grp_intelligenceCurve/lonap_accelCurvature1"
 /begin REF_MEASUREMENT autosar_swc_vmp_rtARID_DEF.TmpSignalConversionAtvxvRefMsOutport1 /end REF_MEASUREMENT
/end GROUP
/begin GROUP autosar_swc_vmp_autosar_swc_vmp_Step_sys_lgt_pln_lonap_grp_intelligenceCurve_lonap_accelJerkIntelIigenceCurve "autosar_swc_vmp/autosar_swc_vmp_Step_sys/lgt_pln/lonap_grp_intelligenceCurve/lonap_accelJerkIntelIigenceCurve" /begin REF_CHARACTERISTIC P_LONP_StepTime /end REF_CHARACTERISTIC /begin REF_MEASUREMENT autosar_swc_vmp_rtARID_DEF.UnitDelay1 /end REF_MEASUREMENT /end GROUP
/begin GROUP autosar_swc_vmp_autosar_swc_vmp_Step_sys_lgt_pln_lonap_grp_intelligenceCurve_lonap_accelKap "autosar_swc_vmp/autosar_swc_vmp_Step_sys/lgt_pln/lonap_grp_intelligenceCurve/lonap_accelKap"
 /begin REF_MEASUREMENT autosar_swc_vmp_rtARID_DEF.TmpSignalConversionAtvxvRefMsOutport1 /end REF_MEASUREMENT
/end GROUP
/begin GROUP autosar_swc_vmp_autosar_swc_vmp_Step_sys_lgt_pln_lonap_grp_intelligenceCurve_lonap_curvatureOfRoadCalc_If_Action_Subsystem_For_Each_Subsystem "autosar_swc_vmp/autosar_swc_vmp_Step_sys/lgt_pln/lonap_grp_intelligenceCurve/lonap_curvatureOfRoadCalc/If Action\nSubsystem/For Each\nSubsystem"
 /begin REF_MEASUREMENT autosar_swc_vmp_rtARID_DEF.TmpSignalConversionAtvxvRefMsOutport1 /end REF_MEASUREMENT
/end GROUP
/begin GROUP autosar_swc_vmp_autosar_swc_vmp_Step_sys_lgt_pln_lonap_grp_intelligenceCurve_lonap_hDMapAccelCalc1 "autosar_swc_vmp/autosar_swc_vmp_Step_sys/lgt_pln/lonap_grp_intelligenceCurve/lonap_hDMapAccelCalc1"
 /begin REF_MEASUREMENT autosar_swc_vmp_rtARID_DEF.TmpSignalConversionAtvxvRefMsOutport1 /end REF_MEASUREMENT
/end GROUP
/begin GROUP autosar_swc_vmp_autosar_swc_vmp_Step_sys_lgt_pln_lonap_grp_intelligenceCurve_lonap_laneProcss1 "autosar_swc_vmp/autosar_swc_vmp_Step_sys/lgt_pln/lonap_grp_intelligenceCurve/lonap_laneProcss1"
 /begin REF_MEASUREMENT autosar_swc_vmp_rtARID_DEF.TmpSignalConversionAtvxvRefMsOutport1 /end REF_MEASUREMENT
/end GROUP
/begin GROUP autosar_swc_vmp_autosar_swc_vmp_Step_sys_lgt_pln_lonap_grp_objectCtrl_lonap_grp_crossAccelCtrl_lonap_crossAccelCalc "autosar_swc_vmp/autosar_swc_vmp_Step_sys/lgt_pln/lonap_grp_objectCtrl/lonap_grp_crossAccelCtrl/lonap_crossAccelCalc"
 /begin REF_MEASUREMENT autosar_swc_vmp_rtARID_DEF.TmpSignalConversionAtaxvRefMs2Outport1 autosar_swc_vmp_rtARID_DEF.TmpSignalConversionAtvxvRefMsOutport1 /end REF_MEASUREMENT
/end GROUP
/begin GROUP autosar_swc_vmp_autosar_swc_vmp_Step_sys_lgt_pln_lonap_grp_objectCtrl_lonap_grp_followCtrl "autosar_swc_vmp/autosar_swc_vmp_Step_sys/lgt_pln/lonap_grp_objectCtrl/lonap_grp_followCtrl"
 /begin REF_MEASUREMENT autosar_swc_vmp_rtARID_DEF.VariantMergeForOutportInsertSpace_St /end REF_MEASUREMENT
/end GROUP
/begin GROUP autosar_swc_vmp_autosar_swc_vmp_Step_sys_lgt_pln_lonap_grp_objectCtrl_lonap_grp_followCtrl_AcceSwitch14 "autosar_swc_vmp/autosar_swc_vmp_Step_sys/lgt_pln/lonap_grp_objectCtrl/lonap_grp_followCtrl/AcceSwitch14"
 /begin REF_MEASUREMENT autosar_swc_vmp_rtARID_DEF.TmpSignalConversionAtvxvRefMsOutport1 /end REF_MEASUREMENT
/end GROUP
/begin GROUP autosar_swc_vmp_autosar_swc_vmp_Step_sys_lgt_pln_lonap_grp_objectCtrl_lonap_grp_followCtrl_Subsystem_lonap_grp_followBandJerkCalc_lonap_accelFollowAfterJerk "autosar_swc_vmp/autosar_swc_vmp_Step_sys/lgt_pln/lonap_grp_objectCtrl/lonap_grp_followCtrl/Subsystem/lonap_grp_followBandJerkCalc/lonap_accelFollowAfterJerk" /begin REF_CHARACTERISTIC P_LONP_StepTime /end REF_CHARACTERISTIC /begin REF_MEASUREMENT autosar_swc_vmp_rtARID_DEF.UnitDelay1 /end REF_MEASUREMENT /end GROUP
/begin GROUP autosar_swc_vmp_autosar_swc_vmp_Step_sys_lgt_pln_lonap_grp_objectCtrl_lonap_grp_followCtrl_Subsystem_lonap_grp_followBandJerkCalc_lonap_accelFollowJerkCalc "autosar_swc_vmp/autosar_swc_vmp_Step_sys/lgt_pln/lonap_grp_objectCtrl/lonap_grp_followCtrl/Subsystem/lonap_grp_followBandJerkCalc/lonap_accelFollowJerkCalc"
 /begin REF_MEASUREMENT autosar_swc_vmp_rtARID_DEF.TmpSignalConversionAtvxvRefMsOutport1 autosar_swc_vmp_rtARID_DEF.UnitDelay1 /end REF_MEASUREMENT
/end GROUP
/begin GROUP autosar_swc_vmp_autosar_swc_vmp_Step_sys_lgt_pln_lonap_grp_objectCtrl_lonap_grp_followCtrl_Subsystem_lonap_grp_followBandJerkCalc_lonap_decelFollowJerkCalc1 "autosar_swc_vmp/autosar_swc_vmp_Step_sys/lgt_pln/lonap_grp_objectCtrl/lonap_grp_followCtrl/Subsystem/lonap_grp_followBandJerkCalc/lonap_decelFollowJerkCalc1" /begin REF_CHARACTERISTIC P_LONP_StepTime /end REF_CHARACTERISTIC
 /begin REF_MEASUREMENT autosar_swc_vmp_rtARID_DEF.ACCModeSts autosar_swc_vmp_rtARID_DEF.TmpSignalConversionAtvxvRefMsOutport1 autosar_swc_vmp_rtARID_DEF.UnitDelay1 /end REF_MEASUREMENT
/end GROUP
/begin GROUP autosar_swc_vmp_autosar_swc_vmp_Step_sys_lgt_pln_lonap_grp_objectCtrl_lonap_grp_followCtrl_Subsystem_lonap_grp_followBandJerkCalc_lonap_decelFollowJerkCalc1_Compare_To_Constant "autosar_swc_vmp/autosar_swc_vmp_Step_sys/lgt_pln/lonap_grp_objectCtrl/lonap_grp_followCtrl/Subsystem/lonap_grp_followBandJerkCalc/lonap_decelFollowJerkCalc1/Compare\nTo Constant"
 /begin REF_MEASUREMENT autosar_swc_vmp_rtARID_DEF.TmpSignalConversionAtvxvRefMsOutport1 /end REF_MEASUREMENT
/end GROUP
/begin GROUP autosar_swc_vmp_autosar_swc_vmp_Step_sys_lgt_pln_lonap_grp_objectCtrl_lonap_grp_followCtrl_Subsystem_lonap_grp_followBandJerkCalc_lonap_decelFollowJerkCalc1_Compare_To_Constant1 "autosar_swc_vmp/autosar_swc_vmp_Step_sys/lgt_pln/lonap_grp_objectCtrl/lonap_grp_followCtrl/Subsystem/lonap_grp_followBandJerkCalc/lonap_decelFollowJerkCalc1/Compare\nTo Constant1"
 /begin REF_MEASUREMENT autosar_swc_vmp_rtARID_DEF.TmpSignalConversionAtvxvRefMsOutport1 /end REF_MEASUREMENT
/end GROUP
/begin GROUP autosar_swc_vmp_autosar_swc_vmp_Step_sys_lgt_pln_lonap_grp_objectCtrl_lonap_grp_followCtrl_TargetIDUpdate_AtomicSubsystem "autosar_swc_vmp/autosar_swc_vmp_Step_sys/lgt_pln/lonap_grp_objectCtrl/lonap_grp_followCtrl/TargetIDUpdate/AtomicSubsystem"
 /begin REF_MEASUREMENT autosar_swc_vmp_rtARID_DEF.TmpSignalConversionAtaxvRefMs2Outport1 /end REF_MEASUREMENT
/end GROUP
/begin GROUP autosar_swc_vmp_autosar_swc_vmp_Step_sys_lgt_pln_lonap_grp_objectCtrl_lonap_grp_followCtrl_TargetIDUpdate_AtomicSubsystem_L__P "autosar_swc_vmp/autosar_swc_vmp_Step_sys/lgt_pln/lonap_grp_objectCtrl/lonap_grp_followCtrl/TargetIDUpdate/AtomicSubsystem/L  P" /begin REF_CHARACTERISTIC P_LONP_StepTime /end REF_CHARACTERISTIC /end GROUP
/begin GROUP autosar_swc_vmp_autosar_swc_vmp_Step_sys_lgt_pln_lonap_grp_objectCtrl_lonap_grp_followCtrl_lonap_accelTargFilter "autosar_swc_vmp/autosar_swc_vmp_Step_sys/lgt_pln/lonap_grp_objectCtrl/lonap_grp_followCtrl/lonap_accelTargFilter" /begin REF_CHARACTERISTIC P_LONP_StepTime /end REF_CHARACTERISTIC /end GROUP
/begin GROUP autosar_swc_vmp_autosar_swc_vmp_Step_sys_lgt_pln_lonap_grp_objectCtrl_lonap_grp_followCtrl_lonap_decelToStopCtrl "autosar_swc_vmp/autosar_swc_vmp_Step_sys/lgt_pln/lonap_grp_objectCtrl/lonap_grp_followCtrl/lonap_decelToStopCtrl"
 /begin REF_MEASUREMENT autosar_swc_vmp_rtARID_DEF.ACCModeSts autosar_swc_vmp_rtARID_DEF.TmpSignalConversionAtvxvRefMsOutport1 /end REF_MEASUREMENT
/end GROUP
/begin GROUP autosar_swc_vmp_autosar_swc_vmp_Step_sys_lgt_pln_lonap_grp_objectCtrl_lonap_grp_followCtrl_lonap_grp_followAccelCalc_lonap_accelTargAbsEnableJudge "autosar_swc_vmp/autosar_swc_vmp_Step_sys/lgt_pln/lonap_grp_objectCtrl/lonap_grp_followCtrl/lonap_grp_followAccelCalc/lonap_accelTargAbsEnableJudge" /begin REF_CHARACTERISTIC P_LONP_StepTime /end REF_CHARACTERISTIC /end GROUP
/begin GROUP autosar_swc_vmp_autosar_swc_vmp_Step_sys_lgt_pln_lonap_grp_objectCtrl_lonap_grp_followCtrl_lonap_grp_followAccelCalc_lonap_advanceBraking "autosar_swc_vmp/autosar_swc_vmp_Step_sys/lgt_pln/lonap_grp_objectCtrl/lonap_grp_followCtrl/lonap_grp_followAccelCalc/lonap_advanceBraking"
 /begin REF_MEASUREMENT autosar_swc_vmp_rtARID_DEF.TmpSignalConversionAtvxvRefMsOutport1 /end REF_MEASUREMENT
/end GROUP
/begin GROUP autosar_swc_vmp_autosar_swc_vmp_Step_sys_lgt_pln_lonap_grp_objectCtrl_lonap_grp_followCtrl_lonap_grp_followAccelCalc_lonap_distDesCalc_Subsystem "autosar_swc_vmp/autosar_swc_vmp_Step_sys/lgt_pln/lonap_grp_objectCtrl/lonap_grp_followCtrl/lonap_grp_followAccelCalc/lonap_distDesCalc/Subsystem"
 /begin REF_MEASUREMENT autosar_swc_vmp_rtARID_DEF.TmpSignalConversionAtvxvRefMsOutport1 /end REF_MEASUREMENT
/end GROUP
/begin GROUP autosar_swc_vmp_autosar_swc_vmp_Step_sys_lgt_pln_lonap_grp_objectCtrl_lonap_grp_followCtrl_lonap_grp_followAccelCalc_lonap_distDesCalc_Subsystem1 "autosar_swc_vmp/autosar_swc_vmp_Step_sys/lgt_pln/lonap_grp_objectCtrl/lonap_grp_followCtrl/lonap_grp_followAccelCalc/lonap_distDesCalc/Subsystem1"
 /begin REF_MEASUREMENT autosar_swc_vmp_rtARID_DEF.TmpSignalConversionAtvxvRefMsOutport1 /end REF_MEASUREMENT
/end GROUP
/begin GROUP autosar_swc_vmp_autosar_swc_vmp_Step_sys_lgt_pln_lonap_grp_objectCtrl_lonap_grp_followCtrl_lonap_grp_followAccelCalc_lonap_distRelPlanTerminateCalc "autosar_swc_vmp/autosar_swc_vmp_Step_sys/lgt_pln/lonap_grp_objectCtrl/lonap_grp_followCtrl/lonap_grp_followAccelCalc/lonap_distRelPlanTerminateCalc"
 /begin REF_MEASUREMENT autosar_swc_vmp_rtARID_DEF.TmpSignalConversionAtvxvRefMsOutport1 /end REF_MEASUREMENT
/end GROUP
/begin GROUP autosar_swc_vmp_autosar_swc_vmp_Step_sys_lgt_pln_lonap_grp_objectCtrl_lonap_grp_followCtrl_lonap_grp_followAccelCalc_lonap_grp_velPlan_lonap_costCoefEnlarge "autosar_swc_vmp/autosar_swc_vmp_Step_sys/lgt_pln/lonap_grp_objectCtrl/lonap_grp_followCtrl/lonap_grp_followAccelCalc/lonap_grp_velPlan/lonap_costCoefEnlarge"
 /begin REF_MEASUREMENT autosar_swc_vmp_rtARID_DEF.TmpSignalConversionAtvxvRefMsOutport1 /end REF_MEASUREMENT
/end GROUP
/begin GROUP autosar_swc_vmp_autosar_swc_vmp_Step_sys_lgt_pln_lonap_grp_objectCtrl_lonap_grp_followCtrl_lonap_grp_followAccelCalc_lonap_grp_velPlan_lonap_numUpdateDecision "autosar_swc_vmp/autosar_swc_vmp_Step_sys/lgt_pln/lonap_grp_objectCtrl/lonap_grp_followCtrl/lonap_grp_followAccelCalc/lonap_grp_velPlan/lonap_numUpdateDecision"
 /begin REF_MEASUREMENT autosar_swc_vmp_rtARID_DEF.TmpSignalConversionAtvxvRefMsOutport1 /end REF_MEASUREMENT
/end GROUP
/begin GROUP autosar_swc_vmp_autosar_swc_vmp_Step_sys_lgt_pln_lonap_grp_objectCtrl_lonap_grp_followCtrl_lonap_grp_followAccelCalc_lonap_grp_velPlan_lonap_spdPlanning "autosar_swc_vmp/autosar_swc_vmp_Step_sys/lgt_pln/lonap_grp_objectCtrl/lonap_grp_followCtrl/lonap_grp_followAccelCalc/lonap_grp_velPlan/lonap_spdPlanning" /begin REF_CHARACTERISTIC P_LONP_StepTime /end REF_CHARACTERISTIC
 /begin REF_MEASUREMENT autosar_swc_vmp_rtARID_DEF.TmpSignalConversionAtvxvRefMsOutport1 /end REF_MEASUREMENT
/end GROUP
/begin GROUP autosar_swc_vmp_autosar_swc_vmp_Step_sys_lgt_pln_lonap_grp_objectCtrl_lonap_grp_followCtrl_lonap_grp_followAccelCalc_lonap_timeToCollision1 "autosar_swc_vmp/autosar_swc_vmp_Step_sys/lgt_pln/lonap_grp_objectCtrl/lonap_grp_followCtrl/lonap_grp_followAccelCalc/lonap_timeToCollision1"
 /begin REF_MEASUREMENT autosar_swc_vmp_rtARID_DEF.TmpSignalConversionAtvxvRefMsOutport1 /end REF_MEASUREMENT
/end GROUP
/begin GROUP autosar_swc_vmp_autosar_swc_vmp_Step_sys_lgt_pln_lonap_grp_objectCtrl_lonap_grp_followCtrl_lonap_grp_followAccelCalc_lonap_velTargPlanTerminateCalc "autosar_swc_vmp/autosar_swc_vmp_Step_sys/lgt_pln/lonap_grp_objectCtrl/lonap_grp_followCtrl/lonap_grp_followAccelCalc/lonap_velTargPlanTerminateCalc"
 /begin REF_MEASUREMENT autosar_swc_vmp_rtARID_DEF.TmpSignalConversionAtvxvRefMsOutport1 /end REF_MEASUREMENT
/end GROUP
/begin GROUP autosar_swc_vmp_autosar_swc_vmp_Step_sys_lgt_pln_lonap_grp_objectCtrl_lonap_grp_followCtrl_lonap_grp_plausibilityCheck_lonap_plauCheckEnable "autosar_swc_vmp/autosar_swc_vmp_Step_sys/lgt_pln/lonap_grp_objectCtrl/lonap_grp_followCtrl/lonap_grp_plausibilityCheck/lonap_plauCheckEnable"
 /begin REF_MEASUREMENT autosar_swc_vmp_rtARID_DEF.TmpSignalConversionAtaxvRefMs2Outport1 autosar_swc_vmp_rtARID_DEF.TmpSignalConversionAtvxvRefMsOutport1 autosar_swc_vmp_rtARID_DEF.UnitDelay1 /end REF_MEASUREMENT
/end GROUP
/begin GROUP autosar_swc_vmp_autosar_swc_vmp_Step_sys_lgt_pln_lonap_grp_objectCtrl_lonap_grp_followCtrl_lonap_grp_plausibilityCheck_lonap_quickDecel_Compare_To_Constant3 "autosar_swc_vmp/autosar_swc_vmp_Step_sys/lgt_pln/lonap_grp_objectCtrl/lonap_grp_followCtrl/lonap_grp_plausibilityCheck/lonap_quickDecel/Compare\nTo Constant3"
 /begin REF_MEASUREMENT autosar_swc_vmp_rtARID_DEF.TmpSignalConversionAtvxvRefMsOutport1 /end REF_MEASUREMENT
/end GROUP
/begin GROUP autosar_swc_vmp_autosar_swc_vmp_Step_sys_lgt_pln_lonap_grp_objectCtrl_lonap_grp_followCtrl_lonap_grp_plausibilityCheck_lonap_standstillOverrideCondition "autosar_swc_vmp/autosar_swc_vmp_Step_sys/lgt_pln/lonap_grp_objectCtrl/lonap_grp_followCtrl/lonap_grp_plausibilityCheck/lonap_standstillOverrideCondition" /begin REF_MEASUREMENT autosar_swc_vmp_rtARID_DEF.ACCModeSts /end REF_MEASUREMENT /end GROUP
/begin GROUP autosar_swc_vmp_autosar_swc_vmp_Step_sys_lgt_pln_lonap_grp_objectCtrl_lonap_grp_followCtrl_lonap_signalMatrix "autosar_swc_vmp/autosar_swc_vmp_Step_sys/lgt_pln/lonap_grp_objectCtrl/lonap_grp_followCtrl/lonap_signalMatrix" /begin REF_MEASUREMENT autosar_swc_vmp_rtARID_DEF.ACCModeSts /end REF_MEASUREMENT /end GROUP
/begin GROUP autosar_swc_vmp_autosar_swc_vmp_Step_sys_lgt_pln_lonap_grp_objectCtrl_lonap_grp_followCtrl_lonap_slopeStartUpAssist "autosar_swc_vmp/autosar_swc_vmp_Step_sys/lgt_pln/lonap_grp_objectCtrl/lonap_grp_followCtrl/lonap_slopeStartUpAssist" /begin REF_CHARACTERISTIC P_LONP_StepTime /end REF_CHARACTERISTIC
 /begin REF_MEASUREMENT autosar_swc_vmp_rtARID_DEF.ACCModeSts autosar_swc_vmp_rtARID_DEF.TmpSignalConversionAtvxvRefMsOutport1 /end REF_MEASUREMENT
/end GROUP
/begin GROUP autosar_swc_vmp_autosar_swc_vmp_Step_sys_lgt_pln_lonap_grp_objectCtrl_lonap_grp_followCtrl_lonap_slopeStartUpAssist_Compare_To_Constant "autosar_swc_vmp/autosar_swc_vmp_Step_sys/lgt_pln/lonap_grp_objectCtrl/lonap_grp_followCtrl/lonap_slopeStartUpAssist/Compare\nTo Constant"
 /begin REF_MEASUREMENT autosar_swc_vmp_rtARID_DEF.TmpSignalConversionAtvxvRefMsOutport1 /end REF_MEASUREMENT
/end GROUP
/begin GROUP autosar_swc_vmp_autosar_swc_vmp_Step_sys_lgt_pln_lonap_grp_offRampDistance1_lonap_ordForceStopCtrl "autosar_swc_vmp/autosar_swc_vmp_Step_sys/lgt_pln/lonap_grp_offRampDistance1/lonap_ordForceStopCtrl"
 /begin REF_MEASUREMENT autosar_swc_vmp_rtARID_DEF.ACCModeSts autosar_swc_vmp_rtARID_DEF.TmpSignalConversionAtvxvRefMsOutport1 /end REF_MEASUREMENT
/end GROUP
/begin GROUP autosar_swc_vmp_autosar_swc_vmp_Step_sys_lgt_pln_lonap_grp_offRampDistance2_lonap_ordForceStopCtrl "autosar_swc_vmp/autosar_swc_vmp_Step_sys/lgt_pln/lonap_grp_offRampDistance2/lonap_ordForceStopCtrl"
 /begin REF_MEASUREMENT autosar_swc_vmp_rtARID_DEF.ACCModeSts autosar_swc_vmp_rtARID_DEF.TmpSignalConversionAtvxvRefMsOutport1 /end REF_MEASUREMENT
/end GROUP
/begin GROUP autosar_swc_vmp_autosar_swc_vmp_Step_sys_lgt_pln_lonap_grp_offRampDistance_lonap_ordForceStopCtrl "autosar_swc_vmp/autosar_swc_vmp_Step_sys/lgt_pln/lonap_grp_offRampDistance/lonap_ordForceStopCtrl"
 /begin REF_MEASUREMENT autosar_swc_vmp_rtARID_DEF.ACCModeSts autosar_swc_vmp_rtARID_DEF.TmpSignalConversionAtvxvRefMsOutport1 /end REF_MEASUREMENT
/end GROUP
/begin GROUP autosar_swc_vmp_autosar_swc_vmp_Step_sys_lgt_pln_lonap_grp_stateJudge_lonap_brakePreferJudge_Compare_To_Constant3 "autosar_swc_vmp/autosar_swc_vmp_Step_sys/lgt_pln/lonap_grp_stateJudge/lonap_brakePreferJudge/Compare\nTo Constant3" /begin REF_MEASUREMENT autosar_swc_vmp_rtARID_DEF.UnitDelay1 /end REF_MEASUREMENT /end GROUP
/begin GROUP autosar_swc_vmp_autosar_swc_vmp_Step_sys_lgt_pln_lonap_grp_stateJudge_lonap_brakePreferJudge_Compare_To_Constant5 "autosar_swc_vmp/autosar_swc_vmp_Step_sys/lgt_pln/lonap_grp_stateJudge/lonap_brakePreferJudge/Compare\nTo Constant5"
 /begin REF_MEASUREMENT autosar_swc_vmp_rtARID_DEF.TmpSignalConversionAtaxvRefMs2Outport1 /end REF_MEASUREMENT
/end GROUP
/begin GROUP autosar_swc_vmp_autosar_swc_vmp_Step_sys_lgt_pln_lonap_grp_stateJudge_lonap_brakePreferJudge_Compare_To_Constant7 "autosar_swc_vmp/autosar_swc_vmp_Step_sys/lgt_pln/lonap_grp_stateJudge/lonap_brakePreferJudge/Compare\nTo Constant7" /begin REF_MEASUREMENT autosar_swc_vmp_rtARID_DEF.ACCModeSts /end REF_MEASUREMENT /end GROUP
/begin GROUP autosar_swc_vmp_autosar_swc_vmp_Step_sys_lgt_pln_lonap_grp_stateJudge_lonap_brakePreferJudge_Compare_To_Constant8 "autosar_swc_vmp/autosar_swc_vmp_Step_sys/lgt_pln/lonap_grp_stateJudge/lonap_brakePreferJudge/Compare\nTo Constant8"
 /begin REF_MEASUREMENT autosar_swc_vmp_rtARID_DEF.TmpSignalConversionAtvxvRefMsOutport1 /end REF_MEASUREMENT
/end GROUP
/begin GROUP autosar_swc_vmp_autosar_swc_vmp_Step_sys_lgt_pln_lonap_grp_stateJudge_lonap_deceleToStop "autosar_swc_vmp/autosar_swc_vmp_Step_sys/lgt_pln/lonap_grp_stateJudge/lonap_deceleToStop" /begin REF_CHARACTERISTIC C_LongCtrl_0_Single /end REF_CHARACTERISTIC
 /begin REF_MEASUREMENT SwcOut_LONP_DecelToStopReq autosar_swc_vmp_rtARID_DEF.ACCModeSts autosar_swc_vmp_rtARID_DEF.TmpSignalConversionAtvxvRefMsOutport1 /end REF_MEASUREMENT
/end GROUP
/begin GROUP autosar_swc_vmp_autosar_swc_vmp_Step_sys_lgt_pln_lonap_grp_stateJudge_lonap_driverOffConditionFulfilled "autosar_swc_vmp/autosar_swc_vmp_Step_sys/lgt_pln/lonap_grp_stateJudge/lonap_driverOffConditionFulfilled"
 /begin REF_MEASUREMENT autosar_swc_vmp_rtARID_DEF.ACCModeSts autosar_swc_vmp_rtARID_DEF.TmpSignalConversionAtvxvRefMsOutport1 /end REF_MEASUREMENT
/end GROUP
/begin GROUP autosar_swc_vmp_autosar_swc_vmp_Step_sys_lgt_pln_lonap_grp_stateJudge_lonap_driverOffConditionFulfilled_Atomic_Subsystem2 "autosar_swc_vmp/autosar_swc_vmp_Step_sys/lgt_pln/lonap_grp_stateJudge/lonap_driverOffConditionFulfilled/Atomic Subsystem2"
 /begin REF_MEASUREMENT autosar_swc_vmp_rtARID_DEF.ACCModeSts autosar_swc_vmp_rtARID_DEF.TmpSignalConversionAtvxvRefMsOutport1 /end REF_MEASUREMENT
/end GROUP
/begin GROUP autosar_swc_vmp_autosar_swc_vmp_Step_sys_lgt_pln_lonap_grp_stateJudge_lonap_takeOver_ttc_2_5_If_Action_Subsystem "autosar_swc_vmp/autosar_swc_vmp_Step_sys/lgt_pln/lonap_grp_stateJudge/lonap_takeOver ttc<2.5/If Action\nSubsystem" /begin REF_MEASUREMENT autosar_swc_vmp_rtARID_DEF.ACCModeSts /end REF_MEASUREMENT /end GROUP
/begin GROUP autosar_swc_vmp_autosar_swc_vmp_Step_sys_lgt_pln_lonap_grp_stateJudge_lonap_takeOver_ttc_2_5_If_Action_Subsystem_Gap "autosar_swc_vmp/autosar_swc_vmp_Step_sys/lgt_pln/lonap_grp_stateJudge/lonap_takeOver ttc<2.5/If Action\nSubsystem/Gap"
 /begin REF_MEASUREMENT autosar_swc_vmp_rtARID_DEF.TmpSignalConversionAtvxvRefMsOutport1 /end REF_MEASUREMENT
/end GROUP
/begin GROUP autosar_swc_vmp_autosar_swc_vmp_Step_sys_lgt_pln_lonap_grp_stateJudge_ttc_3_If_Action_Subsystem "autosar_swc_vmp/autosar_swc_vmp_Step_sys/lgt_pln/lonap_grp_stateJudge/ttc<3/If Action\nSubsystem" /begin REF_MEASUREMENT autosar_swc_vmp_rtARID_DEF.ACCModeSts /end REF_MEASUREMENT /end GROUP
/begin GROUP autosar_swc_vmp_autosar_swc_vmp_Step_sys_lgt_pln_lonap_grp_stateJudge_ttc_3_If_Action_Subsystem_Gap "autosar_swc_vmp/autosar_swc_vmp_Step_sys/lgt_pln/lonap_grp_stateJudge/ttc<3/If Action\nSubsystem/Gap"
 /begin REF_MEASUREMENT autosar_swc_vmp_rtARID_DEF.TmpSignalConversionAtvxvRefMsOutport1 /end REF_MEASUREMENT
/end GROUP
/begin GROUP autosar_swc_vmp_autosar_swc_vmp_Step_sys_lgt_pln_lonap_vlcInternalAccCalc "autosar_swc_vmp/autosar_swc_vmp_Step_sys/lgt_pln/lonap_vlcInternalAccCalc"
 /begin REF_MEASUREMENT autosar_swc_vmp_rtARID_DEF.TmpSignalConversionAtaxvRefMs2Outport1 autosar_swc_vmp_rtARID_DEF.UnitDelay1 /end REF_MEASUREMENT
/end GROUP
/begin RECORD_LAYOUT Record_BOOLEAN FNC_VALUES 1 UBYTE COLUMN_DIR DIRECT /end RECORD_LAYOUT
/begin RECORD_LAYOUT Record_FLOAT32_IEEE FNC_VALUES 1 FLOAT32_IEEE COLUMN_DIR DIRECT /end RECORD_LAYOUT
/begin RECORD_LAYOUT Record_UBYTE FNC_VALUES 1 UBYTE COLUMN_DIR DIRECT /end RECORD_LAYOUT
/begin RECORD_LAYOUT Axis_FLOAT32_IEEE AXIS_PTS_X 1 FLOAT32_IEEE INDEX_INCR DIRECT /end RECORD_LAYOUT
/end MODULE
/end PROJECT
