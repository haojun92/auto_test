ASAP2_VERSION 1 71
/begin PROJECT ProjectName ""
/begin MODULE ModuleName ""
/begin MOD_COMMON "" BYTE_ORDER MSB_LAST ALIGNMENT_BYTE 1 ALIGNMENT_WORD 1 ALIGNMENT_LONG 1 ALIGNMENT_INT64 1 ALIGNMENT_FLOAT16_IEEE 1 ALIGNMENT_FLOAT32_IEEE 1 ALIGNMENT_FLOAT64_IEEE 1 /end MOD_COMMON
/begin RECORD_LAYOUT Scalar_FLOAT32_IEEE FNC_VALUES 1 FLOAT32_IEEE COLUMN_DIR DIRECT /end RECORD_LAYOUT
/begin RECORD_LAYOUT Scalar_FLOAT64_IEEE FNC_VALUES 1 FLOAT64_IEEE COLUMN_DIR DIRECT /end RECORD_LAYOUT
/begin RECORD_LAYOUT Lookup1D_BOOLEAN FNC_VALUES 1 UBYTE COLUMN_DIR DIRECT /end RECORD_LAYOUT
/begin RECORD_LAYOUT Lookup1D_X_BOOLEAN AXIS_PTS_X 1 UBYTE INDEX_INCR DIRECT /end RECORD_LAYOUT
/begin RECORD_LAYOUT Lookup1D_BYTE FNC_VALUES 1 SBYTE COLUMN_DIR DIRECT /end RECORD_LAYOUT
/begin MEASUREMENT SwcOut_AEB_DebugInfo.obj_data_info[1].bounding_box.cos_rotation "" FLOAT32_IEEE autosar_swc_aeb_CM_single 0 0 -3.4E+38 3.4E+38 ECU_ADDRESS 0xfe4a4658 /* @ECU_Address@SwcOut_AEB_DebugInfo.obj_data_info[1].bounding_box.cos_rotation@ */ /end MEASUREMENT
/begin MEASUREMENT SwcOut_AEB_DebugInfo.obj_data_info[1].bounding_box.length_side_lat "" FLOAT32_IEEE autosar_swc_aeb_CM_single 0 0 -3.4E+38 3.4E+38 ECU_ADDRESS 0xfe4a464c /* @ECU_Address@SwcOut_AEB_DebugInfo.obj_data_info[1].bounding_box.length_side_lat@ */ /end MEASUREMENT
/begin MEASUREMENT SwcOut_AEB_DebugInfo.obj_data_info[1].bounding_box.length_side_lgt "" FLOAT32_IEEE autosar_swc_aeb_CM_single 0 0 -3.4E+38 3.4E+38 ECU_ADDRESS 0xfe4a4650 /* @ECU_Address@SwcOut_AEB_DebugInfo.obj_data_info[1].bounding_box.length_side_lgt@ */ /end MEASUREMENT
/begin MEASUREMENT SwcOut_AEB_DebugInfo.obj_data_info[1].bounding_box.sin_rotation "" FLOAT32_IEEE autosar_swc_aeb_CM_single 0 0 -3.4E+38 3.4E+38 ECU_ADDRESS 0xfe4a4654 /* @ECU_Address@SwcOut_AEB_DebugInfo.obj_data_info[1].bounding_box.sin_rotation@ */ /end MEASUREMENT
/begin MEASUREMENT SwcOut_AEB_DebugInfo.obj_data_info[1].long_pred_time.inpath "" UBYTE autosar_swc_aeb_CM_boolean 0 0 0 1 ECU_ADDRESS 0xfe4a4670 /* @ECU_Address@SwcOut_AEB_DebugInfo.obj_data_info[1].long_pred_time.inpath@ */ /end MEASUREMENT
/begin MEASUREMENT SwcOut_AEB_DebugInfo.obj_data_info[1].long_pred_time.inpath_current_position "" UBYTE autosar_swc_aeb_CM_boolean 0 0 0 1 ECU_ADDRESS 0xfe4a4672 /* @ECU_Address@SwcOut_AEB_DebugInfo.obj_data_info[1].long_pred_time.inpath_current_position@ */ /end MEASUREMENT
/begin MEASUREMENT SwcOut_AEB_DebugInfo.obj_data_info[1].long_pred_time.inpath_predict_position "" UBYTE autosar_swc_aeb_CM_boolean 0 0 0 1 ECU_ADDRESS 0xfe4a4671 /* @ECU_Address@SwcOut_AEB_DebugInfo.obj_data_info[1].long_pred_time.inpath_predict_position@ */ /end MEASUREMENT
/begin MEASUREMENT SwcOut_AEB_DebugInfo.obj_data_info[1].long_pred_time.prediction_valid "" UBYTE autosar_swc_aeb_CM_boolean 0 0 0 1 ECU_ADDRESS 0xfe4a4675 /* @ECU_Address@SwcOut_AEB_DebugInfo.obj_data_info[1].long_pred_time.prediction_valid@ */ /end MEASUREMENT
/begin MEASUREMENT SwcOut_AEB_DebugInfo.obj_data_info[1].long_pred_time.ttr "" FLOAT32_IEEE autosar_swc_aeb_CM_single 0 0 -3.4E+38 3.4E+38 ECU_ADDRESS 0xfe4a466c /* @ECU_Address@SwcOut_AEB_DebugInfo.obj_data_info[1].long_pred_time.ttr@ */ /end MEASUREMENT
/begin MEASUREMENT SwcOut_AEB_DebugInfo.obj_data_info[1].long_pred_time.use_inpath_calculation "" UBYTE autosar_swc_aeb_CM_boolean 0 0 0 1 ECU_ADDRESS 0xfe4a4673 /* @ECU_Address@SwcOut_AEB_DebugInfo.obj_data_info[1].long_pred_time.use_inpath_calculation@ */ /end MEASUREMENT
/begin MEASUREMENT SwcOut_AEB_DebugInfo.obj_data_info[1].long_pred_time.use_out_offpath_calculation "" UBYTE autosar_swc_aeb_CM_boolean 0 0 0 1 ECU_ADDRESS 0xfe4a4674 /* @ECU_Address@SwcOut_AEB_DebugInfo.obj_data_info[1].long_pred_time.use_out_offpath_calculation@ */ /end MEASUREMENT
/begin MEASUREMENT SwcOut_AEB_DebugInfo.obj_data_info[1].motion_type.abs_heading "" FLOAT32_IEEE autosar_swc_aeb_CM_single 0 0 -3.4E+38 3.4E+38 ECU_ADDRESS 0xfe4a4648 /* @ECU_Address@SwcOut_AEB_DebugInfo.obj_data_info[1].motion_type.abs_heading@ */ /end MEASUREMENT
/begin MEASUREMENT SwcOut_AEB_DebugInfo.obj_data_info[1].motion_type.curved_motion "" UBYTE autosar_swc_aeb_CM_boolean 0 0 0 1 ECU_ADDRESS 0xfe4a4646 /* @ECU_Address@SwcOut_AEB_DebugInfo.obj_data_info[1].motion_type.curved_motion@ */ /end MEASUREMENT
/begin MEASUREMENT SwcOut_AEB_DebugInfo.obj_data_info[1].motion_type.moving_oncoming "" UBYTE autosar_swc_aeb_CM_boolean 0 0 0 1 ECU_ADDRESS 0xfe4a4641 /* @ECU_Address@SwcOut_AEB_DebugInfo.obj_data_info[1].motion_type.moving_oncoming@ */ /end MEASUREMENT
/begin MEASUREMENT SwcOut_AEB_DebugInfo.obj_data_info[1].motion_type.object_is_motor_vehicle "" UBYTE autosar_swc_aeb_CM_boolean 0 0 0 1 ECU_ADDRESS 0xfe4a4645 /* @ECU_Address@SwcOut_AEB_DebugInfo.obj_data_info[1].motion_type.object_is_motor_vehicle@ */ /end MEASUREMENT
/begin MEASUREMENT SwcOut_AEB_DebugInfo.obj_data_info[1].motion_type.object_is_vehicle "" UBYTE autosar_swc_aeb_CM_boolean 0 0 0 1 ECU_ADDRESS 0xfe4a4644 /* @ECU_Address@SwcOut_AEB_DebugInfo.obj_data_info[1].motion_type.object_is_vehicle@ */ /end MEASUREMENT
/begin MEASUREMENT SwcOut_AEB_DebugInfo.obj_data_info[1].motion_type.parallell_vehicle_long_predict "" UBYTE autosar_swc_aeb_CM_boolean 0 0 0 1 ECU_ADDRESS 0xfe4a4642 /* @ECU_Address@SwcOut_AEB_DebugInfo.obj_data_info[1].motion_type.parallell_vehicle_long_predict@ */ /end MEASUREMENT
/begin MEASUREMENT SwcOut_AEB_DebugInfo.obj_data_info[1].motion_type.parallell_vehicle_short_predict "" UBYTE autosar_swc_aeb_CM_boolean 0 0 0 1 ECU_ADDRESS 0xfe4a4643 /* @ECU_Address@SwcOut_AEB_DebugInfo.obj_data_info[1].motion_type.parallell_vehicle_short_predict@ */ /end MEASUREMENT
/begin MEASUREMENT SwcOut_AEB_DebugInfo.obj_data_info[1].motion_type.side_is_closest "" UBYTE autosar_swc_aeb_CM_boolean 0 0 0 1 ECU_ADDRESS 0xfe4a4647 /* @ECU_Address@SwcOut_AEB_DebugInfo.obj_data_info[1].motion_type.side_is_closest@ */ /end MEASUREMENT
/begin MEASUREMENT SwcOut_AEB_DebugInfo.obj_data_info[1].motion_type.stationary "" UBYTE autosar_swc_aeb_CM_boolean 0 0 0 1 ECU_ADDRESS 0xfe4a4640 /* @ECU_Address@SwcOut_AEB_DebugInfo.obj_data_info[1].motion_type.stationary@ */ /end MEASUREMENT
/begin MEASUREMENT SwcOut_AEB_DebugInfo.obj_data_info[1].offsets.offs_lat_inpath_close_edge "" FLOAT32_IEEE autosar_swc_aeb_CM_single 0 0 -3.4E+38 3.4E+38 ECU_ADDRESS 0xfe4a4690 /* @ECU_Address@SwcOut_AEB_DebugInfo.obj_data_info[1].offsets.offs_lat_inpath_close_edge@ */ /end MEASUREMENT
/begin MEASUREMENT SwcOut_AEB_DebugInfo.obj_data_info[1].offsets.offs_lat_inpath_far_edge "" FLOAT32_IEEE autosar_swc_aeb_CM_single 0 0 -3.4E+38 3.4E+38 ECU_ADDRESS 0xfe4a4694 /* @ECU_Address@SwcOut_AEB_DebugInfo.obj_data_info[1].offsets.offs_lat_inpath_far_edge@ */ /end MEASUREMENT
/begin MEASUREMENT SwcOut_AEB_DebugInfo.obj_data_info[1].offsets.offs_lat_inpath_primary_target "" FLOAT32_IEEE autosar_swc_aeb_CM_single 0 0 -3.4E+38 3.4E+38 ECU_ADDRESS 0xfe4a468c /* @ECU_Address@SwcOut_AEB_DebugInfo.obj_data_info[1].offsets.offs_lat_inpath_primary_target@ */ /end MEASUREMENT
/begin MEASUREMENT SwcOut_AEB_DebugInfo.obj_data_info[1].offsets.offs_lat_intersection "" FLOAT32_IEEE autosar_swc_aeb_CM_single 0 0 -3.4E+38 3.4E+38 ECU_ADDRESS 0xfe4a4698 /* @ECU_Address@SwcOut_AEB_DebugInfo.obj_data_info[1].offsets.offs_lat_intersection@ */ /end MEASUREMENT
/begin MEASUREMENT SwcOut_AEB_DebugInfo.obj_data_info[1].offsets.offs_lat_long_predict "" FLOAT32_IEEE autosar_swc_aeb_CM_single 0 0 -3.4E+38 3.4E+38 ECU_ADDRESS 0xfe4a467c /* @ECU_Address@SwcOut_AEB_DebugInfo.obj_data_info[1].offsets.offs_lat_long_predict@ */ /end MEASUREMENT
/begin MEASUREMENT SwcOut_AEB_DebugInfo.obj_data_info[1].offsets.offs_lat_manoeuvre "" FLOAT32_IEEE autosar_swc_aeb_CM_single 0 0 -3.4E+38 3.4E+38 ECU_ADDRESS 0xfe4a4688 /* @ECU_Address@SwcOut_AEB_DebugInfo.obj_data_info[1].offsets.offs_lat_manoeuvre@ */ /end MEASUREMENT
/begin MEASUREMENT SwcOut_AEB_DebugInfo.obj_data_info[1].offsets.offs_lat_multiple_target "" FLOAT32_IEEE autosar_swc_aeb_CM_single 0 0 -3.4E+38 3.4E+38 ECU_ADDRESS 0xfe4a469c /* @ECU_Address@SwcOut_AEB_DebugInfo.obj_data_info[1].offsets.offs_lat_multiple_target@ */ /end MEASUREMENT
/begin MEASUREMENT SwcOut_AEB_DebugInfo.obj_data_info[1].offsets.offs_lat_short_predict "" FLOAT32_IEEE autosar_swc_aeb_CM_single 0 0 -3.4E+38 3.4E+38 ECU_ADDRESS 0xfe4a4684 /* @ECU_Address@SwcOut_AEB_DebugInfo.obj_data_info[1].offsets.offs_lat_short_predict@ */ /end MEASUREMENT
/begin MEASUREMENT SwcOut_AEB_DebugInfo.obj_data_info[1].offsets.offs_lgt_long_predict "" FLOAT32_IEEE autosar_swc_aeb_CM_single 0 0 -3.4E+38 3.4E+38 ECU_ADDRESS 0xfe4a4678 /* @ECU_Address@SwcOut_AEB_DebugInfo.obj_data_info[1].offsets.offs_lgt_long_predict@ */ /end MEASUREMENT
/begin MEASUREMENT SwcOut_AEB_DebugInfo.obj_data_info[1].offsets.offs_lgt_short_predict "" FLOAT32_IEEE autosar_swc_aeb_CM_single 0 0 -3.4E+38 3.4E+38 ECU_ADDRESS 0xfe4a4680 /* @ECU_Address@SwcOut_AEB_DebugInfo.obj_data_info[1].offsets.offs_lgt_short_predict@ */ /end MEASUREMENT
/begin MEASUREMENT SwcOut_AEB_DebugInfo.obj_data_info[1].porperty.a "" FLOAT32_IEEE autosar_swc_aeb_CM_single 0 0 -3.4E+38 3.4E+38 ECU_ADDRESS 0xfe4a4638 /* @ECU_Address@SwcOut_AEB_DebugInfo.obj_data_info[1].porperty.a@ */ /end MEASUREMENT
/begin MEASUREMENT SwcOut_AEB_DebugInfo.obj_data_info[1].porperty.a_lat "" FLOAT32_IEEE autosar_swc_aeb_CM_single 0 0 -3.4E+38 3.4E+38 ECU_ADDRESS 0xfe4a4634 /* @ECU_Address@SwcOut_AEB_DebugInfo.obj_data_info[1].porperty.a_lat@ */ /end MEASUREMENT
/begin MEASUREMENT SwcOut_AEB_DebugInfo.obj_data_info[1].porperty.a_lgt "" FLOAT32_IEEE autosar_swc_aeb_CM_single 0 0 -3.4E+38 3.4E+38 ECU_ADDRESS 0xfe4a4630 /* @ECU_Address@SwcOut_AEB_DebugInfo.obj_data_info[1].porperty.a_lgt@ */ /end MEASUREMENT
/begin MEASUREMENT SwcOut_AEB_DebugInfo.obj_data_info[1].porperty.curvature "" FLOAT32_IEEE autosar_swc_aeb_CM_single 0 0 -3.4E+38 3.4E+38 ECU_ADDRESS 0xfe4a463c /* @ECU_Address@SwcOut_AEB_DebugInfo.obj_data_info[1].porperty.curvature@ */ /end MEASUREMENT
/begin MEASUREMENT SwcOut_AEB_DebugInfo.obj_data_info[1].porperty.p_lat "" FLOAT32_IEEE autosar_swc_aeb_CM_single 0 0 -3.4E+38 3.4E+38 ECU_ADDRESS 0xfe4a4620 /* @ECU_Address@SwcOut_AEB_DebugInfo.obj_data_info[1].porperty.p_lat@ */ /end MEASUREMENT
/begin MEASUREMENT SwcOut_AEB_DebugInfo.obj_data_info[1].porperty.p_lgt "" FLOAT32_IEEE autosar_swc_aeb_CM_single 0 0 -3.4E+38 3.4E+38 ECU_ADDRESS 0xfe4a461c /* @ECU_Address@SwcOut_AEB_DebugInfo.obj_data_info[1].porperty.p_lgt@ */ /end MEASUREMENT
/begin MEASUREMENT SwcOut_AEB_DebugInfo.obj_data_info[1].porperty.spd "" FLOAT32_IEEE autosar_swc_aeb_CM_single 0 0 -3.4E+38 3.4E+38 ECU_ADDRESS 0xfe4a4624 /* @ECU_Address@SwcOut_AEB_DebugInfo.obj_data_info[1].porperty.spd@ */ /end MEASUREMENT
/begin MEASUREMENT SwcOut_AEB_DebugInfo.obj_data_info[1].porperty.v_lat "" FLOAT32_IEEE autosar_swc_aeb_CM_single 0 0 -3.4E+38 3.4E+38 ECU_ADDRESS 0xfe4a462c /* @ECU_Address@SwcOut_AEB_DebugInfo.obj_data_info[1].porperty.v_lat@ */ /end MEASUREMENT
/begin MEASUREMENT SwcOut_AEB_DebugInfo.obj_data_info[1].porperty.v_lgt "" FLOAT32_IEEE autosar_swc_aeb_CM_single 0 0 -3.4E+38 3.4E+38 ECU_ADDRESS 0xfe4a4628 /* @ECU_Address@SwcOut_AEB_DebugInfo.obj_data_info[1].porperty.v_lgt@ */ /end MEASUREMENT
/begin MEASUREMENT SwcOut_AEB_DebugInfo.obj_data_info[1].short_pred_time.inpath "" UBYTE autosar_swc_aeb_CM_boolean 0 0 0 1 ECU_ADDRESS 0xfe4a4665 /* @ECU_Address@SwcOut_AEB_DebugInfo.obj_data_info[1].short_pred_time.inpath@ */ /end MEASUREMENT
/begin MEASUREMENT SwcOut_AEB_DebugInfo.obj_data_info[1].short_pred_time.inpath_current_position "" UBYTE autosar_swc_aeb_CM_boolean 0 0 0 1 ECU_ADDRESS 0xfe4a4667 /* @ECU_Address@SwcOut_AEB_DebugInfo.obj_data_info[1].short_pred_time.inpath_current_position@ */ /end MEASUREMENT
/begin MEASUREMENT SwcOut_AEB_DebugInfo.obj_data_info[1].short_pred_time.inpath_predict_position "" UBYTE autosar_swc_aeb_CM_boolean 0 0 0 1 ECU_ADDRESS 0xfe4a4666 /* @ECU_Address@SwcOut_AEB_DebugInfo.obj_data_info[1].short_pred_time.inpath_predict_position@ */ /end MEASUREMENT
/begin MEASUREMENT SwcOut_AEB_DebugInfo.obj_data_info[1].short_pred_time.prediction_valid "" UBYTE autosar_swc_aeb_CM_boolean 0 0 0 1 ECU_ADDRESS 0xfe4a466a /* @ECU_Address@SwcOut_AEB_DebugInfo.obj_data_info[1].short_pred_time.prediction_valid@ */ /end MEASUREMENT
/begin MEASUREMENT SwcOut_AEB_DebugInfo.obj_data_info[1].short_pred_time.ttm "" FLOAT32_IEEE autosar_swc_aeb_CM_single 0 0 -3.4E+38 3.4E+38 ECU_ADDRESS 0xfe4a4660 /* @ECU_Address@SwcOut_AEB_DebugInfo.obj_data_info[1].short_pred_time.ttm@ */ /end MEASUREMENT
/begin MEASUREMENT SwcOut_AEB_DebugInfo.obj_data_info[1].short_pred_time.ttm_selected "" UBYTE autosar_swc_aeb_CM_boolean 0 0 0 1 ECU_ADDRESS 0xfe4a4664 /* @ECU_Address@SwcOut_AEB_DebugInfo.obj_data_info[1].short_pred_time.ttm_selected@ */ /end MEASUREMENT
/begin MEASUREMENT SwcOut_AEB_DebugInfo.obj_data_info[1].short_pred_time.ttr "" FLOAT32_IEEE autosar_swc_aeb_CM_single 0 0 -3.4E+38 3.4E+38 ECU_ADDRESS 0xfe4a465c /* @ECU_Address@SwcOut_AEB_DebugInfo.obj_data_info[1].short_pred_time.ttr@ */ /end MEASUREMENT
/begin MEASUREMENT SwcOut_AEB_DebugInfo.obj_data_info[1].short_pred_time.use_inpath_calculation "" UBYTE autosar_swc_aeb_CM_boolean 0 0 0 1 ECU_ADDRESS 0xfe4a4668 /* @ECU_Address@SwcOut_AEB_DebugInfo.obj_data_info[1].short_pred_time.use_inpath_calculation@ */ /end MEASUREMENT
/begin MEASUREMENT SwcOut_AEB_DebugInfo.obj_data_info[1].short_pred_time.use_out_offpath_calculation "" UBYTE autosar_swc_aeb_CM_boolean 0 0 0 1 ECU_ADDRESS 0xfe4a4669 /* @ECU_Address@SwcOut_AEB_DebugInfo.obj_data_info[1].short_pred_time.use_out_offpath_calculation@ */ /end MEASUREMENT
/begin MEASUREMENT SwcOut_AEB_DebugInfo.obj_data_info[2].bounding_box.cos_rotation "" FLOAT32_IEEE autosar_swc_aeb_CM_single 0 0 -3.4E+38 3.4E+38 ECU_ADDRESS 0xfe4a46dc /* @ECU_Address@SwcOut_AEB_DebugInfo.obj_data_info[2].bounding_box.cos_rotation@ */ /end MEASUREMENT
/begin MEASUREMENT SwcOut_AEB_DebugInfo.obj_data_info[2].bounding_box.length_side_lat "" FLOAT32_IEEE autosar_swc_aeb_CM_single 0 0 -3.4E+38 3.4E+38 ECU_ADDRESS 0xfe4a46d0 /* @ECU_Address@SwcOut_AEB_DebugInfo.obj_data_info[2].bounding_box.length_side_lat@ */ /end MEASUREMENT
/begin MEASUREMENT SwcOut_AEB_DebugInfo.obj_data_info[2].bounding_box.length_side_lgt "" FLOAT32_IEEE autosar_swc_aeb_CM_single 0 0 -3.4E+38 3.4E+38 ECU_ADDRESS 0xfe4a46d4 /* @ECU_Address@SwcOut_AEB_DebugInfo.obj_data_info[2].bounding_box.length_side_lgt@ */ /end MEASUREMENT
/begin MEASUREMENT SwcOut_AEB_DebugInfo.obj_data_info[2].bounding_box.sin_rotation "" FLOAT32_IEEE autosar_swc_aeb_CM_single 0 0 -3.4E+38 3.4E+38 ECU_ADDRESS 0xfe4a46d8 /* @ECU_Address@SwcOut_AEB_DebugInfo.obj_data_info[2].bounding_box.sin_rotation@ */ /end MEASUREMENT
/begin MEASUREMENT SwcOut_AEB_DebugInfo.obj_data_info[2].long_pred_time.inpath "" UBYTE autosar_swc_aeb_CM_boolean 0 0 0 1 ECU_ADDRESS 0xfe4a46f4 /* @ECU_Address@SwcOut_AEB_DebugInfo.obj_data_info[2].long_pred_time.inpath@ */ /end MEASUREMENT
/begin MEASUREMENT SwcOut_AEB_DebugInfo.obj_data_info[2].long_pred_time.inpath_current_position "" UBYTE autosar_swc_aeb_CM_boolean 0 0 0 1 ECU_ADDRESS 0xfe4a46f6 /* @ECU_Address@SwcOut_AEB_DebugInfo.obj_data_info[2].long_pred_time.inpath_current_position@ */ /end MEASUREMENT
/begin MEASUREMENT SwcOut_AEB_DebugInfo.obj_data_info[2].long_pred_time.inpath_predict_position "" UBYTE autosar_swc_aeb_CM_boolean 0 0 0 1 ECU_ADDRESS 0xfe4a46f5 /* @ECU_Address@SwcOut_AEB_DebugInfo.obj_data_info[2].long_pred_time.inpath_predict_position@ */ /end MEASUREMENT
/begin MEASUREMENT SwcOut_AEB_DebugInfo.obj_data_info[2].long_pred_time.prediction_valid "" UBYTE autosar_swc_aeb_CM_boolean 0 0 0 1 ECU_ADDRESS 0xfe4a46f9 /* @ECU_Address@SwcOut_AEB_DebugInfo.obj_data_info[2].long_pred_time.prediction_valid@ */ /end MEASUREMENT
/begin MEASUREMENT SwcOut_AEB_DebugInfo.obj_data_info[2].long_pred_time.ttr "" FLOAT32_IEEE autosar_swc_aeb_CM_single 0 0 -3.4E+38 3.4E+38 ECU_ADDRESS 0xfe4a46f0 /* @ECU_Address@SwcOut_AEB_DebugInfo.obj_data_info[2].long_pred_time.ttr@ */ /end MEASUREMENT
/begin MEASUREMENT SwcOut_AEB_DebugInfo.obj_data_info[2].long_pred_time.use_inpath_calculation "" UBYTE autosar_swc_aeb_CM_boolean 0 0 0 1 ECU_ADDRESS 0xfe4a46f7 /* @ECU_Address@SwcOut_AEB_DebugInfo.obj_data_info[2].long_pred_time.use_inpath_calculation@ */ /end MEASUREMENT
/begin MEASUREMENT SwcOut_AEB_DebugInfo.obj_data_info[2].long_pred_time.use_out_offpath_calculation "" UBYTE autosar_swc_aeb_CM_boolean 0 0 0 1 ECU_ADDRESS 0xfe4a46f8 /* @ECU_Address@SwcOut_AEB_DebugInfo.obj_data_info[2].long_pred_time.use_out_offpath_calculation@ */ /end MEASUREMENT
/begin MEASUREMENT SwcOut_AEB_DebugInfo.obj_data_info[2].motion_type.abs_heading "" FLOAT32_IEEE autosar_swc_aeb_CM_single 0 0 -3.4E+38 3.4E+38 ECU_ADDRESS 0xfe4a46cc /* @ECU_Address@SwcOut_AEB_DebugInfo.obj_data_info[2].motion_type.abs_heading@ */ /end MEASUREMENT
/begin MEASUREMENT SwcOut_AEB_DebugInfo.obj_data_info[2].motion_type.curved_motion "" UBYTE autosar_swc_aeb_CM_boolean 0 0 0 1 ECU_ADDRESS 0xfe4a46ca /* @ECU_Address@SwcOut_AEB_DebugInfo.obj_data_info[2].motion_type.curved_motion@ */ /end MEASUREMENT
/begin MEASUREMENT SwcOut_AEB_DebugInfo.obj_data_info[2].motion_type.moving_oncoming "" UBYTE autosar_swc_aeb_CM_boolean 0 0 0 1 ECU_ADDRESS 0xfe4a46c5 /* @ECU_Address@SwcOut_AEB_DebugInfo.obj_data_info[2].motion_type.moving_oncoming@ */ /end MEASUREMENT
/begin MEASUREMENT SwcOut_AEB_DebugInfo.obj_data_info[2].motion_type.object_is_motor_vehicle "" UBYTE autosar_swc_aeb_CM_boolean 0 0 0 1 ECU_ADDRESS 0xfe4a46c9 /* @ECU_Address@SwcOut_AEB_DebugInfo.obj_data_info[2].motion_type.object_is_motor_vehicle@ */ /end MEASUREMENT
/begin MEASUREMENT SwcOut_AEB_DebugInfo.obj_data_info[2].motion_type.object_is_vehicle "" UBYTE autosar_swc_aeb_CM_boolean 0 0 0 1 ECU_ADDRESS 0xfe4a46c8 /* @ECU_Address@SwcOut_AEB_DebugInfo.obj_data_info[2].motion_type.object_is_vehicle@ */ /end MEASUREMENT
/begin MEASUREMENT SwcOut_AEB_DebugInfo.obj_data_info[2].motion_type.parallell_vehicle_long_predict "" UBYTE autosar_swc_aeb_CM_boolean 0 0 0 1 ECU_ADDRESS 0xfe4a46c6 /* @ECU_Address@SwcOut_AEB_DebugInfo.obj_data_info[2].motion_type.parallell_vehicle_long_predict@ */ /end MEASUREMENT
/begin MEASUREMENT SwcOut_AEB_DebugInfo.obj_data_info[2].motion_type.parallell_vehicle_short_predict "" UBYTE autosar_swc_aeb_CM_boolean 0 0 0 1 ECU_ADDRESS 0xfe4a46c7 /* @ECU_Address@SwcOut_AEB_DebugInfo.obj_data_info[2].motion_type.parallell_vehicle_short_predict@ */ /end MEASUREMENT
/begin MEASUREMENT SwcOut_AEB_DebugInfo.obj_data_info[2].motion_type.side_is_closest "" UBYTE autosar_swc_aeb_CM_boolean 0 0 0 1 ECU_ADDRESS 0xfe4a46cb /* @ECU_Address@SwcOut_AEB_DebugInfo.obj_data_info[2].motion_type.side_is_closest@ */ /end MEASUREMENT
/begin MEASUREMENT SwcOut_AEB_DebugInfo.obj_data_info[2].motion_type.stationary "" UBYTE autosar_swc_aeb_CM_boolean 0 0 0 1 ECU_ADDRESS 0xfe4a46c4 /* @ECU_Address@SwcOut_AEB_DebugInfo.obj_data_info[2].motion_type.stationary@ */ /end MEASUREMENT
/begin MEASUREMENT SwcOut_AEB_DebugInfo.obj_data_info[2].offsets.offs_lat_inpath_close_edge "" FLOAT32_IEEE autosar_swc_aeb_CM_single 0 0 -3.4E+38 3.4E+38 ECU_ADDRESS 0xfe4a4714 /* @ECU_Address@SwcOut_AEB_DebugInfo.obj_data_info[2].offsets.offs_lat_inpath_close_edge@ */ /end MEASUREMENT
/begin MEASUREMENT SwcOut_AEB_DebugInfo.obj_data_info[2].offsets.offs_lat_inpath_far_edge "" FLOAT32_IEEE autosar_swc_aeb_CM_single 0 0 -3.4E+38 3.4E+38 ECU_ADDRESS 0xfe4a4718 /* @ECU_Address@SwcOut_AEB_DebugInfo.obj_data_info[2].offsets.offs_lat_inpath_far_edge@ */ /end MEASUREMENT
/begin MEASUREMENT SwcOut_AEB_DebugInfo.obj_data_info[2].offsets.offs_lat_inpath_primary_target "" FLOAT32_IEEE autosar_swc_aeb_CM_single 0 0 -3.4E+38 3.4E+38 ECU_ADDRESS 0xfe4a4710 /* @ECU_Address@SwcOut_AEB_DebugInfo.obj_data_info[2].offsets.offs_lat_inpath_primary_target@ */ /end MEASUREMENT
/begin MEASUREMENT SwcOut_AEB_DebugInfo.obj_data_info[2].offsets.offs_lat_intersection "" FLOAT32_IEEE autosar_swc_aeb_CM_single 0 0 -3.4E+38 3.4E+38 ECU_ADDRESS 0xfe4a471c /* @ECU_Address@SwcOut_AEB_DebugInfo.obj_data_info[2].offsets.offs_lat_intersection@ */ /end MEASUREMENT
/begin MEASUREMENT SwcOut_AEB_DebugInfo.obj_data_info[2].offsets.offs_lat_long_predict "" FLOAT32_IEEE autosar_swc_aeb_CM_single 0 0 -3.4E+38 3.4E+38 ECU_ADDRESS 0xfe4a4700 /* @ECU_Address@SwcOut_AEB_DebugInfo.obj_data_info[2].offsets.offs_lat_long_predict@ */ /end MEASUREMENT
/begin MEASUREMENT SwcOut_AEB_DebugInfo.obj_data_info[2].offsets.offs_lat_manoeuvre "" FLOAT32_IEEE autosar_swc_aeb_CM_single 0 0 -3.4E+38 3.4E+38 ECU_ADDRESS 0xfe4a470c /* @ECU_Address@SwcOut_AEB_DebugInfo.obj_data_info[2].offsets.offs_lat_manoeuvre@ */ /end MEASUREMENT
/begin MEASUREMENT SwcOut_AEB_DebugInfo.obj_data_info[2].offsets.offs_lat_multiple_target "" FLOAT32_IEEE autosar_swc_aeb_CM_single 0 0 -3.4E+38 3.4E+38 ECU_ADDRESS 0xfe4a4720 /* @ECU_Address@SwcOut_AEB_DebugInfo.obj_data_info[2].offsets.offs_lat_multiple_target@ */ /end MEASUREMENT
/begin MEASUREMENT SwcOut_AEB_DebugInfo.obj_data_info[2].offsets.offs_lat_short_predict "" FLOAT32_IEEE autosar_swc_aeb_CM_single 0 0 -3.4E+38 3.4E+38 ECU_ADDRESS 0xfe4a4708 /* @ECU_Address@SwcOut_AEB_DebugInfo.obj_data_info[2].offsets.offs_lat_short_predict@ */ /end MEASUREMENT
/begin MEASUREMENT SwcOut_AEB_DebugInfo.obj_data_info[2].offsets.offs_lgt_long_predict "" FLOAT32_IEEE autosar_swc_aeb_CM_single 0 0 -3.4E+38 3.4E+38 ECU_ADDRESS 0xfe4a46fc /* @ECU_Address@SwcOut_AEB_DebugInfo.obj_data_info[2].offsets.offs_lgt_long_predict@ */ /end MEASUREMENT
/begin MEASUREMENT SwcOut_AEB_DebugInfo.obj_data_info[2].offsets.offs_lgt_short_predict "" FLOAT32_IEEE autosar_swc_aeb_CM_single 0 0 -3.4E+38 3.4E+38 ECU_ADDRESS 0xfe4a4704 /* @ECU_Address@SwcOut_AEB_DebugInfo.obj_data_info[2].offsets.offs_lgt_short_predict@ */ /end MEASUREMENT
/begin MEASUREMENT SwcOut_AEB_DebugInfo.obj_data_info[2].porperty.a "" FLOAT32_IEEE autosar_swc_aeb_CM_single 0 0 -3.4E+38 3.4E+38 ECU_ADDRESS 0xfe4a46bc /* @ECU_Address@SwcOut_AEB_DebugInfo.obj_data_info[2].porperty.a@ */ /end MEASUREMENT
/begin MEASUREMENT SwcOut_AEB_DebugInfo.obj_data_info[2].porperty.a_lat "" FLOAT32_IEEE autosar_swc_aeb_CM_single 0 0 -3.4E+38 3.4E+38 ECU_ADDRESS 0xfe4a46b8 /* @ECU_Address@SwcOut_AEB_DebugInfo.obj_data_info[2].porperty.a_lat@ */ /end MEASUREMENT
/begin MEASUREMENT SwcOut_AEB_DebugInfo.obj_data_info[2].porperty.a_lgt "" FLOAT32_IEEE autosar_swc_aeb_CM_single 0 0 -3.4E+38 3.4E+38 ECU_ADDRESS 0xfe4a46b4 /* @ECU_Address@SwcOut_AEB_DebugInfo.obj_data_info[2].porperty.a_lgt@ */ /end MEASUREMENT
/begin MEASUREMENT SwcOut_AEB_DebugInfo.obj_data_info[2].porperty.curvature "" FLOAT32_IEEE autosar_swc_aeb_CM_single 0 0 -3.4E+38 3.4E+38 ECU_ADDRESS 0xfe4a46c0 /* @ECU_Address@SwcOut_AEB_DebugInfo.obj_data_info[2].porperty.curvature@ */ /end MEASUREMENT
/begin MEASUREMENT SwcOut_AEB_DebugInfo.obj_data_info[2].porperty.p_lat "" FLOAT32_IEEE autosar_swc_aeb_CM_single 0 0 -3.4E+38 3.4E+38 ECU_ADDRESS 0xfe4a46a4 /* @ECU_Address@SwcOut_AEB_DebugInfo.obj_data_info[2].porperty.p_lat@ */ /end MEASUREMENT
/begin MEASUREMENT SwcOut_AEB_DebugInfo.obj_data_info[2].porperty.p_lgt "" FLOAT32_IEEE autosar_swc_aeb_CM_single 0 0 -3.4E+38 3.4E+38 ECU_ADDRESS 0xfe4a46a0 /* @ECU_Address@SwcOut_AEB_DebugInfo.obj_data_info[2].porperty.p_lgt@ */ /end MEASUREMENT
/begin MEASUREMENT SwcOut_AEB_DebugInfo.obj_data_info[2].porperty.spd "" FLOAT32_IEEE autosar_swc_aeb_CM_single 0 0 -3.4E+38 3.4E+38 ECU_ADDRESS 0xfe4a46a8 /* @ECU_Address@SwcOut_AEB_DebugInfo.obj_data_info[2].porperty.spd@ */ /end MEASUREMENT
/begin MEASUREMENT SwcOut_AEB_DebugInfo.obj_data_info[2].porperty.v_lat "" FLOAT32_IEEE autosar_swc_aeb_CM_single 0 0 -3.4E+38 3.4E+38 ECU_ADDRESS 0xfe4a46b0 /* @ECU_Address@SwcOut_AEB_DebugInfo.obj_data_info[2].porperty.v_lat@ */ /end MEASUREMENT
/begin MEASUREMENT SwcOut_AEB_DebugInfo.obj_data_info[2].porperty.v_lgt "" FLOAT32_IEEE autosar_swc_aeb_CM_single 0 0 -3.4E+38 3.4E+38 ECU_ADDRESS 0xfe4a46ac /* @ECU_Address@SwcOut_AEB_DebugInfo.obj_data_info[2].porperty.v_lgt@ */ /end MEASUREMENT
/begin MEASUREMENT SwcOut_AEB_DebugInfo.obj_data_info[2].short_pred_time.inpath "" UBYTE autosar_swc_aeb_CM_boolean 0 0 0 1 ECU_ADDRESS 0xfe4a46e9 /* @ECU_Address@SwcOut_AEB_DebugInfo.obj_data_info[2].short_pred_time.inpath@ */ /end MEASUREMENT
/begin MEASUREMENT SwcOut_AEB_DebugInfo.obj_data_info[2].short_pred_time.inpath_current_position "" UBYTE autosar_swc_aeb_CM_boolean 0 0 0 1 ECU_ADDRESS 0xfe4a46eb /* @ECU_Address@SwcOut_AEB_DebugInfo.obj_data_info[2].short_pred_time.inpath_current_position@ */ /end MEASUREMENT
/begin MEASUREMENT SwcOut_AEB_DebugInfo.obj_data_info[2].short_pred_time.inpath_predict_position "" UBYTE autosar_swc_aeb_CM_boolean 0 0 0 1 ECU_ADDRESS 0xfe4a46ea /* @ECU_Address@SwcOut_AEB_DebugInfo.obj_data_info[2].short_pred_time.inpath_predict_position@ */ /end MEASUREMENT
/begin MEASUREMENT SwcOut_AEB_DebugInfo.obj_data_info[2].short_pred_time.prediction_valid "" UBYTE autosar_swc_aeb_CM_boolean 0 0 0 1 ECU_ADDRESS 0xfe4a46ee /* @ECU_Address@SwcOut_AEB_DebugInfo.obj_data_info[2].short_pred_time.prediction_valid@ */ /end MEASUREMENT
/begin MEASUREMENT SwcOut_AEB_DebugInfo.obj_data_info[2].short_pred_time.ttm "" FLOAT32_IEEE autosar_swc_aeb_CM_single 0 0 -3.4E+38 3.4E+38 ECU_ADDRESS 0xfe4a46e4 /* @ECU_Address@SwcOut_AEB_DebugInfo.obj_data_info[2].short_pred_time.ttm@ */ /end MEASUREMENT
/begin MEASUREMENT SwcOut_AEB_DebugInfo.obj_data_info[2].short_pred_time.ttm_selected "" UBYTE autosar_swc_aeb_CM_boolean 0 0 0 1 ECU_ADDRESS 0xfe4a46e8 /* @ECU_Address@SwcOut_AEB_DebugInfo.obj_data_info[2].short_pred_time.ttm_selected@ */ /end MEASUREMENT
/begin MEASUREMENT SwcOut_AEB_DebugInfo.obj_data_info[2].short_pred_time.ttr "" FLOAT32_IEEE autosar_swc_aeb_CM_single 0 0 -3.4E+38 3.4E+38 ECU_ADDRESS 0xfe4a46e0 /* @ECU_Address@SwcOut_AEB_DebugInfo.obj_data_info[2].short_pred_time.ttr@ */ /end MEASUREMENT
/begin MEASUREMENT SwcOut_AEB_DebugInfo.obj_data_info[2].short_pred_time.use_inpath_calculation "" UBYTE autosar_swc_aeb_CM_boolean 0 0 0 1 ECU_ADDRESS 0xfe4a46ec /* @ECU_Address@SwcOut_AEB_DebugInfo.obj_data_info[2].short_pred_time.use_inpath_calculation@ */ /end MEASUREMENT
/begin MEASUREMENT SwcOut_AEB_DebugInfo.obj_data_info[2].short_pred_time.use_out_offpath_calculation "" UBYTE autosar_swc_aeb_CM_boolean 0 0 0 1 ECU_ADDRESS 0xfe4a46ed /* @ECU_Address@SwcOut_AEB_DebugInfo.obj_data_info[2].short_pred_time.use_out_offpath_calculation@ */ /end MEASUREMENT
/begin MEASUREMENT SwcOut_AEB_DebugInfo.obj_data_info[3].bounding_box.cos_rotation "" FLOAT32_IEEE autosar_swc_aeb_CM_single 0 0 -3.4E+38 3.4E+38 ECU_ADDRESS 0xfe4a4760 /* @ECU_Address@SwcOut_AEB_DebugInfo.obj_data_info[3].bounding_box.cos_rotation@ */ /end MEASUREMENT
/begin MEASUREMENT SwcOut_AEB_DebugInfo.obj_data_info[3].bounding_box.length_side_lat "" FLOAT32_IEEE autosar_swc_aeb_CM_single 0 0 -3.4E+38 3.4E+38 ECU_ADDRESS 0xfe4a4754 /* @ECU_Address@SwcOut_AEB_DebugInfo.obj_data_info[3].bounding_box.length_side_lat@ */ /end MEASUREMENT
/begin MEASUREMENT SwcOut_AEB_DebugInfo.obj_data_info[3].bounding_box.length_side_lgt "" FLOAT32_IEEE autosar_swc_aeb_CM_single 0 0 -3.4E+38 3.4E+38 ECU_ADDRESS 0xfe4a4758 /* @ECU_Address@SwcOut_AEB_DebugInfo.obj_data_info[3].bounding_box.length_side_lgt@ */ /end MEASUREMENT
/begin MEASUREMENT SwcOut_AEB_DebugInfo.obj_data_info[3].bounding_box.sin_rotation "" FLOAT32_IEEE autosar_swc_aeb_CM_single 0 0 -3.4E+38 3.4E+38 ECU_ADDRESS 0xfe4a475c /* @ECU_Address@SwcOut_AEB_DebugInfo.obj_data_info[3].bounding_box.sin_rotation@ */ /end MEASUREMENT
/begin MEASUREMENT SwcOut_AEB_DebugInfo.obj_data_info[3].long_pred_time.inpath "" UBYTE autosar_swc_aeb_CM_boolean 0 0 0 1 ECU_ADDRESS 0xfe4a4778 /* @ECU_Address@SwcOut_AEB_DebugInfo.obj_data_info[3].long_pred_time.inpath@ */ /end MEASUREMENT
/begin MEASUREMENT SwcOut_AEB_DebugInfo.obj_data_info[3].long_pred_time.inpath_current_position "" UBYTE autosar_swc_aeb_CM_boolean 0 0 0 1 ECU_ADDRESS 0xfe4a477a /* @ECU_Address@SwcOut_AEB_DebugInfo.obj_data_info[3].long_pred_time.inpath_current_position@ */ /end MEASUREMENT
/begin MEASUREMENT SwcOut_AEB_DebugInfo.obj_data_info[3].long_pred_time.inpath_predict_position "" UBYTE autosar_swc_aeb_CM_boolean 0 0 0 1 ECU_ADDRESS 0xfe4a4779 /* @ECU_Address@SwcOut_AEB_DebugInfo.obj_data_info[3].long_pred_time.inpath_predict_position@ */ /end MEASUREMENT
/begin MEASUREMENT SwcOut_AEB_DebugInfo.obj_data_info[3].long_pred_time.prediction_valid "" UBYTE autosar_swc_aeb_CM_boolean 0 0 0 1 ECU_ADDRESS 0xfe4a477d /* @ECU_Address@SwcOut_AEB_DebugInfo.obj_data_info[3].long_pred_time.prediction_valid@ */ /end MEASUREMENT
/begin MEASUREMENT SwcOut_AEB_DebugInfo.obj_data_info[3].long_pred_time.ttr "" FLOAT32_IEEE autosar_swc_aeb_CM_single 0 0 -3.4E+38 3.4E+38 ECU_ADDRESS 0xfe4a4774 /* @ECU_Address@SwcOut_AEB_DebugInfo.obj_data_info[3].long_pred_time.ttr@ */ /end MEASUREMENT
/begin MEASUREMENT SwcOut_AEB_DebugInfo.obj_data_info[3].long_pred_time.use_inpath_calculation "" UBYTE autosar_swc_aeb_CM_boolean 0 0 0 1 ECU_ADDRESS 0xfe4a477b /* @ECU_Address@SwcOut_AEB_DebugInfo.obj_data_info[3].long_pred_time.use_inpath_calculation@ */ /end MEASUREMENT
/begin MEASUREMENT SwcOut_AEB_DebugInfo.obj_data_info[3].long_pred_time.use_out_offpath_calculation "" UBYTE autosar_swc_aeb_CM_boolean 0 0 0 1 ECU_ADDRESS 0xfe4a477c /* @ECU_Address@SwcOut_AEB_DebugInfo.obj_data_info[3].long_pred_time.use_out_offpath_calculation@ */ /end MEASUREMENT
/begin MEASUREMENT SwcOut_AEB_DebugInfo.obj_data_info[3].motion_type.abs_heading "" FLOAT32_IEEE autosar_swc_aeb_CM_single 0 0 -3.4E+38 3.4E+38 ECU_ADDRESS 0xfe4a4750 /* @ECU_Address@SwcOut_AEB_DebugInfo.obj_data_info[3].motion_type.abs_heading@ */ /end MEASUREMENT
/begin MEASUREMENT SwcOut_AEB_DebugInfo.obj_data_info[3].motion_type.curved_motion "" UBYTE autosar_swc_aeb_CM_boolean 0 0 0 1 ECU_ADDRESS 0xfe4a474e /* @ECU_Address@SwcOut_AEB_DebugInfo.obj_data_info[3].motion_type.curved_motion@ */ /end MEASUREMENT
/begin MEASUREMENT SwcOut_AEB_DebugInfo.obj_data_info[3].motion_type.moving_oncoming "" UBYTE autosar_swc_aeb_CM_boolean 0 0 0 1 ECU_ADDRESS 0xfe4a4749 /* @ECU_Address@SwcOut_AEB_DebugInfo.obj_data_info[3].motion_type.moving_oncoming@ */ /end MEASUREMENT
/begin MEASUREMENT SwcOut_AEB_DebugInfo.obj_data_info[3].motion_type.object_is_motor_vehicle "" UBYTE autosar_swc_aeb_CM_boolean 0 0 0 1 ECU_ADDRESS 0xfe4a474d /* @ECU_Address@SwcOut_AEB_DebugInfo.obj_data_info[3].motion_type.object_is_motor_vehicle@ */ /end MEASUREMENT
/begin MEASUREMENT SwcOut_AEB_DebugInfo.obj_data_info[3].motion_type.object_is_vehicle "" UBYTE autosar_swc_aeb_CM_boolean 0 0 0 1 ECU_ADDRESS 0xfe4a474c /* @ECU_Address@SwcOut_AEB_DebugInfo.obj_data_info[3].motion_type.object_is_vehicle@ */ /end MEASUREMENT
/begin MEASUREMENT SwcOut_AEB_DebugInfo.obj_data_info[3].motion_type.parallell_vehicle_long_predict "" UBYTE autosar_swc_aeb_CM_boolean 0 0 0 1 ECU_ADDRESS 0xfe4a474a /* @ECU_Address@SwcOut_AEB_DebugInfo.obj_data_info[3].motion_type.parallell_vehicle_long_predict@ */ /end MEASUREMENT
/begin MEASUREMENT SwcOut_AEB_DebugInfo.obj_data_info[3].motion_type.parallell_vehicle_short_predict "" UBYTE autosar_swc_aeb_CM_boolean 0 0 0 1 ECU_ADDRESS 0xfe4a474b /* @ECU_Address@SwcOut_AEB_DebugInfo.obj_data_info[3].motion_type.parallell_vehicle_short_predict@ */ /end MEASUREMENT
/begin MEASUREMENT SwcOut_AEB_DebugInfo.obj_data_info[3].motion_type.side_is_closest "" UBYTE autosar_swc_aeb_CM_boolean 0 0 0 1 ECU_ADDRESS 0xfe4a474f /* @ECU_Address@SwcOut_AEB_DebugInfo.obj_data_info[3].motion_type.side_is_closest@ */ /end MEASUREMENT
/begin MEASUREMENT SwcOut_AEB_DebugInfo.obj_data_info[3].motion_type.stationary "" UBYTE autosar_swc_aeb_CM_boolean 0 0 0 1 ECU_ADDRESS 0xfe4a4748 /* @ECU_Address@SwcOut_AEB_DebugInfo.obj_data_info[3].motion_type.stationary@ */ /end MEASUREMENT
/begin MEASUREMENT SwcOut_AEB_DebugInfo.obj_data_info[3].offsets.offs_lat_inpath_close_edge "" FLOAT32_IEEE autosar_swc_aeb_CM_single 0 0 -3.4E+38 3.4E+38 ECU_ADDRESS 0xfe4a4798 /* @ECU_Address@SwcOut_AEB_DebugInfo.obj_data_info[3].offsets.offs_lat_inpath_close_edge@ */ /end MEASUREMENT
/begin MEASUREMENT SwcOut_AEB_DebugInfo.obj_data_info[3].offsets.offs_lat_inpath_far_edge "" FLOAT32_IEEE autosar_swc_aeb_CM_single 0 0 -3.4E+38 3.4E+38 ECU_ADDRESS 0xfe4a479c /* @ECU_Address@SwcOut_AEB_DebugInfo.obj_data_info[3].offsets.offs_lat_inpath_far_edge@ */ /end MEASUREMENT
/begin MEASUREMENT SwcOut_AEB_DebugInfo.obj_data_info[3].offsets.offs_lat_inpath_primary_target "" FLOAT32_IEEE autosar_swc_aeb_CM_single 0 0 -3.4E+38 3.4E+38 ECU_ADDRESS 0xfe4a4794 /* @ECU_Address@SwcOut_AEB_DebugInfo.obj_data_info[3].offsets.offs_lat_inpath_primary_target@ */ /end MEASUREMENT
/begin MEASUREMENT SwcOut_AEB_DebugInfo.obj_data_info[3].offsets.offs_lat_intersection "" FLOAT32_IEEE autosar_swc_aeb_CM_single 0 0 -3.4E+38 3.4E+38 ECU_ADDRESS 0xfe4a47a0 /* @ECU_Address@SwcOut_AEB_DebugInfo.obj_data_info[3].offsets.offs_lat_intersection@ */ /end MEASUREMENT
/begin MEASUREMENT SwcOut_AEB_DebugInfo.obj_data_info[3].offsets.offs_lat_long_predict "" FLOAT32_IEEE autosar_swc_aeb_CM_single 0 0 -3.4E+38 3.4E+38 ECU_ADDRESS 0xfe4a4784 /* @ECU_Address@SwcOut_AEB_DebugInfo.obj_data_info[3].offsets.offs_lat_long_predict@ */ /end MEASUREMENT
/begin MEASUREMENT SwcOut_AEB_DebugInfo.obj_data_info[3].offsets.offs_lat_manoeuvre "" FLOAT32_IEEE autosar_swc_aeb_CM_single 0 0 -3.4E+38 3.4E+38 ECU_ADDRESS 0xfe4a4790 /* @ECU_Address@SwcOut_AEB_DebugInfo.obj_data_info[3].offsets.offs_lat_manoeuvre@ */ /end MEASUREMENT
/begin MEASUREMENT SwcOut_AEB_DebugInfo.obj_data_info[3].offsets.offs_lat_multiple_target "" FLOAT32_IEEE autosar_swc_aeb_CM_single 0 0 -3.4E+38 3.4E+38 ECU_ADDRESS 0xfe4a47a4 /* @ECU_Address@SwcOut_AEB_DebugInfo.obj_data_info[3].offsets.offs_lat_multiple_target@ */ /end MEASUREMENT
/begin MEASUREMENT SwcOut_AEB_DebugInfo.obj_data_info[3].offsets.offs_lat_short_predict "" FLOAT32_IEEE autosar_swc_aeb_CM_single 0 0 -3.4E+38 3.4E+38 ECU_ADDRESS 0xfe4a478c /* @ECU_Address@SwcOut_AEB_DebugInfo.obj_data_info[3].offsets.offs_lat_short_predict@ */ /end MEASUREMENT
/begin MEASUREMENT SwcOut_AEB_DebugInfo.obj_data_info[3].offsets.offs_lgt_long_predict "" FLOAT32_IEEE autosar_swc_aeb_CM_single 0 0 -3.4E+38 3.4E+38 ECU_ADDRESS 0xfe4a4780 /* @ECU_Address@SwcOut_AEB_DebugInfo.obj_data_info[3].offsets.offs_lgt_long_predict@ */ /end MEASUREMENT
/begin MEASUREMENT SwcOut_AEB_DebugInfo.obj_data_info[3].offsets.offs_lgt_short_predict "" FLOAT32_IEEE autosar_swc_aeb_CM_single 0 0 -3.4E+38 3.4E+38 ECU_ADDRESS 0xfe4a4788 /* @ECU_Address@SwcOut_AEB_DebugInfo.obj_data_info[3].offsets.offs_lgt_short_predict@ */ /end MEASUREMENT
/begin MEASUREMENT SwcOut_AEB_DebugInfo.obj_data_info[3].porperty.a "" FLOAT32_IEEE autosar_swc_aeb_CM_single 0 0 -3.4E+38 3.4E+38 ECU_ADDRESS 0xfe4a4740 /* @ECU_Address@SwcOut_AEB_DebugInfo.obj_data_info[3].porperty.a@ */ /end MEASUREMENT
/begin MEASUREMENT SwcOut_AEB_DebugInfo.obj_data_info[3].porperty.a_lat "" FLOAT32_IEEE autosar_swc_aeb_CM_single 0 0 -3.4E+38 3.4E+38 ECU_ADDRESS 0xfe4a473c /* @ECU_Address@SwcOut_AEB_DebugInfo.obj_data_info[3].porperty.a_lat@ */ /end MEASUREMENT
/begin MEASUREMENT SwcOut_AEB_DebugInfo.obj_data_info[3].porperty.a_lgt "" FLOAT32_IEEE autosar_swc_aeb_CM_single 0 0 -3.4E+38 3.4E+38 ECU_ADDRESS 0xfe4a4738 /* @ECU_Address@SwcOut_AEB_DebugInfo.obj_data_info[3].porperty.a_lgt@ */ /end MEASUREMENT
/begin MEASUREMENT SwcOut_AEB_DebugInfo.obj_data_info[3].porperty.curvature "" FLOAT32_IEEE autosar_swc_aeb_CM_single 0 0 -3.4E+38 3.4E+38 ECU_ADDRESS 0xfe4a4744 /* @ECU_Address@SwcOut_AEB_DebugInfo.obj_data_info[3].porperty.curvature@ */ /end MEASUREMENT
/begin MEASUREMENT SwcOut_AEB_DebugInfo.obj_data_info[3].porperty.p_lat "" FLOAT32_IEEE autosar_swc_aeb_CM_single 0 0 -3.4E+38 3.4E+38 ECU_ADDRESS 0xfe4a4728 /* @ECU_Address@SwcOut_AEB_DebugInfo.obj_data_info[3].porperty.p_lat@ */ /end MEASUREMENT
/begin MEASUREMENT SwcOut_AEB_DebugInfo.obj_data_info[3].porperty.p_lgt "" FLOAT32_IEEE autosar_swc_aeb_CM_single 0 0 -3.4E+38 3.4E+38 ECU_ADDRESS 0xfe4a4724 /* @ECU_Address@SwcOut_AEB_DebugInfo.obj_data_info[3].porperty.p_lgt@ */ /end MEASUREMENT
/begin MEASUREMENT SwcOut_AEB_DebugInfo.obj_data_info[3].porperty.spd "" FLOAT32_IEEE autosar_swc_aeb_CM_single 0 0 -3.4E+38 3.4E+38 ECU_ADDRESS 0xfe4a472c /* @ECU_Address@SwcOut_AEB_DebugInfo.obj_data_info[3].porperty.spd@ */ /end MEASUREMENT
/begin MEASUREMENT SwcOut_AEB_DebugInfo.obj_data_info[3].porperty.v_lat "" FLOAT32_IEEE autosar_swc_aeb_CM_single 0 0 -3.4E+38 3.4E+38 ECU_ADDRESS 0xfe4a4734 /* @ECU_Address@SwcOut_AEB_DebugInfo.obj_data_info[3].porperty.v_lat@ */ /end MEASUREMENT
/begin MEASUREMENT SwcOut_AEB_DebugInfo.obj_data_info[3].porperty.v_lgt "" FLOAT32_IEEE autosar_swc_aeb_CM_single 0 0 -3.4E+38 3.4E+38 ECU_ADDRESS 0xfe4a4730 /* @ECU_Address@SwcOut_AEB_DebugInfo.obj_data_info[3].porperty.v_lgt@ */ /end MEASUREMENT
/begin MEASUREMENT SwcOut_AEB_DebugInfo.obj_data_info[3].short_pred_time.inpath "" UBYTE autosar_swc_aeb_CM_boolean 0 0 0 1 ECU_ADDRESS 0xfe4a476d /* @ECU_Address@SwcOut_AEB_DebugInfo.obj_data_info[3].short_pred_time.inpath@ */ /end MEASUREMENT
/begin MEASUREMENT SwcOut_AEB_DebugInfo.obj_data_info[3].short_pred_time.inpath_current_position "" UBYTE autosar_swc_aeb_CM_boolean 0 0 0 1 ECU_ADDRESS 0xfe4a476f /* @ECU_Address@SwcOut_AEB_DebugInfo.obj_data_info[3].short_pred_time.inpath_current_position@ */ /end MEASUREMENT
/begin MEASUREMENT SwcOut_AEB_DebugInfo.obj_data_info[3].short_pred_time.inpath_predict_position "" UBYTE autosar_swc_aeb_CM_boolean 0 0 0 1 ECU_ADDRESS 0xfe4a476e /* @ECU_Address@SwcOut_AEB_DebugInfo.obj_data_info[3].short_pred_time.inpath_predict_position@ */ /end MEASUREMENT
/begin MEASUREMENT SwcOut_AEB_DebugInfo.obj_data_info[3].short_pred_time.prediction_valid "" UBYTE autosar_swc_aeb_CM_boolean 0 0 0 1 ECU_ADDRESS 0xfe4a4772 /* @ECU_Address@SwcOut_AEB_DebugInfo.obj_data_info[3].short_pred_time.prediction_valid@ */ /end MEASUREMENT
/begin MEASUREMENT SwcOut_AEB_DebugInfo.obj_data_info[3].short_pred_time.ttm "" FLOAT32_IEEE autosar_swc_aeb_CM_single 0 0 -3.4E+38 3.4E+38 ECU_ADDRESS 0xfe4a4768 /* @ECU_Address@SwcOut_AEB_DebugInfo.obj_data_info[3].short_pred_time.ttm@ */ /end MEASUREMENT
/begin MEASUREMENT SwcOut_AEB_DebugInfo.obj_data_info[3].short_pred_time.ttm_selected "" UBYTE autosar_swc_aeb_CM_boolean 0 0 0 1 ECU_ADDRESS 0xfe4a476c /* @ECU_Address@SwcOut_AEB_DebugInfo.obj_data_info[3].short_pred_time.ttm_selected@ */ /end MEASUREMENT
/begin MEASUREMENT SwcOut_AEB_DebugInfo.obj_data_info[3].short_pred_time.ttr "" FLOAT32_IEEE autosar_swc_aeb_CM_single 0 0 -3.4E+38 3.4E+38 ECU_ADDRESS 0xfe4a4764 /* @ECU_Address@SwcOut_AEB_DebugInfo.obj_data_info[3].short_pred_time.ttr@ */ /end MEASUREMENT
/begin MEASUREMENT SwcOut_AEB_DebugInfo.obj_data_info[3].short_pred_time.use_inpath_calculation "" UBYTE autosar_swc_aeb_CM_boolean 0 0 0 1 ECU_ADDRESS 0xfe4a4770 /* @ECU_Address@SwcOut_AEB_DebugInfo.obj_data_info[3].short_pred_time.use_inpath_calculation@ */ /end MEASUREMENT
/begin MEASUREMENT SwcOut_AEB_DebugInfo.obj_data_info[3].short_pred_time.use_out_offpath_calculation "" UBYTE autosar_swc_aeb_CM_boolean 0 0 0 1 ECU_ADDRESS 0xfe4a4771 /* @ECU_Address@SwcOut_AEB_DebugInfo.obj_data_info[3].short_pred_time.use_out_offpath_calculation@ */ /end MEASUREMENT
/begin MEASUREMENT SwcOut_AEB_DebugInfo.obj_data_info[4].bounding_box.cos_rotation "" FLOAT32_IEEE autosar_swc_aeb_CM_single 0 0 -3.4E+38 3.4E+38 ECU_ADDRESS 0xfe4a47e4 /* @ECU_Address@SwcOut_AEB_DebugInfo.obj_data_info[4].bounding_box.cos_rotation@ */ /end MEASUREMENT
/begin MEASUREMENT SwcOut_AEB_DebugInfo.obj_data_info[4].bounding_box.length_side_lat "" FLOAT32_IEEE autosar_swc_aeb_CM_single 0 0 -3.4E+38 3.4E+38 ECU_ADDRESS 0xfe4a47d8 /* @ECU_Address@SwcOut_AEB_DebugInfo.obj_data_info[4].bounding_box.length_side_lat@ */ /end MEASUREMENT
/begin MEASUREMENT SwcOut_AEB_DebugInfo.obj_data_info[4].bounding_box.length_side_lgt "" FLOAT32_IEEE autosar_swc_aeb_CM_single 0 0 -3.4E+38 3.4E+38 ECU_ADDRESS 0xfe4a47dc /* @ECU_Address@SwcOut_AEB_DebugInfo.obj_data_info[4].bounding_box.length_side_lgt@ */ /end MEASUREMENT
/begin MEASUREMENT SwcOut_AEB_DebugInfo.obj_data_info[4].bounding_box.sin_rotation "" FLOAT32_IEEE autosar_swc_aeb_CM_single 0 0 -3.4E+38 3.4E+38 ECU_ADDRESS 0xfe4a47e0 /* @ECU_Address@SwcOut_AEB_DebugInfo.obj_data_info[4].bounding_box.sin_rotation@ */ /end MEASUREMENT
/begin MEASUREMENT SwcOut_AEB_DebugInfo.obj_data_info[4].long_pred_time.inpath "" UBYTE autosar_swc_aeb_CM_boolean 0 0 0 1 ECU_ADDRESS 0xfe4a47fc /* @ECU_Address@SwcOut_AEB_DebugInfo.obj_data_info[4].long_pred_time.inpath@ */ /end MEASUREMENT
/begin MEASUREMENT SwcOut_AEB_DebugInfo.obj_data_info[4].long_pred_time.inpath_current_position "" UBYTE autosar_swc_aeb_CM_boolean 0 0 0 1 ECU_ADDRESS 0xfe4a47fe /* @ECU_Address@SwcOut_AEB_DebugInfo.obj_data_info[4].long_pred_time.inpath_current_position@ */ /end MEASUREMENT
/begin MEASUREMENT SwcOut_AEB_DebugInfo.obj_data_info[4].long_pred_time.inpath_predict_position "" UBYTE autosar_swc_aeb_CM_boolean 0 0 0 1 ECU_ADDRESS 0xfe4a47fd /* @ECU_Address@SwcOut_AEB_DebugInfo.obj_data_info[4].long_pred_time.inpath_predict_position@ */ /end MEASUREMENT
/begin MEASUREMENT SwcOut_AEB_DebugInfo.obj_data_info[4].long_pred_time.prediction_valid "" UBYTE autosar_swc_aeb_CM_boolean 0 0 0 1 ECU_ADDRESS 0xfe4a4801 /* @ECU_Address@SwcOut_AEB_DebugInfo.obj_data_info[4].long_pred_time.prediction_valid@ */ /end MEASUREMENT
/begin MEASUREMENT SwcOut_AEB_DebugInfo.obj_data_info[4].long_pred_time.ttr "" FLOAT32_IEEE autosar_swc_aeb_CM_single 0 0 -3.4E+38 3.4E+38 ECU_ADDRESS 0xfe4a47f8 /* @ECU_Address@SwcOut_AEB_DebugInfo.obj_data_info[4].long_pred_time.ttr@ */ /end MEASUREMENT
/begin MEASUREMENT SwcOut_AEB_DebugInfo.obj_data_info[4].long_pred_time.use_inpath_calculation "" UBYTE autosar_swc_aeb_CM_boolean 0 0 0 1 ECU_ADDRESS 0xfe4a47ff /* @ECU_Address@SwcOut_AEB_DebugInfo.obj_data_info[4].long_pred_time.use_inpath_calculation@ */ /end MEASUREMENT
/begin MEASUREMENT SwcOut_AEB_DebugInfo.obj_data_info[4].long_pred_time.use_out_offpath_calculation "" UBYTE autosar_swc_aeb_CM_boolean 0 0 0 1 ECU_ADDRESS 0xfe4a4800 /* @ECU_Address@SwcOut_AEB_DebugInfo.obj_data_info[4].long_pred_time.use_out_offpath_calculation@ */ /end MEASUREMENT
/begin MEASUREMENT SwcOut_AEB_DebugInfo.obj_data_info[4].motion_type.abs_heading "" FLOAT32_IEEE autosar_swc_aeb_CM_single 0 0 -3.4E+38 3.4E+38 ECU_ADDRESS 0xfe4a47d4 /* @ECU_Address@SwcOut_AEB_DebugInfo.obj_data_info[4].motion_type.abs_heading@ */ /end MEASUREMENT
/begin MEASUREMENT SwcOut_AEB_DebugInfo.obj_data_info[4].motion_type.curved_motion "" UBYTE autosar_swc_aeb_CM_boolean 0 0 0 1 ECU_ADDRESS 0xfe4a47d2 /* @ECU_Address@SwcOut_AEB_DebugInfo.obj_data_info[4].motion_type.curved_motion@ */ /end MEASUREMENT
/begin MEASUREMENT SwcOut_AEB_DebugInfo.obj_data_info[4].motion_type.moving_oncoming "" UBYTE autosar_swc_aeb_CM_boolean 0 0 0 1 ECU_ADDRESS 0xfe4a47cd /* @ECU_Address@SwcOut_AEB_DebugInfo.obj_data_info[4].motion_type.moving_oncoming@ */ /end MEASUREMENT
/begin MEASUREMENT SwcOut_AEB_DebugInfo.obj_data_info[4].motion_type.object_is_motor_vehicle "" UBYTE autosar_swc_aeb_CM_boolean 0 0 0 1 ECU_ADDRESS 0xfe4a47d1 /* @ECU_Address@SwcOut_AEB_DebugInfo.obj_data_info[4].motion_type.object_is_motor_vehicle@ */ /end MEASUREMENT
/begin MEASUREMENT SwcOut_AEB_DebugInfo.obj_data_info[4].motion_type.object_is_vehicle "" UBYTE autosar_swc_aeb_CM_boolean 0 0 0 1 ECU_ADDRESS 0xfe4a47d0 /* @ECU_Address@SwcOut_AEB_DebugInfo.obj_data_info[4].motion_type.object_is_vehicle@ */ /end MEASUREMENT
/begin MEASUREMENT SwcOut_AEB_DebugInfo.obj_data_info[4].motion_type.parallell_vehicle_long_predict "" UBYTE autosar_swc_aeb_CM_boolean 0 0 0 1 ECU_ADDRESS 0xfe4a47ce /* @ECU_Address@SwcOut_AEB_DebugInfo.obj_data_info[4].motion_type.parallell_vehicle_long_predict@ */ /end MEASUREMENT
/begin MEASUREMENT SwcOut_AEB_DebugInfo.obj_data_info[4].motion_type.parallell_vehicle_short_predict "" UBYTE autosar_swc_aeb_CM_boolean 0 0 0 1 ECU_ADDRESS 0xfe4a47cf /* @ECU_Address@SwcOut_AEB_DebugInfo.obj_data_info[4].motion_type.parallell_vehicle_short_predict@ */ /end MEASUREMENT
/begin MEASUREMENT SwcOut_AEB_DebugInfo.obj_data_info[4].motion_type.side_is_closest "" UBYTE autosar_swc_aeb_CM_boolean 0 0 0 1 ECU_ADDRESS 0xfe4a47d3 /* @ECU_Address@SwcOut_AEB_DebugInfo.obj_data_info[4].motion_type.side_is_closest@ */ /end MEASUREMENT
/begin MEASUREMENT SwcOut_AEB_DebugInfo.obj_data_info[4].motion_type.stationary "" UBYTE autosar_swc_aeb_CM_boolean 0 0 0 1 ECU_ADDRESS 0xfe4a47cc /* @ECU_Address@SwcOut_AEB_DebugInfo.obj_data_info[4].motion_type.stationary@ */ /end MEASUREMENT
/begin MEASUREMENT SwcOut_AEB_DebugInfo.obj_data_info[4].offsets.offs_lat_inpath_close_edge "" FLOAT32_IEEE autosar_swc_aeb_CM_single 0 0 -3.4E+38 3.4E+38 ECU_ADDRESS 0xfe4a481c /* @ECU_Address@SwcOut_AEB_DebugInfo.obj_data_info[4].offsets.offs_lat_inpath_close_edge@ */ /end MEASUREMENT
/begin MEASUREMENT SwcOut_AEB_DebugInfo.obj_data_info[4].offsets.offs_lat_inpath_far_edge "" FLOAT32_IEEE autosar_swc_aeb_CM_single 0 0 -3.4E+38 3.4E+38 ECU_ADDRESS 0xfe4a4820 /* @ECU_Address@SwcOut_AEB_DebugInfo.obj_data_info[4].offsets.offs_lat_inpath_far_edge@ */ /end MEASUREMENT
/begin MEASUREMENT SwcOut_AEB_DebugInfo.obj_data_info[4].offsets.offs_lat_inpath_primary_target "" FLOAT32_IEEE autosar_swc_aeb_CM_single 0 0 -3.4E+38 3.4E+38 ECU_ADDRESS 0xfe4a4818 /* @ECU_Address@SwcOut_AEB_DebugInfo.obj_data_info[4].offsets.offs_lat_inpath_primary_target@ */ /end MEASUREMENT
/begin MEASUREMENT SwcOut_AEB_DebugInfo.obj_data_info[4].offsets.offs_lat_intersection "" FLOAT32_IEEE autosar_swc_aeb_CM_single 0 0 -3.4E+38 3.4E+38 ECU_ADDRESS 0xfe4a4824 /* @ECU_Address@SwcOut_AEB_DebugInfo.obj_data_info[4].offsets.offs_lat_intersection@ */ /end MEASUREMENT
/begin MEASUREMENT SwcOut_AEB_DebugInfo.obj_data_info[4].offsets.offs_lat_long_predict "" FLOAT32_IEEE autosar_swc_aeb_CM_single 0 0 -3.4E+38 3.4E+38 ECU_ADDRESS 0xfe4a4808 /* @ECU_Address@SwcOut_AEB_DebugInfo.obj_data_info[4].offsets.offs_lat_long_predict@ */ /end MEASUREMENT
/begin MEASUREMENT SwcOut_AEB_DebugInfo.obj_data_info[4].offsets.offs_lat_manoeuvre "" FLOAT32_IEEE autosar_swc_aeb_CM_single 0 0 -3.4E+38 3.4E+38 ECU_ADDRESS 0xfe4a4814 /* @ECU_Address@SwcOut_AEB_DebugInfo.obj_data_info[4].offsets.offs_lat_manoeuvre@ */ /end MEASUREMENT
/begin MEASUREMENT SwcOut_AEB_DebugInfo.obj_data_info[4].offsets.offs_lat_multiple_target "" FLOAT32_IEEE autosar_swc_aeb_CM_single 0 0 -3.4E+38 3.4E+38 ECU_ADDRESS 0xfe4a4828 /* @ECU_Address@SwcOut_AEB_DebugInfo.obj_data_info[4].offsets.offs_lat_multiple_target@ */ /end MEASUREMENT
/begin MEASUREMENT SwcOut_AEB_DebugInfo.obj_data_info[4].offsets.offs_lat_short_predict "" FLOAT32_IEEE autosar_swc_aeb_CM_single 0 0 -3.4E+38 3.4E+38 ECU_ADDRESS 0xfe4a4810 /* @ECU_Address@SwcOut_AEB_DebugInfo.obj_data_info[4].offsets.offs_lat_short_predict@ */ /end MEASUREMENT
/begin MEASUREMENT SwcOut_AEB_DebugInfo.obj_data_info[4].offsets.offs_lgt_long_predict "" FLOAT32_IEEE autosar_swc_aeb_CM_single 0 0 -3.4E+38 3.4E+38 ECU_ADDRESS 0xfe4a4804 /* @ECU_Address@SwcOut_AEB_DebugInfo.obj_data_info[4].offsets.offs_lgt_long_predict@ */ /end MEASUREMENT
/begin MEASUREMENT SwcOut_AEB_DebugInfo.obj_data_info[4].offsets.offs_lgt_short_predict "" FLOAT32_IEEE autosar_swc_aeb_CM_single 0 0 -3.4E+38 3.4E+38 ECU_ADDRESS 0xfe4a480c /* @ECU_Address@SwcOut_AEB_DebugInfo.obj_data_info[4].offsets.offs_lgt_short_predict@ */ /end MEASUREMENT
/begin MEASUREMENT SwcOut_AEB_DebugInfo.obj_data_info[4].porperty.a "" FLOAT32_IEEE autosar_swc_aeb_CM_single 0 0 -3.4E+38 3.4E+38 ECU_ADDRESS 0xfe4a47c4 /* @ECU_Address@SwcOut_AEB_DebugInfo.obj_data_info[4].porperty.a@ */ /end MEASUREMENT
/begin MEASUREMENT SwcOut_AEB_DebugInfo.obj_data_info[4].porperty.a_lat "" FLOAT32_IEEE autosar_swc_aeb_CM_single 0 0 -3.4E+38 3.4E+38 ECU_ADDRESS 0xfe4a47c0 /* @ECU_Address@SwcOut_AEB_DebugInfo.obj_data_info[4].porperty.a_lat@ */ /end MEASUREMENT
/begin MEASUREMENT SwcOut_AEB_DebugInfo.obj_data_info[4].porperty.a_lgt "" FLOAT32_IEEE autosar_swc_aeb_CM_single 0 0 -3.4E+38 3.4E+38 ECU_ADDRESS 0xfe4a47bc /* @ECU_Address@SwcOut_AEB_DebugInfo.obj_data_info[4].porperty.a_lgt@ */ /end MEASUREMENT
/begin MEASUREMENT SwcOut_AEB_DebugInfo.obj_data_info[4].porperty.curvature "" FLOAT32_IEEE autosar_swc_aeb_CM_single 0 0 -3.4E+38 3.4E+38 ECU_ADDRESS 0xfe4a47c8 /* @ECU_Address@SwcOut_AEB_DebugInfo.obj_data_info[4].porperty.curvature@ */ /end MEASUREMENT
/begin MEASUREMENT SwcOut_AEB_DebugInfo.obj_data_info[4].porperty.p_lat "" FLOAT32_IEEE autosar_swc_aeb_CM_single 0 0 -3.4E+38 3.4E+38 ECU_ADDRESS 0xfe4a47ac /* @ECU_Address@SwcOut_AEB_DebugInfo.obj_data_info[4].porperty.p_lat@ */ /end MEASUREMENT
/begin MEASUREMENT SwcOut_AEB_DebugInfo.obj_data_info[4].porperty.p_lgt "" FLOAT32_IEEE autosar_swc_aeb_CM_single 0 0 -3.4E+38 3.4E+38 ECU_ADDRESS 0xfe4a47a8 /* @ECU_Address@SwcOut_AEB_DebugInfo.obj_data_info[4].porperty.p_lgt@ */ /end MEASUREMENT
/begin MEASUREMENT SwcOut_AEB_DebugInfo.obj_data_info[4].porperty.spd "" FLOAT32_IEEE autosar_swc_aeb_CM_single 0 0 -3.4E+38 3.4E+38 ECU_ADDRESS 0xfe4a47b0 /* @ECU_Address@SwcOut_AEB_DebugInfo.obj_data_info[4].porperty.spd@ */ /end MEASUREMENT
/begin MEASUREMENT SwcOut_AEB_DebugInfo.obj_data_info[4].porperty.v_lat "" FLOAT32_IEEE autosar_swc_aeb_CM_single 0 0 -3.4E+38 3.4E+38 ECU_ADDRESS 0xfe4a47b8 /* @ECU_Address@SwcOut_AEB_DebugInfo.obj_data_info[4].porperty.v_lat@ */ /end MEASUREMENT
/begin MEASUREMENT SwcOut_AEB_DebugInfo.obj_data_info[4].porperty.v_lgt "" FLOAT32_IEEE autosar_swc_aeb_CM_single 0 0 -3.4E+38 3.4E+38 ECU_ADDRESS 0xfe4a47b4 /* @ECU_Address@SwcOut_AEB_DebugInfo.obj_data_info[4].porperty.v_lgt@ */ /end MEASUREMENT
/begin MEASUREMENT SwcOut_AEB_DebugInfo.obj_data_info[4].short_pred_time.inpath "" UBYTE autosar_swc_aeb_CM_boolean 0 0 0 1 ECU_ADDRESS 0xfe4a47f1 /* @ECU_Address@SwcOut_AEB_DebugInfo.obj_data_info[4].short_pred_time.inpath@ */ /end MEASUREMENT
/begin MEASUREMENT SwcOut_AEB_DebugInfo.obj_data_info[4].short_pred_time.inpath_current_position "" UBYTE autosar_swc_aeb_CM_boolean 0 0 0 1 ECU_ADDRESS 0xfe4a47f3 /* @ECU_Address@SwcOut_AEB_DebugInfo.obj_data_info[4].short_pred_time.inpath_current_position@ */ /end MEASUREMENT
/begin MEASUREMENT SwcOut_AEB_DebugInfo.obj_data_info[4].short_pred_time.inpath_predict_position "" UBYTE autosar_swc_aeb_CM_boolean 0 0 0 1 ECU_ADDRESS 0xfe4a47f2 /* @ECU_Address@SwcOut_AEB_DebugInfo.obj_data_info[4].short_pred_time.inpath_predict_position@ */ /end MEASUREMENT
/begin MEASUREMENT SwcOut_AEB_DebugInfo.obj_data_info[4].short_pred_time.prediction_valid "" UBYTE autosar_swc_aeb_CM_boolean 0 0 0 1 ECU_ADDRESS 0xfe4a47f6 /* @ECU_Address@SwcOut_AEB_DebugInfo.obj_data_info[4].short_pred_time.prediction_valid@ */ /end MEASUREMENT
/begin MEASUREMENT SwcOut_AEB_DebugInfo.obj_data_info[4].short_pred_time.ttm "" FLOAT32_IEEE autosar_swc_aeb_CM_single 0 0 -3.4E+38 3.4E+38 ECU_ADDRESS 0xfe4a47ec /* @ECU_Address@SwcOut_AEB_DebugInfo.obj_data_info[4].short_pred_time.ttm@ */ /end MEASUREMENT
/begin MEASUREMENT SwcOut_AEB_DebugInfo.obj_data_info[4].short_pred_time.ttm_selected "" UBYTE autosar_swc_aeb_CM_boolean 0 0 0 1 ECU_ADDRESS 0xfe4a47f0 /* @ECU_Address@SwcOut_AEB_DebugInfo.obj_data_info[4].short_pred_time.ttm_selected@ */ /end MEASUREMENT
/begin MEASUREMENT SwcOut_AEB_DebugInfo.obj_data_info[4].short_pred_time.ttr "" FLOAT32_IEEE autosar_swc_aeb_CM_single 0 0 -3.4E+38 3.4E+38 ECU_ADDRESS 0xfe4a47e8 /* @ECU_Address@SwcOut_AEB_DebugInfo.obj_data_info[4].short_pred_time.ttr@ */ /end MEASUREMENT
/begin MEASUREMENT SwcOut_AEB_DebugInfo.obj_data_info[4].short_pred_time.use_inpath_calculation "" UBYTE autosar_swc_aeb_CM_boolean 0 0 0 1 ECU_ADDRESS 0xfe4a47f4 /* @ECU_Address@SwcOut_AEB_DebugInfo.obj_data_info[4].short_pred_time.use_inpath_calculation@ */ /end MEASUREMENT
/begin MEASUREMENT SwcOut_AEB_DebugInfo.obj_data_info[4].short_pred_time.use_out_offpath_calculation "" UBYTE autosar_swc_aeb_CM_boolean 0 0 0 1 ECU_ADDRESS 0xfe4a47f5 /* @ECU_Address@SwcOut_AEB_DebugInfo.obj_data_info[4].short_pred_time.use_out_offpath_calculation@ */ /end MEASUREMENT
/begin MEASUREMENT SwcOut_AEB_DebugInfo.obj_data_info[5].bounding_box.cos_rotation "" FLOAT32_IEEE autosar_swc_aeb_CM_single 0 0 -3.4E+38 3.4E+38 ECU_ADDRESS 0xfe4a4868 /* @ECU_Address@SwcOut_AEB_DebugInfo.obj_data_info[5].bounding_box.cos_rotation@ */ /end MEASUREMENT
/begin MEASUREMENT SwcOut_AEB_DebugInfo.obj_data_info[5].bounding_box.length_side_lat "" FLOAT32_IEEE autosar_swc_aeb_CM_single 0 0 -3.4E+38 3.4E+38 ECU_ADDRESS 0xfe4a485c /* @ECU_Address@SwcOut_AEB_DebugInfo.obj_data_info[5].bounding_box.length_side_lat@ */ /end MEASUREMENT
/begin MEASUREMENT SwcOut_AEB_DebugInfo.obj_data_info[5].bounding_box.length_side_lgt "" FLOAT32_IEEE autosar_swc_aeb_CM_single 0 0 -3.4E+38 3.4E+38 ECU_ADDRESS 0xfe4a4860 /* @ECU_Address@SwcOut_AEB_DebugInfo.obj_data_info[5].bounding_box.length_side_lgt@ */ /end MEASUREMENT
/begin MEASUREMENT SwcOut_AEB_DebugInfo.obj_data_info[5].bounding_box.sin_rotation "" FLOAT32_IEEE autosar_swc_aeb_CM_single 0 0 -3.4E+38 3.4E+38 ECU_ADDRESS 0xfe4a4864 /* @ECU_Address@SwcOut_AEB_DebugInfo.obj_data_info[5].bounding_box.sin_rotation@ */ /end MEASUREMENT
/begin MEASUREMENT SwcOut_AEB_DebugInfo.obj_data_info[5].long_pred_time.inpath "" UBYTE autosar_swc_aeb_CM_boolean 0 0 0 1 ECU_ADDRESS 0xfe4a4880 /* @ECU_Address@SwcOut_AEB_DebugInfo.obj_data_info[5].long_pred_time.inpath@ */ /end MEASUREMENT
/begin MEASUREMENT SwcOut_AEB_DebugInfo.obj_data_info[5].long_pred_time.inpath_current_position "" UBYTE autosar_swc_aeb_CM_boolean 0 0 0 1 ECU_ADDRESS 0xfe4a4882 /* @ECU_Address@SwcOut_AEB_DebugInfo.obj_data_info[5].long_pred_time.inpath_current_position@ */ /end MEASUREMENT
/begin MEASUREMENT SwcOut_AEB_DebugInfo.obj_data_info[5].long_pred_time.inpath_predict_position "" UBYTE autosar_swc_aeb_CM_boolean 0 0 0 1 ECU_ADDRESS 0xfe4a4881 /* @ECU_Address@SwcOut_AEB_DebugInfo.obj_data_info[5].long_pred_time.inpath_predict_position@ */ /end MEASUREMENT
/begin MEASUREMENT SwcOut_AEB_DebugInfo.obj_data_info[5].long_pred_time.prediction_valid "" UBYTE autosar_swc_aeb_CM_boolean 0 0 0 1 ECU_ADDRESS 0xfe4a4885 /* @ECU_Address@SwcOut_AEB_DebugInfo.obj_data_info[5].long_pred_time.prediction_valid@ */ /end MEASUREMENT
/begin MEASUREMENT SwcOut_AEB_DebugInfo.obj_data_info[5].long_pred_time.ttr "" FLOAT32_IEEE autosar_swc_aeb_CM_single 0 0 -3.4E+38 3.4E+38 ECU_ADDRESS 0xfe4a487c /* @ECU_Address@SwcOut_AEB_DebugInfo.obj_data_info[5].long_pred_time.ttr@ */ /end MEASUREMENT
/begin MEASUREMENT SwcOut_AEB_DebugInfo.obj_data_info[5].long_pred_time.use_inpath_calculation "" UBYTE autosar_swc_aeb_CM_boolean 0 0 0 1 ECU_ADDRESS 0xfe4a4883 /* @ECU_Address@SwcOut_AEB_DebugInfo.obj_data_info[5].long_pred_time.use_inpath_calculation@ */ /end MEASUREMENT
/begin MEASUREMENT SwcOut_AEB_DebugInfo.obj_data_info[5].long_pred_time.use_out_offpath_calculation "" UBYTE autosar_swc_aeb_CM_boolean 0 0 0 1 ECU_ADDRESS 0xfe4a4884 /* @ECU_Address@SwcOut_AEB_DebugInfo.obj_data_info[5].long_pred_time.use_out_offpath_calculation@ */ /end MEASUREMENT
/begin MEASUREMENT SwcOut_AEB_DebugInfo.obj_data_info[5].motion_type.abs_heading "" FLOAT32_IEEE autosar_swc_aeb_CM_single 0 0 -3.4E+38 3.4E+38 ECU_ADDRESS 0xfe4a4858 /* @ECU_Address@SwcOut_AEB_DebugInfo.obj_data_info[5].motion_type.abs_heading@ */ /end MEASUREMENT
/begin MEASUREMENT SwcOut_AEB_DebugInfo.obj_data_info[5].motion_type.curved_motion "" UBYTE autosar_swc_aeb_CM_boolean 0 0 0 1 ECU_ADDRESS 0xfe4a4856 /* @ECU_Address@SwcOut_AEB_DebugInfo.obj_data_info[5].motion_type.curved_motion@ */ /end MEASUREMENT
/begin MEASUREMENT SwcOut_AEB_DebugInfo.obj_data_info[5].motion_type.moving_oncoming "" UBYTE autosar_swc_aeb_CM_boolean 0 0 0 1 ECU_ADDRESS 0xfe4a4851 /* @ECU_Address@SwcOut_AEB_DebugInfo.obj_data_info[5].motion_type.moving_oncoming@ */ /end MEASUREMENT
/begin MEASUREMENT SwcOut_AEB_DebugInfo.obj_data_info[5].motion_type.object_is_motor_vehicle "" UBYTE autosar_swc_aeb_CM_boolean 0 0 0 1 ECU_ADDRESS 0xfe4a4855 /* @ECU_Address@SwcOut_AEB_DebugInfo.obj_data_info[5].motion_type.object_is_motor_vehicle@ */ /end MEASUREMENT
/begin MEASUREMENT SwcOut_AEB_DebugInfo.obj_data_info[5].motion_type.object_is_vehicle "" UBYTE autosar_swc_aeb_CM_boolean 0 0 0 1 ECU_ADDRESS 0xfe4a4854 /* @ECU_Address@SwcOut_AEB_DebugInfo.obj_data_info[5].motion_type.object_is_vehicle@ */ /end MEASUREMENT
/begin MEASUREMENT SwcOut_AEB_DebugInfo.obj_data_info[5].motion_type.parallell_vehicle_long_predict "" UBYTE autosar_swc_aeb_CM_boolean 0 0 0 1 ECU_ADDRESS 0xfe4a4852 /* @ECU_Address@SwcOut_AEB_DebugInfo.obj_data_info[5].motion_type.parallell_vehicle_long_predict@ */ /end MEASUREMENT
/begin MEASUREMENT SwcOut_AEB_DebugInfo.obj_data_info[5].motion_type.parallell_vehicle_short_predict "" UBYTE autosar_swc_aeb_CM_boolean 0 0 0 1 ECU_ADDRESS 0xfe4a4853 /* @ECU_Address@SwcOut_AEB_DebugInfo.obj_data_info[5].motion_type.parallell_vehicle_short_predict@ */ /end MEASUREMENT
/begin MEASUREMENT SwcOut_AEB_DebugInfo.obj_data_info[5].motion_type.side_is_closest "" UBYTE autosar_swc_aeb_CM_boolean 0 0 0 1 ECU_ADDRESS 0xfe4a4857 /* @ECU_Address@SwcOut_AEB_DebugInfo.obj_data_info[5].motion_type.side_is_closest@ */ /end MEASUREMENT
/begin MEASUREMENT SwcOut_AEB_DebugInfo.obj_data_info[5].motion_type.stationary "" UBYTE autosar_swc_aeb_CM_boolean 0 0 0 1 ECU_ADDRESS 0xfe4a4850 /* @ECU_Address@SwcOut_AEB_DebugInfo.obj_data_info[5].motion_type.stationary@ */ /end MEASUREMENT
/begin MEASUREMENT SwcOut_AEB_DebugInfo.obj_data_info[5].offsets.offs_lat_inpath_close_edge "" FLOAT32_IEEE autosar_swc_aeb_CM_single 0 0 -3.4E+38 3.4E+38 ECU_ADDRESS 0xfe4a48a0 /* @ECU_Address@SwcOut_AEB_DebugInfo.obj_data_info[5].offsets.offs_lat_inpath_close_edge@ */ /end MEASUREMENT
/begin MEASUREMENT SwcOut_AEB_DebugInfo.obj_data_info[5].offsets.offs_lat_inpath_far_edge "" FLOAT32_IEEE autosar_swc_aeb_CM_single 0 0 -3.4E+38 3.4E+38 ECU_ADDRESS 0xfe4a48a4 /* @ECU_Address@SwcOut_AEB_DebugInfo.obj_data_info[5].offsets.offs_lat_inpath_far_edge@ */ /end MEASUREMENT
/begin MEASUREMENT SwcOut_AEB_DebugInfo.obj_data_info[5].offsets.offs_lat_inpath_primary_target "" FLOAT32_IEEE autosar_swc_aeb_CM_single 0 0 -3.4E+38 3.4E+38 ECU_ADDRESS 0xfe4a489c /* @ECU_Address@SwcOut_AEB_DebugInfo.obj_data_info[5].offsets.offs_lat_inpath_primary_target@ */ /end MEASUREMENT
/begin MEASUREMENT SwcOut_AEB_DebugInfo.obj_data_info[5].offsets.offs_lat_intersection "" FLOAT32_IEEE autosar_swc_aeb_CM_single 0 0 -3.4E+38 3.4E+38 ECU_ADDRESS 0xfe4a48a8 /* @ECU_Address@SwcOut_AEB_DebugInfo.obj_data_info[5].offsets.offs_lat_intersection@ */ /end MEASUREMENT
/begin MEASUREMENT SwcOut_AEB_DebugInfo.obj_data_info[5].offsets.offs_lat_long_predict "" FLOAT32_IEEE autosar_swc_aeb_CM_single 0 0 -3.4E+38 3.4E+38 ECU_ADDRESS 0xfe4a488c /* @ECU_Address@SwcOut_AEB_DebugInfo.obj_data_info[5].offsets.offs_lat_long_predict@ */ /end MEASUREMENT
/begin MEASUREMENT SwcOut_AEB_DebugInfo.obj_data_info[5].offsets.offs_lat_manoeuvre "" FLOAT32_IEEE autosar_swc_aeb_CM_single 0 0 -3.4E+38 3.4E+38 ECU_ADDRESS 0xfe4a4898 /* @ECU_Address@SwcOut_AEB_DebugInfo.obj_data_info[5].offsets.offs_lat_manoeuvre@ */ /end MEASUREMENT
/begin MEASUREMENT SwcOut_AEB_DebugInfo.obj_data_info[5].offsets.offs_lat_multiple_target "" FLOAT32_IEEE autosar_swc_aeb_CM_single 0 0 -3.4E+38 3.4E+38 ECU_ADDRESS 0xfe4a48ac /* @ECU_Address@SwcOut_AEB_DebugInfo.obj_data_info[5].offsets.offs_lat_multiple_target@ */ /end MEASUREMENT
/begin MEASUREMENT SwcOut_AEB_DebugInfo.obj_data_info[5].offsets.offs_lat_short_predict "" FLOAT32_IEEE autosar_swc_aeb_CM_single 0 0 -3.4E+38 3.4E+38 ECU_ADDRESS 0xfe4a4894 /* @ECU_Address@SwcOut_AEB_DebugInfo.obj_data_info[5].offsets.offs_lat_short_predict@ */ /end MEASUREMENT
/begin MEASUREMENT SwcOut_AEB_DebugInfo.obj_data_info[5].offsets.offs_lgt_long_predict "" FLOAT32_IEEE autosar_swc_aeb_CM_single 0 0 -3.4E+38 3.4E+38 ECU_ADDRESS 0xfe4a4888 /* @ECU_Address@SwcOut_AEB_DebugInfo.obj_data_info[5].offsets.offs_lgt_long_predict@ */ /end MEASUREMENT
/begin MEASUREMENT SwcOut_AEB_DebugInfo.obj_data_info[5].offsets.offs_lgt_short_predict "" FLOAT32_IEEE autosar_swc_aeb_CM_single 0 0 -3.4E+38 3.4E+38 ECU_ADDRESS 0xfe4a4890 /* @ECU_Address@SwcOut_AEB_DebugInfo.obj_data_info[5].offsets.offs_lgt_short_predict@ */ /end MEASUREMENT
/begin MEASUREMENT SwcOut_AEB_DebugInfo.obj_data_info[5].porperty.a "" FLOAT32_IEEE autosar_swc_aeb_CM_single 0 0 -3.4E+38 3.4E+38 ECU_ADDRESS 0xfe4a4848 /* @ECU_Address@SwcOut_AEB_DebugInfo.obj_data_info[5].porperty.a@ */ /end MEASUREMENT
/begin MEASUREMENT SwcOut_AEB_DebugInfo.obj_data_info[5].porperty.a_lat "" FLOAT32_IEEE autosar_swc_aeb_CM_single 0 0 -3.4E+38 3.4E+38 ECU_ADDRESS 0xfe4a4844 /* @ECU_Address@SwcOut_AEB_DebugInfo.obj_data_info[5].porperty.a_lat@ */ /end MEASUREMENT
/begin MEASUREMENT SwcOut_AEB_DebugInfo.obj_data_info[5].porperty.a_lgt "" FLOAT32_IEEE autosar_swc_aeb_CM_single 0 0 -3.4E+38 3.4E+38 ECU_ADDRESS 0xfe4a4840 /* @ECU_Address@SwcOut_AEB_DebugInfo.obj_data_info[5].porperty.a_lgt@ */ /end MEASUREMENT
/begin MEASUREMENT SwcOut_AEB_DebugInfo.obj_data_info[5].porperty.curvature "" FLOAT32_IEEE autosar_swc_aeb_CM_single 0 0 -3.4E+38 3.4E+38 ECU_ADDRESS 0xfe4a484c /* @ECU_Address@SwcOut_AEB_DebugInfo.obj_data_info[5].porperty.curvature@ */ /end MEASUREMENT
/begin MEASUREMENT SwcOut_AEB_DebugInfo.obj_data_info[5].porperty.p_lat "" FLOAT32_IEEE autosar_swc_aeb_CM_single 0 0 -3.4E+38 3.4E+38 ECU_ADDRESS 0xfe4a4830 /* @ECU_Address@SwcOut_AEB_DebugInfo.obj_data_info[5].porperty.p_lat@ */ /end MEASUREMENT
/begin MEASUREMENT SwcOut_AEB_DebugInfo.obj_data_info[5].porperty.p_lgt "" FLOAT32_IEEE autosar_swc_aeb_CM_single 0 0 -3.4E+38 3.4E+38 ECU_ADDRESS 0xfe4a482c /* @ECU_Address@SwcOut_AEB_DebugInfo.obj_data_info[5].porperty.p_lgt@ */ /end MEASUREMENT
/begin MEASUREMENT SwcOut_AEB_DebugInfo.obj_data_info[5].porperty.spd "" FLOAT32_IEEE autosar_swc_aeb_CM_single 0 0 -3.4E+38 3.4E+38 ECU_ADDRESS 0xfe4a4834 /* @ECU_Address@SwcOut_AEB_DebugInfo.obj_data_info[5].porperty.spd@ */ /end MEASUREMENT
/begin MEASUREMENT SwcOut_AEB_DebugInfo.obj_data_info[5].porperty.v_lat "" FLOAT32_IEEE autosar_swc_aeb_CM_single 0 0 -3.4E+38 3.4E+38 ECU_ADDRESS 0xfe4a483c /* @ECU_Address@SwcOut_AEB_DebugInfo.obj_data_info[5].porperty.v_lat@ */ /end MEASUREMENT
/begin MEASUREMENT SwcOut_AEB_DebugInfo.obj_data_info[5].porperty.v_lgt "" FLOAT32_IEEE autosar_swc_aeb_CM_single 0 0 -3.4E+38 3.4E+38 ECU_ADDRESS 0xfe4a4838 /* @ECU_Address@SwcOut_AEB_DebugInfo.obj_data_info[5].porperty.v_lgt@ */ /end MEASUREMENT
/begin MEASUREMENT SwcOut_AEB_DebugInfo.obj_data_info[5].short_pred_time.inpath "" UBYTE autosar_swc_aeb_CM_boolean 0 0 0 1 ECU_ADDRESS 0xfe4a4875 /* @ECU_Address@SwcOut_AEB_DebugInfo.obj_data_info[5].short_pred_time.inpath@ */ /end MEASUREMENT
/begin MEASUREMENT SwcOut_AEB_DebugInfo.obj_data_info[5].short_pred_time.inpath_current_position "" UBYTE autosar_swc_aeb_CM_boolean 0 0 0 1 ECU_ADDRESS 0xfe4a4877 /* @ECU_Address@SwcOut_AEB_DebugInfo.obj_data_info[5].short_pred_time.inpath_current_position@ */ /end MEASUREMENT
/begin MEASUREMENT SwcOut_AEB_DebugInfo.obj_data_info[5].short_pred_time.inpath_predict_position "" UBYTE autosar_swc_aeb_CM_boolean 0 0 0 1 ECU_ADDRESS 0xfe4a4876 /* @ECU_Address@SwcOut_AEB_DebugInfo.obj_data_info[5].short_pred_time.inpath_predict_position@ */ /end MEASUREMENT
/begin MEASUREMENT SwcOut_AEB_DebugInfo.obj_data_info[5].short_pred_time.prediction_valid "" UBYTE autosar_swc_aeb_CM_boolean 0 0 0 1 ECU_ADDRESS 0xfe4a487a /* @ECU_Address@SwcOut_AEB_DebugInfo.obj_data_info[5].short_pred_time.prediction_valid@ */ /end MEASUREMENT
/begin MEASUREMENT SwcOut_AEB_DebugInfo.obj_data_info[5].short_pred_time.ttm "" FLOAT32_IEEE autosar_swc_aeb_CM_single 0 0 -3.4E+38 3.4E+38 ECU_ADDRESS 0xfe4a4870 /* @ECU_Address@SwcOut_AEB_DebugInfo.obj_data_info[5].short_pred_time.ttm@ */ /end MEASUREMENT
/begin MEASUREMENT SwcOut_AEB_DebugInfo.obj_data_info[5].short_pred_time.ttm_selected "" UBYTE autosar_swc_aeb_CM_boolean 0 0 0 1 ECU_ADDRESS 0xfe4a4874 /* @ECU_Address@SwcOut_AEB_DebugInfo.obj_data_info[5].short_pred_time.ttm_selected@ */ /end MEASUREMENT
/begin MEASUREMENT SwcOut_AEB_DebugInfo.obj_data_info[5].short_pred_time.ttr "" FLOAT32_IEEE autosar_swc_aeb_CM_single 0 0 -3.4E+38 3.4E+38 ECU_ADDRESS 0xfe4a486c /* @ECU_Address@SwcOut_AEB_DebugInfo.obj_data_info[5].short_pred_time.ttr@ */ /end MEASUREMENT
/begin MEASUREMENT SwcOut_AEB_DebugInfo.obj_data_info[5].short_pred_time.use_inpath_calculation "" UBYTE autosar_swc_aeb_CM_boolean 0 0 0 1 ECU_ADDRESS 0xfe4a4878 /* @ECU_Address@SwcOut_AEB_DebugInfo.obj_data_info[5].short_pred_time.use_inpath_calculation@ */ /end MEASUREMENT
/begin MEASUREMENT SwcOut_AEB_DebugInfo.obj_data_info[5].short_pred_time.use_out_offpath_calculation "" UBYTE autosar_swc_aeb_CM_boolean 0 0 0 1 ECU_ADDRESS 0xfe4a4879 /* @ECU_Address@SwcOut_AEB_DebugInfo.obj_data_info[5].short_pred_time.use_out_offpath_calculation@ */ /end MEASUREMENT
/begin MEASUREMENT SwcOut_AEB_DebugInfo.obj_data_info[6].bounding_box.cos_rotation "" FLOAT32_IEEE autosar_swc_aeb_CM_single 0 0 -3.4E+38 3.4E+38 ECU_ADDRESS 0xfe4a48ec /* @ECU_Address@SwcOut_AEB_DebugInfo.obj_data_info[6].bounding_box.cos_rotation@ */ /end MEASUREMENT
/begin MEASUREMENT SwcOut_AEB_DebugInfo.obj_data_info[6].bounding_box.length_side_lat "" FLOAT32_IEEE autosar_swc_aeb_CM_single 0 0 -3.4E+38 3.4E+38 ECU_ADDRESS 0xfe4a48e0 /* @ECU_Address@SwcOut_AEB_DebugInfo.obj_data_info[6].bounding_box.length_side_lat@ */ /end MEASUREMENT
/begin MEASUREMENT SwcOut_AEB_DebugInfo.obj_data_info[6].bounding_box.length_side_lgt "" FLOAT32_IEEE autosar_swc_aeb_CM_single 0 0 -3.4E+38 3.4E+38 ECU_ADDRESS 0xfe4a48e4 /* @ECU_Address@SwcOut_AEB_DebugInfo.obj_data_info[6].bounding_box.length_side_lgt@ */ /end MEASUREMENT
/begin MEASUREMENT SwcOut_AEB_DebugInfo.obj_data_info[6].bounding_box.sin_rotation "" FLOAT32_IEEE autosar_swc_aeb_CM_single 0 0 -3.4E+38 3.4E+38 ECU_ADDRESS 0xfe4a48e8 /* @ECU_Address@SwcOut_AEB_DebugInfo.obj_data_info[6].bounding_box.sin_rotation@ */ /end MEASUREMENT
/begin MEASUREMENT SwcOut_AEB_DebugInfo.obj_data_info[6].long_pred_time.inpath "" UBYTE autosar_swc_aeb_CM_boolean 0 0 0 1 ECU_ADDRESS 0xfe4a4904 /* @ECU_Address@SwcOut_AEB_DebugInfo.obj_data_info[6].long_pred_time.inpath@ */ /end MEASUREMENT
/begin MEASUREMENT SwcOut_AEB_DebugInfo.obj_data_info[6].long_pred_time.inpath_current_position "" UBYTE autosar_swc_aeb_CM_boolean 0 0 0 1 ECU_ADDRESS 0xfe4a4906 /* @ECU_Address@SwcOut_AEB_DebugInfo.obj_data_info[6].long_pred_time.inpath_current_position@ */ /end MEASUREMENT
/begin MEASUREMENT SwcOut_AEB_DebugInfo.obj_data_info[6].long_pred_time.inpath_predict_position "" UBYTE autosar_swc_aeb_CM_boolean 0 0 0 1 ECU_ADDRESS 0xfe4a4905 /* @ECU_Address@SwcOut_AEB_DebugInfo.obj_data_info[6].long_pred_time.inpath_predict_position@ */ /end MEASUREMENT
/begin MEASUREMENT SwcOut_AEB_DebugInfo.obj_data_info[6].long_pred_time.prediction_valid "" UBYTE autosar_swc_aeb_CM_boolean 0 0 0 1 ECU_ADDRESS 0xfe4a4909 /* @ECU_Address@SwcOut_AEB_DebugInfo.obj_data_info[6].long_pred_time.prediction_valid@ */ /end MEASUREMENT
/begin MEASUREMENT SwcOut_AEB_DebugInfo.obj_data_info[6].long_pred_time.ttr "" FLOAT32_IEEE autosar_swc_aeb_CM_single 0 0 -3.4E+38 3.4E+38 ECU_ADDRESS 0xfe4a4900 /* @ECU_Address@SwcOut_AEB_DebugInfo.obj_data_info[6].long_pred_time.ttr@ */ /end MEASUREMENT
/begin MEASUREMENT SwcOut_AEB_DebugInfo.obj_data_info[6].long_pred_time.use_inpath_calculation "" UBYTE autosar_swc_aeb_CM_boolean 0 0 0 1 ECU_ADDRESS 0xfe4a4907 /* @ECU_Address@SwcOut_AEB_DebugInfo.obj_data_info[6].long_pred_time.use_inpath_calculation@ */ /end MEASUREMENT
/begin MEASUREMENT SwcOut_AEB_DebugInfo.obj_data_info[6].long_pred_time.use_out_offpath_calculation "" UBYTE autosar_swc_aeb_CM_boolean 0 0 0 1 ECU_ADDRESS 0xfe4a4908 /* @ECU_Address@SwcOut_AEB_DebugInfo.obj_data_info[6].long_pred_time.use_out_offpath_calculation@ */ /end MEASUREMENT
/begin MEASUREMENT SwcOut_AEB_DebugInfo.obj_data_info[6].motion_type.abs_heading "" FLOAT32_IEEE autosar_swc_aeb_CM_single 0 0 -3.4E+38 3.4E+38 ECU_ADDRESS 0xfe4a48dc /* @ECU_Address@SwcOut_AEB_DebugInfo.obj_data_info[6].motion_type.abs_heading@ */ /end MEASUREMENT
/begin MEASUREMENT SwcOut_AEB_DebugInfo.obj_data_info[6].motion_type.curved_motion "" UBYTE autosar_swc_aeb_CM_boolean 0 0 0 1 ECU_ADDRESS 0xfe4a48da /* @ECU_Address@SwcOut_AEB_DebugInfo.obj_data_info[6].motion_type.curved_motion@ */ /end MEASUREMENT
/begin MEASUREMENT SwcOut_AEB_DebugInfo.obj_data_info[6].motion_type.moving_oncoming "" UBYTE autosar_swc_aeb_CM_boolean 0 0 0 1 ECU_ADDRESS 0xfe4a48d5 /* @ECU_Address@SwcOut_AEB_DebugInfo.obj_data_info[6].motion_type.moving_oncoming@ */ /end MEASUREMENT
/begin MEASUREMENT SwcOut_AEB_DebugInfo.obj_data_info[6].motion_type.object_is_motor_vehicle "" UBYTE autosar_swc_aeb_CM_boolean 0 0 0 1 ECU_ADDRESS 0xfe4a48d9 /* @ECU_Address@SwcOut_AEB_DebugInfo.obj_data_info[6].motion_type.object_is_motor_vehicle@ */ /end MEASUREMENT
/begin MEASUREMENT SwcOut_AEB_DebugInfo.obj_data_info[6].motion_type.object_is_vehicle "" UBYTE autosar_swc_aeb_CM_boolean 0 0 0 1 ECU_ADDRESS 0xfe4a48d8 /* @ECU_Address@SwcOut_AEB_DebugInfo.obj_data_info[6].motion_type.object_is_vehicle@ */ /end MEASUREMENT
/begin MEASUREMENT SwcOut_AEB_DebugInfo.obj_data_info[6].motion_type.parallell_vehicle_long_predict "" UBYTE autosar_swc_aeb_CM_boolean 0 0 0 1 ECU_ADDRESS 0xfe4a48d6 /* @ECU_Address@SwcOut_AEB_DebugInfo.obj_data_info[6].motion_type.parallell_vehicle_long_predict@ */ /end MEASUREMENT
/begin MEASUREMENT SwcOut_AEB_DebugInfo.obj_data_info[6].motion_type.parallell_vehicle_short_predict "" UBYTE autosar_swc_aeb_CM_boolean 0 0 0 1 ECU_ADDRESS 0xfe4a48d7 /* @ECU_Address@SwcOut_AEB_DebugInfo.obj_data_info[6].motion_type.parallell_vehicle_short_predict@ */ /end MEASUREMENT
/begin MEASUREMENT SwcOut_AEB_DebugInfo.obj_data_info[6].motion_type.side_is_closest "" UBYTE autosar_swc_aeb_CM_boolean 0 0 0 1 ECU_ADDRESS 0xfe4a48db /* @ECU_Address@SwcOut_AEB_DebugInfo.obj_data_info[6].motion_type.side_is_closest@ */ /end MEASUREMENT
/begin MEASUREMENT SwcOut_AEB_DebugInfo.obj_data_info[6].motion_type.stationary "" UBYTE autosar_swc_aeb_CM_boolean 0 0 0 1 ECU_ADDRESS 0xfe4a48d4 /* @ECU_Address@SwcOut_AEB_DebugInfo.obj_data_info[6].motion_type.stationary@ */ /end MEASUREMENT
/begin MEASUREMENT SwcOut_AEB_DebugInfo.obj_data_info[6].offsets.offs_lat_inpath_close_edge "" FLOAT32_IEEE autosar_swc_aeb_CM_single 0 0 -3.4E+38 3.4E+38 ECU_ADDRESS 0xfe4a4924 /* @ECU_Address@SwcOut_AEB_DebugInfo.obj_data_info[6].offsets.offs_lat_inpath_close_edge@ */ /end MEASUREMENT
/begin MEASUREMENT SwcOut_AEB_DebugInfo.obj_data_info[6].offsets.offs_lat_inpath_far_edge "" FLOAT32_IEEE autosar_swc_aeb_CM_single 0 0 -3.4E+38 3.4E+38 ECU_ADDRESS 0xfe4a4928 /* @ECU_Address@SwcOut_AEB_DebugInfo.obj_data_info[6].offsets.offs_lat_inpath_far_edge@ */ /end MEASUREMENT
/begin MEASUREMENT SwcOut_AEB_DebugInfo.obj_data_info[6].offsets.offs_lat_inpath_primary_target "" FLOAT32_IEEE autosar_swc_aeb_CM_single 0 0 -3.4E+38 3.4E+38 ECU_ADDRESS 0xfe4a4920 /* @ECU_Address@SwcOut_AEB_DebugInfo.obj_data_info[6].offsets.offs_lat_inpath_primary_target@ */ /end MEASUREMENT
/begin MEASUREMENT SwcOut_AEB_DebugInfo.obj_data_info[6].offsets.offs_lat_intersection "" FLOAT32_IEEE autosar_swc_aeb_CM_single 0 0 -3.4E+38 3.4E+38 ECU_ADDRESS 0xfe4a492c /* @ECU_Address@SwcOut_AEB_DebugInfo.obj_data_info[6].offsets.offs_lat_intersection@ */ /end MEASUREMENT
/begin MEASUREMENT SwcOut_AEB_DebugInfo.obj_data_info[6].offsets.offs_lat_long_predict "" FLOAT32_IEEE autosar_swc_aeb_CM_single 0 0 -3.4E+38 3.4E+38 ECU_ADDRESS 0xfe4a4910 /* @ECU_Address@SwcOut_AEB_DebugInfo.obj_data_info[6].offsets.offs_lat_long_predict@ */ /end MEASUREMENT
/begin MEASUREMENT SwcOut_AEB_DebugInfo.obj_data_info[6].offsets.offs_lat_manoeuvre "" FLOAT32_IEEE autosar_swc_aeb_CM_single 0 0 -3.4E+38 3.4E+38 ECU_ADDRESS 0xfe4a491c /* @ECU_Address@SwcOut_AEB_DebugInfo.obj_data_info[6].offsets.offs_lat_manoeuvre@ */ /end MEASUREMENT
/begin MEASUREMENT SwcOut_AEB_DebugInfo.obj_data_info[6].offsets.offs_lat_multiple_target "" FLOAT32_IEEE autosar_swc_aeb_CM_single 0 0 -3.4E+38 3.4E+38 ECU_ADDRESS 0xfe4a4930 /* @ECU_Address@SwcOut_AEB_DebugInfo.obj_data_info[6].offsets.offs_lat_multiple_target@ */ /end MEASUREMENT
/begin MEASUREMENT SwcOut_AEB_DebugInfo.obj_data_info[6].offsets.offs_lat_short_predict "" FLOAT32_IEEE autosar_swc_aeb_CM_single 0 0 -3.4E+38 3.4E+38 ECU_ADDRESS 0xfe4a4918 /* @ECU_Address@SwcOut_AEB_DebugInfo.obj_data_info[6].offsets.offs_lat_short_predict@ */ /end MEASUREMENT
/begin MEASUREMENT SwcOut_AEB_DebugInfo.obj_data_info[6].offsets.offs_lgt_long_predict "" FLOAT32_IEEE autosar_swc_aeb_CM_single 0 0 -3.4E+38 3.4E+38 ECU_ADDRESS 0xfe4a490c /* @ECU_Address@SwcOut_AEB_DebugInfo.obj_data_info[6].offsets.offs_lgt_long_predict@ */ /end MEASUREMENT
/begin MEASUREMENT SwcOut_AEB_DebugInfo.obj_data_info[6].offsets.offs_lgt_short_predict "" FLOAT32_IEEE autosar_swc_aeb_CM_single 0 0 -3.4E+38 3.4E+38 ECU_ADDRESS 0xfe4a4914 /* @ECU_Address@SwcOut_AEB_DebugInfo.obj_data_info[6].offsets.offs_lgt_short_predict@ */ /end MEASUREMENT
/begin MEASUREMENT SwcOut_AEB_DebugInfo.obj_data_info[6].porperty.a "" FLOAT32_IEEE autosar_swc_aeb_CM_single 0 0 -3.4E+38 3.4E+38 ECU_ADDRESS 0xfe4a48cc /* @ECU_Address@SwcOut_AEB_DebugInfo.obj_data_info[6].porperty.a@ */ /end MEASUREMENT
/begin MEASUREMENT SwcOut_AEB_DebugInfo.obj_data_info[6].porperty.a_lat "" FLOAT32_IEEE autosar_swc_aeb_CM_single 0 0 -3.4E+38 3.4E+38 ECU_ADDRESS 0xfe4a48c8 /* @ECU_Address@SwcOut_AEB_DebugInfo.obj_data_info[6].porperty.a_lat@ */ /end MEASUREMENT
/begin MEASUREMENT SwcOut_AEB_DebugInfo.obj_data_info[6].porperty.a_lgt "" FLOAT32_IEEE autosar_swc_aeb_CM_single 0 0 -3.4E+38 3.4E+38 ECU_ADDRESS 0xfe4a48c4 /* @ECU_Address@SwcOut_AEB_DebugInfo.obj_data_info[6].porperty.a_lgt@ */ /end MEASUREMENT
/begin MEASUREMENT SwcOut_AEB_DebugInfo.obj_data_info[6].porperty.curvature "" FLOAT32_IEEE autosar_swc_aeb_CM_single 0 0 -3.4E+38 3.4E+38 ECU_ADDRESS 0xfe4a48d0 /* @ECU_Address@SwcOut_AEB_DebugInfo.obj_data_info[6].porperty.curvature@ */ /end MEASUREMENT
/begin MEASUREMENT SwcOut_AEB_DebugInfo.obj_data_info[6].porperty.p_lat "" FLOAT32_IEEE autosar_swc_aeb_CM_single 0 0 -3.4E+38 3.4E+38 ECU_ADDRESS 0xfe4a48b4 /* @ECU_Address@SwcOut_AEB_DebugInfo.obj_data_info[6].porperty.p_lat@ */ /end MEASUREMENT
/begin MEASUREMENT SwcOut_AEB_DebugInfo.obj_data_info[6].porperty.p_lgt "" FLOAT32_IEEE autosar_swc_aeb_CM_single 0 0 -3.4E+38 3.4E+38 ECU_ADDRESS 0xfe4a48b0 /* @ECU_Address@SwcOut_AEB_DebugInfo.obj_data_info[6].porperty.p_lgt@ */ /end MEASUREMENT
/begin MEASUREMENT SwcOut_AEB_DebugInfo.obj_data_info[6].porperty.spd "" FLOAT32_IEEE autosar_swc_aeb_CM_single 0 0 -3.4E+38 3.4E+38 ECU_ADDRESS 0xfe4a48b8 /* @ECU_Address@SwcOut_AEB_DebugInfo.obj_data_info[6].porperty.spd@ */ /end MEASUREMENT
/begin MEASUREMENT SwcOut_AEB_DebugInfo.obj_data_info[6].porperty.v_lat "" FLOAT32_IEEE autosar_swc_aeb_CM_single 0 0 -3.4E+38 3.4E+38 ECU_ADDRESS 0xfe4a48c0 /* @ECU_Address@SwcOut_AEB_DebugInfo.obj_data_info[6].porperty.v_lat@ */ /end MEASUREMENT
/begin MEASUREMENT SwcOut_AEB_DebugInfo.obj_data_info[6].porperty.v_lgt "" FLOAT32_IEEE autosar_swc_aeb_CM_single 0 0 -3.4E+38 3.4E+38 ECU_ADDRESS 0xfe4a48bc /* @ECU_Address@SwcOut_AEB_DebugInfo.obj_data_info[6].porperty.v_lgt@ */ /end MEASUREMENT
/begin MEASUREMENT SwcOut_AEB_DebugInfo.obj_data_info[6].short_pred_time.inpath "" UBYTE autosar_swc_aeb_CM_boolean 0 0 0 1 ECU_ADDRESS 0xfe4a48f9 /* @ECU_Address@SwcOut_AEB_DebugInfo.obj_data_info[6].short_pred_time.inpath@ */ /end MEASUREMENT
/begin MEASUREMENT SwcOut_AEB_DebugInfo.obj_data_info[6].short_pred_time.inpath_current_position "" UBYTE autosar_swc_aeb_CM_boolean 0 0 0 1 ECU_ADDRESS 0xfe4a48fb /* @ECU_Address@SwcOut_AEB_DebugInfo.obj_data_info[6].short_pred_time.inpath_current_position@ */ /end MEASUREMENT
/begin MEASUREMENT SwcOut_AEB_DebugInfo.obj_data_info[6].short_pred_time.inpath_predict_position "" UBYTE autosar_swc_aeb_CM_boolean 0 0 0 1 ECU_ADDRESS 0xfe4a48fa /* @ECU_Address@SwcOut_AEB_DebugInfo.obj_data_info[6].short_pred_time.inpath_predict_position@ */ /end MEASUREMENT
/begin MEASUREMENT SwcOut_AEB_DebugInfo.obj_data_info[6].short_pred_time.prediction_valid "" UBYTE autosar_swc_aeb_CM_boolean 0 0 0 1 ECU_ADDRESS 0xfe4a48fe /* @ECU_Address@SwcOut_AEB_DebugInfo.obj_data_info[6].short_pred_time.prediction_valid@ */ /end MEASUREMENT
/begin MEASUREMENT SwcOut_AEB_DebugInfo.obj_data_info[6].short_pred_time.ttm "" FLOAT32_IEEE autosar_swc_aeb_CM_single 0 0 -3.4E+38 3.4E+38 ECU_ADDRESS 0xfe4a48f4 /* @ECU_Address@SwcOut_AEB_DebugInfo.obj_data_info[6].short_pred_time.ttm@ */ /end MEASUREMENT
/begin MEASUREMENT SwcOut_AEB_DebugInfo.obj_data_info[6].short_pred_time.ttm_selected "" UBYTE autosar_swc_aeb_CM_boolean 0 0 0 1 ECU_ADDRESS 0xfe4a48f8 /* @ECU_Address@SwcOut_AEB_DebugInfo.obj_data_info[6].short_pred_time.ttm_selected@ */ /end MEASUREMENT
/begin MEASUREMENT SwcOut_AEB_DebugInfo.obj_data_info[6].short_pred_time.ttr "" FLOAT32_IEEE autosar_swc_aeb_CM_single 0 0 -3.4E+38 3.4E+38 ECU_ADDRESS 0xfe4a48f0 /* @ECU_Address@SwcOut_AEB_DebugInfo.obj_data_info[6].short_pred_time.ttr@ */ /end MEASUREMENT
/begin MEASUREMENT SwcOut_AEB_DebugInfo.obj_data_info[6].short_pred_time.use_inpath_calculation "" UBYTE autosar_swc_aeb_CM_boolean 0 0 0 1 ECU_ADDRESS 0xfe4a48fc /* @ECU_Address@SwcOut_AEB_DebugInfo.obj_data_info[6].short_pred_time.use_inpath_calculation@ */ /end MEASUREMENT
/begin MEASUREMENT SwcOut_AEB_DebugInfo.obj_data_info[6].short_pred_time.use_out_offpath_calculation "" UBYTE autosar_swc_aeb_CM_boolean 0 0 0 1 ECU_ADDRESS 0xfe4a48fd /* @ECU_Address@SwcOut_AEB_DebugInfo.obj_data_info[6].short_pred_time.use_out_offpath_calculation@ */ /end MEASUREMENT
/begin MEASUREMENT SwcOut_AEB_DebugInfo.obj_data_info[7].bounding_box.cos_rotation "" FLOAT32_IEEE autosar_swc_aeb_CM_single 0 0 -3.4E+38 3.4E+38 ECU_ADDRESS 0xfe4a4970 /* @ECU_Address@SwcOut_AEB_DebugInfo.obj_data_info[7].bounding_box.cos_rotation@ */ /end MEASUREMENT
/begin MEASUREMENT SwcOut_AEB_DebugInfo.obj_data_info[7].bounding_box.length_side_lat "" FLOAT32_IEEE autosar_swc_aeb_CM_single 0 0 -3.4E+38 3.4E+38 ECU_ADDRESS 0xfe4a4964 /* @ECU_Address@SwcOut_AEB_DebugInfo.obj_data_info[7].bounding_box.length_side_lat@ */ /end MEASUREMENT
/begin MEASUREMENT SwcOut_AEB_DebugInfo.obj_data_info[7].bounding_box.length_side_lgt "" FLOAT32_IEEE autosar_swc_aeb_CM_single 0 0 -3.4E+38 3.4E+38 ECU_ADDRESS 0xfe4a4968 /* @ECU_Address@SwcOut_AEB_DebugInfo.obj_data_info[7].bounding_box.length_side_lgt@ */ /end MEASUREMENT
/begin MEASUREMENT SwcOut_AEB_DebugInfo.obj_data_info[7].bounding_box.sin_rotation "" FLOAT32_IEEE autosar_swc_aeb_CM_single 0 0 -3.4E+38 3.4E+38 ECU_ADDRESS 0xfe4a496c /* @ECU_Address@SwcOut_AEB_DebugInfo.obj_data_info[7].bounding_box.sin_rotation@ */ /end MEASUREMENT
/begin MEASUREMENT SwcOut_AEB_DebugInfo.obj_data_info[7].long_pred_time.inpath "" UBYTE autosar_swc_aeb_CM_boolean 0 0 0 1 ECU_ADDRESS 0xfe4a4988 /* @ECU_Address@SwcOut_AEB_DebugInfo.obj_data_info[7].long_pred_time.inpath@ */ /end MEASUREMENT
/begin MEASUREMENT SwcOut_AEB_DebugInfo.obj_data_info[7].long_pred_time.inpath_current_position "" UBYTE autosar_swc_aeb_CM_boolean 0 0 0 1 ECU_ADDRESS 0xfe4a498a /* @ECU_Address@SwcOut_AEB_DebugInfo.obj_data_info[7].long_pred_time.inpath_current_position@ */ /end MEASUREMENT
/begin MEASUREMENT SwcOut_AEB_DebugInfo.obj_data_info[7].long_pred_time.inpath_predict_position "" UBYTE autosar_swc_aeb_CM_boolean 0 0 0 1 ECU_ADDRESS 0xfe4a4989 /* @ECU_Address@SwcOut_AEB_DebugInfo.obj_data_info[7].long_pred_time.inpath_predict_position@ */ /end MEASUREMENT
/begin MEASUREMENT SwcOut_AEB_DebugInfo.obj_data_info[7].long_pred_time.prediction_valid "" UBYTE autosar_swc_aeb_CM_boolean 0 0 0 1 ECU_ADDRESS 0xfe4a498d /* @ECU_Address@SwcOut_AEB_DebugInfo.obj_data_info[7].long_pred_time.prediction_valid@ */ /end MEASUREMENT
/begin MEASUREMENT SwcOut_AEB_DebugInfo.obj_data_info[7].long_pred_time.ttr "" FLOAT32_IEEE autosar_swc_aeb_CM_single 0 0 -3.4E+38 3.4E+38 ECU_ADDRESS 0xfe4a4984 /* @ECU_Address@SwcOut_AEB_DebugInfo.obj_data_info[7].long_pred_time.ttr@ */ /end MEASUREMENT
/begin MEASUREMENT SwcOut_AEB_DebugInfo.obj_data_info[7].long_pred_time.use_inpath_calculation "" UBYTE autosar_swc_aeb_CM_boolean 0 0 0 1 ECU_ADDRESS 0xfe4a498b /* @ECU_Address@SwcOut_AEB_DebugInfo.obj_data_info[7].long_pred_time.use_inpath_calculation@ */ /end MEASUREMENT
/begin MEASUREMENT SwcOut_AEB_DebugInfo.obj_data_info[7].long_pred_time.use_out_offpath_calculation "" UBYTE autosar_swc_aeb_CM_boolean 0 0 0 1 ECU_ADDRESS 0xfe4a498c /* @ECU_Address@SwcOut_AEB_DebugInfo.obj_data_info[7].long_pred_time.use_out_offpath_calculation@ */ /end MEASUREMENT
/begin MEASUREMENT SwcOut_AEB_DebugInfo.obj_data_info[7].motion_type.abs_heading "" FLOAT32_IEEE autosar_swc_aeb_CM_single 0 0 -3.4E+38 3.4E+38 ECU_ADDRESS 0xfe4a4960 /* @ECU_Address@SwcOut_AEB_DebugInfo.obj_data_info[7].motion_type.abs_heading@ */ /end MEASUREMENT
/begin MEASUREMENT SwcOut_AEB_DebugInfo.obj_data_info[7].motion_type.curved_motion "" UBYTE autosar_swc_aeb_CM_boolean 0 0 0 1 ECU_ADDRESS 0xfe4a495e /* @ECU_Address@SwcOut_AEB_DebugInfo.obj_data_info[7].motion_type.curved_motion@ */ /end MEASUREMENT
/begin MEASUREMENT SwcOut_AEB_DebugInfo.obj_data_info[7].motion_type.moving_oncoming "" UBYTE autosar_swc_aeb_CM_boolean 0 0 0 1 ECU_ADDRESS 0xfe4a4959 /* @ECU_Address@SwcOut_AEB_DebugInfo.obj_data_info[7].motion_type.moving_oncoming@ */ /end MEASUREMENT
/begin MEASUREMENT SwcOut_AEB_DebugInfo.obj_data_info[7].motion_type.object_is_motor_vehicle "" UBYTE autosar_swc_aeb_CM_boolean 0 0 0 1 ECU_ADDRESS 0xfe4a495d /* @ECU_Address@SwcOut_AEB_DebugInfo.obj_data_info[7].motion_type.object_is_motor_vehicle@ */ /end MEASUREMENT
/begin MEASUREMENT SwcOut_AEB_DebugInfo.obj_data_info[7].motion_type.object_is_vehicle "" UBYTE autosar_swc_aeb_CM_boolean 0 0 0 1 ECU_ADDRESS 0xfe4a495c /* @ECU_Address@SwcOut_AEB_DebugInfo.obj_data_info[7].motion_type.object_is_vehicle@ */ /end MEASUREMENT
/begin MEASUREMENT SwcOut_AEB_DebugInfo.obj_data_info[7].motion_type.parallell_vehicle_long_predict "" UBYTE autosar_swc_aeb_CM_boolean 0 0 0 1 ECU_ADDRESS 0xfe4a495a /* @ECU_Address@SwcOut_AEB_DebugInfo.obj_data_info[7].motion_type.parallell_vehicle_long_predict@ */ /end MEASUREMENT
/begin MEASUREMENT SwcOut_AEB_DebugInfo.obj_data_info[7].motion_type.parallell_vehicle_short_predict "" UBYTE autosar_swc_aeb_CM_boolean 0 0 0 1 ECU_ADDRESS 0xfe4a495b /* @ECU_Address@SwcOut_AEB_DebugInfo.obj_data_info[7].motion_type.parallell_vehicle_short_predict@ */ /end MEASUREMENT
/begin MEASUREMENT SwcOut_AEB_DebugInfo.obj_data_info[7].motion_type.side_is_closest "" UBYTE autosar_swc_aeb_CM_boolean 0 0 0 1 ECU_ADDRESS 0xfe4a495f /* @ECU_Address@SwcOut_AEB_DebugInfo.obj_data_info[7].motion_type.side_is_closest@ */ /end MEASUREMENT
/begin MEASUREMENT SwcOut_AEB_DebugInfo.obj_data_info[7].motion_type.stationary "" UBYTE autosar_swc_aeb_CM_boolean 0 0 0 1 ECU_ADDRESS 0xfe4a4958 /* @ECU_Address@SwcOut_AEB_DebugInfo.obj_data_info[7].motion_type.stationary@ */ /end MEASUREMENT
/begin MEASUREMENT SwcOut_AEB_DebugInfo.obj_data_info[7].offsets.offs_lat_inpath_close_edge "" FLOAT32_IEEE autosar_swc_aeb_CM_single 0 0 -3.4E+38 3.4E+38 ECU_ADDRESS 0xfe4a49a8 /* @ECU_Address@SwcOut_AEB_DebugInfo.obj_data_info[7].offsets.offs_lat_inpath_close_edge@ */ /end MEASUREMENT
/begin MEASUREMENT SwcOut_AEB_DebugInfo.obj_data_info[7].offsets.offs_lat_inpath_far_edge "" FLOAT32_IEEE autosar_swc_aeb_CM_single 0 0 -3.4E+38 3.4E+38 ECU_ADDRESS 0xfe4a49ac /* @ECU_Address@SwcOut_AEB_DebugInfo.obj_data_info[7].offsets.offs_lat_inpath_far_edge@ */ /end MEASUREMENT
/begin MEASUREMENT SwcOut_AEB_DebugInfo.obj_data_info[7].offsets.offs_lat_inpath_primary_target "" FLOAT32_IEEE autosar_swc_aeb_CM_single 0 0 -3.4E+38 3.4E+38 ECU_ADDRESS 0xfe4a49a4 /* @ECU_Address@SwcOut_AEB_DebugInfo.obj_data_info[7].offsets.offs_lat_inpath_primary_target@ */ /end MEASUREMENT
/begin MEASUREMENT SwcOut_AEB_DebugInfo.obj_data_info[7].offsets.offs_lat_intersection "" FLOAT32_IEEE autosar_swc_aeb_CM_single 0 0 -3.4E+38 3.4E+38 ECU_ADDRESS 0xfe4a49b0 /* @ECU_Address@SwcOut_AEB_DebugInfo.obj_data_info[7].offsets.offs_lat_intersection@ */ /end MEASUREMENT
/begin MEASUREMENT SwcOut_AEB_DebugInfo.obj_data_info[7].offsets.offs_lat_long_predict "" FLOAT32_IEEE autosar_swc_aeb_CM_single 0 0 -3.4E+38 3.4E+38 ECU_ADDRESS 0xfe4a4994 /* @ECU_Address@SwcOut_AEB_DebugInfo.obj_data_info[7].offsets.offs_lat_long_predict@ */ /end MEASUREMENT
/begin MEASUREMENT SwcOut_AEB_DebugInfo.obj_data_info[7].offsets.offs_lat_manoeuvre "" FLOAT32_IEEE autosar_swc_aeb_CM_single 0 0 -3.4E+38 3.4E+38 ECU_ADDRESS 0xfe4a49a0 /* @ECU_Address@SwcOut_AEB_DebugInfo.obj_data_info[7].offsets.offs_lat_manoeuvre@ */ /end MEASUREMENT
/begin MEASUREMENT SwcOut_AEB_DebugInfo.obj_data_info[7].offsets.offs_lat_multiple_target "" FLOAT32_IEEE autosar_swc_aeb_CM_single 0 0 -3.4E+38 3.4E+38 ECU_ADDRESS 0xfe4a49b4 /* @ECU_Address@SwcOut_AEB_DebugInfo.obj_data_info[7].offsets.offs_lat_multiple_target@ */ /end MEASUREMENT
/begin MEASUREMENT SwcOut_AEB_DebugInfo.obj_data_info[7].offsets.offs_lat_short_predict "" FLOAT32_IEEE autosar_swc_aeb_CM_single 0 0 -3.4E+38 3.4E+38 ECU_ADDRESS 0xfe4a499c /* @ECU_Address@SwcOut_AEB_DebugInfo.obj_data_info[7].offsets.offs_lat_short_predict@ */ /end MEASUREMENT
/begin MEASUREMENT SwcOut_AEB_DebugInfo.obj_data_info[7].offsets.offs_lgt_long_predict "" FLOAT32_IEEE autosar_swc_aeb_CM_single 0 0 -3.4E+38 3.4E+38 ECU_ADDRESS 0xfe4a4990 /* @ECU_Address@SwcOut_AEB_DebugInfo.obj_data_info[7].offsets.offs_lgt_long_predict@ */ /end MEASUREMENT
/begin MEASUREMENT SwcOut_AEB_DebugInfo.obj_data_info[7].offsets.offs_lgt_short_predict "" FLOAT32_IEEE autosar_swc_aeb_CM_single 0 0 -3.4E+38 3.4E+38 ECU_ADDRESS 0xfe4a4998 /* @ECU_Address@SwcOut_AEB_DebugInfo.obj_data_info[7].offsets.offs_lgt_short_predict@ */ /end MEASUREMENT
/begin MEASUREMENT SwcOut_AEB_DebugInfo.obj_data_info[7].porperty.a "" FLOAT32_IEEE autosar_swc_aeb_CM_single 0 0 -3.4E+38 3.4E+38 ECU_ADDRESS 0xfe4a4950 /* @ECU_Address@SwcOut_AEB_DebugInfo.obj_data_info[7].porperty.a@ */ /end MEASUREMENT
/begin MEASUREMENT SwcOut_AEB_DebugInfo.obj_data_info[7].porperty.a_lat "" FLOAT32_IEEE autosar_swc_aeb_CM_single 0 0 -3.4E+38 3.4E+38 ECU_ADDRESS 0xfe4a494c /* @ECU_Address@SwcOut_AEB_DebugInfo.obj_data_info[7].porperty.a_lat@ */ /end MEASUREMENT
/begin MEASUREMENT SwcOut_AEB_DebugInfo.obj_data_info[7].porperty.a_lgt "" FLOAT32_IEEE autosar_swc_aeb_CM_single 0 0 -3.4E+38 3.4E+38 ECU_ADDRESS 0xfe4a4948 /* @ECU_Address@SwcOut_AEB_DebugInfo.obj_data_info[7].porperty.a_lgt@ */ /end MEASUREMENT
/begin MEASUREMENT SwcOut_AEB_DebugInfo.obj_data_info[7].porperty.curvature "" FLOAT32_IEEE autosar_swc_aeb_CM_single 0 0 -3.4E+38 3.4E+38 ECU_ADDRESS 0xfe4a4954 /* @ECU_Address@SwcOut_AEB_DebugInfo.obj_data_info[7].porperty.curvature@ */ /end MEASUREMENT
/begin MEASUREMENT SwcOut_AEB_DebugInfo.obj_data_info[7].porperty.p_lat "" FLOAT32_IEEE autosar_swc_aeb_CM_single 0 0 -3.4E+38 3.4E+38 ECU_ADDRESS 0xfe4a4938 /* @ECU_Address@SwcOut_AEB_DebugInfo.obj_data_info[7].porperty.p_lat@ */ /end MEASUREMENT
/begin MEASUREMENT SwcOut_AEB_DebugInfo.obj_data_info[7].porperty.p_lgt "" FLOAT32_IEEE autosar_swc_aeb_CM_single 0 0 -3.4E+38 3.4E+38 ECU_ADDRESS 0xfe4a4934 /* @ECU_Address@SwcOut_AEB_DebugInfo.obj_data_info[7].porperty.p_lgt@ */ /end MEASUREMENT
/begin MEASUREMENT SwcOut_AEB_DebugInfo.obj_data_info[7].porperty.spd "" FLOAT32_IEEE autosar_swc_aeb_CM_single 0 0 -3.4E+38 3.4E+38 ECU_ADDRESS 0xfe4a493c /* @ECU_Address@SwcOut_AEB_DebugInfo.obj_data_info[7].porperty.spd@ */ /end MEASUREMENT
/begin MEASUREMENT SwcOut_AEB_DebugInfo.obj_data_info[7].porperty.v_lat "" FLOAT32_IEEE autosar_swc_aeb_CM_single 0 0 -3.4E+38 3.4E+38 ECU_ADDRESS 0xfe4a4944 /* @ECU_Address@SwcOut_AEB_DebugInfo.obj_data_info[7].porperty.v_lat@ */ /end MEASUREMENT
/begin MEASUREMENT SwcOut_AEB_DebugInfo.obj_data_info[7].porperty.v_lgt "" FLOAT32_IEEE autosar_swc_aeb_CM_single 0 0 -3.4E+38 3.4E+38 ECU_ADDRESS 0xfe4a4940 /* @ECU_Address@SwcOut_AEB_DebugInfo.obj_data_info[7].porperty.v_lgt@ */ /end MEASUREMENT
/begin MEASUREMENT SwcOut_AEB_DebugInfo.obj_data_info[7].short_pred_time.inpath "" UBYTE autosar_swc_aeb_CM_boolean 0 0 0 1 ECU_ADDRESS 0xfe4a497d /* @ECU_Address@SwcOut_AEB_DebugInfo.obj_data_info[7].short_pred_time.inpath@ */ /end MEASUREMENT
/begin MEASUREMENT SwcOut_AEB_DebugInfo.obj_data_info[7].short_pred_time.inpath_current_position "" UBYTE autosar_swc_aeb_CM_boolean 0 0 0 1 ECU_ADDRESS 0xfe4a497f /* @ECU_Address@SwcOut_AEB_DebugInfo.obj_data_info[7].short_pred_time.inpath_current_position@ */ /end MEASUREMENT
/begin MEASUREMENT SwcOut_AEB_DebugInfo.obj_data_info[7].short_pred_time.inpath_predict_position "" UBYTE autosar_swc_aeb_CM_boolean 0 0 0 1 ECU_ADDRESS 0xfe4a497e /* @ECU_Address@SwcOut_AEB_DebugInfo.obj_data_info[7].short_pred_time.inpath_predict_position@ */ /end MEASUREMENT
/begin MEASUREMENT SwcOut_AEB_DebugInfo.obj_data_info[7].short_pred_time.prediction_valid "" UBYTE autosar_swc_aeb_CM_boolean 0 0 0 1 ECU_ADDRESS 0xfe4a4982 /* @ECU_Address@SwcOut_AEB_DebugInfo.obj_data_info[7].short_pred_time.prediction_valid@ */ /end MEASUREMENT
/begin MEASUREMENT SwcOut_AEB_DebugInfo.obj_data_info[7].short_pred_time.ttm "" FLOAT32_IEEE autosar_swc_aeb_CM_single 0 0 -3.4E+38 3.4E+38 ECU_ADDRESS 0xfe4a4978 /* @ECU_Address@SwcOut_AEB_DebugInfo.obj_data_info[7].short_pred_time.ttm@ */ /end MEASUREMENT
/begin MEASUREMENT SwcOut_AEB_DebugInfo.obj_data_info[7].short_pred_time.ttm_selected "" UBYTE autosar_swc_aeb_CM_boolean 0 0 0 1 ECU_ADDRESS 0xfe4a497c /* @ECU_Address@SwcOut_AEB_DebugInfo.obj_data_info[7].short_pred_time.ttm_selected@ */ /end MEASUREMENT
/begin MEASUREMENT SwcOut_AEB_DebugInfo.obj_data_info[7].short_pred_time.ttr "" FLOAT32_IEEE autosar_swc_aeb_CM_single 0 0 -3.4E+38 3.4E+38 ECU_ADDRESS 0xfe4a4974 /* @ECU_Address@SwcOut_AEB_DebugInfo.obj_data_info[7].short_pred_time.ttr@ */ /end MEASUREMENT
/begin MEASUREMENT SwcOut_AEB_DebugInfo.obj_data_info[7].short_pred_time.use_inpath_calculation "" UBYTE autosar_swc_aeb_CM_boolean 0 0 0 1 ECU_ADDRESS 0xfe4a4980 /* @ECU_Address@SwcOut_AEB_DebugInfo.obj_data_info[7].short_pred_time.use_inpath_calculation@ */ /end MEASUREMENT
/begin MEASUREMENT SwcOut_AEB_DebugInfo.obj_data_info[7].short_pred_time.use_out_offpath_calculation "" UBYTE autosar_swc_aeb_CM_boolean 0 0 0 1 ECU_ADDRESS 0xfe4a4981 /* @ECU_Address@SwcOut_AEB_DebugInfo.obj_data_info[7].short_pred_time.use_out_offpath_calculation@ */ /end MEASUREMENT
/begin MEASUREMENT SwcOut_AEB_FuSAIN.EgoPreTraj[10].Heading "" FLOAT32_IEEE autosar_swc_aeb_CM_single 0 0 -3.4E+38 3.4E+38 ECU_ADDRESS 0xfe4a4bcc /* @ECU_Address@SwcOut_AEB_FuSAIN.EgoPreTraj[10].Heading@ */ /end MEASUREMENT
/begin MEASUREMENT SwcOut_AEB_FuSAIN.EgoPreTraj[10].PosX "" FLOAT32_IEEE autosar_swc_aeb_CM_single 0 0 -3.4E+38 3.4E+38 ECU_ADDRESS 0xfe4a4bc4 /* @ECU_Address@SwcOut_AEB_FuSAIN.EgoPreTraj[10].PosX@ */ /end MEASUREMENT
/begin MEASUREMENT SwcOut_AEB_FuSAIN.EgoPreTraj[10].PosY "" FLOAT32_IEEE autosar_swc_aeb_CM_single 0 0 -3.4E+38 3.4E+38 ECU_ADDRESS 0xfe4a4bc8 /* @ECU_Address@SwcOut_AEB_FuSAIN.EgoPreTraj[10].PosY@ */ /end MEASUREMENT
/begin MEASUREMENT SwcOut_AEB_FuSAIN.EgoPreTraj[11].Heading "" FLOAT32_IEEE autosar_swc_aeb_CM_single 0 0 -3.4E+38 3.4E+38 ECU_ADDRESS 0xfe4a4bd8 /* @ECU_Address@SwcOut_AEB_FuSAIN.EgoPreTraj[11].Heading@ */ /end MEASUREMENT
/begin MEASUREMENT SwcOut_AEB_FuSAIN.EgoPreTraj[11].PosX "" FLOAT32_IEEE autosar_swc_aeb_CM_single 0 0 -3.4E+38 3.4E+38 ECU_ADDRESS 0xfe4a4bd0 /* @ECU_Address@SwcOut_AEB_FuSAIN.EgoPreTraj[11].PosX@ */ /end MEASUREMENT
/begin MEASUREMENT SwcOut_AEB_FuSAIN.EgoPreTraj[11].PosY "" FLOAT32_IEEE autosar_swc_aeb_CM_single 0 0 -3.4E+38 3.4E+38 ECU_ADDRESS 0xfe4a4bd4 /* @ECU_Address@SwcOut_AEB_FuSAIN.EgoPreTraj[11].PosY@ */ /end MEASUREMENT
/begin MEASUREMENT SwcOut_AEB_FuSAIN.EgoPreTraj[12].Heading "" FLOAT32_IEEE autosar_swc_aeb_CM_single 0 0 -3.4E+38 3.4E+38 ECU_ADDRESS 0xfe4a4be4 /* @ECU_Address@SwcOut_AEB_FuSAIN.EgoPreTraj[12].Heading@ */ /end MEASUREMENT
/begin MEASUREMENT SwcOut_AEB_FuSAIN.EgoPreTraj[12].PosX "" FLOAT32_IEEE autosar_swc_aeb_CM_single 0 0 -3.4E+38 3.4E+38 ECU_ADDRESS 0xfe4a4bdc /* @ECU_Address@SwcOut_AEB_FuSAIN.EgoPreTraj[12].PosX@ */ /end MEASUREMENT
/begin MEASUREMENT SwcOut_AEB_FuSAIN.EgoPreTraj[12].PosY "" FLOAT32_IEEE autosar_swc_aeb_CM_single 0 0 -3.4E+38 3.4E+38 ECU_ADDRESS 0xfe4a4be0 /* @ECU_Address@SwcOut_AEB_FuSAIN.EgoPreTraj[12].PosY@ */ /end MEASUREMENT
/begin MEASUREMENT SwcOut_AEB_FuSAIN.EgoPreTraj[13].Heading "" FLOAT32_IEEE autosar_swc_aeb_CM_single 0 0 -3.4E+38 3.4E+38 ECU_ADDRESS 0xfe4a4bf0 /* @ECU_Address@SwcOut_AEB_FuSAIN.EgoPreTraj[13].Heading@ */ /end MEASUREMENT
/begin MEASUREMENT SwcOut_AEB_FuSAIN.EgoPreTraj[13].PosX "" FLOAT32_IEEE autosar_swc_aeb_CM_single 0 0 -3.4E+38 3.4E+38 ECU_ADDRESS 0xfe4a4be8 /* @ECU_Address@SwcOut_AEB_FuSAIN.EgoPreTraj[13].PosX@ */ /end MEASUREMENT
/begin MEASUREMENT SwcOut_AEB_FuSAIN.EgoPreTraj[13].PosY "" FLOAT32_IEEE autosar_swc_aeb_CM_single 0 0 -3.4E+38 3.4E+38 ECU_ADDRESS 0xfe4a4bec /* @ECU_Address@SwcOut_AEB_FuSAIN.EgoPreTraj[13].PosY@ */ /end MEASUREMENT
/begin MEASUREMENT SwcOut_AEB_FuSAIN.EgoPreTraj[14].Heading "" FLOAT32_IEEE autosar_swc_aeb_CM_single 0 0 -3.4E+38 3.4E+38 ECU_ADDRESS 0xfe4a4bfc /* @ECU_Address@SwcOut_AEB_FuSAIN.EgoPreTraj[14].Heading@ */ /end MEASUREMENT
/begin MEASUREMENT SwcOut_AEB_FuSAIN.EgoPreTraj[14].PosX "" FLOAT32_IEEE autosar_swc_aeb_CM_single 0 0 -3.4E+38 3.4E+38 ECU_ADDRESS 0xfe4a4bf4 /* @ECU_Address@SwcOut_AEB_FuSAIN.EgoPreTraj[14].PosX@ */ /end MEASUREMENT
/begin MEASUREMENT SwcOut_AEB_FuSAIN.EgoPreTraj[14].PosY "" FLOAT32_IEEE autosar_swc_aeb_CM_single 0 0 -3.4E+38 3.4E+38 ECU_ADDRESS 0xfe4a4bf8 /* @ECU_Address@SwcOut_AEB_FuSAIN.EgoPreTraj[14].PosY@ */ /end MEASUREMENT
/begin MEASUREMENT SwcOut_AEB_FuSAIN.EgoPreTraj[15].Heading "" FLOAT32_IEEE autosar_swc_aeb_CM_single 0 0 -3.4E+38 3.4E+38 ECU_ADDRESS 0xfe4a4c08 /* @ECU_Address@SwcOut_AEB_FuSAIN.EgoPreTraj[15].Heading@ */ /end MEASUREMENT
/begin MEASUREMENT SwcOut_AEB_FuSAIN.EgoPreTraj[15].PosX "" FLOAT32_IEEE autosar_swc_aeb_CM_single 0 0 -3.4E+38 3.4E+38 ECU_ADDRESS 0xfe4a4c00 /* @ECU_Address@SwcOut_AEB_FuSAIN.EgoPreTraj[15].PosX@ */ /end MEASUREMENT
/begin MEASUREMENT SwcOut_AEB_FuSAIN.EgoPreTraj[15].PosY "" FLOAT32_IEEE autosar_swc_aeb_CM_single 0 0 -3.4E+38 3.4E+38 ECU_ADDRESS 0xfe4a4c04 /* @ECU_Address@SwcOut_AEB_FuSAIN.EgoPreTraj[15].PosY@ */ /end MEASUREMENT
/begin MEASUREMENT SwcOut_AEB_FuSAIN.EgoPreTraj[16].Heading "" FLOAT32_IEEE autosar_swc_aeb_CM_single 0 0 -3.4E+38 3.4E+38 ECU_ADDRESS 0xfe4a4c14 /* @ECU_Address@SwcOut_AEB_FuSAIN.EgoPreTraj[16].Heading@ */ /end MEASUREMENT
/begin MEASUREMENT SwcOut_AEB_FuSAIN.EgoPreTraj[16].PosX "" FLOAT32_IEEE autosar_swc_aeb_CM_single 0 0 -3.4E+38 3.4E+38 ECU_ADDRESS 0xfe4a4c0c /* @ECU_Address@SwcOut_AEB_FuSAIN.EgoPreTraj[16].PosX@ */ /end MEASUREMENT
/begin MEASUREMENT SwcOut_AEB_FuSAIN.EgoPreTraj[16].PosY "" FLOAT32_IEEE autosar_swc_aeb_CM_single 0 0 -3.4E+38 3.4E+38 ECU_ADDRESS 0xfe4a4c10 /* @ECU_Address@SwcOut_AEB_FuSAIN.EgoPreTraj[16].PosY@ */ /end MEASUREMENT
/begin MEASUREMENT SwcOut_AEB_FuSAIN.EgoPreTraj[17].Heading "" FLOAT32_IEEE autosar_swc_aeb_CM_single 0 0 -3.4E+38 3.4E+38 ECU_ADDRESS 0xfe4a4c20 /* @ECU_Address@SwcOut_AEB_FuSAIN.EgoPreTraj[17].Heading@ */ /end MEASUREMENT
/begin MEASUREMENT SwcOut_AEB_FuSAIN.EgoPreTraj[17].PosX "" FLOAT32_IEEE autosar_swc_aeb_CM_single 0 0 -3.4E+38 3.4E+38 ECU_ADDRESS 0xfe4a4c18 /* @ECU_Address@SwcOut_AEB_FuSAIN.EgoPreTraj[17].PosX@ */ /end MEASUREMENT
/begin MEASUREMENT SwcOut_AEB_FuSAIN.EgoPreTraj[17].PosY "" FLOAT32_IEEE autosar_swc_aeb_CM_single 0 0 -3.4E+38 3.4E+38 ECU_ADDRESS 0xfe4a4c1c /* @ECU_Address@SwcOut_AEB_FuSAIN.EgoPreTraj[17].PosY@ */ /end MEASUREMENT
/begin MEASUREMENT SwcOut_AEB_FuSAIN.EgoPreTraj[18].Heading "" FLOAT32_IEEE autosar_swc_aeb_CM_single 0 0 -3.4E+38 3.4E+38 ECU_ADDRESS 0xfe4a4c2c /* @ECU_Address@SwcOut_AEB_FuSAIN.EgoPreTraj[18].Heading@ */ /end MEASUREMENT
/begin MEASUREMENT SwcOut_AEB_FuSAIN.EgoPreTraj[18].PosX "" FLOAT32_IEEE autosar_swc_aeb_CM_single 0 0 -3.4E+38 3.4E+38 ECU_ADDRESS 0xfe4a4c24 /* @ECU_Address@SwcOut_AEB_FuSAIN.EgoPreTraj[18].PosX@ */ /end MEASUREMENT
/begin MEASUREMENT SwcOut_AEB_FuSAIN.EgoPreTraj[18].PosY "" FLOAT32_IEEE autosar_swc_aeb_CM_single 0 0 -3.4E+38 3.4E+38 ECU_ADDRESS 0xfe4a4c28 /* @ECU_Address@SwcOut_AEB_FuSAIN.EgoPreTraj[18].PosY@ */ /end MEASUREMENT
/begin MEASUREMENT SwcOut_AEB_FuSAIN.EgoPreTraj[19].Heading "" FLOAT32_IEEE autosar_swc_aeb_CM_single 0 0 -3.4E+38 3.4E+38 ECU_ADDRESS 0xfe4a4c38 /* @ECU_Address@SwcOut_AEB_FuSAIN.EgoPreTraj[19].Heading@ */ /end MEASUREMENT
/begin MEASUREMENT SwcOut_AEB_FuSAIN.EgoPreTraj[19].PosX "" FLOAT32_IEEE autosar_swc_aeb_CM_single 0 0 -3.4E+38 3.4E+38 ECU_ADDRESS 0xfe4a4c30 /* @ECU_Address@SwcOut_AEB_FuSAIN.EgoPreTraj[19].PosX@ */ /end MEASUREMENT
/begin MEASUREMENT SwcOut_AEB_FuSAIN.EgoPreTraj[19].PosY "" FLOAT32_IEEE autosar_swc_aeb_CM_single 0 0 -3.4E+38 3.4E+38 ECU_ADDRESS 0xfe4a4c34 /* @ECU_Address@SwcOut_AEB_FuSAIN.EgoPreTraj[19].PosY@ */ /end MEASUREMENT
/begin MEASUREMENT SwcOut_AEB_FuSAIN.EgoPreTraj[1].Heading "" FLOAT32_IEEE autosar_swc_aeb_CM_single 0 0 -3.4E+38 3.4E+38 ECU_ADDRESS 0xfe4a4b60 /* @ECU_Address@SwcOut_AEB_FuSAIN.EgoPreTraj[1].Heading@ */ /end MEASUREMENT
/begin MEASUREMENT SwcOut_AEB_FuSAIN.EgoPreTraj[1].PosX "" FLOAT32_IEEE autosar_swc_aeb_CM_single 0 0 -3.4E+38 3.4E+38 ECU_ADDRESS 0xfe4a4b58 /* @ECU_Address@SwcOut_AEB_FuSAIN.EgoPreTraj[1].PosX@ */ /end MEASUREMENT
/begin MEASUREMENT SwcOut_AEB_FuSAIN.EgoPreTraj[1].PosY "" FLOAT32_IEEE autosar_swc_aeb_CM_single 0 0 -3.4E+38 3.4E+38 ECU_ADDRESS 0xfe4a4b5c /* @ECU_Address@SwcOut_AEB_FuSAIN.EgoPreTraj[1].PosY@ */ /end MEASUREMENT
/begin MEASUREMENT SwcOut_AEB_FuSAIN.EgoPreTraj[20].Heading "" FLOAT32_IEEE autosar_swc_aeb_CM_single 0 0 -3.4E+38 3.4E+38 ECU_ADDRESS 0xfe4a4c44 /* @ECU_Address@SwcOut_AEB_FuSAIN.EgoPreTraj[20].Heading@ */ /end MEASUREMENT
/begin MEASUREMENT SwcOut_AEB_FuSAIN.EgoPreTraj[20].PosX "" FLOAT32_IEEE autosar_swc_aeb_CM_single 0 0 -3.4E+38 3.4E+38 ECU_ADDRESS 0xfe4a4c3c /* @ECU_Address@SwcOut_AEB_FuSAIN.EgoPreTraj[20].PosX@ */ /end MEASUREMENT
/begin MEASUREMENT SwcOut_AEB_FuSAIN.EgoPreTraj[20].PosY "" FLOAT32_IEEE autosar_swc_aeb_CM_single 0 0 -3.4E+38 3.4E+38 ECU_ADDRESS 0xfe4a4c40 /* @ECU_Address@SwcOut_AEB_FuSAIN.EgoPreTraj[20].PosY@ */ /end MEASUREMENT
/begin MEASUREMENT SwcOut_AEB_FuSAIN.EgoPreTraj[21].Heading "" FLOAT32_IEEE autosar_swc_aeb_CM_single 0 0 -3.4E+38 3.4E+38 ECU_ADDRESS 0xfe4a4c50 /* @ECU_Address@SwcOut_AEB_FuSAIN.EgoPreTraj[21].Heading@ */ /end MEASUREMENT
/begin MEASUREMENT SwcOut_AEB_FuSAIN.EgoPreTraj[21].PosX "" FLOAT32_IEEE autosar_swc_aeb_CM_single 0 0 -3.4E+38 3.4E+38 ECU_ADDRESS 0xfe4a4c48 /* @ECU_Address@SwcOut_AEB_FuSAIN.EgoPreTraj[21].PosX@ */ /end MEASUREMENT
/begin MEASUREMENT SwcOut_AEB_FuSAIN.EgoPreTraj[21].PosY "" FLOAT32_IEEE autosar_swc_aeb_CM_single 0 0 -3.4E+38 3.4E+38 ECU_ADDRESS 0xfe4a4c4c /* @ECU_Address@SwcOut_AEB_FuSAIN.EgoPreTraj[21].PosY@ */ /end MEASUREMENT
/begin MEASUREMENT SwcOut_AEB_FuSAIN.EgoPreTraj[22].Heading "" FLOAT32_IEEE autosar_swc_aeb_CM_single 0 0 -3.4E+38 3.4E+38 ECU_ADDRESS 0xfe4a4c5c /* @ECU_Address@SwcOut_AEB_FuSAIN.EgoPreTraj[22].Heading@ */ /end MEASUREMENT
/begin MEASUREMENT SwcOut_AEB_FuSAIN.EgoPreTraj[22].PosX "" FLOAT32_IEEE autosar_swc_aeb_CM_single 0 0 -3.4E+38 3.4E+38 ECU_ADDRESS 0xfe4a4c54 /* @ECU_Address@SwcOut_AEB_FuSAIN.EgoPreTraj[22].PosX@ */ /end MEASUREMENT
/begin MEASUREMENT SwcOut_AEB_FuSAIN.EgoPreTraj[22].PosY "" FLOAT32_IEEE autosar_swc_aeb_CM_single 0 0 -3.4E+38 3.4E+38 ECU_ADDRESS 0xfe4a4c58 /* @ECU_Address@SwcOut_AEB_FuSAIN.EgoPreTraj[22].PosY@ */ /end MEASUREMENT
/begin MEASUREMENT SwcOut_AEB_FuSAIN.EgoPreTraj[23].Heading "" FLOAT32_IEEE autosar_swc_aeb_CM_single 0 0 -3.4E+38 3.4E+38 ECU_ADDRESS 0xfe4a4c68 /* @ECU_Address@SwcOut_AEB_FuSAIN.EgoPreTraj[23].Heading@ */ /end MEASUREMENT
/begin MEASUREMENT SwcOut_AEB_FuSAIN.EgoPreTraj[23].PosX "" FLOAT32_IEEE autosar_swc_aeb_CM_single 0 0 -3.4E+38 3.4E+38 ECU_ADDRESS 0xfe4a4c60 /* @ECU_Address@SwcOut_AEB_FuSAIN.EgoPreTraj[23].PosX@ */ /end MEASUREMENT
/begin MEASUREMENT SwcOut_AEB_FuSAIN.EgoPreTraj[23].PosY "" FLOAT32_IEEE autosar_swc_aeb_CM_single 0 0 -3.4E+38 3.4E+38 ECU_ADDRESS 0xfe4a4c64 /* @ECU_Address@SwcOut_AEB_FuSAIN.EgoPreTraj[23].PosY@ */ /end MEASUREMENT
/begin MEASUREMENT SwcOut_AEB_FuSAIN.EgoPreTraj[24].Heading "" FLOAT32_IEEE autosar_swc_aeb_CM_single 0 0 -3.4E+38 3.4E+38 ECU_ADDRESS 0xfe4a4c74 /* @ECU_Address@SwcOut_AEB_FuSAIN.EgoPreTraj[24].Heading@ */ /end MEASUREMENT
/begin MEASUREMENT SwcOut_AEB_FuSAIN.EgoPreTraj[24].PosX "" FLOAT32_IEEE autosar_swc_aeb_CM_single 0 0 -3.4E+38 3.4E+38 ECU_ADDRESS 0xfe4a4c6c /* @ECU_Address@SwcOut_AEB_FuSAIN.EgoPreTraj[24].PosX@ */ /end MEASUREMENT
/begin MEASUREMENT SwcOut_AEB_FuSAIN.EgoPreTraj[24].PosY "" FLOAT32_IEEE autosar_swc_aeb_CM_single 0 0 -3.4E+38 3.4E+38 ECU_ADDRESS 0xfe4a4c70 /* @ECU_Address@SwcOut_AEB_FuSAIN.EgoPreTraj[24].PosY@ */ /end MEASUREMENT
/begin MEASUREMENT SwcOut_AEB_FuSAIN.EgoPreTraj[25].Heading "" FLOAT32_IEEE autosar_swc_aeb_CM_single 0 0 -3.4E+38 3.4E+38 ECU_ADDRESS 0xfe4a4c80 /* @ECU_Address@SwcOut_AEB_FuSAIN.EgoPreTraj[25].Heading@ */ /end MEASUREMENT
/begin MEASUREMENT SwcOut_AEB_FuSAIN.EgoPreTraj[25].PosX "" FLOAT32_IEEE autosar_swc_aeb_CM_single 0 0 -3.4E+38 3.4E+38 ECU_ADDRESS 0xfe4a4c78 /* @ECU_Address@SwcOut_AEB_FuSAIN.EgoPreTraj[25].PosX@ */ /end MEASUREMENT
/begin MEASUREMENT SwcOut_AEB_FuSAIN.EgoPreTraj[25].PosY "" FLOAT32_IEEE autosar_swc_aeb_CM_single 0 0 -3.4E+38 3.4E+38 ECU_ADDRESS 0xfe4a4c7c /* @ECU_Address@SwcOut_AEB_FuSAIN.EgoPreTraj[25].PosY@ */ /end MEASUREMENT
/begin MEASUREMENT SwcOut_AEB_FuSAIN.EgoPreTraj[26].Heading "" FLOAT32_IEEE autosar_swc_aeb_CM_single 0 0 -3.4E+38 3.4E+38 ECU_ADDRESS 0xfe4a4c8c /* @ECU_Address@SwcOut_AEB_FuSAIN.EgoPreTraj[26].Heading@ */ /end MEASUREMENT
/begin MEASUREMENT SwcOut_AEB_FuSAIN.EgoPreTraj[26].PosX "" FLOAT32_IEEE autosar_swc_aeb_CM_single 0 0 -3.4E+38 3.4E+38 ECU_ADDRESS 0xfe4a4c84 /* @ECU_Address@SwcOut_AEB_FuSAIN.EgoPreTraj[26].PosX@ */ /end MEASUREMENT
/begin MEASUREMENT SwcOut_AEB_FuSAIN.EgoPreTraj[26].PosY "" FLOAT32_IEEE autosar_swc_aeb_CM_single 0 0 -3.4E+38 3.4E+38 ECU_ADDRESS 0xfe4a4c88 /* @ECU_Address@SwcOut_AEB_FuSAIN.EgoPreTraj[26].PosY@ */ /end MEASUREMENT
/begin MEASUREMENT SwcOut_AEB_FuSAIN.EgoPreTraj[27].Heading "" FLOAT32_IEEE autosar_swc_aeb_CM_single 0 0 -3.4E+38 3.4E+38 ECU_ADDRESS 0xfe4a4c98 /* @ECU_Address@SwcOut_AEB_FuSAIN.EgoPreTraj[27].Heading@ */ /end MEASUREMENT
/begin MEASUREMENT SwcOut_AEB_FuSAIN.EgoPreTraj[27].PosX "" FLOAT32_IEEE autosar_swc_aeb_CM_single 0 0 -3.4E+38 3.4E+38 ECU_ADDRESS 0xfe4a4c90 /* @ECU_Address@SwcOut_AEB_FuSAIN.EgoPreTraj[27].PosX@ */ /end MEASUREMENT
/begin MEASUREMENT SwcOut_AEB_FuSAIN.EgoPreTraj[27].PosY "" FLOAT32_IEEE autosar_swc_aeb_CM_single 0 0 -3.4E+38 3.4E+38 ECU_ADDRESS 0xfe4a4c94 /* @ECU_Address@SwcOut_AEB_FuSAIN.EgoPreTraj[27].PosY@ */ /end MEASUREMENT
/begin MEASUREMENT SwcOut_AEB_FuSAIN.EgoPreTraj[28].Heading "" FLOAT32_IEEE autosar_swc_aeb_CM_single 0 0 -3.4E+38 3.4E+38 ECU_ADDRESS 0xfe4a4ca4 /* @ECU_Address@SwcOut_AEB_FuSAIN.EgoPreTraj[28].Heading@ */ /end MEASUREMENT
/begin MEASUREMENT SwcOut_AEB_FuSAIN.EgoPreTraj[28].PosX "" FLOAT32_IEEE autosar_swc_aeb_CM_single 0 0 -3.4E+38 3.4E+38 ECU_ADDRESS 0xfe4a4c9c /* @ECU_Address@SwcOut_AEB_FuSAIN.EgoPreTraj[28].PosX@ */ /end MEASUREMENT
/begin MEASUREMENT SwcOut_AEB_FuSAIN.EgoPreTraj[28].PosY "" FLOAT32_IEEE autosar_swc_aeb_CM_single 0 0 -3.4E+38 3.4E+38 ECU_ADDRESS 0xfe4a4ca0 /* @ECU_Address@SwcOut_AEB_FuSAIN.EgoPreTraj[28].PosY@ */ /end MEASUREMENT
/begin MEASUREMENT SwcOut_AEB_FuSAIN.EgoPreTraj[29].Heading "" FLOAT32_IEEE autosar_swc_aeb_CM_single 0 0 -3.4E+38 3.4E+38 ECU_ADDRESS 0xfe4a4cb0 /* @ECU_Address@SwcOut_AEB_FuSAIN.EgoPreTraj[29].Heading@ */ /end MEASUREMENT
/begin MEASUREMENT SwcOut_AEB_FuSAIN.EgoPreTraj[29].PosX "" FLOAT32_IEEE autosar_swc_aeb_CM_single 0 0 -3.4E+38 3.4E+38 ECU_ADDRESS 0xfe4a4ca8 /* @ECU_Address@SwcOut_AEB_FuSAIN.EgoPreTraj[29].PosX@ */ /end MEASUREMENT
/begin MEASUREMENT SwcOut_AEB_FuSAIN.EgoPreTraj[29].PosY "" FLOAT32_IEEE autosar_swc_aeb_CM_single 0 0 -3.4E+38 3.4E+38 ECU_ADDRESS 0xfe4a4cac /* @ECU_Address@SwcOut_AEB_FuSAIN.EgoPreTraj[29].PosY@ */ /end MEASUREMENT
/begin MEASUREMENT SwcOut_AEB_FuSAIN.EgoPreTraj[2].Heading "" FLOAT32_IEEE autosar_swc_aeb_CM_single 0 0 -3.4E+38 3.4E+38 ECU_ADDRESS 0xfe4a4b6c /* @ECU_Address@SwcOut_AEB_FuSAIN.EgoPreTraj[2].Heading@ */ /end MEASUREMENT
/begin MEASUREMENT SwcOut_AEB_FuSAIN.EgoPreTraj[2].PosX "" FLOAT32_IEEE autosar_swc_aeb_CM_single 0 0 -3.4E+38 3.4E+38 ECU_ADDRESS 0xfe4a4b64 /* @ECU_Address@SwcOut_AEB_FuSAIN.EgoPreTraj[2].PosX@ */ /end MEASUREMENT
/begin MEASUREMENT SwcOut_AEB_FuSAIN.EgoPreTraj[2].PosY "" FLOAT32_IEEE autosar_swc_aeb_CM_single 0 0 -3.4E+38 3.4E+38 ECU_ADDRESS 0xfe4a4b68 /* @ECU_Address@SwcOut_AEB_FuSAIN.EgoPreTraj[2].PosY@ */ /end MEASUREMENT
/begin MEASUREMENT SwcOut_AEB_FuSAIN.EgoPreTraj[3].Heading "" FLOAT32_IEEE autosar_swc_aeb_CM_single 0 0 -3.4E+38 3.4E+38 ECU_ADDRESS 0xfe4a4b78 /* @ECU_Address@SwcOut_AEB_FuSAIN.EgoPreTraj[3].Heading@ */ /end MEASUREMENT
/begin MEASUREMENT SwcOut_AEB_FuSAIN.EgoPreTraj[3].PosX "" FLOAT32_IEEE autosar_swc_aeb_CM_single 0 0 -3.4E+38 3.4E+38 ECU_ADDRESS 0xfe4a4b70 /* @ECU_Address@SwcOut_AEB_FuSAIN.EgoPreTraj[3].PosX@ */ /end MEASUREMENT
/begin MEASUREMENT SwcOut_AEB_FuSAIN.EgoPreTraj[3].PosY "" FLOAT32_IEEE autosar_swc_aeb_CM_single 0 0 -3.4E+38 3.4E+38 ECU_ADDRESS 0xfe4a4b74 /* @ECU_Address@SwcOut_AEB_FuSAIN.EgoPreTraj[3].PosY@ */ /end MEASUREMENT
/begin MEASUREMENT SwcOut_AEB_FuSAIN.EgoPreTraj[4].Heading "" FLOAT32_IEEE autosar_swc_aeb_CM_single 0 0 -3.4E+38 3.4E+38 ECU_ADDRESS 0xfe4a4b84 /* @ECU_Address@SwcOut_AEB_FuSAIN.EgoPreTraj[4].Heading@ */ /end MEASUREMENT
/begin MEASUREMENT SwcOut_AEB_FuSAIN.EgoPreTraj[4].PosX "" FLOAT32_IEEE autosar_swc_aeb_CM_single 0 0 -3.4E+38 3.4E+38 ECU_ADDRESS 0xfe4a4b7c /* @ECU_Address@SwcOut_AEB_FuSAIN.EgoPreTraj[4].PosX@ */ /end MEASUREMENT
/begin MEASUREMENT SwcOut_AEB_FuSAIN.EgoPreTraj[4].PosY "" FLOAT32_IEEE autosar_swc_aeb_CM_single 0 0 -3.4E+38 3.4E+38 ECU_ADDRESS 0xfe4a4b80 /* @ECU_Address@SwcOut_AEB_FuSAIN.EgoPreTraj[4].PosY@ */ /end MEASUREMENT
/begin MEASUREMENT SwcOut_AEB_FuSAIN.EgoPreTraj[5].Heading "" FLOAT32_IEEE autosar_swc_aeb_CM_single 0 0 -3.4E+38 3.4E+38 ECU_ADDRESS 0xfe4a4b90 /* @ECU_Address@SwcOut_AEB_FuSAIN.EgoPreTraj[5].Heading@ */ /end MEASUREMENT
/begin MEASUREMENT SwcOut_AEB_FuSAIN.EgoPreTraj[5].PosX "" FLOAT32_IEEE autosar_swc_aeb_CM_single 0 0 -3.4E+38 3.4E+38 ECU_ADDRESS 0xfe4a4b88 /* @ECU_Address@SwcOut_AEB_FuSAIN.EgoPreTraj[5].PosX@ */ /end MEASUREMENT
/begin MEASUREMENT SwcOut_AEB_FuSAIN.EgoPreTraj[5].PosY "" FLOAT32_IEEE autosar_swc_aeb_CM_single 0 0 -3.4E+38 3.4E+38 ECU_ADDRESS 0xfe4a4b8c /* @ECU_Address@SwcOut_AEB_FuSAIN.EgoPreTraj[5].PosY@ */ /end MEASUREMENT
/begin MEASUREMENT SwcOut_AEB_FuSAIN.EgoPreTraj[6].Heading "" FLOAT32_IEEE autosar_swc_aeb_CM_single 0 0 -3.4E+38 3.4E+38 ECU_ADDRESS 0xfe4a4b9c /* @ECU_Address@SwcOut_AEB_FuSAIN.EgoPreTraj[6].Heading@ */ /end MEASUREMENT
/begin MEASUREMENT SwcOut_AEB_FuSAIN.EgoPreTraj[6].PosX "" FLOAT32_IEEE autosar_swc_aeb_CM_single 0 0 -3.4E+38 3.4E+38 ECU_ADDRESS 0xfe4a4b94 /* @ECU_Address@SwcOut_AEB_FuSAIN.EgoPreTraj[6].PosX@ */ /end MEASUREMENT
/begin MEASUREMENT SwcOut_AEB_FuSAIN.EgoPreTraj[6].PosY "" FLOAT32_IEEE autosar_swc_aeb_CM_single 0 0 -3.4E+38 3.4E+38 ECU_ADDRESS 0xfe4a4b98 /* @ECU_Address@SwcOut_AEB_FuSAIN.EgoPreTraj[6].PosY@ */ /end MEASUREMENT
/begin MEASUREMENT SwcOut_AEB_FuSAIN.EgoPreTraj[7].Heading "" FLOAT32_IEEE autosar_swc_aeb_CM_single 0 0 -3.4E+38 3.4E+38 ECU_ADDRESS 0xfe4a4ba8 /* @ECU_Address@SwcOut_AEB_FuSAIN.EgoPreTraj[7].Heading@ */ /end MEASUREMENT
/begin MEASUREMENT SwcOut_AEB_FuSAIN.EgoPreTraj[7].PosX "" FLOAT32_IEEE autosar_swc_aeb_CM_single 0 0 -3.4E+38 3.4E+38 ECU_ADDRESS 0xfe4a4ba0 /* @ECU_Address@SwcOut_AEB_FuSAIN.EgoPreTraj[7].PosX@ */ /end MEASUREMENT
/begin MEASUREMENT SwcOut_AEB_FuSAIN.EgoPreTraj[7].PosY "" FLOAT32_IEEE autosar_swc_aeb_CM_single 0 0 -3.4E+38 3.4E+38 ECU_ADDRESS 0xfe4a4ba4 /* @ECU_Address@SwcOut_AEB_FuSAIN.EgoPreTraj[7].PosY@ */ /end MEASUREMENT
/begin MEASUREMENT SwcOut_AEB_FuSAIN.EgoPreTraj[8].Heading "" FLOAT32_IEEE autosar_swc_aeb_CM_single 0 0 -3.4E+38 3.4E+38 ECU_ADDRESS 0xfe4a4bb4 /* @ECU_Address@SwcOut_AEB_FuSAIN.EgoPreTraj[8].Heading@ */ /end MEASUREMENT
/begin MEASUREMENT SwcOut_AEB_FuSAIN.EgoPreTraj[8].PosX "" FLOAT32_IEEE autosar_swc_aeb_CM_single 0 0 -3.4E+38 3.4E+38 ECU_ADDRESS 0xfe4a4bac /* @ECU_Address@SwcOut_AEB_FuSAIN.EgoPreTraj[8].PosX@ */ /end MEASUREMENT
/begin MEASUREMENT SwcOut_AEB_FuSAIN.EgoPreTraj[8].PosY "" FLOAT32_IEEE autosar_swc_aeb_CM_single 0 0 -3.4E+38 3.4E+38 ECU_ADDRESS 0xfe4a4bb0 /* @ECU_Address@SwcOut_AEB_FuSAIN.EgoPreTraj[8].PosY@ */ /end MEASUREMENT
/begin MEASUREMENT SwcOut_AEB_FuSAIN.EgoPreTraj[9].Heading "" FLOAT32_IEEE autosar_swc_aeb_CM_single 0 0 -3.4E+38 3.4E+38 ECU_ADDRESS 0xfe4a4bc0 /* @ECU_Address@SwcOut_AEB_FuSAIN.EgoPreTraj[9].Heading@ */ /end MEASUREMENT
/begin MEASUREMENT SwcOut_AEB_FuSAIN.EgoPreTraj[9].PosX "" FLOAT32_IEEE autosar_swc_aeb_CM_single 0 0 -3.4E+38 3.4E+38 ECU_ADDRESS 0xfe4a4bb8 /* @ECU_Address@SwcOut_AEB_FuSAIN.EgoPreTraj[9].PosX@ */ /end MEASUREMENT
/begin MEASUREMENT SwcOut_AEB_FuSAIN.EgoPreTraj[9].PosY "" FLOAT32_IEEE autosar_swc_aeb_CM_single 0 0 -3.4E+38 3.4E+38 ECU_ADDRESS 0xfe4a4bbc /* @ECU_Address@SwcOut_AEB_FuSAIN.EgoPreTraj[9].PosY@ */ /end MEASUREMENT
/begin MEASUREMENT autosar_swc_aeb_rtARID_DEF.ARID_DEF_ForEachSegmentInPahEstimn.Width "" SBYTE autosar_swc_aeb_CM_int8 0 0 -128 127 ECU_ADDRESS 0xfe4a4d60 /* @ECU_Address@autosar_swc_aeb_rtARID_DEF.ARID_DEF_ForEachSegmentInPahEstimn.Width@ */ /end MEASUREMENT
/begin MEASUREMENT autosar_swc_aeb_rtARID_DEF.ARID_DEF_ForEachSegmentInPahEstimn_b.Width "" SBYTE autosar_swc_aeb_CM_int8 0 0 -128 127 ECU_ADDRESS 0xfe4a4daf /* @ECU_Address@autosar_swc_aeb_rtARID_DEF.ARID_DEF_ForEachSegmentInPahEstimn_b.Width@ */ /end MEASUREMENT
/begin MEASUREMENT autosar_swc_aeb_rtARID_DEF.ARID_DEF_ForEachSegmentInPahEstimn_c.Width "" SBYTE autosar_swc_aeb_CM_int8 0 0 -128 127 ECU_ADDRESS 0xfe4a4dac /* @ECU_Address@autosar_swc_aeb_rtARID_DEF.ARID_DEF_ForEachSegmentInPahEstimn_c.Width@ */ /end MEASUREMENT
/begin MEASUREMENT autosar_swc_aeb_rtARID_DEF.ARID_DEF_ForEachSegmentInPahEstimn_cx.Width "" SBYTE autosar_swc_aeb_CM_int8 0 0 -128 127 ECU_ADDRESS 0xfe4a4dae /* @ECU_Address@autosar_swc_aeb_rtARID_DEF.ARID_DEF_ForEachSegmentInPahEstimn_cx.Width@ */ /end MEASUREMENT
/begin MEASUREMENT autosar_swc_aeb_rtARID_DEF.ARID_DEF_ForEachSegmentInPahEstimn_k.Width "" SBYTE autosar_swc_aeb_CM_int8 0 0 -128 127 ECU_ADDRESS 0xfe4a4dad /* @ECU_Address@autosar_swc_aeb_rtARID_DEF.ARID_DEF_ForEachSegmentInPahEstimn_k.Width@ */ /end MEASUREMENT
/begin MEASUREMENT autosar_swc_aeb_rtARID_DEF.ARID_DEF_ForEachSegmentInPahEstimn_m.Width "" SBYTE autosar_swc_aeb_CM_int8 0 0 -128 127 ECU_ADDRESS 0xfe4a4d61 /* @ECU_Address@autosar_swc_aeb_rtARID_DEF.ARID_DEF_ForEachSegmentInPahEstimn_m.Width@ */ /end MEASUREMENT
/begin MEASUREMENT autosar_swc_aeb_rtARID_DEF.ARID_DEF_ForEachSegmentInPahEstimn_p.Width "" SBYTE autosar_swc_aeb_CM_int8 0 0 -128 127 ECU_ADDRESS 0xfe4a4db0 /* @ECU_Address@autosar_swc_aeb_rtARID_DEF.ARID_DEF_ForEachSegmentInPahEstimn_p.Width@ */ /end MEASUREMENT
/begin MEASUREMENT autosar_swc_aeb_rtARID_DEF.ARID_DEF_MATLABFunction1.Active_Sts "" UBYTE autosar_swc_aeb_CM_uint8 0 0 0 255 ECU_ADDRESS 0xfe4a4f24 /* @ECU_Address@autosar_swc_aeb_rtARID_DEF.ARID_DEF_MATLABFunction1.Active_Sts@ */ /end MEASUREMENT
/begin MEASUREMENT autosar_swc_aeb_rtARID_DEF.ARID_DEF_MATLABFunction1.Active_Time "" FLOAT32_IEEE autosar_swc_aeb_CM_single 0 0 -3.4E+38 3.4E+38 ECU_ADDRESS 0xfe4a4f20 /* @ECU_Address@autosar_swc_aeb_rtARID_DEF.ARID_DEF_MATLABFunction1.Active_Time@ */ /end MEASUREMENT
/begin MEASUREMENT autosar_swc_aeb_rtARID_DEF.ARID_DEF_MATLABFunction10.Active_Sts "" UBYTE autosar_swc_aeb_CM_uint8 0 0 0 255 ECU_ADDRESS 0xfe4a5054 /* @ECU_Address@autosar_swc_aeb_rtARID_DEF.ARID_DEF_MATLABFunction10.Active_Sts@ */ /end MEASUREMENT
/begin MEASUREMENT autosar_swc_aeb_rtARID_DEF.ARID_DEF_MATLABFunction10.Active_Time "" FLOAT32_IEEE autosar_swc_aeb_CM_single 0 0 -3.4E+38 3.4E+38 ECU_ADDRESS 0xfe4a5050 /* @ECU_Address@autosar_swc_aeb_rtARID_DEF.ARID_DEF_MATLABFunction10.Active_Time@ */ /end MEASUREMENT
/begin MEASUREMENT autosar_swc_aeb_rtARID_DEF.ARID_DEF_MATLABFunction11.Active_Sts "" UBYTE autosar_swc_aeb_CM_uint8 0 0 0 255 ECU_ADDRESS 0xfe4a4f1c /* @ECU_Address@autosar_swc_aeb_rtARID_DEF.ARID_DEF_MATLABFunction11.Active_Sts@ */ /end MEASUREMENT
/begin MEASUREMENT autosar_swc_aeb_rtARID_DEF.ARID_DEF_MATLABFunction11.Active_Time "" FLOAT32_IEEE autosar_swc_aeb_CM_single 0 0 -3.4E+38 3.4E+38 ECU_ADDRESS 0xfe4a4f18 /* @ECU_Address@autosar_swc_aeb_rtARID_DEF.ARID_DEF_MATLABFunction11.Active_Time@ */ /end MEASUREMENT
/begin MEASUREMENT autosar_swc_aeb_rtARID_DEF.ARID_DEF_MATLABFunction11_m.Active_Sts "" UBYTE autosar_swc_aeb_CM_uint8 0 0 0 255 ECU_ADDRESS 0xfe4a504c /* @ECU_Address@autosar_swc_aeb_rtARID_DEF.ARID_DEF_MATLABFunction11_m.Active_Sts@ */ /end MEASUREMENT
/begin COMPU_METHOD autosar_swc_aeb_CM_boolean "Q = V" IDENTICAL "%1.0" "" /end COMPU_METHOD
/begin COMPU_METHOD autosar_swc_aeb_CM_int8 "Q = V" IDENTICAL "%3.0" "" /end COMPU_METHOD
/begin COMPU_METHOD autosar_swc_aeb_CM_single "Q = V" IDENTICAL "%8.6" "" /end COMPU_METHOD
/begin COMPU_METHOD autosar_swc_aeb_CM_uint8 "Q = V" IDENTICAL "%3.0" "" /end COMPU_METHOD
/begin MEASUREMENT autosar_swc_val_rtARID_DEF.BusAssignment1.FCM_2_AbaLvl "" UBYTE autosar_swc_val_CM_FCM_2_AbaLvl_325_dt 0 0 0 255 ECU_ADDRESS 0xfe4cc751 /* @ECU_Address@autosar_swc_val_rtARID_DEF.BusAssignment1.FCM_2_AbaLvl@ */ /end MEASUREMENT
/begin MEASUREMENT autosar_swc_val_rtARID_DEF.BusAssignment1.FCM_2_AbaReq "" UBYTE autosar_swc_val_CM_FCM_2_AbaReq_325_dt 0 0 0 255 ECU_ADDRESS 0xfe4cc750 /* @ECU_Address@autosar_swc_val_rtARID_DEF.BusAssignment1.FCM_2_AbaReq@ */ /end MEASUREMENT
/begin MEASUREMENT autosar_swc_val_rtARID_DEF.BusAssignment1.FCM_2_AebReqTyp "" UBYTE autosar_swc_val_CM_FCM_2_AebReqTyp_325_dt 0 0 0 255 ECU_ADDRESS 0xfe4cc747 /* @ECU_Address@autosar_swc_val_rtARID_DEF.BusAssignment1.FCM_2_AebReqTyp@ */ /end MEASUREMENT
/begin MEASUREMENT autosar_swc_val_rtARID_DEF.BusAssignment1.FCM_2_AebTarDec "" FLOAT32_IEEE autosar_swc_val_CM_FCM_2_AebTarDec_325_dt 0 0 -3.4E+38 3.4E+38 ECU_ADDRESS 0xfe4cc748 /* @ECU_Address@autosar_swc_val_rtARID_DEF.BusAssignment1.FCM_2_AebTarDec@ */ /end MEASUREMENT
/begin MEASUREMENT autosar_swc_val_rtARID_DEF.BusAssignment1.FCM_2_AebTarDecVld "" UBYTE autosar_swc_val_CM_FCM_2_AebTarDecVld_325_dt 0 0 0 255 ECU_ADDRESS 0xfe4cc74c /* @ECU_Address@autosar_swc_val_rtARID_DEF.BusAssignment1.FCM_2_AebTarDecVld@ */ /end MEASUREMENT
/begin MEASUREMENT autosar_swc_val_rtARID_DEF.BusAssignment1.FCM_2_Avl "" UBYTE autosar_swc_val_CM_FCM_2_Avl_325_dt 0 0 0 255 ECU_ADDRESS 0xfe4cc752 /* @ECU_Address@autosar_swc_val_rtARID_DEF.BusAssignment1.FCM_2_Avl@ */ /end MEASUREMENT
/begin MEASUREMENT autosar_swc_val_rtARID_DEF.BusAssignment1.FCM_2_AwbLvl "" UBYTE autosar_swc_val_CM_FCM_2_AwbLvl_325_dt 0 0 0 255 ECU_ADDRESS 0xfe4cc74e /* @ECU_Address@autosar_swc_val_rtARID_DEF.BusAssignment1.FCM_2_AwbLvl@ */ /end MEASUREMENT
/begin MEASUREMENT autosar_swc_val_rtARID_DEF.BusAssignment1.FCM_2_AwbReq "" UBYTE autosar_swc_val_CM_FCM_2_AwbReq_325_dt 0 0 0 255 ECU_ADDRESS 0xfe4cc74d /* @ECU_Address@autosar_swc_val_rtARID_DEF.BusAssignment1.FCM_2_AwbReq@ */ /end MEASUREMENT
/begin MEASUREMENT autosar_swc_val_rtARID_DEF.BusAssignment1.FCM_2_BrkPreFillReq "" UBYTE autosar_swc_val_CM_FCM_2_BrkPreFillReq_325_dt 0 0 0 255 ECU_ADDRESS 0xfe4cc74f /* @ECU_Address@autosar_swc_val_rtARID_DEF.BusAssignment1.FCM_2_BrkPreFillReq@ */ /end MEASUREMENT
/begin MEASUREMENT autosar_swc_val_rtARID_DEF.BusAssignment1.FCM_2_CRC1 "" UBYTE autosar_swc_val_CM_FCM_2_CRC1_325_dt 0 0 0 255 ECU_ADDRESS 0xfe4cc744 /* @ECU_Address@autosar_swc_val_rtARID_DEF.BusAssignment1.FCM_2_CRC1@ */ /end MEASUREMENT
/begin MEASUREMENT autosar_swc_val_rtARID_DEF.BusAssignment1.FCM_2_Resd1 "" UBYTE autosar_swc_val_CM_FCM_2_Resd1_325_dt 0 0 0 255 ECU_ADDRESS 0xfe4cc746 /* @ECU_Address@autosar_swc_val_rtARID_DEF.BusAssignment1.FCM_2_Resd1@ */ /end MEASUREMENT
/begin MEASUREMENT autosar_swc_val_rtARID_DEF.BusAssignment1.FCM_2_RollgCntr1 "" UBYTE autosar_swc_val_CM_FCM_2_RollgCntr1_325_dt 0 0 0 255 ECU_ADDRESS 0xfe4cc745 /* @ECU_Address@autosar_swc_val_rtARID_DEF.BusAssignment1.FCM_2_RollgCntr1@ */ /end MEASUREMENT
/begin MEASUREMENT autosar_swc_val_rtARID_DEF.BusAssignment2.CutOutFreshvalues_2CB_S "" UWORD autosar_swc_val_CM_CutOutFreshvalues_2CB_S_330_dt 0 0 0 65535 ECU_ADDRESS 0xfe4cc5f8 /* @ECU_Address@autosar_swc_val_rtARID_DEF.BusAssignment2.CutOutFreshvalues_2CB_S@ */ /end MEASUREMENT
/begin MEASUREMENT autosar_swc_val_rtARID_DEF.BusAssignment2.CutOutMAC_2CB_S "" A_UINT64 autosar_swc_val_CM_CutOutMAC_2CB_S_330_dt 0 0 0.0 1.844674407370955e+19 ECU_ADDRESS 0xfe4cc600 /* @ECU_Address@autosar_swc_val_rtARID_DEF.BusAssignment2.CutOutMAC_2CB_S@ */ /end MEASUREMENT
/begin MEASUREMENT autosar_swc_val_rtARID_DEF.BusAssignment2.FCM_3_CRC1 "" UBYTE autosar_swc_val_CM_FCM_3_CRC1_330_dt 0 0 0 255 ECU_ADDRESS 0xfe4cc5e8 /* @ECU_Address@autosar_swc_val_rtARID_DEF.BusAssignment2.FCM_3_CRC1@ */ /end MEASUREMENT
/begin MEASUREMENT autosar_swc_val_rtARID_DEF.BusAssignment2.FCM_3_PilotBrkDecTarReq "" UBYTE autosar_swc_val_CM_FCM_3_PilotBrkDecTarReq_330_dt 0 0 0 255 ECU_ADDRESS 0xfe4cc5f5 /* @ECU_Address@autosar_swc_val_rtARID_DEF.BusAssignment2.FCM_3_PilotBrkDecTarReq@ */ /end MEASUREMENT
/begin MEASUREMENT autosar_swc_val_rtARID_DEF.BusAssignment2.FCM_3_PilotBrkDecTarVld "" UBYTE autosar_swc_val_CM_FCM_3_PilotBrkDecTarVld_330_dt 0 0 0 255 ECU_ADDRESS 0xfe4cc5f4 /* @ECU_Address@autosar_swc_val_rtARID_DEF.BusAssignment2.FCM_3_PilotBrkDecTarVld@ */ /end MEASUREMENT
/begin MEASUREMENT autosar_swc_val_rtARID_DEF.BusAssignment2.FCM_3_PilotCtrlType "" UBYTE autosar_swc_val_CM_FCM_3_PilotCtrlType_330_dt 0 0 0 255 ECU_ADDRESS 0xfe4cc5ec /* @ECU_Address@autosar_swc_val_rtARID_DEF.BusAssignment2.FCM_3_PilotCtrlType@ */ /end MEASUREMENT
/begin MEASUREMENT autosar_swc_val_rtARID_DEF.BusAssignment2.FCM_3_PilotDec2StpReq "" UBYTE autosar_swc_val_CM_FCM_3_PilotDec2StpReq_330_dt 0 0 0 255 ECU_ADDRESS 0xfe4cc5f6 /* @ECU_Address@autosar_swc_val_rtARID_DEF.BusAssignment2.FCM_3_PilotDec2StpReq@ */ /end MEASUREMENT
/begin MEASUREMENT autosar_swc_val_rtARID_DEF.BusAssignment2.FCM_3_PilotDriOffReq "" UBYTE autosar_swc_val_CM_FCM_3_PilotDriOffReq_330_dt 0 0 0 255 ECU_ADDRESS 0xfe4cc5f7 /* @ECU_Address@autosar_swc_val_rtARID_DEF.BusAssignment2.FCM_3_PilotDriOffReq@ */ /end MEASUREMENT
/begin MEASUREMENT autosar_swc_val_rtARID_DEF.BusAssignment2.FCM_3_PilotParkCtrlRepSta "" UBYTE autosar_swc_val_CM_FCM_3_PilotParkCtrlRepSta_330_dt 0 0 0 255 ECU_ADDRESS 0xfe4cc5eb /* @ECU_Address@autosar_swc_val_rtARID_DEF.BusAssignment2.FCM_3_PilotParkCtrlRepSta@ */ /end MEASUREMENT
/begin MEASUREMENT autosar_swc_val_rtARID_DEF.BusAssignment2.FCM_3_PilotkBrkDecTar "" FLOAT32_IEEE autosar_swc_val_CM_FCM_3_PilotkBrkDecTar_330_dt 0 0 -3.4E+38 3.4E+38 ECU_ADDRESS 0xfe4cc5f0 /* @ECU_Address@autosar_swc_val_rtARID_DEF.BusAssignment2.FCM_3_PilotkBrkDecTar@ */ /end MEASUREMENT
/begin MEASUREMENT autosar_swc_val_rtARID_DEF.BusAssignment2.FCM_3_Resd1 "" UBYTE autosar_swc_val_CM_FCM_3_Resd1_330_dt 0 0 0 255 ECU_ADDRESS 0xfe4cc5ea /* @ECU_Address@autosar_swc_val_rtARID_DEF.BusAssignment2.FCM_3_Resd1@ */ /end MEASUREMENT
/begin MEASUREMENT autosar_swc_val_rtARID_DEF.BusAssignment2.FCM_3_RollgCntr1 "" UBYTE autosar_swc_val_CM_FCM_3_RollgCntr1_330_dt 0 0 0 255 ECU_ADDRESS 0xfe4cc5e9 /* @ECU_Address@autosar_swc_val_rtARID_DEF.BusAssignment2.FCM_3_RollgCntr1@ */ /end MEASUREMENT
/begin MEASUREMENT autosar_swc_val_rtARID_DEF.BusAssignment3.ADS_1_ADCCAvl "" UBYTE autosar_swc_val_CM_ADS_1_ADCCAvl_359_dt 0 0 0 255 ECU_ADDRESS 0xfe4cc6a8 /* @ECU_Address@autosar_swc_val_rtARID_DEF.BusAssignment3.ADS_1_ADCCAvl@ */ /end MEASUREMENT
/begin MEASUREMENT autosar_swc_val_rtARID_DEF.BusAssignment3.ADS_1_AMAPRequest "" UBYTE autosar_swc_val_CM_ADS_1_AMAPRequest_359_dt 0 0 0 255 ECU_ADDRESS 0xfe4cc6a6 /* @ECU_Address@autosar_swc_val_rtARID_DEF.BusAssignment3.ADS_1_AMAPRequest@ */ /end MEASUREMENT
/begin MEASUREMENT autosar_swc_val_rtARID_DEF.BusAssignment3.ADS_1_AMAPRequestVld "" UBYTE autosar_swc_val_CM_ADS_1_AMAPRequestVld_359_dt 0 0 0 255 ECU_ADDRESS 0xfe4cc6a7 /* @ECU_Address@autosar_swc_val_rtARID_DEF.BusAssignment3.ADS_1_AMAPRequestVld@ */ /end MEASUREMENT
/begin MEASUREMENT autosar_swc_val_rtARID_DEF.BusAssignment3.ADS_1_AMAPTqLimit "" UWORD autosar_swc_val_CM_ADS_1_AMAPTqLimit_359_dt 0 0 0 65535 ECU_ADDRESS 0xfe4cc6aa /* @ECU_Address@autosar_swc_val_rtARID_DEF.BusAssignment3.ADS_1_AMAPTqLimit@ */ /end MEASUREMENT
/begin MEASUREMENT autosar_swc_val_rtARID_DEF.BusAssignment3.ADS_1_AMAPTqLimitVld "" UBYTE autosar_swc_val_CM_ADS_1_AMAPTqLimitVld_359_dt 0 0 0 255 ECU_ADDRESS 0xfe4cc6ac /* @ECU_Address@autosar_swc_val_rtARID_DEF.BusAssignment3.ADS_1_AMAPTqLimitVld@ */ /end MEASUREMENT
/begin MEASUREMENT autosar_swc_val_rtARID_DEF.BusAssignment3.ADS_1_CRC1 "" UBYTE autosar_swc_val_CM_ADS_1_CRC1_359_dt 0 0 0 255 ECU_ADDRESS 0xfe4cc69c /* @ECU_Address@autosar_swc_val_rtARID_DEF.BusAssignment3.ADS_1_CRC1@ */ /end MEASUREMENT
/begin MEASUREMENT autosar_swc_val_rtARID_DEF.BusAssignment3.ADS_1_CRC2 "" UBYTE autosar_swc_val_CM_ADS_1_CRC2_359_dt 0 0 0 255 ECU_ADDRESS 0xfe4cc6ad /* @ECU_Address@autosar_swc_val_rtARID_DEF.BusAssignment3.ADS_1_CRC2@ */ /end MEASUREMENT
/begin MEASUREMENT autosar_swc_val_rtARID_DEF.BusAssignment3.ADS_1_CtrlReqMod "" UBYTE autosar_swc_val_CM_ADS_1_CtrlReqMod_359_dt 0 0 0 255 ECU_ADDRESS 0xfe4cc6a4 /* @ECU_Address@autosar_swc_val_rtARID_DEF.BusAssignment3.ADS_1_CtrlReqMod@ */ /end MEASUREMENT
/begin MEASUREMENT autosar_swc_val_rtARID_DEF.BusAssignment3.ADS_1_DrvCtrlReq "" UBYTE autosar_swc_val_CM_ADS_1_DrvCtrlReq_359_dt 0 0 0 255 ECU_ADDRESS 0xfe4cc6a3 /* @ECU_Address@autosar_swc_val_rtARID_DEF.BusAssignment3.ADS_1_DrvCtrlReq@ */ /end MEASUREMENT
/begin MEASUREMENT autosar_swc_val_rtARID_DEF.BusAssignment3.ADS_1_DrvTarTq "" UWORD autosar_swc_val_CM_ADS_1_DrvTarTq_359_dt 0 0 0 65535 ECU_ADDRESS 0xfe4cc6a0 /* @ECU_Address@autosar_swc_val_rtARID_DEF.BusAssignment3.ADS_1_DrvTarTq@ */ /end MEASUREMENT
/begin MEASUREMENT autosar_swc_val_rtARID_DEF.BusAssignment3.ADS_1_DrvTarTqEnable "" UBYTE autosar_swc_val_CM_ADS_1_DrvTarTqEnable_359_dt 0 0 0 255 ECU_ADDRESS 0xfe4cc6a5 /* @ECU_Address@autosar_swc_val_rtARID_DEF.BusAssignment3.ADS_1_DrvTarTqEnable@ */ /end MEASUREMENT
/begin MEASUREMENT autosar_swc_val_rtARID_DEF.BusAssignment3.ADS_1_DrvTarTqVld "" UBYTE autosar_swc_val_CM_ADS_1_DrvTarTqVld_359_dt 0 0 0 255 ECU_ADDRESS 0xfe4cc6a2 /* @ECU_Address@autosar_swc_val_rtARID_DEF.BusAssignment3.ADS_1_DrvTarTqVld@ */ /end MEASUREMENT
/begin MEASUREMENT autosar_swc_val_rtARID_DEF.BusAssignment3.ADS_1_GearCtrlEnable "" UBYTE autosar_swc_val_CM_ADS_1_GearCtrlEnable_359_dt 0 0 0 255 ECU_ADDRESS 0xfe4cc6b2 /* @ECU_Address@autosar_swc_val_rtARID_DEF.BusAssignment3.ADS_1_GearCtrlEnable@ */ /end MEASUREMENT
/begin MEASUREMENT autosar_swc_val_rtARID_DEF.BusAssignment3.ADS_1_Resd1 "" UBYTE autosar_swc_val_CM_ADS_1_Resd1_359_dt 0 0 0 255 ECU_ADDRESS 0xfe4cc69e /* @ECU_Address@autosar_swc_val_rtARID_DEF.BusAssignment3.ADS_1_Resd1@ */ /end MEASUREMENT
/begin MEASUREMENT autosar_swc_val_rtARID_DEF.BusAssignment3.ADS_1_Resd2 "" UBYTE autosar_swc_val_CM_ADS_1_Resd2_359_dt 0 0 0 255 ECU_ADDRESS 0xfe4cc6af /* @ECU_Address@autosar_swc_val_rtARID_DEF.BusAssignment3.ADS_1_Resd2@ */ /end MEASUREMENT
/begin MEASUREMENT autosar_swc_val_rtARID_DEF.BusAssignment3.ADS_1_RollgCntr1 "" UBYTE autosar_swc_val_CM_ADS_1_RollgCntr1_359_dt 0 0 0 255 ECU_ADDRESS 0xfe4cc69d /* @ECU_Address@autosar_swc_val_rtARID_DEF.BusAssignment3.ADS_1_RollgCntr1@ */ /end MEASUREMENT
/begin MEASUREMENT autosar_swc_val_rtARID_DEF.BusAssignment3.ADS_1_RollgCntr2 "" UBYTE autosar_swc_val_CM_ADS_1_RollgCntr2_359_dt 0 0 0 255 ECU_ADDRESS 0xfe4cc6ae /* @ECU_Address@autosar_swc_val_rtARID_DEF.BusAssignment3.ADS_1_RollgCntr2@ */ /end MEASUREMENT
/begin MEASUREMENT autosar_swc_val_rtARID_DEF.BusAssignment3.ADS_1_RpaPTReadyReq "" UBYTE autosar_swc_val_CM_ADS_1_RpaPTReadyReq_359_dt 0 0 0 255 ECU_ADDRESS 0xfe4cc6b3 /* @ECU_Address@autosar_swc_val_rtARID_DEF.BusAssignment3.ADS_1_RpaPTReadyReq@ */ /end MEASUREMENT
/begin MEASUREMENT autosar_swc_val_rtARID_DEF.BusAssignment3.ADS_1_TarGearReq "" UBYTE autosar_swc_val_CM_ADS_1_TarGearReq_359_dt 0 0 0 255 ECU_ADDRESS 0xfe4cc6b0 /* @ECU_Address@autosar_swc_val_rtARID_DEF.BusAssignment3.ADS_1_TarGearReq@ */ /end MEASUREMENT
/begin MEASUREMENT autosar_swc_val_rtARID_DEF.BusAssignment3.ADS_1_TarGearReqVld "" UBYTE autosar_swc_val_CM_ADS_1_TarGearReqVld_359_dt 0 0 0 255 ECU_ADDRESS 0xfe4cc6b1 /* @ECU_Address@autosar_swc_val_rtARID_DEF.BusAssignment3.ADS_1_TarGearReqVld@ */ /end MEASUREMENT
/begin MEASUREMENT autosar_swc_val_rtARID_DEF.BusAssignment4.isAEBFrbdnAct "" UBYTE autosar_swc_val_CM_logical 0 0 0 1 ECU_ADDRESS 0xfe4cc7bb /* @ECU_Address@autosar_swc_val_rtARID_DEF.BusAssignment4.isAEBFrbdnAct@ */ /end MEASUREMENT
/begin MEASUREMENT autosar_swc_val_rtARID_DEF.BusAssignment4.isLatFrbdnAct "" UBYTE autosar_swc_val_CM_logical 0 0 0 1 ECU_ADDRESS 0xfe4cc7b8 /* @ECU_Address@autosar_swc_val_rtARID_DEF.BusAssignment4.isLatFrbdnAct@ */ /end MEASUREMENT
/begin MEASUREMENT autosar_swc_val_rtARID_DEF.BusAssignment4.isLgtNegFrbdnAct "" UBYTE autosar_swc_val_CM_logical 0 0 0 1 ECU_ADDRESS 0xfe4cc7ba /* @ECU_Address@autosar_swc_val_rtARID_DEF.BusAssignment4.isLgtNegFrbdnAct@ */ /end MEASUREMENT
/begin MEASUREMENT autosar_swc_val_rtARID_DEF.BusAssignment4.isLgtPosFrbdnAct "" UBYTE autosar_swc_val_CM_logical 0 0 0 1 ECU_ADDRESS 0xfe4cc7b9 /* @ECU_Address@autosar_swc_val_rtARID_DEF.BusAssignment4.isLgtPosFrbdnAct@ */ /end MEASUREMENT
/begin MEASUREMENT autosar_swc_val_rtARID_DEF.SignalCopy4.CutOutFreshvalues_2CB_S "" UWORD autosar_swc_val_CM_CutOutFreshvalues_2CB_S_330_dt 0 0 0 65535 ECU_ADDRESS 0xfe4cc5d8 /* @ECU_Address@autosar_swc_val_rtARID_DEF.SignalCopy4.CutOutFreshvalues_2CB_S@ */ /end MEASUREMENT
/begin MEASUREMENT autosar_swc_val_rtARID_DEF.SignalCopy4.CutOutMAC_2CB_S "" A_UINT64 autosar_swc_val_CM_CutOutMAC_2CB_S_330_dt 0 0 0.0 1.844674407370955e+19 ECU_ADDRESS 0xfe4cc5e0 /* @ECU_Address@autosar_swc_val_rtARID_DEF.SignalCopy4.CutOutMAC_2CB_S@ */ /end MEASUREMENT
/begin MEASUREMENT autosar_swc_val_rtARID_DEF.SignalCopy4.FCM_3_CRC1 "" UBYTE autosar_swc_val_CM_FCM_3_CRC1_330_dt 0 0 0 255 ECU_ADDRESS 0xfe4cc5c8 /* @ECU_Address@autosar_swc_val_rtARID_DEF.SignalCopy4.FCM_3_CRC1@ */ /end MEASUREMENT
/begin MEASUREMENT autosar_swc_val_rtARID_DEF.SignalCopy4.FCM_3_PilotBrkDecTarReq "" UBYTE autosar_swc_val_CM_FCM_3_PilotBrkDecTarReq_330_dt 0 0 0 255 ECU_ADDRESS 0xfe4cc5d5 /* @ECU_Address@autosar_swc_val_rtARID_DEF.SignalCopy4.FCM_3_PilotBrkDecTarReq@ */ /end MEASUREMENT
/begin MEASUREMENT autosar_swc_val_rtARID_DEF.SignalCopy4.FCM_3_PilotBrkDecTarVld "" UBYTE autosar_swc_val_CM_FCM_3_PilotBrkDecTarVld_330_dt 0 0 0 255 ECU_ADDRESS 0xfe4cc5d4 /* @ECU_Address@autosar_swc_val_rtARID_DEF.SignalCopy4.FCM_3_PilotBrkDecTarVld@ */ /end MEASUREMENT
/begin MEASUREMENT autosar_swc_val_rtARID_DEF.SignalCopy4.FCM_3_PilotCtrlType "" UBYTE autosar_swc_val_CM_FCM_3_PilotCtrlType_330_dt 0 0 0 255 ECU_ADDRESS 0xfe4cc5cc /* @ECU_Address@autosar_swc_val_rtARID_DEF.SignalCopy4.FCM_3_PilotCtrlType@ */ /end MEASUREMENT
/begin MEASUREMENT autosar_swc_val_rtARID_DEF.SignalCopy4.FCM_3_PilotDec2StpReq "" UBYTE autosar_swc_val_CM_FCM_3_PilotDec2StpReq_330_dt 0 0 0 255 ECU_ADDRESS 0xfe4cc5d6 /* @ECU_Address@autosar_swc_val_rtARID_DEF.SignalCopy4.FCM_3_PilotDec2StpReq@ */ /end MEASUREMENT
/begin MEASUREMENT autosar_swc_val_rtARID_DEF.SignalCopy4.FCM_3_PilotDriOffReq "" UBYTE autosar_swc_val_CM_FCM_3_PilotDriOffReq_330_dt 0 0 0 255 ECU_ADDRESS 0xfe4cc5d7 /* @ECU_Address@autosar_swc_val_rtARID_DEF.SignalCopy4.FCM_3_PilotDriOffReq@ */ /end MEASUREMENT
/begin MEASUREMENT autosar_swc_val_rtARID_DEF.SignalCopy4.FCM_3_PilotParkCtrlRepSta "" UBYTE autosar_swc_val_CM_FCM_3_PilotParkCtrlRepSta_330_dt 0 0 0 255 ECU_ADDRESS 0xfe4cc5cb /* @ECU_Address@autosar_swc_val_rtARID_DEF.SignalCopy4.FCM_3_PilotParkCtrlRepSta@ */ /end MEASUREMENT
/begin MEASUREMENT autosar_swc_val_rtARID_DEF.SignalCopy4.FCM_3_PilotkBrkDecTar "" FLOAT32_IEEE autosar_swc_val_CM_FCM_3_PilotkBrkDecTar_330_dt 0 0 -3.4E+38 3.4E+38 ECU_ADDRESS 0xfe4cc5d0 /* @ECU_Address@autosar_swc_val_rtARID_DEF.SignalCopy4.FCM_3_PilotkBrkDecTar@ */ /end MEASUREMENT
/begin MEASUREMENT autosar_swc_val_rtARID_DEF.SignalCopy4.FCM_3_Resd1 "" UBYTE autosar_swc_val_CM_FCM_3_Resd1_330_dt 0 0 0 255 ECU_ADDRESS 0xfe4cc5ca /* @ECU_Address@autosar_swc_val_rtARID_DEF.SignalCopy4.FCM_3_Resd1@ */ /end MEASUREMENT
/begin MEASUREMENT autosar_swc_val_rtARID_DEF.SignalCopy4.FCM_3_RollgCntr1 "" UBYTE autosar_swc_val_CM_FCM_3_RollgCntr1_330_dt 0 0 0 255 ECU_ADDRESS 0xfe4cc5c9 /* @ECU_Address@autosar_swc_val_rtARID_DEF.SignalCopy4.FCM_3_RollgCntr1@ */ /end MEASUREMENT
/begin MEASUREMENT autosar_swc_val_rtARID_DEF.TmpSignalConversionAtAEB_BRKINFO_AEB_BRKINFOOutport1.AEBDecCtrlReqest "" UBYTE autosar_swc_val_CM_uint8 0 0 0 255 ECU_ADDRESS 0xfe4cc688 /* @ECU_Address@autosar_swc_val_rtARID_DEF.TmpSignalConversionAtAEB_BRKINFO_AEB_BRKINFOOutport1.AEBDecCtrlReqest@ */ /end MEASUREMENT
/begin MEASUREMENT autosar_swc_val_rtARID_DEF.TmpSignalConversionAtAEB_BRKINFO_AEB_BRKINFOOutport1.AEBMode "" UBYTE autosar_swc_val_CM_uint8 0 0 0 255 ECU_ADDRESS 0xfe4cc691 /* @ECU_Address@autosar_swc_val_rtARID_DEF.TmpSignalConversionAtAEB_BRKINFO_AEB_BRKINFOOutport1.AEBMode@ */ /end MEASUREMENT
/begin MEASUREMENT autosar_swc_val_rtARID_DEF.TmpSignalConversionAtAEB_BRKINFO_AEB_BRKINFOOutport1.AEBReq "" UBYTE autosar_swc_val_CM_uint8 0 0 0 255 ECU_ADDRESS 0xfe4cc689 /* @ECU_Address@autosar_swc_val_rtARID_DEF.TmpSignalConversionAtAEB_BRKINFO_AEB_BRKINFOOutport1.AEBReq@ */ /end MEASUREMENT
/begin MEASUREMENT autosar_swc_val_rtARID_DEF.TmpSignalConversionAtAEB_BRKINFO_AEB_BRKINFOOutport1.AEBTarDec "" FLOAT32_IEEE autosar_swc_val_CM_single 0 0 -3.4E+38 3.4E+38 ECU_ADDRESS 0xfe4cc698 /* @ECU_Address@autosar_swc_val_rtARID_DEF.TmpSignalConversionAtAEB_BRKINFO_AEB_BRKINFOOutport1.AEBTarDec@ */ /end MEASUREMENT
/begin MEASUREMENT autosar_swc_val_rtARID_DEF.TmpSignalConversionAtAEB_BRKINFO_AEB_BRKINFOOutport1.AWBLevel "" UBYTE autosar_swc_val_CM_uint8 0 0 0 255 ECU_ADDRESS 0xfe4cc68c /* @ECU_Address@autosar_swc_val_rtARID_DEF.TmpSignalConversionAtAEB_BRKINFO_AEB_BRKINFOOutport1.AWBLevel@ */ /end MEASUREMENT
/begin MEASUREMENT autosar_swc_val_rtARID_DEF.TmpSignalConversionAtAEB_BRKINFO_AEB_BRKINFOOutport1.AWBRequest "" UBYTE autosar_swc_val_CM_uint8 0 0 0 255 ECU_ADDRESS 0xfe4cc68b /* @ECU_Address@autosar_swc_val_rtARID_DEF.TmpSignalConversionAtAEB_BRKINFO_AEB_BRKINFOOutport1.AWBRequest@ */ /end MEASUREMENT
/begin MEASUREMENT autosar_swc_val_rtARID_DEF.TmpSignalConversionAtAEB_BRKINFO_AEB_BRKINFOOutport1.DWReq "" UBYTE autosar_swc_val_CM_uint8 0 0 0 255 ECU_ADDRESS 0xfe4cc68a /* @ECU_Address@autosar_swc_val_rtARID_DEF.TmpSignalConversionAtAEB_BRKINFO_AEB_BRKINFOOutport1.DWReq@ */ /end MEASUREMENT
/begin MEASUREMENT autosar_swc_val_rtARID_DEF.TmpSignalConversionAtAEB_BRKINFO_AEB_BRKINFOOutport1.FCTBMode "" UBYTE autosar_swc_val_CM_uint8 0 0 0 255 ECU_ADDRESS 0xfe4cc692 /* @ECU_Address@autosar_swc_val_rtARID_DEF.TmpSignalConversionAtAEB_BRKINFO_AEB_BRKINFOOutport1.FCTBMode@ */ /end MEASUREMENT
/begin MEASUREMENT autosar_swc_val_rtARID_DEF.TmpSignalConversionAtAEB_BRKINFO_AEB_BRKINFOOutport1.FCWMode "" UBYTE autosar_swc_val_CM_uint8 0 0 0 255 ECU_ADDRESS 0xfe4cc690 /* @ECU_Address@autosar_swc_val_rtARID_DEF.TmpSignalConversionAtAEB_BRKINFO_AEB_BRKINFOOutport1.FCWMode@ */ /end MEASUREMENT
/begin MEASUREMENT autosar_swc_val_rtARID_DEF.TmpSignalConversionAtAEB_BRKINFO_AEB_BRKINFOOutport1.HBAlevel "" UBYTE autosar_swc_val_CM_uint8 0 0 0 255 ECU_ADDRESS 0xfe4cc68e /* @ECU_Address@autosar_swc_val_rtARID_DEF.TmpSignalConversionAtAEB_BRKINFO_AEB_BRKINFOOutport1.HBAlevel@ */ /end MEASUREMENT
/begin MEASUREMENT autosar_swc_val_rtARID_DEF.TmpSignalConversionAtAEB_BRKINFO_AEB_BRKINFOOutport1.HBArequest "" UBYTE autosar_swc_val_CM_uint8 0 0 0 255 ECU_ADDRESS 0xfe4cc68f /* @ECU_Address@autosar_swc_val_rtARID_DEF.TmpSignalConversionAtAEB_BRKINFO_AEB_BRKINFOOutport1.HBArequest@ */ /end MEASUREMENT
/begin MEASUREMENT autosar_swc_val_rtARID_DEF.TmpSignalConversionAtAEB_BRKINFO_AEB_BRKINFOOutport1.HazdLmpReq "" UBYTE autosar_swc_val_CM_uint8 0 0 0 255 ECU_ADDRESS 0xfe4cc693 /* @ECU_Address@autosar_swc_val_rtARID_DEF.TmpSignalConversionAtAEB_BRKINFO_AEB_BRKINFOOutport1.HazdLmpReq@ */ /end MEASUREMENT
/begin MEASUREMENT autosar_swc_val_rtARID_DEF.TmpSignalConversionAtAEB_BRKINFO_AEB_BRKINFOOutport1.PrefillRequest "" UBYTE autosar_swc_val_CM_uint8 0 0 0 255 ECU_ADDRESS 0xfe4cc68d /* @ECU_Address@autosar_swc_val_rtARID_DEF.TmpSignalConversionAtAEB_BRKINFO_AEB_BRKINFOOutport1.PrefillRequest@ */ /end MEASUREMENT
/begin MEASUREMENT autosar_swc_val_rtARID_DEF.TmpSignalConversionAtAEB_BRKINFO_AEB_BRKINFOOutport1.TextInfo "" UBYTE autosar_swc_val_CM_uint8 0 0 0 255 ECU_ADDRESS 0xfe4cc694 /* @ECU_Address@autosar_swc_val_rtARID_DEF.TmpSignalConversionAtAEB_BRKINFO_AEB_BRKINFOOutport1.TextInfo@ */ /end MEASUREMENT
/begin MEASUREMENT autosar_swc_val_rtARID_DEF.TmpSignalConversionAtAEB_BRKINFO_AEB_BRKINFOOutport1.TextinfoWarn "" UBYTE autosar_swc_val_CM_uint8 0 0 0 255 ECU_ADDRESS 0xfe4cc695 /* @ECU_Address@autosar_swc_val_rtARID_DEF.TmpSignalConversionAtAEB_BRKINFO_AEB_BRKINFOOutport1.TextinfoWarn@ */ /end MEASUREMENT
/begin MEASUREMENT autosar_swc_val_rtARID_DEF.TmpSignalConversionAtFM_SAF_OUT_FM_SAF_OUTOutport1.SftyCmd "" ULONG autosar_swc_val_CM_uint32 0 0 0 4294967295 ECU_ADDRESS 0xfe4cc07c /* @ECU_Address@autosar_swc_val_rtARID_DEF.TmpSignalConversionAtFM_SAF_OUT_FM_SAF_OUTOutport1.SftyCmd@ */ /end MEASUREMENT
/begin MEASUREMENT autosar_swc_val_rtARID_DEF.TmpSignalConversionAtFM_SAF_OUT_FM_SAF_OUTOutport1.SftyErrInfo.SftyErr_0 "" ULONG autosar_swc_val_CM_uint32 0 0 0 4294967295 ECU_ADDRESS 0xfe4cc08c /* @ECU_Address@autosar_swc_val_rtARID_DEF.TmpSignalConversionAtFM_SAF_OUT_FM_SAF_OUTOutport1.SftyErrInfo.SftyErr_0@ */ /end MEASUREMENT
/begin MEASUREMENT autosar_swc_val_rtARID_DEF.TmpSignalConversionAtFM_SAF_OUT_FM_SAF_OUTOutport1.SftyErrInfo.SftyErr_1 "" ULONG autosar_swc_val_CM_uint32 0 0 0 4294967295 ECU_ADDRESS 0xfe4cc090 /* @ECU_Address@autosar_swc_val_rtARID_DEF.TmpSignalConversionAtFM_SAF_OUT_FM_SAF_OUTOutport1.SftyErrInfo.SftyErr_1@ */ /end MEASUREMENT
/begin MEASUREMENT autosar_swc_val_rtARID_DEF.TmpSignalConversionAtFM_SAF_OUT_FM_SAF_OUTOutport1.SftyErrInfo.SftyErr_2 "" ULONG autosar_swc_val_CM_uint32 0 0 0 4294967295 ECU_ADDRESS 0xfe4cc094 /* @ECU_Address@autosar_swc_val_rtARID_DEF.TmpSignalConversionAtFM_SAF_OUT_FM_SAF_OUTOutport1.SftyErrInfo.SftyErr_2@ */ /end MEASUREMENT
/begin MEASUREMENT autosar_swc_val_rtARID_DEF.TmpSignalConversionAtFM_SAF_OUT_FM_SAF_OUTOutport1.SftyErrInfo.SftyErr_3 "" ULONG autosar_swc_val_CM_uint32 0 0 0 4294967295 ECU_ADDRESS 0xfe4cc098 /* @ECU_Address@autosar_swc_val_rtARID_DEF.TmpSignalConversionAtFM_SAF_OUT_FM_SAF_OUTOutport1.SftyErrInfo.SftyErr_3@ */ /end MEASUREMENT
/begin MEASUREMENT autosar_swc_val_rtARID_DEF.TmpSignalConversionAtFM_SAF_OUT_FM_SAF_OUTOutport1.SftyErrInfo.SftyErr_4 "" ULONG autosar_swc_val_CM_uint32 0 0 0 4294967295 ECU_ADDRESS 0xfe4cc09c /* @ECU_Address@autosar_swc_val_rtARID_DEF.TmpSignalConversionAtFM_SAF_OUT_FM_SAF_OUTOutport1.SftyErrInfo.SftyErr_4@ */ /end MEASUREMENT
/begin MEASUREMENT autosar_swc_val_rtARID_DEF.TmpSignalConversionAtFM_SAF_OUT_FM_SAF_OUTOutport1.SftyErrInfo.SftyErr_5 "" ULONG autosar_swc_val_CM_uint32 0 0 0 4294967295 ECU_ADDRESS 0xfe4cc0a0 /* @ECU_Address@autosar_swc_val_rtARID_DEF.TmpSignalConversionAtFM_SAF_OUT_FM_SAF_OUTOutport1.SftyErrInfo.SftyErr_5@ */ /end MEASUREMENT
/begin MEASUREMENT autosar_swc_val_rtARID_DEF.TmpSignalConversionAtFM_SAF_OUT_FM_SAF_OUTOutport1.SftyErrInfo.SftyErr_6 "" ULONG autosar_swc_val_CM_uint32 0 0 0 4294967295 ECU_ADDRESS 0xfe4cc0a4 /* @ECU_Address@autosar_swc_val_rtARID_DEF.TmpSignalConversionAtFM_SAF_OUT_FM_SAF_OUTOutport1.SftyErrInfo.SftyErr_6@ */ /end MEASUREMENT
/begin MEASUREMENT autosar_swc_val_rtARID_DEF.TmpSignalConversionAtFM_SAF_OUT_FM_SAF_OUTOutport1.SftyErrInfo.SftyErr_7 "" ULONG autosar_swc_val_CM_uint32 0 0 0 4294967295 ECU_ADDRESS 0xfe4cc0a8 /* @ECU_Address@autosar_swc_val_rtARID_DEF.TmpSignalConversionAtFM_SAF_OUT_FM_SAF_OUTOutport1.SftyErrInfo.SftyErr_7@ */ /end MEASUREMENT
/begin MEASUREMENT autosar_swc_val_rtARID_DEF.TmpSignalConversionAtFM_SAF_OUT_FM_SAF_OUTOutport1.SftyErrInfo.SftyModeFuSa "" ULONG autosar_swc_val_CM_uint32 0 0 0 4294967295 ECU_ADDRESS 0xfe4cc088 /* @ECU_Address@autosar_swc_val_rtARID_DEF.TmpSignalConversionAtFM_SAF_OUT_FM_SAF_OUTOutport1.SftyErrInfo.SftyModeFuSa@ */ /end MEASUREMENT
/begin MEASUREMENT autosar_swc_val_rtARID_DEF.TmpSignalConversionAtFM_SAF_OUT_FM_SAF_OUTOutport1.SftyErrInfo.SftyVehSpdChassis "" FLOAT32_IEEE autosar_swc_val_CM_single 0 0 -3.4E+38 3.4E+38 ECU_ADDRESS 0xfe4cc084 /* @ECU_Address@autosar_swc_val_rtARID_DEF.TmpSignalConversionAtFM_SAF_OUT_FM_SAF_OUTOutport1.SftyErrInfo.SftyVehSpdChassis@ */ /end MEASUREMENT
/begin MEASUREMENT autosar_swc_val_rtARID_DEF.TmpSignalConversionAtFM_SAF_OUT_FM_SAF_OUTOutport1.SftyErrInfo.SftyVehSpdChassisVld "" UBYTE autosar_swc_val_CM_logical 0 0 0 1 ECU_ADDRESS 0xfe4cc080 /* @ECU_Address@autosar_swc_val_rtARID_DEF.TmpSignalConversionAtFM_SAF_OUT_FM_SAF_OUTOutport1.SftyErrInfo.SftyVehSpdChassisVld@ */ /end MEASUREMENT
/begin MEASUREMENT autosar_swc_val_rtARID_DEF.TmpSignalConversionAtFM_SAF_OUT_FM_SAF_OUTOutport1.SftyErrInfoQue[0].SftyErrID "" ULONG autosar_swc_val_CM_uint32 0 0 0 4294967295 ECU_ADDRESS 0xfe4cc0ac /* @ECU_Address@autosar_swc_val_rtARID_DEF.TmpSignalConversionAtFM_SAF_OUT_FM_SAF_OUTOutport1.SftyErrInfoQue[0].SftyErrID@ */ /end MEASUREMENT
/begin MEASUREMENT autosar_swc_val_rtARID_DEF.TmpSignalConversionAtFM_SAF_OUT_FM_SAF_OUTOutport1.SftyErrInfoQue[0].TrigTimeStamp "" ULONG autosar_swc_val_CM_uint32 0 0 0 4294967295 ECU_ADDRESS 0xfe4cc0b0 /* @ECU_Address@autosar_swc_val_rtARID_DEF.TmpSignalConversionAtFM_SAF_OUT_FM_SAF_OUTOutport1.SftyErrInfoQue[0].TrigTimeStamp@ */ /end MEASUREMENT
/begin MEASUREMENT autosar_swc_val_rtARID_DEF.TmpSignalConversionAtFM_SAF_OUT_FM_SAF_OUTOutport1.SftyErrLvl "" UBYTE autosar_swc_val_CM_uint8 0 0 0 255 ECU_ADDRESS 0xfe4cc078 /* @ECU_Address@autosar_swc_val_rtARID_DEF.TmpSignalConversionAtFM_SAF_OUT_FM_SAF_OUTOutport1.SftyErrLvl@ */ /end MEASUREMENT
/begin MEASUREMENT autosar_swc_val_rtARID_DEF.TmpSignalConversionAtIF_sysEPS_4_sysEPS_4Outport1.EPS_4_ADSMaxTq "" FLOAT32_IEEE autosar_swc_val_CM_EPS_4_ADSMaxTq_421_dt 0 0 -3.4E+38 3.4E+38 ECU_ADDRESS 0xfe4cc4bc /* @ECU_Address@autosar_swc_val_rtARID_DEF.TmpSignalConversionAtIF_sysEPS_4_sysEPS_4Outport1.EPS_4_ADSMaxTq@ */ /end MEASUREMENT
/begin MEASUREMENT autosar_swc_val_rtARID_DEF.TmpSignalConversionAtIF_sysEPS_4_sysEPS_4Outport1.EPS_4_ADSMinTq "" FLOAT32_IEEE autosar_swc_val_CM_EPS_4_ADSMinTq_421_dt 0 0 -3.4E+38 3.4E+38 ECU_ADDRESS 0xfe4cc4c0 /* @ECU_Address@autosar_swc_val_rtARID_DEF.TmpSignalConversionAtIF_sysEPS_4_sysEPS_4Outport1.EPS_4_ADSMinTq@ */ /end MEASUREMENT
/begin MEASUREMENT autosar_swc_val_rtARID_DEF.TmpSignalConversionAtIF_sysEPS_4_sysEPS_4Outport1.EPS_4_AgParkCtrlAvl "" UBYTE autosar_swc_val_CM_EPS_4_AgParkCtrlAvl_421_dt 0 0 0 255 ECU_ADDRESS 0xfe4cc48f /* @ECU_Address@autosar_swc_val_rtARID_DEF.TmpSignalConversionAtIF_sysEPS_4_sysEPS_4Outport1.EPS_4_AgParkCtrlAvl@ */ /end MEASUREMENT
/begin MEASUREMENT autosar_swc_val_rtARID_DEF.TmpSignalConversionAtIF_sysEPS_4_sysEPS_4Outport1.EPS_4_AgParkCtrlSts "" UBYTE autosar_swc_val_CM_EPS_4_AgParkCtrlSts_421_dt 0 0 0 255 ECU_ADDRESS 0xfe4cc496 /* @ECU_Address@autosar_swc_val_rtARID_DEF.TmpSignalConversionAtIF_sysEPS_4_sysEPS_4Outport1.EPS_4_AgParkCtrlSts@ */ /end MEASUREMENT
/begin MEASUREMENT autosar_swc_val_rtARID_DEF.TmpSignalConversionAtIF_sysEPS_4_sysEPS_4Outport1.EPS_4_AgPilotCtrlAvl "" UBYTE autosar_swc_val_CM_EPS_4_AgPilotCtrlAvl_421_dt 0 0 0 255 ECU_ADDRESS 0xfe4cc490 /* @ECU_Address@autosar_swc_val_rtARID_DEF.TmpSignalConversionAtIF_sysEPS_4_sysEPS_4Outport1.EPS_4_AgPilotCtrlAvl@ */ /end MEASUREMENT
/begin MEASUREMENT autosar_swc_val_rtARID_DEF.TmpSignalConversionAtIF_sysEPS_4_sysEPS_4Outport1.EPS_4_AgPilotCtrlSts "" UBYTE autosar_swc_val_CM_EPS_4_AgPilotCtrlSts_421_dt 0 0 0 255 ECU_ADDRESS 0xfe4cc491 /* @ECU_Address@autosar_swc_val_rtARID_DEF.TmpSignalConversionAtIF_sysEPS_4_sysEPS_4Outport1.EPS_4_AgPilotCtrlSts@ */ /end MEASUREMENT
/begin MEASUREMENT autosar_swc_val_rtARID_DEF.TmpSignalConversionAtIF_sysEPS_4_sysEPS_4Outport1.EPS_4_AsscMotCrtTq "" FLOAT32_IEEE autosar_swc_val_CM_EPS_4_AsscMotCrtTq_421_dt 0 0 -3.4E+38 3.4E+38 ECU_ADDRESS 0xfe4cc4a4 /* @ECU_Address@autosar_swc_val_rtARID_DEF.TmpSignalConversionAtIF_sysEPS_4_sysEPS_4Outport1.EPS_4_AsscMotCrtTq@ */ /end MEASUREMENT
/begin MEASUREMENT autosar_swc_val_rtARID_DEF.TmpSignalConversionAtIF_sysEPS_4_sysEPS_4Outport1.EPS_4_AsscMotCrtTqVld "" UBYTE autosar_swc_val_CM_EPS_4_AsscMotCrtTqVld_421_dt 0 0 0 255 ECU_ADDRESS 0xfe4cc4a8 /* @ECU_Address@autosar_swc_val_rtARID_DEF.TmpSignalConversionAtIF_sysEPS_4_sysEPS_4Outport1.EPS_4_AsscMotCrtTqVld@ */ /end MEASUREMENT
/begin MEASUREMENT autosar_swc_val_rtARID_DEF.TmpSignalConversionAtIF_sysEPS_4_sysEPS_4Outport1.EPS_4_CRC1 "" UBYTE autosar_swc_val_CM_EPS_4_CRC1_421_dt 0 0 0 255 ECU_ADDRESS 0xfe4cc48c /* @ECU_Address@autosar_swc_val_rtARID_DEF.TmpSignalConversionAtIF_sysEPS_4_sysEPS_4Outport1.EPS_4_CRC1@ */ /end MEASUREMENT
/begin MEASUREMENT autosar_swc_val_rtARID_DEF.TmpSignalConversionAtIF_sysEPS_4_sysEPS_4Outport1.EPS_4_CRC2 "" UBYTE autosar_swc_val_CM_EPS_4_CRC2_421_dt 0 0 0 255 ECU_ADDRESS 0xfe4cc497 /* @ECU_Address@autosar_swc_val_rtARID_DEF.TmpSignalConversionAtIF_sysEPS_4_sysEPS_4Outport1.EPS_4_CRC2@ */ /end MEASUREMENT
/begin MEASUREMENT autosar_swc_val_rtARID_DEF.TmpSignalConversionAtIF_sysEPS_4_sysEPS_4Outport1.EPS_4_CRC3 "" UBYTE autosar_swc_val_CM_EPS_4_CRC3_421_dt 0 0 0 255 ECU_ADDRESS 0xfe4cc4a9 /* @ECU_Address@autosar_swc_val_rtARID_DEF.TmpSignalConversionAtIF_sysEPS_4_sysEPS_4Outport1.EPS_4_CRC3@ */ /end MEASUREMENT
/begin MEASUREMENT autosar_swc_val_rtARID_DEF.TmpSignalConversionAtIF_sysEPS_4_sysEPS_4Outport1.EPS_4_CRC4 "" UBYTE autosar_swc_val_CM_EPS_4_CRC4_421_dt 0 0 0 255 ECU_ADDRESS 0xfe4cc4af /* @ECU_Address@autosar_swc_val_rtARID_DEF.TmpSignalConversionAtIF_sysEPS_4_sysEPS_4Outport1.EPS_4_CRC4@ */ /end MEASUREMENT
/begin MEASUREMENT autosar_swc_val_rtARID_DEF.TmpSignalConversionAtIF_sysEPS_4_sysEPS_4Outport1.EPS_4_CRC5 "" UBYTE autosar_swc_val_CM_EPS_4_CRC5_421_dt 0 0 0 255 ECU_ADDRESS 0xfe4cc4b8 /* @ECU_Address@autosar_swc_val_rtARID_DEF.TmpSignalConversionAtIF_sysEPS_4_sysEPS_4Outport1.EPS_4_CRC5@ */ /end MEASUREMENT
/begin MEASUREMENT autosar_swc_val_rtARID_DEF.TmpSignalConversionAtIF_sysEPS_4_sysEPS_4Outport1.EPS_4_LdwWarnSts "" UBYTE autosar_swc_val_CM_EPS_4_LdwWarnSts_421_dt 0 0 0 255 ECU_ADDRESS 0xfe4cc494 /* @ECU_Address@autosar_swc_val_rtARID_DEF.TmpSignalConversionAtIF_sysEPS_4_sysEPS_4Outport1.EPS_4_LdwWarnSts@ */ /end MEASUREMENT
/begin MEASUREMENT autosar_swc_val_rtARID_DEF.TmpSignalConversionAtIF_sysEPS_4_sysEPS_4Outport1.EPS_4_LdwWarnStsVD "" UBYTE autosar_swc_val_CM_EPS_4_LdwWarnStsVD_421_dt 0 0 0 255 ECU_ADDRESS 0xfe4cc495 /* @ECU_Address@autosar_swc_val_rtARID_DEF.TmpSignalConversionAtIF_sysEPS_4_sysEPS_4Outport1.EPS_4_LdwWarnStsVD@ */ /end MEASUREMENT
/begin MEASUREMENT autosar_swc_val_rtARID_DEF.TmpSignalConversionAtIF_sysEPS_4_sysEPS_4Outport1.EPS_4_OverrangeFeedback "" UBYTE autosar_swc_val_CM_EPS_4_OverrangeFeedback_421_dt 0 0 0 255 ECU_ADDRESS 0xfe4cc4bb /* @ECU_Address@autosar_swc_val_rtARID_DEF.TmpSignalConversionAtIF_sysEPS_4_sysEPS_4Outport1.EPS_4_OverrangeFeedback@ */ /end MEASUREMENT
/begin MEASUREMENT autosar_swc_val_rtARID_DEF.TmpSignalConversionAtIF_sysEPS_4_sysEPS_4Outport1.EPS_4_OverrangeFeedbackVD "" UBYTE autosar_swc_val_CM_EPS_4_OverrangeFeedbackVD_421_dt 0 0 0 255 ECU_ADDRESS 0xfe4cc4c4 /* @ECU_Address@autosar_swc_val_rtARID_DEF.TmpSignalConversionAtIF_sysEPS_4_sysEPS_4Outport1.EPS_4_OverrangeFeedbackVD@ */ /end MEASUREMENT
/begin MEASUREMENT autosar_swc_val_rtARID_DEF.TmpSignalConversionAtIF_sysEPS_4_sysEPS_4Outport1.EPS_4_Resd1 "" UBYTE autosar_swc_val_CM_EPS_4_Resd1_421_dt 0 0 0 255 ECU_ADDRESS 0xfe4cc48e /* @ECU_Address@autosar_swc_val_rtARID_DEF.TmpSignalConversionAtIF_sysEPS_4_sysEPS_4Outport1.EPS_4_Resd1@ */ /end MEASUREMENT
/begin MEASUREMENT autosar_swc_val_rtARID_DEF.TmpSignalConversionAtIF_sysEPS_4_sysEPS_4Outport1.EPS_4_Resd2 "" UBYTE autosar_swc_val_CM_EPS_4_Resd2_421_dt 0 0 0 255 ECU_ADDRESS 0xfe4cc499 /* @ECU_Address@autosar_swc_val_rtARID_DEF.TmpSignalConversionAtIF_sysEPS_4_sysEPS_4Outport1.EPS_4_Resd2@ */ /end MEASUREMENT
/begin MEASUREMENT autosar_swc_val_rtARID_DEF.TmpSignalConversionAtIF_sysEPS_4_sysEPS_4Outport1.EPS_4_Resd3 "" UBYTE autosar_swc_val_CM_EPS_4_Resd3_421_dt 0 0 0 255 ECU_ADDRESS 0xfe4cc4ab /* @ECU_Address@autosar_swc_val_rtARID_DEF.TmpSignalConversionAtIF_sysEPS_4_sysEPS_4Outport1.EPS_4_Resd3@ */ /end MEASUREMENT
/begin MEASUREMENT autosar_swc_val_rtARID_DEF.TmpSignalConversionAtIF_sysEPS_4_sysEPS_4Outport1.EPS_4_Resd4 "" UBYTE autosar_swc_val_CM_EPS_4_Resd4_421_dt 0 0 0 255 ECU_ADDRESS 0xfe4cc4b1 /* @ECU_Address@autosar_swc_val_rtARID_DEF.TmpSignalConversionAtIF_sysEPS_4_sysEPS_4Outport1.EPS_4_Resd4@ */ /end MEASUREMENT
/begin MEASUREMENT autosar_swc_val_rtARID_DEF.TmpSignalConversionAtIF_sysEPS_4_sysEPS_4Outport1.EPS_4_Resd5 "" UBYTE autosar_swc_val_CM_EPS_4_Resd5_421_dt 0 0 0 255 ECU_ADDRESS 0xfe4cc4ba /* @ECU_Address@autosar_swc_val_rtARID_DEF.TmpSignalConversionAtIF_sysEPS_4_sysEPS_4Outport1.EPS_4_Resd5@ */ /end MEASUREMENT
/begin MEASUREMENT autosar_swc_val_rtARID_DEF.TmpSignalConversionAtIF_sysEPS_4_sysEPS_4Outport1.EPS_4_RollgCntr1 "" UBYTE autosar_swc_val_CM_EPS_4_RollgCntr1_421_dt 0 0 0 255 ECU_ADDRESS 0xfe4cc48d /* @ECU_Address@autosar_swc_val_rtARID_DEF.TmpSignalConversionAtIF_sysEPS_4_sysEPS_4Outport1.EPS_4_RollgCntr1@ */ /end MEASUREMENT
/begin MEASUREMENT autosar_swc_val_rtARID_DEF.TmpSignalConversionAtIF_sysEPS_4_sysEPS_4Outport1.EPS_4_RollgCntr2 "" UBYTE autosar_swc_val_CM_EPS_4_RollgCntr2_421_dt 0 0 0 255 ECU_ADDRESS 0xfe4cc498 /* @ECU_Address@autosar_swc_val_rtARID_DEF.TmpSignalConversionAtIF_sysEPS_4_sysEPS_4Outport1.EPS_4_RollgCntr2@ */ /end MEASUREMENT
/begin MEASUREMENT autosar_swc_val_rtARID_DEF.TmpSignalConversionAtIF_sysEPS_4_sysEPS_4Outport1.EPS_4_RollgCntr3 "" UBYTE autosar_swc_val_CM_EPS_4_RollgCntr3_421_dt 0 0 0 255 ECU_ADDRESS 0xfe4cc4aa /* @ECU_Address@autosar_swc_val_rtARID_DEF.TmpSignalConversionAtIF_sysEPS_4_sysEPS_4Outport1.EPS_4_RollgCntr3@ */ /end MEASUREMENT
/begin MEASUREMENT autosar_swc_val_rtARID_DEF.TmpSignalConversionAtIF_sysEPS_4_sysEPS_4Outport1.EPS_4_RollgCntr4 "" UBYTE autosar_swc_val_CM_EPS_4_RollgCntr4_421_dt 0 0 0 255 ECU_ADDRESS 0xfe4cc4b0 /* @ECU_Address@autosar_swc_val_rtARID_DEF.TmpSignalConversionAtIF_sysEPS_4_sysEPS_4Outport1.EPS_4_RollgCntr4@ */ /end MEASUREMENT
/begin MEASUREMENT autosar_swc_val_rtARID_DEF.TmpSignalConversionAtIF_sysEPS_4_sysEPS_4Outport1.EPS_4_RollgCntr5 "" UBYTE autosar_swc_val_CM_EPS_4_RollgCntr5_421_dt 0 0 0 255 ECU_ADDRESS 0xfe4cc4b9 /* @ECU_Address@autosar_swc_val_rtARID_DEF.TmpSignalConversionAtIF_sysEPS_4_sysEPS_4Outport1.EPS_4_RollgCntr5@ */ /end MEASUREMENT
/begin MEASUREMENT autosar_swc_val_rtARID_DEF.TmpSignalConversionAtIF_sysEPS_4_sysEPS_4Outport1.EPS_4_SteerDrvrOvrd "" UBYTE autosar_swc_val_CM_EPS_4_SteerDrvrOvrd_421_dt 0 0 0 255 ECU_ADDRESS 0xfe4cc4ac /* @ECU_Address@autosar_swc_val_rtARID_DEF.TmpSignalConversionAtIF_sysEPS_4_sysEPS_4Outport1.EPS_4_SteerDrvrOvrd@ */ /end MEASUREMENT
/begin MEASUREMENT autosar_swc_val_rtARID_DEF.TmpSignalConversionAtIF_sysEPS_4_sysEPS_4Outport1.EPS_4_SteerDrvrOvrdVld "" UBYTE autosar_swc_val_CM_EPS_4_SteerDrvrOvrdVld_421_dt 0 0 0 255 ECU_ADDRESS 0xfe4cc4ad /* @ECU_Address@autosar_swc_val_rtARID_DEF.TmpSignalConversionAtIF_sysEPS_4_sysEPS_4Outport1.EPS_4_SteerDrvrOvrdVld@ */ /end MEASUREMENT
/begin MEASUREMENT autosar_swc_val_rtARID_DEF.TmpSignalConversionAtIF_sysEPS_4_sysEPS_4Outport1.EPS_4_SteerMod "" UBYTE autosar_swc_val_CM_EPS_4_SteerMod_421_dt 0 0 0 255 ECU_ADDRESS 0xfe4cc4ae /* @ECU_Address@autosar_swc_val_rtARID_DEF.TmpSignalConversionAtIF_sysEPS_4_sysEPS_4Outport1.EPS_4_SteerMod@ */ /end MEASUREMENT
/begin MEASUREMENT autosar_swc_val_rtARID_DEF.TmpSignalConversionAtIF_sysEPS_4_sysEPS_4Outport1.EPS_4_SteerPinionTq "" FLOAT32_IEEE autosar_swc_val_CM_EPS_4_SteerPinionTq_421_dt 0 0 -3.4E+38 3.4E+38 ECU_ADDRESS 0xfe4cc49c /* @ECU_Address@autosar_swc_val_rtARID_DEF.TmpSignalConversionAtIF_sysEPS_4_sysEPS_4Outport1.EPS_4_SteerPinionTq@ */ /end MEASUREMENT
/begin MEASUREMENT autosar_swc_val_rtARID_DEF.TmpSignalConversionAtIF_sysEPS_4_sysEPS_4Outport1.EPS_4_SteerPinionTqVld "" UBYTE autosar_swc_val_CM_EPS_4_SteerPinionTqVld_421_dt 0 0 0 255 ECU_ADDRESS 0xfe4cc4a0 /* @ECU_Address@autosar_swc_val_rtARID_DEF.TmpSignalConversionAtIF_sysEPS_4_sysEPS_4Outport1.EPS_4_SteerPinionTqVld@ */ /end MEASUREMENT
/begin MEASUREMENT autosar_swc_val_rtARID_DEF.TmpSignalConversionAtIF_sysEPS_4_sysEPS_4Outport1.EPS_4_Tq2 "" FLOAT32_IEEE autosar_swc_val_CM_EPS_4_Tq2_421_dt 0 0 -3.4E+38 3.4E+38 ECU_ADDRESS 0xfe4cc4b4 /* @ECU_Address@autosar_swc_val_rtARID_DEF.TmpSignalConversionAtIF_sysEPS_4_sysEPS_4Outport1.EPS_4_Tq2@ */ /end MEASUREMENT
/begin MEASUREMENT autosar_swc_val_rtARID_DEF.TmpSignalConversionAtIF_sysEPS_4_sysEPS_4Outport1.EPS_4_TqCtrlAvl "" UBYTE autosar_swc_val_CM_EPS_4_TqCtrlAvl_421_dt 0 0 0 255 ECU_ADDRESS 0xfe4cc492 /* @ECU_Address@autosar_swc_val_rtARID_DEF.TmpSignalConversionAtIF_sysEPS_4_sysEPS_4Outport1.EPS_4_TqCtrlAvl@ */ /end MEASUREMENT
/begin MEASUREMENT autosar_swc_val_rtARID_DEF.TmpSignalConversionAtIF_sysEPS_4_sysEPS_4Outport1.EPS_4_TqCtrlSts "" UBYTE autosar_swc_val_CM_EPS_4_TqCtrlSts_421_dt 0 0 0 255 ECU_ADDRESS 0xfe4cc493 /* @ECU_Address@autosar_swc_val_rtARID_DEF.TmpSignalConversionAtIF_sysEPS_4_sysEPS_4Outport1.EPS_4_TqCtrlSts@ */ /end MEASUREMENT
/begin MEASUREMENT autosar_swc_val_rtARID_DEF.TmpSignalConversionAtIF_sysONEBOX_5_sysONEBOX_5Outport1.ONEBOX_5_APCFailureSts "" UBYTE autosar_swc_val_CM_ONEBOX_5_APCFailureSts_335_dt 0 0 0 255 ECU_ADDRESS 0xfe4cc6ba /* @ECU_Address@autosar_swc_val_rtARID_DEF.TmpSignalConversionAtIF_sysONEBOX_5_sysONEBOX_5Outport1.ONEBOX_5_APCFailureSts@ */ /end MEASUREMENT
/begin MEASUREMENT autosar_swc_val_rtARID_DEF.TmpSignalConversionAtIF_sysONEBOX_5_sysONEBOX_5Outport1.ONEBOX_5_APCStatus "" UBYTE autosar_swc_val_CM_ONEBOX_5_APCStatus_335_dt 0 0 0 255 ECU_ADDRESS 0xfe4cc6bb /* @ECU_Address@autosar_swc_val_rtARID_DEF.TmpSignalConversionAtIF_sysONEBOX_5_sysONEBOX_5Outport1.ONEBOX_5_APCStatus@ */ /end MEASUREMENT
/begin MEASUREMENT autosar_swc_val_rtARID_DEF.TmpSignalConversionAtIF_sysONEBOX_5_sysONEBOX_5Outport1.ONEBOX_5_AbaActSts "" UBYTE autosar_swc_val_CM_ONEBOX_5_AbaActSts_335_dt 0 0 0 255 ECU_ADDRESS 0xfe4cc6c7 /* @ECU_Address@autosar_swc_val_rtARID_DEF.TmpSignalConversionAtIF_sysONEBOX_5_sysONEBOX_5Outport1.ONEBOX_5_AbaActSts@ */ /end MEASUREMENT
/begin MEASUREMENT autosar_swc_val_rtARID_DEF.TmpSignalConversionAtIF_sysONEBOX_5_sysONEBOX_5Outport1.ONEBOX_5_AbaAvlSts "" UBYTE autosar_swc_val_CM_ONEBOX_5_AbaAvlSts_335_dt 0 0 0 255 ECU_ADDRESS 0xfe4cc6c8 /* @ECU_Address@autosar_swc_val_rtARID_DEF.TmpSignalConversionAtIF_sysONEBOX_5_sysONEBOX_5Outport1.ONEBOX_5_AbaAvlSts@ */ /end MEASUREMENT
/begin MEASUREMENT autosar_swc_val_rtARID_DEF.TmpSignalConversionAtIF_sysONEBOX_5_sysONEBOX_5Outport1.ONEBOX_5_AbaLvlSts "" UBYTE autosar_swc_val_CM_ONEBOX_5_AbaLvlSts_335_dt 0 0 0 255 ECU_ADDRESS 0xfe4cc6c9 /* @ECU_Address@autosar_swc_val_rtARID_DEF.TmpSignalConversionAtIF_sysONEBOX_5_sysONEBOX_5Outport1.ONEBOX_5_AbaLvlSts@ */ /end MEASUREMENT
/begin MEASUREMENT autosar_swc_val_rtARID_DEF.TmpSignalConversionAtIF_sysONEBOX_5_sysONEBOX_5Outport1.ONEBOX_5_AbpActSts "" UBYTE autosar_swc_val_CM_ONEBOX_5_AbpActSts_335_dt 0 0 0 255 ECU_ADDRESS 0xfe4cc6c3 /* @ECU_Address@autosar_swc_val_rtARID_DEF.TmpSignalConversionAtIF_sysONEBOX_5_sysONEBOX_5Outport1.ONEBOX_5_AbpActSts@ */ /end MEASUREMENT
/begin MEASUREMENT autosar_swc_val_rtARID_DEF.TmpSignalConversionAtIF_sysONEBOX_5_sysONEBOX_5Outport1.ONEBOX_5_AbpAvlSts "" UBYTE autosar_swc_val_CM_ONEBOX_5_AbpAvlSts_335_dt 0 0 0 255 ECU_ADDRESS 0xfe4cc6c4 /* @ECU_Address@autosar_swc_val_rtARID_DEF.TmpSignalConversionAtIF_sysONEBOX_5_sysONEBOX_5Outport1.ONEBOX_5_AbpAvlSts@ */ /end MEASUREMENT
/begin MEASUREMENT autosar_swc_val_rtARID_DEF.TmpSignalConversionAtIF_sysONEBOX_5_sysONEBOX_5Outport1.ONEBOX_5_ApaAvl "" UBYTE autosar_swc_val_CM_ONEBOX_5_ApaAvl_335_dt 0 0 0 255 ECU_ADDRESS 0xfe4cc6bc /* @ECU_Address@autosar_swc_val_rtARID_DEF.TmpSignalConversionAtIF_sysONEBOX_5_sysONEBOX_5Outport1.ONEBOX_5_ApaAvl@ */ /end MEASUREMENT
/begin MEASUREMENT autosar_swc_val_rtARID_DEF.TmpSignalConversionAtIF_sysONEBOX_5_sysONEBOX_5Outport1.ONEBOX_5_AwbActSts "" UBYTE autosar_swc_val_CM_ONEBOX_5_AwbActSts_335_dt 0 0 0 255 ECU_ADDRESS 0xfe4cc6c5 /* @ECU_Address@autosar_swc_val_rtARID_DEF.TmpSignalConversionAtIF_sysONEBOX_5_sysONEBOX_5Outport1.ONEBOX_5_AwbActSts@ */ /end MEASUREMENT
/begin MEASUREMENT autosar_swc_val_rtARID_DEF.TmpSignalConversionAtIF_sysONEBOX_5_sysONEBOX_5Outport1.ONEBOX_5_AwbAvlSts "" UBYTE autosar_swc_val_CM_ONEBOX_5_AwbAvlSts_335_dt 0 0 0 255 ECU_ADDRESS 0xfe4cc6c6 /* @ECU_Address@autosar_swc_val_rtARID_DEF.TmpSignalConversionAtIF_sysONEBOX_5_sysONEBOX_5Outport1.ONEBOX_5_AwbAvlSts@ */ /end MEASUREMENT
/begin MEASUREMENT autosar_swc_val_rtARID_DEF.TmpSignalConversionAtIF_sysONEBOX_5_sysONEBOX_5Outport1.ONEBOX_5_CRC1 "" UBYTE autosar_swc_val_CM_ONEBOX_5_CRC1_335_dt 0 0 0 255 ECU_ADDRESS 0xfe4cc6b4 /* @ECU_Address@autosar_swc_val_rtARID_DEF.TmpSignalConversionAtIF_sysONEBOX_5_sysONEBOX_5Outport1.ONEBOX_5_CRC1@ */ /end MEASUREMENT
/begin MEASUREMENT autosar_swc_val_rtARID_DEF.TmpSignalConversionAtIF_sysONEBOX_5_sysONEBOX_5Outport1.ONEBOX_5_CddAdcActiveVehHld "" UBYTE autosar_swc_val_CM_ONEBOX_5_CddAdcActiveVehHld_335_dt 0 0 0 255 ECU_ADDRESS 0xfe4cc6b9 /* @ECU_Address@autosar_swc_val_rtARID_DEF.TmpSignalConversionAtIF_sysONEBOX_5_sysONEBOX_5Outport1.ONEBOX_5_CddAdcActiveVehHld@ */ /end MEASUREMENT
/begin MEASUREMENT autosar_swc_val_rtARID_DEF.TmpSignalConversionAtIF_sysONEBOX_5_sysONEBOX_5Outport1.ONEBOX_5_CddApActiveVehHld "" UBYTE autosar_swc_val_CM_ONEBOX_5_CddApActiveVehHld_335_dt 0 0 0 255 ECU_ADDRESS 0xfe4cc6bf /* @ECU_Address@autosar_swc_val_rtARID_DEF.TmpSignalConversionAtIF_sysONEBOX_5_sysONEBOX_5Outport1.ONEBOX_5_CddApActiveVehHld@ */ /end MEASUREMENT
/begin MEASUREMENT autosar_swc_val_rtARID_DEF.TmpSignalConversionAtIF_sysONEBOX_5_sysONEBOX_5Outport1.ONEBOX_5_MebAvl "" UBYTE autosar_swc_val_CM_ONEBOX_5_MebAvl_335_dt 0 0 0 255 ECU_ADDRESS 0xfe4cc6be /* @ECU_Address@autosar_swc_val_rtARID_DEF.TmpSignalConversionAtIF_sysONEBOX_5_sysONEBOX_5Outport1.ONEBOX_5_MebAvl@ */ /end MEASUREMENT
/begin MEASUREMENT autosar_swc_val_rtARID_DEF.TmpSignalConversionAtIF_sysONEBOX_5_sysONEBOX_5Outport1.ONEBOX_5_PilotParkBrkDecActSts "" UBYTE autosar_swc_val_CM_ONEBOX_5_PilotParkBrkDecActSts_335_dt 0 0 0 255 ECU_ADDRESS 0xfe4cc6b8 /* @ECU_Address@autosar_swc_val_rtARID_DEF.TmpSignalConversionAtIF_sysONEBOX_5_sysONEBOX_5Outport1.ONEBOX_5_PilotParkBrkDecActSts@ */ /end MEASUREMENT
/begin MEASUREMENT autosar_swc_val_rtARID_DEF.TmpSignalConversionAtIF_sysONEBOX_5_sysONEBOX_5Outport1.ONEBOX_5_PilotParkBrkDecCtlAvl "" UBYTE autosar_swc_val_CM_ONEBOX_5_PilotParkBrkDecCtlAvl_335_dt 0 0 0 255 ECU_ADDRESS 0xfe4cc6b7 /* @ECU_Address@autosar_swc_val_rtARID_DEF.TmpSignalConversionAtIF_sysONEBOX_5_sysONEBOX_5Outport1.ONEBOX_5_PilotParkBrkDecCtlAvl@ */ /end MEASUREMENT
/begin MEASUREMENT autosar_swc_val_rtARID_DEF.TmpSignalConversionAtIF_sysONEBOX_5_sysONEBOX_5Outport1.ONEBOX_5_Resd1 "" UBYTE autosar_swc_val_CM_ONEBOX_5_Resd1_335_dt 0 0 0 255 ECU_ADDRESS 0xfe4cc6b6 /* @ECU_Address@autosar_swc_val_rtARID_DEF.TmpSignalConversionAtIF_sysONEBOX_5_sysONEBOX_5Outport1.ONEBOX_5_Resd1@ */ /end MEASUREMENT
/begin MEASUREMENT autosar_swc_val_rtARID_DEF.TmpSignalConversionAtIF_sysONEBOX_5_sysONEBOX_5Outport1.ONEBOX_5_RollgCntr1 "" UBYTE autosar_swc_val_CM_ONEBOX_5_RollgCntr1_335_dt 0 0 0 255 ECU_ADDRESS 0xfe4cc6b5 /* @ECU_Address@autosar_swc_val_rtARID_DEF.TmpSignalConversionAtIF_sysONEBOX_5_sysONEBOX_5Outport1.ONEBOX_5_RollgCntr1@ */ /end MEASUREMENT
/begin MEASUREMENT autosar_swc_val_rtARID_DEF.TmpSignalConversionAtIF_sysONEBOX_5_sysONEBOX_5Outport1.ONEBOX_5_RpaAvl "" UBYTE autosar_swc_val_CM_ONEBOX_5_RpaAvl_335_dt 0 0 0 255 ECU_ADDRESS 0xfe4cc6bd /* @ECU_Address@autosar_swc_val_rtARID_DEF.TmpSignalConversionAtIF_sysONEBOX_5_sysONEBOX_5Outport1.ONEBOX_5_RpaAvl@ */ /end MEASUREMENT
/begin MEASUREMENT autosar_swc_val_rtARID_DEF.TmpSignalConversionAtIF_sysONEBOX_5_sysONEBOX_5Outport1.ONEBOX_5_SysBrkP "" UWORD autosar_swc_val_CM_ONEBOX_5_SysBrkP_335_dt 0 0 0 65535 ECU_ADDRESS 0xfe4cc6c0 /* @ECU_Address@autosar_swc_val_rtARID_DEF.TmpSignalConversionAtIF_sysONEBOX_5_sysONEBOX_5Outport1.ONEBOX_5_SysBrkP@ */ /end MEASUREMENT
/begin MEASUREMENT autosar_swc_val_rtARID_DEF.TmpSignalConversionAtIF_sysONEBOX_5_sysONEBOX_5Outport1.ONEBOX_5_SysBrkPVld "" UBYTE autosar_swc_val_CM_ONEBOX_5_SysBrkPVld_335_dt 0 0 0 255 ECU_ADDRESS 0xfe4cc6c2 /* @ECU_Address@autosar_swc_val_rtARID_DEF.TmpSignalConversionAtIF_sysONEBOX_5_sysONEBOX_5Outport1.ONEBOX_5_SysBrkPVld@ */ /end MEASUREMENT
/begin MEASUREMENT autosar_swc_val_rtARID_DEF.TmpSignalConversionAtIF_sysVCU_ADCC_12_sysVCU_ADCC_12Outport1.VCU_12_CRC1 "" UBYTE autosar_swc_val_CM_VCU_12_CRC1_75_dt 0 0 0 255 ECU_ADDRESS 0xfe4cc608 /* @ECU_Address@autosar_swc_val_rtARID_DEF.TmpSignalConversionAtIF_sysVCU_ADCC_12_sysVCU_ADCC_12Outport1.VCU_12_CRC1@ */ /end MEASUREMENT
/begin MEASUREMENT autosar_swc_val_rtARID_DEF.TmpSignalConversionAtIF_sysVCU_ADCC_12_sysVCU_ADCC_12Outport1.VCU_12_CRC2 "" UBYTE autosar_swc_val_CM_VCU_12_CRC2_75_dt 0 0 0 255 ECU_ADDRESS 0xfe4cc615 /* @ECU_Address@autosar_swc_val_rtARID_DEF.TmpSignalConversionAtIF_sysVCU_ADCC_12_sysVCU_ADCC_12Outport1.VCU_12_CRC2@ */ /end MEASUREMENT
/begin MEASUREMENT autosar_swc_val_rtARID_DEF.TmpSignalConversionAtIF_sysVCU_ADCC_12_sysVCU_ADCC_12Outport1.VCU_12_CRC3 "" UBYTE autosar_swc_val_CM_VCU_12_CRC3_75_dt 0 0 0 255 ECU_ADDRESS 0xfe4cc61c /* @ECU_Address@autosar_swc_val_rtARID_DEF.TmpSignalConversionAtIF_sysVCU_ADCC_12_sysVCU_ADCC_12Outport1.VCU_12_CRC3@ */ /end MEASUREMENT
/begin MEASUREMENT autosar_swc_val_rtARID_DEF.TmpSignalConversionAtIF_sysVCU_ADCC_12_sysVCU_ADCC_12Outport1.VCU_12_DriverTorqueDesired "" SWORD autosar_swc_val_CM_VCU_12_DriverTorqueDesired_75_dt 0 0 -32768 32767 ECU_ADDRESS 0xfe4cc60e /* @ECU_Address@autosar_swc_val_rtARID_DEF.TmpSignalConversionAtIF_sysVCU_ADCC_12_sysVCU_ADCC_12Outport1.VCU_12_DriverTorqueDesired@ */ /end MEASUREMENT
/begin MEASUREMENT autosar_swc_val_rtARID_DEF.TmpSignalConversionAtIF_sysVCU_ADCC_12_sysVCU_ADCC_12Outport1.VCU_12_DrvrAccrPedlOvrd "" UBYTE autosar_swc_val_CM_VCU_12_DrvrAccrPedlOvrd_75_dt 0 0 0 255 ECU_ADDRESS 0xfe4cc610 /* @ECU_Address@autosar_swc_val_rtARID_DEF.TmpSignalConversionAtIF_sysVCU_ADCC_12_sysVCU_ADCC_12Outport1.VCU_12_DrvrAccrPedlOvrd@ */ /end MEASUREMENT
/begin MEASUREMENT autosar_swc_val_rtARID_DEF.TmpSignalConversionAtIF_sysVCU_ADCC_12_sysVCU_ADCC_12Outport1.VCU_12_DrvrGearIntervention "" UBYTE autosar_swc_val_CM_VCU_12_DrvrGearIntervention_75_dt 0 0 0 255 ECU_ADDRESS 0xfe4cc60b /* @ECU_Address@autosar_swc_val_rtARID_DEF.TmpSignalConversionAtIF_sysVCU_ADCC_12_sysVCU_ADCC_12Outport1.VCU_12_DrvrGearIntervention@ */ /end MEASUREMENT
/begin MEASUREMENT autosar_swc_val_rtARID_DEF.TmpSignalConversionAtIF_sysVCU_ADCC_12_sysVCU_ADCC_12Outport1.VCU_12_GasPedalInhabition "" UBYTE autosar_swc_val_CM_VCU_12_GasPedalInhabition_75_dt 0 0 0 255 ECU_ADDRESS 0xfe4cc61b /* @ECU_Address@autosar_swc_val_rtARID_DEF.TmpSignalConversionAtIF_sysVCU_ADCC_12_sysVCU_ADCC_12Outport1.VCU_12_GasPedalInhabition@ */ /end MEASUREMENT
/begin MEASUREMENT autosar_swc_val_rtARID_DEF.TmpSignalConversionAtIF_sysVCU_ADCC_12_sysVCU_ADCC_12Outport1.VCU_12_PtTqActvSts "" UBYTE autosar_swc_val_CM_VCU_12_PtTqActvSts_75_dt 0 0 0 255 ECU_ADDRESS 0xfe4cc60c /* @ECU_Address@autosar_swc_val_rtARID_DEF.TmpSignalConversionAtIF_sysVCU_ADCC_12_sysVCU_ADCC_12Outport1.VCU_12_PtTqActvSts@ */ /end MEASUREMENT
/begin MEASUREMENT autosar_swc_val_rtARID_DEF.TmpSignalConversionAtIF_sysVCU_ADCC_12_sysVCU_ADCC_12Outport1.VCU_12_PtTqAvl "" UBYTE autosar_swc_val_CM_VCU_12_PtTqAvl_75_dt 0 0 0 255 ECU_ADDRESS 0xfe4cc60d /* @ECU_Address@autosar_swc_val_rtARID_DEF.TmpSignalConversionAtIF_sysVCU_ADCC_12_sysVCU_ADCC_12Outport1.VCU_12_PtTqAvl@ */ /end MEASUREMENT
/begin MEASUREMENT autosar_swc_val_rtARID_DEF.TmpSignalConversionAtIF_sysVCU_ADCC_12_sysVCU_ADCC_12Outport1.VCU_12_PtTqMax "" SWORD autosar_swc_val_CM_VCU_12_PtTqMax_75_dt 0 0 -32768 32767 ECU_ADDRESS 0xfe4cc618 /* @ECU_Address@autosar_swc_val_rtARID_DEF.TmpSignalConversionAtIF_sysVCU_ADCC_12_sysVCU_ADCC_12Outport1.VCU_12_PtTqMax@ */ /end MEASUREMENT
/begin MEASUREMENT autosar_swc_val_rtARID_DEF.TmpSignalConversionAtIF_sysVCU_ADCC_12_sysVCU_ADCC_12Outport1.VCU_12_PtTqMaxVld "" UBYTE autosar_swc_val_CM_VCU_12_PtTqMaxVld_75_dt 0 0 0 255 ECU_ADDRESS 0xfe4cc61a /* @ECU_Address@autosar_swc_val_rtARID_DEF.TmpSignalConversionAtIF_sysVCU_ADCC_12_sysVCU_ADCC_12Outport1.VCU_12_PtTqMaxVld@ */ /end MEASUREMENT
/begin MEASUREMENT autosar_swc_val_rtARID_DEF.TmpSignalConversionAtIF_sysVCU_ADCC_12_sysVCU_ADCC_12Outport1.VCU_12_Resd1 "" UBYTE autosar_swc_val_CM_VCU_12_Resd1_75_dt 0 0 0 255 ECU_ADDRESS 0xfe4cc60a /* @ECU_Address@autosar_swc_val_rtARID_DEF.TmpSignalConversionAtIF_sysVCU_ADCC_12_sysVCU_ADCC_12Outport1.VCU_12_Resd1@ */ /end MEASUREMENT
/begin MEASUREMENT autosar_swc_val_rtARID_DEF.TmpSignalConversionAtIF_sysVCU_ADCC_12_sysVCU_ADCC_12Outport1.VCU_12_Resd2 "" UBYTE autosar_swc_val_CM_VCU_12_Resd2_75_dt 0 0 0 255 ECU_ADDRESS 0xfe4cc617 /* @ECU_Address@autosar_swc_val_rtARID_DEF.TmpSignalConversionAtIF_sysVCU_ADCC_12_sysVCU_ADCC_12Outport1.VCU_12_Resd2@ */ /end MEASUREMENT
/begin MEASUREMENT autosar_swc_val_rtARID_DEF.TmpSignalConversionAtIF_sysVCU_ADCC_12_sysVCU_ADCC_12Outport1.VCU_12_Resd3 "" UBYTE autosar_swc_val_CM_VCU_12_Resd3_75_dt 0 0 0 255 ECU_ADDRESS 0xfe4cc61e /* @ECU_Address@autosar_swc_val_rtARID_DEF.TmpSignalConversionAtIF_sysVCU_ADCC_12_sysVCU_ADCC_12Outport1.VCU_12_Resd3@ */ /end MEASUREMENT
/begin MEASUREMENT autosar_swc_val_rtARID_DEF.TmpSignalConversionAtIF_sysVCU_ADCC_12_sysVCU_ADCC_12Outport1.VCU_12_RollgCntr1 "" UBYTE autosar_swc_val_CM_VCU_12_RollgCntr1_75_dt 0 0 0 255 ECU_ADDRESS 0xfe4cc609 /* @ECU_Address@autosar_swc_val_rtARID_DEF.TmpSignalConversionAtIF_sysVCU_ADCC_12_sysVCU_ADCC_12Outport1.VCU_12_RollgCntr1@ */ /end MEASUREMENT
/begin MEASUREMENT autosar_swc_val_rtARID_DEF.TmpSignalConversionAtIF_sysVCU_ADCC_12_sysVCU_ADCC_12Outport1.VCU_12_RollgCntr2 "" UBYTE autosar_swc_val_CM_VCU_12_RollgCntr2_75_dt 0 0 0 255 ECU_ADDRESS 0xfe4cc616 /* @ECU_Address@autosar_swc_val_rtARID_DEF.TmpSignalConversionAtIF_sysVCU_ADCC_12_sysVCU_ADCC_12Outport1.VCU_12_RollgCntr2@ */ /end MEASUREMENT
/begin MEASUREMENT autosar_swc_val_rtARID_DEF.TmpSignalConversionAtIF_sysVCU_ADCC_12_sysVCU_ADCC_12Outport1.VCU_12_RollgCntr3 "" UBYTE autosar_swc_val_CM_VCU_12_RollgCntr3_75_dt 0 0 0 255 ECU_ADDRESS 0xfe4cc61d /* @ECU_Address@autosar_swc_val_rtARID_DEF.TmpSignalConversionAtIF_sysVCU_ADCC_12_sysVCU_ADCC_12Outport1.VCU_12_RollgCntr3@ */ /end MEASUREMENT
/begin MEASUREMENT autosar_swc_val_rtARID_DEF.TmpSignalConversionAtIF_sysVCU_ADCC_12_sysVCU_ADCC_12Outport1.VCU_12_VehWhlActTq "" SWORD autosar_swc_val_CM_VCU_12_VehWhlActTq_75_dt 0 0 -32768 32767 ECU_ADDRESS 0xfe4cc612 /* @ECU_Address@autosar_swc_val_rtARID_DEF.TmpSignalConversionAtIF_sysVCU_ADCC_12_sysVCU_ADCC_12Outport1.VCU_12_VehWhlActTq@ */ /end MEASUREMENT
/begin MEASUREMENT autosar_swc_val_rtARID_DEF.TmpSignalConversionAtIF_sysVCU_ADCC_12_sysVCU_ADCC_12Outport1.VCU_12_VehWhlActTqADS "" UWORD autosar_swc_val_CM_VCU_12_VehWhlActTqADS_75_dt 0 0 0 65535 ECU_ADDRESS 0xfe4cc620 /* @ECU_Address@autosar_swc_val_rtARID_DEF.TmpSignalConversionAtIF_sysVCU_ADCC_12_sysVCU_ADCC_12Outport1.VCU_12_VehWhlActTqADS@ */ /end MEASUREMENT
/begin MEASUREMENT autosar_swc_val_rtARID_DEF.TmpSignalConversionAtIF_sysVCU_ADCC_12_sysVCU_ADCC_12Outport1.VCU_12_VehWhlActTqADSVld "" UBYTE autosar_swc_val_CM_VCU_12_VehWhlActTqADSVld_75_dt 0 0 0 255 ECU_ADDRESS 0xfe4cc622 /* @ECU_Address@autosar_swc_val_rtARID_DEF.TmpSignalConversionAtIF_sysVCU_ADCC_12_sysVCU_ADCC_12Outport1.VCU_12_VehWhlActTqADSVld@ */ /end MEASUREMENT
/begin MEASUREMENT autosar_swc_val_rtARID_DEF.TmpSignalConversionAtIF_sysVCU_ADCC_12_sysVCU_ADCC_12Outport1.VCU_12_VehWhlActTqVld "" UBYTE autosar_swc_val_CM_VCU_12_VehWhlActTqVld_75_dt 0 0 0 255 ECU_ADDRESS 0xfe4cc614 /* @ECU_Address@autosar_swc_val_rtARID_DEF.TmpSignalConversionAtIF_sysVCU_ADCC_12_sysVCU_ADCC_12Outport1.VCU_12_VehWhlActTqVld@ */ /end MEASUREMENT
/begin COMPU_METHOD autosar_swc_val_CM_ADS_1_ADCCAvl_359_dt "Q = V" IDENTICAL "%0.6" "" /end COMPU_METHOD
/begin COMPU_METHOD autosar_swc_val_CM_ADS_1_AMAPRequestVld_359_dt "Q = V" IDENTICAL "%0.6" "" /end COMPU_METHOD
/begin COMPU_METHOD autosar_swc_val_CM_ADS_1_AMAPRequest_359_dt "Q = V" IDENTICAL "%0.6" "" /end COMPU_METHOD
/begin COMPU_METHOD autosar_swc_val_CM_ADS_1_AMAPTqLimitVld_359_dt "Q = V" IDENTICAL "%0.6" "" /end COMPU_METHOD
/begin COMPU_METHOD autosar_swc_val_CM_ADS_1_AMAPTqLimit_359_dt "Q = V" IDENTICAL "%0.6" "" /end COMPU_METHOD
/begin COMPU_METHOD autosar_swc_val_CM_ADS_1_CRC1_359_dt "Q = V" IDENTICAL "%0.6" "" /end COMPU_METHOD
/begin COMPU_METHOD autosar_swc_val_CM_ADS_1_CRC2_359_dt "Q = V" IDENTICAL "%0.6" "" /end COMPU_METHOD
/begin COMPU_METHOD autosar_swc_val_CM_ADS_1_CtrlReqMod_359_dt "Q = V" IDENTICAL "%0.6" "" /end COMPU_METHOD
/begin COMPU_METHOD autosar_swc_val_CM_ADS_1_DrvCtrlReq_359_dt "Q = V" IDENTICAL "%0.6" "" /end COMPU_METHOD
/begin COMPU_METHOD autosar_swc_val_CM_ADS_1_DrvTarTqEnable_359_dt "Q = V" IDENTICAL "%0.6" "" /end COMPU_METHOD
/begin COMPU_METHOD autosar_swc_val_CM_ADS_1_DrvTarTqVld_359_dt "Q = V" IDENTICAL "%0.6" "" /end COMPU_METHOD
/begin COMPU_METHOD autosar_swc_val_CM_ADS_1_DrvTarTq_359_dt "Q = V" IDENTICAL "%0.6" "" /end COMPU_METHOD
/begin COMPU_METHOD autosar_swc_val_CM_ADS_1_GearCtrlEnable_359_dt "Q = V" IDENTICAL "%0.6" "" /end COMPU_METHOD
/begin COMPU_METHOD autosar_swc_val_CM_ADS_1_Resd1_359_dt "Q = V" IDENTICAL "%0.6" "" /end COMPU_METHOD
/begin COMPU_METHOD autosar_swc_val_CM_ADS_1_Resd2_359_dt "Q = V" IDENTICAL "%0.6" "" /end COMPU_METHOD
/begin COMPU_METHOD autosar_swc_val_CM_ADS_1_RollgCntr1_359_dt "Q = V" IDENTICAL "%0.6" "" /end COMPU_METHOD
/begin COMPU_METHOD autosar_swc_val_CM_ADS_1_RollgCntr2_359_dt "Q = V" IDENTICAL "%0.6" "" /end COMPU_METHOD
/begin COMPU_METHOD autosar_swc_val_CM_ADS_1_RpaPTReadyReq_359_dt "Q = V" IDENTICAL "%0.6" "" /end COMPU_METHOD
/begin COMPU_METHOD autosar_swc_val_CM_ADS_1_TarGearReqVld_359_dt "Q = V" IDENTICAL "%0.6" "" /end COMPU_METHOD
/begin COMPU_METHOD autosar_swc_val_CM_ADS_1_TarGearReq_359_dt "Q = V" IDENTICAL "%0.6" "" /end COMPU_METHOD
/begin COMPU_METHOD autosar_swc_val_CM_CutOutFreshvalues_2CB_S_330_dt "Q = V" IDENTICAL "%0.6" "" /end COMPU_METHOD
/begin COMPU_METHOD autosar_swc_val_CM_CutOutMAC_2CB_S_330_dt "Q = V" IDENTICAL "%0.6" "" /end COMPU_METHOD
/begin COMPU_METHOD autosar_swc_val_CM_EPS_4_ADSMaxTq_421_dt "Q = V" IDENTICAL "%8.6" "" /end COMPU_METHOD
/begin COMPU_METHOD autosar_swc_val_CM_EPS_4_ADSMinTq_421_dt "Q = V" IDENTICAL "%8.6" "" /end COMPU_METHOD
/begin COMPU_METHOD autosar_swc_val_CM_EPS_4_AgParkCtrlAvl_421_dt "Q = V" IDENTICAL "%0.6" "" /end COMPU_METHOD
/begin COMPU_METHOD autosar_swc_val_CM_EPS_4_AgParkCtrlSts_421_dt "Q = V" IDENTICAL "%0.6" "" /end COMPU_METHOD
/begin COMPU_METHOD autosar_swc_val_CM_EPS_4_AgPilotCtrlAvl_421_dt "Q = V" IDENTICAL "%0.6" "" /end COMPU_METHOD
/begin COMPU_METHOD autosar_swc_val_CM_EPS_4_AgPilotCtrlSts_421_dt "Q = V" IDENTICAL "%0.6" "" /end COMPU_METHOD
/begin COMPU_METHOD autosar_swc_val_CM_EPS_4_AsscMotCrtTqVld_421_dt "Q = V" IDENTICAL "%0.6" "" /end COMPU_METHOD
/begin COMPU_METHOD autosar_swc_val_CM_EPS_4_AsscMotCrtTq_421_dt "Q = V" IDENTICAL "%8.6" "" /end COMPU_METHOD
/begin COMPU_METHOD autosar_swc_val_CM_EPS_4_CRC1_421_dt "Q = V" IDENTICAL "%0.6" "" /end COMPU_METHOD
/begin COMPU_METHOD autosar_swc_val_CM_EPS_4_CRC2_421_dt "Q = V" IDENTICAL "%0.6" "" /end COMPU_METHOD
/begin COMPU_METHOD autosar_swc_val_CM_EPS_4_CRC3_421_dt "Q = V" IDENTICAL "%0.6" "" /end COMPU_METHOD
/begin COMPU_METHOD autosar_swc_val_CM_EPS_4_CRC4_421_dt "Q = V" IDENTICAL "%0.6" "" /end COMPU_METHOD
/begin COMPU_METHOD autosar_swc_val_CM_EPS_4_CRC5_421_dt "Q = V" IDENTICAL "%0.6" "" /end COMPU_METHOD
/begin COMPU_METHOD autosar_swc_val_CM_EPS_4_LdwWarnStsVD_421_dt "Q = V" IDENTICAL "%0.6" "" /end COMPU_METHOD
/begin COMPU_METHOD autosar_swc_val_CM_EPS_4_LdwWarnSts_421_dt "Q = V" IDENTICAL "%0.6" "" /end COMPU_METHOD
/begin COMPU_METHOD autosar_swc_val_CM_EPS_4_OverrangeFeedbackVD_421_dt "Q = V" IDENTICAL "%0.6" "" /end COMPU_METHOD
/begin COMPU_METHOD autosar_swc_val_CM_EPS_4_OverrangeFeedback_421_dt "Q = V" IDENTICAL "%0.6" "" /end COMPU_METHOD
/begin COMPU_METHOD autosar_swc_val_CM_EPS_4_Resd1_421_dt "Q = V" IDENTICAL "%0.6" "" /end COMPU_METHOD
/begin COMPU_METHOD autosar_swc_val_CM_EPS_4_Resd2_421_dt "Q = V" IDENTICAL "%0.6" "" /end COMPU_METHOD
/begin COMPU_METHOD autosar_swc_val_CM_EPS_4_Resd3_421_dt "Q = V" IDENTICAL "%0.6" "" /end COMPU_METHOD
/begin COMPU_METHOD autosar_swc_val_CM_EPS_4_Resd4_421_dt "Q = V" IDENTICAL "%0.6" "" /end COMPU_METHOD
/begin COMPU_METHOD autosar_swc_val_CM_EPS_4_Resd5_421_dt "Q = V" IDENTICAL "%0.6" "" /end COMPU_METHOD
/begin COMPU_METHOD autosar_swc_val_CM_EPS_4_RollgCntr1_421_dt "Q = V" IDENTICAL "%0.6" "" /end COMPU_METHOD
/begin COMPU_METHOD autosar_swc_val_CM_EPS_4_RollgCntr2_421_dt "Q = V" IDENTICAL "%0.6" "" /end COMPU_METHOD
/begin COMPU_METHOD autosar_swc_val_CM_EPS_4_RollgCntr3_421_dt "Q = V" IDENTICAL "%0.6" "" /end COMPU_METHOD
/begin COMPU_METHOD autosar_swc_val_CM_EPS_4_RollgCntr4_421_dt "Q = V" IDENTICAL "%0.6" "" /end COMPU_METHOD
/begin COMPU_METHOD autosar_swc_val_CM_EPS_4_RollgCntr5_421_dt "Q = V" IDENTICAL "%0.6" "" /end COMPU_METHOD
/begin COMPU_METHOD autosar_swc_val_CM_EPS_4_SteerDrvrOvrdVld_421_dt "Q = V" IDENTICAL "%0.6" "" /end COMPU_METHOD
/begin COMPU_METHOD autosar_swc_val_CM_EPS_4_SteerDrvrOvrd_421_dt "Q = V" IDENTICAL "%0.6" "" /end COMPU_METHOD
/begin COMPU_METHOD autosar_swc_val_CM_EPS_4_SteerMod_421_dt "Q = V" IDENTICAL "%0.6" "" /end COMPU_METHOD
/begin COMPU_METHOD autosar_swc_val_CM_EPS_4_SteerPinionTqVld_421_dt "Q = V" IDENTICAL "%0.6" "" /end COMPU_METHOD
/begin COMPU_METHOD autosar_swc_val_CM_EPS_4_SteerPinionTq_421_dt "Q = V" IDENTICAL "%8.6" "" /end COMPU_METHOD
/begin COMPU_METHOD autosar_swc_val_CM_EPS_4_Tq2_421_dt "Q = V" IDENTICAL "%8.6" "" /end COMPU_METHOD
/begin COMPU_METHOD autosar_swc_val_CM_EPS_4_TqCtrlAvl_421_dt "Q = V" IDENTICAL "%0.6" "" /end COMPU_METHOD
/begin COMPU_METHOD autosar_swc_val_CM_EPS_4_TqCtrlSts_421_dt "Q = V" IDENTICAL "%0.6" "" /end COMPU_METHOD
/begin COMPU_METHOD autosar_swc_val_CM_FCM_2_AbaLvl_325_dt "Q = V" IDENTICAL "%0.6" "" /end COMPU_METHOD
/begin COMPU_METHOD autosar_swc_val_CM_FCM_2_AbaReq_325_dt "Q = V" IDENTICAL "%0.6" "" /end COMPU_METHOD
/begin COMPU_METHOD autosar_swc_val_CM_FCM_2_AebReqTyp_325_dt "Q = V" IDENTICAL "%0.6" "" /end COMPU_METHOD
/begin COMPU_METHOD autosar_swc_val_CM_FCM_2_AebTarDecVld_325_dt "Q = V" IDENTICAL "%0.6" "" /end COMPU_METHOD
/begin COMPU_METHOD autosar_swc_val_CM_FCM_2_AebTarDec_325_dt "Q = V" IDENTICAL "%8.6" "" /end COMPU_METHOD
/begin COMPU_METHOD autosar_swc_val_CM_FCM_2_Avl_325_dt "Q = V" IDENTICAL "%0.6" "" /end COMPU_METHOD
/begin COMPU_METHOD autosar_swc_val_CM_FCM_2_AwbLvl_325_dt "Q = V" IDENTICAL "%0.6" "" /end COMPU_METHOD
/begin COMPU_METHOD autosar_swc_val_CM_FCM_2_AwbReq_325_dt "Q = V" IDENTICAL "%0.6" "" /end COMPU_METHOD
/begin COMPU_METHOD autosar_swc_val_CM_FCM_2_BrkPreFillReq_325_dt "Q = V" IDENTICAL "%0.6" "" /end COMPU_METHOD
/begin COMPU_METHOD autosar_swc_val_CM_FCM_2_CRC1_325_dt "Q = V" IDENTICAL "%0.6" "" /end COMPU_METHOD
/begin COMPU_METHOD autosar_swc_val_CM_FCM_2_Resd1_325_dt "Q = V" IDENTICAL "%0.6" "" /end COMPU_METHOD
/begin COMPU_METHOD autosar_swc_val_CM_FCM_2_RollgCntr1_325_dt "Q = V" IDENTICAL "%0.6" "" /end COMPU_METHOD
/begin COMPU_METHOD autosar_swc_val_CM_FCM_3_CRC1_330_dt "Q = V" IDENTICAL "%0.6" "" /end COMPU_METHOD
/begin COMPU_METHOD autosar_swc_val_CM_FCM_3_PilotBrkDecTarReq_330_dt "Q = V" IDENTICAL "%0.6" "" /end COMPU_METHOD
/begin COMPU_METHOD autosar_swc_val_CM_FCM_3_PilotBrkDecTarVld_330_dt "Q = V" IDENTICAL "%0.6" "" /end COMPU_METHOD
/begin COMPU_METHOD autosar_swc_val_CM_FCM_3_PilotCtrlType_330_dt "Q = V" IDENTICAL "%0.6" "" /end COMPU_METHOD
/begin COMPU_METHOD autosar_swc_val_CM_FCM_3_PilotDec2StpReq_330_dt "Q = V" IDENTICAL "%0.6" "" /end COMPU_METHOD
/begin COMPU_METHOD autosar_swc_val_CM_FCM_3_PilotDriOffReq_330_dt "Q = V" IDENTICAL "%0.6" "" /end COMPU_METHOD
/begin COMPU_METHOD autosar_swc_val_CM_FCM_3_PilotParkCtrlRepSta_330_dt "Q = V" IDENTICAL "%0.6" "" /end COMPU_METHOD
/begin COMPU_METHOD autosar_swc_val_CM_FCM_3_PilotkBrkDecTar_330_dt "Q = V" IDENTICAL "%8.6" "" /end COMPU_METHOD
/begin COMPU_METHOD autosar_swc_val_CM_FCM_3_Resd1_330_dt "Q = V" IDENTICAL "%0.6" "" /end COMPU_METHOD
/begin COMPU_METHOD autosar_swc_val_CM_FCM_3_RollgCntr1_330_dt "Q = V" IDENTICAL "%0.6" "" /end COMPU_METHOD
/begin COMPU_METHOD autosar_swc_val_CM_ONEBOX_5_APCFailureSts_335_dt "Q = V" IDENTICAL "%0.6" "" /end COMPU_METHOD
/begin COMPU_METHOD autosar_swc_val_CM_ONEBOX_5_APCStatus_335_dt "Q = V" IDENTICAL "%0.6" "" /end COMPU_METHOD
/begin COMPU_METHOD autosar_swc_val_CM_ONEBOX_5_AbaActSts_335_dt "Q = V" IDENTICAL "%0.6" "" /end COMPU_METHOD
/begin COMPU_METHOD autosar_swc_val_CM_ONEBOX_5_AbaAvlSts_335_dt "Q = V" IDENTICAL "%0.6" "" /end COMPU_METHOD
/begin COMPU_METHOD autosar_swc_val_CM_ONEBOX_5_AbaLvlSts_335_dt "Q = V" IDENTICAL "%0.6" "" /end COMPU_METHOD
/begin COMPU_METHOD autosar_swc_val_CM_ONEBOX_5_AbpActSts_335_dt "Q = V" IDENTICAL "%0.6" "" /end COMPU_METHOD
/begin COMPU_METHOD autosar_swc_val_CM_ONEBOX_5_AbpAvlSts_335_dt "Q = V" IDENTICAL "%0.6" "" /end COMPU_METHOD
/begin COMPU_METHOD autosar_swc_val_CM_ONEBOX_5_ApaAvl_335_dt "Q = V" IDENTICAL "%0.6" "" /end COMPU_METHOD
/begin COMPU_METHOD autosar_swc_val_CM_ONEBOX_5_AwbActSts_335_dt "Q = V" IDENTICAL "%0.6" "" /end COMPU_METHOD
/begin COMPU_METHOD autosar_swc_val_CM_ONEBOX_5_AwbAvlSts_335_dt "Q = V" IDENTICAL "%0.6" "" /end COMPU_METHOD
/begin COMPU_METHOD autosar_swc_val_CM_ONEBOX_5_CRC1_335_dt "Q = V" IDENTICAL "%0.6" "" /end COMPU_METHOD
/begin COMPU_METHOD autosar_swc_val_CM_ONEBOX_5_CddAdcActiveVehHld_335_dt "Q = V" IDENTICAL "%0.6" "" /end COMPU_METHOD
/begin COMPU_METHOD autosar_swc_val_CM_ONEBOX_5_CddApActiveVehHld_335_dt "Q = V" IDENTICAL "%0.6" "" /end COMPU_METHOD
/begin COMPU_METHOD autosar_swc_val_CM_ONEBOX_5_MebAvl_335_dt "Q = V" IDENTICAL "%0.6" "" /end COMPU_METHOD
/begin COMPU_METHOD autosar_swc_val_CM_ONEBOX_5_PilotParkBrkDecActSts_335_dt "Q = V" IDENTICAL "%0.6" "" /end COMPU_METHOD
/begin COMPU_METHOD autosar_swc_val_CM_ONEBOX_5_PilotParkBrkDecCtlAvl_335_dt "Q = V" IDENTICAL "%0.6" "" /end COMPU_METHOD
/begin COMPU_METHOD autosar_swc_val_CM_ONEBOX_5_Resd1_335_dt "Q = V" IDENTICAL "%0.6" "" /end COMPU_METHOD
/begin COMPU_METHOD autosar_swc_val_CM_ONEBOX_5_RollgCntr1_335_dt "Q = V" IDENTICAL "%0.6" "" /end COMPU_METHOD
/begin COMPU_METHOD autosar_swc_val_CM_ONEBOX_5_RpaAvl_335_dt "Q = V" IDENTICAL "%0.6" "" /end COMPU_METHOD
/begin COMPU_METHOD autosar_swc_val_CM_ONEBOX_5_SysBrkPVld_335_dt "Q = V" IDENTICAL "%0.6" "" /end COMPU_METHOD
/begin COMPU_METHOD autosar_swc_val_CM_ONEBOX_5_SysBrkP_335_dt "Q = V" IDENTICAL "%0.6" "" /end COMPU_METHOD
/begin COMPU_METHOD autosar_swc_val_CM_VCU_12_CRC1_75_dt "Q = V" IDENTICAL "%0.6" "" /end COMPU_METHOD
/begin COMPU_METHOD autosar_swc_val_CM_VCU_12_CRC2_75_dt "Q = V" IDENTICAL "%0.6" "" /end COMPU_METHOD
/begin COMPU_METHOD autosar_swc_val_CM_VCU_12_CRC3_75_dt "Q = V" IDENTICAL "%0.6" "" /end COMPU_METHOD
/begin COMPU_METHOD autosar_swc_val_CM_VCU_12_DriverTorqueDesired_75_dt "Q = V" IDENTICAL "%0.6" "" /end COMPU_METHOD
/begin COMPU_METHOD autosar_swc_val_CM_VCU_12_DrvrAccrPedlOvrd_75_dt "Q = V" IDENTICAL "%0.6" "" /end COMPU_METHOD
/begin COMPU_METHOD autosar_swc_val_CM_VCU_12_DrvrGearIntervention_75_dt "Q = V" IDENTICAL "%0.6" "" /end COMPU_METHOD
/begin COMPU_METHOD autosar_swc_val_CM_VCU_12_GasPedalInhabition_75_dt "Q = V" IDENTICAL "%0.6" "" /end COMPU_METHOD
/begin COMPU_METHOD autosar_swc_val_CM_VCU_12_PtTqActvSts_75_dt "Q = V" IDENTICAL "%0.6" "" /end COMPU_METHOD
/begin COMPU_METHOD autosar_swc_val_CM_VCU_12_PtTqAvl_75_dt "Q = V" IDENTICAL "%0.6" "" /end COMPU_METHOD
/begin COMPU_METHOD autosar_swc_val_CM_VCU_12_PtTqMaxVld_75_dt "Q = V" IDENTICAL "%0.6" "" /end COMPU_METHOD
/begin COMPU_METHOD autosar_swc_val_CM_VCU_12_PtTqMax_75_dt "Q = V" IDENTICAL "%0.6" "" /end COMPU_METHOD
/begin COMPU_METHOD autosar_swc_val_CM_VCU_12_Resd1_75_dt "Q = V" IDENTICAL "%0.6" "" /end COMPU_METHOD
/begin COMPU_METHOD autosar_swc_val_CM_VCU_12_Resd2_75_dt "Q = V" IDENTICAL "%0.6" "" /end COMPU_METHOD
/begin COMPU_METHOD autosar_swc_val_CM_VCU_12_Resd3_75_dt "Q = V" IDENTICAL "%0.6" "" /end COMPU_METHOD
/begin COMPU_METHOD autosar_swc_val_CM_VCU_12_RollgCntr1_75_dt "Q = V" IDENTICAL "%0.6" "" /end COMPU_METHOD
/begin COMPU_METHOD autosar_swc_val_CM_VCU_12_RollgCntr2_75_dt "Q = V" IDENTICAL "%0.6" "" /end COMPU_METHOD
/begin COMPU_METHOD autosar_swc_val_CM_VCU_12_RollgCntr3_75_dt "Q = V" IDENTICAL "%0.6" "" /end COMPU_METHOD
/begin COMPU_METHOD autosar_swc_val_CM_VCU_12_VehWhlActTqADSVld_75_dt "Q = V" IDENTICAL "%0.6" "" /end COMPU_METHOD
/begin COMPU_METHOD autosar_swc_val_CM_VCU_12_VehWhlActTqADS_75_dt "Q = V" IDENTICAL "%0.6" "" /end COMPU_METHOD
/begin COMPU_METHOD autosar_swc_val_CM_VCU_12_VehWhlActTqVld_75_dt "Q = V" IDENTICAL "%0.6" "" /end COMPU_METHOD
/begin COMPU_METHOD autosar_swc_val_CM_VCU_12_VehWhlActTq_75_dt "Q = V" IDENTICAL "%0.6" "" /end COMPU_METHOD
/begin COMPU_METHOD autosar_swc_val_CM_logical "Q = V" IDENTICAL "%1.0" "" /end COMPU_METHOD
/begin COMPU_METHOD autosar_swc_val_CM_single "Q = V" IDENTICAL "%8.6" "" /end COMPU_METHOD
/begin COMPU_METHOD autosar_swc_val_CM_uint32 "Q = V" IDENTICAL "%10.0" "" /end COMPU_METHOD
/begin COMPU_METHOD autosar_swc_val_CM_uint8 "Q = V" IDENTICAL "%3.0" "" /end COMPU_METHOD
/begin GROUP autosar_swc_val_rtARID_DEF.BusAssignment1 ""
 /begin REF_MEASUREMENT autosar_swc_val_rtARID_DEF.BusAssignment1.FCM_2_CRC1 autosar_swc_val_rtARID_DEF.BusAssignment1.FCM_2_RollgCntr1 autosar_swc_val_rtARID_DEF.BusAssignment1.FCM_2_Resd1 autosar_swc_val_rtARID_DEF.BusAssignment1.FCM_2_AebReqTyp autosar_swc_val_rtARID_DEF.BusAssignment1.FCM_2_AebTarDec autosar_swc_val_rtARID_DEF.BusAssignment1.FCM_2_AebTarDecVld autosar_swc_val_rtARID_DEF.BusAssignment1.FCM_2_AwbReq autosar_swc_val_rtARID_DEF.BusAssignment1.FCM_2_AwbLvl autosar_swc_val_rtARID_DEF.BusAssignment1.FCM_2_BrkPreFillReq autosar_swc_val_rtARID_DEF.BusAssignment1.FCM_2_AbaReq autosar_swc_val_rtARID_DEF.BusAssignment1.FCM_2_AbaLvl autosar_swc_val_rtARID_DEF.BusAssignment1.FCM_2_Avl /end REF_MEASUREMENT
/end GROUP
/begin GROUP autosar_swc_val_rtARID_DEF.BusAssignment2 ""
 /begin REF_MEASUREMENT autosar_swc_val_rtARID_DEF.BusAssignment2.FCM_3_CRC1 autosar_swc_val_rtARID_DEF.BusAssignment2.FCM_3_RollgCntr1 autosar_swc_val_rtARID_DEF.BusAssignment2.FCM_3_Resd1 autosar_swc_val_rtARID_DEF.BusAssignment2.FCM_3_PilotParkCtrlRepSta autosar_swc_val_rtARID_DEF.BusAssignment2.FCM_3_PilotCtrlType autosar_swc_val_rtARID_DEF.BusAssignment2.FCM_3_PilotkBrkDecTar autosar_swc_val_rtARID_DEF.BusAssignment2.FCM_3_PilotBrkDecTarVld autosar_swc_val_rtARID_DEF.BusAssignment2.FCM_3_PilotBrkDecTarReq autosar_swc_val_rtARID_DEF.BusAssignment2.FCM_3_PilotDec2StpReq autosar_swc_val_rtARID_DEF.BusAssignment2.FCM_3_PilotDriOffReq autosar_swc_val_rtARID_DEF.BusAssignment2.CutOutFreshvalues_2CB_S autosar_swc_val_rtARID_DEF.BusAssignment2.CutOutMAC_2CB_S /end REF_MEASUREMENT
/end GROUP
/begin GROUP autosar_swc_val_rtARID_DEF.BusAssignment3 ""
 /begin REF_MEASUREMENT autosar_swc_val_rtARID_DEF.BusAssignment3.ADS_1_CRC1 autosar_swc_val_rtARID_DEF.BusAssignment3.ADS_1_RollgCntr1 autosar_swc_val_rtARID_DEF.BusAssignment3.ADS_1_Resd1 autosar_swc_val_rtARID_DEF.BusAssignment3.ADS_1_DrvTarTq autosar_swc_val_rtARID_DEF.BusAssignment3.ADS_1_DrvTarTqVld autosar_swc_val_rtARID_DEF.BusAssignment3.ADS_1_DrvCtrlReq autosar_swc_val_rtARID_DEF.BusAssignment3.ADS_1_CtrlReqMod autosar_swc_val_rtARID_DEF.BusAssignment3.ADS_1_DrvTarTqEnable autosar_swc_val_rtARID_DEF.BusAssignment3.ADS_1_AMAPRequest autosar_swc_val_rtARID_DEF.BusAssignment3.ADS_1_AMAPRequestVld autosar_swc_val_rtARID_DEF.BusAssignment3.ADS_1_ADCCAvl autosar_swc_val_rtARID_DEF.BusAssignment3.ADS_1_AMAPTqLimit autosar_swc_val_rtARID_DEF.BusAssignment3.ADS_1_AMAPTqLimitVld autosar_swc_val_rtARID_DEF.BusAssignment3.ADS_1_CRC2 autosar_swc_val_rtARID_DEF.BusAssignment3.ADS_1_RollgCntr2 autosar_swc_val_rtARID_DEF.BusAssignment3.ADS_1_Resd2 autosar_swc_val_rtARID_DEF.BusAssignment3.ADS_1_TarGearReq autosar_swc_val_rtARID_DEF.BusAssignment3.ADS_1_TarGearReqVld autosar_swc_val_rtARID_DEF.BusAssignment3.ADS_1_GearCtrlEnable autosar_swc_val_rtARID_DEF.BusAssignment3.ADS_1_RpaPTReadyReq /end REF_MEASUREMENT
/end GROUP
/begin GROUP autosar_swc_val_rtARID_DEF.BusAssignment4 ""
 /begin REF_MEASUREMENT autosar_swc_val_rtARID_DEF.BusAssignment4.isLatFrbdnAct autosar_swc_val_rtARID_DEF.BusAssignment4.isLgtPosFrbdnAct autosar_swc_val_rtARID_DEF.BusAssignment4.isLgtNegFrbdnAct autosar_swc_val_rtARID_DEF.BusAssignment4.isAEBFrbdnAct /end REF_MEASUREMENT
/end GROUP
/begin GROUP autosar_swc_val_rtARID_DEF.SignalCopy4 ""
 /begin REF_MEASUREMENT autosar_swc_val_rtARID_DEF.SignalCopy4.FCM_3_CRC1 autosar_swc_val_rtARID_DEF.SignalCopy4.FCM_3_RollgCntr1 autosar_swc_val_rtARID_DEF.SignalCopy4.FCM_3_Resd1 autosar_swc_val_rtARID_DEF.SignalCopy4.FCM_3_PilotParkCtrlRepSta autosar_swc_val_rtARID_DEF.SignalCopy4.FCM_3_PilotCtrlType autosar_swc_val_rtARID_DEF.SignalCopy4.FCM_3_PilotkBrkDecTar autosar_swc_val_rtARID_DEF.SignalCopy4.FCM_3_PilotBrkDecTarVld autosar_swc_val_rtARID_DEF.SignalCopy4.FCM_3_PilotBrkDecTarReq autosar_swc_val_rtARID_DEF.SignalCopy4.FCM_3_PilotDec2StpReq autosar_swc_val_rtARID_DEF.SignalCopy4.FCM_3_PilotDriOffReq autosar_swc_val_rtARID_DEF.SignalCopy4.CutOutFreshvalues_2CB_S autosar_swc_val_rtARID_DEF.SignalCopy4.CutOutMAC_2CB_S /end REF_MEASUREMENT
/end GROUP
/begin GROUP autosar_swc_val_rtARID_DEF.TmpSignalConversionAtAEB_BRKINFO_AEB_BRKINFOOutport1 ""
 /begin REF_MEASUREMENT autosar_swc_val_rtARID_DEF.TmpSignalConversionAtAEB_BRKINFO_AEB_BRKINFOOutport1.AEBDecCtrlReqest autosar_swc_val_rtARID_DEF.TmpSignalConversionAtAEB_BRKINFO_AEB_BRKINFOOutport1.AEBReq autosar_swc_val_rtARID_DEF.TmpSignalConversionAtAEB_BRKINFO_AEB_BRKINFOOutport1.DWReq autosar_swc_val_rtARID_DEF.TmpSignalConversionAtAEB_BRKINFO_AEB_BRKINFOOutport1.AWBRequest autosar_swc_val_rtARID_DEF.TmpSignalConversionAtAEB_BRKINFO_AEB_BRKINFOOutport1.AWBLevel autosar_swc_val_rtARID_DEF.TmpSignalConversionAtAEB_BRKINFO_AEB_BRKINFOOutport1.PrefillRequest autosar_swc_val_rtARID_DEF.TmpSignalConversionAtAEB_BRKINFO_AEB_BRKINFOOutport1.HBAlevel autosar_swc_val_rtARID_DEF.TmpSignalConversionAtAEB_BRKINFO_AEB_BRKINFOOutport1.HBArequest autosar_swc_val_rtARID_DEF.TmpSignalConversionAtAEB_BRKINFO_AEB_BRKINFOOutport1.FCWMode autosar_swc_val_rtARID_DEF.TmpSignalConversionAtAEB_BRKINFO_AEB_BRKINFOOutport1.AEBMode autosar_swc_val_rtARID_DEF.TmpSignalConversionAtAEB_BRKINFO_AEB_BRKINFOOutport1.FCTBMode autosar_swc_val_rtARID_DEF.TmpSignalConversionAtAEB_BRKINFO_AEB_BRKINFOOutport1.HazdLmpReq autosar_swc_val_rtARID_DEF.TmpSignalConversionAtAEB_BRKINFO_AEB_BRKINFOOutport1.TextInfo autosar_swc_val_rtARID_DEF.TmpSignalConversionAtAEB_BRKINFO_AEB_BRKINFOOutport1.TextinfoWarn autosar_swc_val_rtARID_DEF.TmpSignalConversionAtAEB_BRKINFO_AEB_BRKINFOOutport1.AEBTarDec /end REF_MEASUREMENT
/end GROUP
/begin GROUP autosar_swc_val_rtARID_DEF.TmpSignalConversionAtFM_SAF_OUT_FM_SAF_OUTOutport1 ""
 /begin SUB_GROUP autosar_swc_val_rtARID_DEF.TmpSignalConversionAtFM_SAF_OUT_FM_SAF_OUTOutport1.SftyErrInfo /end SUB_GROUP
 /begin REF_MEASUREMENT autosar_swc_val_rtARID_DEF.TmpSignalConversionAtFM_SAF_OUT_FM_SAF_OUTOutport1.SftyErrLvl autosar_swc_val_rtARID_DEF.TmpSignalConversionAtFM_SAF_OUT_FM_SAF_OUTOutport1.SftyCmd /end REF_MEASUREMENT
/end GROUP
/begin GROUP autosar_swc_val_rtARID_DEF.TmpSignalConversionAtFM_SAF_OUT_FM_SAF_OUTOutport1.SftyErrInfo ""
 /begin REF_MEASUREMENT autosar_swc_val_rtARID_DEF.TmpSignalConversionAtFM_SAF_OUT_FM_SAF_OUTOutport1.SftyErrInfo.SftyVehSpdChassisVld autosar_swc_val_rtARID_DEF.TmpSignalConversionAtFM_SAF_OUT_FM_SAF_OUTOutport1.SftyErrInfo.SftyVehSpdChassis autosar_swc_val_rtARID_DEF.TmpSignalConversionAtFM_SAF_OUT_FM_SAF_OUTOutport1.SftyErrInfo.SftyModeFuSa autosar_swc_val_rtARID_DEF.TmpSignalConversionAtFM_SAF_OUT_FM_SAF_OUTOutport1.SftyErrInfo.SftyErr_0 autosar_swc_val_rtARID_DEF.TmpSignalConversionAtFM_SAF_OUT_FM_SAF_OUTOutport1.SftyErrInfo.SftyErr_1 autosar_swc_val_rtARID_DEF.TmpSignalConversionAtFM_SAF_OUT_FM_SAF_OUTOutport1.SftyErrInfo.SftyErr_2 autosar_swc_val_rtARID_DEF.TmpSignalConversionAtFM_SAF_OUT_FM_SAF_OUTOutport1.SftyErrInfo.SftyErr_3 autosar_swc_val_rtARID_DEF.TmpSignalConversionAtFM_SAF_OUT_FM_SAF_OUTOutport1.SftyErrInfo.SftyErr_4 autosar_swc_val_rtARID_DEF.TmpSignalConversionAtFM_SAF_OUT_FM_SAF_OUTOutport1.SftyErrInfo.SftyErr_5 autosar_swc_val_rtARID_DEF.TmpSignalConversionAtFM_SAF_OUT_FM_SAF_OUTOutport1.SftyErrInfo.SftyErr_6 autosar_swc_val_rtARID_DEF.TmpSignalConversionAtFM_SAF_OUT_FM_SAF_OUTOutport1.SftyErrInfo.SftyErr_7 /end REF_MEASUREMENT
/end GROUP
/begin GROUP autosar_swc_val_rtARID_DEF.TmpSignalConversionAtFM_SAF_OUT_FM_SAF_OUTOutport1.SftyErrInfoQue[0] ""
 /begin REF_MEASUREMENT autosar_swc_val_rtARID_DEF.TmpSignalConversionAtFM_SAF_OUT_FM_SAF_OUTOutport1.SftyErrInfoQue[0].SftyErrID autosar_swc_val_rtARID_DEF.TmpSignalConversionAtFM_SAF_OUT_FM_SAF_OUTOutport1.SftyErrInfoQue[0].TrigTimeStamp /end REF_MEASUREMENT
/end GROUP
/begin GROUP autosar_swc_val_rtARID_DEF.TmpSignalConversionAtIF_sysEPS_4_sysEPS_4Outport1 ""
 /begin REF_MEASUREMENT autosar_swc_val_rtARID_DEF.TmpSignalConversionAtIF_sysEPS_4_sysEPS_4Outport1.EPS_4_CRC1 autosar_swc_val_rtARID_DEF.TmpSignalConversionAtIF_sysEPS_4_sysEPS_4Outport1.EPS_4_RollgCntr1 autosar_swc_val_rtARID_DEF.TmpSignalConversionAtIF_sysEPS_4_sysEPS_4Outport1.EPS_4_Resd1 autosar_swc_val_rtARID_DEF.TmpSignalConversionAtIF_sysEPS_4_sysEPS_4Outport1.EPS_4_AgParkCtrlAvl autosar_swc_val_rtARID_DEF.TmpSignalConversionAtIF_sysEPS_4_sysEPS_4Outport1.EPS_4_AgPilotCtrlAvl autosar_swc_val_rtARID_DEF.TmpSignalConversionAtIF_sysEPS_4_sysEPS_4Outport1.EPS_4_AgPilotCtrlSts autosar_swc_val_rtARID_DEF.TmpSignalConversionAtIF_sysEPS_4_sysEPS_4Outport1.EPS_4_TqCtrlAvl autosar_swc_val_rtARID_DEF.TmpSignalConversionAtIF_sysEPS_4_sysEPS_4Outport1.EPS_4_TqCtrlSts autosar_swc_val_rtARID_DEF.TmpSignalConversionAtIF_sysEPS_4_sysEPS_4Outport1.EPS_4_LdwWarnSts autosar_swc_val_rtARID_DEF.TmpSignalConversionAtIF_sysEPS_4_sysEPS_4Outport1.EPS_4_LdwWarnStsVD autosar_swc_val_rtARID_DEF.TmpSignalConversionAtIF_sysEPS_4_sysEPS_4Outport1.EPS_4_AgParkCtrlSts autosar_swc_val_rtARID_DEF.TmpSignalConversionAtIF_sysEPS_4_sysEPS_4Outport1.EPS_4_CRC2 autosar_swc_val_rtARID_DEF.TmpSignalConversionAtIF_sysEPS_4_sysEPS_4Outport1.EPS_4_RollgCntr2 autosar_swc_val_rtARID_DEF.TmpSignalConversionAtIF_sysEPS_4_sysEPS_4Outport1.EPS_4_Resd2 autosar_swc_val_rtARID_DEF.TmpSignalConversionAtIF_sysEPS_4_sysEPS_4Outport1.EPS_4_SteerPinionTq autosar_swc_val_rtARID_DEF.TmpSignalConversionAtIF_sysEPS_4_sysEPS_4Outport1.EPS_4_SteerPinionTqVld autosar_swc_val_rtARID_DEF.TmpSignalConversionAtIF_sysEPS_4_sysEPS_4Outport1.EPS_4_AsscMotCrtTq autosar_swc_val_rtARID_DEF.TmpSignalConversionAtIF_sysEPS_4_sysEPS_4Outport1.EPS_4_AsscMotCrtTqVld autosar_swc_val_rtARID_DEF.TmpSignalConversionAtIF_sysEPS_4_sysEPS_4Outport1.EPS_4_CRC3 autosar_swc_val_rtARID_DEF.TmpSignalConversionAtIF_sysEPS_4_sysEPS_4Outport1.EPS_4_RollgCntr3 autosar_swc_val_rtARID_DEF.TmpSignalConversionAtIF_sysEPS_4_sysEPS_4Outport1.EPS_4_Resd3 autosar_swc_val_rtARID_DEF.TmpSignalConversionAtIF_sysEPS_4_sysEPS_4Outport1.EPS_4_SteerDrvrOvrd autosar_swc_val_rtARID_DEF.TmpSignalConversionAtIF_sysEPS_4_sysEPS_4Outport1.EPS_4_SteerDrvrOvrdVld autosar_swc_val_rtARID_DEF.TmpSignalConversionAtIF_sysEPS_4_sysEPS_4Outport1.EPS_4_SteerMod autosar_swc_val_rtARID_DEF.TmpSignalConversionAtIF_sysEPS_4_sysEPS_4Outport1.EPS_4_CRC4 autosar_swc_val_rtARID_DEF.TmpSignalConversionAtIF_sysEPS_4_sysEPS_4Outport1.EPS_4_RollgCntr4 autosar_swc_val_rtARID_DEF.TmpSignalConversionAtIF_sysEPS_4_sysEPS_4Outport1.EPS_4_Resd4 autosar_swc_val_rtARID_DEF.TmpSignalConversionAtIF_sysEPS_4_sysEPS_4Outport1.EPS_4_Tq2 autosar_swc_val_rtARID_DEF.TmpSignalConversionAtIF_sysEPS_4_sysEPS_4Outport1.EPS_4_CRC5 autosar_swc_val_rtARID_DEF.TmpSignalConversionAtIF_sysEPS_4_sysEPS_4Outport1.EPS_4_RollgCntr5 autosar_swc_val_rtARID_DEF.TmpSignalConversionAtIF_sysEPS_4_sysEPS_4Outport1.EPS_4_Resd5 autosar_swc_val_rtARID_DEF.TmpSignalConversionAtIF_sysEPS_4_sysEPS_4Outport1.EPS_4_OverrangeFeedback autosar_swc_val_rtARID_DEF.TmpSignalConversionAtIF_sysEPS_4_sysEPS_4Outport1.EPS_4_ADSMaxTq autosar_swc_val_rtARID_DEF.TmpSignalConversionAtIF_sysEPS_4_sysEPS_4Outport1.EPS_4_ADSMinTq autosar_swc_val_rtARID_DEF.TmpSignalConversionAtIF_sysEPS_4_sysEPS_4Outport1.EPS_4_OverrangeFeedbackVD /end REF_MEASUREMENT
/end GROUP
/begin GROUP autosar_swc_val_rtARID_DEF.TmpSignalConversionAtIF_sysONEBOX_5_sysONEBOX_5Outport1 ""
 /begin REF_MEASUREMENT autosar_swc_val_rtARID_DEF.TmpSignalConversionAtIF_sysONEBOX_5_sysONEBOX_5Outport1.ONEBOX_5_CRC1 autosar_swc_val_rtARID_DEF.TmpSignalConversionAtIF_sysONEBOX_5_sysONEBOX_5Outport1.ONEBOX_5_RollgCntr1 autosar_swc_val_rtARID_DEF.TmpSignalConversionAtIF_sysONEBOX_5_sysONEBOX_5Outport1.ONEBOX_5_Resd1 autosar_swc_val_rtARID_DEF.TmpSignalConversionAtIF_sysONEBOX_5_sysONEBOX_5Outport1.ONEBOX_5_PilotParkBrkDecCtlAvl autosar_swc_val_rtARID_DEF.TmpSignalConversionAtIF_sysONEBOX_5_sysONEBOX_5Outport1.ONEBOX_5_PilotParkBrkDecActSts autosar_swc_val_rtARID_DEF.TmpSignalConversionAtIF_sysONEBOX_5_sysONEBOX_5Outport1.ONEBOX_5_CddAdcActiveVehHld autosar_swc_val_rtARID_DEF.TmpSignalConversionAtIF_sysONEBOX_5_sysONEBOX_5Outport1.ONEBOX_5_APCFailureSts autosar_swc_val_rtARID_DEF.TmpSignalConversionAtIF_sysONEBOX_5_sysONEBOX_5Outport1.ONEBOX_5_APCStatus autosar_swc_val_rtARID_DEF.TmpSignalConversionAtIF_sysONEBOX_5_sysONEBOX_5Outport1.ONEBOX_5_ApaAvl autosar_swc_val_rtARID_DEF.TmpSignalConversionAtIF_sysONEBOX_5_sysONEBOX_5Outport1.ONEBOX_5_RpaAvl autosar_swc_val_rtARID_DEF.TmpSignalConversionAtIF_sysONEBOX_5_sysONEBOX_5Outport1.ONEBOX_5_MebAvl autosar_swc_val_rtARID_DEF.TmpSignalConversionAtIF_sysONEBOX_5_sysONEBOX_5Outport1.ONEBOX_5_CddApActiveVehHld autosar_swc_val_rtARID_DEF.TmpSignalConversionAtIF_sysONEBOX_5_sysONEBOX_5Outport1.ONEBOX_5_SysBrkP autosar_swc_val_rtARID_DEF.TmpSignalConversionAtIF_sysONEBOX_5_sysONEBOX_5Outport1.ONEBOX_5_SysBrkPVld autosar_swc_val_rtARID_DEF.TmpSignalConversionAtIF_sysONEBOX_5_sysONEBOX_5Outport1.ONEBOX_5_AbpActSts autosar_swc_val_rtARID_DEF.TmpSignalConversionAtIF_sysONEBOX_5_sysONEBOX_5Outport1.ONEBOX_5_AbpAvlSts autosar_swc_val_rtARID_DEF.TmpSignalConversionAtIF_sysONEBOX_5_sysONEBOX_5Outport1.ONEBOX_5_AwbActSts autosar_swc_val_rtARID_DEF.TmpSignalConversionAtIF_sysONEBOX_5_sysONEBOX_5Outport1.ONEBOX_5_AwbAvlSts autosar_swc_val_rtARID_DEF.TmpSignalConversionAtIF_sysONEBOX_5_sysONEBOX_5Outport1.ONEBOX_5_AbaActSts autosar_swc_val_rtARID_DEF.TmpSignalConversionAtIF_sysONEBOX_5_sysONEBOX_5Outport1.ONEBOX_5_AbaAvlSts autosar_swc_val_rtARID_DEF.TmpSignalConversionAtIF_sysONEBOX_5_sysONEBOX_5Outport1.ONEBOX_5_AbaLvlSts /end REF_MEASUREMENT
/end GROUP
/begin GROUP autosar_swc_val_rtARID_DEF.TmpSignalConversionAtIF_sysVCU_ADCC_12_sysVCU_ADCC_12Outport1 ""
 /begin REF_MEASUREMENT autosar_swc_val_rtARID_DEF.TmpSignalConversionAtIF_sysVCU_ADCC_12_sysVCU_ADCC_12Outport1.VCU_12_CRC1 autosar_swc_val_rtARID_DEF.TmpSignalConversionAtIF_sysVCU_ADCC_12_sysVCU_ADCC_12Outport1.VCU_12_RollgCntr1 autosar_swc_val_rtARID_DEF.TmpSignalConversionAtIF_sysVCU_ADCC_12_sysVCU_ADCC_12Outport1.VCU_12_Resd1 autosar_swc_val_rtARID_DEF.TmpSignalConversionAtIF_sysVCU_ADCC_12_sysVCU_ADCC_12Outport1.VCU_12_DrvrGearIntervention autosar_swc_val_rtARID_DEF.TmpSignalConversionAtIF_sysVCU_ADCC_12_sysVCU_ADCC_12Outport1.VCU_12_PtTqActvSts autosar_swc_val_rtARID_DEF.TmpSignalConversionAtIF_sysVCU_ADCC_12_sysVCU_ADCC_12Outport1.VCU_12_PtTqAvl autosar_swc_val_rtARID_DEF.TmpSignalConversionAtIF_sysVCU_ADCC_12_sysVCU_ADCC_12Outport1.VCU_12_DriverTorqueDesired autosar_swc_val_rtARID_DEF.TmpSignalConversionAtIF_sysVCU_ADCC_12_sysVCU_ADCC_12Outport1.VCU_12_DrvrAccrPedlOvrd autosar_swc_val_rtARID_DEF.TmpSignalConversionAtIF_sysVCU_ADCC_12_sysVCU_ADCC_12Outport1.VCU_12_VehWhlActTq autosar_swc_val_rtARID_DEF.TmpSignalConversionAtIF_sysVCU_ADCC_12_sysVCU_ADCC_12Outport1.VCU_12_VehWhlActTqVld autosar_swc_val_rtARID_DEF.TmpSignalConversionAtIF_sysVCU_ADCC_12_sysVCU_ADCC_12Outport1.VCU_12_CRC2 autosar_swc_val_rtARID_DEF.TmpSignalConversionAtIF_sysVCU_ADCC_12_sysVCU_ADCC_12Outport1.VCU_12_RollgCntr2 autosar_swc_val_rtARID_DEF.TmpSignalConversionAtIF_sysVCU_ADCC_12_sysVCU_ADCC_12Outport1.VCU_12_Resd2 autosar_swc_val_rtARID_DEF.TmpSignalConversionAtIF_sysVCU_ADCC_12_sysVCU_ADCC_12Outport1.VCU_12_PtTqMax autosar_swc_val_rtARID_DEF.TmpSignalConversionAtIF_sysVCU_ADCC_12_sysVCU_ADCC_12Outport1.VCU_12_PtTqMaxVld autosar_swc_val_rtARID_DEF.TmpSignalConversionAtIF_sysVCU_ADCC_12_sysVCU_ADCC_12Outport1.VCU_12_GasPedalInhabition autosar_swc_val_rtARID_DEF.TmpSignalConversionAtIF_sysVCU_ADCC_12_sysVCU_ADCC_12Outport1.VCU_12_CRC3 autosar_swc_val_rtARID_DEF.TmpSignalConversionAtIF_sysVCU_ADCC_12_sysVCU_ADCC_12Outport1.VCU_12_RollgCntr3 autosar_swc_val_rtARID_DEF.TmpSignalConversionAtIF_sysVCU_ADCC_12_sysVCU_ADCC_12Outport1.VCU_12_Resd3 autosar_swc_val_rtARID_DEF.TmpSignalConversionAtIF_sysVCU_ADCC_12_sysVCU_ADCC_12Outport1.VCU_12_VehWhlActTqADS autosar_swc_val_rtARID_DEF.TmpSignalConversionAtIF_sysVCU_ADCC_12_sysVCU_ADCC_12Outport1.VCU_12_VehWhlActTqADSVld /end REF_MEASUREMENT
/end GROUP
/end MODULE
/end PROJECT
