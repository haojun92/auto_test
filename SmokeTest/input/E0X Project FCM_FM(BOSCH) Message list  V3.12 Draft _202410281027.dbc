VERSION ""

NS_ :

BS_:

BU_: ADCC_FM_4X

BO_ 1027 FRM_56: 64 Vector__XXX
 SG_ FRM_56_CRC : 7|16@0+ (1,0) [0|65535] ""  ADCC_FM_4X
 SG_ FRM_56_RollgCntr : 23|8@0+ (1,0) [0|255] ""  ADCC_FM_4X
 SG_ FRM_56_DetnBlockCounter : 27|4@0+ (1,0) [0|15] ""  ADCC_FM_4X
 SG_ FRM_56_DetnMotionSts_198 : 29|2@0+ (1,0) [0|3] ""  ADCC_FM_4X
 SG_ FRM_56_DetnRngRadial_198 : 39|15@0+ (0.01,0) [0|200] "m"  ADCC_FM_4X
 SG_ FRM_56_DetnAziAngle_198 : 40|11@0+ (0.1,-90) [-90|90] "deg"  ADCC_FM_4X
 SG_ FRM_56_DetnElevnAngle_198 : 61|8@0+ (0.1,-10) [-10|10] "deg"  ADCC_FM_4X
 SG_ FRM_56_DetnRelVelRadial_198 : 69|15@0+ (0.01,-100) [-100|80] "m/s"  ADCC_FM_4X
 SG_ FRM_56_DetnSNR_198 : 86|7@0+ (1,0) [0|100] "dB"  ADCC_FM_4X
 SG_ FRM_56_DetnRCS_198 : 95|15@0+ (0.01,-50) [-50|128] "dBsm"  ADCC_FM_4X
 SG_ FRM_56_DetnQuality_198 : 96|4@0+ (10,0) [0|100] "%"  ADCC_FM_4X
 SG_ FRM_56_DetnMotionSts_199 : 31|2@0+ (1,0) [0|3] ""  ADCC_FM_4X
 SG_ FRM_56_DetnRngRadial_199 : 108|15@0+ (0.01,0) [0|200] "m"  ADCC_FM_4X
 SG_ FRM_56_DetnAziAngle_199 : 125|11@0+ (0.1,-90) [-90|90] "deg"  ADCC_FM_4X
 SG_ FRM_56_DetnElevnAngle_199 : 130|8@0+ (0.1,-10) [-10|10] "deg"  ADCC_FM_4X
 SG_ FRM_56_DetnRelVelRadial_199 : 138|15@0+ (0.01,-100) [-100|80] "m/s"  ADCC_FM_4X
 SG_ FRM_56_DetnSNR_199 : 155|7@0+ (1,0) [0|100] "dB"  ADCC_FM_4X
 SG_ FRM_56_DetnRCS_199 : 164|15@0+ (0.01,-50) [-50|128] "dBsm"  ADCC_FM_4X
 SG_ FRM_56_DetnQuality_199 : 181|4@0+ (10,0) [0|100] "%"  ADCC_FM_4X
 SG_ FRM_56_DetnMotionSts_200 : 177|2@0+ (1,0) [0|3] ""  ADCC_FM_4X
 SG_ FRM_56_DetnRngRadial_200 : 191|15@0+ (0.01,0) [0|200] "m"  ADCC_FM_4X
 SG_ FRM_56_DetnAziAngle_200 : 192|11@0+ (0.1,-90) [-90|90] "deg"  ADCC_FM_4X
 SG_ FRM_56_DetnElevnAngle_200 : 213|8@0+ (0.1,-10) [-10|10] "deg"  ADCC_FM_4X
 SG_ FRM_56_DetnRelVelRadial_200 : 221|15@0+ (0.01,-100) [-100|80] "m/s"  ADCC_FM_4X
 SG_ FRM_56_DetnSNR_200 : 238|7@0+ (1,0) [0|100] "dB"  ADCC_FM_4X
 SG_ FRM_56_DetnRCS_200 : 247|15@0+ (0.01,-50) [-50|128] "dBsm"  ADCC_FM_4X
 SG_ FRM_56_DetnQuality_200 : 248|4@0+ (10,0) [0|100] "%"  ADCC_FM_4X
 SG_ FRM_56_DetnMotionSts_201 : 260|2@0+ (1,0) [0|3] ""  ADCC_FM_4X
 SG_ FRM_56_DetnRngRadial_201 : 258|15@0+ (0.01,0) [0|200] "m"  ADCC_FM_4X
 SG_ FRM_56_DetnAziAngle_201 : 275|11@0+ (0.1,-90) [-90|90] "deg"  ADCC_FM_4X
 SG_ FRM_56_DetnElevnAngle_201 : 280|8@0+ (0.1,-10) [-10|10] "deg"  ADCC_FM_4X
 SG_ FRM_56_DetnRelVelRadial_201 : 288|15@0+ (0.01,-100) [-100|80] "m/s"  ADCC_FM_4X
 SG_ FRM_56_DetnSNR_201 : 305|7@0+ (1,0) [0|100] "dB"  ADCC_FM_4X
 SG_ FRM_56_DetnRCS_201 : 314|15@0+ (0.01,-50) [-50|128] "dBsm"  ADCC_FM_4X
 SG_ FRM_56_DetnQuality_201 : 331|4@0+ (10,0) [0|100] "%"  ADCC_FM_4X
 SG_ FRM_56_DetnMotionSts_202 : 343|2@0+ (1,0) [0|3] ""  ADCC_FM_4X
 SG_ FRM_56_DetnRngRadial_202 : 341|15@0+ (0.01,0) [0|200] "m"  ADCC_FM_4X
 SG_ FRM_56_DetnAziAngle_202 : 358|11@0+ (0.1,-90) [-90|90] "deg"  ADCC_FM_4X
 SG_ FRM_56_DetnElevnAngle_202 : 363|8@0+ (0.1,-10) [-10|10] "deg"  ADCC_FM_4X
 SG_ FRM_56_DetnRelVelRadial_202 : 371|15@0+ (0.01,-100) [-100|80] "m/s"  ADCC_FM_4X
 SG_ FRM_56_DetnSNR_202 : 388|7@0+ (1,0) [0|100] "dB"  ADCC_FM_4X
 SG_ FRM_56_DetnRCS_202 : 397|15@0+ (0.01,-50) [-50|128] "dBsm"  ADCC_FM_4X
 SG_ FRM_56_DetnQuality_202 : 414|4@0+ (10,0) [0|100] "%"  ADCC_FM_4X
 SG_ FRM_56_DetnMotionSts_203 : 410|2@0+ (1,0) [0|3] ""  ADCC_FM_4X
 SG_ FRM_56_DetnRngRadial_203 : 408|15@0+ (0.01,0) [0|200] "m"  ADCC_FM_4X
 SG_ FRM_56_DetnAziAngle_203 : 425|11@0+ (0.1,-90) [-90|90] "deg"  ADCC_FM_4X
 SG_ FRM_56_DetnElevnAngle_203 : 446|8@0+ (0.1,-10) [-10|10] "deg"  ADCC_FM_4X
 SG_ FRM_56_DetnRelVelRadial_203 : 454|15@0+ (0.01,-100) [-100|80] "m/s"  ADCC_FM_4X
 SG_ FRM_56_DetnSNR_203 : 471|7@0+ (1,0) [0|100] "dB"  ADCC_FM_4X
 SG_ FRM_56_DetnRCS_203 : 464|15@0+ (0.01,-50) [-50|128] "dBsm"  ADCC_FM_4X
 SG_ FRM_56_DetnQuality_203 : 481|4@0+ (10,0) [0|100] "%"  ADCC_FM_4X
 SG_ FRM_56_Loc198_Valid : 488|1@0+ (1,0) [0|1] ""  ADCC_FM_4X
 SG_ FRM_56_Loc199_Valid : 489|1@0+ (1,0) [0|1] ""  ADCC_FM_4X
 SG_ FRM_56_Loc200_Valid : 490|1@0+ (1,0) [0|1] ""  ADCC_FM_4X
 SG_ FRM_56_Loc201_Valid : 491|1@0+ (1,0) [0|1] ""  ADCC_FM_4X
 SG_ FRM_56_Loc202_Valid : 492|1@0+ (1,0) [0|1] ""  ADCC_FM_4X
 SG_ FRM_56_Loc203_Valid : 493|1@0+ (1,0) [0|1] ""  ADCC_FM_4X

BO_ 1028 FRM_57: 64 Vector__XXX
 SG_ FRM_57_CRC : 7|16@0+ (1,0) [0|65535] ""  ADCC_FM_4X
 SG_ FRM_57_RollgCntr : 23|8@0+ (1,0) [0|255] ""  ADCC_FM_4X
 SG_ FRM_57_DetnBlockCounter : 27|4@0+ (1,0) [0|15] ""  ADCC_FM_4X
 SG_ FRM_57_DetnMotionSts_204 : 29|2@0+ (1,0) [0|3] ""  ADCC_FM_4X
 SG_ FRM_57_DetnRngRadial_204 : 39|15@0+ (0.01,0) [0|200] "m"  ADCC_FM_4X
 SG_ FRM_57_DetnAziAngle_204 : 40|11@0+ (0.1,-90) [-90|90] "deg"  ADCC_FM_4X
 SG_ FRM_57_DetnElevnAngle_204 : 61|8@0+ (0.1,-10) [-10|10] "deg"  ADCC_FM_4X
 SG_ FRM_57_DetnRelVelRadial_204 : 69|15@0+ (0.01,-100) [-100|80] "m/s"  ADCC_FM_4X
 SG_ FRM_57_DetnSNR_204 : 86|7@0+ (1,0) [0|100] "dB"  ADCC_FM_4X
 SG_ FRM_57_DetnRCS_204 : 95|15@0+ (0.01,-50) [-50|128] "dBsm"  ADCC_FM_4X
 SG_ FRM_57_DetnQuality_204 : 96|4@0+ (10,0) [0|100] "%"  ADCC_FM_4X
 SG_ FRM_57_DetnMotionSts_205 : 31|2@0+ (1,0) [0|3] ""  ADCC_FM_4X
 SG_ FRM_57_DetnRngRadial_205 : 108|15@0+ (0.01,0) [0|200] "m"  ADCC_FM_4X
 SG_ FRM_57_DetnAziAngle_205 : 125|11@0+ (0.1,-90) [-90|90] "deg"  ADCC_FM_4X
 SG_ FRM_57_DetnElevnAngle_205 : 130|8@0+ (0.1,-10) [-10|10] "deg"  ADCC_FM_4X
 SG_ FRM_57_DetnRelVelRadial_205 : 138|15@0+ (0.01,-100) [-100|80] "m/s"  ADCC_FM_4X
 SG_ FRM_57_DetnSNR_205 : 155|7@0+ (1,0) [0|100] "dB"  ADCC_FM_4X
 SG_ FRM_57_DetnRCS_205 : 164|15@0+ (0.01,-50) [-50|128] "dBsm"  ADCC_FM_4X
 SG_ FRM_57_DetnQuality_205 : 181|4@0+ (10,0) [0|100] "%"  ADCC_FM_4X
 SG_ FRM_57_DetnMotionSts_206 : 177|2@0+ (1,0) [0|3] ""  ADCC_FM_4X
 SG_ FRM_57_DetnRngRadial_206 : 191|15@0+ (0.01,0) [0|200] "m"  ADCC_FM_4X
 SG_ FRM_57_DetnAziAngle_206 : 192|11@0+ (0.1,-90) [-90|90] "deg"  ADCC_FM_4X
 SG_ FRM_57_DetnElevnAngle_206 : 213|8@0+ (0.1,-10) [-10|10] "deg"  ADCC_FM_4X
 SG_ FRM_57_DetnRelVelRadial_206 : 221|15@0+ (0.01,-100) [-100|80] "m/s"  ADCC_FM_4X
 SG_ FRM_57_DetnSNR_206 : 238|7@0+ (1,0) [0|100] "dB"  ADCC_FM_4X
 SG_ FRM_57_DetnRCS_206 : 247|15@0+ (0.01,-50) [-50|128] "dBsm"  ADCC_FM_4X
 SG_ FRM_57_DetnQuality_206 : 248|4@0+ (10,0) [0|100] "%"  ADCC_FM_4X
 SG_ FRM_57_DetnMotionSts_207 : 260|2@0+ (1,0) [0|3] ""  ADCC_FM_4X
 SG_ FRM_57_DetnRngRadial_207 : 258|15@0+ (0.01,0) [0|200] "m"  ADCC_FM_4X
 SG_ FRM_57_DetnAziAngle_207 : 275|11@0+ (0.1,-90) [-90|90] "deg"  ADCC_FM_4X
 SG_ FRM_57_DetnElevnAngle_207 : 280|8@0+ (0.1,-10) [-10|10] "deg"  ADCC_FM_4X
 SG_ FRM_57_DetnRelVelRadial_207 : 288|15@0+ (0.01,-100) [-100|80] "m/s"  ADCC_FM_4X
 SG_ FRM_57_DetnSNR_207 : 305|7@0+ (1,0) [0|100] "dB"  ADCC_FM_4X
 SG_ FRM_57_DetnRCS_207 : 314|15@0+ (0.01,-50) [-50|128] "dBsm"  ADCC_FM_4X
 SG_ FRM_57_DetnQuality_207 : 331|4@0+ (10,0) [0|100] "%"  ADCC_FM_4X
 SG_ FRM_57_DetnMotionSts_208 : 343|2@0+ (1,0) [0|3] ""  ADCC_FM_4X
 SG_ FRM_57_DetnRngRadial_208 : 341|15@0+ (0.01,0) [0|200] "m"  ADCC_FM_4X
 SG_ FRM_57_DetnAziAngle_208 : 358|11@0+ (0.1,-90) [-90|90] "deg"  ADCC_FM_4X
 SG_ FRM_57_DetnElevnAngle_208 : 363|8@0+ (0.1,-10) [-10|10] "deg"  ADCC_FM_4X
 SG_ FRM_57_DetnRelVelRadial_208 : 371|15@0+ (0.01,-100) [-100|80] "m/s"  ADCC_FM_4X
 SG_ FRM_57_DetnSNR_208 : 388|7@0+ (1,0) [0|100] "dB"  ADCC_FM_4X
 SG_ FRM_57_DetnRCS_208 : 397|15@0+ (0.01,-50) [-50|128] "dBsm"  ADCC_FM_4X
 SG_ FRM_57_DetnQuality_208 : 414|4@0+ (10,0) [0|100] "%"  ADCC_FM_4X
 SG_ FRM_57_DetnMotionSts_209 : 410|2@0+ (1,0) [0|3] ""  ADCC_FM_4X
 SG_ FRM_57_DetnRngRadial_209 : 408|15@0+ (0.01,0) [0|200] "m"  ADCC_FM_4X
 SG_ FRM_57_DetnAziAngle_209 : 425|11@0+ (0.1,-90) [-90|90] "deg"  ADCC_FM_4X
 SG_ FRM_57_DetnElevnAngle_209 : 446|8@0+ (0.1,-10) [-10|10] "deg"  ADCC_FM_4X
 SG_ FRM_57_DetnRelVelRadial_209 : 454|15@0+ (0.01,-100) [-100|80] "m/s"  ADCC_FM_4X
 SG_ FRM_57_DetnSNR_209 : 471|7@0+ (1,0) [0|100] "dB"  ADCC_FM_4X
 SG_ FRM_57_DetnRCS_209 : 464|15@0+ (0.01,-50) [-50|128] "dBsm"  ADCC_FM_4X
 SG_ FRM_57_DetnQuality_209 : 481|4@0+ (10,0) [0|100] "%"  ADCC_FM_4X
 SG_ FRM_57_Loc204_Valid : 488|1@0+ (1,0) [0|1] ""  ADCC_FM_4X
 SG_ FRM_57_Loc205_Valid : 489|1@0+ (1,0) [0|1] ""  ADCC_FM_4X
 SG_ FRM_57_Loc206_Valid : 490|1@0+ (1,0) [0|1] ""  ADCC_FM_4X
 SG_ FRM_57_Loc207_Valid : 491|1@0+ (1,0) [0|1] ""  ADCC_FM_4X
 SG_ FRM_57_Loc208_Valid : 492|1@0+ (1,0) [0|1] ""  ADCC_FM_4X
 SG_ FRM_57_Loc209_Valid : 493|1@0+ (1,0) [0|1] ""  ADCC_FM_4X

BO_ 1029 FRM_58: 64 Vector__XXX
 SG_ FRM_58_CRC : 7|16@0+ (1,0) [0|65535] ""  ADCC_FM_4X
 SG_ FRM_58_RollgCntr : 23|8@0+ (1,0) [0|255] ""  ADCC_FM_4X
 SG_ FRM_58_DetnBlockCounter : 27|4@0+ (1,0) [0|15] ""  ADCC_FM_4X
 SG_ FRM_58_DetnMotionSts_210 : 29|2@0+ (1,0) [0|3] ""  ADCC_FM_4X
 SG_ FRM_58_DetnRngRadial_210 : 39|15@0+ (0.01,0) [0|200] "m"  ADCC_FM_4X
 SG_ FRM_58_DetnAziAngle_210 : 40|11@0+ (0.1,-90) [-90|90] "deg"  ADCC_FM_4X
 SG_ FRM_58_DetnElevnAngle_210 : 61|8@0+ (0.1,-10) [-10|10] "deg"  ADCC_FM_4X
 SG_ FRM_58_DetnRelVelRadial_210 : 69|15@0+ (0.01,-100) [-100|80] "m/s"  ADCC_FM_4X
 SG_ FRM_58_DetnSNR_210 : 86|7@0+ (1,0) [0|100] "dB"  ADCC_FM_4X
 SG_ FRM_58_DetnRCS_210 : 95|15@0+ (0.01,-50) [-50|128] "dBsm"  ADCC_FM_4X
 SG_ FRM_58_DetnQuality_210 : 96|4@0+ (10,0) [0|100] "%"  ADCC_FM_4X
 SG_ FRM_58_DetnMotionSts_211 : 31|2@0+ (1,0) [0|3] ""  ADCC_FM_4X
 SG_ FRM_58_DetnRngRadial_211 : 108|15@0+ (0.01,0) [0|200] "m"  ADCC_FM_4X
 SG_ FRM_58_DetnAziAngle_211 : 125|11@0+ (0.1,-90) [-90|90] "deg"  ADCC_FM_4X
 SG_ FRM_58_DetnElevnAngle_211 : 130|8@0+ (0.1,-10) [-10|10] "deg"  ADCC_FM_4X
 SG_ FRM_58_DetnRelVelRadial_211 : 138|15@0+ (0.01,-100) [-100|80] "m/s"  ADCC_FM_4X
 SG_ FRM_58_DetnSNR_211 : 155|7@0+ (1,0) [0|100] "dB"  ADCC_FM_4X
 SG_ FRM_58_DetnRCS_211 : 164|15@0+ (0.01,-50) [-50|128] "dBsm"  ADCC_FM_4X
 SG_ FRM_58_DetnQuality_211 : 181|4@0+ (10,0) [0|100] "%"  ADCC_FM_4X
 SG_ FRM_58_DetnMotionSts_212 : 177|2@0+ (1,0) [0|3] ""  ADCC_FM_4X
 SG_ FRM_58_DetnRngRadial_212 : 191|15@0+ (0.01,0) [0|200] "m"  ADCC_FM_4X
 SG_ FRM_58_DetnAziAngle_212 : 192|11@0+ (0.1,-90) [-90|90] "deg"  ADCC_FM_4X
 SG_ FRM_58_DetnElevnAngle_212 : 213|8@0+ (0.1,-10) [-10|10] "deg"  ADCC_FM_4X
 SG_ FRM_58_DetnRelVelRadial_212 : 221|15@0+ (0.01,-100) [-100|80] "m/s"  ADCC_FM_4X
 SG_ FRM_58_DetnSNR_212 : 238|7@0+ (1,0) [0|100] "dB"  ADCC_FM_4X
 SG_ FRM_58_DetnRCS_212 : 247|15@0+ (0.01,-50) [-50|128] "dBsm"  ADCC_FM_4X
 SG_ FRM_58_DetnQuality_212 : 248|4@0+ (10,0) [0|100] "%"  ADCC_FM_4X
 SG_ FRM_58_DetnMotionSts_213 : 260|2@0+ (1,0) [0|3] ""  ADCC_FM_4X
 SG_ FRM_58_DetnRngRadial_213 : 258|15@0+ (0.01,0) [0|200] "m"  ADCC_FM_4X
 SG_ FRM_58_DetnAziAngle_213 : 275|11@0+ (0.1,-90) [-90|90] "deg"  ADCC_FM_4X
 SG_ FRM_58_DetnElevnAngle_213 : 280|8@0+ (0.1,-10) [-10|10] "deg"  ADCC_FM_4X
 SG_ FRM_58_DetnRelVelRadial_213 : 288|15@0+ (0.01,-100) [-100|80] "m/s"  ADCC_FM_4X
 SG_ FRM_58_DetnSNR_213 : 305|7@0+ (1,0) [0|100] "dB"  ADCC_FM_4X
 SG_ FRM_58_DetnRCS_213 : 314|15@0+ (0.01,-50) [-50|128] "dBsm"  ADCC_FM_4X
 SG_ FRM_58_DetnQuality_213 : 331|4@0+ (10,0) [0|100] "%"  ADCC_FM_4X
 SG_ FRM_58_DetnMotionSts_214 : 343|2@0+ (1,0) [0|3] ""  ADCC_FM_4X
 SG_ FRM_58_DetnRngRadial_214 : 341|15@0+ (0.01,0) [0|200] "m"  ADCC_FM_4X
 SG_ FRM_58_DetnAziAngle_214 : 358|11@0+ (0.1,-90) [-90|90] "deg"  ADCC_FM_4X
 SG_ FRM_58_DetnElevnAngle_214 : 363|8@0+ (0.1,-10) [-10|10] "deg"  ADCC_FM_4X
 SG_ FRM_58_DetnRelVelRadial_214 : 371|15@0+ (0.01,-100) [-100|80] "m/s"  ADCC_FM_4X
 SG_ FRM_58_DetnSNR_214 : 388|7@0+ (1,0) [0|100] "dB"  ADCC_FM_4X
 SG_ FRM_58_DetnRCS_214 : 397|15@0+ (0.01,-50) [-50|128] "dBsm"  ADCC_FM_4X
 SG_ FRM_58_DetnQuality_214 : 414|4@0+ (10,0) [0|100] "%"  ADCC_FM_4X
 SG_ FRM_58_DetnMotionSts_215 : 410|2@0+ (1,0) [0|3] ""  ADCC_FM_4X
 SG_ FRM_58_DetnRngRadial_215 : 408|15@0+ (0.01,0) [0|200] "m"  ADCC_FM_4X
 SG_ FRM_58_DetnAziAngle_215 : 425|11@0+ (0.1,-90) [-90|90] "deg"  ADCC_FM_4X
 SG_ FRM_58_DetnElevnAngle_215 : 446|8@0+ (0.1,-10) [-10|10] "deg"  ADCC_FM_4X
 SG_ FRM_58_DetnRelVelRadial_215 : 454|15@0+ (0.01,-100) [-100|80] "m/s"  ADCC_FM_4X
 SG_ FRM_58_DetnSNR_215 : 471|7@0+ (1,0) [0|100] "dB"  ADCC_FM_4X
 SG_ FRM_58_DetnRCS_215 : 464|15@0+ (0.01,-50) [-50|128] "dBsm"  ADCC_FM_4X
 SG_ FRM_58_DetnQuality_215 : 481|4@0+ (10,0) [0|100] "%"  ADCC_FM_4X
 SG_ FRM_58_Loc210_Valid : 488|1@0+ (1,0) [0|1] ""  ADCC_FM_4X
 SG_ FRM_58_Loc211_Valid : 489|1@0+ (1,0) [0|1] ""  ADCC_FM_4X
 SG_ FRM_58_Loc212_Valid : 490|1@0+ (1,0) [0|1] ""  ADCC_FM_4X
 SG_ FRM_58_Loc213_Valid : 491|1@0+ (1,0) [0|1] ""  ADCC_FM_4X
 SG_ FRM_58_Loc214_Valid : 492|1@0+ (1,0) [0|1] ""  ADCC_FM_4X
 SG_ FRM_58_Loc215_Valid : 493|1@0+ (1,0) [0|1] ""  ADCC_FM_4X

BO_ 1030 FRM_59: 64 Vector__XXX
 SG_ FRM_59_CRC : 7|16@0+ (1,0) [0|65535] ""  ADCC_FM_4X
 SG_ FRM_59_RollgCntr : 23|8@0+ (1,0) [0|255] ""  ADCC_FM_4X
 SG_ FRM_59_DetnBlockCounter : 27|4@0+ (1,0) [0|15] ""  ADCC_FM_4X
 SG_ FRM_59_DetnMotionSts_216 : 29|2@0+ (1,0) [0|3] ""  ADCC_FM_4X
 SG_ FRM_59_DetnRngRadial_216 : 39|15@0+ (0.01,0) [0|200] "m"  ADCC_FM_4X
 SG_ FRM_59_DetnAziAngle_216 : 40|11@0+ (0.1,-90) [-90|90] "deg"  ADCC_FM_4X
 SG_ FRM_59_DetnElevnAngle_216 : 61|8@0+ (0.1,-10) [-10|10] "deg"  ADCC_FM_4X
 SG_ FRM_59_DetnRelVelRadial_216 : 69|15@0+ (0.01,-100) [-100|80] "m/s"  ADCC_FM_4X
 SG_ FRM_59_DetnSNR_216 : 86|7@0+ (1,0) [0|100] "dB"  ADCC_FM_4X
 SG_ FRM_59_DetnRCS_216 : 95|15@0+ (0.01,-50) [-50|128] "dBsm"  ADCC_FM_4X
 SG_ FRM_59_DetnQuality_216 : 96|4@0+ (10,0) [0|100] "%"  ADCC_FM_4X
 SG_ FRM_59_DetnMotionSts_217 : 31|2@0+ (1,0) [0|3] ""  ADCC_FM_4X
 SG_ FRM_59_DetnRngRadial_217 : 108|15@0+ (0.01,0) [0|200] "m"  ADCC_FM_4X
 SG_ FRM_59_DetnAziAngle_217 : 125|11@0+ (0.1,-90) [-90|90] "deg"  ADCC_FM_4X
 SG_ FRM_59_DetnElevnAngle_217 : 130|8@0+ (0.1,-10) [-10|10] "deg"  ADCC_FM_4X
 SG_ FRM_59_DetnRelVelRadial_217 : 138|15@0+ (0.01,-100) [-100|80] "m/s"  ADCC_FM_4X
 SG_ FRM_59_DetnSNR_217 : 155|7@0+ (1,0) [0|100] "dB"  ADCC_FM_4X
 SG_ FRM_59_DetnRCS_217 : 164|15@0+ (0.01,-50) [-50|128] "dBsm"  ADCC_FM_4X
 SG_ FRM_59_DetnQuality_217 : 181|4@0+ (10,0) [0|100] "%"  ADCC_FM_4X
 SG_ FRM_59_DetnMotionSts_218 : 177|2@0+ (1,0) [0|3] ""  ADCC_FM_4X
 SG_ FRM_59_DetnRngRadial_218 : 191|15@0+ (0.01,0) [0|200] "m"  ADCC_FM_4X
 SG_ FRM_59_DetnAziAngle_218 : 192|11@0+ (0.1,-90) [-90|90] "deg"  ADCC_FM_4X
 SG_ FRM_59_DetnElevnAngle_218 : 213|8@0+ (0.1,-10) [-10|10] "deg"  ADCC_FM_4X
 SG_ FRM_59_DetnRelVelRadial_218 : 221|15@0+ (0.01,-100) [-100|80] "m/s"  ADCC_FM_4X
 SG_ FRM_59_DetnSNR_218 : 238|7@0+ (1,0) [0|100] "dB"  ADCC_FM_4X
 SG_ FRM_59_DetnRCS_218 : 247|15@0+ (0.01,-50) [-50|128] "dBsm"  ADCC_FM_4X
 SG_ FRM_59_DetnQuality_218 : 248|4@0+ (10,0) [0|100] "%"  ADCC_FM_4X
 SG_ FRM_59_DetnMotionSts_219 : 260|2@0+ (1,0) [0|3] ""  ADCC_FM_4X
 SG_ FRM_59_DetnRngRadial_219 : 258|15@0+ (0.01,0) [0|200] "m"  ADCC_FM_4X
 SG_ FRM_59_DetnAziAngle_219 : 275|11@0+ (0.1,-90) [-90|90] "deg"  ADCC_FM_4X
 SG_ FRM_59_DetnElevnAngle_219 : 280|8@0+ (0.1,-10) [-10|10] "deg"  ADCC_FM_4X
 SG_ FRM_59_DetnRelVelRadial_219 : 288|15@0+ (0.01,-100) [-100|80] "m/s"  ADCC_FM_4X
 SG_ FRM_59_DetnSNR_219 : 305|7@0+ (1,0) [0|100] "dB"  ADCC_FM_4X
 SG_ FRM_59_DetnRCS_219 : 314|15@0+ (0.01,-50) [-50|128] "dBsm"  ADCC_FM_4X
 SG_ FRM_59_DetnQuality_219 : 331|4@0+ (10,0) [0|100] "%"  ADCC_FM_4X
 SG_ FRM_59_DetnMotionSts_220 : 343|2@0+ (1,0) [0|3] ""  ADCC_FM_4X
 SG_ FRM_59_DetnRngRadial_220 : 341|15@0+ (0.01,0) [0|200] "m"  ADCC_FM_4X
 SG_ FRM_59_DetnAziAngle_220 : 358|11@0+ (0.1,-90) [-90|90] "deg"  ADCC_FM_4X
 SG_ FRM_59_DetnElevnAngle_220 : 363|8@0+ (0.1,-10) [-10|10] "deg"  ADCC_FM_4X
 SG_ FRM_59_DetnRelVelRadial_220 : 371|15@0+ (0.01,-100) [-100|80] "m/s"  ADCC_FM_4X
 SG_ FRM_59_DetnSNR_220 : 388|7@0+ (1,0) [0|100] "dB"  ADCC_FM_4X
 SG_ FRM_59_DetnRCS_220 : 397|15@0+ (0.01,-50) [-50|128] "dBsm"  ADCC_FM_4X
 SG_ FRM_59_DetnQuality_220 : 414|4@0+ (10,0) [0|100] "%"  ADCC_FM_4X
 SG_ FRM_59_DetnMotionSts_221 : 410|2@0+ (1,0) [0|3] ""  ADCC_FM_4X
 SG_ FRM_59_DetnRngRadial_221 : 408|15@0+ (0.01,0) [0|200] "m"  ADCC_FM_4X
 SG_ FRM_59_DetnAziAngle_221 : 425|11@0+ (0.1,-90) [-90|90] "deg"  ADCC_FM_4X
 SG_ FRM_59_DetnElevnAngle_221 : 446|8@0+ (0.1,-10) [-10|10] "deg"  ADCC_FM_4X
 SG_ FRM_59_DetnRelVelRadial_221 : 454|15@0+ (0.01,-100) [-100|80] "m/s"  ADCC_FM_4X
 SG_ FRM_59_DetnSNR_221 : 471|7@0+ (1,0) [0|100] "dB"  ADCC_FM_4X
 SG_ FRM_59_DetnRCS_221 : 464|15@0+ (0.01,-50) [-50|128] "dBsm"  ADCC_FM_4X
 SG_ FRM_59_DetnQuality_221 : 481|4@0+ (10,0) [0|100] "%"  ADCC_FM_4X
 SG_ FRM_59_Loc216_Valid : 488|1@0+ (1,0) [0|1] ""  ADCC_FM_4X
 SG_ FRM_59_Loc217_Valid : 489|1@0+ (1,0) [0|1] ""  ADCC_FM_4X
 SG_ FRM_59_Loc218_Valid : 490|1@0+ (1,0) [0|1] ""  ADCC_FM_4X
 SG_ FRM_59_Loc219_Valid : 491|1@0+ (1,0) [0|1] ""  ADCC_FM_4X
 SG_ FRM_59_Loc220_Valid : 492|1@0+ (1,0) [0|1] ""  ADCC_FM_4X
 SG_ FRM_59_Loc221_Valid : 493|1@0+ (1,0) [0|1] ""  ADCC_FM_4X

BO_ 1031 FRM_60: 64 Vector__XXX
 SG_ FRM_60_CRC : 7|16@0+ (1,0) [0|65535] ""  ADCC_FM_4X
 SG_ FRM_60_RollgCntr : 23|8@0+ (1,0) [0|255] ""  ADCC_FM_4X
 SG_ FRM_60_DetnBlockCounter : 27|4@0+ (1,0) [0|15] ""  ADCC_FM_4X
 SG_ FRM_60_DetnMotionSts_222 : 29|2@0+ (1,0) [0|3] ""  ADCC_FM_4X
 SG_ FRM_60_DetnRngRadial_222 : 39|15@0+ (0.01,0) [0|200] "m"  ADCC_FM_4X
 SG_ FRM_60_DetnAziAngle_222 : 40|11@0+ (0.1,-90) [-90|90] "deg"  ADCC_FM_4X
 SG_ FRM_60_DetnElevnAngle_222 : 61|8@0+ (0.1,-10) [-10|10] "deg"  ADCC_FM_4X
 SG_ FRM_60_DetnRelVelRadial_222 : 69|15@0+ (0.01,-100) [-100|80] "m/s"  ADCC_FM_4X
 SG_ FRM_60_DetnSNR_222 : 86|7@0+ (1,0) [0|100] "dB"  ADCC_FM_4X
 SG_ FRM_60_DetnRCS_222 : 95|15@0+ (0.01,-50) [-50|128] "dBsm"  ADCC_FM_4X
 SG_ FRM_60_DetnQuality_222 : 96|4@0+ (10,0) [0|100] "%"  ADCC_FM_4X
 SG_ FRM_60_DetnMotionSts_223 : 31|2@0+ (1,0) [0|3] ""  ADCC_FM_4X
 SG_ FRM_60_DetnRngRadial_223 : 108|15@0+ (0.01,0) [0|200] "m"  ADCC_FM_4X
 SG_ FRM_60_DetnAziAngle_223 : 125|11@0+ (0.1,-90) [-90|90] "deg"  ADCC_FM_4X
 SG_ FRM_60_DetnElevnAngle_223 : 130|8@0+ (0.1,-10) [-10|10] "deg"  ADCC_FM_4X
 SG_ FRM_60_DetnRelVelRadial_223 : 138|15@0+ (0.01,-100) [-100|80] "m/s"  ADCC_FM_4X
 SG_ FRM_60_DetnSNR_223 : 155|7@0+ (1,0) [0|100] "dB"  ADCC_FM_4X
 SG_ FRM_60_DetnRCS_223 : 164|15@0+ (0.01,-50) [-50|128] "dBsm"  ADCC_FM_4X
 SG_ FRM_60_DetnQuality_223 : 181|4@0+ (10,0) [0|100] "%"  ADCC_FM_4X
 SG_ FRM_60_DetnMotionSts_224 : 177|2@0+ (1,0) [0|3] ""  ADCC_FM_4X
 SG_ FRM_60_DetnRngRadial_224 : 191|15@0+ (0.01,0) [0|200] "m"  ADCC_FM_4X
 SG_ FRM_60_DetnAziAngle_224 : 192|11@0+ (0.1,-90) [-90|90] "deg"  ADCC_FM_4X
 SG_ FRM_60_DetnElevnAngle_224 : 213|8@0+ (0.1,-10) [-10|10] "deg"  ADCC_FM_4X
 SG_ FRM_60_DetnRelVelRadial_224 : 221|15@0+ (0.01,-100) [-100|80] "m/s"  ADCC_FM_4X
 SG_ FRM_60_DetnSNR_224 : 238|7@0+ (1,0) [0|100] "dB"  ADCC_FM_4X
 SG_ FRM_60_DetnRCS_224 : 247|15@0+ (0.01,-50) [-50|128] "dBsm"  ADCC_FM_4X
 SG_ FRM_60_DetnQuality_224 : 248|4@0+ (10,0) [0|100] "%"  ADCC_FM_4X
 SG_ FRM_60_DetnMotionSts_225 : 260|2@0+ (1,0) [0|3] ""  ADCC_FM_4X
 SG_ FRM_60_DetnRngRadial_225 : 258|15@0+ (0.01,0) [0|200] "m"  ADCC_FM_4X
 SG_ FRM_60_DetnAziAngle_225 : 275|11@0+ (0.1,-90) [-90|90] "deg"  ADCC_FM_4X
 SG_ FRM_60_DetnElevnAngle_225 : 280|8@0+ (0.1,-10) [-10|10] "deg"  ADCC_FM_4X
 SG_ FRM_60_DetnRelVelRadial_225 : 288|15@0+ (0.01,-100) [-100|80] "m/s"  ADCC_FM_4X
 SG_ FRM_60_DetnSNR_225 : 305|7@0+ (1,0) [0|100] "dB"  ADCC_FM_4X
 SG_ FRM_60_DetnRCS_225 : 314|15@0+ (0.01,-50) [-50|128] "dBsm"  ADCC_FM_4X
 SG_ FRM_60_DetnQuality_225 : 331|4@0+ (10,0) [0|100] "%"  ADCC_FM_4X
 SG_ FRM_60_DetnMotionSts_226 : 343|2@0+ (1,0) [0|3] ""  ADCC_FM_4X
 SG_ FRM_60_DetnRngRadial_226 : 341|15@0+ (0.01,0) [0|200] "m"  ADCC_FM_4X
 SG_ FRM_60_DetnAziAngle_226 : 358|11@0+ (0.1,-90) [-90|90] "deg"  ADCC_FM_4X
 SG_ FRM_60_DetnElevnAngle_226 : 363|8@0+ (0.1,-10) [-10|10] "deg"  ADCC_FM_4X
 SG_ FRM_60_DetnRelVelRadial_226 : 371|15@0+ (0.01,-100) [-100|80] "m/s"  ADCC_FM_4X
 SG_ FRM_60_DetnSNR_226 : 388|7@0+ (1,0) [0|100] "dB"  ADCC_FM_4X
 SG_ FRM_60_DetnRCS_226 : 397|15@0+ (0.01,-50) [-50|128] "dBsm"  ADCC_FM_4X
 SG_ FRM_60_DetnQuality_226 : 414|4@0+ (10,0) [0|100] "%"  ADCC_FM_4X
 SG_ FRM_60_DetnMotionSts_227 : 410|2@0+ (1,0) [0|3] ""  ADCC_FM_4X
 SG_ FRM_60_DetnRngRadial_227 : 408|15@0+ (0.01,0) [0|200] "m"  ADCC_FM_4X
 SG_ FRM_60_DetnAziAngle_227 : 425|11@0+ (0.1,-90) [-90|90] "deg"  ADCC_FM_4X
 SG_ FRM_60_DetnElevnAngle_227 : 446|8@0+ (0.1,-10) [-10|10] "deg"  ADCC_FM_4X
 SG_ FRM_60_DetnRelVelRadial_227 : 454|15@0+ (0.01,-100) [-100|80] "m/s"  ADCC_FM_4X
 SG_ FRM_60_DetnSNR_227 : 471|7@0+ (1,0) [0|100] "dB"  ADCC_FM_4X
 SG_ FRM_60_DetnRCS_227 : 464|15@0+ (0.01,-50) [-50|128] "dBsm"  ADCC_FM_4X
 SG_ FRM_60_DetnQuality_227 : 481|4@0+ (10,0) [0|100] "%"  ADCC_FM_4X
 SG_ FRM_60_Loc222_Valid : 488|1@0+ (1,0) [0|1] ""  ADCC_FM_4X
 SG_ FRM_60_Loc223_Valid : 489|1@0+ (1,0) [0|1] ""  ADCC_FM_4X
 SG_ FRM_60_Loc224_Valid : 490|1@0+ (1,0) [0|1] ""  ADCC_FM_4X
 SG_ FRM_60_Loc225_Valid : 491|1@0+ (1,0) [0|1] ""  ADCC_FM_4X
 SG_ FRM_60_Loc226_Valid : 492|1@0+ (1,0) [0|1] ""  ADCC_FM_4X
 SG_ FRM_60_Loc227_Valid : 493|1@0+ (1,0) [0|1] ""  ADCC_FM_4X

BO_ 1032 FRM_61: 64 Vector__XXX
 SG_ FRM_61_CRC : 7|16@0+ (1,0) [0|65535] ""  ADCC_FM_4X
 SG_ FRM_61_RollgCntr : 23|8@0+ (1,0) [0|255] ""  ADCC_FM_4X
 SG_ FRM_61_DetnBlockCounter : 27|4@0+ (1,0) [0|15] ""  ADCC_FM_4X
 SG_ FRM_61_DetnMotionSts_228 : 29|2@0+ (1,0) [0|3] ""  ADCC_FM_4X
 SG_ FRM_61_DetnRngRadial_228 : 39|15@0+ (0.01,0) [0|200] "m"  ADCC_FM_4X
 SG_ FRM_61_DetnAziAngle_228 : 40|11@0+ (0.1,-90) [-90|90] "deg"  ADCC_FM_4X
 SG_ FRM_61_DetnElevnAngle_228 : 61|8@0+ (0.1,-10) [-10|10] "deg"  ADCC_FM_4X
 SG_ FRM_61_DetnRelVelRadial_228 : 69|15@0+ (0.01,-100) [-100|80] "m/s"  ADCC_FM_4X
 SG_ FRM_61_DetnSNR_228 : 86|7@0+ (1,0) [0|100] "dB"  ADCC_FM_4X
 SG_ FRM_61_DetnRCS_228 : 95|15@0+ (0.01,-50) [-50|128] "dBsm"  ADCC_FM_4X
 SG_ FRM_61_DetnQuality_228 : 96|4@0+ (10,0) [0|100] "%"  ADCC_FM_4X
 SG_ FRM_61_DetnMotionSts_229 : 31|2@0+ (1,0) [0|3] ""  ADCC_FM_4X
 SG_ FRM_61_DetnRngRadial_229 : 108|15@0+ (0.01,0) [0|200] "m"  ADCC_FM_4X
 SG_ FRM_61_DetnAziAngle_229 : 125|11@0+ (0.1,-90) [-90|90] "deg"  ADCC_FM_4X
 SG_ FRM_61_DetnElevnAngle_229 : 130|8@0+ (0.1,-10) [-10|10] "deg"  ADCC_FM_4X
 SG_ FRM_61_DetnRelVelRadial_229 : 138|15@0+ (0.01,-100) [-100|80] "m/s"  ADCC_FM_4X
 SG_ FRM_61_DetnSNR_229 : 155|7@0+ (1,0) [0|100] "dB"  ADCC_FM_4X
 SG_ FRM_61_DetnRCS_229 : 164|15@0+ (0.01,-50) [-50|128] "dBsm"  ADCC_FM_4X
 SG_ FRM_61_DetnQuality_229 : 181|4@0+ (10,0) [0|100] "%"  ADCC_FM_4X
 SG_ FRM_61_DetnMotionSts_230 : 177|2@0+ (1,0) [0|3] ""  ADCC_FM_4X
 SG_ FRM_61_DetnRngRadial_230 : 191|15@0+ (0.01,0) [0|200] "m"  ADCC_FM_4X
 SG_ FRM_61_DetnAziAngle_230 : 192|11@0+ (0.1,-90) [-90|90] "deg"  ADCC_FM_4X
 SG_ FRM_61_DetnElevnAngle_230 : 213|8@0+ (0.1,-10) [-10|10] "deg"  ADCC_FM_4X
 SG_ FRM_61_DetnRelVelRadial_230 : 221|15@0+ (0.01,-100) [-100|80] "m/s"  ADCC_FM_4X
 SG_ FRM_61_DetnSNR_230 : 238|7@0+ (1,0) [0|100] "dB"  ADCC_FM_4X
 SG_ FRM_61_DetnRCS_230 : 247|15@0+ (0.01,-50) [-50|128] "dBsm"  ADCC_FM_4X
 SG_ FRM_61_DetnQuality_230 : 248|4@0+ (10,0) [0|100] "%"  ADCC_FM_4X
 SG_ FRM_61_DetnMotionSts_231 : 260|2@0+ (1,0) [0|3] ""  ADCC_FM_4X
 SG_ FRM_61_DetnRngRadial_231 : 258|15@0+ (0.01,0) [0|200] "m"  ADCC_FM_4X
 SG_ FRM_61_DetnAziAngle_231 : 275|11@0+ (0.1,-90) [-90|90] "deg"  ADCC_FM_4X
 SG_ FRM_61_DetnElevnAngle_231 : 280|8@0+ (0.1,-10) [-10|10] "deg"  ADCC_FM_4X
 SG_ FRM_61_DetnRelVelRadial_231 : 288|15@0+ (0.01,-100) [-100|80] "m/s"  ADCC_FM_4X
 SG_ FRM_61_DetnSNR_231 : 305|7@0+ (1,0) [0|100] "dB"  ADCC_FM_4X
 SG_ FRM_61_DetnRCS_231 : 314|15@0+ (0.01,-50) [-50|128] "dBsm"  ADCC_FM_4X
 SG_ FRM_61_DetnQuality_231 : 331|4@0+ (10,0) [0|100] "%"  ADCC_FM_4X
 SG_ FRM_61_DetnMotionSts_232 : 343|2@0+ (1,0) [0|3] ""  ADCC_FM_4X
 SG_ FRM_61_DetnRngRadial_232 : 341|15@0+ (0.01,0) [0|200] "m"  ADCC_FM_4X
 SG_ FRM_61_DetnAziAngle_232 : 358|11@0+ (0.1,-90) [-90|90] "deg"  ADCC_FM_4X
 SG_ FRM_61_DetnElevnAngle_232 : 363|8@0+ (0.1,-10) [-10|10] "deg"  ADCC_FM_4X
 SG_ FRM_61_DetnRelVelRadial_232 : 371|15@0+ (0.01,-100) [-100|80] "m/s"  ADCC_FM_4X
 SG_ FRM_61_DetnSNR_232 : 388|7@0+ (1,0) [0|100] "dB"  ADCC_FM_4X
 SG_ FRM_61_DetnRCS_232 : 397|15@0+ (0.01,-50) [-50|128] "dBsm"  ADCC_FM_4X
 SG_ FRM_61_DetnQuality_232 : 414|4@0+ (10,0) [0|100] "%"  ADCC_FM_4X
 SG_ FRM_61_DetnMotionSts_233 : 410|2@0+ (1,0) [0|3] ""  ADCC_FM_4X
 SG_ FRM_61_DetnRngRadial_233 : 408|15@0+ (0.01,0) [0|200] "m"  ADCC_FM_4X
 SG_ FRM_61_DetnAziAngle_233 : 425|11@0+ (0.1,-90) [-90|90] "deg"  ADCC_FM_4X
 SG_ FRM_61_DetnElevnAngle_233 : 446|8@0+ (0.1,-10) [-10|10] "deg"  ADCC_FM_4X
 SG_ FRM_61_DetnRelVelRadial_233 : 454|15@0+ (0.01,-100) [-100|80] "m/s"  ADCC_FM_4X
 SG_ FRM_61_DetnSNR_233 : 471|7@0+ (1,0) [0|100] "dB"  ADCC_FM_4X
 SG_ FRM_61_DetnRCS_233 : 464|15@0+ (0.01,-50) [-50|128] "dBsm"  ADCC_FM_4X
 SG_ FRM_61_DetnQuality_233 : 481|4@0+ (10,0) [0|100] "%"  ADCC_FM_4X
 SG_ FRM_61_Loc228_Valid : 488|1@0+ (1,0) [0|1] ""  ADCC_FM_4X
 SG_ FRM_61_Loc229_Valid : 489|1@0+ (1,0) [0|1] ""  ADCC_FM_4X
 SG_ FRM_61_Loc230_Valid : 490|1@0+ (1,0) [0|1] ""  ADCC_FM_4X
 SG_ FRM_61_Loc231_Valid : 491|1@0+ (1,0) [0|1] ""  ADCC_FM_4X
 SG_ FRM_61_Loc232_Valid : 492|1@0+ (1,0) [0|1] ""  ADCC_FM_4X
 SG_ FRM_61_Loc233_Valid : 493|1@0+ (1,0) [0|1] ""  ADCC_FM_4X

BO_ 1033 FRM_62: 64 Vector__XXX
 SG_ FRM_62_CRC : 7|16@0+ (1,0) [0|65535] ""  ADCC_FM_4X
 SG_ FRM_62_RollgCntr : 23|8@0+ (1,0) [0|255] ""  ADCC_FM_4X
 SG_ FRM_62_DetnBlockCounter : 27|4@0+ (1,0) [0|15] ""  ADCC_FM_4X
 SG_ FRM_62_DetnMotionSts_234 : 29|2@0+ (1,0) [0|3] ""  ADCC_FM_4X
 SG_ FRM_62_DetnRngRadial_234 : 39|15@0+ (0.01,0) [0|200] "m"  ADCC_FM_4X
 SG_ FRM_62_DetnAziAngle_234 : 40|11@0+ (0.1,-90) [-90|90] "deg"  ADCC_FM_4X
 SG_ FRM_62_DetnElevnAngle_234 : 61|8@0+ (0.1,-10) [-10|10] "deg"  ADCC_FM_4X
 SG_ FRM_62_DetnRelVelRadial_234 : 69|15@0+ (0.01,-100) [-100|80] "m/s"  ADCC_FM_4X
 SG_ FRM_62_DetnSNR_234 : 86|7@0+ (1,0) [0|100] "dB"  ADCC_FM_4X
 SG_ FRM_62_DetnRCS_234 : 95|15@0+ (0.01,-50) [-50|128] "dBsm"  ADCC_FM_4X
 SG_ FRM_62_DetnQuality_234 : 96|4@0+ (10,0) [0|100] "%"  ADCC_FM_4X
 SG_ FRM_62_DetnMotionSts_235 : 31|2@0+ (1,0) [0|3] ""  ADCC_FM_4X
 SG_ FRM_62_DetnRngRadial_235 : 108|15@0+ (0.01,0) [0|200] "m"  ADCC_FM_4X
 SG_ FRM_62_DetnAziAngle_235 : 125|11@0+ (0.1,-90) [-90|90] "deg"  ADCC_FM_4X
 SG_ FRM_62_DetnElevnAngle_235 : 130|8@0+ (0.1,-10) [-10|10] "deg"  ADCC_FM_4X
 SG_ FRM_62_DetnRelVelRadial_235 : 138|15@0+ (0.01,-100) [-100|80] "m/s"  ADCC_FM_4X
 SG_ FRM_62_DetnSNR_235 : 155|7@0+ (1,0) [0|100] "dB"  ADCC_FM_4X
 SG_ FRM_62_DetnRCS_235 : 164|15@0+ (0.01,-50) [-50|128] "dBsm"  ADCC_FM_4X
 SG_ FRM_62_DetnQuality_235 : 181|4@0+ (10,0) [0|100] "%"  ADCC_FM_4X
 SG_ FRM_62_DetnMotionSts_236 : 177|2@0+ (1,0) [0|3] ""  ADCC_FM_4X
 SG_ FRM_62_DetnRngRadial_236 : 191|15@0+ (0.01,0) [0|200] "m"  ADCC_FM_4X
 SG_ FRM_62_DetnAziAngle_236 : 192|11@0+ (0.1,-90) [-90|90] "deg"  ADCC_FM_4X
 SG_ FRM_62_DetnElevnAngle_236 : 213|8@0+ (0.1,-10) [-10|10] "deg"  ADCC_FM_4X
 SG_ FRM_62_DetnRelVelRadial_236 : 221|15@0+ (0.01,-100) [-100|80] "m/s"  ADCC_FM_4X
 SG_ FRM_62_DetnSNR_236 : 238|7@0+ (1,0) [0|100] "dB"  ADCC_FM_4X
 SG_ FRM_62_DetnRCS_236 : 247|15@0+ (0.01,-50) [-50|128] "dBsm"  ADCC_FM_4X
 SG_ FRM_62_DetnQuality_236 : 248|4@0+ (10,0) [0|100] "%"  ADCC_FM_4X
 SG_ FRM_62_DetnMotionSts_237 : 260|2@0+ (1,0) [0|3] ""  ADCC_FM_4X
 SG_ FRM_62_DetnRngRadial_237 : 258|15@0+ (0.01,0) [0|200] "m"  ADCC_FM_4X
 SG_ FRM_62_DetnAziAngle_237 : 275|11@0+ (0.1,-90) [-90|90] "deg"  ADCC_FM_4X
 SG_ FRM_62_DetnElevnAngle_237 : 280|8@0+ (0.1,-10) [-10|10] "deg"  ADCC_FM_4X
 SG_ FRM_62_DetnRelVelRadial_237 : 288|15@0+ (0.01,-100) [-100|80] "m/s"  ADCC_FM_4X
 SG_ FRM_62_DetnSNR_237 : 305|7@0+ (1,0) [0|100] "dB"  ADCC_FM_4X
 SG_ FRM_62_DetnRCS_237 : 314|15@0+ (0.01,-50) [-50|128] "dBsm"  ADCC_FM_4X
 SG_ FRM_62_DetnQuality_237 : 331|4@0+ (10,0) [0|100] "%"  ADCC_FM_4X
 SG_ FRM_62_DetnMotionSts_238 : 343|2@0+ (1,0) [0|3] ""  ADCC_FM_4X
 SG_ FRM_62_DetnRngRadial_238 : 341|15@0+ (0.01,0) [0|200] "m"  ADCC_FM_4X
 SG_ FRM_62_DetnAziAngle_238 : 358|11@0+ (0.1,-90) [-90|90] "deg"  ADCC_FM_4X
 SG_ FRM_62_DetnElevnAngle_238 : 363|8@0+ (0.1,-10) [-10|10] "deg"  ADCC_FM_4X
 SG_ FRM_62_DetnRelVelRadial_238 : 371|15@0+ (0.01,-100) [-100|80] "m/s"  ADCC_FM_4X
 SG_ FRM_62_DetnSNR_238 : 388|7@0+ (1,0) [0|100] "dB"  ADCC_FM_4X
 SG_ FRM_62_DetnRCS_238 : 397|15@0+ (0.01,-50) [-50|128] "dBsm"  ADCC_FM_4X
 SG_ FRM_62_DetnQuality_238 : 414|4@0+ (10,0) [0|100] "%"  ADCC_FM_4X
 SG_ FRM_62_DetnMotionSts_239 : 410|2@0+ (1,0) [0|3] ""  ADCC_FM_4X
 SG_ FRM_62_DetnRngRadial_239 : 408|15@0+ (0.01,0) [0|200] "m"  ADCC_FM_4X
 SG_ FRM_62_DetnAziAngle_239 : 425|11@0+ (0.1,-90) [-90|90] "deg"  ADCC_FM_4X
 SG_ FRM_62_DetnElevnAngle_239 : 446|8@0+ (0.1,-10) [-10|10] "deg"  ADCC_FM_4X
 SG_ FRM_62_DetnRelVelRadial_239 : 454|15@0+ (0.01,-100) [-100|80] "m/s"  ADCC_FM_4X
 SG_ FRM_62_DetnSNR_239 : 471|7@0+ (1,0) [0|100] "dB"  ADCC_FM_4X
 SG_ FRM_62_DetnRCS_239 : 464|15@0+ (0.01,-50) [-50|128] "dBsm"  ADCC_FM_4X
 SG_ FRM_62_DetnQuality_239 : 481|4@0+ (10,0) [0|100] "%"  ADCC_FM_4X
 SG_ FRM_62_Loc234_Valid : 488|1@0+ (1,0) [0|1] ""  ADCC_FM_4X
 SG_ FRM_62_Loc235_Valid : 489|1@0+ (1,0) [0|1] ""  ADCC_FM_4X
 SG_ FRM_62_Loc236_Valid : 490|1@0+ (1,0) [0|1] ""  ADCC_FM_4X
 SG_ FRM_62_Loc237_Valid : 491|1@0+ (1,0) [0|1] ""  ADCC_FM_4X
 SG_ FRM_62_Loc238_Valid : 492|1@0+ (1,0) [0|1] ""  ADCC_FM_4X
 SG_ FRM_62_Loc239_Valid : 493|1@0+ (1,0) [0|1] ""  ADCC_FM_4X

BO_ 1040 FRM_63: 64 Vector__XXX
 SG_ FRM_63_CRC : 7|16@0+ (1,0) [0|65535] ""  ADCC_FM_4X
 SG_ FRM_63_RollgCntr : 23|8@0+ (1,0) [0|255] ""  ADCC_FM_4X
 SG_ FRM_63_DetnBlockCounter : 27|4@0+ (1,0) [0|15] ""  ADCC_FM_4X
 SG_ FRM_63_DetnMotionSts_240 : 29|2@0+ (1,0) [0|3] ""  ADCC_FM_4X
 SG_ FRM_63_DetnRngRadial_240 : 39|15@0+ (0.01,0) [0|200] "m"  ADCC_FM_4X
 SG_ FRM_63_DetnAziAngle_240 : 40|11@0+ (0.1,-90) [-90|90] "deg"  ADCC_FM_4X
 SG_ FRM_63_DetnElevnAngle_240 : 61|8@0+ (0.1,-10) [-10|10] "deg"  ADCC_FM_4X
 SG_ FRM_63_DetnRelVelRadial_240 : 69|15@0+ (0.01,-100) [-100|80] "m/s"  ADCC_FM_4X
 SG_ FRM_63_DetnSNR_240 : 86|7@0+ (1,0) [0|100] "dB"  ADCC_FM_4X
 SG_ FRM_63_DetnRCS_240 : 95|15@0+ (0.01,-50) [-50|128] "dBsm"  ADCC_FM_4X
 SG_ FRM_63_DetnQuality_240 : 96|4@0+ (10,0) [0|100] "%"  ADCC_FM_4X
 SG_ FRM_63_DetnMotionSts_241 : 31|2@0+ (1,0) [0|3] ""  ADCC_FM_4X
 SG_ FRM_63_DetnRngRadial_241 : 108|15@0+ (0.01,0) [0|200] "m"  ADCC_FM_4X
 SG_ FRM_63_DetnAziAngle_241 : 125|11@0+ (0.1,-90) [-90|90] "deg"  ADCC_FM_4X
 SG_ FRM_63_DetnElevnAngle_241 : 130|8@0+ (0.1,-10) [-10|10] "deg"  ADCC_FM_4X
 SG_ FRM_63_DetnRelVelRadial_241 : 138|15@0+ (0.01,-100) [-100|80] "m/s"  ADCC_FM_4X
 SG_ FRM_63_DetnSNR_241 : 155|7@0+ (1,0) [0|100] "dB"  ADCC_FM_4X
 SG_ FRM_63_DetnRCS_241 : 164|15@0+ (0.01,-50) [-50|128] "dBsm"  ADCC_FM_4X
 SG_ FRM_63_DetnQuality_241 : 181|4@0+ (10,0) [0|100] "%"  ADCC_FM_4X
 SG_ FRM_63_DetnMotionSts_242 : 177|2@0+ (1,0) [0|3] ""  ADCC_FM_4X
 SG_ FRM_63_DetnRngRadial_242 : 191|15@0+ (0.01,0) [0|200] "m"  ADCC_FM_4X
 SG_ FRM_63_DetnAziAngle_242 : 192|11@0+ (0.1,-90) [-90|90] "deg"  ADCC_FM_4X
 SG_ FRM_63_DetnElevnAngle_242 : 213|8@0+ (0.1,-10) [-10|10] "deg"  ADCC_FM_4X
 SG_ FRM_63_DetnRelVelRadial_242 : 221|15@0+ (0.01,-100) [-100|80] "m/s"  ADCC_FM_4X
 SG_ FRM_63_DetnSNR_242 : 238|7@0+ (1,0) [0|100] "dB"  ADCC_FM_4X
 SG_ FRM_63_DetnRCS_242 : 247|15@0+ (0.01,-50) [-50|128] "dBsm"  ADCC_FM_4X
 SG_ FRM_63_DetnQuality_242 : 248|4@0+ (10,0) [0|100] "%"  ADCC_FM_4X
 SG_ FRM_63_DetnMotionSts_243 : 260|2@0+ (1,0) [0|3] ""  ADCC_FM_4X
 SG_ FRM_63_DetnRngRadial_243 : 258|15@0+ (0.01,0) [0|200] "m"  ADCC_FM_4X
 SG_ FRM_63_DetnAziAngle_243 : 275|11@0+ (0.1,-90) [-90|90] "deg"  ADCC_FM_4X
 SG_ FRM_63_DetnElevnAngle_243 : 280|8@0+ (0.1,-10) [-10|10] "deg"  ADCC_FM_4X
 SG_ FRM_63_DetnRelVelRadial_243 : 288|15@0+ (0.01,-100) [-100|80] "m/s"  ADCC_FM_4X
 SG_ FRM_63_DetnSNR_243 : 305|7@0+ (1,0) [0|100] "dB"  ADCC_FM_4X
 SG_ FRM_63_DetnRCS_243 : 314|15@0+ (0.01,-50) [-50|128] "dBsm"  ADCC_FM_4X
 SG_ FRM_63_DetnQuality_243 : 331|4@0+ (10,0) [0|100] "%"  ADCC_FM_4X
 SG_ FRM_63_DetnMotionSts_244 : 343|2@0+ (1,0) [0|3] ""  ADCC_FM_4X
 SG_ FRM_63_DetnRngRadial_244 : 341|15@0+ (0.01,0) [0|200] "m"  ADCC_FM_4X
 SG_ FRM_63_DetnAziAngle_244 : 358|11@0+ (0.1,-90) [-90|90] "deg"  ADCC_FM_4X
 SG_ FRM_63_DetnElevnAngle_244 : 363|8@0+ (0.1,-10) [-10|10] "deg"  ADCC_FM_4X
 SG_ FRM_63_DetnRelVelRadial_244 : 371|15@0+ (0.01,-100) [-100|80] "m/s"  ADCC_FM_4X
 SG_ FRM_63_DetnSNR_244 : 388|7@0+ (1,0) [0|100] "dB"  ADCC_FM_4X
 SG_ FRM_63_DetnRCS_244 : 397|15@0+ (0.01,-50) [-50|128] "dBsm"  ADCC_FM_4X
 SG_ FRM_63_DetnQuality_244 : 414|4@0+ (10,0) [0|100] "%"  ADCC_FM_4X
 SG_ FRM_63_DetnMotionSts_245 : 410|2@0+ (1,0) [0|3] ""  ADCC_FM_4X
 SG_ FRM_63_DetnRngRadial_245 : 408|15@0+ (0.01,0) [0|200] "m"  ADCC_FM_4X
 SG_ FRM_63_DetnAziAngle_245 : 425|11@0+ (0.1,-90) [-90|90] "deg"  ADCC_FM_4X
 SG_ FRM_63_DetnElevnAngle_245 : 446|8@0+ (0.1,-10) [-10|10] "deg"  ADCC_FM_4X
 SG_ FRM_63_DetnRelVelRadial_245 : 454|15@0+ (0.01,-100) [-100|80] "m/s"  ADCC_FM_4X
 SG_ FRM_63_DetnSNR_245 : 471|7@0+ (1,0) [0|100] "dB"  ADCC_FM_4X
 SG_ FRM_63_DetnRCS_245 : 464|15@0+ (0.01,-50) [-50|128] "dBsm"  ADCC_FM_4X
 SG_ FRM_63_DetnQuality_245 : 481|4@0+ (10,0) [0|100] "%"  ADCC_FM_4X
 SG_ FRM_63_Loc240_Valid : 488|1@0+ (1,0) [0|1] ""  ADCC_FM_4X
 SG_ FRM_63_Loc241_Valid : 489|1@0+ (1,0) [0|1] ""  ADCC_FM_4X
 SG_ FRM_63_Loc242_Valid : 490|1@0+ (1,0) [0|1] ""  ADCC_FM_4X
 SG_ FRM_63_Loc243_Valid : 491|1@0+ (1,0) [0|1] ""  ADCC_FM_4X
 SG_ FRM_63_Loc244_Valid : 492|1@0+ (1,0) [0|1] ""  ADCC_FM_4X
 SG_ FRM_63_Loc245_Valid : 493|1@0+ (1,0) [0|1] ""  ADCC_FM_4X

BO_ 1041 FRM_64: 64 Vector__XXX
 SG_ FRM_64_CRC : 7|16@0+ (1,0) [0|65535] ""  ADCC_FM_4X
 SG_ FRM_64_RollgCntr : 23|8@0+ (1,0) [0|255] ""  ADCC_FM_4X
 SG_ FRM_64_DetnBlockCounter : 27|4@0+ (1,0) [0|15] ""  ADCC_FM_4X
 SG_ FRM_64_DetnMotionSts_246 : 29|2@0+ (1,0) [0|3] ""  ADCC_FM_4X
 SG_ FRM_64_DetnRngRadial_246 : 39|15@0+ (0.01,0) [0|200] "m"  ADCC_FM_4X
 SG_ FRM_64_DetnAziAngle_246 : 40|11@0+ (0.1,-90) [-90|90] "deg"  ADCC_FM_4X
 SG_ FRM_64_DetnElevnAngle_246 : 61|8@0+ (0.1,-10) [-10|10] "deg"  ADCC_FM_4X
 SG_ FRM_64_DetnRelVelRadial_246 : 69|15@0+ (0.01,-100) [-100|80] "m/s"  ADCC_FM_4X
 SG_ FRM_64_DetnSNR_246 : 86|7@0+ (1,0) [0|100] "dB"  ADCC_FM_4X
 SG_ FRM_64_DetnRCS_246 : 95|15@0+ (0.01,-50) [-50|128] "dBsm"  ADCC_FM_4X
 SG_ FRM_64_DetnQuality_246 : 96|4@0+ (10,0) [0|100] "%"  ADCC_FM_4X
 SG_ FRM_64_DetnMotionSts_247 : 31|2@0+ (1,0) [0|3] ""  ADCC_FM_4X
 SG_ FRM_64_DetnRngRadial_247 : 108|15@0+ (0.01,0) [0|200] "m"  ADCC_FM_4X
 SG_ FRM_64_DetnAziAngle_247 : 125|11@0+ (0.1,-90) [-90|90] "deg"  ADCC_FM_4X
 SG_ FRM_64_DetnElevnAngle_247 : 130|8@0+ (0.1,-10) [-10|10] "deg"  ADCC_FM_4X
 SG_ FRM_64_DetnRelVelRadial_247 : 138|15@0+ (0.01,-100) [-100|80] "m/s"  ADCC_FM_4X
 SG_ FRM_64_DetnSNR_247 : 155|7@0+ (1,0) [0|100] "dB"  ADCC_FM_4X
 SG_ FRM_64_DetnRCS_247 : 164|15@0+ (0.01,-50) [-50|128] "dBsm"  ADCC_FM_4X
 SG_ FRM_64_DetnQuality_247 : 181|4@0+ (10,0) [0|100] "%"  ADCC_FM_4X
 SG_ FRM_64_DetnMotionSts_248 : 177|2@0+ (1,0) [0|3] ""  ADCC_FM_4X
 SG_ FRM_64_DetnRngRadial_248 : 191|15@0+ (0.01,0) [0|200] "m"  ADCC_FM_4X
 SG_ FRM_64_DetnAziAngle_248 : 192|11@0+ (0.1,-90) [-90|90] "deg"  ADCC_FM_4X
 SG_ FRM_64_DetnElevnAngle_248 : 213|8@0+ (0.1,-10) [-10|10] "deg"  ADCC_FM_4X
 SG_ FRM_64_DetnRelVelRadial_248 : 221|15@0+ (0.01,-100) [-100|80] "m/s"  ADCC_FM_4X
 SG_ FRM_64_DetnSNR_248 : 238|7@0+ (1,0) [0|100] "dB"  ADCC_FM_4X
 SG_ FRM_64_DetnRCS_248 : 247|15@0+ (0.01,-50) [-50|128] "dBsm"  ADCC_FM_4X
 SG_ FRM_64_DetnQuality_248 : 248|4@0+ (10,0) [0|100] "%"  ADCC_FM_4X
 SG_ FRM_64_DetnMotionSts_249 : 260|2@0+ (1,0) [0|3] ""  ADCC_FM_4X
 SG_ FRM_64_DetnRngRadial_249 : 258|15@0+ (0.01,0) [0|200] "m"  ADCC_FM_4X
 SG_ FRM_64_DetnAziAngle_249 : 275|11@0+ (0.1,-90) [-90|90] "deg"  ADCC_FM_4X
 SG_ FRM_64_DetnElevnAngle_249 : 280|8@0+ (0.1,-10) [-10|10] "deg"  ADCC_FM_4X
 SG_ FRM_64_DetnRelVelRadial_249 : 288|15@0+ (0.01,-100) [-100|80] "m/s"  ADCC_FM_4X
 SG_ FRM_64_DetnSNR_249 : 305|7@0+ (1,0) [0|100] "dB"  ADCC_FM_4X
 SG_ FRM_64_DetnRCS_249 : 314|15@0+ (0.01,-50) [-50|128] "dBsm"  ADCC_FM_4X
 SG_ FRM_64_DetnQuality_249 : 331|4@0+ (10,0) [0|100] "%"  ADCC_FM_4X
 SG_ FRM_64_DetnMotionSts_250 : 343|2@0+ (1,0) [0|3] ""  ADCC_FM_4X
 SG_ FRM_64_DetnRngRadial_250 : 341|15@0+ (0.01,0) [0|200] "m"  ADCC_FM_4X
 SG_ FRM_64_DetnAziAngle_250 : 358|11@0+ (0.1,-90) [-90|90] "deg"  ADCC_FM_4X
 SG_ FRM_64_DetnElevnAngle_250 : 363|8@0+ (0.1,-10) [-10|10] "deg"  ADCC_FM_4X
 SG_ FRM_64_DetnRelVelRadial_250 : 371|15@0+ (0.01,-100) [-100|80] "m/s"  ADCC_FM_4X
 SG_ FRM_64_DetnSNR_250 : 388|7@0+ (1,0) [0|100] "dB"  ADCC_FM_4X
 SG_ FRM_64_DetnRCS_250 : 397|15@0+ (0.01,-50) [-50|128] "dBsm"  ADCC_FM_4X
 SG_ FRM_64_DetnQuality_250 : 414|4@0+ (10,0) [0|100] "%"  ADCC_FM_4X
 SG_ FRM_64_DetnMotionSts_251 : 410|2@0+ (1,0) [0|3] ""  ADCC_FM_4X
 SG_ FRM_64_DetnRngRadial_251 : 408|15@0+ (0.01,0) [0|200] "m"  ADCC_FM_4X
 SG_ FRM_64_DetnAziAngle_251 : 425|11@0+ (0.1,-90) [-90|90] "deg"  ADCC_FM_4X
 SG_ FRM_64_DetnElevnAngle_251 : 446|8@0+ (0.1,-10) [-10|10] "deg"  ADCC_FM_4X
 SG_ FRM_64_DetnRelVelRadial_251 : 454|15@0+ (0.01,-100) [-100|80] "m/s"  ADCC_FM_4X
 SG_ FRM_64_DetnSNR_251 : 471|7@0+ (1,0) [0|100] "dB"  ADCC_FM_4X
 SG_ FRM_64_DetnRCS_251 : 464|15@0+ (0.01,-50) [-50|128] "dBsm"  ADCC_FM_4X
 SG_ FRM_64_DetnQuality_251 : 481|4@0+ (10,0) [0|100] "%"  ADCC_FM_4X
 SG_ FRM_64_Loc246_Valid : 488|1@0+ (1,0) [0|1] ""  ADCC_FM_4X
 SG_ FRM_64_Loc247_Valid : 489|1@0+ (1,0) [0|1] ""  ADCC_FM_4X
 SG_ FRM_64_Loc248_Valid : 490|1@0+ (1,0) [0|1] ""  ADCC_FM_4X
 SG_ FRM_64_Loc249_Valid : 491|1@0+ (1,0) [0|1] ""  ADCC_FM_4X
 SG_ FRM_64_Loc250_Valid : 492|1@0+ (1,0) [0|1] ""  ADCC_FM_4X
 SG_ FRM_64_Loc251_Valid : 493|1@0+ (1,0) [0|1] ""  ADCC_FM_4X

BO_ 1042 FRM_65: 64 Vector__XXX
 SG_ FRM_65_CRC : 7|16@0+ (1,0) [0|65535] ""  ADCC_FM_4X
 SG_ FRM_65_RollgCntr : 23|8@0+ (1,0) [0|255] ""  ADCC_FM_4X
 SG_ FRM_65_DetnBlockCounter : 27|4@0+ (1,0) [0|15] ""  ADCC_FM_4X
 SG_ FRM_65_DetnMotionSts_252 : 29|2@0+ (1,0) [0|3] ""  ADCC_FM_4X
 SG_ FRM_65_DetnRngRadial_252 : 39|15@0+ (0.01,0) [0|200] "m"  ADCC_FM_4X
 SG_ FRM_65_DetnAziAngle_252 : 40|11@0+ (0.1,-90) [-90|90] "deg"  ADCC_FM_4X
 SG_ FRM_65_DetnElevnAngle_252 : 61|8@0+ (0.1,-10) [-10|10] "deg"  ADCC_FM_4X
 SG_ FRM_65_DetnRelVelRadial_252 : 69|15@0+ (0.01,-100) [-100|80] "m/s"  ADCC_FM_4X
 SG_ FRM_65_DetnSNR_252 : 86|7@0+ (1,0) [0|100] "dB"  ADCC_FM_4X
 SG_ FRM_65_DetnRCS_252 : 95|15@0+ (0.01,-50) [-50|128] "dBsm"  ADCC_FM_4X
 SG_ FRM_65_DetnQuality_252 : 96|4@0+ (10,0) [0|100] "%"  ADCC_FM_4X
 SG_ FRM_65_DetnMotionSts_253 : 31|2@0+ (1,0) [0|3] ""  ADCC_FM_4X
 SG_ FRM_65_DetnRngRadial_253 : 108|15@0+ (0.01,0) [0|200] "m"  ADCC_FM_4X
 SG_ FRM_65_DetnAziAngle_253 : 125|11@0+ (0.1,-90) [-90|90] "deg"  ADCC_FM_4X
 SG_ FRM_65_DetnElevnAngle_253 : 130|8@0+ (0.1,-10) [-10|10] "deg"  ADCC_FM_4X
 SG_ FRM_65_DetnRelVelRadial_253 : 138|15@0+ (0.01,-100) [-100|80] "m/s"  ADCC_FM_4X
 SG_ FRM_65_DetnSNR_253 : 155|7@0+ (1,0) [0|100] "dB"  ADCC_FM_4X
 SG_ FRM_65_DetnRCS_253 : 164|15@0+ (0.01,-50) [-50|128] "dBsm"  ADCC_FM_4X
 SG_ FRM_65_DetnQuality_253 : 181|4@0+ (10,0) [0|100] "%"  ADCC_FM_4X
 SG_ FRM_65_DetnMotionSts_254 : 177|2@0+ (1,0) [0|3] ""  ADCC_FM_4X
 SG_ FRM_65_DetnRngRadial_254 : 191|15@0+ (0.01,0) [0|200] "m"  ADCC_FM_4X
 SG_ FRM_65_DetnAziAngle_254 : 192|11@0+ (0.1,-90) [-90|90] "deg"  ADCC_FM_4X
 SG_ FRM_65_DetnElevnAngle_254 : 213|8@0+ (0.1,-10) [-10|10] "deg"  ADCC_FM_4X
 SG_ FRM_65_DetnRelVelRadial_254 : 221|15@0+ (0.01,-100) [-100|80] "m/s"  ADCC_FM_4X
 SG_ FRM_65_DetnSNR_254 : 238|7@0+ (1,0) [0|100] "dB"  ADCC_FM_4X
 SG_ FRM_65_DetnRCS_254 : 247|15@0+ (0.01,-50) [-50|128] "dBsm"  ADCC_FM_4X
 SG_ FRM_65_DetnQuality_254 : 248|4@0+ (10,0) [0|100] "%"  ADCC_FM_4X
 SG_ FRM_65_DetnMotionSts_255 : 260|2@0+ (1,0) [0|3] ""  ADCC_FM_4X
 SG_ FRM_65_DetnRngRadial_255 : 258|15@0+ (0.01,0) [0|200] "m"  ADCC_FM_4X
 SG_ FRM_65_DetnAziAngle_255 : 275|11@0+ (0.1,-90) [-90|90] "deg"  ADCC_FM_4X
 SG_ FRM_65_DetnElevnAngle_255 : 280|8@0+ (0.1,-10) [-10|10] "deg"  ADCC_FM_4X
 SG_ FRM_65_DetnRelVelRadial_255 : 288|15@0+ (0.01,-100) [-100|80] "m/s"  ADCC_FM_4X
 SG_ FRM_65_DetnSNR_255 : 305|7@0+ (1,0) [0|100] "dB"  ADCC_FM_4X
 SG_ FRM_65_DetnRCS_255 : 314|15@0+ (0.01,-50) [-50|128] "dBsm"  ADCC_FM_4X
 SG_ FRM_65_DetnQuality_255 : 331|4@0+ (10,0) [0|100] "%"  ADCC_FM_4X
 SG_ FRM_65_Loc252_Valid : 488|1@0+ (1,0) [0|1] ""  ADCC_FM_4X
 SG_ FRM_65_Loc253_Valid : 489|1@0+ (1,0) [0|1] ""  ADCC_FM_4X
 SG_ FRM_65_Loc254_Valid : 490|1@0+ (1,0) [0|1] ""  ADCC_FM_4X
 SG_ FRM_65_Loc255_Valid : 491|1@0+ (1,0) [0|1] ""  ADCC_FM_4X

CM_ BO_ 1027 "禾多配置不发此帧报文";
CM_ BO_ 1028 "禾多配置不发此帧报文";
CM_ BO_ 1029 "禾多配置不发此帧报文";
CM_ BO_ 1030 "禾多配置不发此帧报文";
CM_ BO_ 1031 "禾多配置不发此帧报文";
CM_ BO_ 1032 "禾多配置不发此帧报文";
CM_ BO_ 1033 "禾多配置不发此帧报文";
CM_ BO_ 1040 "禾多配置不发此帧报文";
CM_ BO_ 1041 "禾多配置不发此帧报文";
CM_ BO_ 1042 "禾多配置不发此帧报文";
CM_ SG_ 1027 FRM_56_CRC "Profile5:E2E CRC16 (polynomial:0x1021)       
DataID:Use CANID,other bits Fill with 0";
CM_ SG_ 1027 FRM_56_RollgCntr "Profile5:E2E Rolling message counter";
CM_ SG_ 1027 FRM_56_DetnBlockCounter "Front Radar Moudle_X_Detection Block Counter
前雷达探测点块计数";
CM_ SG_ 1027 FRM_56_DetnMotionSts_198 "Detection point motion status
Front Radar Moudle_X_Detection Motion Status
前雷达探测点运动状态";
CM_ SG_ 1027 FRM_56_DetnRngRadial_198 "Detection point radial distance
Front Radar Moudle_X_Detection Range Radial
前雷达探测点径向距离";
CM_ SG_ 1027 FRM_56_DetnAziAngle_198 "Detection point azimuth angle
Front Radar Moudle_X_Detection Azimuth Angle
前雷达探测点水平方位角";
CM_ SG_ 1027 FRM_56_DetnElevnAngle_198 "Detection point elevation angle
Front Radar Moudle_X_Detection Elevation Angle
前雷达探测点俯仰角";
CM_ SG_ 1027 FRM_56_DetnRelVelRadial_198 "Detection point radial relative velocity
Front Radar Moudle_X_Detection Relative Velocity Radial 
前雷达探测点在径向上的相对速度";
CM_ SG_ 1027 FRM_56_DetnSNR_198 "Detection point signal noise ratio
Front Radar Moudle_X_Detection Signal Noise Ratio
前雷达探测点信号噪声比";
CM_ SG_ 1027 FRM_56_DetnRCS_198 "Detection point radar cross section
Front Radar Moudle_X_Detection Radar Cross Section
前雷达探测点雷达散射截面积";
CM_ SG_ 1027 FRM_56_DetnQuality_198 "Detection point quality
Front Radar Moudle_X_Detection Quality
前雷达探测点质量";
CM_ SG_ 1027 FRM_56_DetnMotionSts_199 "Detection point motion status
Front Radar Moudle_X_Detection Motion Status
前雷达探测点运动状态";
CM_ SG_ 1027 FRM_56_DetnRngRadial_199 "Detection point radial distance
Front Radar Moudle_X_Detection Range Radial
前雷达探测点径向距离";
CM_ SG_ 1027 FRM_56_DetnAziAngle_199 "Detection point azimuth angle
Front Radar Moudle_X_Detection Azimuth Angle
前雷达探测点水平方位角";
CM_ SG_ 1027 FRM_56_DetnElevnAngle_199 "Detection point elevation angle
Front Radar Moudle_X_Detection Elevation Angle
前雷达探测点俯仰角";
CM_ SG_ 1027 FRM_56_DetnRelVelRadial_199 "Detection point radial relative velocity
Front Radar Moudle_X_Detection Relative Velocity Radial 
前雷达探测点在径向上的相对速度";
CM_ SG_ 1027 FRM_56_DetnSNR_199 "Detection point signal noise ratio
Front Radar Moudle_X_Detection Signal Noise Ratio
前雷达探测点信号噪声比";
CM_ SG_ 1027 FRM_56_DetnRCS_199 "Detection point radar cross section
Front Radar Moudle_X_Detection Radar Cross Section
前雷达探测点雷达散射截面积";
CM_ SG_ 1027 FRM_56_DetnQuality_199 "Detection point quality
Front Radar Moudle_X_Detection Quality
前雷达探测点质量";
CM_ SG_ 1027 FRM_56_DetnMotionSts_200 "Detection point motion status
Front Radar Moudle_X_Detection Motion Status
前雷达探测点运动状态";
CM_ SG_ 1027 FRM_56_DetnRngRadial_200 "Detection point radial distance
Front Radar Moudle_X_Detection Range Radial
前雷达探测点径向距离";
CM_ SG_ 1027 FRM_56_DetnAziAngle_200 "Detection point azimuth angle
Front Radar Moudle_X_Detection Azimuth Angle
前雷达探测点水平方位角";
CM_ SG_ 1027 FRM_56_DetnElevnAngle_200 "Detection point elevation angle
Front Radar Moudle_X_Detection Elevation Angle
前雷达探测点俯仰角";
CM_ SG_ 1027 FRM_56_DetnRelVelRadial_200 "Detection point radial relative velocity
Front Radar Moudle_X_Detection Relative Velocity Radial 
前雷达探测点在径向上的相对速度";
CM_ SG_ 1027 FRM_56_DetnSNR_200 "Detection point signal noise ratio
Front Radar Moudle_X_Detection Signal Noise Ratio
前雷达探测点信号噪声比";
CM_ SG_ 1027 FRM_56_DetnRCS_200 "Detection point radar cross section
Front Radar Moudle_X_Detection Radar Cross Section
前雷达探测点雷达散射截面积";
CM_ SG_ 1027 FRM_56_DetnQuality_200 "Detection point quality
Front Radar Moudle_X_Detection Quality
前雷达探测点质量";
CM_ SG_ 1027 FRM_56_DetnMotionSts_201 "Detection point motion status
Front Radar Moudle_X_Detection Motion Status
前雷达探测点运动状态";
CM_ SG_ 1027 FRM_56_DetnRngRadial_201 "Detection point radial distance
Front Radar Moudle_X_Detection Range Radial
前雷达探测点径向距离";
CM_ SG_ 1027 FRM_56_DetnAziAngle_201 "Detection point azimuth angle
Front Radar Moudle_X_Detection Azimuth Angle
前雷达探测点水平方位角";
CM_ SG_ 1027 FRM_56_DetnElevnAngle_201 "Detection point elevation angle
Front Radar Moudle_X_Detection Elevation Angle
前雷达探测点俯仰角";
CM_ SG_ 1027 FRM_56_DetnRelVelRadial_201 "Detection point radial relative velocity
Front Radar Moudle_X_Detection Relative Velocity Radial 
前雷达探测点在径向上的相对速度";
CM_ SG_ 1027 FRM_56_DetnSNR_201 "Detection point signal noise ratio
Front Radar Moudle_X_Detection Signal Noise Ratio
前雷达探测点信号噪声比";
CM_ SG_ 1027 FRM_56_DetnRCS_201 "Detection point radar cross section
Front Radar Moudle_X_Detection Radar Cross Section
前雷达探测点雷达散射截面积";
CM_ SG_ 1027 FRM_56_DetnQuality_201 "Detection point quality
Front Radar Moudle_X_Detection Quality
前雷达探测点质量";
CM_ SG_ 1027 FRM_56_DetnMotionSts_202 "Detection point motion status
Front Radar Moudle_X_Detection Motion Status
前雷达探测点运动状态";
CM_ SG_ 1027 FRM_56_DetnRngRadial_202 "Detection point radial distance
Front Radar Moudle_X_Detection Range Radial
前雷达探测点径向距离";
CM_ SG_ 1027 FRM_56_DetnAziAngle_202 "Detection point azimuth angle
Front Radar Moudle_X_Detection Azimuth Angle
前雷达探测点水平方位角";
CM_ SG_ 1027 FRM_56_DetnElevnAngle_202 "Detection point elevation angle
Front Radar Moudle_X_Detection Elevation Angle
前雷达探测点俯仰角";
CM_ SG_ 1027 FRM_56_DetnRelVelRadial_202 "Detection point radial relative velocity
Front Radar Moudle_X_Detection Relative Velocity Radial 
前雷达探测点在径向上的相对速度";
CM_ SG_ 1027 FRM_56_DetnSNR_202 "Detection point signal noise ratio
Front Radar Moudle_X_Detection Signal Noise Ratio
前雷达探测点信号噪声比";
CM_ SG_ 1027 FRM_56_DetnRCS_202 "Detection point radar cross section
Front Radar Moudle_X_Detection Radar Cross Section
前雷达探测点雷达散射截面积";
CM_ SG_ 1027 FRM_56_DetnQuality_202 "Detection point quality
Front Radar Moudle_X_Detection Quality
前雷达探测点质量";
CM_ SG_ 1027 FRM_56_DetnMotionSts_203 "Detection point motion status
Front Radar Moudle_X_Detection Motion Status
前雷达探测点运动状态";
CM_ SG_ 1027 FRM_56_DetnRngRadial_203 "Detection point radial distance
Front Radar Moudle_X_Detection Range Radial
前雷达探测点径向距离";
CM_ SG_ 1027 FRM_56_DetnAziAngle_203 "Detection point azimuth angle
Front Radar Moudle_X_Detection Azimuth Angle
前雷达探测点水平方位角";
CM_ SG_ 1027 FRM_56_DetnElevnAngle_203 "Detection point elevation angle
Front Radar Moudle_X_Detection Elevation Angle
前雷达探测点俯仰角";
CM_ SG_ 1027 FRM_56_DetnRelVelRadial_203 "Detection point radial relative velocity
Front Radar Moudle_X_Detection Relative Velocity Radial 
前雷达探测点在径向上的相对速度";
CM_ SG_ 1027 FRM_56_DetnSNR_203 "Detection point signal noise ratio
Front Radar Moudle_X_Detection Signal Noise Ratio
前雷达探测点信号噪声比";
CM_ SG_ 1027 FRM_56_DetnRCS_203 "Detection point radar cross section
Front Radar Moudle_X_Detection Radar Cross Section
前雷达探测点雷达散射截面积";
CM_ SG_ 1027 FRM_56_DetnQuality_203 "Detection point quality
Front Radar Moudle_X_Detection Quality
前雷达探测点质量";
CM_ SG_ 1027 FRM_56_Loc198_Valid "the valid flag of each location 
每一点云的有效状态";
CM_ SG_ 1027 FRM_56_Loc199_Valid "the valid flag of each location 
每一点云的有效状态";
CM_ SG_ 1027 FRM_56_Loc200_Valid "the valid flag of each location 
每一点云的有效状态";
CM_ SG_ 1027 FRM_56_Loc201_Valid "the valid flag of each location 
每一点云的有效状态";
CM_ SG_ 1027 FRM_56_Loc202_Valid "the valid flag of each location 
每一点云的有效状态";
CM_ SG_ 1027 FRM_56_Loc203_Valid "the valid flag of each location 
每一点云的有效状态";
CM_ SG_ 1028 FRM_57_CRC "Profile5:E2E CRC16 (polynomial:0x1021)       
DataID:Use CANID,other bits Fill with 0";
CM_ SG_ 1028 FRM_57_RollgCntr "Profile5:E2E Rolling message counter";
CM_ SG_ 1028 FRM_57_DetnBlockCounter "Front Radar Moudle_X_Detection Block Counter
前雷达探测点块计数";
CM_ SG_ 1028 FRM_57_DetnMotionSts_204 "Detection point motion status
Front Radar Moudle_X_Detection Motion Status
前雷达探测点运动状态";
CM_ SG_ 1028 FRM_57_DetnRngRadial_204 "Detection point radial distance
Front Radar Moudle_X_Detection Range Radial
前雷达探测点径向距离";
CM_ SG_ 1028 FRM_57_DetnAziAngle_204 "Detection point azimuth angle
Front Radar Moudle_X_Detection Azimuth Angle
前雷达探测点水平方位角";
CM_ SG_ 1028 FRM_57_DetnElevnAngle_204 "Detection point elevation angle
Front Radar Moudle_X_Detection Elevation Angle
前雷达探测点俯仰角";
CM_ SG_ 1028 FRM_57_DetnRelVelRadial_204 "Detection point radial relative velocity
Front Radar Moudle_X_Detection Relative Velocity Radial 
前雷达探测点在径向上的相对速度";
CM_ SG_ 1028 FRM_57_DetnSNR_204 "Detection point signal noise ratio
Front Radar Moudle_X_Detection Signal Noise Ratio
前雷达探测点信号噪声比";
CM_ SG_ 1028 FRM_57_DetnRCS_204 "Detection point radar cross section
Front Radar Moudle_X_Detection Radar Cross Section
前雷达探测点雷达散射截面积";
CM_ SG_ 1028 FRM_57_DetnQuality_204 "Detection point quality
Front Radar Moudle_X_Detection Quality
前雷达探测点质量";
CM_ SG_ 1028 FRM_57_DetnMotionSts_205 "Detection point motion status
Front Radar Moudle_X_Detection Motion Status
前雷达探测点运动状态";
CM_ SG_ 1028 FRM_57_DetnRngRadial_205 "Detection point radial distance
Front Radar Moudle_X_Detection Range Radial
前雷达探测点径向距离";
CM_ SG_ 1028 FRM_57_DetnAziAngle_205 "Detection point azimuth angle
Front Radar Moudle_X_Detection Azimuth Angle
前雷达探测点水平方位角";
CM_ SG_ 1028 FRM_57_DetnElevnAngle_205 "Detection point elevation angle
Front Radar Moudle_X_Detection Elevation Angle
前雷达探测点俯仰角";
CM_ SG_ 1028 FRM_57_DetnRelVelRadial_205 "Detection point radial relative velocity
Front Radar Moudle_X_Detection Relative Velocity Radial 
前雷达探测点在径向上的相对速度";
CM_ SG_ 1028 FRM_57_DetnSNR_205 "Detection point signal noise ratio
Front Radar Moudle_X_Detection Signal Noise Ratio
前雷达探测点信号噪声比";
CM_ SG_ 1028 FRM_57_DetnRCS_205 "Detection point radar cross section
Front Radar Moudle_X_Detection Radar Cross Section
前雷达探测点雷达散射截面积";
CM_ SG_ 1028 FRM_57_DetnQuality_205 "Detection point quality
Front Radar Moudle_X_Detection Quality
前雷达探测点质量";
CM_ SG_ 1028 FRM_57_DetnMotionSts_206 "Detection point motion status
Front Radar Moudle_X_Detection Motion Status
前雷达探测点运动状态";
CM_ SG_ 1028 FRM_57_DetnRngRadial_206 "Detection point radial distance
Front Radar Moudle_X_Detection Range Radial
前雷达探测点径向距离";
CM_ SG_ 1028 FRM_57_DetnAziAngle_206 "Detection point azimuth angle
Front Radar Moudle_X_Detection Azimuth Angle
前雷达探测点水平方位角";
CM_ SG_ 1028 FRM_57_DetnElevnAngle_206 "Detection point elevation angle
Front Radar Moudle_X_Detection Elevation Angle
前雷达探测点俯仰角";
CM_ SG_ 1028 FRM_57_DetnRelVelRadial_206 "Detection point radial relative velocity
Front Radar Moudle_X_Detection Relative Velocity Radial 
前雷达探测点在径向上的相对速度";
CM_ SG_ 1028 FRM_57_DetnSNR_206 "Detection point signal noise ratio
Front Radar Moudle_X_Detection Signal Noise Ratio
前雷达探测点信号噪声比";
CM_ SG_ 1028 FRM_57_DetnRCS_206 "Detection point radar cross section
Front Radar Moudle_X_Detection Radar Cross Section
前雷达探测点雷达散射截面积";
CM_ SG_ 1028 FRM_57_DetnQuality_206 "Detection point quality
Front Radar Moudle_X_Detection Quality
前雷达探测点质量";
CM_ SG_ 1028 FRM_57_DetnMotionSts_207 "Detection point motion status
Front Radar Moudle_X_Detection Motion Status
前雷达探测点运动状态";
CM_ SG_ 1028 FRM_57_DetnRngRadial_207 "Detection point radial distance
Front Radar Moudle_X_Detection Range Radial
前雷达探测点径向距离";
CM_ SG_ 1028 FRM_57_DetnAziAngle_207 "Detection point azimuth angle
Front Radar Moudle_X_Detection Azimuth Angle
前雷达探测点水平方位角";
CM_ SG_ 1028 FRM_57_DetnElevnAngle_207 "Detection point elevation angle
Front Radar Moudle_X_Detection Elevation Angle
前雷达探测点俯仰角";
CM_ SG_ 1028 FRM_57_DetnRelVelRadial_207 "Detection point radial relative velocity
Front Radar Moudle_X_Detection Relative Velocity Radial 
前雷达探测点在径向上的相对速度";
CM_ SG_ 1028 FRM_57_DetnSNR_207 "Detection point signal noise ratio
Front Radar Moudle_X_Detection Signal Noise Ratio
前雷达探测点信号噪声比";
CM_ SG_ 1028 FRM_57_DetnRCS_207 "Detection point radar cross section
Front Radar Moudle_X_Detection Radar Cross Section
前雷达探测点雷达散射截面积";
CM_ SG_ 1028 FRM_57_DetnQuality_207 "Detection point quality
Front Radar Moudle_X_Detection Quality
前雷达探测点质量";
CM_ SG_ 1028 FRM_57_DetnMotionSts_208 "Detection point motion status
Front Radar Moudle_X_Detection Motion Status
前雷达探测点运动状态";
CM_ SG_ 1028 FRM_57_DetnRngRadial_208 "Detection point radial distance
Front Radar Moudle_X_Detection Range Radial
前雷达探测点径向距离";
CM_ SG_ 1028 FRM_57_DetnAziAngle_208 "Detection point azimuth angle
Front Radar Moudle_X_Detection Azimuth Angle
前雷达探测点水平方位角";
CM_ SG_ 1028 FRM_57_DetnElevnAngle_208 "Detection point elevation angle
Front Radar Moudle_X_Detection Elevation Angle
前雷达探测点俯仰角";
CM_ SG_ 1028 FRM_57_DetnRelVelRadial_208 "Detection point radial relative velocity
Front Radar Moudle_X_Detection Relative Velocity Radial 
前雷达探测点在径向上的相对速度";
CM_ SG_ 1028 FRM_57_DetnSNR_208 "Detection point signal noise ratio
Front Radar Moudle_X_Detection Signal Noise Ratio
前雷达探测点信号噪声比";
CM_ SG_ 1028 FRM_57_DetnRCS_208 "Detection point radar cross section
Front Radar Moudle_X_Detection Radar Cross Section
前雷达探测点雷达散射截面积";
CM_ SG_ 1028 FRM_57_DetnQuality_208 "Detection point quality
Front Radar Moudle_X_Detection Quality
前雷达探测点质量";
CM_ SG_ 1028 FRM_57_DetnMotionSts_209 "Detection point motion status
Front Radar Moudle_X_Detection Motion Status
前雷达探测点运动状态";
CM_ SG_ 1028 FRM_57_DetnRngRadial_209 "Detection point radial distance
Front Radar Moudle_X_Detection Range Radial
前雷达探测点径向距离";
CM_ SG_ 1028 FRM_57_DetnAziAngle_209 "Detection point azimuth angle
Front Radar Moudle_X_Detection Azimuth Angle
前雷达探测点水平方位角";
CM_ SG_ 1028 FRM_57_DetnElevnAngle_209 "Detection point elevation angle
Front Radar Moudle_X_Detection Elevation Angle
前雷达探测点俯仰角";
CM_ SG_ 1028 FRM_57_DetnRelVelRadial_209 "Detection point radial relative velocity
Front Radar Moudle_X_Detection Relative Velocity Radial 
前雷达探测点在径向上的相对速度";
CM_ SG_ 1028 FRM_57_DetnSNR_209 "Detection point signal noise ratio
Front Radar Moudle_X_Detection Signal Noise Ratio
前雷达探测点信号噪声比";
CM_ SG_ 1028 FRM_57_DetnRCS_209 "Detection point radar cross section
Front Radar Moudle_X_Detection Radar Cross Section
前雷达探测点雷达散射截面积";
CM_ SG_ 1028 FRM_57_DetnQuality_209 "Detection point quality
Front Radar Moudle_X_Detection Quality
前雷达探测点质量";
CM_ SG_ 1028 FRM_57_Loc204_Valid "the valid flag of each location 
每一点云的有效状态";
CM_ SG_ 1028 FRM_57_Loc205_Valid "the valid flag of each location 
每一点云的有效状态";
CM_ SG_ 1028 FRM_57_Loc206_Valid "the valid flag of each location 
每一点云的有效状态";
CM_ SG_ 1028 FRM_57_Loc207_Valid "the valid flag of each location 
每一点云的有效状态";
CM_ SG_ 1028 FRM_57_Loc208_Valid "the valid flag of each location 
每一点云的有效状态";
CM_ SG_ 1028 FRM_57_Loc209_Valid "the valid flag of each location 
每一点云的有效状态";
CM_ SG_ 1029 FRM_58_CRC "Profile5:E2E CRC16 (polynomial:0x1021)       
DataID:Use CANID,other bits Fill with 0";
CM_ SG_ 1029 FRM_58_RollgCntr "Profile5:E2E Rolling message counter";
CM_ SG_ 1029 FRM_58_DetnBlockCounter "Front Radar Moudle_X_Detection Block Counter
前雷达探测点块计数";
CM_ SG_ 1029 FRM_58_DetnMotionSts_210 "Detection point motion status
Front Radar Moudle_X_Detection Motion Status
前雷达探测点运动状态";
CM_ SG_ 1029 FRM_58_DetnRngRadial_210 "Detection point radial distance
Front Radar Moudle_X_Detection Range Radial
前雷达探测点径向距离";
CM_ SG_ 1029 FRM_58_DetnAziAngle_210 "Detection point azimuth angle
Front Radar Moudle_X_Detection Azimuth Angle
前雷达探测点水平方位角";
CM_ SG_ 1029 FRM_58_DetnElevnAngle_210 "Detection point elevation angle
Front Radar Moudle_X_Detection Elevation Angle
前雷达探测点俯仰角";
CM_ SG_ 1029 FRM_58_DetnRelVelRadial_210 "Detection point radial relative velocity
Front Radar Moudle_X_Detection Relative Velocity Radial 
前雷达探测点在径向上的相对速度";
CM_ SG_ 1029 FRM_58_DetnSNR_210 "Detection point signal noise ratio
Front Radar Moudle_X_Detection Signal Noise Ratio
前雷达探测点信号噪声比";
CM_ SG_ 1029 FRM_58_DetnRCS_210 "Detection point radar cross section
Front Radar Moudle_X_Detection Radar Cross Section
前雷达探测点雷达散射截面积";
CM_ SG_ 1029 FRM_58_DetnQuality_210 "Detection point quality
Front Radar Moudle_X_Detection Quality
前雷达探测点质量";
CM_ SG_ 1029 FRM_58_DetnMotionSts_211 "Detection point motion status
Front Radar Moudle_X_Detection Motion Status
前雷达探测点运动状态";
CM_ SG_ 1029 FRM_58_DetnRngRadial_211 "Detection point radial distance
Front Radar Moudle_X_Detection Range Radial
前雷达探测点径向距离";
CM_ SG_ 1029 FRM_58_DetnAziAngle_211 "Detection point azimuth angle
Front Radar Moudle_X_Detection Azimuth Angle
前雷达探测点水平方位角";
CM_ SG_ 1029 FRM_58_DetnElevnAngle_211 "Detection point elevation angle
Front Radar Moudle_X_Detection Elevation Angle
前雷达探测点俯仰角";
CM_ SG_ 1029 FRM_58_DetnRelVelRadial_211 "Detection point radial relative velocity
Front Radar Moudle_X_Detection Relative Velocity Radial 
前雷达探测点在径向上的相对速度";
CM_ SG_ 1029 FRM_58_DetnSNR_211 "Detection point signal noise ratio
Front Radar Moudle_X_Detection Signal Noise Ratio
前雷达探测点信号噪声比";
CM_ SG_ 1029 FRM_58_DetnRCS_211 "Detection point radar cross section
Front Radar Moudle_X_Detection Radar Cross Section
前雷达探测点雷达散射截面积";
CM_ SG_ 1029 FRM_58_DetnQuality_211 "Detection point quality
Front Radar Moudle_X_Detection Quality
前雷达探测点质量";
CM_ SG_ 1029 FRM_58_DetnMotionSts_212 "Detection point motion status
Front Radar Moudle_X_Detection Motion Status
前雷达探测点运动状态";
CM_ SG_ 1029 FRM_58_DetnRngRadial_212 "Detection point radial distance
Front Radar Moudle_X_Detection Range Radial
前雷达探测点径向距离";
CM_ SG_ 1029 FRM_58_DetnAziAngle_212 "Detection point azimuth angle
Front Radar Moudle_X_Detection Azimuth Angle
前雷达探测点水平方位角";
CM_ SG_ 1029 FRM_58_DetnElevnAngle_212 "Detection point elevation angle
Front Radar Moudle_X_Detection Elevation Angle
前雷达探测点俯仰角";
CM_ SG_ 1029 FRM_58_DetnRelVelRadial_212 "Detection point radial relative velocity
Front Radar Moudle_X_Detection Relative Velocity Radial 
前雷达探测点在径向上的相对速度";
CM_ SG_ 1029 FRM_58_DetnSNR_212 "Detection point signal noise ratio
Front Radar Moudle_X_Detection Signal Noise Ratio
前雷达探测点信号噪声比";
CM_ SG_ 1029 FRM_58_DetnRCS_212 "Detection point radar cross section
Front Radar Moudle_X_Detection Radar Cross Section
前雷达探测点雷达散射截面积";
CM_ SG_ 1029 FRM_58_DetnQuality_212 "Detection point quality
Front Radar Moudle_X_Detection Quality
前雷达探测点质量";
CM_ SG_ 1029 FRM_58_DetnMotionSts_213 "Detection point motion status
Front Radar Moudle_X_Detection Motion Status
前雷达探测点运动状态";
CM_ SG_ 1029 FRM_58_DetnRngRadial_213 "Detection point radial distance
Front Radar Moudle_X_Detection Range Radial
前雷达探测点径向距离";
CM_ SG_ 1029 FRM_58_DetnAziAngle_213 "Detection point azimuth angle
Front Radar Moudle_X_Detection Azimuth Angle
前雷达探测点水平方位角";
CM_ SG_ 1029 FRM_58_DetnElevnAngle_213 "Detection point elevation angle
Front Radar Moudle_X_Detection Elevation Angle
前雷达探测点俯仰角";
CM_ SG_ 1029 FRM_58_DetnRelVelRadial_213 "Detection point radial relative velocity
Front Radar Moudle_X_Detection Relative Velocity Radial 
前雷达探测点在径向上的相对速度";
CM_ SG_ 1029 FRM_58_DetnSNR_213 "Detection point signal noise ratio
Front Radar Moudle_X_Detection Signal Noise Ratio
前雷达探测点信号噪声比";
CM_ SG_ 1029 FRM_58_DetnRCS_213 "Detection point radar cross section
Front Radar Moudle_X_Detection Radar Cross Section
前雷达探测点雷达散射截面积";
CM_ SG_ 1029 FRM_58_DetnQuality_213 "Detection point quality
Front Radar Moudle_X_Detection Quality
前雷达探测点质量";
CM_ SG_ 1029 FRM_58_DetnMotionSts_214 "Detection point motion status
Front Radar Moudle_X_Detection Motion Status
前雷达探测点运动状态";
CM_ SG_ 1029 FRM_58_DetnRngRadial_214 "Detection point radial distance
Front Radar Moudle_X_Detection Range Radial
前雷达探测点径向距离";
CM_ SG_ 1029 FRM_58_DetnAziAngle_214 "Detection point azimuth angle
Front Radar Moudle_X_Detection Azimuth Angle
前雷达探测点水平方位角";
CM_ SG_ 1029 FRM_58_DetnElevnAngle_214 "Detection point elevation angle
Front Radar Moudle_X_Detection Elevation Angle
前雷达探测点俯仰角";
CM_ SG_ 1029 FRM_58_DetnRelVelRadial_214 "Detection point radial relative velocity
Front Radar Moudle_X_Detection Relative Velocity Radial 
前雷达探测点在径向上的相对速度";
CM_ SG_ 1029 FRM_58_DetnSNR_214 "Detection point signal noise ratio
Front Radar Moudle_X_Detection Signal Noise Ratio
前雷达探测点信号噪声比";
CM_ SG_ 1029 FRM_58_DetnRCS_214 "Detection point radar cross section
Front Radar Moudle_X_Detection Radar Cross Section
前雷达探测点雷达散射截面积";
CM_ SG_ 1029 FRM_58_DetnQuality_214 "Detection point quality
Front Radar Moudle_X_Detection Quality
前雷达探测点质量";
CM_ SG_ 1029 FRM_58_DetnMotionSts_215 "Detection point motion status
Front Radar Moudle_X_Detection Motion Status
前雷达探测点运动状态";
CM_ SG_ 1029 FRM_58_DetnRngRadial_215 "Detection point radial distance
Front Radar Moudle_X_Detection Range Radial
前雷达探测点径向距离";
CM_ SG_ 1029 FRM_58_DetnAziAngle_215 "Detection point azimuth angle
Front Radar Moudle_X_Detection Azimuth Angle
前雷达探测点水平方位角";
CM_ SG_ 1029 FRM_58_DetnElevnAngle_215 "Detection point elevation angle
Front Radar Moudle_X_Detection Elevation Angle
前雷达探测点俯仰角";
CM_ SG_ 1029 FRM_58_DetnRelVelRadial_215 "Detection point radial relative velocity
Front Radar Moudle_X_Detection Relative Velocity Radial 
前雷达探测点在径向上的相对速度";
CM_ SG_ 1029 FRM_58_DetnSNR_215 "Detection point signal noise ratio
Front Radar Moudle_X_Detection Signal Noise Ratio
前雷达探测点信号噪声比";
CM_ SG_ 1029 FRM_58_DetnRCS_215 "Detection point radar cross section
Front Radar Moudle_X_Detection Radar Cross Section
前雷达探测点雷达散射截面积";
CM_ SG_ 1029 FRM_58_DetnQuality_215 "Detection point quality
Front Radar Moudle_X_Detection Quality
前雷达探测点质量";
CM_ SG_ 1029 FRM_58_Loc210_Valid "the valid flag of each location 
每一点云的有效状态";
CM_ SG_ 1029 FRM_58_Loc211_Valid "the valid flag of each location 
每一点云的有效状态";
CM_ SG_ 1029 FRM_58_Loc212_Valid "the valid flag of each location 
每一点云的有效状态";
CM_ SG_ 1029 FRM_58_Loc213_Valid "the valid flag of each location 
每一点云的有效状态";
CM_ SG_ 1029 FRM_58_Loc214_Valid "the valid flag of each location 
每一点云的有效状态";
CM_ SG_ 1029 FRM_58_Loc215_Valid "the valid flag of each location 
每一点云的有效状态";
CM_ SG_ 1030 FRM_59_CRC "Profile5:E2E CRC16 (polynomial:0x1021)       
DataID:Use CANID,other bits Fill with 0";
CM_ SG_ 1030 FRM_59_RollgCntr "Profile5:E2E Rolling message counter";
CM_ SG_ 1030 FRM_59_DetnBlockCounter "Front Radar Moudle_X_Detection Block Counter
前雷达探测点块计数";
CM_ SG_ 1030 FRM_59_DetnMotionSts_216 "Detection point motion status
Front Radar Moudle_X_Detection Motion Status
前雷达探测点运动状态";
CM_ SG_ 1030 FRM_59_DetnRngRadial_216 "Detection point radial distance
Front Radar Moudle_X_Detection Range Radial
前雷达探测点径向距离";
CM_ SG_ 1030 FRM_59_DetnAziAngle_216 "Detection point azimuth angle
Front Radar Moudle_X_Detection Azimuth Angle
前雷达探测点水平方位角";
CM_ SG_ 1030 FRM_59_DetnElevnAngle_216 "Detection point elevation angle
Front Radar Moudle_X_Detection Elevation Angle
前雷达探测点俯仰角";
CM_ SG_ 1030 FRM_59_DetnRelVelRadial_216 "Detection point radial relative velocity
Front Radar Moudle_X_Detection Relative Velocity Radial 
前雷达探测点在径向上的相对速度";
CM_ SG_ 1030 FRM_59_DetnSNR_216 "Detection point signal noise ratio
Front Radar Moudle_X_Detection Signal Noise Ratio
前雷达探测点信号噪声比";
CM_ SG_ 1030 FRM_59_DetnRCS_216 "Detection point radar cross section
Front Radar Moudle_X_Detection Radar Cross Section
前雷达探测点雷达散射截面积";
CM_ SG_ 1030 FRM_59_DetnQuality_216 "Detection point quality
Front Radar Moudle_X_Detection Quality
前雷达探测点质量";
CM_ SG_ 1030 FRM_59_DetnMotionSts_217 "Detection point motion status
Front Radar Moudle_X_Detection Motion Status
前雷达探测点运动状态";
CM_ SG_ 1030 FRM_59_DetnRngRadial_217 "Detection point radial distance
Front Radar Moudle_X_Detection Range Radial
前雷达探测点径向距离";
CM_ SG_ 1030 FRM_59_DetnAziAngle_217 "Detection point azimuth angle
Front Radar Moudle_X_Detection Azimuth Angle
前雷达探测点水平方位角";
CM_ SG_ 1030 FRM_59_DetnElevnAngle_217 "Detection point elevation angle
Front Radar Moudle_X_Detection Elevation Angle
前雷达探测点俯仰角";
CM_ SG_ 1030 FRM_59_DetnRelVelRadial_217 "Detection point radial relative velocity
Front Radar Moudle_X_Detection Relative Velocity Radial 
前雷达探测点在径向上的相对速度";
CM_ SG_ 1030 FRM_59_DetnSNR_217 "Detection point signal noise ratio
Front Radar Moudle_X_Detection Signal Noise Ratio
前雷达探测点信号噪声比";
CM_ SG_ 1030 FRM_59_DetnRCS_217 "Detection point radar cross section
Front Radar Moudle_X_Detection Radar Cross Section
前雷达探测点雷达散射截面积";
CM_ SG_ 1030 FRM_59_DetnQuality_217 "Detection point quality
Front Radar Moudle_X_Detection Quality
前雷达探测点质量";
CM_ SG_ 1030 FRM_59_DetnMotionSts_218 "Detection point motion status
Front Radar Moudle_X_Detection Motion Status
前雷达探测点运动状态";
CM_ SG_ 1030 FRM_59_DetnRngRadial_218 "Detection point radial distance
Front Radar Moudle_X_Detection Range Radial
前雷达探测点径向距离";
CM_ SG_ 1030 FRM_59_DetnAziAngle_218 "Detection point azimuth angle
Front Radar Moudle_X_Detection Azimuth Angle
前雷达探测点水平方位角";
CM_ SG_ 1030 FRM_59_DetnElevnAngle_218 "Detection point elevation angle
Front Radar Moudle_X_Detection Elevation Angle
前雷达探测点俯仰角";
CM_ SG_ 1030 FRM_59_DetnRelVelRadial_218 "Detection point radial relative velocity
Front Radar Moudle_X_Detection Relative Velocity Radial 
前雷达探测点在径向上的相对速度";
CM_ SG_ 1030 FRM_59_DetnSNR_218 "Detection point signal noise ratio
Front Radar Moudle_X_Detection Signal Noise Ratio
前雷达探测点信号噪声比";
CM_ SG_ 1030 FRM_59_DetnRCS_218 "Detection point radar cross section
Front Radar Moudle_X_Detection Radar Cross Section
前雷达探测点雷达散射截面积";
CM_ SG_ 1030 FRM_59_DetnQuality_218 "Detection point quality
Front Radar Moudle_X_Detection Quality
前雷达探测点质量";
CM_ SG_ 1030 FRM_59_DetnMotionSts_219 "Detection point motion status
Front Radar Moudle_X_Detection Motion Status
前雷达探测点运动状态";
CM_ SG_ 1030 FRM_59_DetnRngRadial_219 "Detection point radial distance
Front Radar Moudle_X_Detection Range Radial
前雷达探测点径向距离";
CM_ SG_ 1030 FRM_59_DetnAziAngle_219 "Detection point azimuth angle
Front Radar Moudle_X_Detection Azimuth Angle
前雷达探测点水平方位角";
CM_ SG_ 1030 FRM_59_DetnElevnAngle_219 "Detection point elevation angle
Front Radar Moudle_X_Detection Elevation Angle
前雷达探测点俯仰角";
CM_ SG_ 1030 FRM_59_DetnRelVelRadial_219 "Detection point radial relative velocity
Front Radar Moudle_X_Detection Relative Velocity Radial 
前雷达探测点在径向上的相对速度";
CM_ SG_ 1030 FRM_59_DetnSNR_219 "Detection point signal noise ratio
Front Radar Moudle_X_Detection Signal Noise Ratio
前雷达探测点信号噪声比";
CM_ SG_ 1030 FRM_59_DetnRCS_219 "Detection point radar cross section
Front Radar Moudle_X_Detection Radar Cross Section
前雷达探测点雷达散射截面积";
CM_ SG_ 1030 FRM_59_DetnQuality_219 "Detection point quality
Front Radar Moudle_X_Detection Quality
前雷达探测点质量";
CM_ SG_ 1030 FRM_59_DetnMotionSts_220 "Detection point motion status
Front Radar Moudle_X_Detection Motion Status
前雷达探测点运动状态";
CM_ SG_ 1030 FRM_59_DetnRngRadial_220 "Detection point radial distance
Front Radar Moudle_X_Detection Range Radial
前雷达探测点径向距离";
CM_ SG_ 1030 FRM_59_DetnAziAngle_220 "Detection point azimuth angle
Front Radar Moudle_X_Detection Azimuth Angle
前雷达探测点水平方位角";
CM_ SG_ 1030 FRM_59_DetnElevnAngle_220 "Detection point elevation angle
Front Radar Moudle_X_Detection Elevation Angle
前雷达探测点俯仰角";
CM_ SG_ 1030 FRM_59_DetnRelVelRadial_220 "Detection point radial relative velocity
Front Radar Moudle_X_Detection Relative Velocity Radial 
前雷达探测点在径向上的相对速度";
CM_ SG_ 1030 FRM_59_DetnSNR_220 "Detection point signal noise ratio
Front Radar Moudle_X_Detection Signal Noise Ratio
前雷达探测点信号噪声比";
CM_ SG_ 1030 FRM_59_DetnRCS_220 "Detection point radar cross section
Front Radar Moudle_X_Detection Radar Cross Section
前雷达探测点雷达散射截面积";
CM_ SG_ 1030 FRM_59_DetnQuality_220 "Detection point quality
Front Radar Moudle_X_Detection Quality
前雷达探测点质量";
CM_ SG_ 1030 FRM_59_DetnMotionSts_221 "Detection point motion status
Front Radar Moudle_X_Detection Motion Status
前雷达探测点运动状态";
CM_ SG_ 1030 FRM_59_DetnRngRadial_221 "Detection point radial distance
Front Radar Moudle_X_Detection Range Radial
前雷达探测点径向距离";
CM_ SG_ 1030 FRM_59_DetnAziAngle_221 "Detection point azimuth angle
Front Radar Moudle_X_Detection Azimuth Angle
前雷达探测点水平方位角";
CM_ SG_ 1030 FRM_59_DetnElevnAngle_221 "Detection point elevation angle
Front Radar Moudle_X_Detection Elevation Angle
前雷达探测点俯仰角";
CM_ SG_ 1030 FRM_59_DetnRelVelRadial_221 "Detection point radial relative velocity
Front Radar Moudle_X_Detection Relative Velocity Radial 
前雷达探测点在径向上的相对速度";
CM_ SG_ 1030 FRM_59_DetnSNR_221 "Detection point signal noise ratio
Front Radar Moudle_X_Detection Signal Noise Ratio
前雷达探测点信号噪声比";
CM_ SG_ 1030 FRM_59_DetnRCS_221 "Detection point radar cross section
Front Radar Moudle_X_Detection Radar Cross Section
前雷达探测点雷达散射截面积";
CM_ SG_ 1030 FRM_59_DetnQuality_221 "Detection point quality
Front Radar Moudle_X_Detection Quality
前雷达探测点质量";
CM_ SG_ 1030 FRM_59_Loc216_Valid "the valid flag of each location 
每一点云的有效状态";
CM_ SG_ 1030 FRM_59_Loc217_Valid "the valid flag of each location 
每一点云的有效状态";
CM_ SG_ 1030 FRM_59_Loc218_Valid "the valid flag of each location 
每一点云的有效状态";
CM_ SG_ 1030 FRM_59_Loc219_Valid "the valid flag of each location 
每一点云的有效状态";
CM_ SG_ 1030 FRM_59_Loc220_Valid "the valid flag of each location 
每一点云的有效状态";
CM_ SG_ 1030 FRM_59_Loc221_Valid "the valid flag of each location 
每一点云的有效状态";
CM_ SG_ 1031 FRM_60_CRC "Profile5:E2E CRC16 (polynomial:0x1021)       
DataID:Use CANID,other bits Fill with 0";
CM_ SG_ 1031 FRM_60_RollgCntr "Profile5:E2E Rolling message counter";
CM_ SG_ 1031 FRM_60_DetnBlockCounter "Front Radar Moudle_X_Detection Block Counter
前雷达探测点块计数";
CM_ SG_ 1031 FRM_60_DetnMotionSts_222 "Detection point motion status
Front Radar Moudle_X_Detection Motion Status
前雷达探测点运动状态";
CM_ SG_ 1031 FRM_60_DetnRngRadial_222 "Detection point radial distance
Front Radar Moudle_X_Detection Range Radial
前雷达探测点径向距离";
CM_ SG_ 1031 FRM_60_DetnAziAngle_222 "Detection point azimuth angle
Front Radar Moudle_X_Detection Azimuth Angle
前雷达探测点水平方位角";
CM_ SG_ 1031 FRM_60_DetnElevnAngle_222 "Detection point elevation angle
Front Radar Moudle_X_Detection Elevation Angle
前雷达探测点俯仰角";
CM_ SG_ 1031 FRM_60_DetnRelVelRadial_222 "Detection point radial relative velocity
Front Radar Moudle_X_Detection Relative Velocity Radial 
前雷达探测点在径向上的相对速度";
CM_ SG_ 1031 FRM_60_DetnSNR_222 "Detection point signal noise ratio
Front Radar Moudle_X_Detection Signal Noise Ratio
前雷达探测点信号噪声比";
CM_ SG_ 1031 FRM_60_DetnRCS_222 "Detection point radar cross section
Front Radar Moudle_X_Detection Radar Cross Section
前雷达探测点雷达散射截面积";
CM_ SG_ 1031 FRM_60_DetnQuality_222 "Detection point quality
Front Radar Moudle_X_Detection Quality
前雷达探测点质量";
CM_ SG_ 1031 FRM_60_DetnMotionSts_223 "Detection point motion status
Front Radar Moudle_X_Detection Motion Status
前雷达探测点运动状态";
CM_ SG_ 1031 FRM_60_DetnRngRadial_223 "Detection point radial distance
Front Radar Moudle_X_Detection Range Radial
前雷达探测点径向距离";
CM_ SG_ 1031 FRM_60_DetnAziAngle_223 "Detection point azimuth angle
Front Radar Moudle_X_Detection Azimuth Angle
前雷达探测点水平方位角";
CM_ SG_ 1031 FRM_60_DetnElevnAngle_223 "Detection point elevation angle
Front Radar Moudle_X_Detection Elevation Angle
前雷达探测点俯仰角";
CM_ SG_ 1031 FRM_60_DetnRelVelRadial_223 "Detection point radial relative velocity
Front Radar Moudle_X_Detection Relative Velocity Radial 
前雷达探测点在径向上的相对速度";
CM_ SG_ 1031 FRM_60_DetnSNR_223 "Detection point signal noise ratio
Front Radar Moudle_X_Detection Signal Noise Ratio
前雷达探测点信号噪声比";
CM_ SG_ 1031 FRM_60_DetnRCS_223 "Detection point radar cross section
Front Radar Moudle_X_Detection Radar Cross Section
前雷达探测点雷达散射截面积";
CM_ SG_ 1031 FRM_60_DetnQuality_223 "Detection point quality
Front Radar Moudle_X_Detection Quality
前雷达探测点质量";
CM_ SG_ 1031 FRM_60_DetnMotionSts_224 "Detection point motion status
Front Radar Moudle_X_Detection Motion Status
前雷达探测点运动状态";
CM_ SG_ 1031 FRM_60_DetnRngRadial_224 "Detection point radial distance
Front Radar Moudle_X_Detection Range Radial
前雷达探测点径向距离";
CM_ SG_ 1031 FRM_60_DetnAziAngle_224 "Detection point azimuth angle
Front Radar Moudle_X_Detection Azimuth Angle
前雷达探测点水平方位角";
CM_ SG_ 1031 FRM_60_DetnElevnAngle_224 "Detection point elevation angle
Front Radar Moudle_X_Detection Elevation Angle
前雷达探测点俯仰角";
CM_ SG_ 1031 FRM_60_DetnRelVelRadial_224 "Detection point radial relative velocity
Front Radar Moudle_X_Detection Relative Velocity Radial 
前雷达探测点在径向上的相对速度";
CM_ SG_ 1031 FRM_60_DetnSNR_224 "Detection point signal noise ratio
Front Radar Moudle_X_Detection Signal Noise Ratio
前雷达探测点信号噪声比";
CM_ SG_ 1031 FRM_60_DetnRCS_224 "Detection point radar cross section
Front Radar Moudle_X_Detection Radar Cross Section
前雷达探测点雷达散射截面积";
CM_ SG_ 1031 FRM_60_DetnQuality_224 "Detection point quality
Front Radar Moudle_X_Detection Quality
前雷达探测点质量";
CM_ SG_ 1031 FRM_60_DetnMotionSts_225 "Detection point motion status
Front Radar Moudle_X_Detection Motion Status
前雷达探测点运动状态";
CM_ SG_ 1031 FRM_60_DetnRngRadial_225 "Detection point radial distance
Front Radar Moudle_X_Detection Range Radial
前雷达探测点径向距离";
CM_ SG_ 1031 FRM_60_DetnAziAngle_225 "Detection point azimuth angle
Front Radar Moudle_X_Detection Azimuth Angle
前雷达探测点水平方位角";
CM_ SG_ 1031 FRM_60_DetnElevnAngle_225 "Detection point elevation angle
Front Radar Moudle_X_Detection Elevation Angle
前雷达探测点俯仰角";
CM_ SG_ 1031 FRM_60_DetnRelVelRadial_225 "Detection point radial relative velocity
Front Radar Moudle_X_Detection Relative Velocity Radial 
前雷达探测点在径向上的相对速度";
CM_ SG_ 1031 FRM_60_DetnSNR_225 "Detection point signal noise ratio
Front Radar Moudle_X_Detection Signal Noise Ratio
前雷达探测点信号噪声比";
CM_ SG_ 1031 FRM_60_DetnRCS_225 "Detection point radar cross section
Front Radar Moudle_X_Detection Radar Cross Section
前雷达探测点雷达散射截面积";
CM_ SG_ 1031 FRM_60_DetnQuality_225 "Detection point quality
Front Radar Moudle_X_Detection Quality
前雷达探测点质量";
CM_ SG_ 1031 FRM_60_DetnMotionSts_226 "Detection point motion status
Front Radar Moudle_X_Detection Motion Status
前雷达探测点运动状态";
CM_ SG_ 1031 FRM_60_DetnRngRadial_226 "Detection point radial distance
Front Radar Moudle_X_Detection Range Radial
前雷达探测点径向距离";
CM_ SG_ 1031 FRM_60_DetnAziAngle_226 "Detection point azimuth angle
Front Radar Moudle_X_Detection Azimuth Angle
前雷达探测点水平方位角";
CM_ SG_ 1031 FRM_60_DetnElevnAngle_226 "Detection point elevation angle
Front Radar Moudle_X_Detection Elevation Angle
前雷达探测点俯仰角";
CM_ SG_ 1031 FRM_60_DetnRelVelRadial_226 "Detection point radial relative velocity
Front Radar Moudle_X_Detection Relative Velocity Radial 
前雷达探测点在径向上的相对速度";
CM_ SG_ 1031 FRM_60_DetnSNR_226 "Detection point signal noise ratio
Front Radar Moudle_X_Detection Signal Noise Ratio
前雷达探测点信号噪声比";
CM_ SG_ 1031 FRM_60_DetnRCS_226 "Detection point radar cross section
Front Radar Moudle_X_Detection Radar Cross Section
前雷达探测点雷达散射截面积";
CM_ SG_ 1031 FRM_60_DetnQuality_226 "Detection point quality
Front Radar Moudle_X_Detection Quality
前雷达探测点质量";
CM_ SG_ 1031 FRM_60_DetnMotionSts_227 "Detection point motion status
Front Radar Moudle_X_Detection Motion Status
前雷达探测点运动状态";
CM_ SG_ 1031 FRM_60_DetnRngRadial_227 "Detection point radial distance
Front Radar Moudle_X_Detection Range Radial
前雷达探测点径向距离";
CM_ SG_ 1031 FRM_60_DetnAziAngle_227 "Detection point azimuth angle
Front Radar Moudle_X_Detection Azimuth Angle
前雷达探测点水平方位角";
CM_ SG_ 1031 FRM_60_DetnElevnAngle_227 "Detection point elevation angle
Front Radar Moudle_X_Detection Elevation Angle
前雷达探测点俯仰角";
CM_ SG_ 1031 FRM_60_DetnRelVelRadial_227 "Detection point radial relative velocity
Front Radar Moudle_X_Detection Relative Velocity Radial 
前雷达探测点在径向上的相对速度";
CM_ SG_ 1031 FRM_60_DetnSNR_227 "Detection point signal noise ratio
Front Radar Moudle_X_Detection Signal Noise Ratio
前雷达探测点信号噪声比";
CM_ SG_ 1031 FRM_60_DetnRCS_227 "Detection point radar cross section
Front Radar Moudle_X_Detection Radar Cross Section
前雷达探测点雷达散射截面积";
CM_ SG_ 1031 FRM_60_DetnQuality_227 "Detection point quality
Front Radar Moudle_X_Detection Quality
前雷达探测点质量";
CM_ SG_ 1031 FRM_60_Loc222_Valid "the valid flag of each location 
每一点云的有效状态";
CM_ SG_ 1031 FRM_60_Loc223_Valid "the valid flag of each location 
每一点云的有效状态";
CM_ SG_ 1031 FRM_60_Loc224_Valid "the valid flag of each location 
每一点云的有效状态";
CM_ SG_ 1031 FRM_60_Loc225_Valid "the valid flag of each location 
每一点云的有效状态";
CM_ SG_ 1031 FRM_60_Loc226_Valid "the valid flag of each location 
每一点云的有效状态";
CM_ SG_ 1031 FRM_60_Loc227_Valid "the valid flag of each location 
每一点云的有效状态";
CM_ SG_ 1032 FRM_61_CRC "Profile5:E2E CRC16 (polynomial:0x1021)       
DataID:Use CANID,other bits Fill with 0";
CM_ SG_ 1032 FRM_61_RollgCntr "Profile5:E2E Rolling message counter";
CM_ SG_ 1032 FRM_61_DetnBlockCounter "Front Radar Moudle_X_Detection Block Counter
前雷达探测点块计数";
CM_ SG_ 1032 FRM_61_DetnMotionSts_228 "Detection point motion status
Front Radar Moudle_X_Detection Motion Status
前雷达探测点运动状态";
CM_ SG_ 1032 FRM_61_DetnRngRadial_228 "Detection point radial distance
Front Radar Moudle_X_Detection Range Radial
前雷达探测点径向距离";
CM_ SG_ 1032 FRM_61_DetnAziAngle_228 "Detection point azimuth angle
Front Radar Moudle_X_Detection Azimuth Angle
前雷达探测点水平方位角";
CM_ SG_ 1032 FRM_61_DetnElevnAngle_228 "Detection point elevation angle
Front Radar Moudle_X_Detection Elevation Angle
前雷达探测点俯仰角";
CM_ SG_ 1032 FRM_61_DetnRelVelRadial_228 "Detection point radial relative velocity
Front Radar Moudle_X_Detection Relative Velocity Radial 
前雷达探测点在径向上的相对速度";
CM_ SG_ 1032 FRM_61_DetnSNR_228 "Detection point signal noise ratio
Front Radar Moudle_X_Detection Signal Noise Ratio
前雷达探测点信号噪声比";
CM_ SG_ 1032 FRM_61_DetnRCS_228 "Detection point radar cross section
Front Radar Moudle_X_Detection Radar Cross Section
前雷达探测点雷达散射截面积";
CM_ SG_ 1032 FRM_61_DetnQuality_228 "Detection point quality
Front Radar Moudle_X_Detection Quality
前雷达探测点质量";
CM_ SG_ 1032 FRM_61_DetnMotionSts_229 "Detection point motion status
Front Radar Moudle_X_Detection Motion Status
前雷达探测点运动状态";
CM_ SG_ 1032 FRM_61_DetnRngRadial_229 "Detection point radial distance
Front Radar Moudle_X_Detection Range Radial
前雷达探测点径向距离";
CM_ SG_ 1032 FRM_61_DetnAziAngle_229 "Detection point azimuth angle
Front Radar Moudle_X_Detection Azimuth Angle
前雷达探测点水平方位角";
CM_ SG_ 1032 FRM_61_DetnElevnAngle_229 "Detection point elevation angle
Front Radar Moudle_X_Detection Elevation Angle
前雷达探测点俯仰角";
CM_ SG_ 1032 FRM_61_DetnRelVelRadial_229 "Detection point radial relative velocity
Front Radar Moudle_X_Detection Relative Velocity Radial 
前雷达探测点在径向上的相对速度";
CM_ SG_ 1032 FRM_61_DetnSNR_229 "Detection point signal noise ratio
Front Radar Moudle_X_Detection Signal Noise Ratio
前雷达探测点信号噪声比";
CM_ SG_ 1032 FRM_61_DetnRCS_229 "Detection point radar cross section
Front Radar Moudle_X_Detection Radar Cross Section
前雷达探测点雷达散射截面积";
CM_ SG_ 1032 FRM_61_DetnQuality_229 "Detection point quality
Front Radar Moudle_X_Detection Quality
前雷达探测点质量";
CM_ SG_ 1032 FRM_61_DetnMotionSts_230 "Detection point motion status
Front Radar Moudle_X_Detection Motion Status
前雷达探测点运动状态";
CM_ SG_ 1032 FRM_61_DetnRngRadial_230 "Detection point radial distance
Front Radar Moudle_X_Detection Range Radial
前雷达探测点径向距离";
CM_ SG_ 1032 FRM_61_DetnAziAngle_230 "Detection point azimuth angle
Front Radar Moudle_X_Detection Azimuth Angle
前雷达探测点水平方位角";
CM_ SG_ 1032 FRM_61_DetnElevnAngle_230 "Detection point elevation angle
Front Radar Moudle_X_Detection Elevation Angle
前雷达探测点俯仰角";
CM_ SG_ 1032 FRM_61_DetnRelVelRadial_230 "Detection point radial relative velocity
Front Radar Moudle_X_Detection Relative Velocity Radial 
前雷达探测点在径向上的相对速度";
CM_ SG_ 1032 FRM_61_DetnSNR_230 "Detection point signal noise ratio
Front Radar Moudle_X_Detection Signal Noise Ratio
前雷达探测点信号噪声比";
CM_ SG_ 1032 FRM_61_DetnRCS_230 "Detection point radar cross section
Front Radar Moudle_X_Detection Radar Cross Section
前雷达探测点雷达散射截面积";
CM_ SG_ 1032 FRM_61_DetnQuality_230 "Detection point quality
Front Radar Moudle_X_Detection Quality
前雷达探测点质量";
CM_ SG_ 1032 FRM_61_DetnMotionSts_231 "Detection point motion status
Front Radar Moudle_X_Detection Motion Status
前雷达探测点运动状态";
CM_ SG_ 1032 FRM_61_DetnRngRadial_231 "Detection point radial distance
Front Radar Moudle_X_Detection Range Radial
前雷达探测点径向距离";
CM_ SG_ 1032 FRM_61_DetnAziAngle_231 "Detection point azimuth angle
Front Radar Moudle_X_Detection Azimuth Angle
前雷达探测点水平方位角";
CM_ SG_ 1032 FRM_61_DetnElevnAngle_231 "Detection point elevation angle
Front Radar Moudle_X_Detection Elevation Angle
前雷达探测点俯仰角";
CM_ SG_ 1032 FRM_61_DetnRelVelRadial_231 "Detection point radial relative velocity
Front Radar Moudle_X_Detection Relative Velocity Radial 
前雷达探测点在径向上的相对速度";
CM_ SG_ 1032 FRM_61_DetnSNR_231 "Detection point signal noise ratio
Front Radar Moudle_X_Detection Signal Noise Ratio
前雷达探测点信号噪声比";
CM_ SG_ 1032 FRM_61_DetnRCS_231 "Detection point radar cross section
Front Radar Moudle_X_Detection Radar Cross Section
前雷达探测点雷达散射截面积";
CM_ SG_ 1032 FRM_61_DetnQuality_231 "Detection point quality
Front Radar Moudle_X_Detection Quality
前雷达探测点质量";
CM_ SG_ 1032 FRM_61_DetnMotionSts_232 "Detection point motion status
Front Radar Moudle_X_Detection Motion Status
前雷达探测点运动状态";
CM_ SG_ 1032 FRM_61_DetnRngRadial_232 "Detection point radial distance
Front Radar Moudle_X_Detection Range Radial
前雷达探测点径向距离";
CM_ SG_ 1032 FRM_61_DetnAziAngle_232 "Detection point azimuth angle
Front Radar Moudle_X_Detection Azimuth Angle
前雷达探测点水平方位角";
CM_ SG_ 1032 FRM_61_DetnElevnAngle_232 "Detection point elevation angle
Front Radar Moudle_X_Detection Elevation Angle
前雷达探测点俯仰角";
CM_ SG_ 1032 FRM_61_DetnRelVelRadial_232 "Detection point radial relative velocity
Front Radar Moudle_X_Detection Relative Velocity Radial 
前雷达探测点在径向上的相对速度";
CM_ SG_ 1032 FRM_61_DetnSNR_232 "Detection point signal noise ratio
Front Radar Moudle_X_Detection Signal Noise Ratio
前雷达探测点信号噪声比";
CM_ SG_ 1032 FRM_61_DetnRCS_232 "Detection point radar cross section
Front Radar Moudle_X_Detection Radar Cross Section
前雷达探测点雷达散射截面积";
CM_ SG_ 1032 FRM_61_DetnQuality_232 "Detection point quality
Front Radar Moudle_X_Detection Quality
前雷达探测点质量";
CM_ SG_ 1032 FRM_61_DetnMotionSts_233 "Detection point motion status
Front Radar Moudle_X_Detection Motion Status
前雷达探测点运动状态";
CM_ SG_ 1032 FRM_61_DetnRngRadial_233 "Detection point radial distance
Front Radar Moudle_X_Detection Range Radial
前雷达探测点径向距离";
CM_ SG_ 1032 FRM_61_DetnAziAngle_233 "Detection point azimuth angle
Front Radar Moudle_X_Detection Azimuth Angle
前雷达探测点水平方位角";
CM_ SG_ 1032 FRM_61_DetnElevnAngle_233 "Detection point elevation angle
Front Radar Moudle_X_Detection Elevation Angle
前雷达探测点俯仰角";
CM_ SG_ 1032 FRM_61_DetnRelVelRadial_233 "Detection point radial relative velocity
Front Radar Moudle_X_Detection Relative Velocity Radial 
前雷达探测点在径向上的相对速度";
CM_ SG_ 1032 FRM_61_DetnSNR_233 "Detection point signal noise ratio
Front Radar Moudle_X_Detection Signal Noise Ratio
前雷达探测点信号噪声比";
CM_ SG_ 1032 FRM_61_DetnRCS_233 "Detection point radar cross section
Front Radar Moudle_X_Detection Radar Cross Section
前雷达探测点雷达散射截面积";
CM_ SG_ 1032 FRM_61_DetnQuality_233 "Detection point quality
Front Radar Moudle_X_Detection Quality
前雷达探测点质量";
CM_ SG_ 1032 FRM_61_Loc228_Valid "the valid flag of each location 
每一点云的有效状态";
CM_ SG_ 1032 FRM_61_Loc229_Valid "the valid flag of each location 
每一点云的有效状态";
CM_ SG_ 1032 FRM_61_Loc230_Valid "the valid flag of each location 
每一点云的有效状态";
CM_ SG_ 1032 FRM_61_Loc231_Valid "the valid flag of each location 
每一点云的有效状态";
CM_ SG_ 1032 FRM_61_Loc232_Valid "the valid flag of each location 
每一点云的有效状态";
CM_ SG_ 1032 FRM_61_Loc233_Valid "the valid flag of each location 
每一点云的有效状态";
CM_ SG_ 1033 FRM_62_CRC "Profile5:E2E CRC16 (polynomial:0x1021)       
DataID:Use CANID,other bits Fill with 0";
CM_ SG_ 1033 FRM_62_RollgCntr "Profile5:E2E Rolling message counter";
CM_ SG_ 1033 FRM_62_DetnBlockCounter "Front Radar Moudle_X_Detection Block Counter
前雷达探测点块计数";
CM_ SG_ 1033 FRM_62_DetnMotionSts_234 "Detection point motion status
Front Radar Moudle_X_Detection Motion Status
前雷达探测点运动状态";
CM_ SG_ 1033 FRM_62_DetnRngRadial_234 "Detection point radial distance
Front Radar Moudle_X_Detection Range Radial
前雷达探测点径向距离";
CM_ SG_ 1033 FRM_62_DetnAziAngle_234 "Detection point azimuth angle
Front Radar Moudle_X_Detection Azimuth Angle
前雷达探测点水平方位角";
CM_ SG_ 1033 FRM_62_DetnElevnAngle_234 "Detection point elevation angle
Front Radar Moudle_X_Detection Elevation Angle
前雷达探测点俯仰角";
CM_ SG_ 1033 FRM_62_DetnRelVelRadial_234 "Detection point radial relative velocity
Front Radar Moudle_X_Detection Relative Velocity Radial 
前雷达探测点在径向上的相对速度";
CM_ SG_ 1033 FRM_62_DetnSNR_234 "Detection point signal noise ratio
Front Radar Moudle_X_Detection Signal Noise Ratio
前雷达探测点信号噪声比";
CM_ SG_ 1033 FRM_62_DetnRCS_234 "Detection point radar cross section
Front Radar Moudle_X_Detection Radar Cross Section
前雷达探测点雷达散射截面积";
CM_ SG_ 1033 FRM_62_DetnQuality_234 "Detection point quality
Front Radar Moudle_X_Detection Quality
前雷达探测点质量";
CM_ SG_ 1033 FRM_62_DetnMotionSts_235 "Detection point motion status
Front Radar Moudle_X_Detection Motion Status
前雷达探测点运动状态";
CM_ SG_ 1033 FRM_62_DetnRngRadial_235 "Detection point radial distance
Front Radar Moudle_X_Detection Range Radial
前雷达探测点径向距离";
CM_ SG_ 1033 FRM_62_DetnAziAngle_235 "Detection point azimuth angle
Front Radar Moudle_X_Detection Azimuth Angle
前雷达探测点水平方位角";
CM_ SG_ 1033 FRM_62_DetnElevnAngle_235 "Detection point elevation angle
Front Radar Moudle_X_Detection Elevation Angle
前雷达探测点俯仰角";
CM_ SG_ 1033 FRM_62_DetnRelVelRadial_235 "Detection point radial relative velocity
Front Radar Moudle_X_Detection Relative Velocity Radial 
前雷达探测点在径向上的相对速度";
CM_ SG_ 1033 FRM_62_DetnSNR_235 "Detection point signal noise ratio
Front Radar Moudle_X_Detection Signal Noise Ratio
前雷达探测点信号噪声比";
CM_ SG_ 1033 FRM_62_DetnRCS_235 "Detection point radar cross section
Front Radar Moudle_X_Detection Radar Cross Section
前雷达探测点雷达散射截面积";
CM_ SG_ 1033 FRM_62_DetnQuality_235 "Detection point quality
Front Radar Moudle_X_Detection Quality
前雷达探测点质量";
CM_ SG_ 1033 FRM_62_DetnMotionSts_236 "Detection point motion status
Front Radar Moudle_X_Detection Motion Status
前雷达探测点运动状态";
CM_ SG_ 1033 FRM_62_DetnRngRadial_236 "Detection point radial distance
Front Radar Moudle_X_Detection Range Radial
前雷达探测点径向距离";
CM_ SG_ 1033 FRM_62_DetnAziAngle_236 "Detection point azimuth angle
Front Radar Moudle_X_Detection Azimuth Angle
前雷达探测点水平方位角";
CM_ SG_ 1033 FRM_62_DetnElevnAngle_236 "Detection point elevation angle
Front Radar Moudle_X_Detection Elevation Angle
前雷达探测点俯仰角";
CM_ SG_ 1033 FRM_62_DetnRelVelRadial_236 "Detection point radial relative velocity
Front Radar Moudle_X_Detection Relative Velocity Radial 
前雷达探测点在径向上的相对速度";
CM_ SG_ 1033 FRM_62_DetnSNR_236 "Detection point signal noise ratio
Front Radar Moudle_X_Detection Signal Noise Ratio
前雷达探测点信号噪声比";
CM_ SG_ 1033 FRM_62_DetnRCS_236 "Detection point radar cross section
Front Radar Moudle_X_Detection Radar Cross Section
前雷达探测点雷达散射截面积";
CM_ SG_ 1033 FRM_62_DetnQuality_236 "Detection point quality
Front Radar Moudle_X_Detection Quality
前雷达探测点质量";
CM_ SG_ 1033 FRM_62_DetnMotionSts_237 "Detection point motion status
Front Radar Moudle_X_Detection Motion Status
前雷达探测点运动状态";
CM_ SG_ 1033 FRM_62_DetnRngRadial_237 "Detection point radial distance
Front Radar Moudle_X_Detection Range Radial
前雷达探测点径向距离";
CM_ SG_ 1033 FRM_62_DetnAziAngle_237 "Detection point azimuth angle
Front Radar Moudle_X_Detection Azimuth Angle
前雷达探测点水平方位角";
CM_ SG_ 1033 FRM_62_DetnElevnAngle_237 "Detection point elevation angle
Front Radar Moudle_X_Detection Elevation Angle
前雷达探测点俯仰角";
CM_ SG_ 1033 FRM_62_DetnRelVelRadial_237 "Detection point radial relative velocity
Front Radar Moudle_X_Detection Relative Velocity Radial 
前雷达探测点在径向上的相对速度";
CM_ SG_ 1033 FRM_62_DetnSNR_237 "Detection point signal noise ratio
Front Radar Moudle_X_Detection Signal Noise Ratio
前雷达探测点信号噪声比";
CM_ SG_ 1033 FRM_62_DetnRCS_237 "Detection point radar cross section
Front Radar Moudle_X_Detection Radar Cross Section
前雷达探测点雷达散射截面积";
CM_ SG_ 1033 FRM_62_DetnQuality_237 "Detection point quality
Front Radar Moudle_X_Detection Quality
前雷达探测点质量";
CM_ SG_ 1033 FRM_62_DetnMotionSts_238 "Detection point motion status
Front Radar Moudle_X_Detection Motion Status
前雷达探测点运动状态";
CM_ SG_ 1033 FRM_62_DetnRngRadial_238 "Detection point radial distance
Front Radar Moudle_X_Detection Range Radial
前雷达探测点径向距离";
CM_ SG_ 1033 FRM_62_DetnAziAngle_238 "Detection point azimuth angle
Front Radar Moudle_X_Detection Azimuth Angle
前雷达探测点水平方位角";
CM_ SG_ 1033 FRM_62_DetnElevnAngle_238 "Detection point elevation angle
Front Radar Moudle_X_Detection Elevation Angle
前雷达探测点俯仰角";
CM_ SG_ 1033 FRM_62_DetnRelVelRadial_238 "Detection point radial relative velocity
Front Radar Moudle_X_Detection Relative Velocity Radial 
前雷达探测点在径向上的相对速度";
CM_ SG_ 1033 FRM_62_DetnSNR_238 "Detection point signal noise ratio
Front Radar Moudle_X_Detection Signal Noise Ratio
前雷达探测点信号噪声比";
CM_ SG_ 1033 FRM_62_DetnRCS_238 "Detection point radar cross section
Front Radar Moudle_X_Detection Radar Cross Section
前雷达探测点雷达散射截面积";
CM_ SG_ 1033 FRM_62_DetnQuality_238 "Detection point quality
Front Radar Moudle_X_Detection Quality
前雷达探测点质量";
CM_ SG_ 1033 FRM_62_DetnMotionSts_239 "Detection point motion status
Front Radar Moudle_X_Detection Motion Status
前雷达探测点运动状态";
CM_ SG_ 1033 FRM_62_DetnRngRadial_239 "Detection point radial distance
Front Radar Moudle_X_Detection Range Radial
前雷达探测点径向距离";
CM_ SG_ 1033 FRM_62_DetnAziAngle_239 "Detection point azimuth angle
Front Radar Moudle_X_Detection Azimuth Angle
前雷达探测点水平方位角";
CM_ SG_ 1033 FRM_62_DetnElevnAngle_239 "Detection point elevation angle
Front Radar Moudle_X_Detection Elevation Angle
前雷达探测点俯仰角";
CM_ SG_ 1033 FRM_62_DetnRelVelRadial_239 "Detection point radial relative velocity
Front Radar Moudle_X_Detection Relative Velocity Radial 
前雷达探测点在径向上的相对速度";
CM_ SG_ 1033 FRM_62_DetnSNR_239 "Detection point signal noise ratio
Front Radar Moudle_X_Detection Signal Noise Ratio
前雷达探测点信号噪声比";
CM_ SG_ 1033 FRM_62_DetnRCS_239 "Detection point radar cross section
Front Radar Moudle_X_Detection Radar Cross Section
前雷达探测点雷达散射截面积";
CM_ SG_ 1033 FRM_62_DetnQuality_239 "Detection point quality
Front Radar Moudle_X_Detection Quality
前雷达探测点质量";
CM_ SG_ 1033 FRM_62_Loc234_Valid "the valid flag of each location 
每一点云的有效状态";
CM_ SG_ 1033 FRM_62_Loc235_Valid "the valid flag of each location 
每一点云的有效状态";
CM_ SG_ 1033 FRM_62_Loc236_Valid "the valid flag of each location 
每一点云的有效状态";
CM_ SG_ 1033 FRM_62_Loc237_Valid "the valid flag of each location 
每一点云的有效状态";
CM_ SG_ 1033 FRM_62_Loc238_Valid "the valid flag of each location 
每一点云的有效状态";
CM_ SG_ 1033 FRM_62_Loc239_Valid "the valid flag of each location 
每一点云的有效状态";
CM_ SG_ 1040 FRM_63_CRC "Profile5:E2E CRC16 (polynomial:0x1021)       
DataID:Use CANID,other bits Fill with 0";
CM_ SG_ 1040 FRM_63_RollgCntr "Profile5:E2E Rolling message counter";
CM_ SG_ 1040 FRM_63_DetnBlockCounter "Front Radar Moudle_X_Detection Block Counter
前雷达探测点块计数";
CM_ SG_ 1040 FRM_63_DetnMotionSts_240 "Detection point motion status
Front Radar Moudle_X_Detection Motion Status
前雷达探测点运动状态";
CM_ SG_ 1040 FRM_63_DetnRngRadial_240 "Detection point radial distance
Front Radar Moudle_X_Detection Range Radial
前雷达探测点径向距离";
CM_ SG_ 1040 FRM_63_DetnAziAngle_240 "Detection point azimuth angle
Front Radar Moudle_X_Detection Azimuth Angle
前雷达探测点水平方位角";
CM_ SG_ 1040 FRM_63_DetnElevnAngle_240 "Detection point elevation angle
Front Radar Moudle_X_Detection Elevation Angle
前雷达探测点俯仰角";
CM_ SG_ 1040 FRM_63_DetnRelVelRadial_240 "Detection point radial relative velocity
Front Radar Moudle_X_Detection Relative Velocity Radial 
前雷达探测点在径向上的相对速度";
CM_ SG_ 1040 FRM_63_DetnSNR_240 "Detection point signal noise ratio
Front Radar Moudle_X_Detection Signal Noise Ratio
前雷达探测点信号噪声比";
CM_ SG_ 1040 FRM_63_DetnRCS_240 "Detection point radar cross section
Front Radar Moudle_X_Detection Radar Cross Section
前雷达探测点雷达散射截面积";
CM_ SG_ 1040 FRM_63_DetnQuality_240 "Detection point quality
Front Radar Moudle_X_Detection Quality
前雷达探测点质量";
CM_ SG_ 1040 FRM_63_DetnMotionSts_241 "Detection point motion status
Front Radar Moudle_X_Detection Motion Status
前雷达探测点运动状态";
CM_ SG_ 1040 FRM_63_DetnRngRadial_241 "Detection point radial distance
Front Radar Moudle_X_Detection Range Radial
前雷达探测点径向距离";
CM_ SG_ 1040 FRM_63_DetnAziAngle_241 "Detection point azimuth angle
Front Radar Moudle_X_Detection Azimuth Angle
前雷达探测点水平方位角";
CM_ SG_ 1040 FRM_63_DetnElevnAngle_241 "Detection point elevation angle
Front Radar Moudle_X_Detection Elevation Angle
前雷达探测点俯仰角";
CM_ SG_ 1040 FRM_63_DetnRelVelRadial_241 "Detection point radial relative velocity
Front Radar Moudle_X_Detection Relative Velocity Radial 
前雷达探测点在径向上的相对速度";
CM_ SG_ 1040 FRM_63_DetnSNR_241 "Detection point signal noise ratio
Front Radar Moudle_X_Detection Signal Noise Ratio
前雷达探测点信号噪声比";
CM_ SG_ 1040 FRM_63_DetnRCS_241 "Detection point radar cross section
Front Radar Moudle_X_Detection Radar Cross Section
前雷达探测点雷达散射截面积";
CM_ SG_ 1040 FRM_63_DetnQuality_241 "Detection point quality
Front Radar Moudle_X_Detection Quality
前雷达探测点质量";
CM_ SG_ 1040 FRM_63_DetnMotionSts_242 "Detection point motion status
Front Radar Moudle_X_Detection Motion Status
前雷达探测点运动状态";
CM_ SG_ 1040 FRM_63_DetnRngRadial_242 "Detection point radial distance
Front Radar Moudle_X_Detection Range Radial
前雷达探测点径向距离";
CM_ SG_ 1040 FRM_63_DetnAziAngle_242 "Detection point azimuth angle
Front Radar Moudle_X_Detection Azimuth Angle
前雷达探测点水平方位角";
CM_ SG_ 1040 FRM_63_DetnElevnAngle_242 "Detection point elevation angle
Front Radar Moudle_X_Detection Elevation Angle
前雷达探测点俯仰角";
CM_ SG_ 1040 FRM_63_DetnRelVelRadial_242 "Detection point radial relative velocity
Front Radar Moudle_X_Detection Relative Velocity Radial 
前雷达探测点在径向上的相对速度";
CM_ SG_ 1040 FRM_63_DetnSNR_242 "Detection point signal noise ratio
Front Radar Moudle_X_Detection Signal Noise Ratio
前雷达探测点信号噪声比";
CM_ SG_ 1040 FRM_63_DetnRCS_242 "Detection point radar cross section
Front Radar Moudle_X_Detection Radar Cross Section
前雷达探测点雷达散射截面积";
CM_ SG_ 1040 FRM_63_DetnQuality_242 "Detection point quality
Front Radar Moudle_X_Detection Quality
前雷达探测点质量";
CM_ SG_ 1040 FRM_63_DetnMotionSts_243 "Detection point motion status
Front Radar Moudle_X_Detection Motion Status
前雷达探测点运动状态";
CM_ SG_ 1040 FRM_63_DetnRngRadial_243 "Detection point radial distance
Front Radar Moudle_X_Detection Range Radial
前雷达探测点径向距离";
CM_ SG_ 1040 FRM_63_DetnAziAngle_243 "Detection point azimuth angle
Front Radar Moudle_X_Detection Azimuth Angle
前雷达探测点水平方位角";
CM_ SG_ 1040 FRM_63_DetnElevnAngle_243 "Detection point elevation angle
Front Radar Moudle_X_Detection Elevation Angle
前雷达探测点俯仰角";
CM_ SG_ 1040 FRM_63_DetnRelVelRadial_243 "Detection point radial relative velocity
Front Radar Moudle_X_Detection Relative Velocity Radial 
前雷达探测点在径向上的相对速度";
CM_ SG_ 1040 FRM_63_DetnSNR_243 "Detection point signal noise ratio
Front Radar Moudle_X_Detection Signal Noise Ratio
前雷达探测点信号噪声比";
CM_ SG_ 1040 FRM_63_DetnRCS_243 "Detection point radar cross section
Front Radar Moudle_X_Detection Radar Cross Section
前雷达探测点雷达散射截面积";
CM_ SG_ 1040 FRM_63_DetnQuality_243 "Detection point quality
Front Radar Moudle_X_Detection Quality
前雷达探测点质量";
CM_ SG_ 1040 FRM_63_DetnMotionSts_244 "Detection point motion status
Front Radar Moudle_X_Detection Motion Status
前雷达探测点运动状态";
CM_ SG_ 1040 FRM_63_DetnRngRadial_244 "Detection point radial distance
Front Radar Moudle_X_Detection Range Radial
前雷达探测点径向距离";
CM_ SG_ 1040 FRM_63_DetnAziAngle_244 "Detection point azimuth angle
Front Radar Moudle_X_Detection Azimuth Angle
前雷达探测点水平方位角";
CM_ SG_ 1040 FRM_63_DetnElevnAngle_244 "Detection point elevation angle
Front Radar Moudle_X_Detection Elevation Angle
前雷达探测点俯仰角";
CM_ SG_ 1040 FRM_63_DetnRelVelRadial_244 "Detection point radial relative velocity
Front Radar Moudle_X_Detection Relative Velocity Radial 
前雷达探测点在径向上的相对速度";
CM_ SG_ 1040 FRM_63_DetnSNR_244 "Detection point signal noise ratio
Front Radar Moudle_X_Detection Signal Noise Ratio
前雷达探测点信号噪声比";
CM_ SG_ 1040 FRM_63_DetnRCS_244 "Detection point radar cross section
Front Radar Moudle_X_Detection Radar Cross Section
前雷达探测点雷达散射截面积";
CM_ SG_ 1040 FRM_63_DetnQuality_244 "Detection point quality
Front Radar Moudle_X_Detection Quality
前雷达探测点质量";
CM_ SG_ 1040 FRM_63_DetnMotionSts_245 "Detection point motion status
Front Radar Moudle_X_Detection Motion Status
前雷达探测点运动状态";
CM_ SG_ 1040 FRM_63_DetnRngRadial_245 "Detection point radial distance
Front Radar Moudle_X_Detection Range Radial
前雷达探测点径向距离";
CM_ SG_ 1040 FRM_63_DetnAziAngle_245 "Detection point azimuth angle
Front Radar Moudle_X_Detection Azimuth Angle
前雷达探测点水平方位角";
CM_ SG_ 1040 FRM_63_DetnElevnAngle_245 "Detection point elevation angle
Front Radar Moudle_X_Detection Elevation Angle
前雷达探测点俯仰角";
CM_ SG_ 1040 FRM_63_DetnRelVelRadial_245 "Detection point radial relative velocity
Front Radar Moudle_X_Detection Relative Velocity Radial 
前雷达探测点在径向上的相对速度";
CM_ SG_ 1040 FRM_63_DetnSNR_245 "Detection point signal noise ratio
Front Radar Moudle_X_Detection Signal Noise Ratio
前雷达探测点信号噪声比";
CM_ SG_ 1040 FRM_63_DetnRCS_245 "Detection point radar cross section
Front Radar Moudle_X_Detection Radar Cross Section
前雷达探测点雷达散射截面积";
CM_ SG_ 1040 FRM_63_DetnQuality_245 "Detection point quality
Front Radar Moudle_X_Detection Quality
前雷达探测点质量";
CM_ SG_ 1040 FRM_63_Loc240_Valid "the valid flag of each location 
每一点云的有效状态";
CM_ SG_ 1040 FRM_63_Loc241_Valid "the valid flag of each location 
每一点云的有效状态";
CM_ SG_ 1040 FRM_63_Loc242_Valid "the valid flag of each location 
每一点云的有效状态";
CM_ SG_ 1040 FRM_63_Loc243_Valid "the valid flag of each location 
每一点云的有效状态";
CM_ SG_ 1040 FRM_63_Loc244_Valid "the valid flag of each location 
每一点云的有效状态";
CM_ SG_ 1040 FRM_63_Loc245_Valid "the valid flag of each location 
每一点云的有效状态";
CM_ SG_ 1041 FRM_64_CRC "Profile5:E2E CRC16 (polynomial:0x1021)       
DataID:Use CANID,other bits Fill with 0";
CM_ SG_ 1041 FRM_64_RollgCntr "Profile5:E2E Rolling message counter";
CM_ SG_ 1041 FRM_64_DetnBlockCounter "Front Radar Moudle_X_Detection Block Counter
前雷达探测点块计数";
CM_ SG_ 1041 FRM_64_DetnMotionSts_246 "Detection point motion status
Front Radar Moudle_X_Detection Motion Status
前雷达探测点运动状态";
CM_ SG_ 1041 FRM_64_DetnRngRadial_246 "Detection point radial distance
Front Radar Moudle_X_Detection Range Radial
前雷达探测点径向距离";
CM_ SG_ 1041 FRM_64_DetnAziAngle_246 "Detection point azimuth angle
Front Radar Moudle_X_Detection Azimuth Angle
前雷达探测点水平方位角";
CM_ SG_ 1041 FRM_64_DetnElevnAngle_246 "Detection point elevation angle
Front Radar Moudle_X_Detection Elevation Angle
前雷达探测点俯仰角";
CM_ SG_ 1041 FRM_64_DetnRelVelRadial_246 "Detection point radial relative velocity
Front Radar Moudle_X_Detection Relative Velocity Radial 
前雷达探测点在径向上的相对速度";
CM_ SG_ 1041 FRM_64_DetnSNR_246 "Detection point signal noise ratio
Front Radar Moudle_X_Detection Signal Noise Ratio
前雷达探测点信号噪声比";
CM_ SG_ 1041 FRM_64_DetnRCS_246 "Detection point radar cross section
Front Radar Moudle_X_Detection Radar Cross Section
前雷达探测点雷达散射截面积";
CM_ SG_ 1041 FRM_64_DetnQuality_246 "Detection point quality
Front Radar Moudle_X_Detection Quality
前雷达探测点质量";
CM_ SG_ 1041 FRM_64_DetnMotionSts_247 "Detection point motion status
Front Radar Moudle_X_Detection Motion Status
前雷达探测点运动状态";
CM_ SG_ 1041 FRM_64_DetnRngRadial_247 "Detection point radial distance
Front Radar Moudle_X_Detection Range Radial
前雷达探测点径向距离";
CM_ SG_ 1041 FRM_64_DetnAziAngle_247 "Detection point azimuth angle
Front Radar Moudle_X_Detection Azimuth Angle
前雷达探测点水平方位角";
CM_ SG_ 1041 FRM_64_DetnElevnAngle_247 "Detection point elevation angle
Front Radar Moudle_X_Detection Elevation Angle
前雷达探测点俯仰角";
CM_ SG_ 1041 FRM_64_DetnRelVelRadial_247 "Detection point radial relative velocity
Front Radar Moudle_X_Detection Relative Velocity Radial 
前雷达探测点在径向上的相对速度";
CM_ SG_ 1041 FRM_64_DetnSNR_247 "Detection point signal noise ratio
Front Radar Moudle_X_Detection Signal Noise Ratio
前雷达探测点信号噪声比";
CM_ SG_ 1041 FRM_64_DetnRCS_247 "Detection point radar cross section
Front Radar Moudle_X_Detection Radar Cross Section
前雷达探测点雷达散射截面积";
CM_ SG_ 1041 FRM_64_DetnQuality_247 "Detection point quality
Front Radar Moudle_X_Detection Quality
前雷达探测点质量";
CM_ SG_ 1041 FRM_64_DetnMotionSts_248 "Detection point motion status
Front Radar Moudle_X_Detection Motion Status
前雷达探测点运动状态";
CM_ SG_ 1041 FRM_64_DetnRngRadial_248 "Detection point radial distance
Front Radar Moudle_X_Detection Range Radial
前雷达探测点径向距离";
CM_ SG_ 1041 FRM_64_DetnAziAngle_248 "Detection point azimuth angle
Front Radar Moudle_X_Detection Azimuth Angle
前雷达探测点水平方位角";
CM_ SG_ 1041 FRM_64_DetnElevnAngle_248 "Detection point elevation angle
Front Radar Moudle_X_Detection Elevation Angle
前雷达探测点俯仰角";
CM_ SG_ 1041 FRM_64_DetnRelVelRadial_248 "Detection point radial relative velocity
Front Radar Moudle_X_Detection Relative Velocity Radial 
前雷达探测点在径向上的相对速度";
CM_ SG_ 1041 FRM_64_DetnSNR_248 "Detection point signal noise ratio
Front Radar Moudle_X_Detection Signal Noise Ratio
前雷达探测点信号噪声比";
CM_ SG_ 1041 FRM_64_DetnRCS_248 "Detection point radar cross section
Front Radar Moudle_X_Detection Radar Cross Section
前雷达探测点雷达散射截面积";
CM_ SG_ 1041 FRM_64_DetnQuality_248 "Detection point quality
Front Radar Moudle_X_Detection Quality
前雷达探测点质量";
CM_ SG_ 1041 FRM_64_DetnMotionSts_249 "Detection point motion status
Front Radar Moudle_X_Detection Motion Status
前雷达探测点运动状态";
CM_ SG_ 1041 FRM_64_DetnRngRadial_249 "Detection point radial distance
Front Radar Moudle_X_Detection Range Radial
前雷达探测点径向距离";
CM_ SG_ 1041 FRM_64_DetnAziAngle_249 "Detection point azimuth angle
Front Radar Moudle_X_Detection Azimuth Angle
前雷达探测点水平方位角";
CM_ SG_ 1041 FRM_64_DetnElevnAngle_249 "Detection point elevation angle
Front Radar Moudle_X_Detection Elevation Angle
前雷达探测点俯仰角";
CM_ SG_ 1041 FRM_64_DetnRelVelRadial_249 "Detection point radial relative velocity
Front Radar Moudle_X_Detection Relative Velocity Radial 
前雷达探测点在径向上的相对速度";
CM_ SG_ 1041 FRM_64_DetnSNR_249 "Detection point signal noise ratio
Front Radar Moudle_X_Detection Signal Noise Ratio
前雷达探测点信号噪声比";
CM_ SG_ 1041 FRM_64_DetnRCS_249 "Detection point radar cross section
Front Radar Moudle_X_Detection Radar Cross Section
前雷达探测点雷达散射截面积";
CM_ SG_ 1041 FRM_64_DetnQuality_249 "Detection point quality
Front Radar Moudle_X_Detection Quality
前雷达探测点质量";
CM_ SG_ 1041 FRM_64_DetnMotionSts_250 "Detection point motion status
Front Radar Moudle_X_Detection Motion Status
前雷达探测点运动状态";
CM_ SG_ 1041 FRM_64_DetnRngRadial_250 "Detection point radial distance
Front Radar Moudle_X_Detection Range Radial
前雷达探测点径向距离";
CM_ SG_ 1041 FRM_64_DetnAziAngle_250 "Detection point azimuth angle
Front Radar Moudle_X_Detection Azimuth Angle
前雷达探测点水平方位角";
CM_ SG_ 1041 FRM_64_DetnElevnAngle_250 "Detection point elevation angle
Front Radar Moudle_X_Detection Elevation Angle
前雷达探测点俯仰角";
CM_ SG_ 1041 FRM_64_DetnRelVelRadial_250 "Detection point radial relative velocity
Front Radar Moudle_X_Detection Relative Velocity Radial 
前雷达探测点在径向上的相对速度";
CM_ SG_ 1041 FRM_64_DetnSNR_250 "Detection point signal noise ratio
Front Radar Moudle_X_Detection Signal Noise Ratio
前雷达探测点信号噪声比";
CM_ SG_ 1041 FRM_64_DetnRCS_250 "Detection point radar cross section
Front Radar Moudle_X_Detection Radar Cross Section
前雷达探测点雷达散射截面积";
CM_ SG_ 1041 FRM_64_DetnQuality_250 "Detection point quality
Front Radar Moudle_X_Detection Quality
前雷达探测点质量";
CM_ SG_ 1041 FRM_64_DetnMotionSts_251 "Detection point motion status
Front Radar Moudle_X_Detection Motion Status
前雷达探测点运动状态";
CM_ SG_ 1041 FRM_64_DetnRngRadial_251 "Detection point radial distance
Front Radar Moudle_X_Detection Range Radial
前雷达探测点径向距离";
CM_ SG_ 1041 FRM_64_DetnAziAngle_251 "Detection point azimuth angle
Front Radar Moudle_X_Detection Azimuth Angle
前雷达探测点水平方位角";
CM_ SG_ 1041 FRM_64_DetnElevnAngle_251 "Detection point elevation angle
Front Radar Moudle_X_Detection Elevation Angle
前雷达探测点俯仰角";
CM_ SG_ 1041 FRM_64_DetnRelVelRadial_251 "Detection point radial relative velocity
Front Radar Moudle_X_Detection Relative Velocity Radial 
前雷达探测点在径向上的相对速度";
CM_ SG_ 1041 FRM_64_DetnSNR_251 "Detection point signal noise ratio
Front Radar Moudle_X_Detection Signal Noise Ratio
前雷达探测点信号噪声比";
CM_ SG_ 1041 FRM_64_DetnRCS_251 "Detection point radar cross section
Front Radar Moudle_X_Detection Radar Cross Section
前雷达探测点雷达散射截面积";
CM_ SG_ 1041 FRM_64_DetnQuality_251 "Detection point quality
Front Radar Moudle_X_Detection Quality
前雷达探测点质量";
CM_ SG_ 1041 FRM_64_Loc246_Valid "the valid flag of each location 
每一点云的有效状态";
CM_ SG_ 1041 FRM_64_Loc247_Valid "the valid flag of each location 
每一点云的有效状态";
CM_ SG_ 1041 FRM_64_Loc248_Valid "the valid flag of each location 
每一点云的有效状态";
CM_ SG_ 1041 FRM_64_Loc249_Valid "the valid flag of each location 
每一点云的有效状态";
CM_ SG_ 1041 FRM_64_Loc250_Valid "the valid flag of each location 
每一点云的有效状态";
CM_ SG_ 1041 FRM_64_Loc251_Valid "the valid flag of each location 
每一点云的有效状态";
CM_ SG_ 1042 FRM_65_CRC "Profile5:E2E CRC16 (polynomial:0x1021)       
DataID:Use CANID,other bits Fill with 0";
CM_ SG_ 1042 FRM_65_RollgCntr "Profile5:E2E Rolling message counter";
CM_ SG_ 1042 FRM_65_DetnBlockCounter "Front Radar Moudle_X_Detection Block Counter
前雷达探测点块计数";
CM_ SG_ 1042 FRM_65_DetnMotionSts_252 "Detection point motion status
Front Radar Moudle_X_Detection Motion Status
前雷达探测点运动状态";
CM_ SG_ 1042 FRM_65_DetnRngRadial_252 "Detection point radial distance
Front Radar Moudle_X_Detection Range Radial
前雷达探测点径向距离";
CM_ SG_ 1042 FRM_65_DetnAziAngle_252 "Detection point azimuth angle
Front Radar Moudle_X_Detection Azimuth Angle
前雷达探测点水平方位角";
CM_ SG_ 1042 FRM_65_DetnElevnAngle_252 "Detection point elevation angle
Front Radar Moudle_X_Detection Elevation Angle
前雷达探测点俯仰角";
CM_ SG_ 1042 FRM_65_DetnRelVelRadial_252 "Detection point radial relative velocity
Front Radar Moudle_X_Detection Relative Velocity Radial 
前雷达探测点在径向上的相对速度";
CM_ SG_ 1042 FRM_65_DetnSNR_252 "Detection point signal noise ratio
Front Radar Moudle_X_Detection Signal Noise Ratio
前雷达探测点信号噪声比";
CM_ SG_ 1042 FRM_65_DetnRCS_252 "Detection point radar cross section
Front Radar Moudle_X_Detection Radar Cross Section
前雷达探测点雷达散射截面积";
CM_ SG_ 1042 FRM_65_DetnQuality_252 "Detection point quality
Front Radar Moudle_X_Detection Quality
前雷达探测点质量";
CM_ SG_ 1042 FRM_65_DetnMotionSts_253 "Detection point motion status
Front Radar Moudle_X_Detection Motion Status
前雷达探测点运动状态";
CM_ SG_ 1042 FRM_65_DetnRngRadial_253 "Detection point radial distance
Front Radar Moudle_X_Detection Range Radial
前雷达探测点径向距离";
CM_ SG_ 1042 FRM_65_DetnAziAngle_253 "Detection point azimuth angle
Front Radar Moudle_X_Detection Azimuth Angle
前雷达探测点水平方位角";
CM_ SG_ 1042 FRM_65_DetnElevnAngle_253 "Detection point elevation angle
Front Radar Moudle_X_Detection Elevation Angle
前雷达探测点俯仰角";
CM_ SG_ 1042 FRM_65_DetnRelVelRadial_253 "Detection point radial relative velocity
Front Radar Moudle_X_Detection Relative Velocity Radial 
前雷达探测点在径向上的相对速度";
CM_ SG_ 1042 FRM_65_DetnSNR_253 "Detection point signal noise ratio
Front Radar Moudle_X_Detection Signal Noise Ratio
前雷达探测点信号噪声比";
CM_ SG_ 1042 FRM_65_DetnRCS_253 "Detection point radar cross section
Front Radar Moudle_X_Detection Radar Cross Section
前雷达探测点雷达散射截面积";
CM_ SG_ 1042 FRM_65_DetnQuality_253 "Detection point quality
Front Radar Moudle_X_Detection Quality
前雷达探测点质量";
CM_ SG_ 1042 FRM_65_DetnMotionSts_254 "Detection point motion status
Front Radar Moudle_X_Detection Motion Status
前雷达探测点运动状态";
CM_ SG_ 1042 FRM_65_DetnRngRadial_254 "Detection point radial distance
Front Radar Moudle_X_Detection Range Radial
前雷达探测点径向距离";
CM_ SG_ 1042 FRM_65_DetnAziAngle_254 "Detection point azimuth angle
Front Radar Moudle_X_Detection Azimuth Angle
前雷达探测点水平方位角";
CM_ SG_ 1042 FRM_65_DetnElevnAngle_254 "Detection point elevation angle
Front Radar Moudle_X_Detection Elevation Angle
前雷达探测点俯仰角";
CM_ SG_ 1042 FRM_65_DetnRelVelRadial_254 "Detection point radial relative velocity
Front Radar Moudle_X_Detection Relative Velocity Radial 
前雷达探测点在径向上的相对速度";
CM_ SG_ 1042 FRM_65_DetnSNR_254 "Detection point signal noise ratio
Front Radar Moudle_X_Detection Signal Noise Ratio
前雷达探测点信号噪声比";
CM_ SG_ 1042 FRM_65_DetnRCS_254 "Detection point radar cross section
Front Radar Moudle_X_Detection Radar Cross Section
前雷达探测点雷达散射截面积";
CM_ SG_ 1042 FRM_65_DetnQuality_254 "Detection point quality
Front Radar Moudle_X_Detection Quality
前雷达探测点质量";
CM_ SG_ 1042 FRM_65_DetnMotionSts_255 "Detection point motion status
Front Radar Moudle_X_Detection Motion Status
前雷达探测点运动状态";
CM_ SG_ 1042 FRM_65_DetnRngRadial_255 "Detection point radial distance
Front Radar Moudle_X_Detection Range Radial
前雷达探测点径向距离";
CM_ SG_ 1042 FRM_65_DetnAziAngle_255 "Detection point azimuth angle
Front Radar Moudle_X_Detection Azimuth Angle
前雷达探测点水平方位角";
CM_ SG_ 1042 FRM_65_DetnElevnAngle_255 "Detection point elevation angle
Front Radar Moudle_X_Detection Elevation Angle
前雷达探测点俯仰角";
CM_ SG_ 1042 FRM_65_DetnRelVelRadial_255 "Detection point radial relative velocity
Front Radar Moudle_X_Detection Relative Velocity Radial 
前雷达探测点在径向上的相对速度";
CM_ SG_ 1042 FRM_65_DetnSNR_255 "Detection point signal noise ratio
Front Radar Moudle_X_Detection Signal Noise Ratio
前雷达探测点信号噪声比";
CM_ SG_ 1042 FRM_65_DetnRCS_255 "Detection point radar cross section
Front Radar Moudle_X_Detection Radar Cross Section
前雷达探测点雷达散射截面积";
CM_ SG_ 1042 FRM_65_DetnQuality_255 "Detection point quality
Front Radar Moudle_X_Detection Quality
前雷达探测点质量";
CM_ SG_ 1042 FRM_65_Loc252_Valid "the valid flag of each location 
每一点云的有效状态";
CM_ SG_ 1042 FRM_65_Loc253_Valid "the valid flag of each location 
每一点云的有效状态";
CM_ SG_ 1042 FRM_65_Loc254_Valid "the valid flag of each location 
每一点云的有效状态";
CM_ SG_ 1042 FRM_65_Loc255_Valid "the valid flag of each location 
每一点云的有效状态";

BA_DEF_ BO_  "GenMsgSendType" ENUM  "Cyclic","Event","IfActive","CE","CA","NoMsgSendType";
BA_DEF_ BO_  "GenMsgCycleTime" INT 0 0;
BA_DEF_ SG_  "GenSigSendType" ENUM  "Cyclic","OnChange","OnWrite","IfActive","OnChangeWithRepetition","OnWriteWithRepetition","IfActiveWithRepetition","NoSigSendType","OnChangeAndIfActive","OnChangeAndIfActiveWithRepetition","CA","CE","Event";
BA_DEF_ SG_  "GenSigStartValue" INT 0 0;
BA_DEF_ BO_  "GenMsgCycleTimeFast" INT 0 0;
BA_DEF_ BO_  "GenMsgNrOfRepetition" INT 0 0;
BA_DEF_ BO_  "GenMsgDelayTime" INT 0 0;
BA_DEF_ BO_  "CANFD_BRS" ENUM  "0","1";
BA_DEF_ BO_  "VFrameFormat" ENUM  "StandardCAN","ExtendedCAN","reserved","reserved","reserved","reserved","reserved","reserved","reserved","reserved","reserved","reserved","reserved","reserved","StandardCAN_FD","ExtendedCAN_FD";
BA_DEF_ BO_  "GenMsgILSupport" ENUM  "No","Yes";
BA_DEF_ SG_ "GenSigASIL" ENUM "QM","A","B","C","D","";
BA_DEF_DEF_  "GenMsgSendType" "Cyclic";
BA_DEF_DEF_  "GenMsgCycleTime" 0;
BA_DEF_DEF_  "GenSigSendType" "Cyclic";
BA_DEF_DEF_  "GenSigStartValue" 0;
BA_DEF_DEF_  "GenMsgCycleTimeFast" 0;
BA_DEF_DEF_  "GenMsgNrOfRepetition" 0;
BA_DEF_DEF_  "GenMsgDelayTime" 0;
BA_DEF_DEF_  "CANFD_BRS" "1";
BA_DEF_DEF_  "VFrameFormat" "StandardCAN_FD";
BA_DEF_DEF_  "GenMsgILSupport" "No";
BA_DEF_DEF_ "GenSigASIL" "QM";
BA_ "GenMsgILSupport" BO_ 1027 1;
BA_ "GenMsgCycleTime" BO_ 1027 50;
BA_ "GenSigASIL"  SG_ 1027 FRM_56_CRC 5;
BA_ "GenSigASIL"  SG_ 1027 FRM_56_RollgCntr 5;
BA_ "GenSigASIL"  SG_ 1027 FRM_56_DetnBlockCounter 2;
BA_ "GenSigASIL"  SG_ 1027 FRM_56_DetnMotionSts_198 2;
BA_ "GenSigASIL"  SG_ 1027 FRM_56_DetnRngRadial_198 2;
BA_ "GenSigStartValue" SG_ 1027 FRM_56_DetnAziAngle_198 900;
BA_ "GenSigASIL"  SG_ 1027 FRM_56_DetnAziAngle_198 2;
BA_ "GenSigStartValue" SG_ 1027 FRM_56_DetnElevnAngle_198 100;
BA_ "GenSigASIL"  SG_ 1027 FRM_56_DetnElevnAngle_198 2;
BA_ "GenSigStartValue" SG_ 1027 FRM_56_DetnRelVelRadial_198 10000;
BA_ "GenSigASIL"  SG_ 1027 FRM_56_DetnRelVelRadial_198 2;
BA_ "GenSigASIL"  SG_ 1027 FRM_56_DetnSNR_198 2;
BA_ "GenSigStartValue" SG_ 1027 FRM_56_DetnRCS_198 5000;
BA_ "GenSigASIL"  SG_ 1027 FRM_56_DetnRCS_198 2;
BA_ "GenSigASIL"  SG_ 1027 FRM_56_DetnQuality_198 2;
BA_ "GenSigASIL"  SG_ 1027 FRM_56_DetnMotionSts_199 2;
BA_ "GenSigASIL"  SG_ 1027 FRM_56_DetnRngRadial_199 2;
BA_ "GenSigStartValue" SG_ 1027 FRM_56_DetnAziAngle_199 900;
BA_ "GenSigASIL"  SG_ 1027 FRM_56_DetnAziAngle_199 2;
BA_ "GenSigStartValue" SG_ 1027 FRM_56_DetnElevnAngle_199 100;
BA_ "GenSigASIL"  SG_ 1027 FRM_56_DetnElevnAngle_199 2;
BA_ "GenSigStartValue" SG_ 1027 FRM_56_DetnRelVelRadial_199 10000;
BA_ "GenSigASIL"  SG_ 1027 FRM_56_DetnRelVelRadial_199 2;
BA_ "GenSigASIL"  SG_ 1027 FRM_56_DetnSNR_199 2;
BA_ "GenSigStartValue" SG_ 1027 FRM_56_DetnRCS_199 5000;
BA_ "GenSigASIL"  SG_ 1027 FRM_56_DetnRCS_199 2;
BA_ "GenSigASIL"  SG_ 1027 FRM_56_DetnQuality_199 2;
BA_ "GenSigASIL"  SG_ 1027 FRM_56_DetnMotionSts_200 2;
BA_ "GenSigASIL"  SG_ 1027 FRM_56_DetnRngRadial_200 2;
BA_ "GenSigStartValue" SG_ 1027 FRM_56_DetnAziAngle_200 900;
BA_ "GenSigASIL"  SG_ 1027 FRM_56_DetnAziAngle_200 2;
BA_ "GenSigStartValue" SG_ 1027 FRM_56_DetnElevnAngle_200 100;
BA_ "GenSigASIL"  SG_ 1027 FRM_56_DetnElevnAngle_200 2;
BA_ "GenSigStartValue" SG_ 1027 FRM_56_DetnRelVelRadial_200 10000;
BA_ "GenSigASIL"  SG_ 1027 FRM_56_DetnRelVelRadial_200 2;
BA_ "GenSigASIL"  SG_ 1027 FRM_56_DetnSNR_200 2;
BA_ "GenSigStartValue" SG_ 1027 FRM_56_DetnRCS_200 5000;
BA_ "GenSigASIL"  SG_ 1027 FRM_56_DetnRCS_200 2;
BA_ "GenSigASIL"  SG_ 1027 FRM_56_DetnQuality_200 2;
BA_ "GenSigASIL"  SG_ 1027 FRM_56_DetnMotionSts_201 2;
BA_ "GenSigASIL"  SG_ 1027 FRM_56_DetnRngRadial_201 2;
BA_ "GenSigStartValue" SG_ 1027 FRM_56_DetnAziAngle_201 900;
BA_ "GenSigASIL"  SG_ 1027 FRM_56_DetnAziAngle_201 2;
BA_ "GenSigStartValue" SG_ 1027 FRM_56_DetnElevnAngle_201 100;
BA_ "GenSigASIL"  SG_ 1027 FRM_56_DetnElevnAngle_201 2;
BA_ "GenSigStartValue" SG_ 1027 FRM_56_DetnRelVelRadial_201 10000;
BA_ "GenSigASIL"  SG_ 1027 FRM_56_DetnRelVelRadial_201 2;
BA_ "GenSigASIL"  SG_ 1027 FRM_56_DetnSNR_201 2;
BA_ "GenSigStartValue" SG_ 1027 FRM_56_DetnRCS_201 5000;
BA_ "GenSigASIL"  SG_ 1027 FRM_56_DetnRCS_201 2;
BA_ "GenSigASIL"  SG_ 1027 FRM_56_DetnQuality_201 2;
BA_ "GenSigASIL"  SG_ 1027 FRM_56_DetnMotionSts_202 2;
BA_ "GenSigASIL"  SG_ 1027 FRM_56_DetnRngRadial_202 2;
BA_ "GenSigStartValue" SG_ 1027 FRM_56_DetnAziAngle_202 900;
BA_ "GenSigASIL"  SG_ 1027 FRM_56_DetnAziAngle_202 2;
BA_ "GenSigStartValue" SG_ 1027 FRM_56_DetnElevnAngle_202 100;
BA_ "GenSigASIL"  SG_ 1027 FRM_56_DetnElevnAngle_202 2;
BA_ "GenSigStartValue" SG_ 1027 FRM_56_DetnRelVelRadial_202 10000;
BA_ "GenSigASIL"  SG_ 1027 FRM_56_DetnRelVelRadial_202 2;
BA_ "GenSigASIL"  SG_ 1027 FRM_56_DetnSNR_202 2;
BA_ "GenSigStartValue" SG_ 1027 FRM_56_DetnRCS_202 5000;
BA_ "GenSigASIL"  SG_ 1027 FRM_56_DetnRCS_202 2;
BA_ "GenSigASIL"  SG_ 1027 FRM_56_DetnQuality_202 2;
BA_ "GenSigASIL"  SG_ 1027 FRM_56_DetnMotionSts_203 2;
BA_ "GenSigASIL"  SG_ 1027 FRM_56_DetnRngRadial_203 2;
BA_ "GenSigStartValue" SG_ 1027 FRM_56_DetnAziAngle_203 900;
BA_ "GenSigASIL"  SG_ 1027 FRM_56_DetnAziAngle_203 2;
BA_ "GenSigStartValue" SG_ 1027 FRM_56_DetnElevnAngle_203 100;
BA_ "GenSigASIL"  SG_ 1027 FRM_56_DetnElevnAngle_203 2;
BA_ "GenSigStartValue" SG_ 1027 FRM_56_DetnRelVelRadial_203 10000;
BA_ "GenSigASIL"  SG_ 1027 FRM_56_DetnRelVelRadial_203 2;
BA_ "GenSigASIL"  SG_ 1027 FRM_56_DetnSNR_203 2;
BA_ "GenSigStartValue" SG_ 1027 FRM_56_DetnRCS_203 5000;
BA_ "GenSigASIL"  SG_ 1027 FRM_56_DetnRCS_203 2;
BA_ "GenSigASIL"  SG_ 1027 FRM_56_DetnQuality_203 2;
BA_ "GenMsgILSupport" BO_ 1028 1;
BA_ "GenMsgCycleTime" BO_ 1028 50;
BA_ "GenSigASIL"  SG_ 1028 FRM_57_CRC 5;
BA_ "GenSigASIL"  SG_ 1028 FRM_57_RollgCntr 5;
BA_ "GenSigASIL"  SG_ 1028 FRM_57_DetnBlockCounter 2;
BA_ "GenSigASIL"  SG_ 1028 FRM_57_DetnMotionSts_204 2;
BA_ "GenSigASIL"  SG_ 1028 FRM_57_DetnRngRadial_204 2;
BA_ "GenSigStartValue" SG_ 1028 FRM_57_DetnAziAngle_204 900;
BA_ "GenSigASIL"  SG_ 1028 FRM_57_DetnAziAngle_204 2;
BA_ "GenSigStartValue" SG_ 1028 FRM_57_DetnElevnAngle_204 100;
BA_ "GenSigASIL"  SG_ 1028 FRM_57_DetnElevnAngle_204 2;
BA_ "GenSigStartValue" SG_ 1028 FRM_57_DetnRelVelRadial_204 10000;
BA_ "GenSigASIL"  SG_ 1028 FRM_57_DetnRelVelRadial_204 2;
BA_ "GenSigASIL"  SG_ 1028 FRM_57_DetnSNR_204 2;
BA_ "GenSigStartValue" SG_ 1028 FRM_57_DetnRCS_204 5000;
BA_ "GenSigASIL"  SG_ 1028 FRM_57_DetnRCS_204 2;
BA_ "GenSigASIL"  SG_ 1028 FRM_57_DetnQuality_204 2;
BA_ "GenSigASIL"  SG_ 1028 FRM_57_DetnMotionSts_205 2;
BA_ "GenSigASIL"  SG_ 1028 FRM_57_DetnRngRadial_205 2;
BA_ "GenSigStartValue" SG_ 1028 FRM_57_DetnAziAngle_205 900;
BA_ "GenSigASIL"  SG_ 1028 FRM_57_DetnAziAngle_205 2;
BA_ "GenSigStartValue" SG_ 1028 FRM_57_DetnElevnAngle_205 100;
BA_ "GenSigASIL"  SG_ 1028 FRM_57_DetnElevnAngle_205 2;
BA_ "GenSigStartValue" SG_ 1028 FRM_57_DetnRelVelRadial_205 10000;
BA_ "GenSigASIL"  SG_ 1028 FRM_57_DetnRelVelRadial_205 2;
BA_ "GenSigASIL"  SG_ 1028 FRM_57_DetnSNR_205 2;
BA_ "GenSigStartValue" SG_ 1028 FRM_57_DetnRCS_205 5000;
BA_ "GenSigASIL"  SG_ 1028 FRM_57_DetnRCS_205 2;
BA_ "GenSigASIL"  SG_ 1028 FRM_57_DetnQuality_205 2;
BA_ "GenSigASIL"  SG_ 1028 FRM_57_DetnMotionSts_206 2;
BA_ "GenSigASIL"  SG_ 1028 FRM_57_DetnRngRadial_206 2;
BA_ "GenSigStartValue" SG_ 1028 FRM_57_DetnAziAngle_206 900;
BA_ "GenSigASIL"  SG_ 1028 FRM_57_DetnAziAngle_206 2;
BA_ "GenSigStartValue" SG_ 1028 FRM_57_DetnElevnAngle_206 100;
BA_ "GenSigASIL"  SG_ 1028 FRM_57_DetnElevnAngle_206 2;
BA_ "GenSigStartValue" SG_ 1028 FRM_57_DetnRelVelRadial_206 10000;
BA_ "GenSigASIL"  SG_ 1028 FRM_57_DetnRelVelRadial_206 2;
BA_ "GenSigASIL"  SG_ 1028 FRM_57_DetnSNR_206 2;
BA_ "GenSigStartValue" SG_ 1028 FRM_57_DetnRCS_206 5000;
BA_ "GenSigASIL"  SG_ 1028 FRM_57_DetnRCS_206 2;
BA_ "GenSigASIL"  SG_ 1028 FRM_57_DetnQuality_206 2;
BA_ "GenSigASIL"  SG_ 1028 FRM_57_DetnMotionSts_207 2;
BA_ "GenSigASIL"  SG_ 1028 FRM_57_DetnRngRadial_207 2;
BA_ "GenSigStartValue" SG_ 1028 FRM_57_DetnAziAngle_207 900;
BA_ "GenSigASIL"  SG_ 1028 FRM_57_DetnAziAngle_207 2;
BA_ "GenSigStartValue" SG_ 1028 FRM_57_DetnElevnAngle_207 100;
BA_ "GenSigASIL"  SG_ 1028 FRM_57_DetnElevnAngle_207 2;
BA_ "GenSigStartValue" SG_ 1028 FRM_57_DetnRelVelRadial_207 10000;
BA_ "GenSigASIL"  SG_ 1028 FRM_57_DetnRelVelRadial_207 2;
BA_ "GenSigASIL"  SG_ 1028 FRM_57_DetnSNR_207 2;
BA_ "GenSigStartValue" SG_ 1028 FRM_57_DetnRCS_207 5000;
BA_ "GenSigASIL"  SG_ 1028 FRM_57_DetnRCS_207 2;
BA_ "GenSigASIL"  SG_ 1028 FRM_57_DetnQuality_207 2;
BA_ "GenSigASIL"  SG_ 1028 FRM_57_DetnMotionSts_208 2;
BA_ "GenSigASIL"  SG_ 1028 FRM_57_DetnRngRadial_208 2;
BA_ "GenSigStartValue" SG_ 1028 FRM_57_DetnAziAngle_208 900;
BA_ "GenSigASIL"  SG_ 1028 FRM_57_DetnAziAngle_208 2;
BA_ "GenSigStartValue" SG_ 1028 FRM_57_DetnElevnAngle_208 100;
BA_ "GenSigASIL"  SG_ 1028 FRM_57_DetnElevnAngle_208 2;
BA_ "GenSigStartValue" SG_ 1028 FRM_57_DetnRelVelRadial_208 10000;
BA_ "GenSigASIL"  SG_ 1028 FRM_57_DetnRelVelRadial_208 2;
BA_ "GenSigASIL"  SG_ 1028 FRM_57_DetnSNR_208 2;
BA_ "GenSigStartValue" SG_ 1028 FRM_57_DetnRCS_208 5000;
BA_ "GenSigASIL"  SG_ 1028 FRM_57_DetnRCS_208 2;
BA_ "GenSigASIL"  SG_ 1028 FRM_57_DetnQuality_208 2;
BA_ "GenSigASIL"  SG_ 1028 FRM_57_DetnMotionSts_209 2;
BA_ "GenSigASIL"  SG_ 1028 FRM_57_DetnRngRadial_209 2;
BA_ "GenSigStartValue" SG_ 1028 FRM_57_DetnAziAngle_209 900;
BA_ "GenSigASIL"  SG_ 1028 FRM_57_DetnAziAngle_209 2;
BA_ "GenSigStartValue" SG_ 1028 FRM_57_DetnElevnAngle_209 100;
BA_ "GenSigASIL"  SG_ 1028 FRM_57_DetnElevnAngle_209 2;
BA_ "GenSigStartValue" SG_ 1028 FRM_57_DetnRelVelRadial_209 10000;
BA_ "GenSigASIL"  SG_ 1028 FRM_57_DetnRelVelRadial_209 2;
BA_ "GenSigASIL"  SG_ 1028 FRM_57_DetnSNR_209 2;
BA_ "GenSigStartValue" SG_ 1028 FRM_57_DetnRCS_209 5000;
BA_ "GenSigASIL"  SG_ 1028 FRM_57_DetnRCS_209 2;
BA_ "GenSigASIL"  SG_ 1028 FRM_57_DetnQuality_209 2;
BA_ "GenMsgILSupport" BO_ 1029 1;
BA_ "GenMsgCycleTime" BO_ 1029 50;
BA_ "GenSigASIL"  SG_ 1029 FRM_58_CRC 5;
BA_ "GenSigASIL"  SG_ 1029 FRM_58_RollgCntr 5;
BA_ "GenSigASIL"  SG_ 1029 FRM_58_DetnBlockCounter 2;
BA_ "GenSigASIL"  SG_ 1029 FRM_58_DetnMotionSts_210 2;
BA_ "GenSigASIL"  SG_ 1029 FRM_58_DetnRngRadial_210 2;
BA_ "GenSigStartValue" SG_ 1029 FRM_58_DetnAziAngle_210 900;
BA_ "GenSigASIL"  SG_ 1029 FRM_58_DetnAziAngle_210 2;
BA_ "GenSigStartValue" SG_ 1029 FRM_58_DetnElevnAngle_210 100;
BA_ "GenSigASIL"  SG_ 1029 FRM_58_DetnElevnAngle_210 2;
BA_ "GenSigStartValue" SG_ 1029 FRM_58_DetnRelVelRadial_210 10000;
BA_ "GenSigASIL"  SG_ 1029 FRM_58_DetnRelVelRadial_210 2;
BA_ "GenSigASIL"  SG_ 1029 FRM_58_DetnSNR_210 2;
BA_ "GenSigStartValue" SG_ 1029 FRM_58_DetnRCS_210 5000;
BA_ "GenSigASIL"  SG_ 1029 FRM_58_DetnRCS_210 2;
BA_ "GenSigASIL"  SG_ 1029 FRM_58_DetnQuality_210 2;
BA_ "GenSigASIL"  SG_ 1029 FRM_58_DetnMotionSts_211 2;
BA_ "GenSigASIL"  SG_ 1029 FRM_58_DetnRngRadial_211 2;
BA_ "GenSigStartValue" SG_ 1029 FRM_58_DetnAziAngle_211 900;
BA_ "GenSigASIL"  SG_ 1029 FRM_58_DetnAziAngle_211 2;
BA_ "GenSigStartValue" SG_ 1029 FRM_58_DetnElevnAngle_211 100;
BA_ "GenSigASIL"  SG_ 1029 FRM_58_DetnElevnAngle_211 2;
BA_ "GenSigStartValue" SG_ 1029 FRM_58_DetnRelVelRadial_211 10000;
BA_ "GenSigASIL"  SG_ 1029 FRM_58_DetnRelVelRadial_211 2;
BA_ "GenSigASIL"  SG_ 1029 FRM_58_DetnSNR_211 2;
BA_ "GenSigStartValue" SG_ 1029 FRM_58_DetnRCS_211 5000;
BA_ "GenSigASIL"  SG_ 1029 FRM_58_DetnRCS_211 2;
BA_ "GenSigASIL"  SG_ 1029 FRM_58_DetnQuality_211 2;
BA_ "GenSigASIL"  SG_ 1029 FRM_58_DetnMotionSts_212 2;
BA_ "GenSigASIL"  SG_ 1029 FRM_58_DetnRngRadial_212 2;
BA_ "GenSigStartValue" SG_ 1029 FRM_58_DetnAziAngle_212 900;
BA_ "GenSigASIL"  SG_ 1029 FRM_58_DetnAziAngle_212 2;
BA_ "GenSigStartValue" SG_ 1029 FRM_58_DetnElevnAngle_212 100;
BA_ "GenSigASIL"  SG_ 1029 FRM_58_DetnElevnAngle_212 2;
BA_ "GenSigStartValue" SG_ 1029 FRM_58_DetnRelVelRadial_212 10000;
BA_ "GenSigASIL"  SG_ 1029 FRM_58_DetnRelVelRadial_212 2;
BA_ "GenSigASIL"  SG_ 1029 FRM_58_DetnSNR_212 2;
BA_ "GenSigStartValue" SG_ 1029 FRM_58_DetnRCS_212 5000;
BA_ "GenSigASIL"  SG_ 1029 FRM_58_DetnRCS_212 2;
BA_ "GenSigASIL"  SG_ 1029 FRM_58_DetnQuality_212 2;
BA_ "GenSigASIL"  SG_ 1029 FRM_58_DetnMotionSts_213 2;
BA_ "GenSigASIL"  SG_ 1029 FRM_58_DetnRngRadial_213 2;
BA_ "GenSigStartValue" SG_ 1029 FRM_58_DetnAziAngle_213 900;
BA_ "GenSigASIL"  SG_ 1029 FRM_58_DetnAziAngle_213 2;
BA_ "GenSigStartValue" SG_ 1029 FRM_58_DetnElevnAngle_213 100;
BA_ "GenSigASIL"  SG_ 1029 FRM_58_DetnElevnAngle_213 2;
BA_ "GenSigStartValue" SG_ 1029 FRM_58_DetnRelVelRadial_213 10000;
BA_ "GenSigASIL"  SG_ 1029 FRM_58_DetnRelVelRadial_213 2;
BA_ "GenSigASIL"  SG_ 1029 FRM_58_DetnSNR_213 2;
BA_ "GenSigStartValue" SG_ 1029 FRM_58_DetnRCS_213 5000;
BA_ "GenSigASIL"  SG_ 1029 FRM_58_DetnRCS_213 2;
BA_ "GenSigASIL"  SG_ 1029 FRM_58_DetnQuality_213 2;
BA_ "GenSigASIL"  SG_ 1029 FRM_58_DetnMotionSts_214 2;
BA_ "GenSigASIL"  SG_ 1029 FRM_58_DetnRngRadial_214 2;
BA_ "GenSigStartValue" SG_ 1029 FRM_58_DetnAziAngle_214 900;
BA_ "GenSigASIL"  SG_ 1029 FRM_58_DetnAziAngle_214 2;
BA_ "GenSigStartValue" SG_ 1029 FRM_58_DetnElevnAngle_214 100;
BA_ "GenSigASIL"  SG_ 1029 FRM_58_DetnElevnAngle_214 2;
BA_ "GenSigStartValue" SG_ 1029 FRM_58_DetnRelVelRadial_214 10000;
BA_ "GenSigASIL"  SG_ 1029 FRM_58_DetnRelVelRadial_214 2;
BA_ "GenSigASIL"  SG_ 1029 FRM_58_DetnSNR_214 2;
BA_ "GenSigStartValue" SG_ 1029 FRM_58_DetnRCS_214 5000;
BA_ "GenSigASIL"  SG_ 1029 FRM_58_DetnRCS_214 2;
BA_ "GenSigASIL"  SG_ 1029 FRM_58_DetnQuality_214 2;
BA_ "GenSigASIL"  SG_ 1029 FRM_58_DetnMotionSts_215 2;
BA_ "GenSigASIL"  SG_ 1029 FRM_58_DetnRngRadial_215 2;
BA_ "GenSigStartValue" SG_ 1029 FRM_58_DetnAziAngle_215 900;
BA_ "GenSigASIL"  SG_ 1029 FRM_58_DetnAziAngle_215 2;
BA_ "GenSigStartValue" SG_ 1029 FRM_58_DetnElevnAngle_215 100;
BA_ "GenSigASIL"  SG_ 1029 FRM_58_DetnElevnAngle_215 2;
BA_ "GenSigStartValue" SG_ 1029 FRM_58_DetnRelVelRadial_215 10000;
BA_ "GenSigASIL"  SG_ 1029 FRM_58_DetnRelVelRadial_215 2;
BA_ "GenSigASIL"  SG_ 1029 FRM_58_DetnSNR_215 2;
BA_ "GenSigStartValue" SG_ 1029 FRM_58_DetnRCS_215 5000;
BA_ "GenSigASIL"  SG_ 1029 FRM_58_DetnRCS_215 2;
BA_ "GenSigASIL"  SG_ 1029 FRM_58_DetnQuality_215 2;
BA_ "GenMsgILSupport" BO_ 1030 1;
BA_ "GenMsgCycleTime" BO_ 1030 50;
BA_ "GenSigASIL"  SG_ 1030 FRM_59_CRC 5;
BA_ "GenSigASIL"  SG_ 1030 FRM_59_RollgCntr 5;
BA_ "GenSigASIL"  SG_ 1030 FRM_59_DetnBlockCounter 2;
BA_ "GenSigASIL"  SG_ 1030 FRM_59_DetnMotionSts_216 2;
BA_ "GenSigASIL"  SG_ 1030 FRM_59_DetnRngRadial_216 2;
BA_ "GenSigStartValue" SG_ 1030 FRM_59_DetnAziAngle_216 900;
BA_ "GenSigASIL"  SG_ 1030 FRM_59_DetnAziAngle_216 2;
BA_ "GenSigStartValue" SG_ 1030 FRM_59_DetnElevnAngle_216 100;
BA_ "GenSigASIL"  SG_ 1030 FRM_59_DetnElevnAngle_216 2;
BA_ "GenSigStartValue" SG_ 1030 FRM_59_DetnRelVelRadial_216 10000;
BA_ "GenSigASIL"  SG_ 1030 FRM_59_DetnRelVelRadial_216 2;
BA_ "GenSigASIL"  SG_ 1030 FRM_59_DetnSNR_216 2;
BA_ "GenSigStartValue" SG_ 1030 FRM_59_DetnRCS_216 5000;
BA_ "GenSigASIL"  SG_ 1030 FRM_59_DetnRCS_216 2;
BA_ "GenSigASIL"  SG_ 1030 FRM_59_DetnQuality_216 2;
BA_ "GenSigASIL"  SG_ 1030 FRM_59_DetnMotionSts_217 2;
BA_ "GenSigASIL"  SG_ 1030 FRM_59_DetnRngRadial_217 2;
BA_ "GenSigStartValue" SG_ 1030 FRM_59_DetnAziAngle_217 900;
BA_ "GenSigASIL"  SG_ 1030 FRM_59_DetnAziAngle_217 2;
BA_ "GenSigStartValue" SG_ 1030 FRM_59_DetnElevnAngle_217 100;
BA_ "GenSigASIL"  SG_ 1030 FRM_59_DetnElevnAngle_217 2;
BA_ "GenSigStartValue" SG_ 1030 FRM_59_DetnRelVelRadial_217 10000;
BA_ "GenSigASIL"  SG_ 1030 FRM_59_DetnRelVelRadial_217 2;
BA_ "GenSigASIL"  SG_ 1030 FRM_59_DetnSNR_217 2;
BA_ "GenSigStartValue" SG_ 1030 FRM_59_DetnRCS_217 5000;
BA_ "GenSigASIL"  SG_ 1030 FRM_59_DetnRCS_217 2;
BA_ "GenSigASIL"  SG_ 1030 FRM_59_DetnQuality_217 2;
BA_ "GenSigASIL"  SG_ 1030 FRM_59_DetnMotionSts_218 2;
BA_ "GenSigASIL"  SG_ 1030 FRM_59_DetnRngRadial_218 2;
BA_ "GenSigStartValue" SG_ 1030 FRM_59_DetnAziAngle_218 900;
BA_ "GenSigASIL"  SG_ 1030 FRM_59_DetnAziAngle_218 2;
BA_ "GenSigStartValue" SG_ 1030 FRM_59_DetnElevnAngle_218 100;
BA_ "GenSigASIL"  SG_ 1030 FRM_59_DetnElevnAngle_218 2;
BA_ "GenSigStartValue" SG_ 1030 FRM_59_DetnRelVelRadial_218 10000;
BA_ "GenSigASIL"  SG_ 1030 FRM_59_DetnRelVelRadial_218 2;
BA_ "GenSigASIL"  SG_ 1030 FRM_59_DetnSNR_218 2;
BA_ "GenSigStartValue" SG_ 1030 FRM_59_DetnRCS_218 5000;
BA_ "GenSigASIL"  SG_ 1030 FRM_59_DetnRCS_218 2;
BA_ "GenSigASIL"  SG_ 1030 FRM_59_DetnQuality_218 2;
BA_ "GenSigASIL"  SG_ 1030 FRM_59_DetnMotionSts_219 2;
BA_ "GenSigASIL"  SG_ 1030 FRM_59_DetnRngRadial_219 2;
BA_ "GenSigStartValue" SG_ 1030 FRM_59_DetnAziAngle_219 900;
BA_ "GenSigASIL"  SG_ 1030 FRM_59_DetnAziAngle_219 2;
BA_ "GenSigStartValue" SG_ 1030 FRM_59_DetnElevnAngle_219 100;
BA_ "GenSigASIL"  SG_ 1030 FRM_59_DetnElevnAngle_219 2;
BA_ "GenSigStartValue" SG_ 1030 FRM_59_DetnRelVelRadial_219 10000;
BA_ "GenSigASIL"  SG_ 1030 FRM_59_DetnRelVelRadial_219 2;
BA_ "GenSigASIL"  SG_ 1030 FRM_59_DetnSNR_219 2;
BA_ "GenSigStartValue" SG_ 1030 FRM_59_DetnRCS_219 5000;
BA_ "GenSigASIL"  SG_ 1030 FRM_59_DetnRCS_219 2;
BA_ "GenSigASIL"  SG_ 1030 FRM_59_DetnQuality_219 2;
BA_ "GenSigASIL"  SG_ 1030 FRM_59_DetnMotionSts_220 2;
BA_ "GenSigASIL"  SG_ 1030 FRM_59_DetnRngRadial_220 2;
BA_ "GenSigStartValue" SG_ 1030 FRM_59_DetnAziAngle_220 900;
BA_ "GenSigASIL"  SG_ 1030 FRM_59_DetnAziAngle_220 2;
BA_ "GenSigStartValue" SG_ 1030 FRM_59_DetnElevnAngle_220 100;
BA_ "GenSigASIL"  SG_ 1030 FRM_59_DetnElevnAngle_220 2;
BA_ "GenSigStartValue" SG_ 1030 FRM_59_DetnRelVelRadial_220 10000;
BA_ "GenSigASIL"  SG_ 1030 FRM_59_DetnRelVelRadial_220 2;
BA_ "GenSigASIL"  SG_ 1030 FRM_59_DetnSNR_220 2;
BA_ "GenSigStartValue" SG_ 1030 FRM_59_DetnRCS_220 5000;
BA_ "GenSigASIL"  SG_ 1030 FRM_59_DetnRCS_220 2;
BA_ "GenSigASIL"  SG_ 1030 FRM_59_DetnQuality_220 2;
BA_ "GenSigASIL"  SG_ 1030 FRM_59_DetnMotionSts_221 2;
BA_ "GenSigASIL"  SG_ 1030 FRM_59_DetnRngRadial_221 2;
BA_ "GenSigStartValue" SG_ 1030 FRM_59_DetnAziAngle_221 900;
BA_ "GenSigASIL"  SG_ 1030 FRM_59_DetnAziAngle_221 2;
BA_ "GenSigStartValue" SG_ 1030 FRM_59_DetnElevnAngle_221 100;
BA_ "GenSigASIL"  SG_ 1030 FRM_59_DetnElevnAngle_221 2;
BA_ "GenSigStartValue" SG_ 1030 FRM_59_DetnRelVelRadial_221 10000;
BA_ "GenSigASIL"  SG_ 1030 FRM_59_DetnRelVelRadial_221 2;
BA_ "GenSigASIL"  SG_ 1030 FRM_59_DetnSNR_221 2;
BA_ "GenSigStartValue" SG_ 1030 FRM_59_DetnRCS_221 5000;
BA_ "GenSigASIL"  SG_ 1030 FRM_59_DetnRCS_221 2;
BA_ "GenSigASIL"  SG_ 1030 FRM_59_DetnQuality_221 2;
BA_ "GenMsgILSupport" BO_ 1031 1;
BA_ "GenMsgCycleTime" BO_ 1031 50;
BA_ "GenSigASIL"  SG_ 1031 FRM_60_CRC 5;
BA_ "GenSigASIL"  SG_ 1031 FRM_60_RollgCntr 5;
BA_ "GenSigASIL"  SG_ 1031 FRM_60_DetnBlockCounter 2;
BA_ "GenSigASIL"  SG_ 1031 FRM_60_DetnMotionSts_222 2;
BA_ "GenSigASIL"  SG_ 1031 FRM_60_DetnRngRadial_222 2;
BA_ "GenSigStartValue" SG_ 1031 FRM_60_DetnAziAngle_222 900;
BA_ "GenSigASIL"  SG_ 1031 FRM_60_DetnAziAngle_222 2;
BA_ "GenSigStartValue" SG_ 1031 FRM_60_DetnElevnAngle_222 100;
BA_ "GenSigASIL"  SG_ 1031 FRM_60_DetnElevnAngle_222 2;
BA_ "GenSigStartValue" SG_ 1031 FRM_60_DetnRelVelRadial_222 10000;
BA_ "GenSigASIL"  SG_ 1031 FRM_60_DetnRelVelRadial_222 2;
BA_ "GenSigASIL"  SG_ 1031 FRM_60_DetnSNR_222 2;
BA_ "GenSigStartValue" SG_ 1031 FRM_60_DetnRCS_222 5000;
BA_ "GenSigASIL"  SG_ 1031 FRM_60_DetnRCS_222 2;
BA_ "GenSigASIL"  SG_ 1031 FRM_60_DetnQuality_222 2;
BA_ "GenSigASIL"  SG_ 1031 FRM_60_DetnMotionSts_223 2;
BA_ "GenSigASIL"  SG_ 1031 FRM_60_DetnRngRadial_223 2;
BA_ "GenSigStartValue" SG_ 1031 FRM_60_DetnAziAngle_223 900;
BA_ "GenSigASIL"  SG_ 1031 FRM_60_DetnAziAngle_223 2;
BA_ "GenSigStartValue" SG_ 1031 FRM_60_DetnElevnAngle_223 100;
BA_ "GenSigASIL"  SG_ 1031 FRM_60_DetnElevnAngle_223 2;
BA_ "GenSigStartValue" SG_ 1031 FRM_60_DetnRelVelRadial_223 10000;
BA_ "GenSigASIL"  SG_ 1031 FRM_60_DetnRelVelRadial_223 2;
BA_ "GenSigASIL"  SG_ 1031 FRM_60_DetnSNR_223 2;
BA_ "GenSigStartValue" SG_ 1031 FRM_60_DetnRCS_223 5000;
BA_ "GenSigASIL"  SG_ 1031 FRM_60_DetnRCS_223 2;
BA_ "GenSigASIL"  SG_ 1031 FRM_60_DetnQuality_223 2;
BA_ "GenSigASIL"  SG_ 1031 FRM_60_DetnMotionSts_224 2;
BA_ "GenSigASIL"  SG_ 1031 FRM_60_DetnRngRadial_224 2;
BA_ "GenSigStartValue" SG_ 1031 FRM_60_DetnAziAngle_224 900;
BA_ "GenSigASIL"  SG_ 1031 FRM_60_DetnAziAngle_224 2;
BA_ "GenSigStartValue" SG_ 1031 FRM_60_DetnElevnAngle_224 100;
BA_ "GenSigASIL"  SG_ 1031 FRM_60_DetnElevnAngle_224 2;
BA_ "GenSigStartValue" SG_ 1031 FRM_60_DetnRelVelRadial_224 10000;
BA_ "GenSigASIL"  SG_ 1031 FRM_60_DetnRelVelRadial_224 2;
BA_ "GenSigASIL"  SG_ 1031 FRM_60_DetnSNR_224 2;
BA_ "GenSigStartValue" SG_ 1031 FRM_60_DetnRCS_224 5000;
BA_ "GenSigASIL"  SG_ 1031 FRM_60_DetnRCS_224 2;
BA_ "GenSigASIL"  SG_ 1031 FRM_60_DetnQuality_224 2;
BA_ "GenSigASIL"  SG_ 1031 FRM_60_DetnMotionSts_225 2;
BA_ "GenSigASIL"  SG_ 1031 FRM_60_DetnRngRadial_225 2;
BA_ "GenSigStartValue" SG_ 1031 FRM_60_DetnAziAngle_225 900;
BA_ "GenSigASIL"  SG_ 1031 FRM_60_DetnAziAngle_225 2;
BA_ "GenSigStartValue" SG_ 1031 FRM_60_DetnElevnAngle_225 100;
BA_ "GenSigASIL"  SG_ 1031 FRM_60_DetnElevnAngle_225 2;
BA_ "GenSigStartValue" SG_ 1031 FRM_60_DetnRelVelRadial_225 10000;
BA_ "GenSigASIL"  SG_ 1031 FRM_60_DetnRelVelRadial_225 2;
BA_ "GenSigASIL"  SG_ 1031 FRM_60_DetnSNR_225 2;
BA_ "GenSigStartValue" SG_ 1031 FRM_60_DetnRCS_225 5000;
BA_ "GenSigASIL"  SG_ 1031 FRM_60_DetnRCS_225 2;
BA_ "GenSigASIL"  SG_ 1031 FRM_60_DetnQuality_225 2;
BA_ "GenSigASIL"  SG_ 1031 FRM_60_DetnMotionSts_226 2;
BA_ "GenSigASIL"  SG_ 1031 FRM_60_DetnRngRadial_226 2;
BA_ "GenSigStartValue" SG_ 1031 FRM_60_DetnAziAngle_226 900;
BA_ "GenSigASIL"  SG_ 1031 FRM_60_DetnAziAngle_226 2;
BA_ "GenSigStartValue" SG_ 1031 FRM_60_DetnElevnAngle_226 100;
BA_ "GenSigASIL"  SG_ 1031 FRM_60_DetnElevnAngle_226 2;
BA_ "GenSigStartValue" SG_ 1031 FRM_60_DetnRelVelRadial_226 10000;
BA_ "GenSigASIL"  SG_ 1031 FRM_60_DetnRelVelRadial_226 2;
BA_ "GenSigASIL"  SG_ 1031 FRM_60_DetnSNR_226 2;
BA_ "GenSigStartValue" SG_ 1031 FRM_60_DetnRCS_226 5000;
BA_ "GenSigASIL"  SG_ 1031 FRM_60_DetnRCS_226 2;
BA_ "GenSigASIL"  SG_ 1031 FRM_60_DetnQuality_226 2;
BA_ "GenSigASIL"  SG_ 1031 FRM_60_DetnMotionSts_227 2;
BA_ "GenSigASIL"  SG_ 1031 FRM_60_DetnRngRadial_227 2;
BA_ "GenSigStartValue" SG_ 1031 FRM_60_DetnAziAngle_227 900;
BA_ "GenSigASIL"  SG_ 1031 FRM_60_DetnAziAngle_227 2;
BA_ "GenSigStartValue" SG_ 1031 FRM_60_DetnElevnAngle_227 100;
BA_ "GenSigASIL"  SG_ 1031 FRM_60_DetnElevnAngle_227 2;
BA_ "GenSigStartValue" SG_ 1031 FRM_60_DetnRelVelRadial_227 10000;
BA_ "GenSigASIL"  SG_ 1031 FRM_60_DetnRelVelRadial_227 2;
BA_ "GenSigASIL"  SG_ 1031 FRM_60_DetnSNR_227 2;
BA_ "GenSigStartValue" SG_ 1031 FRM_60_DetnRCS_227 5000;
BA_ "GenSigASIL"  SG_ 1031 FRM_60_DetnRCS_227 2;
BA_ "GenSigASIL"  SG_ 1031 FRM_60_DetnQuality_227 2;
BA_ "GenMsgILSupport" BO_ 1032 1;
BA_ "GenMsgCycleTime" BO_ 1032 50;
BA_ "GenSigASIL"  SG_ 1032 FRM_61_CRC 5;
BA_ "GenSigASIL"  SG_ 1032 FRM_61_RollgCntr 5;
BA_ "GenSigASIL"  SG_ 1032 FRM_61_DetnBlockCounter 2;
BA_ "GenSigASIL"  SG_ 1032 FRM_61_DetnMotionSts_228 2;
BA_ "GenSigASIL"  SG_ 1032 FRM_61_DetnRngRadial_228 2;
BA_ "GenSigStartValue" SG_ 1032 FRM_61_DetnAziAngle_228 900;
BA_ "GenSigASIL"  SG_ 1032 FRM_61_DetnAziAngle_228 2;
BA_ "GenSigStartValue" SG_ 1032 FRM_61_DetnElevnAngle_228 100;
BA_ "GenSigASIL"  SG_ 1032 FRM_61_DetnElevnAngle_228 2;
BA_ "GenSigStartValue" SG_ 1032 FRM_61_DetnRelVelRadial_228 10000;
BA_ "GenSigASIL"  SG_ 1032 FRM_61_DetnRelVelRadial_228 2;
BA_ "GenSigASIL"  SG_ 1032 FRM_61_DetnSNR_228 2;
BA_ "GenSigStartValue" SG_ 1032 FRM_61_DetnRCS_228 5000;
BA_ "GenSigASIL"  SG_ 1032 FRM_61_DetnRCS_228 2;
BA_ "GenSigASIL"  SG_ 1032 FRM_61_DetnQuality_228 2;
BA_ "GenSigASIL"  SG_ 1032 FRM_61_DetnMotionSts_229 2;
BA_ "GenSigASIL"  SG_ 1032 FRM_61_DetnRngRadial_229 2;
BA_ "GenSigStartValue" SG_ 1032 FRM_61_DetnAziAngle_229 900;
BA_ "GenSigASIL"  SG_ 1032 FRM_61_DetnAziAngle_229 2;
BA_ "GenSigStartValue" SG_ 1032 FRM_61_DetnElevnAngle_229 100;
BA_ "GenSigASIL"  SG_ 1032 FRM_61_DetnElevnAngle_229 2;
BA_ "GenSigStartValue" SG_ 1032 FRM_61_DetnRelVelRadial_229 10000;
BA_ "GenSigASIL"  SG_ 1032 FRM_61_DetnRelVelRadial_229 2;
BA_ "GenSigASIL"  SG_ 1032 FRM_61_DetnSNR_229 2;
BA_ "GenSigStartValue" SG_ 1032 FRM_61_DetnRCS_229 5000;
BA_ "GenSigASIL"  SG_ 1032 FRM_61_DetnRCS_229 2;
BA_ "GenSigASIL"  SG_ 1032 FRM_61_DetnQuality_229 2;
BA_ "GenSigASIL"  SG_ 1032 FRM_61_DetnMotionSts_230 2;
BA_ "GenSigASIL"  SG_ 1032 FRM_61_DetnRngRadial_230 2;
BA_ "GenSigStartValue" SG_ 1032 FRM_61_DetnAziAngle_230 900;
BA_ "GenSigASIL"  SG_ 1032 FRM_61_DetnAziAngle_230 2;
BA_ "GenSigStartValue" SG_ 1032 FRM_61_DetnElevnAngle_230 100;
BA_ "GenSigASIL"  SG_ 1032 FRM_61_DetnElevnAngle_230 2;
BA_ "GenSigStartValue" SG_ 1032 FRM_61_DetnRelVelRadial_230 10000;
BA_ "GenSigASIL"  SG_ 1032 FRM_61_DetnRelVelRadial_230 2;
BA_ "GenSigASIL"  SG_ 1032 FRM_61_DetnSNR_230 2;
BA_ "GenSigStartValue" SG_ 1032 FRM_61_DetnRCS_230 5000;
BA_ "GenSigASIL"  SG_ 1032 FRM_61_DetnRCS_230 2;
BA_ "GenSigASIL"  SG_ 1032 FRM_61_DetnQuality_230 2;
BA_ "GenSigASIL"  SG_ 1032 FRM_61_DetnMotionSts_231 2;
BA_ "GenSigASIL"  SG_ 1032 FRM_61_DetnRngRadial_231 2;
BA_ "GenSigStartValue" SG_ 1032 FRM_61_DetnAziAngle_231 900;
BA_ "GenSigASIL"  SG_ 1032 FRM_61_DetnAziAngle_231 2;
BA_ "GenSigStartValue" SG_ 1032 FRM_61_DetnElevnAngle_231 100;
BA_ "GenSigASIL"  SG_ 1032 FRM_61_DetnElevnAngle_231 2;
BA_ "GenSigStartValue" SG_ 1032 FRM_61_DetnRelVelRadial_231 10000;
BA_ "GenSigASIL"  SG_ 1032 FRM_61_DetnRelVelRadial_231 2;
BA_ "GenSigASIL"  SG_ 1032 FRM_61_DetnSNR_231 2;
BA_ "GenSigStartValue" SG_ 1032 FRM_61_DetnRCS_231 5000;
BA_ "GenSigASIL"  SG_ 1032 FRM_61_DetnRCS_231 2;
BA_ "GenSigASIL"  SG_ 1032 FRM_61_DetnQuality_231 2;
BA_ "GenSigASIL"  SG_ 1032 FRM_61_DetnMotionSts_232 2;
BA_ "GenSigASIL"  SG_ 1032 FRM_61_DetnRngRadial_232 2;
BA_ "GenSigStartValue" SG_ 1032 FRM_61_DetnAziAngle_232 900;
BA_ "GenSigASIL"  SG_ 1032 FRM_61_DetnAziAngle_232 2;
BA_ "GenSigStartValue" SG_ 1032 FRM_61_DetnElevnAngle_232 100;
BA_ "GenSigASIL"  SG_ 1032 FRM_61_DetnElevnAngle_232 2;
BA_ "GenSigStartValue" SG_ 1032 FRM_61_DetnRelVelRadial_232 10000;
BA_ "GenSigASIL"  SG_ 1032 FRM_61_DetnRelVelRadial_232 2;
BA_ "GenSigASIL"  SG_ 1032 FRM_61_DetnSNR_232 2;
BA_ "GenSigStartValue" SG_ 1032 FRM_61_DetnRCS_232 5000;
BA_ "GenSigASIL"  SG_ 1032 FRM_61_DetnRCS_232 2;
BA_ "GenSigASIL"  SG_ 1032 FRM_61_DetnQuality_232 2;
BA_ "GenSigASIL"  SG_ 1032 FRM_61_DetnMotionSts_233 2;
BA_ "GenSigASIL"  SG_ 1032 FRM_61_DetnRngRadial_233 2;
BA_ "GenSigStartValue" SG_ 1032 FRM_61_DetnAziAngle_233 900;
BA_ "GenSigASIL"  SG_ 1032 FRM_61_DetnAziAngle_233 2;
BA_ "GenSigStartValue" SG_ 1032 FRM_61_DetnElevnAngle_233 100;
BA_ "GenSigASIL"  SG_ 1032 FRM_61_DetnElevnAngle_233 2;
BA_ "GenSigStartValue" SG_ 1032 FRM_61_DetnRelVelRadial_233 10000;
BA_ "GenSigASIL"  SG_ 1032 FRM_61_DetnRelVelRadial_233 2;
BA_ "GenSigASIL"  SG_ 1032 FRM_61_DetnSNR_233 2;
BA_ "GenSigStartValue" SG_ 1032 FRM_61_DetnRCS_233 5000;
BA_ "GenSigASIL"  SG_ 1032 FRM_61_DetnRCS_233 2;
BA_ "GenSigASIL"  SG_ 1032 FRM_61_DetnQuality_233 2;
BA_ "GenMsgILSupport" BO_ 1033 1;
BA_ "GenMsgCycleTime" BO_ 1033 50;
BA_ "GenSigASIL"  SG_ 1033 FRM_62_CRC 5;
BA_ "GenSigASIL"  SG_ 1033 FRM_62_RollgCntr 5;
BA_ "GenSigASIL"  SG_ 1033 FRM_62_DetnBlockCounter 2;
BA_ "GenSigASIL"  SG_ 1033 FRM_62_DetnMotionSts_234 2;
BA_ "GenSigASIL"  SG_ 1033 FRM_62_DetnRngRadial_234 2;
BA_ "GenSigStartValue" SG_ 1033 FRM_62_DetnAziAngle_234 900;
BA_ "GenSigASIL"  SG_ 1033 FRM_62_DetnAziAngle_234 2;
BA_ "GenSigStartValue" SG_ 1033 FRM_62_DetnElevnAngle_234 100;
BA_ "GenSigASIL"  SG_ 1033 FRM_62_DetnElevnAngle_234 2;
BA_ "GenSigStartValue" SG_ 1033 FRM_62_DetnRelVelRadial_234 10000;
BA_ "GenSigASIL"  SG_ 1033 FRM_62_DetnRelVelRadial_234 2;
BA_ "GenSigASIL"  SG_ 1033 FRM_62_DetnSNR_234 2;
BA_ "GenSigStartValue" SG_ 1033 FRM_62_DetnRCS_234 5000;
BA_ "GenSigASIL"  SG_ 1033 FRM_62_DetnRCS_234 2;
BA_ "GenSigASIL"  SG_ 1033 FRM_62_DetnQuality_234 2;
BA_ "GenSigASIL"  SG_ 1033 FRM_62_DetnMotionSts_235 2;
BA_ "GenSigASIL"  SG_ 1033 FRM_62_DetnRngRadial_235 2;
BA_ "GenSigStartValue" SG_ 1033 FRM_62_DetnAziAngle_235 900;
BA_ "GenSigASIL"  SG_ 1033 FRM_62_DetnAziAngle_235 2;
BA_ "GenSigStartValue" SG_ 1033 FRM_62_DetnElevnAngle_235 100;
BA_ "GenSigASIL"  SG_ 1033 FRM_62_DetnElevnAngle_235 2;
BA_ "GenSigStartValue" SG_ 1033 FRM_62_DetnRelVelRadial_235 10000;
BA_ "GenSigASIL"  SG_ 1033 FRM_62_DetnRelVelRadial_235 2;
BA_ "GenSigASIL"  SG_ 1033 FRM_62_DetnSNR_235 2;
BA_ "GenSigStartValue" SG_ 1033 FRM_62_DetnRCS_235 5000;
BA_ "GenSigASIL"  SG_ 1033 FRM_62_DetnRCS_235 2;
BA_ "GenSigASIL"  SG_ 1033 FRM_62_DetnQuality_235 2;
BA_ "GenSigASIL"  SG_ 1033 FRM_62_DetnMotionSts_236 2;
BA_ "GenSigASIL"  SG_ 1033 FRM_62_DetnRngRadial_236 2;
BA_ "GenSigStartValue" SG_ 1033 FRM_62_DetnAziAngle_236 900;
BA_ "GenSigASIL"  SG_ 1033 FRM_62_DetnAziAngle_236 2;
BA_ "GenSigStartValue" SG_ 1033 FRM_62_DetnElevnAngle_236 100;
BA_ "GenSigASIL"  SG_ 1033 FRM_62_DetnElevnAngle_236 2;
BA_ "GenSigStartValue" SG_ 1033 FRM_62_DetnRelVelRadial_236 10000;
BA_ "GenSigASIL"  SG_ 1033 FRM_62_DetnRelVelRadial_236 2;
BA_ "GenSigASIL"  SG_ 1033 FRM_62_DetnSNR_236 2;
BA_ "GenSigStartValue" SG_ 1033 FRM_62_DetnRCS_236 5000;
BA_ "GenSigASIL"  SG_ 1033 FRM_62_DetnRCS_236 2;
BA_ "GenSigASIL"  SG_ 1033 FRM_62_DetnQuality_236 2;
BA_ "GenSigASIL"  SG_ 1033 FRM_62_DetnMotionSts_237 2;
BA_ "GenSigASIL"  SG_ 1033 FRM_62_DetnRngRadial_237 2;
BA_ "GenSigStartValue" SG_ 1033 FRM_62_DetnAziAngle_237 900;
BA_ "GenSigASIL"  SG_ 1033 FRM_62_DetnAziAngle_237 2;
BA_ "GenSigStartValue" SG_ 1033 FRM_62_DetnElevnAngle_237 100;
BA_ "GenSigASIL"  SG_ 1033 FRM_62_DetnElevnAngle_237 2;
BA_ "GenSigStartValue" SG_ 1033 FRM_62_DetnRelVelRadial_237 10000;
BA_ "GenSigASIL"  SG_ 1033 FRM_62_DetnRelVelRadial_237 2;
BA_ "GenSigASIL"  SG_ 1033 FRM_62_DetnSNR_237 2;
BA_ "GenSigStartValue" SG_ 1033 FRM_62_DetnRCS_237 5000;
BA_ "GenSigASIL"  SG_ 1033 FRM_62_DetnRCS_237 2;
BA_ "GenSigASIL"  SG_ 1033 FRM_62_DetnQuality_237 2;
BA_ "GenSigASIL"  SG_ 1033 FRM_62_DetnMotionSts_238 2;
BA_ "GenSigASIL"  SG_ 1033 FRM_62_DetnRngRadial_238 2;
BA_ "GenSigStartValue" SG_ 1033 FRM_62_DetnAziAngle_238 900;
BA_ "GenSigASIL"  SG_ 1033 FRM_62_DetnAziAngle_238 2;
BA_ "GenSigStartValue" SG_ 1033 FRM_62_DetnElevnAngle_238 100;
BA_ "GenSigASIL"  SG_ 1033 FRM_62_DetnElevnAngle_238 2;
BA_ "GenSigStartValue" SG_ 1033 FRM_62_DetnRelVelRadial_238 10000;
BA_ "GenSigASIL"  SG_ 1033 FRM_62_DetnRelVelRadial_238 2;
BA_ "GenSigASIL"  SG_ 1033 FRM_62_DetnSNR_238 2;
BA_ "GenSigStartValue" SG_ 1033 FRM_62_DetnRCS_238 5000;
BA_ "GenSigASIL"  SG_ 1033 FRM_62_DetnRCS_238 2;
BA_ "GenSigASIL"  SG_ 1033 FRM_62_DetnQuality_238 2;
BA_ "GenSigASIL"  SG_ 1033 FRM_62_DetnMotionSts_239 2;
BA_ "GenSigASIL"  SG_ 1033 FRM_62_DetnRngRadial_239 2;
BA_ "GenSigStartValue" SG_ 1033 FRM_62_DetnAziAngle_239 900;
BA_ "GenSigASIL"  SG_ 1033 FRM_62_DetnAziAngle_239 2;
BA_ "GenSigStartValue" SG_ 1033 FRM_62_DetnElevnAngle_239 100;
BA_ "GenSigASIL"  SG_ 1033 FRM_62_DetnElevnAngle_239 2;
BA_ "GenSigStartValue" SG_ 1033 FRM_62_DetnRelVelRadial_239 10000;
BA_ "GenSigASIL"  SG_ 1033 FRM_62_DetnRelVelRadial_239 2;
BA_ "GenSigASIL"  SG_ 1033 FRM_62_DetnSNR_239 2;
BA_ "GenSigStartValue" SG_ 1033 FRM_62_DetnRCS_239 5000;
BA_ "GenSigASIL"  SG_ 1033 FRM_62_DetnRCS_239 2;
BA_ "GenSigASIL"  SG_ 1033 FRM_62_DetnQuality_239 2;
BA_ "GenMsgILSupport" BO_ 1040 1;
BA_ "GenMsgCycleTime" BO_ 1040 50;
BA_ "GenSigASIL"  SG_ 1040 FRM_63_CRC 5;
BA_ "GenSigASIL"  SG_ 1040 FRM_63_RollgCntr 5;
BA_ "GenSigASIL"  SG_ 1040 FRM_63_DetnBlockCounter 2;
BA_ "GenSigASIL"  SG_ 1040 FRM_63_DetnMotionSts_240 2;
BA_ "GenSigASIL"  SG_ 1040 FRM_63_DetnRngRadial_240 2;
BA_ "GenSigStartValue" SG_ 1040 FRM_63_DetnAziAngle_240 900;
BA_ "GenSigASIL"  SG_ 1040 FRM_63_DetnAziAngle_240 2;
BA_ "GenSigStartValue" SG_ 1040 FRM_63_DetnElevnAngle_240 100;
BA_ "GenSigASIL"  SG_ 1040 FRM_63_DetnElevnAngle_240 2;
BA_ "GenSigStartValue" SG_ 1040 FRM_63_DetnRelVelRadial_240 10000;
BA_ "GenSigASIL"  SG_ 1040 FRM_63_DetnRelVelRadial_240 2;
BA_ "GenSigASIL"  SG_ 1040 FRM_63_DetnSNR_240 2;
BA_ "GenSigStartValue" SG_ 1040 FRM_63_DetnRCS_240 5000;
BA_ "GenSigASIL"  SG_ 1040 FRM_63_DetnRCS_240 2;
BA_ "GenSigASIL"  SG_ 1040 FRM_63_DetnQuality_240 2;
BA_ "GenSigASIL"  SG_ 1040 FRM_63_DetnMotionSts_241 2;
BA_ "GenSigASIL"  SG_ 1040 FRM_63_DetnRngRadial_241 2;
BA_ "GenSigStartValue" SG_ 1040 FRM_63_DetnAziAngle_241 900;
BA_ "GenSigASIL"  SG_ 1040 FRM_63_DetnAziAngle_241 2;
BA_ "GenSigStartValue" SG_ 1040 FRM_63_DetnElevnAngle_241 100;
BA_ "GenSigASIL"  SG_ 1040 FRM_63_DetnElevnAngle_241 2;
BA_ "GenSigStartValue" SG_ 1040 FRM_63_DetnRelVelRadial_241 10000;
BA_ "GenSigASIL"  SG_ 1040 FRM_63_DetnRelVelRadial_241 2;
BA_ "GenSigASIL"  SG_ 1040 FRM_63_DetnSNR_241 2;
BA_ "GenSigStartValue" SG_ 1040 FRM_63_DetnRCS_241 5000;
BA_ "GenSigASIL"  SG_ 1040 FRM_63_DetnRCS_241 2;
BA_ "GenSigASIL"  SG_ 1040 FRM_63_DetnQuality_241 2;
BA_ "GenSigASIL"  SG_ 1040 FRM_63_DetnMotionSts_242 2;
BA_ "GenSigASIL"  SG_ 1040 FRM_63_DetnRngRadial_242 2;
BA_ "GenSigStartValue" SG_ 1040 FRM_63_DetnAziAngle_242 900;
BA_ "GenSigASIL"  SG_ 1040 FRM_63_DetnAziAngle_242 2;
BA_ "GenSigStartValue" SG_ 1040 FRM_63_DetnElevnAngle_242 100;
BA_ "GenSigASIL"  SG_ 1040 FRM_63_DetnElevnAngle_242 2;
BA_ "GenSigStartValue" SG_ 1040 FRM_63_DetnRelVelRadial_242 10000;
BA_ "GenSigASIL"  SG_ 1040 FRM_63_DetnRelVelRadial_242 2;
BA_ "GenSigASIL"  SG_ 1040 FRM_63_DetnSNR_242 2;
BA_ "GenSigStartValue" SG_ 1040 FRM_63_DetnRCS_242 5000;
BA_ "GenSigASIL"  SG_ 1040 FRM_63_DetnRCS_242 2;
BA_ "GenSigASIL"  SG_ 1040 FRM_63_DetnQuality_242 2;
BA_ "GenSigASIL"  SG_ 1040 FRM_63_DetnMotionSts_243 2;
BA_ "GenSigASIL"  SG_ 1040 FRM_63_DetnRngRadial_243 2;
BA_ "GenSigStartValue" SG_ 1040 FRM_63_DetnAziAngle_243 900;
BA_ "GenSigASIL"  SG_ 1040 FRM_63_DetnAziAngle_243 2;
BA_ "GenSigStartValue" SG_ 1040 FRM_63_DetnElevnAngle_243 100;
BA_ "GenSigASIL"  SG_ 1040 FRM_63_DetnElevnAngle_243 2;
BA_ "GenSigStartValue" SG_ 1040 FRM_63_DetnRelVelRadial_243 10000;
BA_ "GenSigASIL"  SG_ 1040 FRM_63_DetnRelVelRadial_243 2;
BA_ "GenSigASIL"  SG_ 1040 FRM_63_DetnSNR_243 2;
BA_ "GenSigStartValue" SG_ 1040 FRM_63_DetnRCS_243 5000;
BA_ "GenSigASIL"  SG_ 1040 FRM_63_DetnRCS_243 2;
BA_ "GenSigASIL"  SG_ 1040 FRM_63_DetnQuality_243 2;
BA_ "GenSigASIL"  SG_ 1040 FRM_63_DetnMotionSts_244 2;
BA_ "GenSigASIL"  SG_ 1040 FRM_63_DetnRngRadial_244 2;
BA_ "GenSigStartValue" SG_ 1040 FRM_63_DetnAziAngle_244 900;
BA_ "GenSigASIL"  SG_ 1040 FRM_63_DetnAziAngle_244 2;
BA_ "GenSigStartValue" SG_ 1040 FRM_63_DetnElevnAngle_244 100;
BA_ "GenSigASIL"  SG_ 1040 FRM_63_DetnElevnAngle_244 2;
BA_ "GenSigStartValue" SG_ 1040 FRM_63_DetnRelVelRadial_244 10000;
BA_ "GenSigASIL"  SG_ 1040 FRM_63_DetnRelVelRadial_244 2;
BA_ "GenSigASIL"  SG_ 1040 FRM_63_DetnSNR_244 2;
BA_ "GenSigStartValue" SG_ 1040 FRM_63_DetnRCS_244 5000;
BA_ "GenSigASIL"  SG_ 1040 FRM_63_DetnRCS_244 2;
BA_ "GenSigASIL"  SG_ 1040 FRM_63_DetnQuality_244 2;
BA_ "GenSigASIL"  SG_ 1040 FRM_63_DetnMotionSts_245 2;
BA_ "GenSigASIL"  SG_ 1040 FRM_63_DetnRngRadial_245 2;
BA_ "GenSigStartValue" SG_ 1040 FRM_63_DetnAziAngle_245 900;
BA_ "GenSigASIL"  SG_ 1040 FRM_63_DetnAziAngle_245 2;
BA_ "GenSigStartValue" SG_ 1040 FRM_63_DetnElevnAngle_245 100;
BA_ "GenSigASIL"  SG_ 1040 FRM_63_DetnElevnAngle_245 2;
BA_ "GenSigStartValue" SG_ 1040 FRM_63_DetnRelVelRadial_245 10000;
BA_ "GenSigASIL"  SG_ 1040 FRM_63_DetnRelVelRadial_245 2;
BA_ "GenSigASIL"  SG_ 1040 FRM_63_DetnSNR_245 2;
BA_ "GenSigStartValue" SG_ 1040 FRM_63_DetnRCS_245 5000;
BA_ "GenSigASIL"  SG_ 1040 FRM_63_DetnRCS_245 2;
BA_ "GenSigASIL"  SG_ 1040 FRM_63_DetnQuality_245 2;
BA_ "GenMsgILSupport" BO_ 1041 1;
BA_ "GenMsgCycleTime" BO_ 1041 50;
BA_ "GenSigASIL"  SG_ 1041 FRM_64_CRC 5;
BA_ "GenSigASIL"  SG_ 1041 FRM_64_RollgCntr 5;
BA_ "GenSigASIL"  SG_ 1041 FRM_64_DetnBlockCounter 2;
BA_ "GenSigASIL"  SG_ 1041 FRM_64_DetnMotionSts_246 2;
BA_ "GenSigASIL"  SG_ 1041 FRM_64_DetnRngRadial_246 2;
BA_ "GenSigStartValue" SG_ 1041 FRM_64_DetnAziAngle_246 900;
BA_ "GenSigASIL"  SG_ 1041 FRM_64_DetnAziAngle_246 2;
BA_ "GenSigStartValue" SG_ 1041 FRM_64_DetnElevnAngle_246 100;
BA_ "GenSigASIL"  SG_ 1041 FRM_64_DetnElevnAngle_246 2;
BA_ "GenSigStartValue" SG_ 1041 FRM_64_DetnRelVelRadial_246 10000;
BA_ "GenSigASIL"  SG_ 1041 FRM_64_DetnRelVelRadial_246 2;
BA_ "GenSigASIL"  SG_ 1041 FRM_64_DetnSNR_246 2;
BA_ "GenSigStartValue" SG_ 1041 FRM_64_DetnRCS_246 5000;
BA_ "GenSigASIL"  SG_ 1041 FRM_64_DetnRCS_246 2;
BA_ "GenSigASIL"  SG_ 1041 FRM_64_DetnQuality_246 2;
BA_ "GenSigASIL"  SG_ 1041 FRM_64_DetnMotionSts_247 2;
BA_ "GenSigASIL"  SG_ 1041 FRM_64_DetnRngRadial_247 2;
BA_ "GenSigStartValue" SG_ 1041 FRM_64_DetnAziAngle_247 900;
BA_ "GenSigASIL"  SG_ 1041 FRM_64_DetnAziAngle_247 2;
BA_ "GenSigStartValue" SG_ 1041 FRM_64_DetnElevnAngle_247 100;
BA_ "GenSigASIL"  SG_ 1041 FRM_64_DetnElevnAngle_247 2;
BA_ "GenSigStartValue" SG_ 1041 FRM_64_DetnRelVelRadial_247 10000;
BA_ "GenSigASIL"  SG_ 1041 FRM_64_DetnRelVelRadial_247 2;
BA_ "GenSigASIL"  SG_ 1041 FRM_64_DetnSNR_247 2;
BA_ "GenSigStartValue" SG_ 1041 FRM_64_DetnRCS_247 5000;
BA_ "GenSigASIL"  SG_ 1041 FRM_64_DetnRCS_247 2;
BA_ "GenSigASIL"  SG_ 1041 FRM_64_DetnQuality_247 2;
BA_ "GenSigASIL"  SG_ 1041 FRM_64_DetnMotionSts_248 2;
BA_ "GenSigASIL"  SG_ 1041 FRM_64_DetnRngRadial_248 2;
BA_ "GenSigStartValue" SG_ 1041 FRM_64_DetnAziAngle_248 900;
BA_ "GenSigASIL"  SG_ 1041 FRM_64_DetnAziAngle_248 2;
BA_ "GenSigStartValue" SG_ 1041 FRM_64_DetnElevnAngle_248 100;
BA_ "GenSigASIL"  SG_ 1041 FRM_64_DetnElevnAngle_248 2;
BA_ "GenSigStartValue" SG_ 1041 FRM_64_DetnRelVelRadial_248 10000;
BA_ "GenSigASIL"  SG_ 1041 FRM_64_DetnRelVelRadial_248 2;
BA_ "GenSigASIL"  SG_ 1041 FRM_64_DetnSNR_248 2;
BA_ "GenSigStartValue" SG_ 1041 FRM_64_DetnRCS_248 5000;
BA_ "GenSigASIL"  SG_ 1041 FRM_64_DetnRCS_248 2;
BA_ "GenSigASIL"  SG_ 1041 FRM_64_DetnQuality_248 2;
BA_ "GenSigASIL"  SG_ 1041 FRM_64_DetnMotionSts_249 2;
BA_ "GenSigASIL"  SG_ 1041 FRM_64_DetnRngRadial_249 2;
BA_ "GenSigStartValue" SG_ 1041 FRM_64_DetnAziAngle_249 900;
BA_ "GenSigASIL"  SG_ 1041 FRM_64_DetnAziAngle_249 2;
BA_ "GenSigStartValue" SG_ 1041 FRM_64_DetnElevnAngle_249 100;
BA_ "GenSigASIL"  SG_ 1041 FRM_64_DetnElevnAngle_249 2;
BA_ "GenSigStartValue" SG_ 1041 FRM_64_DetnRelVelRadial_249 10000;
BA_ "GenSigASIL"  SG_ 1041 FRM_64_DetnRelVelRadial_249 2;
BA_ "GenSigASIL"  SG_ 1041 FRM_64_DetnSNR_249 2;
BA_ "GenSigStartValue" SG_ 1041 FRM_64_DetnRCS_249 5000;
BA_ "GenSigASIL"  SG_ 1041 FRM_64_DetnRCS_249 2;
BA_ "GenSigASIL"  SG_ 1041 FRM_64_DetnQuality_249 2;
BA_ "GenSigASIL"  SG_ 1041 FRM_64_DetnMotionSts_250 2;
BA_ "GenSigASIL"  SG_ 1041 FRM_64_DetnRngRadial_250 2;
BA_ "GenSigStartValue" SG_ 1041 FRM_64_DetnAziAngle_250 900;
BA_ "GenSigASIL"  SG_ 1041 FRM_64_DetnAziAngle_250 2;
BA_ "GenSigStartValue" SG_ 1041 FRM_64_DetnElevnAngle_250 100;
BA_ "GenSigASIL"  SG_ 1041 FRM_64_DetnElevnAngle_250 2;
BA_ "GenSigStartValue" SG_ 1041 FRM_64_DetnRelVelRadial_250 10000;
BA_ "GenSigASIL"  SG_ 1041 FRM_64_DetnRelVelRadial_250 2;
BA_ "GenSigASIL"  SG_ 1041 FRM_64_DetnSNR_250 2;
BA_ "GenSigStartValue" SG_ 1041 FRM_64_DetnRCS_250 5000;
BA_ "GenSigASIL"  SG_ 1041 FRM_64_DetnRCS_250 2;
BA_ "GenSigASIL"  SG_ 1041 FRM_64_DetnQuality_250 2;
BA_ "GenSigASIL"  SG_ 1041 FRM_64_DetnMotionSts_251 2;
BA_ "GenSigASIL"  SG_ 1041 FRM_64_DetnRngRadial_251 2;
BA_ "GenSigStartValue" SG_ 1041 FRM_64_DetnAziAngle_251 900;
BA_ "GenSigASIL"  SG_ 1041 FRM_64_DetnAziAngle_251 2;
BA_ "GenSigStartValue" SG_ 1041 FRM_64_DetnElevnAngle_251 100;
BA_ "GenSigASIL"  SG_ 1041 FRM_64_DetnElevnAngle_251 2;
BA_ "GenSigStartValue" SG_ 1041 FRM_64_DetnRelVelRadial_251 10000;
BA_ "GenSigASIL"  SG_ 1041 FRM_64_DetnRelVelRadial_251 2;
BA_ "GenSigASIL"  SG_ 1041 FRM_64_DetnSNR_251 2;
BA_ "GenSigStartValue" SG_ 1041 FRM_64_DetnRCS_251 5000;
BA_ "GenSigASIL"  SG_ 1041 FRM_64_DetnRCS_251 2;
BA_ "GenSigASIL"  SG_ 1041 FRM_64_DetnQuality_251 2;
BA_ "GenMsgILSupport" BO_ 1042 1;
BA_ "GenMsgCycleTime" BO_ 1042 50;
BA_ "GenSigASIL"  SG_ 1042 FRM_65_CRC 5;
BA_ "GenSigASIL"  SG_ 1042 FRM_65_RollgCntr 5;
BA_ "GenSigASIL"  SG_ 1042 FRM_65_DetnBlockCounter 2;
BA_ "GenSigASIL"  SG_ 1042 FRM_65_DetnMotionSts_252 2;
BA_ "GenSigASIL"  SG_ 1042 FRM_65_DetnRngRadial_252 2;
BA_ "GenSigStartValue" SG_ 1042 FRM_65_DetnAziAngle_252 900;
BA_ "GenSigASIL"  SG_ 1042 FRM_65_DetnAziAngle_252 2;
BA_ "GenSigStartValue" SG_ 1042 FRM_65_DetnElevnAngle_252 100;
BA_ "GenSigASIL"  SG_ 1042 FRM_65_DetnElevnAngle_252 2;
BA_ "GenSigStartValue" SG_ 1042 FRM_65_DetnRelVelRadial_252 10000;
BA_ "GenSigASIL"  SG_ 1042 FRM_65_DetnRelVelRadial_252 2;
BA_ "GenSigASIL"  SG_ 1042 FRM_65_DetnSNR_252 2;
BA_ "GenSigStartValue" SG_ 1042 FRM_65_DetnRCS_252 5000;
BA_ "GenSigASIL"  SG_ 1042 FRM_65_DetnRCS_252 2;
BA_ "GenSigASIL"  SG_ 1042 FRM_65_DetnQuality_252 2;
BA_ "GenSigASIL"  SG_ 1042 FRM_65_DetnMotionSts_253 2;
BA_ "GenSigASIL"  SG_ 1042 FRM_65_DetnRngRadial_253 2;
BA_ "GenSigStartValue" SG_ 1042 FRM_65_DetnAziAngle_253 900;
BA_ "GenSigASIL"  SG_ 1042 FRM_65_DetnAziAngle_253 2;
BA_ "GenSigStartValue" SG_ 1042 FRM_65_DetnElevnAngle_253 100;
BA_ "GenSigASIL"  SG_ 1042 FRM_65_DetnElevnAngle_253 2;
BA_ "GenSigStartValue" SG_ 1042 FRM_65_DetnRelVelRadial_253 10000;
BA_ "GenSigASIL"  SG_ 1042 FRM_65_DetnRelVelRadial_253 2;
BA_ "GenSigASIL"  SG_ 1042 FRM_65_DetnSNR_253 2;
BA_ "GenSigStartValue" SG_ 1042 FRM_65_DetnRCS_253 5000;
BA_ "GenSigASIL"  SG_ 1042 FRM_65_DetnRCS_253 2;
BA_ "GenSigASIL"  SG_ 1042 FRM_65_DetnQuality_253 2;
BA_ "GenSigASIL"  SG_ 1042 FRM_65_DetnMotionSts_254 2;
BA_ "GenSigASIL"  SG_ 1042 FRM_65_DetnRngRadial_254 2;
BA_ "GenSigStartValue" SG_ 1042 FRM_65_DetnAziAngle_254 900;
BA_ "GenSigASIL"  SG_ 1042 FRM_65_DetnAziAngle_254 2;
BA_ "GenSigStartValue" SG_ 1042 FRM_65_DetnElevnAngle_254 100;
BA_ "GenSigASIL"  SG_ 1042 FRM_65_DetnElevnAngle_254 2;
BA_ "GenSigStartValue" SG_ 1042 FRM_65_DetnRelVelRadial_254 10000;
BA_ "GenSigASIL"  SG_ 1042 FRM_65_DetnRelVelRadial_254 2;
BA_ "GenSigASIL"  SG_ 1042 FRM_65_DetnSNR_254 2;
BA_ "GenSigStartValue" SG_ 1042 FRM_65_DetnRCS_254 5000;
BA_ "GenSigASIL"  SG_ 1042 FRM_65_DetnRCS_254 2;
BA_ "GenSigASIL"  SG_ 1042 FRM_65_DetnQuality_254 2;
BA_ "GenSigASIL"  SG_ 1042 FRM_65_DetnMotionSts_255 2;
BA_ "GenSigASIL"  SG_ 1042 FRM_65_DetnRngRadial_255 2;
BA_ "GenSigStartValue" SG_ 1042 FRM_65_DetnAziAngle_255 900;
BA_ "GenSigASIL"  SG_ 1042 FRM_65_DetnAziAngle_255 2;
BA_ "GenSigStartValue" SG_ 1042 FRM_65_DetnElevnAngle_255 100;
BA_ "GenSigASIL"  SG_ 1042 FRM_65_DetnElevnAngle_255 2;
BA_ "GenSigStartValue" SG_ 1042 FRM_65_DetnRelVelRadial_255 10000;
BA_ "GenSigASIL"  SG_ 1042 FRM_65_DetnRelVelRadial_255 2;
BA_ "GenSigASIL"  SG_ 1042 FRM_65_DetnSNR_255 2;
BA_ "GenSigStartValue" SG_ 1042 FRM_65_DetnRCS_255 5000;
BA_ "GenSigASIL"  SG_ 1042 FRM_65_DetnRCS_255 2;
BA_ "GenSigASIL"  SG_ 1042 FRM_65_DetnQuality_255 2;
VAL_ 1027 FRM_56_DetnMotionSts_198 3 "Invalid" 2 "Static" 1 "Moving" 0 "NoTarget" ;
VAL_ 1027 FRM_56_DetnMotionSts_199 3 "Invalid" 2 "Static" 1 "Moving" 0 "NoTarget" ;
VAL_ 1027 FRM_56_DetnMotionSts_200 3 "Invalid" 2 "Static" 1 "Moving" 0 "NoTarget" ;
VAL_ 1027 FRM_56_DetnMotionSts_201 3 "Invalid" 2 "Static" 1 "Moving" 0 "NoTarget" ;
VAL_ 1027 FRM_56_DetnMotionSts_202 3 "Invalid" 2 "Static" 1 "Moving" 0 "NoTarget" ;
VAL_ 1027 FRM_56_DetnMotionSts_203 3 "Invalid" 2 "Static" 1 "Moving" 0 "NoTarget" ;
VAL_ 1028 FRM_57_DetnMotionSts_204 3 "Invalid" 2 "Static" 1 "Moving" 0 "NoTarget" ;
VAL_ 1028 FRM_57_DetnMotionSts_205 3 "Invalid" 2 "Static" 1 "Moving" 0 "NoTarget" ;
VAL_ 1028 FRM_57_DetnMotionSts_206 3 "Invalid" 2 "Static" 1 "Moving" 0 "NoTarget" ;
VAL_ 1028 FRM_57_DetnMotionSts_207 3 "Invalid" 2 "Static" 1 "Moving" 0 "NoTarget" ;
VAL_ 1028 FRM_57_DetnMotionSts_208 3 "Invalid" 2 "Static" 1 "Moving" 0 "NoTarget" ;
VAL_ 1028 FRM_57_DetnMotionSts_209 3 "Invalid" 2 "Static" 1 "Moving" 0 "NoTarget" ;
VAL_ 1029 FRM_58_DetnMotionSts_210 3 "Invalid" 2 "Static" 1 "Moving" 0 "NoTarget" ;
VAL_ 1029 FRM_58_DetnMotionSts_211 3 "Invalid" 2 "Static" 1 "Moving" 0 "NoTarget" ;
VAL_ 1029 FRM_58_DetnMotionSts_212 3 "Invalid" 2 "Static" 1 "Moving" 0 "NoTarget" ;
VAL_ 1029 FRM_58_DetnMotionSts_213 3 "Invalid" 2 "Static" 1 "Moving" 0 "NoTarget" ;
VAL_ 1029 FRM_58_DetnMotionSts_214 3 "Invalid" 2 "Static" 1 "Moving" 0 "NoTarget" ;
VAL_ 1029 FRM_58_DetnMotionSts_215 3 "Invalid" 2 "Static" 1 "Moving" 0 "NoTarget" ;
VAL_ 1030 FRM_59_DetnMotionSts_216 3 "Invalid" 2 "Static" 1 "Moving" 0 "NoTarget" ;
VAL_ 1030 FRM_59_DetnMotionSts_217 3 "Invalid" 2 "Static" 1 "Moving" 0 "NoTarget" ;
VAL_ 1030 FRM_59_DetnMotionSts_218 3 "Invalid" 2 "Static" 1 "Moving" 0 "NoTarget" ;
VAL_ 1030 FRM_59_DetnMotionSts_219 3 "Invalid" 2 "Static" 1 "Moving" 0 "NoTarget" ;
VAL_ 1030 FRM_59_DetnMotionSts_220 3 "Invalid" 2 "Static" 1 "Moving" 0 "NoTarget" ;
VAL_ 1030 FRM_59_DetnMotionSts_221 3 "Invalid" 2 "Static" 1 "Moving" 0 "NoTarget" ;
VAL_ 1031 FRM_60_DetnMotionSts_222 3 "Invalid" 2 "Static" 1 "Moving" 0 "NoTarget" ;
VAL_ 1031 FRM_60_DetnMotionSts_223 3 "Invalid" 2 "Static" 1 "Moving" 0 "NoTarget" ;
VAL_ 1031 FRM_60_DetnMotionSts_224 3 "Invalid" 2 "Static" 1 "Moving" 0 "NoTarget" ;
VAL_ 1031 FRM_60_DetnMotionSts_225 3 "Invalid" 2 "Static" 1 "Moving" 0 "NoTarget" ;
VAL_ 1031 FRM_60_DetnMotionSts_226 3 "Invalid" 2 "Static" 1 "Moving" 0 "NoTarget" ;
VAL_ 1031 FRM_60_DetnMotionSts_227 3 "Invalid" 2 "Static" 1 "Moving" 0 "NoTarget" ;
VAL_ 1032 FRM_61_DetnMotionSts_228 3 "Invalid" 2 "Static" 1 "Moving" 0 "NoTarget" ;
VAL_ 1032 FRM_61_DetnMotionSts_229 3 "Invalid" 2 "Static" 1 "Moving" 0 "NoTarget" ;
VAL_ 1032 FRM_61_DetnMotionSts_230 3 "Invalid" 2 "Static" 1 "Moving" 0 "NoTarget" ;
VAL_ 1032 FRM_61_DetnMotionSts_231 3 "Invalid" 2 "Static" 1 "Moving" 0 "NoTarget" ;
VAL_ 1032 FRM_61_DetnMotionSts_232 3 "Invalid" 2 "Static" 1 "Moving" 0 "NoTarget" ;
VAL_ 1032 FRM_61_DetnMotionSts_233 3 "Invalid" 2 "Static" 1 "Moving" 0 "NoTarget" ;
VAL_ 1033 FRM_62_DetnMotionSts_234 3 "Invalid" 2 "Static" 1 "Moving" 0 "NoTarget" ;
VAL_ 1033 FRM_62_DetnMotionSts_235 3 "Invalid" 2 "Static" 1 "Moving" 0 "NoTarget" ;
VAL_ 1033 FRM_62_DetnMotionSts_236 3 "Invalid" 2 "Static" 1 "Moving" 0 "NoTarget" ;
VAL_ 1033 FRM_62_DetnMotionSts_237 3 "Invalid" 2 "Static" 1 "Moving" 0 "NoTarget" ;
VAL_ 1033 FRM_62_DetnMotionSts_238 3 "Invalid" 2 "Static" 1 "Moving" 0 "NoTarget" ;
VAL_ 1033 FRM_62_DetnMotionSts_239 3 "Invalid" 2 "Static" 1 "Moving" 0 "NoTarget" ;
VAL_ 1040 FRM_63_DetnMotionSts_240 3 "Invalid" 2 "Static" 1 "Moving" 0 "NoTarget" ;
VAL_ 1040 FRM_63_DetnMotionSts_241 3 "Invalid" 2 "Static" 1 "Moving" 0 "NoTarget" ;
VAL_ 1040 FRM_63_DetnMotionSts_242 3 "Invalid" 2 "Static" 1 "Moving" 0 "NoTarget" ;
VAL_ 1040 FRM_63_DetnMotionSts_243 3 "Invalid" 2 "Static" 1 "Moving" 0 "NoTarget" ;
VAL_ 1040 FRM_63_DetnMotionSts_244 3 "Invalid" 2 "Static" 1 "Moving" 0 "NoTarget" ;
VAL_ 1040 FRM_63_DetnMotionSts_245 3 "Invalid" 2 "Static" 1 "Moving" 0 "NoTarget" ;
VAL_ 1041 FRM_64_DetnMotionSts_246 3 "Invalid" 2 "Static" 1 "Moving" 0 "NoTarget" ;
VAL_ 1041 FRM_64_DetnMotionSts_247 3 "Invalid" 2 "Static" 1 "Moving" 0 "NoTarget" ;
VAL_ 1041 FRM_64_DetnMotionSts_248 3 "Invalid" 2 "Static" 1 "Moving" 0 "NoTarget" ;
VAL_ 1041 FRM_64_DetnMotionSts_249 3 "Invalid" 2 "Static" 1 "Moving" 0 "NoTarget" ;
VAL_ 1041 FRM_64_DetnMotionSts_250 3 "Invalid" 2 "Static" 1 "Moving" 0 "NoTarget" ;
VAL_ 1041 FRM_64_DetnMotionSts_251 3 "Invalid" 2 "Static" 1 "Moving" 0 "NoTarget" ;
VAL_ 1042 FRM_65_DetnMotionSts_252 3 "Invalid" 2 "Static" 1 "Moving" 0 "NoTarget" ;
VAL_ 1042 FRM_65_DetnMotionSts_253 3 "Invalid" 2 "Static" 1 "Moving" 0 "NoTarget" ;
VAL_ 1042 FRM_65_DetnMotionSts_254 3 "Invalid" 2 "Static" 1 "Moving" 0 "NoTarget" ;
VAL_ 1042 FRM_65_DetnMotionSts_255 3 "Invalid" 2 "Static" 1 "Moving" 0 "NoTarget" ;
