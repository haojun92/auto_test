VERSION ""

NS_ :

BS_:

BU_: ADCC_FM_4X

BO_ 1016 FRM_45: 64 Vector__XXX
 SG_ FRM_45_CRC : 7|16@0+ (1,0) [0|65535] ""  ADCC_FM_4X
 SG_ FRM_45_RollgCntr : 23|8@0+ (1,0) [0|255] ""  ADCC_FM_4X
 SG_ FRM_45_DetnBlockCounter : 27|4@0+ (1,0) [0|15] ""  ADCC_FM_4X
 SG_ FRM_45_DetnMotionSts_132 : 29|2@0+ (1,0) [0|3] ""  ADCC_FM_4X
 SG_ FRM_45_DetnRngRadial_132 : 39|15@0+ (0.01,0) [0|200] "m"  ADCC_FM_4X
 SG_ FRM_45_DetnAziAngle_132 : 40|11@0+ (0.1,-90) [-90|90] "deg"  ADCC_FM_4X
 SG_ FRM_45_DetnElevnAngle_132 : 61|8@0+ (0.1,-10) [-10|10] "deg"  ADCC_FM_4X
 SG_ FRM_45_DetnRelVelRadial_132 : 69|15@0+ (0.01,-100) [-100|80] "m/s"  ADCC_FM_4X
 SG_ FRM_45_DetnSNR_132 : 86|7@0+ (1,0) [0|100] "dB"  ADCC_FM_4X
 SG_ FRM_45_DetnRCS_132 : 95|15@0+ (0.01,-50) [-50|128] "dBsm"  ADCC_FM_4X
 SG_ FRM_45_DetnQuality_132 : 96|4@0+ (10,0) [0|100] "%"  ADCC_FM_4X
 SG_ FRM_45_DetnMotionSts_133 : 31|2@0+ (1,0) [0|3] ""  ADCC_FM_4X
 SG_ FRM_45_DetnRngRadial_133 : 108|15@0+ (0.01,0) [0|200] "m"  ADCC_FM_4X
 SG_ FRM_45_DetnAziAngle_133 : 125|11@0+ (0.1,-90) [-90|90] "deg"  ADCC_FM_4X
 SG_ FRM_45_DetnElevnAngle_133 : 130|8@0+ (0.1,-10) [-10|10] "deg"  ADCC_FM_4X
 SG_ FRM_45_DetnRelVelRadial_133 : 138|15@0+ (0.01,-100) [-100|80] "m/s"  ADCC_FM_4X
 SG_ FRM_45_DetnSNR_133 : 155|7@0+ (1,0) [0|100] "dB"  ADCC_FM_4X
 SG_ FRM_45_DetnRCS_133 : 164|15@0+ (0.01,-50) [-50|128] "dBsm"  ADCC_FM_4X
 SG_ FRM_45_DetnQuality_133 : 181|4@0+ (10,0) [0|100] "%"  ADCC_FM_4X
 SG_ FRM_45_DetnMotionSts_134 : 177|2@0+ (1,0) [0|3] ""  ADCC_FM_4X
 SG_ FRM_45_DetnRngRadial_134 : 191|15@0+ (0.01,0) [0|200] "m"  ADCC_FM_4X
 SG_ FRM_45_DetnAziAngle_134 : 192|11@0+ (0.1,-90) [-90|90] "deg"  ADCC_FM_4X
 SG_ FRM_45_DetnElevnAngle_134 : 213|8@0+ (0.1,-10) [-10|10] "deg"  ADCC_FM_4X
 SG_ FRM_45_DetnRelVelRadial_134 : 221|15@0+ (0.01,-100) [-100|80] "m/s"  ADCC_FM_4X
 SG_ FRM_45_DetnSNR_134 : 238|7@0+ (1,0) [0|100] "dB"  ADCC_FM_4X
 SG_ FRM_45_DetnRCS_134 : 247|15@0+ (0.01,-50) [-50|128] "dBsm"  ADCC_FM_4X
 SG_ FRM_45_DetnQuality_134 : 248|4@0+ (10,0) [0|100] "%"  ADCC_FM_4X
 SG_ FRM_45_DetnMotionSts_135 : 260|2@0+ (1,0) [0|3] ""  ADCC_FM_4X
 SG_ FRM_45_DetnRngRadial_135 : 258|15@0+ (0.01,0) [0|200] "m"  ADCC_FM_4X
 SG_ FRM_45_DetnAziAngle_135 : 275|11@0+ (0.1,-90) [-90|90] "deg"  ADCC_FM_4X
 SG_ FRM_45_DetnElevnAngle_135 : 280|8@0+ (0.1,-10) [-10|10] "deg"  ADCC_FM_4X
 SG_ FRM_45_DetnRelVelRadial_135 : 288|15@0+ (0.01,-100) [-100|80] "m/s"  ADCC_FM_4X
 SG_ FRM_45_DetnSNR_135 : 305|7@0+ (1,0) [0|100] "dB"  ADCC_FM_4X
 SG_ FRM_45_DetnRCS_135 : 314|15@0+ (0.01,-50) [-50|128] "dBsm"  ADCC_FM_4X
 SG_ FRM_45_DetnQuality_135 : 331|4@0+ (10,0) [0|100] "%"  ADCC_FM_4X
 SG_ FRM_45_DetnMotionSts_136 : 343|2@0+ (1,0) [0|3] ""  ADCC_FM_4X
 SG_ FRM_45_DetnRngRadial_136 : 341|15@0+ (0.01,0) [0|200] "m"  ADCC_FM_4X
 SG_ FRM_45_DetnAziAngle_136 : 358|11@0+ (0.1,-90) [-90|90] "deg"  ADCC_FM_4X
 SG_ FRM_45_DetnElevnAngle_136 : 363|8@0+ (0.1,-10) [-10|10] "deg"  ADCC_FM_4X
 SG_ FRM_45_DetnRelVelRadial_136 : 371|15@0+ (0.01,-100) [-100|80] "m/s"  ADCC_FM_4X
 SG_ FRM_45_DetnSNR_136 : 388|7@0+ (1,0) [0|100] "dB"  ADCC_FM_4X
 SG_ FRM_45_DetnRCS_136 : 397|15@0+ (0.01,-50) [-50|128] "dBsm"  ADCC_FM_4X
 SG_ FRM_45_DetnQuality_136 : 414|4@0+ (10,0) [0|100] "%"  ADCC_FM_4X
 SG_ FRM_45_DetnMotionSts_137 : 410|2@0+ (1,0) [0|3] ""  ADCC_FM_4X
 SG_ FRM_45_DetnRngRadial_137 : 408|15@0+ (0.01,0) [0|200] "m"  ADCC_FM_4X
 SG_ FRM_45_DetnAziAngle_137 : 425|11@0+ (0.1,-90) [-90|90] "deg"  ADCC_FM_4X
 SG_ FRM_45_DetnElevnAngle_137 : 446|8@0+ (0.1,-10) [-10|10] "deg"  ADCC_FM_4X
 SG_ FRM_45_DetnRelVelRadial_137 : 454|15@0+ (0.01,-100) [-100|80] "m/s"  ADCC_FM_4X
 SG_ FRM_45_DetnSNR_137 : 471|7@0+ (1,0) [0|100] "dB"  ADCC_FM_4X
 SG_ FRM_45_DetnRCS_137 : 464|15@0+ (0.01,-50) [-50|128] "dBsm"  ADCC_FM_4X
 SG_ FRM_45_DetnQuality_137 : 481|4@0+ (10,0) [0|100] "%"  ADCC_FM_4X
 SG_ FRM_45_Loc132_Valid : 488|1@0+ (1,0) [0|1] ""  ADCC_FM_4X
 SG_ FRM_45_Loc133_Valid : 489|1@0+ (1,0) [0|1] ""  ADCC_FM_4X
 SG_ FRM_45_Loc134_Valid : 490|1@0+ (1,0) [0|1] ""  ADCC_FM_4X
 SG_ FRM_45_Loc135_Valid : 491|1@0+ (1,0) [0|1] ""  ADCC_FM_4X
 SG_ FRM_45_Loc136_Valid : 492|1@0+ (1,0) [0|1] ""  ADCC_FM_4X
 SG_ FRM_45_Loc137_Valid : 493|1@0+ (1,0) [0|1] ""  ADCC_FM_4X

BO_ 1017 FRM_46: 64 Vector__XXX
 SG_ FRM_46_CRC : 7|16@0+ (1,0) [0|65535] ""  ADCC_FM_4X
 SG_ FRM_46_RollgCntr : 23|8@0+ (1,0) [0|255] ""  ADCC_FM_4X
 SG_ FRM_46_DetnBlockCounter : 27|4@0+ (1,0) [0|15] ""  ADCC_FM_4X
 SG_ FRM_46_DetnMotionSts_138 : 29|2@0+ (1,0) [0|3] ""  ADCC_FM_4X
 SG_ FRM_46_DetnRngRadial_138 : 39|15@0+ (0.01,0) [0|200] "m"  ADCC_FM_4X
 SG_ FRM_46_DetnAziAngle_138 : 40|11@0+ (0.1,-90) [-90|90] "deg"  ADCC_FM_4X
 SG_ FRM_46_DetnElevnAngle_138 : 61|8@0+ (0.1,-10) [-10|10] "deg"  ADCC_FM_4X
 SG_ FRM_46_DetnRelVelRadial_138 : 69|15@0+ (0.01,-100) [-100|80] "m/s"  ADCC_FM_4X
 SG_ FRM_46_DetnSNR_138 : 86|7@0+ (1,0) [0|100] "dB"  ADCC_FM_4X
 SG_ FRM_46_DetnRCS_138 : 95|15@0+ (0.01,-50) [-50|128] "dBsm"  ADCC_FM_4X
 SG_ FRM_46_DetnQuality_138 : 96|4@0+ (10,0) [0|100] "%"  ADCC_FM_4X
 SG_ FRM_46_DetnMotionSts_139 : 31|2@0+ (1,0) [0|3] ""  ADCC_FM_4X
 SG_ FRM_46_DetnRngRadial_139 : 108|15@0+ (0.01,0) [0|200] "m"  ADCC_FM_4X
 SG_ FRM_46_DetnAziAngle_139 : 125|11@0+ (0.1,-90) [-90|90] "deg"  ADCC_FM_4X
 SG_ FRM_46_DetnElevnAngle_139 : 130|8@0+ (0.1,-10) [-10|10] "deg"  ADCC_FM_4X
 SG_ FRM_46_DetnRelVelRadial_139 : 138|15@0+ (0.01,-100) [-100|80] "m/s"  ADCC_FM_4X
 SG_ FRM_46_DetnSNR_139 : 155|7@0+ (1,0) [0|100] "dB"  ADCC_FM_4X
 SG_ FRM_46_DetnRCS_139 : 164|15@0+ (0.01,-50) [-50|128] "dBsm"  ADCC_FM_4X
 SG_ FRM_46_DetnQuality_139 : 181|4@0+ (10,0) [0|100] "%"  ADCC_FM_4X
 SG_ FRM_46_DetnMotionSts_140 : 177|2@0+ (1,0) [0|3] ""  ADCC_FM_4X
 SG_ FRM_46_DetnRngRadial_140 : 191|15@0+ (0.01,0) [0|200] "m"  ADCC_FM_4X
 SG_ FRM_46_DetnAziAngle_140 : 192|11@0+ (0.1,-90) [-90|90] "deg"  ADCC_FM_4X
 SG_ FRM_46_DetnElevnAngle_140 : 213|8@0+ (0.1,-10) [-10|10] "deg"  ADCC_FM_4X
 SG_ FRM_46_DetnRelVelRadial_140 : 221|15@0+ (0.01,-100) [-100|80] "m/s"  ADCC_FM_4X
 SG_ FRM_46_DetnSNR_140 : 238|7@0+ (1,0) [0|100] "dB"  ADCC_FM_4X
 SG_ FRM_46_DetnRCS_140 : 247|15@0+ (0.01,-50) [-50|128] "dBsm"  ADCC_FM_4X
 SG_ FRM_46_DetnQuality_140 : 248|4@0+ (10,0) [0|100] "%"  ADCC_FM_4X
 SG_ FRM_46_DetnMotionSts_141 : 260|2@0+ (1,0) [0|3] ""  ADCC_FM_4X
 SG_ FRM_46_DetnRngRadial_141 : 258|15@0+ (0.01,0) [0|200] "m"  ADCC_FM_4X
 SG_ FRM_46_DetnAziAngle_141 : 275|11@0+ (0.1,-90) [-90|90] "deg"  ADCC_FM_4X
 SG_ FRM_46_DetnElevnAngle_141 : 280|8@0+ (0.1,-10) [-10|10] "deg"  ADCC_FM_4X
 SG_ FRM_46_DetnRelVelRadial_141 : 288|15@0+ (0.01,-100) [-100|80] "m/s"  ADCC_FM_4X
 SG_ FRM_46_DetnSNR_141 : 305|7@0+ (1,0) [0|100] "dB"  ADCC_FM_4X
 SG_ FRM_46_DetnRCS_141 : 314|15@0+ (0.01,-50) [-50|128] "dBsm"  ADCC_FM_4X
 SG_ FRM_46_DetnQuality_141 : 331|4@0+ (10,0) [0|100] "%"  ADCC_FM_4X
 SG_ FRM_46_DetnMotionSts_142 : 343|2@0+ (1,0) [0|3] ""  ADCC_FM_4X
 SG_ FRM_46_DetnRngRadial_142 : 341|15@0+ (0.01,0) [0|200] "m"  ADCC_FM_4X
 SG_ FRM_46_DetnAziAngle_142 : 358|11@0+ (0.1,-90) [-90|90] "deg"  ADCC_FM_4X
 SG_ FRM_46_DetnElevnAngle_142 : 363|8@0+ (0.1,-10) [-10|10] "deg"  ADCC_FM_4X
 SG_ FRM_46_DetnRelVelRadial_142 : 371|15@0+ (0.01,-100) [-100|80] "m/s"  ADCC_FM_4X
 SG_ FRM_46_DetnSNR_142 : 388|7@0+ (1,0) [0|100] "dB"  ADCC_FM_4X
 SG_ FRM_46_DetnRCS_142 : 397|15@0+ (0.01,-50) [-50|128] "dBsm"  ADCC_FM_4X
 SG_ FRM_46_DetnQuality_142 : 414|4@0+ (10,0) [0|100] "%"  ADCC_FM_4X
 SG_ FRM_46_DetnMotionSts_143 : 410|2@0+ (1,0) [0|3] ""  ADCC_FM_4X
 SG_ FRM_46_DetnRngRadial_143 : 408|15@0+ (0.01,0) [0|200] "m"  ADCC_FM_4X
 SG_ FRM_46_DetnAziAngle_143 : 425|11@0+ (0.1,-90) [-90|90] "deg"  ADCC_FM_4X
 SG_ FRM_46_DetnElevnAngle_143 : 446|8@0+ (0.1,-10) [-10|10] "deg"  ADCC_FM_4X
 SG_ FRM_46_DetnRelVelRadial_143 : 454|15@0+ (0.01,-100) [-100|80] "m/s"  ADCC_FM_4X
 SG_ FRM_46_DetnSNR_143 : 471|7@0+ (1,0) [0|100] "dB"  ADCC_FM_4X
 SG_ FRM_46_DetnRCS_143 : 464|15@0+ (0.01,-50) [-50|128] "dBsm"  ADCC_FM_4X
 SG_ FRM_46_DetnQuality_143 : 481|4@0+ (10,0) [0|100] "%"  ADCC_FM_4X
 SG_ FRM_46_Loc138_Valid : 488|1@0+ (1,0) [0|1] ""  ADCC_FM_4X
 SG_ FRM_46_Loc139_Valid : 489|1@0+ (1,0) [0|1] ""  ADCC_FM_4X
 SG_ FRM_46_Loc140_Valid : 490|1@0+ (1,0) [0|1] ""  ADCC_FM_4X
 SG_ FRM_46_Loc141_Valid : 491|1@0+ (1,0) [0|1] ""  ADCC_FM_4X
 SG_ FRM_46_Loc142_Valid : 492|1@0+ (1,0) [0|1] ""  ADCC_FM_4X
 SG_ FRM_46_Loc143_Valid : 493|1@0+ (1,0) [0|1] ""  ADCC_FM_4X

BO_ 1018 FRM_47: 64 Vector__XXX
 SG_ FRM_47_CRC : 7|16@0+ (1,0) [0|65535] ""  ADCC_FM_4X
 SG_ FRM_47_RollgCntr : 23|8@0+ (1,0) [0|255] ""  ADCC_FM_4X
 SG_ FRM_47_DetnBlockCounter : 27|4@0+ (1,0) [0|15] ""  ADCC_FM_4X
 SG_ FRM_47_DetnMotionSts_144 : 29|2@0+ (1,0) [0|3] ""  ADCC_FM_4X
 SG_ FRM_47_DetnRngRadial_144 : 39|15@0+ (0.01,0) [0|200] "m"  ADCC_FM_4X
 SG_ FRM_47_DetnAziAngle_144 : 40|11@0+ (0.1,-90) [-90|90] "deg"  ADCC_FM_4X
 SG_ FRM_47_DetnElevnAngle_144 : 61|8@0+ (0.1,-10) [-10|10] "deg"  ADCC_FM_4X
 SG_ FRM_47_DetnRelVelRadial_144 : 69|15@0+ (0.01,-100) [-100|80] "m/s"  ADCC_FM_4X
 SG_ FRM_47_DetnSNR_144 : 86|7@0+ (1,0) [0|100] "dB"  ADCC_FM_4X
 SG_ FRM_47_DetnRCS_144 : 95|15@0+ (0.01,-50) [-50|128] "dBsm"  ADCC_FM_4X
 SG_ FRM_47_DetnQuality_144 : 96|4@0+ (10,0) [0|100] "%"  ADCC_FM_4X
 SG_ FRM_47_DetnMotionSts_145 : 31|2@0+ (1,0) [0|3] ""  ADCC_FM_4X
 SG_ FRM_47_DetnRngRadial_145 : 108|15@0+ (0.01,0) [0|200] "m"  ADCC_FM_4X
 SG_ FRM_47_DetnAziAngle_145 : 125|11@0+ (0.1,-90) [-90|90] "deg"  ADCC_FM_4X
 SG_ FRM_47_DetnElevnAngle_145 : 130|8@0+ (0.1,-10) [-10|10] "deg"  ADCC_FM_4X
 SG_ FRM_47_DetnRelVelRadial_145 : 138|15@0+ (0.01,-100) [-100|80] "m/s"  ADCC_FM_4X
 SG_ FRM_47_DetnSNR_145 : 155|7@0+ (1,0) [0|100] "dB"  ADCC_FM_4X
 SG_ FRM_47_DetnRCS_145 : 164|15@0+ (0.01,-50) [-50|128] "dBsm"  ADCC_FM_4X
 SG_ FRM_47_DetnQuality_145 : 181|4@0+ (10,0) [0|100] "%"  ADCC_FM_4X
 SG_ FRM_47_DetnMotionSts_146 : 177|2@0+ (1,0) [0|3] ""  ADCC_FM_4X
 SG_ FRM_47_DetnRngRadial_146 : 191|15@0+ (0.01,0) [0|200] "m"  ADCC_FM_4X
 SG_ FRM_47_DetnAziAngle_146 : 192|11@0+ (0.1,-90) [-90|90] "deg"  ADCC_FM_4X
 SG_ FRM_47_DetnElevnAngle_146 : 213|8@0+ (0.1,-10) [-10|10] "deg"  ADCC_FM_4X
 SG_ FRM_47_DetnRelVelRadial_146 : 221|15@0+ (0.01,-100) [-100|80] "m/s"  ADCC_FM_4X
 SG_ FRM_47_DetnSNR_146 : 238|7@0+ (1,0) [0|100] "dB"  ADCC_FM_4X
 SG_ FRM_47_DetnRCS_146 : 247|15@0+ (0.01,-50) [-50|128] "dBsm"  ADCC_FM_4X
 SG_ FRM_47_DetnQuality_146 : 248|4@0+ (10,0) [0|100] "%"  ADCC_FM_4X
 SG_ FRM_47_DetnMotionSts_147 : 260|2@0+ (1,0) [0|3] ""  ADCC_FM_4X
 SG_ FRM_47_DetnRngRadial_147 : 258|15@0+ (0.01,0) [0|200] "m"  ADCC_FM_4X
 SG_ FRM_47_DetnAziAngle_147 : 275|11@0+ (0.1,-90) [-90|90] "deg"  ADCC_FM_4X
 SG_ FRM_47_DetnElevnAngle_147 : 280|8@0+ (0.1,-10) [-10|10] "deg"  ADCC_FM_4X
 SG_ FRM_47_DetnRelVelRadial_147 : 288|15@0+ (0.01,-100) [-100|80] "m/s"  ADCC_FM_4X
 SG_ FRM_47_DetnSNR_147 : 305|7@0+ (1,0) [0|100] "dB"  ADCC_FM_4X
 SG_ FRM_47_DetnRCS_147 : 314|15@0+ (0.01,-50) [-50|128] "dBsm"  ADCC_FM_4X
 SG_ FRM_47_DetnQuality_147 : 331|4@0+ (10,0) [0|100] "%"  ADCC_FM_4X
 SG_ FRM_47_DetnMotionSts_148 : 343|2@0+ (1,0) [0|3] ""  ADCC_FM_4X
 SG_ FRM_47_DetnRngRadial_148 : 341|15@0+ (0.01,0) [0|200] "m"  ADCC_FM_4X
 SG_ FRM_47_DetnAziAngle_148 : 358|11@0+ (0.1,-90) [-90|90] "deg"  ADCC_FM_4X
 SG_ FRM_47_DetnElevnAngle_148 : 363|8@0+ (0.1,-10) [-10|10] "deg"  ADCC_FM_4X
 SG_ FRM_47_DetnRelVelRadial_148 : 371|15@0+ (0.01,-100) [-100|80] "m/s"  ADCC_FM_4X
 SG_ FRM_47_DetnSNR_148 : 388|7@0+ (1,0) [0|100] "dB"  ADCC_FM_4X
 SG_ FRM_47_DetnRCS_148 : 397|15@0+ (0.01,-50) [-50|128] "dBsm"  ADCC_FM_4X
 SG_ FRM_47_DetnQuality_148 : 414|4@0+ (10,0) [0|100] "%"  ADCC_FM_4X
 SG_ FRM_47_DetnMotionSts_149 : 410|2@0+ (1,0) [0|3] ""  ADCC_FM_4X
 SG_ FRM_47_DetnRngRadial_149 : 408|15@0+ (0.01,0) [0|200] "m"  ADCC_FM_4X
 SG_ FRM_47_DetnAziAngle_149 : 425|11@0+ (0.1,-90) [-90|90] "deg"  ADCC_FM_4X
 SG_ FRM_47_DetnElevnAngle_149 : 446|8@0+ (0.1,-10) [-10|10] "deg"  ADCC_FM_4X
 SG_ FRM_47_DetnRelVelRadial_149 : 454|15@0+ (0.01,-100) [-100|80] "m/s"  ADCC_FM_4X
 SG_ FRM_47_DetnSNR_149 : 471|7@0+ (1,0) [0|100] "dB"  ADCC_FM_4X
 SG_ FRM_47_DetnRCS_149 : 464|15@0+ (0.01,-50) [-50|128] "dBsm"  ADCC_FM_4X
 SG_ FRM_47_DetnQuality_149 : 481|4@0+ (10,0) [0|100] "%"  ADCC_FM_4X
 SG_ FRM_47_Loc144_Valid : 488|1@0+ (1,0) [0|1] ""  ADCC_FM_4X
 SG_ FRM_47_Loc145_Valid : 489|1@0+ (1,0) [0|1] ""  ADCC_FM_4X
 SG_ FRM_47_Loc146_Valid : 490|1@0+ (1,0) [0|1] ""  ADCC_FM_4X
 SG_ FRM_47_Loc147_Valid : 491|1@0+ (1,0) [0|1] ""  ADCC_FM_4X
 SG_ FRM_47_Loc148_Valid : 492|1@0+ (1,0) [0|1] ""  ADCC_FM_4X
 SG_ FRM_47_Loc149_Valid : 493|1@0+ (1,0) [0|1] ""  ADCC_FM_4X

BO_ 1019 FRM_48: 64 Vector__XXX
 SG_ FRM_48_CRC : 7|16@0+ (1,0) [0|65535] ""  ADCC_FM_4X
 SG_ FRM_48_RollgCntr : 23|8@0+ (1,0) [0|255] ""  ADCC_FM_4X
 SG_ FRM_48_DetnBlockCounter : 27|4@0+ (1,0) [0|15] ""  ADCC_FM_4X
 SG_ FRM_48_DetnMotionSts_150 : 29|2@0+ (1,0) [0|3] ""  ADCC_FM_4X
 SG_ FRM_48_DetnRngRadial_150 : 39|15@0+ (0.01,0) [0|200] "m"  ADCC_FM_4X
 SG_ FRM_48_DetnAziAngle_150 : 40|11@0+ (0.1,-90) [-90|90] "deg"  ADCC_FM_4X
 SG_ FRM_48_DetnElevnAngle_150 : 61|8@0+ (0.1,-10) [-10|10] "deg"  ADCC_FM_4X
 SG_ FRM_48_DetnRelVelRadial_150 : 69|15@0+ (0.01,-100) [-100|80] "m/s"  ADCC_FM_4X
 SG_ FRM_48_DetnSNR_150 : 86|7@0+ (1,0) [0|100] "dB"  ADCC_FM_4X
 SG_ FRM_48_DetnRCS_150 : 95|15@0+ (0.01,-50) [-50|128] "dBsm"  ADCC_FM_4X
 SG_ FRM_48_DetnQuality_150 : 96|4@0+ (10,0) [0|100] "%"  ADCC_FM_4X
 SG_ FRM_48_DetnMotionSts_151 : 31|2@0+ (1,0) [0|3] ""  ADCC_FM_4X
 SG_ FRM_48_DetnRngRadial_151 : 108|15@0+ (0.01,0) [0|200] "m"  ADCC_FM_4X
 SG_ FRM_48_DetnAziAngle_151 : 125|11@0+ (0.1,-90) [-90|90] "deg"  ADCC_FM_4X
 SG_ FRM_48_DetnElevnAngle_151 : 130|8@0+ (0.1,-10) [-10|10] "deg"  ADCC_FM_4X
 SG_ FRM_48_DetnRelVelRadial_151 : 138|15@0+ (0.01,-100) [-100|80] "m/s"  ADCC_FM_4X
 SG_ FRM_48_DetnSNR_151 : 155|7@0+ (1,0) [0|100] "dB"  ADCC_FM_4X
 SG_ FRM_48_DetnRCS_151 : 164|15@0+ (0.01,-50) [-50|128] "dBsm"  ADCC_FM_4X
 SG_ FRM_48_DetnQuality_151 : 181|4@0+ (10,0) [0|100] "%"  ADCC_FM_4X
 SG_ FRM_48_DetnMotionSts_152 : 177|2@0+ (1,0) [0|3] ""  ADCC_FM_4X
 SG_ FRM_48_DetnRngRadial_152 : 191|15@0+ (0.01,0) [0|200] "m"  ADCC_FM_4X
 SG_ FRM_48_DetnAziAngle_152 : 192|11@0+ (0.1,-90) [-90|90] "deg"  ADCC_FM_4X
 SG_ FRM_48_DetnElevnAngle_152 : 213|8@0+ (0.1,-10) [-10|10] "deg"  ADCC_FM_4X
 SG_ FRM_48_DetnRelVelRadial_152 : 221|15@0+ (0.01,-100) [-100|80] "m/s"  ADCC_FM_4X
 SG_ FRM_48_DetnSNR_152 : 238|7@0+ (1,0) [0|100] "dB"  ADCC_FM_4X
 SG_ FRM_48_DetnRCS_152 : 247|15@0+ (0.01,-50) [-50|128] "dBsm"  ADCC_FM_4X
 SG_ FRM_48_DetnQuality_152 : 248|4@0+ (10,0) [0|100] "%"  ADCC_FM_4X
 SG_ FRM_48_DetnMotionSts_153 : 260|2@0+ (1,0) [0|3] ""  ADCC_FM_4X
 SG_ FRM_48_DetnRngRadial_153 : 258|15@0+ (0.01,0) [0|200] "m"  ADCC_FM_4X
 SG_ FRM_48_DetnAziAngle_153 : 275|11@0+ (0.1,-90) [-90|90] "deg"  ADCC_FM_4X
 SG_ FRM_48_DetnElevnAngle_153 : 280|8@0+ (0.1,-10) [-10|10] "deg"  ADCC_FM_4X
 SG_ FRM_48_DetnRelVelRadial_153 : 288|15@0+ (0.01,-100) [-100|80] "m/s"  ADCC_FM_4X
 SG_ FRM_48_DetnSNR_153 : 305|7@0+ (1,0) [0|100] "dB"  ADCC_FM_4X
 SG_ FRM_48_DetnRCS_153 : 314|15@0+ (0.01,-50) [-50|128] "dBsm"  ADCC_FM_4X
 SG_ FRM_48_DetnQuality_153 : 331|4@0+ (10,0) [0|100] "%"  ADCC_FM_4X
 SG_ FRM_48_DetnMotionSts_154 : 343|2@0+ (1,0) [0|3] ""  ADCC_FM_4X
 SG_ FRM_48_DetnRngRadial_154 : 341|15@0+ (0.01,0) [0|200] "m"  ADCC_FM_4X
 SG_ FRM_48_DetnAziAngle_154 : 358|11@0+ (0.1,-90) [-90|90] "deg"  ADCC_FM_4X
 SG_ FRM_48_DetnElevnAngle_154 : 363|8@0+ (0.1,-10) [-10|10] "deg"  ADCC_FM_4X
 SG_ FRM_48_DetnRelVelRadial_154 : 371|15@0+ (0.01,-100) [-100|80] "m/s"  ADCC_FM_4X
 SG_ FRM_48_DetnSNR_154 : 388|7@0+ (1,0) [0|100] "dB"  ADCC_FM_4X
 SG_ FRM_48_DetnRCS_154 : 397|15@0+ (0.01,-50) [-50|128] "dBsm"  ADCC_FM_4X
 SG_ FRM_48_DetnQuality_154 : 414|4@0+ (10,0) [0|100] "%"  ADCC_FM_4X
 SG_ FRM_48_DetnMotionSts_155 : 410|2@0+ (1,0) [0|3] ""  ADCC_FM_4X
 SG_ FRM_48_DetnRngRadial_155 : 408|15@0+ (0.01,0) [0|200] "m"  ADCC_FM_4X
 SG_ FRM_48_DetnAziAngle_155 : 425|11@0+ (0.1,-90) [-90|90] "deg"  ADCC_FM_4X
 SG_ FRM_48_DetnElevnAngle_155 : 446|8@0+ (0.1,-10) [-10|10] "deg"  ADCC_FM_4X
 SG_ FRM_48_DetnRelVelRadial_155 : 454|15@0+ (0.01,-100) [-100|80] "m/s"  ADCC_FM_4X
 SG_ FRM_48_DetnSNR_155 : 471|7@0+ (1,0) [0|100] "dB"  ADCC_FM_4X
 SG_ FRM_48_DetnRCS_155 : 464|15@0+ (0.01,-50) [-50|128] "dBsm"  ADCC_FM_4X
 SG_ FRM_48_DetnQuality_155 : 481|4@0+ (10,0) [0|100] "%"  ADCC_FM_4X
 SG_ FRM_48_Loc150_Valid : 488|1@0+ (1,0) [0|1] ""  ADCC_FM_4X
 SG_ FRM_48_Loc151_Valid : 489|1@0+ (1,0) [0|1] ""  ADCC_FM_4X
 SG_ FRM_48_Loc152_Valid : 490|1@0+ (1,0) [0|1] ""  ADCC_FM_4X
 SG_ FRM_48_Loc153_Valid : 491|1@0+ (1,0) [0|1] ""  ADCC_FM_4X
 SG_ FRM_48_Loc154_Valid : 492|1@0+ (1,0) [0|1] ""  ADCC_FM_4X
 SG_ FRM_48_Loc155_Valid : 493|1@0+ (1,0) [0|1] ""  ADCC_FM_4X

BO_ 1020 FRM_49: 64 Vector__XXX
 SG_ FRM_49_CRC : 7|16@0+ (1,0) [0|65535] ""  ADCC_FM_4X
 SG_ FRM_49_RollgCntr : 23|8@0+ (1,0) [0|255] ""  ADCC_FM_4X
 SG_ FRM_49_DetnBlockCounter : 27|4@0+ (1,0) [0|15] ""  ADCC_FM_4X
 SG_ FRM_49_DetnMotionSts_156 : 29|2@0+ (1,0) [0|3] ""  ADCC_FM_4X
 SG_ FRM_49_DetnRngRadial_156 : 39|15@0+ (0.01,0) [0|200] "m"  ADCC_FM_4X
 SG_ FRM_49_DetnAziAngle_156 : 40|11@0+ (0.1,-90) [-90|90] "deg"  ADCC_FM_4X
 SG_ FRM_49_DetnElevnAngle_156 : 61|8@0+ (0.1,-10) [-10|10] "deg"  ADCC_FM_4X
 SG_ FRM_49_DetnRelVelRadial_156 : 69|15@0+ (0.01,-100) [-100|80] "m/s"  ADCC_FM_4X
 SG_ FRM_49_DetnSNR_156 : 86|7@0+ (1,0) [0|100] "dB"  ADCC_FM_4X
 SG_ FRM_49_DetnRCS_156 : 95|15@0+ (0.01,-50) [-50|128] "dBsm"  ADCC_FM_4X
 SG_ FRM_49_DetnQuality_156 : 96|4@0+ (10,0) [0|100] "%"  ADCC_FM_4X
 SG_ FRM_49_DetnMotionSts_157 : 31|2@0+ (1,0) [0|3] ""  ADCC_FM_4X
 SG_ FRM_49_DetnRngRadial_157 : 108|15@0+ (0.01,0) [0|200] "m"  ADCC_FM_4X
 SG_ FRM_49_DetnAziAngle_157 : 125|11@0+ (0.1,-90) [-90|90] "deg"  ADCC_FM_4X
 SG_ FRM_49_DetnElevnAngle_157 : 130|8@0+ (0.1,-10) [-10|10] "deg"  ADCC_FM_4X
 SG_ FRM_49_DetnRelVelRadial_157 : 138|15@0+ (0.01,-100) [-100|80] "m/s"  ADCC_FM_4X
 SG_ FRM_49_DetnSNR_157 : 155|7@0+ (1,0) [0|100] "dB"  ADCC_FM_4X
 SG_ FRM_49_DetnRCS_157 : 164|15@0+ (0.01,-50) [-50|128] "dBsm"  ADCC_FM_4X
 SG_ FRM_49_DetnQuality_157 : 181|4@0+ (10,0) [0|100] "%"  ADCC_FM_4X
 SG_ FRM_49_DetnMotionSts_158 : 177|2@0+ (1,0) [0|3] ""  ADCC_FM_4X
 SG_ FRM_49_DetnRngRadial_158 : 191|15@0+ (0.01,0) [0|200] "m"  ADCC_FM_4X
 SG_ FRM_49_DetnAziAngle_158 : 192|11@0+ (0.1,-90) [-90|90] "deg"  ADCC_FM_4X
 SG_ FRM_49_DetnElevnAngle_158 : 213|8@0+ (0.1,-10) [-10|10] "deg"  ADCC_FM_4X
 SG_ FRM_49_DetnRelVelRadial_158 : 221|15@0+ (0.01,-100) [-100|80] "m/s"  ADCC_FM_4X
 SG_ FRM_49_DetnSNR_158 : 238|7@0+ (1,0) [0|100] "dB"  ADCC_FM_4X
 SG_ FRM_49_DetnRCS_158 : 247|15@0+ (0.01,-50) [-50|128] "dBsm"  ADCC_FM_4X
 SG_ FRM_49_DetnQuality_158 : 248|4@0+ (10,0) [0|100] "%"  ADCC_FM_4X
 SG_ FRM_49_DetnMotionSts_159 : 260|2@0+ (1,0) [0|3] ""  ADCC_FM_4X
 SG_ FRM_49_DetnRngRadial_159 : 258|15@0+ (0.01,0) [0|200] "m"  ADCC_FM_4X
 SG_ FRM_49_DetnAziAngle_159 : 275|11@0+ (0.1,-90) [-90|90] "deg"  ADCC_FM_4X
 SG_ FRM_49_DetnElevnAngle_159 : 280|8@0+ (0.1,-10) [-10|10] "deg"  ADCC_FM_4X
 SG_ FRM_49_DetnRelVelRadial_159 : 288|15@0+ (0.01,-100) [-100|80] "m/s"  ADCC_FM_4X
 SG_ FRM_49_DetnSNR_159 : 305|7@0+ (1,0) [0|100] "dB"  ADCC_FM_4X
 SG_ FRM_49_DetnRCS_159 : 314|15@0+ (0.01,-50) [-50|128] "dBsm"  ADCC_FM_4X
 SG_ FRM_49_DetnQuality_159 : 331|4@0+ (10,0) [0|100] "%"  ADCC_FM_4X
 SG_ FRM_49_DetnMotionSts_160 : 343|2@0+ (1,0) [0|3] ""  ADCC_FM_4X
 SG_ FRM_49_DetnRngRadial_160 : 341|15@0+ (0.01,0) [0|200] "m"  ADCC_FM_4X
 SG_ FRM_49_DetnAziAngle_160 : 358|11@0+ (0.1,-90) [-90|90] "deg"  ADCC_FM_4X
 SG_ FRM_49_DetnElevnAngle_160 : 363|8@0+ (0.1,-10) [-10|10] "deg"  ADCC_FM_4X
 SG_ FRM_49_DetnRelVelRadial_160 : 371|15@0+ (0.01,-100) [-100|80] "m/s"  ADCC_FM_4X
 SG_ FRM_49_DetnSNR_160 : 388|7@0+ (1,0) [0|100] "dB"  ADCC_FM_4X
 SG_ FRM_49_DetnRCS_160 : 397|15@0+ (0.01,-50) [-50|128] "dBsm"  ADCC_FM_4X
 SG_ FRM_49_DetnQuality_160 : 414|4@0+ (10,0) [0|100] "%"  ADCC_FM_4X
 SG_ FRM_49_DetnMotionSts_161 : 410|2@0+ (1,0) [0|3] ""  ADCC_FM_4X
 SG_ FRM_49_DetnRngRadial_161 : 408|15@0+ (0.01,0) [0|200] "m"  ADCC_FM_4X
 SG_ FRM_49_DetnAziAngle_161 : 425|11@0+ (0.1,-90) [-90|90] "deg"  ADCC_FM_4X
 SG_ FRM_49_DetnElevnAngle_161 : 446|8@0+ (0.1,-10) [-10|10] "deg"  ADCC_FM_4X
 SG_ FRM_49_DetnRelVelRadial_161 : 454|15@0+ (0.01,-100) [-100|80] "m/s"  ADCC_FM_4X
 SG_ FRM_49_DetnSNR_161 : 471|7@0+ (1,0) [0|100] "dB"  ADCC_FM_4X
 SG_ FRM_49_DetnRCS_161 : 464|15@0+ (0.01,-50) [-50|128] "dBsm"  ADCC_FM_4X
 SG_ FRM_49_DetnQuality_161 : 481|4@0+ (10,0) [0|100] "%"  ADCC_FM_4X
 SG_ FRM_49_Loc156_Valid : 488|1@0+ (1,0) [0|1] ""  ADCC_FM_4X
 SG_ FRM_49_Loc157_Valid : 489|1@0+ (1,0) [0|1] ""  ADCC_FM_4X
 SG_ FRM_49_Loc158_Valid : 490|1@0+ (1,0) [0|1] ""  ADCC_FM_4X
 SG_ FRM_49_Loc159_Valid : 491|1@0+ (1,0) [0|1] ""  ADCC_FM_4X
 SG_ FRM_49_Loc160_Valid : 492|1@0+ (1,0) [0|1] ""  ADCC_FM_4X
 SG_ FRM_49_Loc161_Valid : 493|1@0+ (1,0) [0|1] ""  ADCC_FM_4X

BO_ 1021 FRM_50: 64 Vector__XXX
 SG_ FRM_50_CRC : 7|16@0+ (1,0) [0|65535] ""  ADCC_FM_4X
 SG_ FRM_50_RollgCntr : 23|8@0+ (1,0) [0|255] ""  ADCC_FM_4X
 SG_ FRM_50_DetnBlockCounter : 27|4@0+ (1,0) [0|15] ""  ADCC_FM_4X
 SG_ FRM_50_DetnMotionSts_162 : 29|2@0+ (1,0) [0|3] ""  ADCC_FM_4X
 SG_ FRM_50_DetnRngRadial_162 : 39|15@0+ (0.01,0) [0|200] "m"  ADCC_FM_4X
 SG_ FRM_50_DetnAziAngle_162 : 40|11@0+ (0.1,-90) [-90|90] "deg"  ADCC_FM_4X
 SG_ FRM_50_DetnElevnAngle_162 : 61|8@0+ (0.1,-10) [-10|10] "deg"  ADCC_FM_4X
 SG_ FRM_50_DetnRelVelRadial_162 : 69|15@0+ (0.01,-100) [-100|80] "m/s"  ADCC_FM_4X
 SG_ FRM_50_DetnSNR_162 : 86|7@0+ (1,0) [0|100] "dB"  ADCC_FM_4X
 SG_ FRM_50_DetnRCS_162 : 95|15@0+ (0.01,-50) [-50|128] "dBsm"  ADCC_FM_4X
 SG_ FRM_50_DetnQuality_162 : 96|4@0+ (10,0) [0|100] "%"  ADCC_FM_4X
 SG_ FRM_50_DetnMotionSts_163 : 31|2@0+ (1,0) [0|3] ""  ADCC_FM_4X
 SG_ FRM_50_DetnRngRadial_163 : 108|15@0+ (0.01,0) [0|200] "m"  ADCC_FM_4X
 SG_ FRM_50_DetnAziAngle_163 : 125|11@0+ (0.1,-90) [-90|90] "deg"  ADCC_FM_4X
 SG_ FRM_50_DetnElevnAngle_163 : 130|8@0+ (0.1,-10) [-10|10] "deg"  ADCC_FM_4X
 SG_ FRM_50_DetnRelVelRadial_163 : 138|15@0+ (0.01,-100) [-100|80] "m/s"  ADCC_FM_4X
 SG_ FRM_50_DetnSNR_163 : 155|7@0+ (1,0) [0|100] "dB"  ADCC_FM_4X
 SG_ FRM_50_DetnRCS_163 : 164|15@0+ (0.01,-50) [-50|128] "dBsm"  ADCC_FM_4X
 SG_ FRM_50_DetnQuality_163 : 181|4@0+ (10,0) [0|100] "%"  ADCC_FM_4X
 SG_ FRM_50_DetnMotionSts_164 : 177|2@0+ (1,0) [0|3] ""  ADCC_FM_4X
 SG_ FRM_50_DetnRngRadial_164 : 191|15@0+ (0.01,0) [0|200] "m"  ADCC_FM_4X
 SG_ FRM_50_DetnAziAngle_164 : 192|11@0+ (0.1,-90) [-90|90] "deg"  ADCC_FM_4X
 SG_ FRM_50_DetnElevnAngle_164 : 213|8@0+ (0.1,-10) [-10|10] "deg"  ADCC_FM_4X
 SG_ FRM_50_DetnRelVelRadial_164 : 221|15@0+ (0.01,-100) [-100|80] "m/s"  ADCC_FM_4X
 SG_ FRM_50_DetnSNR_164 : 238|7@0+ (1,0) [0|100] "dB"  ADCC_FM_4X
 SG_ FRM_50_DetnRCS_164 : 247|15@0+ (0.01,-50) [-50|128] "dBsm"  ADCC_FM_4X
 SG_ FRM_50_DetnQuality_164 : 248|4@0+ (10,0) [0|100] "%"  ADCC_FM_4X
 SG_ FRM_50_DetnMotionSts_165 : 260|2@0+ (1,0) [0|3] ""  ADCC_FM_4X
 SG_ FRM_50_DetnRngRadial_165 : 258|15@0+ (0.01,0) [0|200] "m"  ADCC_FM_4X
 SG_ FRM_50_DetnAziAngle_165 : 275|11@0+ (0.1,-90) [-90|90] "deg"  ADCC_FM_4X
 SG_ FRM_50_DetnElevnAngle_165 : 280|8@0+ (0.1,-10) [-10|10] "deg"  ADCC_FM_4X
 SG_ FRM_50_DetnRelVelRadial_165 : 288|15@0+ (0.01,-100) [-100|80] "m/s"  ADCC_FM_4X
 SG_ FRM_50_DetnSNR_165 : 305|7@0+ (1,0) [0|100] "dB"  ADCC_FM_4X
 SG_ FRM_50_DetnRCS_165 : 314|15@0+ (0.01,-50) [-50|128] "dBsm"  ADCC_FM_4X
 SG_ FRM_50_DetnQuality_165 : 331|4@0+ (10,0) [0|100] "%"  ADCC_FM_4X
 SG_ FRM_50_DetnMotionSts_166 : 343|2@0+ (1,0) [0|3] ""  ADCC_FM_4X
 SG_ FRM_50_DetnRngRadial_166 : 341|15@0+ (0.01,0) [0|200] "m"  ADCC_FM_4X
 SG_ FRM_50_DetnAziAngle_166 : 358|11@0+ (0.1,-90) [-90|90] "deg"  ADCC_FM_4X
 SG_ FRM_50_DetnElevnAngle_166 : 363|8@0+ (0.1,-10) [-10|10] "deg"  ADCC_FM_4X
 SG_ FRM_50_DetnRelVelRadial_166 : 371|15@0+ (0.01,-100) [-100|80] "m/s"  ADCC_FM_4X
 SG_ FRM_50_DetnSNR_166 : 388|7@0+ (1,0) [0|100] "dB"  ADCC_FM_4X
 SG_ FRM_50_DetnRCS_166 : 397|15@0+ (0.01,-50) [-50|128] "dBsm"  ADCC_FM_4X
 SG_ FRM_50_DetnQuality_166 : 414|4@0+ (10,0) [0|100] "%"  ADCC_FM_4X
 SG_ FRM_50_DetnMotionSts_167 : 410|2@0+ (1,0) [0|3] ""  ADCC_FM_4X
 SG_ FRM_50_DetnRngRadial_167 : 408|15@0+ (0.01,0) [0|200] "m"  ADCC_FM_4X
 SG_ FRM_50_DetnAziAngle_167 : 425|11@0+ (0.1,-90) [-90|90] "deg"  ADCC_FM_4X
 SG_ FRM_50_DetnElevnAngle_167 : 446|8@0+ (0.1,-10) [-10|10] "deg"  ADCC_FM_4X
 SG_ FRM_50_DetnRelVelRadial_167 : 454|15@0+ (0.01,-100) [-100|80] "m/s"  ADCC_FM_4X
 SG_ FRM_50_DetnSNR_167 : 471|7@0+ (1,0) [0|100] "dB"  ADCC_FM_4X
 SG_ FRM_50_DetnRCS_167 : 464|15@0+ (0.01,-50) [-50|128] "dBsm"  ADCC_FM_4X
 SG_ FRM_50_DetnQuality_167 : 481|4@0+ (10,0) [0|100] "%"  ADCC_FM_4X
 SG_ FRM_50_Loc162_Valid : 488|1@0+ (1,0) [0|1] ""  ADCC_FM_4X
 SG_ FRM_50_Loc163_Valid : 489|1@0+ (1,0) [0|1] ""  ADCC_FM_4X
 SG_ FRM_50_Loc164_Valid : 490|1@0+ (1,0) [0|1] ""  ADCC_FM_4X
 SG_ FRM_50_Loc165_Valid : 491|1@0+ (1,0) [0|1] ""  ADCC_FM_4X
 SG_ FRM_50_Loc166_Valid : 492|1@0+ (1,0) [0|1] ""  ADCC_FM_4X
 SG_ FRM_50_Loc167_Valid : 493|1@0+ (1,0) [0|1] ""  ADCC_FM_4X

BO_ 1022 FRM_51: 64 Vector__XXX
 SG_ FRM_51_CRC : 7|16@0+ (1,0) [0|65535] ""  ADCC_FM_4X
 SG_ FRM_51_RollgCntr : 23|8@0+ (1,0) [0|255] ""  ADCC_FM_4X
 SG_ FRM_51_DetnBlockCounter : 27|4@0+ (1,0) [0|15] ""  ADCC_FM_4X
 SG_ FRM_51_DetnMotionSts_168 : 29|2@0+ (1,0) [0|3] ""  ADCC_FM_4X
 SG_ FRM_51_DetnRngRadial_168 : 39|15@0+ (0.01,0) [0|200] "m"  ADCC_FM_4X
 SG_ FRM_51_DetnAziAngle_168 : 40|11@0+ (0.1,-90) [-90|90] "deg"  ADCC_FM_4X
 SG_ FRM_51_DetnElevnAngle_168 : 61|8@0+ (0.1,-10) [-10|10] "deg"  ADCC_FM_4X
 SG_ FRM_51_DetnRelVelRadial_168 : 69|15@0+ (0.01,-100) [-100|80] "m/s"  ADCC_FM_4X
 SG_ FRM_51_DetnSNR_168 : 86|7@0+ (1,0) [0|100] "dB"  ADCC_FM_4X
 SG_ FRM_51_DetnRCS_168 : 95|15@0+ (0.01,-50) [-50|128] "dBsm"  ADCC_FM_4X
 SG_ FRM_51_DetnQuality_168 : 96|4@0+ (10,0) [0|100] "%"  ADCC_FM_4X
 SG_ FRM_51_DetnMotionSts_169 : 31|2@0+ (1,0) [0|3] ""  ADCC_FM_4X
 SG_ FRM_51_DetnRngRadial_169 : 108|15@0+ (0.01,0) [0|200] "m"  ADCC_FM_4X
 SG_ FRM_51_DetnAziAngle_169 : 125|11@0+ (0.1,-90) [-90|90] "deg"  ADCC_FM_4X
 SG_ FRM_51_DetnElevnAngle_169 : 130|8@0+ (0.1,-10) [-10|10] "deg"  ADCC_FM_4X
 SG_ FRM_51_DetnRelVelRadial_169 : 138|15@0+ (0.01,-100) [-100|80] "m/s"  ADCC_FM_4X
 SG_ FRM_51_DetnSNR_169 : 155|7@0+ (1,0) [0|100] "dB"  ADCC_FM_4X
 SG_ FRM_51_DetnRCS_169 : 164|15@0+ (0.01,-50) [-50|128] "dBsm"  ADCC_FM_4X
 SG_ FRM_51_DetnQuality_169 : 181|4@0+ (10,0) [0|100] "%"  ADCC_FM_4X
 SG_ FRM_51_DetnMotionSts_170 : 177|2@0+ (1,0) [0|3] ""  ADCC_FM_4X
 SG_ FRM_51_DetnRngRadial_170 : 191|15@0+ (0.01,0) [0|200] "m"  ADCC_FM_4X
 SG_ FRM_51_DetnAziAngle_170 : 192|11@0+ (0.1,-90) [-90|90] "deg"  ADCC_FM_4X
 SG_ FRM_51_DetnElevnAngle_170 : 213|8@0+ (0.1,-10) [-10|10] "deg"  ADCC_FM_4X
 SG_ FRM_51_DetnRelVelRadial_170 : 221|15@0+ (0.01,-100) [-100|80] "m/s"  ADCC_FM_4X
 SG_ FRM_51_DetnSNR_170 : 238|7@0+ (1,0) [0|100] "dB"  ADCC_FM_4X
 SG_ FRM_51_DetnRCS_170 : 247|15@0+ (0.01,-50) [-50|128] "dBsm"  ADCC_FM_4X
 SG_ FRM_51_DetnQuality_170 : 248|4@0+ (10,0) [0|100] "%"  ADCC_FM_4X
 SG_ FRM_51_DetnMotionSts_171 : 260|2@0+ (1,0) [0|3] ""  ADCC_FM_4X
 SG_ FRM_51_DetnRngRadial_171 : 258|15@0+ (0.01,0) [0|200] "m"  ADCC_FM_4X
 SG_ FRM_51_DetnAziAngle_171 : 275|11@0+ (0.1,-90) [-90|90] "deg"  ADCC_FM_4X
 SG_ FRM_51_DetnElevnAngle_171 : 280|8@0+ (0.1,-10) [-10|10] "deg"  ADCC_FM_4X
 SG_ FRM_51_DetnRelVelRadial_171 : 288|15@0+ (0.01,-100) [-100|80] "m/s"  ADCC_FM_4X
 SG_ FRM_51_DetnSNR_171 : 305|7@0+ (1,0) [0|100] "dB"  ADCC_FM_4X
 SG_ FRM_51_DetnRCS_171 : 314|15@0+ (0.01,-50) [-50|128] "dBsm"  ADCC_FM_4X
 SG_ FRM_51_DetnQuality_171 : 331|4@0+ (10,0) [0|100] "%"  ADCC_FM_4X
 SG_ FRM_51_DetnMotionSts_172 : 343|2@0+ (1,0) [0|3] ""  ADCC_FM_4X
 SG_ FRM_51_DetnRngRadial_172 : 341|15@0+ (0.01,0) [0|200] "m"  ADCC_FM_4X
 SG_ FRM_51_DetnAziAngle_172 : 358|11@0+ (0.1,-90) [-90|90] "deg"  ADCC_FM_4X
 SG_ FRM_51_DetnElevnAngle_172 : 363|8@0+ (0.1,-10) [-10|10] "deg"  ADCC_FM_4X
 SG_ FRM_51_DetnRelVelRadial_172 : 371|15@0+ (0.01,-100) [-100|80] "m/s"  ADCC_FM_4X
 SG_ FRM_51_DetnSNR_172 : 388|7@0+ (1,0) [0|100] "dB"  ADCC_FM_4X
 SG_ FRM_51_DetnRCS_172 : 397|15@0+ (0.01,-50) [-50|128] "dBsm"  ADCC_FM_4X
 SG_ FRM_51_DetnQuality_172 : 414|4@0+ (10,0) [0|100] "%"  ADCC_FM_4X
 SG_ FRM_51_DetnMotionSts_173 : 410|2@0+ (1,0) [0|3] ""  ADCC_FM_4X
 SG_ FRM_51_DetnRngRadial_173 : 408|15@0+ (0.01,0) [0|200] "m"  ADCC_FM_4X
 SG_ FRM_51_DetnAziAngle_173 : 425|11@0+ (0.1,-90) [-90|90] "deg"  ADCC_FM_4X
 SG_ FRM_51_DetnElevnAngle_173 : 446|8@0+ (0.1,-10) [-10|10] "deg"  ADCC_FM_4X
 SG_ FRM_51_DetnRelVelRadial_173 : 454|15@0+ (0.01,-100) [-100|80] "m/s"  ADCC_FM_4X
 SG_ FRM_51_DetnSNR_173 : 471|7@0+ (1,0) [0|100] "dB"  ADCC_FM_4X
 SG_ FRM_51_DetnRCS_173 : 464|15@0+ (0.01,-50) [-50|128] "dBsm"  ADCC_FM_4X
 SG_ FRM_51_DetnQuality_173 : 481|4@0+ (10,0) [0|100] "%"  ADCC_FM_4X
 SG_ FRM_51_Loc168_Valid : 488|1@0+ (1,0) [0|1] ""  ADCC_FM_4X
 SG_ FRM_51_Loc169_Valid : 489|1@0+ (1,0) [0|1] ""  ADCC_FM_4X
 SG_ FRM_51_Loc170_Valid : 490|1@0+ (1,0) [0|1] ""  ADCC_FM_4X
 SG_ FRM_51_Loc171_Valid : 491|1@0+ (1,0) [0|1] ""  ADCC_FM_4X
 SG_ FRM_51_Loc172_Valid : 492|1@0+ (1,0) [0|1] ""  ADCC_FM_4X
 SG_ FRM_51_Loc173_Valid : 493|1@0+ (1,0) [0|1] ""  ADCC_FM_4X

BO_ 1023 FRM_52: 64 Vector__XXX
 SG_ FRM_52_CRC : 7|16@0+ (1,0) [0|65535] ""  ADCC_FM_4X
 SG_ FRM_52_RollgCntr : 23|8@0+ (1,0) [0|255] ""  ADCC_FM_4X
 SG_ FRM_52_DetnBlockCounter : 27|4@0+ (1,0) [0|15] ""  ADCC_FM_4X
 SG_ FRM_52_DetnMotionSts_174 : 29|2@0+ (1,0) [0|3] ""  ADCC_FM_4X
 SG_ FRM_52_DetnRngRadial_174 : 39|15@0+ (0.01,0) [0|200] "m"  ADCC_FM_4X
 SG_ FRM_52_DetnAziAngle_174 : 40|11@0+ (0.1,-90) [-90|90] "deg"  ADCC_FM_4X
 SG_ FRM_52_DetnElevnAngle_174 : 61|8@0+ (0.1,-10) [-10|10] "deg"  ADCC_FM_4X
 SG_ FRM_52_DetnRelVelRadial_174 : 69|15@0+ (0.01,-100) [-100|80] "m/s"  ADCC_FM_4X
 SG_ FRM_52_DetnSNR_174 : 86|7@0+ (1,0) [0|100] "dB"  ADCC_FM_4X
 SG_ FRM_52_DetnRCS_174 : 95|15@0+ (0.01,-50) [-50|128] "dBsm"  ADCC_FM_4X
 SG_ FRM_52_DetnQuality_174 : 96|4@0+ (10,0) [0|100] "%"  ADCC_FM_4X
 SG_ FRM_52_DetnMotionSts_175 : 31|2@0+ (1,0) [0|3] ""  ADCC_FM_4X
 SG_ FRM_52_DetnRngRadial_175 : 108|15@0+ (0.01,0) [0|200] "m"  ADCC_FM_4X
 SG_ FRM_52_DetnAziAngle_175 : 125|11@0+ (0.1,-90) [-90|90] "deg"  ADCC_FM_4X
 SG_ FRM_52_DetnElevnAngle_175 : 130|8@0+ (0.1,-10) [-10|10] "deg"  ADCC_FM_4X
 SG_ FRM_52_DetnRelVelRadial_175 : 138|15@0+ (0.01,-100) [-100|80] "m/s"  ADCC_FM_4X
 SG_ FRM_52_DetnSNR_175 : 155|7@0+ (1,0) [0|100] "dB"  ADCC_FM_4X
 SG_ FRM_52_DetnRCS_175 : 164|15@0+ (0.01,-50) [-50|128] "dBsm"  ADCC_FM_4X
 SG_ FRM_52_DetnQuality_175 : 181|4@0+ (10,0) [0|100] "%"  ADCC_FM_4X
 SG_ FRM_52_DetnMotionSts_176 : 177|2@0+ (1,0) [0|3] ""  ADCC_FM_4X
 SG_ FRM_52_DetnRngRadial_176 : 191|15@0+ (0.01,0) [0|200] "m"  ADCC_FM_4X
 SG_ FRM_52_DetnAziAngle_176 : 192|11@0+ (0.1,-90) [-90|90] "deg"  ADCC_FM_4X
 SG_ FRM_52_DetnElevnAngle_176 : 213|8@0+ (0.1,-10) [-10|10] "deg"  ADCC_FM_4X
 SG_ FRM_52_DetnRelVelRadial_176 : 221|15@0+ (0.01,-100) [-100|80] "m/s"  ADCC_FM_4X
 SG_ FRM_52_DetnSNR_176 : 238|7@0+ (1,0) [0|100] "dB"  ADCC_FM_4X
 SG_ FRM_52_DetnRCS_176 : 247|15@0+ (0.01,-50) [-50|128] "dBsm"  ADCC_FM_4X
 SG_ FRM_52_DetnQuality_176 : 248|4@0+ (10,0) [0|100] "%"  ADCC_FM_4X
 SG_ FRM_52_DetnMotionSts_177 : 260|2@0+ (1,0) [0|3] ""  ADCC_FM_4X
 SG_ FRM_52_DetnRngRadial_177 : 258|15@0+ (0.01,0) [0|200] "m"  ADCC_FM_4X
 SG_ FRM_52_DetnAziAngle_177 : 275|11@0+ (0.1,-90) [-90|90] "deg"  ADCC_FM_4X
 SG_ FRM_52_DetnElevnAngle_177 : 280|8@0+ (0.1,-10) [-10|10] "deg"  ADCC_FM_4X
 SG_ FRM_52_DetnRelVelRadial_177 : 288|15@0+ (0.01,-100) [-100|80] "m/s"  ADCC_FM_4X
 SG_ FRM_52_DetnSNR_177 : 305|7@0+ (1,0) [0|100] "dB"  ADCC_FM_4X
 SG_ FRM_52_DetnRCS_177 : 314|15@0+ (0.01,-50) [-50|128] "dBsm"  ADCC_FM_4X
 SG_ FRM_52_DetnQuality_177 : 331|4@0+ (10,0) [0|100] "%"  ADCC_FM_4X
 SG_ FRM_52_DetnMotionSts_178 : 343|2@0+ (1,0) [0|3] ""  ADCC_FM_4X
 SG_ FRM_52_DetnRngRadial_178 : 341|15@0+ (0.01,0) [0|200] "m"  ADCC_FM_4X
 SG_ FRM_52_DetnAziAngle_178 : 358|11@0+ (0.1,-90) [-90|90] "deg"  ADCC_FM_4X
 SG_ FRM_52_DetnElevnAngle_178 : 363|8@0+ (0.1,-10) [-10|10] "deg"  ADCC_FM_4X
 SG_ FRM_52_DetnRelVelRadial_178 : 371|15@0+ (0.01,-100) [-100|80] "m/s"  ADCC_FM_4X
 SG_ FRM_52_DetnSNR_178 : 388|7@0+ (1,0) [0|100] "dB"  ADCC_FM_4X
 SG_ FRM_52_DetnRCS_178 : 397|15@0+ (0.01,-50) [-50|128] "dBsm"  ADCC_FM_4X
 SG_ FRM_52_DetnQuality_178 : 414|4@0+ (10,0) [0|100] "%"  ADCC_FM_4X
 SG_ FRM_52_DetnMotionSts_179 : 410|2@0+ (1,0) [0|3] ""  ADCC_FM_4X
 SG_ FRM_52_DetnRngRadial_179 : 408|15@0+ (0.01,0) [0|200] "m"  ADCC_FM_4X
 SG_ FRM_52_DetnAziAngle_179 : 425|11@0+ (0.1,-90) [-90|90] "deg"  ADCC_FM_4X
 SG_ FRM_52_DetnElevnAngle_179 : 446|8@0+ (0.1,-10) [-10|10] "deg"  ADCC_FM_4X
 SG_ FRM_52_DetnRelVelRadial_179 : 454|15@0+ (0.01,-100) [-100|80] "m/s"  ADCC_FM_4X
 SG_ FRM_52_DetnSNR_179 : 471|7@0+ (1,0) [0|100] "dB"  ADCC_FM_4X
 SG_ FRM_52_DetnRCS_179 : 464|15@0+ (0.01,-50) [-50|128] "dBsm"  ADCC_FM_4X
 SG_ FRM_52_DetnQuality_179 : 481|4@0+ (10,0) [0|100] "%"  ADCC_FM_4X
 SG_ FRM_52_Loc174_Valid : 488|1@0+ (1,0) [0|1] ""  ADCC_FM_4X
 SG_ FRM_52_Loc175_Valid : 489|1@0+ (1,0) [0|1] ""  ADCC_FM_4X
 SG_ FRM_52_Loc176_Valid : 490|1@0+ (1,0) [0|1] ""  ADCC_FM_4X
 SG_ FRM_52_Loc177_Valid : 491|1@0+ (1,0) [0|1] ""  ADCC_FM_4X
 SG_ FRM_52_Loc178_Valid : 492|1@0+ (1,0) [0|1] ""  ADCC_FM_4X
 SG_ FRM_52_Loc179_Valid : 493|1@0+ (1,0) [0|1] ""  ADCC_FM_4X

BO_ 1024 FRM_53: 64 Vector__XXX
 SG_ FRM_53_CRC : 7|16@0+ (1,0) [0|65535] ""  ADCC_FM_4X
 SG_ FRM_53_RollgCntr : 23|8@0+ (1,0) [0|255] ""  ADCC_FM_4X
 SG_ FRM_53_DetnBlockCounter : 27|4@0+ (1,0) [0|15] ""  ADCC_FM_4X
 SG_ FRM_53_DetnMotionSts_180 : 29|2@0+ (1,0) [0|3] ""  ADCC_FM_4X
 SG_ FRM_53_DetnRngRadial_180 : 39|15@0+ (0.01,0) [0|200] "m"  ADCC_FM_4X
 SG_ FRM_53_DetnAziAngle_180 : 40|11@0+ (0.1,-90) [-90|90] "deg"  ADCC_FM_4X
 SG_ FRM_53_DetnElevnAngle_180 : 61|8@0+ (0.1,-10) [-10|10] "deg"  ADCC_FM_4X
 SG_ FRM_53_DetnRelVelRadial_180 : 69|15@0+ (0.01,-100) [-100|80] "m/s"  ADCC_FM_4X
 SG_ FRM_53_DetnSNR_180 : 86|7@0+ (1,0) [0|100] "dB"  ADCC_FM_4X
 SG_ FRM_53_DetnRCS_180 : 95|15@0+ (0.01,-50) [-50|128] "dBsm"  ADCC_FM_4X
 SG_ FRM_53_DetnQuality_180 : 96|4@0+ (10,0) [0|100] "%"  ADCC_FM_4X
 SG_ FRM_53_DetnMotionSts_181 : 31|2@0+ (1,0) [0|3] ""  ADCC_FM_4X
 SG_ FRM_53_DetnRngRadial_181 : 108|15@0+ (0.01,0) [0|200] "m"  ADCC_FM_4X
 SG_ FRM_53_DetnAziAngle_181 : 125|11@0+ (0.1,-90) [-90|90] "deg"  ADCC_FM_4X
 SG_ FRM_53_DetnElevnAngle_181 : 130|8@0+ (0.1,-10) [-10|10] "deg"  ADCC_FM_4X
 SG_ FRM_53_DetnRelVelRadial_181 : 138|15@0+ (0.01,-100) [-100|80] "m/s"  ADCC_FM_4X
 SG_ FRM_53_DetnSNR_181 : 155|7@0+ (1,0) [0|100] "dB"  ADCC_FM_4X
 SG_ FRM_53_DetnRCS_181 : 164|15@0+ (0.01,-50) [-50|128] "dBsm"  ADCC_FM_4X
 SG_ FRM_53_DetnQuality_181 : 181|4@0+ (10,0) [0|100] "%"  ADCC_FM_4X
 SG_ FRM_53_DetnMotionSts_182 : 177|2@0+ (1,0) [0|3] ""  ADCC_FM_4X
 SG_ FRM_53_DetnRngRadial_182 : 191|15@0+ (0.01,0) [0|200] "m"  ADCC_FM_4X
 SG_ FRM_53_DetnAziAngle_182 : 192|11@0+ (0.1,-90) [-90|90] "deg"  ADCC_FM_4X
 SG_ FRM_53_DetnElevnAngle_182 : 213|8@0+ (0.1,-10) [-10|10] "deg"  ADCC_FM_4X
 SG_ FRM_53_DetnRelVelRadial_182 : 221|15@0+ (0.01,-100) [-100|80] "m/s"  ADCC_FM_4X
 SG_ FRM_53_DetnSNR_182 : 238|7@0+ (1,0) [0|100] "dB"  ADCC_FM_4X
 SG_ FRM_53_DetnRCS_182 : 247|15@0+ (0.01,-50) [-50|128] "dBsm"  ADCC_FM_4X
 SG_ FRM_53_DetnQuality_182 : 248|4@0+ (10,0) [0|100] "%"  ADCC_FM_4X
 SG_ FRM_53_DetnMotionSts_183 : 260|2@0+ (1,0) [0|3] ""  ADCC_FM_4X
 SG_ FRM_53_DetnRngRadial_183 : 258|15@0+ (0.01,0) [0|200] "m"  ADCC_FM_4X
 SG_ FRM_53_DetnAziAngle_183 : 275|11@0+ (0.1,-90) [-90|90] "deg"  ADCC_FM_4X
 SG_ FRM_53_DetnElevnAngle_183 : 280|8@0+ (0.1,-10) [-10|10] "deg"  ADCC_FM_4X
 SG_ FRM_53_DetnRelVelRadial_183 : 288|15@0+ (0.01,-100) [-100|80] "m/s"  ADCC_FM_4X
 SG_ FRM_53_DetnSNR_183 : 305|7@0+ (1,0) [0|100] "dB"  ADCC_FM_4X
 SG_ FRM_53_DetnRCS_183 : 314|15@0+ (0.01,-50) [-50|128] "dBsm"  ADCC_FM_4X
 SG_ FRM_53_DetnQuality_183 : 331|4@0+ (10,0) [0|100] "%"  ADCC_FM_4X
 SG_ FRM_53_DetnMotionSts_184 : 343|2@0+ (1,0) [0|3] ""  ADCC_FM_4X
 SG_ FRM_53_DetnRngRadial_184 : 341|15@0+ (0.01,0) [0|200] "m"  ADCC_FM_4X
 SG_ FRM_53_DetnAziAngle_184 : 358|11@0+ (0.1,-90) [-90|90] "deg"  ADCC_FM_4X
 SG_ FRM_53_DetnElevnAngle_184 : 363|8@0+ (0.1,-10) [-10|10] "deg"  ADCC_FM_4X
 SG_ FRM_53_DetnRelVelRadial_184 : 371|15@0+ (0.01,-100) [-100|80] "m/s"  ADCC_FM_4X
 SG_ FRM_53_DetnSNR_184 : 388|7@0+ (1,0) [0|100] "dB"  ADCC_FM_4X
 SG_ FRM_53_DetnRCS_184 : 397|15@0+ (0.01,-50) [-50|128] "dBsm"  ADCC_FM_4X
 SG_ FRM_53_DetnQuality_184 : 414|4@0+ (10,0) [0|100] "%"  ADCC_FM_4X
 SG_ FRM_53_DetnMotionSts_185 : 410|2@0+ (1,0) [0|3] ""  ADCC_FM_4X
 SG_ FRM_53_DetnRngRadial_185 : 408|15@0+ (0.01,0) [0|200] "m"  ADCC_FM_4X
 SG_ FRM_53_DetnAziAngle_185 : 425|11@0+ (0.1,-90) [-90|90] "deg"  ADCC_FM_4X
 SG_ FRM_53_DetnElevnAngle_185 : 446|8@0+ (0.1,-10) [-10|10] "deg"  ADCC_FM_4X
 SG_ FRM_53_DetnRelVelRadial_185 : 454|15@0+ (0.01,-100) [-100|80] "m/s"  ADCC_FM_4X
 SG_ FRM_53_DetnSNR_185 : 471|7@0+ (1,0) [0|100] "dB"  ADCC_FM_4X
 SG_ FRM_53_DetnRCS_185 : 464|15@0+ (0.01,-50) [-50|128] "dBsm"  ADCC_FM_4X
 SG_ FRM_53_DetnQuality_185 : 481|4@0+ (10,0) [0|100] "%"  ADCC_FM_4X
 SG_ FRM_53_Loc180_Valid : 488|1@0+ (1,0) [0|1] ""  ADCC_FM_4X
 SG_ FRM_53_Loc181_Valid : 489|1@0+ (1,0) [0|1] ""  ADCC_FM_4X
 SG_ FRM_53_Loc182_Valid : 490|1@0+ (1,0) [0|1] ""  ADCC_FM_4X
 SG_ FRM_53_Loc183_Valid : 491|1@0+ (1,0) [0|1] ""  ADCC_FM_4X
 SG_ FRM_53_Loc184_Valid : 492|1@0+ (1,0) [0|1] ""  ADCC_FM_4X
 SG_ FRM_53_Loc185_Valid : 493|1@0+ (1,0) [0|1] ""  ADCC_FM_4X

BO_ 1025 FRM_54: 64 Vector__XXX
 SG_ FRM_54_CRC : 7|16@0+ (1,0) [0|65535] ""  ADCC_FM_4X
 SG_ FRM_54_RollgCntr : 23|8@0+ (1,0) [0|255] ""  ADCC_FM_4X
 SG_ FRM_54_DetnBlockCounter : 27|4@0+ (1,0) [0|15] ""  ADCC_FM_4X
 SG_ FRM_54_DetnMotionSts_186 : 29|2@0+ (1,0) [0|3] ""  ADCC_FM_4X
 SG_ FRM_54_DetnRngRadial_186 : 39|15@0+ (0.01,0) [0|200] "m"  ADCC_FM_4X
 SG_ FRM_54_DetnAziAngle_186 : 40|11@0+ (0.1,-90) [-90|90] "deg"  ADCC_FM_4X
 SG_ FRM_54_DetnElevnAngle_186 : 61|8@0+ (0.1,-10) [-10|10] "deg"  ADCC_FM_4X
 SG_ FRM_54_DetnRelVelRadial_186 : 69|15@0+ (0.01,-100) [-100|80] "m/s"  ADCC_FM_4X
 SG_ FRM_54_DetnSNR_186 : 86|7@0+ (1,0) [0|100] "dB"  ADCC_FM_4X
 SG_ FRM_54_DetnRCS_186 : 95|15@0+ (0.01,-50) [-50|128] "dBsm"  ADCC_FM_4X
 SG_ FRM_54_DetnQuality_186 : 96|4@0+ (10,0) [0|100] "%"  ADCC_FM_4X
 SG_ FRM_54_DetnMotionSts_187 : 31|2@0+ (1,0) [0|3] ""  ADCC_FM_4X
 SG_ FRM_54_DetnRngRadial_187 : 108|15@0+ (0.01,0) [0|200] "m"  ADCC_FM_4X
 SG_ FRM_54_DetnAziAngle_187 : 125|11@0+ (0.1,-90) [-90|90] "deg"  ADCC_FM_4X
 SG_ FRM_54_DetnElevnAngle_187 : 130|8@0+ (0.1,-10) [-10|10] "deg"  ADCC_FM_4X
 SG_ FRM_54_DetnRelVelRadial_187 : 138|15@0+ (0.01,-100) [-100|80] "m/s"  ADCC_FM_4X
 SG_ FRM_54_DetnSNR_187 : 155|7@0+ (1,0) [0|100] "dB"  ADCC_FM_4X
 SG_ FRM_54_DetnRCS_187 : 164|15@0+ (0.01,-50) [-50|128] "dBsm"  ADCC_FM_4X
 SG_ FRM_54_DetnQuality_187 : 181|4@0+ (10,0) [0|100] "%"  ADCC_FM_4X
 SG_ FRM_54_DetnMotionSts_188 : 177|2@0+ (1,0) [0|3] ""  ADCC_FM_4X
 SG_ FRM_54_DetnRngRadial_188 : 191|15@0+ (0.01,0) [0|200] "m"  ADCC_FM_4X
 SG_ FRM_54_DetnAziAngle_188 : 192|11@0+ (0.1,-90) [-90|90] "deg"  ADCC_FM_4X
 SG_ FRM_54_DetnElevnAngle_188 : 213|8@0+ (0.1,-10) [-10|10] "deg"  ADCC_FM_4X
 SG_ FRM_54_DetnRelVelRadial_188 : 221|15@0+ (0.01,-100) [-100|80] "m/s"  ADCC_FM_4X
 SG_ FRM_54_DetnSNR_188 : 238|7@0+ (1,0) [0|100] "dB"  ADCC_FM_4X
 SG_ FRM_54_DetnRCS_188 : 247|15@0+ (0.01,-50) [-50|128] "dBsm"  ADCC_FM_4X
 SG_ FRM_54_DetnQuality_188 : 248|4@0+ (10,0) [0|100] "%"  ADCC_FM_4X
 SG_ FRM_54_DetnMotionSts_189 : 260|2@0+ (1,0) [0|3] ""  ADCC_FM_4X
 SG_ FRM_54_DetnRngRadial_189 : 258|15@0+ (0.01,0) [0|200] "m"  ADCC_FM_4X
 SG_ FRM_54_DetnAziAngle_189 : 275|11@0+ (0.1,-90) [-90|90] "deg"  ADCC_FM_4X
 SG_ FRM_54_DetnElevnAngle_189 : 280|8@0+ (0.1,-10) [-10|10] "deg"  ADCC_FM_4X
 SG_ FRM_54_DetnRelVelRadial_189 : 288|15@0+ (0.01,-100) [-100|80] "m/s"  ADCC_FM_4X
 SG_ FRM_54_DetnSNR_189 : 305|7@0+ (1,0) [0|100] "dB"  ADCC_FM_4X
 SG_ FRM_54_DetnRCS_189 : 314|15@0+ (0.01,-50) [-50|128] "dBsm"  ADCC_FM_4X
 SG_ FRM_54_DetnQuality_189 : 331|4@0+ (10,0) [0|100] "%"  ADCC_FM_4X
 SG_ FRM_54_DetnMotionSts_190 : 343|2@0+ (1,0) [0|3] ""  ADCC_FM_4X
 SG_ FRM_54_DetnRngRadial_190 : 341|15@0+ (0.01,0) [0|200] "m"  ADCC_FM_4X
 SG_ FRM_54_DetnAziAngle_190 : 358|11@0+ (0.1,-90) [-90|90] "deg"  ADCC_FM_4X
 SG_ FRM_54_DetnElevnAngle_190 : 363|8@0+ (0.1,-10) [-10|10] "deg"  ADCC_FM_4X
 SG_ FRM_54_DetnRelVelRadial_190 : 371|15@0+ (0.01,-100) [-100|80] "m/s"  ADCC_FM_4X
 SG_ FRM_54_DetnSNR_190 : 388|7@0+ (1,0) [0|100] "dB"  ADCC_FM_4X
 SG_ FRM_54_DetnRCS_190 : 397|15@0+ (0.01,-50) [-50|128] "dBsm"  ADCC_FM_4X
 SG_ FRM_54_DetnQuality_190 : 414|4@0+ (10,0) [0|100] "%"  ADCC_FM_4X
 SG_ FRM_54_DetnMotionSts_191 : 410|2@0+ (1,0) [0|3] ""  ADCC_FM_4X
 SG_ FRM_54_DetnRngRadial_191 : 408|15@0+ (0.01,0) [0|200] "m"  ADCC_FM_4X
 SG_ FRM_54_DetnAziAngle_191 : 425|11@0+ (0.1,-90) [-90|90] "deg"  ADCC_FM_4X
 SG_ FRM_54_DetnElevnAngle_191 : 446|8@0+ (0.1,-10) [-10|10] "deg"  ADCC_FM_4X
 SG_ FRM_54_DetnRelVelRadial_191 : 454|15@0+ (0.01,-100) [-100|80] "m/s"  ADCC_FM_4X
 SG_ FRM_54_DetnSNR_191 : 471|7@0+ (1,0) [0|100] "dB"  ADCC_FM_4X
 SG_ FRM_54_DetnRCS_191 : 464|15@0+ (0.01,-50) [-50|128] "dBsm"  ADCC_FM_4X
 SG_ FRM_54_DetnQuality_191 : 481|4@0+ (10,0) [0|100] "%"  ADCC_FM_4X
 SG_ FRM_54_Loc186_Valid : 488|1@0+ (1,0) [0|1] ""  ADCC_FM_4X
 SG_ FRM_54_Loc187_Valid : 489|1@0+ (1,0) [0|1] ""  ADCC_FM_4X
 SG_ FRM_54_Loc188_Valid : 490|1@0+ (1,0) [0|1] ""  ADCC_FM_4X
 SG_ FRM_54_Loc189_Valid : 491|1@0+ (1,0) [0|1] ""  ADCC_FM_4X
 SG_ FRM_54_Loc190_Valid : 492|1@0+ (1,0) [0|1] ""  ADCC_FM_4X
 SG_ FRM_54_Loc191_Valid : 493|1@0+ (1,0) [0|1] ""  ADCC_FM_4X

BO_ 1026 FRM_55: 64 Vector__XXX
 SG_ FRM_55_CRC : 7|16@0+ (1,0) [0|65535] ""  ADCC_FM_4X
 SG_ FRM_55_RollgCntr : 23|8@0+ (1,0) [0|255] ""  ADCC_FM_4X
 SG_ FRM_55_DetnBlockCounter : 27|4@0+ (1,0) [0|15] ""  ADCC_FM_4X
 SG_ FRM_55_DetnMotionSts_192 : 29|2@0+ (1,0) [0|3] ""  ADCC_FM_4X
 SG_ FRM_55_DetnRngRadial_192 : 39|15@0+ (0.01,0) [0|200] "m"  ADCC_FM_4X
 SG_ FRM_55_DetnAziAngle_192 : 40|11@0+ (0.1,-90) [-90|90] "deg"  ADCC_FM_4X
 SG_ FRM_55_DetnElevnAngle_192 : 61|8@0+ (0.1,-10) [-10|10] "deg"  ADCC_FM_4X
 SG_ FRM_55_DetnRelVelRadial_192 : 69|15@0+ (0.01,-100) [-100|80] "m/s"  ADCC_FM_4X
 SG_ FRM_55_DetnSNR_192 : 86|7@0+ (1,0) [0|100] "dB"  ADCC_FM_4X
 SG_ FRM_55_DetnRCS_192 : 95|15@0+ (0.01,-50) [-50|128] "dBsm"  ADCC_FM_4X
 SG_ FRM_55_DetnQuality_192 : 96|4@0+ (10,0) [0|100] "%"  ADCC_FM_4X
 SG_ FRM_55_DetnMotionSts_193 : 31|2@0+ (1,0) [0|3] ""  ADCC_FM_4X
 SG_ FRM_55_DetnRngRadial_193 : 108|15@0+ (0.01,0) [0|200] "m"  ADCC_FM_4X
 SG_ FRM_55_DetnAziAngle_193 : 125|11@0+ (0.1,-90) [-90|90] "deg"  ADCC_FM_4X
 SG_ FRM_55_DetnElevnAngle_193 : 130|8@0+ (0.1,-10) [-10|10] "deg"  ADCC_FM_4X
 SG_ FRM_55_DetnRelVelRadial_193 : 138|15@0+ (0.01,-100) [-100|80] "m/s"  ADCC_FM_4X
 SG_ FRM_55_DetnSNR_193 : 155|7@0+ (1,0) [0|100] "dB"  ADCC_FM_4X
 SG_ FRM_55_DetnRCS_193 : 164|15@0+ (0.01,-50) [-50|128] "dBsm"  ADCC_FM_4X
 SG_ FRM_55_DetnQuality_193 : 181|4@0+ (10,0) [0|100] "%"  ADCC_FM_4X
 SG_ FRM_55_DetnMotionSts_194 : 177|2@0+ (1,0) [0|3] ""  ADCC_FM_4X
 SG_ FRM_55_DetnRngRadial_194 : 191|15@0+ (0.01,0) [0|200] "m"  ADCC_FM_4X
 SG_ FRM_55_DetnAziAngle_194 : 192|11@0+ (0.1,-90) [-90|90] "deg"  ADCC_FM_4X
 SG_ FRM_55_DetnElevnAngle_194 : 213|8@0+ (0.1,-10) [-10|10] "deg"  ADCC_FM_4X
 SG_ FRM_55_DetnRelVelRadial_194 : 221|15@0+ (0.01,-100) [-100|80] "m/s"  ADCC_FM_4X
 SG_ FRM_55_DetnSNR_194 : 238|7@0+ (1,0) [0|100] "dB"  ADCC_FM_4X
 SG_ FRM_55_DetnRCS_194 : 247|15@0+ (0.01,-50) [-50|128] "dBsm"  ADCC_FM_4X
 SG_ FRM_55_DetnQuality_194 : 248|4@0+ (10,0) [0|100] "%"  ADCC_FM_4X
 SG_ FRM_55_DetnMotionSts_195 : 260|2@0+ (1,0) [0|3] ""  ADCC_FM_4X
 SG_ FRM_55_DetnRngRadial_195 : 258|15@0+ (0.01,0) [0|200] "m"  ADCC_FM_4X
 SG_ FRM_55_DetnAziAngle_195 : 275|11@0+ (0.1,-90) [-90|90] "deg"  ADCC_FM_4X
 SG_ FRM_55_DetnElevnAngle_195 : 280|8@0+ (0.1,-10) [-10|10] "deg"  ADCC_FM_4X
 SG_ FRM_55_DetnRelVelRadial_195 : 288|15@0+ (0.01,-100) [-100|80] "m/s"  ADCC_FM_4X
 SG_ FRM_55_DetnSNR_195 : 305|7@0+ (1,0) [0|100] "dB"  ADCC_FM_4X
 SG_ FRM_55_DetnRCS_195 : 314|15@0+ (0.01,-50) [-50|128] "dBsm"  ADCC_FM_4X
 SG_ FRM_55_DetnQuality_195 : 331|4@0+ (10,0) [0|100] "%"  ADCC_FM_4X
 SG_ FRM_55_DetnMotionSts_196 : 343|2@0+ (1,0) [0|3] ""  ADCC_FM_4X
 SG_ FRM_55_DetnRngRadial_196 : 341|15@0+ (0.01,0) [0|200] "m"  ADCC_FM_4X
 SG_ FRM_55_DetnAziAngle_196 : 358|11@0+ (0.1,-90) [-90|90] "deg"  ADCC_FM_4X
 SG_ FRM_55_DetnElevnAngle_196 : 363|8@0+ (0.1,-10) [-10|10] "deg"  ADCC_FM_4X
 SG_ FRM_55_DetnRelVelRadial_196 : 371|15@0+ (0.01,-100) [-100|80] "m/s"  ADCC_FM_4X
 SG_ FRM_55_DetnSNR_196 : 388|7@0+ (1,0) [0|100] "dB"  ADCC_FM_4X
 SG_ FRM_55_DetnRCS_196 : 397|15@0+ (0.01,-50) [-50|128] "dBsm"  ADCC_FM_4X
 SG_ FRM_55_DetnQuality_196 : 414|4@0+ (10,0) [0|100] "%"  ADCC_FM_4X
 SG_ FRM_55_DetnMotionSts_197 : 410|2@0+ (1,0) [0|3] ""  ADCC_FM_4X
 SG_ FRM_55_DetnRngRadial_197 : 408|15@0+ (0.01,0) [0|200] "m"  ADCC_FM_4X
 SG_ FRM_55_DetnAziAngle_197 : 425|11@0+ (0.1,-90) [-90|90] "deg"  ADCC_FM_4X
 SG_ FRM_55_DetnElevnAngle_197 : 446|8@0+ (0.1,-10) [-10|10] "deg"  ADCC_FM_4X
 SG_ FRM_55_DetnRelVelRadial_197 : 454|15@0+ (0.01,-100) [-100|80] "m/s"  ADCC_FM_4X
 SG_ FRM_55_DetnSNR_197 : 471|7@0+ (1,0) [0|100] "dB"  ADCC_FM_4X
 SG_ FRM_55_DetnRCS_197 : 464|15@0+ (0.01,-50) [-50|128] "dBsm"  ADCC_FM_4X
 SG_ FRM_55_DetnQuality_197 : 481|4@0+ (10,0) [0|100] "%"  ADCC_FM_4X
 SG_ FRM_55_Loc192_Valid : 488|1@0+ (1,0) [0|1] ""  ADCC_FM_4X
 SG_ FRM_55_Loc193_Valid : 489|1@0+ (1,0) [0|1] ""  ADCC_FM_4X
 SG_ FRM_55_Loc194_Valid : 490|1@0+ (1,0) [0|1] ""  ADCC_FM_4X
 SG_ FRM_55_Loc195_Valid : 491|1@0+ (1,0) [0|1] ""  ADCC_FM_4X
 SG_ FRM_55_Loc196_Valid : 492|1@0+ (1,0) [0|1] ""  ADCC_FM_4X
 SG_ FRM_55_Loc197_Valid : 493|1@0+ (1,0) [0|1] ""  ADCC_FM_4X

CM_ BO_ 1016 "禾多配置不发此帧报文";
CM_ BO_ 1017 "禾多配置不发此帧报文";
CM_ BO_ 1018 "禾多配置不发此帧报文";
CM_ BO_ 1019 "禾多配置不发此帧报文";
CM_ BO_ 1020 "禾多配置不发此帧报文";
CM_ BO_ 1021 "禾多配置不发此帧报文";
CM_ BO_ 1022 "禾多配置不发此帧报文";
CM_ BO_ 1023 "禾多配置不发此帧报文";
CM_ BO_ 1024 "禾多配置不发此帧报文";
CM_ BO_ 1025 "禾多配置不发此帧报文";
CM_ BO_ 1026 "禾多配置不发此帧报文";
CM_ SG_ 1016 FRM_45_CRC "Profile5:E2E CRC16 (polynomial:0x1021)       
DataID:Use CANID,other bits Fill with 0";
CM_ SG_ 1016 FRM_45_RollgCntr "Profile5:E2E Rolling message counter";
CM_ SG_ 1016 FRM_45_DetnBlockCounter "Front Radar Moudle_X_Detection Block Counter
前雷达探测点块计数";
CM_ SG_ 1016 FRM_45_DetnMotionSts_132 "Detection point motion status
Front Radar Moudle_X_Detection Motion Status
前雷达探测点运动状态";
CM_ SG_ 1016 FRM_45_DetnRngRadial_132 "Detection point radial distance
Front Radar Moudle_X_Detection Range Radial
前雷达探测点径向距离";
CM_ SG_ 1016 FRM_45_DetnAziAngle_132 "Detection point azimuth angle
Front Radar Moudle_X_Detection Azimuth Angle
前雷达探测点水平方位角";
CM_ SG_ 1016 FRM_45_DetnElevnAngle_132 "Detection point elevation angle
Front Radar Moudle_X_Detection Elevation Angle
前雷达探测点俯仰角";
CM_ SG_ 1016 FRM_45_DetnRelVelRadial_132 "Detection point radial relative velocity
Front Radar Moudle_X_Detection Relative Velocity Radial 
前雷达探测点在径向上的相对速度";
CM_ SG_ 1016 FRM_45_DetnSNR_132 "Detection point signal noise ratio
Front Radar Moudle_X_Detection Signal Noise Ratio
前雷达探测点信号噪声比";
CM_ SG_ 1016 FRM_45_DetnRCS_132 "Detection point radar cross section
Front Radar Moudle_X_Detection Radar Cross Section
前雷达探测点雷达散射截面积";
CM_ SG_ 1016 FRM_45_DetnQuality_132 "Detection point quality
Front Radar Moudle_X_Detection Quality
前雷达探测点质量";
CM_ SG_ 1016 FRM_45_DetnMotionSts_133 "Detection point motion status
Front Radar Moudle_X_Detection Motion Status
前雷达探测点运动状态";
CM_ SG_ 1016 FRM_45_DetnRngRadial_133 "Detection point radial distance
Front Radar Moudle_X_Detection Range Radial
前雷达探测点径向距离";
CM_ SG_ 1016 FRM_45_DetnAziAngle_133 "Detection point azimuth angle
Front Radar Moudle_X_Detection Azimuth Angle
前雷达探测点水平方位角";
CM_ SG_ 1016 FRM_45_DetnElevnAngle_133 "Detection point elevation angle
Front Radar Moudle_X_Detection Elevation Angle
前雷达探测点俯仰角";
CM_ SG_ 1016 FRM_45_DetnRelVelRadial_133 "Detection point radial relative velocity
Front Radar Moudle_X_Detection Relative Velocity Radial 
前雷达探测点在径向上的相对速度";
CM_ SG_ 1016 FRM_45_DetnSNR_133 "Detection point signal noise ratio
Front Radar Moudle_X_Detection Signal Noise Ratio
前雷达探测点信号噪声比";
CM_ SG_ 1016 FRM_45_DetnRCS_133 "Detection point radar cross section
Front Radar Moudle_X_Detection Radar Cross Section
前雷达探测点雷达散射截面积";
CM_ SG_ 1016 FRM_45_DetnQuality_133 "Detection point quality
Front Radar Moudle_X_Detection Quality
前雷达探测点质量";
CM_ SG_ 1016 FRM_45_DetnMotionSts_134 "Detection point motion status
Front Radar Moudle_X_Detection Motion Status
前雷达探测点运动状态";
CM_ SG_ 1016 FRM_45_DetnRngRadial_134 "Detection point radial distance
Front Radar Moudle_X_Detection Range Radial
前雷达探测点径向距离";
CM_ SG_ 1016 FRM_45_DetnAziAngle_134 "Detection point azimuth angle
Front Radar Moudle_X_Detection Azimuth Angle
前雷达探测点水平方位角";
CM_ SG_ 1016 FRM_45_DetnElevnAngle_134 "Detection point elevation angle
Front Radar Moudle_X_Detection Elevation Angle
前雷达探测点俯仰角";
CM_ SG_ 1016 FRM_45_DetnRelVelRadial_134 "Detection point radial relative velocity
Front Radar Moudle_X_Detection Relative Velocity Radial 
前雷达探测点在径向上的相对速度";
CM_ SG_ 1016 FRM_45_DetnSNR_134 "Detection point signal noise ratio
Front Radar Moudle_X_Detection Signal Noise Ratio
前雷达探测点信号噪声比";
CM_ SG_ 1016 FRM_45_DetnRCS_134 "Detection point radar cross section
Front Radar Moudle_X_Detection Radar Cross Section
前雷达探测点雷达散射截面积";
CM_ SG_ 1016 FRM_45_DetnQuality_134 "Detection point quality
Front Radar Moudle_X_Detection Quality
前雷达探测点质量";
CM_ SG_ 1016 FRM_45_DetnMotionSts_135 "Detection point motion status
Front Radar Moudle_X_Detection Motion Status
前雷达探测点运动状态";
CM_ SG_ 1016 FRM_45_DetnRngRadial_135 "Detection point radial distance
Front Radar Moudle_X_Detection Range Radial
前雷达探测点径向距离";
CM_ SG_ 1016 FRM_45_DetnAziAngle_135 "Detection point azimuth angle
Front Radar Moudle_X_Detection Azimuth Angle
前雷达探测点水平方位角";
CM_ SG_ 1016 FRM_45_DetnElevnAngle_135 "Detection point elevation angle
Front Radar Moudle_X_Detection Elevation Angle
前雷达探测点俯仰角";
CM_ SG_ 1016 FRM_45_DetnRelVelRadial_135 "Detection point radial relative velocity
Front Radar Moudle_X_Detection Relative Velocity Radial 
前雷达探测点在径向上的相对速度";
CM_ SG_ 1016 FRM_45_DetnSNR_135 "Detection point signal noise ratio
Front Radar Moudle_X_Detection Signal Noise Ratio
前雷达探测点信号噪声比";
CM_ SG_ 1016 FRM_45_DetnRCS_135 "Detection point radar cross section
Front Radar Moudle_X_Detection Radar Cross Section
前雷达探测点雷达散射截面积";
CM_ SG_ 1016 FRM_45_DetnQuality_135 "Detection point quality
Front Radar Moudle_X_Detection Quality
前雷达探测点质量";
CM_ SG_ 1016 FRM_45_DetnMotionSts_136 "Detection point motion status
Front Radar Moudle_X_Detection Motion Status
前雷达探测点运动状态";
CM_ SG_ 1016 FRM_45_DetnRngRadial_136 "Detection point radial distance
Front Radar Moudle_X_Detection Range Radial
前雷达探测点径向距离";
CM_ SG_ 1016 FRM_45_DetnAziAngle_136 "Detection point azimuth angle
Front Radar Moudle_X_Detection Azimuth Angle
前雷达探测点水平方位角";
CM_ SG_ 1016 FRM_45_DetnElevnAngle_136 "Detection point elevation angle
Front Radar Moudle_X_Detection Elevation Angle
前雷达探测点俯仰角";
CM_ SG_ 1016 FRM_45_DetnRelVelRadial_136 "Detection point radial relative velocity
Front Radar Moudle_X_Detection Relative Velocity Radial 
前雷达探测点在径向上的相对速度";
CM_ SG_ 1016 FRM_45_DetnSNR_136 "Detection point signal noise ratio
Front Radar Moudle_X_Detection Signal Noise Ratio
前雷达探测点信号噪声比";
CM_ SG_ 1016 FRM_45_DetnRCS_136 "Detection point radar cross section
Front Radar Moudle_X_Detection Radar Cross Section
前雷达探测点雷达散射截面积";
CM_ SG_ 1016 FRM_45_DetnQuality_136 "Detection point quality
Front Radar Moudle_X_Detection Quality
前雷达探测点质量";
CM_ SG_ 1016 FRM_45_DetnMotionSts_137 "Detection point motion status
Front Radar Moudle_X_Detection Motion Status
前雷达探测点运动状态";
CM_ SG_ 1016 FRM_45_DetnRngRadial_137 "Detection point radial distance
Front Radar Moudle_X_Detection Range Radial
前雷达探测点径向距离";
CM_ SG_ 1016 FRM_45_DetnAziAngle_137 "Detection point azimuth angle
Front Radar Moudle_X_Detection Azimuth Angle
前雷达探测点水平方位角";
CM_ SG_ 1016 FRM_45_DetnElevnAngle_137 "Detection point elevation angle
Front Radar Moudle_X_Detection Elevation Angle
前雷达探测点俯仰角";
CM_ SG_ 1016 FRM_45_DetnRelVelRadial_137 "Detection point radial relative velocity
Front Radar Moudle_X_Detection Relative Velocity Radial 
前雷达探测点在径向上的相对速度";
CM_ SG_ 1016 FRM_45_DetnSNR_137 "Detection point signal noise ratio
Front Radar Moudle_X_Detection Signal Noise Ratio
前雷达探测点信号噪声比";
CM_ SG_ 1016 FRM_45_DetnRCS_137 "Detection point radar cross section
Front Radar Moudle_X_Detection Radar Cross Section
前雷达探测点雷达散射截面积";
CM_ SG_ 1016 FRM_45_DetnQuality_137 "Detection point quality
Front Radar Moudle_X_Detection Quality
前雷达探测点质量";
CM_ SG_ 1016 FRM_45_Loc132_Valid "the valid flag of each location 
每一点云的有效状态";
CM_ SG_ 1016 FRM_45_Loc133_Valid "the valid flag of each location 
每一点云的有效状态";
CM_ SG_ 1016 FRM_45_Loc134_Valid "the valid flag of each location 
每一点云的有效状态";
CM_ SG_ 1016 FRM_45_Loc135_Valid "the valid flag of each location 
每一点云的有效状态";
CM_ SG_ 1016 FRM_45_Loc136_Valid "the valid flag of each location 
每一点云的有效状态";
CM_ SG_ 1016 FRM_45_Loc137_Valid "the valid flag of each location 
每一点云的有效状态";
CM_ SG_ 1017 FRM_46_CRC "Profile5:E2E CRC16 (polynomial:0x1021)       
DataID:Use CANID,other bits Fill with 0";
CM_ SG_ 1017 FRM_46_RollgCntr "Profile5:E2E Rolling message counter";
CM_ SG_ 1017 FRM_46_DetnBlockCounter "Front Radar Moudle_X_Detection Block Counter
前雷达探测点块计数";
CM_ SG_ 1017 FRM_46_DetnMotionSts_138 "Detection point motion status
Front Radar Moudle_X_Detection Motion Status
前雷达探测点运动状态";
CM_ SG_ 1017 FRM_46_DetnRngRadial_138 "Detection point radial distance
Front Radar Moudle_X_Detection Range Radial
前雷达探测点径向距离";
CM_ SG_ 1017 FRM_46_DetnAziAngle_138 "Detection point azimuth angle
Front Radar Moudle_X_Detection Azimuth Angle
前雷达探测点水平方位角";
CM_ SG_ 1017 FRM_46_DetnElevnAngle_138 "Detection point elevation angle
Front Radar Moudle_X_Detection Elevation Angle
前雷达探测点俯仰角";
CM_ SG_ 1017 FRM_46_DetnRelVelRadial_138 "Detection point radial relative velocity
Front Radar Moudle_X_Detection Relative Velocity Radial 
前雷达探测点在径向上的相对速度";
CM_ SG_ 1017 FRM_46_DetnSNR_138 "Detection point signal noise ratio
Front Radar Moudle_X_Detection Signal Noise Ratio
前雷达探测点信号噪声比";
CM_ SG_ 1017 FRM_46_DetnRCS_138 "Detection point radar cross section
Front Radar Moudle_X_Detection Radar Cross Section
前雷达探测点雷达散射截面积";
CM_ SG_ 1017 FRM_46_DetnQuality_138 "Detection point quality
Front Radar Moudle_X_Detection Quality
前雷达探测点质量";
CM_ SG_ 1017 FRM_46_DetnMotionSts_139 "Detection point motion status
Front Radar Moudle_X_Detection Motion Status
前雷达探测点运动状态";
CM_ SG_ 1017 FRM_46_DetnRngRadial_139 "Detection point radial distance
Front Radar Moudle_X_Detection Range Radial
前雷达探测点径向距离";
CM_ SG_ 1017 FRM_46_DetnAziAngle_139 "Detection point azimuth angle
Front Radar Moudle_X_Detection Azimuth Angle
前雷达探测点水平方位角";
CM_ SG_ 1017 FRM_46_DetnElevnAngle_139 "Detection point elevation angle
Front Radar Moudle_X_Detection Elevation Angle
前雷达探测点俯仰角";
CM_ SG_ 1017 FRM_46_DetnRelVelRadial_139 "Detection point radial relative velocity
Front Radar Moudle_X_Detection Relative Velocity Radial 
前雷达探测点在径向上的相对速度";
CM_ SG_ 1017 FRM_46_DetnSNR_139 "Detection point signal noise ratio
Front Radar Moudle_X_Detection Signal Noise Ratio
前雷达探测点信号噪声比";
CM_ SG_ 1017 FRM_46_DetnRCS_139 "Detection point radar cross section
Front Radar Moudle_X_Detection Radar Cross Section
前雷达探测点雷达散射截面积";
CM_ SG_ 1017 FRM_46_DetnQuality_139 "Detection point quality
Front Radar Moudle_X_Detection Quality
前雷达探测点质量";
CM_ SG_ 1017 FRM_46_DetnMotionSts_140 "Detection point motion status
Front Radar Moudle_X_Detection Motion Status
前雷达探测点运动状态";
CM_ SG_ 1017 FRM_46_DetnRngRadial_140 "Detection point radial distance
Front Radar Moudle_X_Detection Range Radial
前雷达探测点径向距离";
CM_ SG_ 1017 FRM_46_DetnAziAngle_140 "Detection point azimuth angle
Front Radar Moudle_X_Detection Azimuth Angle
前雷达探测点水平方位角";
CM_ SG_ 1017 FRM_46_DetnElevnAngle_140 "Detection point elevation angle
Front Radar Moudle_X_Detection Elevation Angle
前雷达探测点俯仰角";
CM_ SG_ 1017 FRM_46_DetnRelVelRadial_140 "Detection point radial relative velocity
Front Radar Moudle_X_Detection Relative Velocity Radial 
前雷达探测点在径向上的相对速度";
CM_ SG_ 1017 FRM_46_DetnSNR_140 "Detection point signal noise ratio
Front Radar Moudle_X_Detection Signal Noise Ratio
前雷达探测点信号噪声比";
CM_ SG_ 1017 FRM_46_DetnRCS_140 "Detection point radar cross section
Front Radar Moudle_X_Detection Radar Cross Section
前雷达探测点雷达散射截面积";
CM_ SG_ 1017 FRM_46_DetnQuality_140 "Detection point quality
Front Radar Moudle_X_Detection Quality
前雷达探测点质量";
CM_ SG_ 1017 FRM_46_DetnMotionSts_141 "Detection point motion status
Front Radar Moudle_X_Detection Motion Status
前雷达探测点运动状态";
CM_ SG_ 1017 FRM_46_DetnRngRadial_141 "Detection point radial distance
Front Radar Moudle_X_Detection Range Radial
前雷达探测点径向距离";
CM_ SG_ 1017 FRM_46_DetnAziAngle_141 "Detection point azimuth angle
Front Radar Moudle_X_Detection Azimuth Angle
前雷达探测点水平方位角";
CM_ SG_ 1017 FRM_46_DetnElevnAngle_141 "Detection point elevation angle
Front Radar Moudle_X_Detection Elevation Angle
前雷达探测点俯仰角";
CM_ SG_ 1017 FRM_46_DetnRelVelRadial_141 "Detection point radial relative velocity
Front Radar Moudle_X_Detection Relative Velocity Radial 
前雷达探测点在径向上的相对速度";
CM_ SG_ 1017 FRM_46_DetnSNR_141 "Detection point signal noise ratio
Front Radar Moudle_X_Detection Signal Noise Ratio
前雷达探测点信号噪声比";
CM_ SG_ 1017 FRM_46_DetnRCS_141 "Detection point radar cross section
Front Radar Moudle_X_Detection Radar Cross Section
前雷达探测点雷达散射截面积";
CM_ SG_ 1017 FRM_46_DetnQuality_141 "Detection point quality
Front Radar Moudle_X_Detection Quality
前雷达探测点质量";
CM_ SG_ 1017 FRM_46_DetnMotionSts_142 "Detection point motion status
Front Radar Moudle_X_Detection Motion Status
前雷达探测点运动状态";
CM_ SG_ 1017 FRM_46_DetnRngRadial_142 "Detection point radial distance
Front Radar Moudle_X_Detection Range Radial
前雷达探测点径向距离";
CM_ SG_ 1017 FRM_46_DetnAziAngle_142 "Detection point azimuth angle
Front Radar Moudle_X_Detection Azimuth Angle
前雷达探测点水平方位角";
CM_ SG_ 1017 FRM_46_DetnElevnAngle_142 "Detection point elevation angle
Front Radar Moudle_X_Detection Elevation Angle
前雷达探测点俯仰角";
CM_ SG_ 1017 FRM_46_DetnRelVelRadial_142 "Detection point radial relative velocity
Front Radar Moudle_X_Detection Relative Velocity Radial 
前雷达探测点在径向上的相对速度";
CM_ SG_ 1017 FRM_46_DetnSNR_142 "Detection point signal noise ratio
Front Radar Moudle_X_Detection Signal Noise Ratio
前雷达探测点信号噪声比";
CM_ SG_ 1017 FRM_46_DetnRCS_142 "Detection point radar cross section
Front Radar Moudle_X_Detection Radar Cross Section
前雷达探测点雷达散射截面积";
CM_ SG_ 1017 FRM_46_DetnQuality_142 "Detection point quality
Front Radar Moudle_X_Detection Quality
前雷达探测点质量";
CM_ SG_ 1017 FRM_46_DetnMotionSts_143 "Detection point motion status
Front Radar Moudle_X_Detection Motion Status
前雷达探测点运动状态";
CM_ SG_ 1017 FRM_46_DetnRngRadial_143 "Detection point radial distance
Front Radar Moudle_X_Detection Range Radial
前雷达探测点径向距离";
CM_ SG_ 1017 FRM_46_DetnAziAngle_143 "Detection point azimuth angle
Front Radar Moudle_X_Detection Azimuth Angle
前雷达探测点水平方位角";
CM_ SG_ 1017 FRM_46_DetnElevnAngle_143 "Detection point elevation angle
Front Radar Moudle_X_Detection Elevation Angle
前雷达探测点俯仰角";
CM_ SG_ 1017 FRM_46_DetnRelVelRadial_143 "Detection point radial relative velocity
Front Radar Moudle_X_Detection Relative Velocity Radial 
前雷达探测点在径向上的相对速度";
CM_ SG_ 1017 FRM_46_DetnSNR_143 "Detection point signal noise ratio
Front Radar Moudle_X_Detection Signal Noise Ratio
前雷达探测点信号噪声比";
CM_ SG_ 1017 FRM_46_DetnRCS_143 "Detection point radar cross section
Front Radar Moudle_X_Detection Radar Cross Section
前雷达探测点雷达散射截面积";
CM_ SG_ 1017 FRM_46_DetnQuality_143 "Detection point quality
Front Radar Moudle_X_Detection Quality
前雷达探测点质量";
CM_ SG_ 1017 FRM_46_Loc138_Valid "the valid flag of each location 
每一点云的有效状态";
CM_ SG_ 1017 FRM_46_Loc139_Valid "the valid flag of each location 
每一点云的有效状态";
CM_ SG_ 1017 FRM_46_Loc140_Valid "the valid flag of each location 
每一点云的有效状态";
CM_ SG_ 1017 FRM_46_Loc141_Valid "the valid flag of each location 
每一点云的有效状态";
CM_ SG_ 1017 FRM_46_Loc142_Valid "the valid flag of each location 
每一点云的有效状态";
CM_ SG_ 1017 FRM_46_Loc143_Valid "the valid flag of each location 
每一点云的有效状态";
CM_ SG_ 1018 FRM_47_CRC "Profile5:E2E CRC16 (polynomial:0x1021)       
DataID:Use CANID,other bits Fill with 0";
CM_ SG_ 1018 FRM_47_RollgCntr "Profile5:E2E Rolling message counter";
CM_ SG_ 1018 FRM_47_DetnBlockCounter "Front Radar Moudle_X_Detection Block Counter
前雷达探测点块计数";
CM_ SG_ 1018 FRM_47_DetnMotionSts_144 "Detection point motion status
Front Radar Moudle_X_Detection Motion Status
前雷达探测点运动状态";
CM_ SG_ 1018 FRM_47_DetnRngRadial_144 "Detection point radial distance
Front Radar Moudle_X_Detection Range Radial
前雷达探测点径向距离";
CM_ SG_ 1018 FRM_47_DetnAziAngle_144 "Detection point azimuth angle
Front Radar Moudle_X_Detection Azimuth Angle
前雷达探测点水平方位角";
CM_ SG_ 1018 FRM_47_DetnElevnAngle_144 "Detection point elevation angle
Front Radar Moudle_X_Detection Elevation Angle
前雷达探测点俯仰角";
CM_ SG_ 1018 FRM_47_DetnRelVelRadial_144 "Detection point radial relative velocity
Front Radar Moudle_X_Detection Relative Velocity Radial 
前雷达探测点在径向上的相对速度";
CM_ SG_ 1018 FRM_47_DetnSNR_144 "Detection point signal noise ratio
Front Radar Moudle_X_Detection Signal Noise Ratio
前雷达探测点信号噪声比";
CM_ SG_ 1018 FRM_47_DetnRCS_144 "Detection point radar cross section
Front Radar Moudle_X_Detection Radar Cross Section
前雷达探测点雷达散射截面积";
CM_ SG_ 1018 FRM_47_DetnQuality_144 "Detection point quality
Front Radar Moudle_X_Detection Quality
前雷达探测点质量";
CM_ SG_ 1018 FRM_47_DetnMotionSts_145 "Detection point motion status
Front Radar Moudle_X_Detection Motion Status
前雷达探测点运动状态";
CM_ SG_ 1018 FRM_47_DetnRngRadial_145 "Detection point radial distance
Front Radar Moudle_X_Detection Range Radial
前雷达探测点径向距离";
CM_ SG_ 1018 FRM_47_DetnAziAngle_145 "Detection point azimuth angle
Front Radar Moudle_X_Detection Azimuth Angle
前雷达探测点水平方位角";
CM_ SG_ 1018 FRM_47_DetnElevnAngle_145 "Detection point elevation angle
Front Radar Moudle_X_Detection Elevation Angle
前雷达探测点俯仰角";
CM_ SG_ 1018 FRM_47_DetnRelVelRadial_145 "Detection point radial relative velocity
Front Radar Moudle_X_Detection Relative Velocity Radial 
前雷达探测点在径向上的相对速度";
CM_ SG_ 1018 FRM_47_DetnSNR_145 "Detection point signal noise ratio
Front Radar Moudle_X_Detection Signal Noise Ratio
前雷达探测点信号噪声比";
CM_ SG_ 1018 FRM_47_DetnRCS_145 "Detection point radar cross section
Front Radar Moudle_X_Detection Radar Cross Section
前雷达探测点雷达散射截面积";
CM_ SG_ 1018 FRM_47_DetnQuality_145 "Detection point quality
Front Radar Moudle_X_Detection Quality
前雷达探测点质量";
CM_ SG_ 1018 FRM_47_DetnMotionSts_146 "Detection point motion status
Front Radar Moudle_X_Detection Motion Status
前雷达探测点运动状态";
CM_ SG_ 1018 FRM_47_DetnRngRadial_146 "Detection point radial distance
Front Radar Moudle_X_Detection Range Radial
前雷达探测点径向距离";
CM_ SG_ 1018 FRM_47_DetnAziAngle_146 "Detection point azimuth angle
Front Radar Moudle_X_Detection Azimuth Angle
前雷达探测点水平方位角";
CM_ SG_ 1018 FRM_47_DetnElevnAngle_146 "Detection point elevation angle
Front Radar Moudle_X_Detection Elevation Angle
前雷达探测点俯仰角";
CM_ SG_ 1018 FRM_47_DetnRelVelRadial_146 "Detection point radial relative velocity
Front Radar Moudle_X_Detection Relative Velocity Radial 
前雷达探测点在径向上的相对速度";
CM_ SG_ 1018 FRM_47_DetnSNR_146 "Detection point signal noise ratio
Front Radar Moudle_X_Detection Signal Noise Ratio
前雷达探测点信号噪声比";
CM_ SG_ 1018 FRM_47_DetnRCS_146 "Detection point radar cross section
Front Radar Moudle_X_Detection Radar Cross Section
前雷达探测点雷达散射截面积";
CM_ SG_ 1018 FRM_47_DetnQuality_146 "Detection point quality
Front Radar Moudle_X_Detection Quality
前雷达探测点质量";
CM_ SG_ 1018 FRM_47_DetnMotionSts_147 "Detection point motion status
Front Radar Moudle_X_Detection Motion Status
前雷达探测点运动状态";
CM_ SG_ 1018 FRM_47_DetnRngRadial_147 "Detection point radial distance
Front Radar Moudle_X_Detection Range Radial
前雷达探测点径向距离";
CM_ SG_ 1018 FRM_47_DetnAziAngle_147 "Detection point azimuth angle
Front Radar Moudle_X_Detection Azimuth Angle
前雷达探测点水平方位角";
CM_ SG_ 1018 FRM_47_DetnElevnAngle_147 "Detection point elevation angle
Front Radar Moudle_X_Detection Elevation Angle
前雷达探测点俯仰角";
CM_ SG_ 1018 FRM_47_DetnRelVelRadial_147 "Detection point radial relative velocity
Front Radar Moudle_X_Detection Relative Velocity Radial 
前雷达探测点在径向上的相对速度";
CM_ SG_ 1018 FRM_47_DetnSNR_147 "Detection point signal noise ratio
Front Radar Moudle_X_Detection Signal Noise Ratio
前雷达探测点信号噪声比";
CM_ SG_ 1018 FRM_47_DetnRCS_147 "Detection point radar cross section
Front Radar Moudle_X_Detection Radar Cross Section
前雷达探测点雷达散射截面积";
CM_ SG_ 1018 FRM_47_DetnQuality_147 "Detection point quality
Front Radar Moudle_X_Detection Quality
前雷达探测点质量";
CM_ SG_ 1018 FRM_47_DetnMotionSts_148 "Detection point motion status
Front Radar Moudle_X_Detection Motion Status
前雷达探测点运动状态";
CM_ SG_ 1018 FRM_47_DetnRngRadial_148 "Detection point radial distance
Front Radar Moudle_X_Detection Range Radial
前雷达探测点径向距离";
CM_ SG_ 1018 FRM_47_DetnAziAngle_148 "Detection point azimuth angle
Front Radar Moudle_X_Detection Azimuth Angle
前雷达探测点水平方位角";
CM_ SG_ 1018 FRM_47_DetnElevnAngle_148 "Detection point elevation angle
Front Radar Moudle_X_Detection Elevation Angle
前雷达探测点俯仰角";
CM_ SG_ 1018 FRM_47_DetnRelVelRadial_148 "Detection point radial relative velocity
Front Radar Moudle_X_Detection Relative Velocity Radial 
前雷达探测点在径向上的相对速度";
CM_ SG_ 1018 FRM_47_DetnSNR_148 "Detection point signal noise ratio
Front Radar Moudle_X_Detection Signal Noise Ratio
前雷达探测点信号噪声比";
CM_ SG_ 1018 FRM_47_DetnRCS_148 "Detection point radar cross section
Front Radar Moudle_X_Detection Radar Cross Section
前雷达探测点雷达散射截面积";
CM_ SG_ 1018 FRM_47_DetnQuality_148 "Detection point quality
Front Radar Moudle_X_Detection Quality
前雷达探测点质量";
CM_ SG_ 1018 FRM_47_DetnMotionSts_149 "Detection point motion status
Front Radar Moudle_X_Detection Motion Status
前雷达探测点运动状态";
CM_ SG_ 1018 FRM_47_DetnRngRadial_149 "Detection point radial distance
Front Radar Moudle_X_Detection Range Radial
前雷达探测点径向距离";
CM_ SG_ 1018 FRM_47_DetnAziAngle_149 "Detection point azimuth angle
Front Radar Moudle_X_Detection Azimuth Angle
前雷达探测点水平方位角";
CM_ SG_ 1018 FRM_47_DetnElevnAngle_149 "Detection point elevation angle
Front Radar Moudle_X_Detection Elevation Angle
前雷达探测点俯仰角";
CM_ SG_ 1018 FRM_47_DetnRelVelRadial_149 "Detection point radial relative velocity
Front Radar Moudle_X_Detection Relative Velocity Radial 
前雷达探测点在径向上的相对速度";
CM_ SG_ 1018 FRM_47_DetnSNR_149 "Detection point signal noise ratio
Front Radar Moudle_X_Detection Signal Noise Ratio
前雷达探测点信号噪声比";
CM_ SG_ 1018 FRM_47_DetnRCS_149 "Detection point radar cross section
Front Radar Moudle_X_Detection Radar Cross Section
前雷达探测点雷达散射截面积";
CM_ SG_ 1018 FRM_47_DetnQuality_149 "Detection point quality
Front Radar Moudle_X_Detection Quality
前雷达探测点质量";
CM_ SG_ 1018 FRM_47_Loc144_Valid "the valid flag of each location 
每一点云的有效状态";
CM_ SG_ 1018 FRM_47_Loc145_Valid "the valid flag of each location 
每一点云的有效状态";
CM_ SG_ 1018 FRM_47_Loc146_Valid "the valid flag of each location 
每一点云的有效状态";
CM_ SG_ 1018 FRM_47_Loc147_Valid "the valid flag of each location 
每一点云的有效状态";
CM_ SG_ 1018 FRM_47_Loc148_Valid "the valid flag of each location 
每一点云的有效状态";
CM_ SG_ 1018 FRM_47_Loc149_Valid "the valid flag of each location 
每一点云的有效状态";
CM_ SG_ 1019 FRM_48_CRC "Profile5:E2E CRC16 (polynomial:0x1021)       
DataID:Use CANID,other bits Fill with 0";
CM_ SG_ 1019 FRM_48_RollgCntr "Profile5:E2E Rolling message counter";
CM_ SG_ 1019 FRM_48_DetnBlockCounter "Front Radar Moudle_X_Detection Block Counter
前雷达探测点块计数";
CM_ SG_ 1019 FRM_48_DetnMotionSts_150 "Detection point motion status
Front Radar Moudle_X_Detection Motion Status
前雷达探测点运动状态";
CM_ SG_ 1019 FRM_48_DetnRngRadial_150 "Detection point radial distance
Front Radar Moudle_X_Detection Range Radial
前雷达探测点径向距离";
CM_ SG_ 1019 FRM_48_DetnAziAngle_150 "Detection point azimuth angle
Front Radar Moudle_X_Detection Azimuth Angle
前雷达探测点水平方位角";
CM_ SG_ 1019 FRM_48_DetnElevnAngle_150 "Detection point elevation angle
Front Radar Moudle_X_Detection Elevation Angle
前雷达探测点俯仰角";
CM_ SG_ 1019 FRM_48_DetnRelVelRadial_150 "Detection point radial relative velocity
Front Radar Moudle_X_Detection Relative Velocity Radial 
前雷达探测点在径向上的相对速度";
CM_ SG_ 1019 FRM_48_DetnSNR_150 "Detection point signal noise ratio
Front Radar Moudle_X_Detection Signal Noise Ratio
前雷达探测点信号噪声比";
CM_ SG_ 1019 FRM_48_DetnRCS_150 "Detection point radar cross section
Front Radar Moudle_X_Detection Radar Cross Section
前雷达探测点雷达散射截面积";
CM_ SG_ 1019 FRM_48_DetnQuality_150 "Detection point quality
Front Radar Moudle_X_Detection Quality
前雷达探测点质量";
CM_ SG_ 1019 FRM_48_DetnMotionSts_151 "Detection point motion status
Front Radar Moudle_X_Detection Motion Status
前雷达探测点运动状态";
CM_ SG_ 1019 FRM_48_DetnRngRadial_151 "Detection point radial distance
Front Radar Moudle_X_Detection Range Radial
前雷达探测点径向距离";
CM_ SG_ 1019 FRM_48_DetnAziAngle_151 "Detection point azimuth angle
Front Radar Moudle_X_Detection Azimuth Angle
前雷达探测点水平方位角";
CM_ SG_ 1019 FRM_48_DetnElevnAngle_151 "Detection point elevation angle
Front Radar Moudle_X_Detection Elevation Angle
前雷达探测点俯仰角";
CM_ SG_ 1019 FRM_48_DetnRelVelRadial_151 "Detection point radial relative velocity
Front Radar Moudle_X_Detection Relative Velocity Radial 
前雷达探测点在径向上的相对速度";
CM_ SG_ 1019 FRM_48_DetnSNR_151 "Detection point signal noise ratio
Front Radar Moudle_X_Detection Signal Noise Ratio
前雷达探测点信号噪声比";
CM_ SG_ 1019 FRM_48_DetnRCS_151 "Detection point radar cross section
Front Radar Moudle_X_Detection Radar Cross Section
前雷达探测点雷达散射截面积";
CM_ SG_ 1019 FRM_48_DetnQuality_151 "Detection point quality
Front Radar Moudle_X_Detection Quality
前雷达探测点质量";
CM_ SG_ 1019 FRM_48_DetnMotionSts_152 "Detection point motion status
Front Radar Moudle_X_Detection Motion Status
前雷达探测点运动状态";
CM_ SG_ 1019 FRM_48_DetnRngRadial_152 "Detection point radial distance
Front Radar Moudle_X_Detection Range Radial
前雷达探测点径向距离";
CM_ SG_ 1019 FRM_48_DetnAziAngle_152 "Detection point azimuth angle
Front Radar Moudle_X_Detection Azimuth Angle
前雷达探测点水平方位角";
CM_ SG_ 1019 FRM_48_DetnElevnAngle_152 "Detection point elevation angle
Front Radar Moudle_X_Detection Elevation Angle
前雷达探测点俯仰角";
CM_ SG_ 1019 FRM_48_DetnRelVelRadial_152 "Detection point radial relative velocity
Front Radar Moudle_X_Detection Relative Velocity Radial 
前雷达探测点在径向上的相对速度";
CM_ SG_ 1019 FRM_48_DetnSNR_152 "Detection point signal noise ratio
Front Radar Moudle_X_Detection Signal Noise Ratio
前雷达探测点信号噪声比";
CM_ SG_ 1019 FRM_48_DetnRCS_152 "Detection point radar cross section
Front Radar Moudle_X_Detection Radar Cross Section
前雷达探测点雷达散射截面积";
CM_ SG_ 1019 FRM_48_DetnQuality_152 "Detection point quality
Front Radar Moudle_X_Detection Quality
前雷达探测点质量";
CM_ SG_ 1019 FRM_48_DetnMotionSts_153 "Detection point motion status
Front Radar Moudle_X_Detection Motion Status
前雷达探测点运动状态";
CM_ SG_ 1019 FRM_48_DetnRngRadial_153 "Detection point radial distance
Front Radar Moudle_X_Detection Range Radial
前雷达探测点径向距离";
CM_ SG_ 1019 FRM_48_DetnAziAngle_153 "Detection point azimuth angle
Front Radar Moudle_X_Detection Azimuth Angle
前雷达探测点水平方位角";
CM_ SG_ 1019 FRM_48_DetnElevnAngle_153 "Detection point elevation angle
Front Radar Moudle_X_Detection Elevation Angle
前雷达探测点俯仰角";
CM_ SG_ 1019 FRM_48_DetnRelVelRadial_153 "Detection point radial relative velocity
Front Radar Moudle_X_Detection Relative Velocity Radial 
前雷达探测点在径向上的相对速度";
CM_ SG_ 1019 FRM_48_DetnSNR_153 "Detection point signal noise ratio
Front Radar Moudle_X_Detection Signal Noise Ratio
前雷达探测点信号噪声比";
CM_ SG_ 1019 FRM_48_DetnRCS_153 "Detection point radar cross section
Front Radar Moudle_X_Detection Radar Cross Section
前雷达探测点雷达散射截面积";
CM_ SG_ 1019 FRM_48_DetnQuality_153 "Detection point quality
Front Radar Moudle_X_Detection Quality
前雷达探测点质量";
CM_ SG_ 1019 FRM_48_DetnMotionSts_154 "Detection point motion status
Front Radar Moudle_X_Detection Motion Status
前雷达探测点运动状态";
CM_ SG_ 1019 FRM_48_DetnRngRadial_154 "Detection point radial distance
Front Radar Moudle_X_Detection Range Radial
前雷达探测点径向距离";
CM_ SG_ 1019 FRM_48_DetnAziAngle_154 "Detection point azimuth angle
Front Radar Moudle_X_Detection Azimuth Angle
前雷达探测点水平方位角";
CM_ SG_ 1019 FRM_48_DetnElevnAngle_154 "Detection point elevation angle
Front Radar Moudle_X_Detection Elevation Angle
前雷达探测点俯仰角";
CM_ SG_ 1019 FRM_48_DetnRelVelRadial_154 "Detection point radial relative velocity
Front Radar Moudle_X_Detection Relative Velocity Radial 
前雷达探测点在径向上的相对速度";
CM_ SG_ 1019 FRM_48_DetnSNR_154 "Detection point signal noise ratio
Front Radar Moudle_X_Detection Signal Noise Ratio
前雷达探测点信号噪声比";
CM_ SG_ 1019 FRM_48_DetnRCS_154 "Detection point radar cross section
Front Radar Moudle_X_Detection Radar Cross Section
前雷达探测点雷达散射截面积";
CM_ SG_ 1019 FRM_48_DetnQuality_154 "Detection point quality
Front Radar Moudle_X_Detection Quality
前雷达探测点质量";
CM_ SG_ 1019 FRM_48_DetnMotionSts_155 "Detection point motion status
Front Radar Moudle_X_Detection Motion Status
前雷达探测点运动状态";
CM_ SG_ 1019 FRM_48_DetnRngRadial_155 "Detection point radial distance
Front Radar Moudle_X_Detection Range Radial
前雷达探测点径向距离";
CM_ SG_ 1019 FRM_48_DetnAziAngle_155 "Detection point azimuth angle
Front Radar Moudle_X_Detection Azimuth Angle
前雷达探测点水平方位角";
CM_ SG_ 1019 FRM_48_DetnElevnAngle_155 "Detection point elevation angle
Front Radar Moudle_X_Detection Elevation Angle
前雷达探测点俯仰角";
CM_ SG_ 1019 FRM_48_DetnRelVelRadial_155 "Detection point radial relative velocity
Front Radar Moudle_X_Detection Relative Velocity Radial 
前雷达探测点在径向上的相对速度";
CM_ SG_ 1019 FRM_48_DetnSNR_155 "Detection point signal noise ratio
Front Radar Moudle_X_Detection Signal Noise Ratio
前雷达探测点信号噪声比";
CM_ SG_ 1019 FRM_48_DetnRCS_155 "Detection point radar cross section
Front Radar Moudle_X_Detection Radar Cross Section
前雷达探测点雷达散射截面积";
CM_ SG_ 1019 FRM_48_DetnQuality_155 "Detection point quality
Front Radar Moudle_X_Detection Quality
前雷达探测点质量";
CM_ SG_ 1019 FRM_48_Loc150_Valid "the valid flag of each location 
每一点云的有效状态";
CM_ SG_ 1019 FRM_48_Loc151_Valid "the valid flag of each location 
每一点云的有效状态";
CM_ SG_ 1019 FRM_48_Loc152_Valid "the valid flag of each location 
每一点云的有效状态";
CM_ SG_ 1019 FRM_48_Loc153_Valid "the valid flag of each location 
每一点云的有效状态";
CM_ SG_ 1019 FRM_48_Loc154_Valid "the valid flag of each location 
每一点云的有效状态";
CM_ SG_ 1019 FRM_48_Loc155_Valid "the valid flag of each location 
每一点云的有效状态";
CM_ SG_ 1020 FRM_49_CRC "Profile5:E2E CRC16 (polynomial:0x1021)       
DataID:Use CANID,other bits Fill with 0";
CM_ SG_ 1020 FRM_49_RollgCntr "Profile5:E2E Rolling message counter";
CM_ SG_ 1020 FRM_49_DetnBlockCounter "Front Radar Moudle_X_Detection Block Counter
前雷达探测点块计数";
CM_ SG_ 1020 FRM_49_DetnMotionSts_156 "Detection point motion status
Front Radar Moudle_X_Detection Motion Status
前雷达探测点运动状态";
CM_ SG_ 1020 FRM_49_DetnRngRadial_156 "Detection point radial distance
Front Radar Moudle_X_Detection Range Radial
前雷达探测点径向距离";
CM_ SG_ 1020 FRM_49_DetnAziAngle_156 "Detection point azimuth angle
Front Radar Moudle_X_Detection Azimuth Angle
前雷达探测点水平方位角";
CM_ SG_ 1020 FRM_49_DetnElevnAngle_156 "Detection point elevation angle
Front Radar Moudle_X_Detection Elevation Angle
前雷达探测点俯仰角";
CM_ SG_ 1020 FRM_49_DetnRelVelRadial_156 "Detection point radial relative velocity
Front Radar Moudle_X_Detection Relative Velocity Radial 
前雷达探测点在径向上的相对速度";
CM_ SG_ 1020 FRM_49_DetnSNR_156 "Detection point signal noise ratio
Front Radar Moudle_X_Detection Signal Noise Ratio
前雷达探测点信号噪声比";
CM_ SG_ 1020 FRM_49_DetnRCS_156 "Detection point radar cross section
Front Radar Moudle_X_Detection Radar Cross Section
前雷达探测点雷达散射截面积";
CM_ SG_ 1020 FRM_49_DetnQuality_156 "Detection point quality
Front Radar Moudle_X_Detection Quality
前雷达探测点质量";
CM_ SG_ 1020 FRM_49_DetnMotionSts_157 "Detection point motion status
Front Radar Moudle_X_Detection Motion Status
前雷达探测点运动状态";
CM_ SG_ 1020 FRM_49_DetnRngRadial_157 "Detection point radial distance
Front Radar Moudle_X_Detection Range Radial
前雷达探测点径向距离";
CM_ SG_ 1020 FRM_49_DetnAziAngle_157 "Detection point azimuth angle
Front Radar Moudle_X_Detection Azimuth Angle
前雷达探测点水平方位角";
CM_ SG_ 1020 FRM_49_DetnElevnAngle_157 "Detection point elevation angle
Front Radar Moudle_X_Detection Elevation Angle
前雷达探测点俯仰角";
CM_ SG_ 1020 FRM_49_DetnRelVelRadial_157 "Detection point radial relative velocity
Front Radar Moudle_X_Detection Relative Velocity Radial 
前雷达探测点在径向上的相对速度";
CM_ SG_ 1020 FRM_49_DetnSNR_157 "Detection point signal noise ratio
Front Radar Moudle_X_Detection Signal Noise Ratio
前雷达探测点信号噪声比";
CM_ SG_ 1020 FRM_49_DetnRCS_157 "Detection point radar cross section
Front Radar Moudle_X_Detection Radar Cross Section
前雷达探测点雷达散射截面积";
CM_ SG_ 1020 FRM_49_DetnQuality_157 "Detection point quality
Front Radar Moudle_X_Detection Quality
前雷达探测点质量";
CM_ SG_ 1020 FRM_49_DetnMotionSts_158 "Detection point motion status
Front Radar Moudle_X_Detection Motion Status
前雷达探测点运动状态";
CM_ SG_ 1020 FRM_49_DetnRngRadial_158 "Detection point radial distance
Front Radar Moudle_X_Detection Range Radial
前雷达探测点径向距离";
CM_ SG_ 1020 FRM_49_DetnAziAngle_158 "Detection point azimuth angle
Front Radar Moudle_X_Detection Azimuth Angle
前雷达探测点水平方位角";
CM_ SG_ 1020 FRM_49_DetnElevnAngle_158 "Detection point elevation angle
Front Radar Moudle_X_Detection Elevation Angle
前雷达探测点俯仰角";
CM_ SG_ 1020 FRM_49_DetnRelVelRadial_158 "Detection point radial relative velocity
Front Radar Moudle_X_Detection Relative Velocity Radial 
前雷达探测点在径向上的相对速度";
CM_ SG_ 1020 FRM_49_DetnSNR_158 "Detection point signal noise ratio
Front Radar Moudle_X_Detection Signal Noise Ratio
前雷达探测点信号噪声比";
CM_ SG_ 1020 FRM_49_DetnRCS_158 "Detection point radar cross section
Front Radar Moudle_X_Detection Radar Cross Section
前雷达探测点雷达散射截面积";
CM_ SG_ 1020 FRM_49_DetnQuality_158 "Detection point quality
Front Radar Moudle_X_Detection Quality
前雷达探测点质量";
CM_ SG_ 1020 FRM_49_DetnMotionSts_159 "Detection point motion status
Front Radar Moudle_X_Detection Motion Status
前雷达探测点运动状态";
CM_ SG_ 1020 FRM_49_DetnRngRadial_159 "Detection point radial distance
Front Radar Moudle_X_Detection Range Radial
前雷达探测点径向距离";
CM_ SG_ 1020 FRM_49_DetnAziAngle_159 "Detection point azimuth angle
Front Radar Moudle_X_Detection Azimuth Angle
前雷达探测点水平方位角";
CM_ SG_ 1020 FRM_49_DetnElevnAngle_159 "Detection point elevation angle
Front Radar Moudle_X_Detection Elevation Angle
前雷达探测点俯仰角";
CM_ SG_ 1020 FRM_49_DetnRelVelRadial_159 "Detection point radial relative velocity
Front Radar Moudle_X_Detection Relative Velocity Radial 
前雷达探测点在径向上的相对速度";
CM_ SG_ 1020 FRM_49_DetnSNR_159 "Detection point signal noise ratio
Front Radar Moudle_X_Detection Signal Noise Ratio
前雷达探测点信号噪声比";
CM_ SG_ 1020 FRM_49_DetnRCS_159 "Detection point radar cross section
Front Radar Moudle_X_Detection Radar Cross Section
前雷达探测点雷达散射截面积";
CM_ SG_ 1020 FRM_49_DetnQuality_159 "Detection point quality
Front Radar Moudle_X_Detection Quality
前雷达探测点质量";
CM_ SG_ 1020 FRM_49_DetnMotionSts_160 "Detection point motion status
Front Radar Moudle_X_Detection Motion Status
前雷达探测点运动状态";
CM_ SG_ 1020 FRM_49_DetnRngRadial_160 "Detection point radial distance
Front Radar Moudle_X_Detection Range Radial
前雷达探测点径向距离";
CM_ SG_ 1020 FRM_49_DetnAziAngle_160 "Detection point azimuth angle
Front Radar Moudle_X_Detection Azimuth Angle
前雷达探测点水平方位角";
CM_ SG_ 1020 FRM_49_DetnElevnAngle_160 "Detection point elevation angle
Front Radar Moudle_X_Detection Elevation Angle
前雷达探测点俯仰角";
CM_ SG_ 1020 FRM_49_DetnRelVelRadial_160 "Detection point radial relative velocity
Front Radar Moudle_X_Detection Relative Velocity Radial 
前雷达探测点在径向上的相对速度";
CM_ SG_ 1020 FRM_49_DetnSNR_160 "Detection point signal noise ratio
Front Radar Moudle_X_Detection Signal Noise Ratio
前雷达探测点信号噪声比";
CM_ SG_ 1020 FRM_49_DetnRCS_160 "Detection point radar cross section
Front Radar Moudle_X_Detection Radar Cross Section
前雷达探测点雷达散射截面积";
CM_ SG_ 1020 FRM_49_DetnQuality_160 "Detection point quality
Front Radar Moudle_X_Detection Quality
前雷达探测点质量";
CM_ SG_ 1020 FRM_49_DetnMotionSts_161 "Detection point motion status
Front Radar Moudle_X_Detection Motion Status
前雷达探测点运动状态";
CM_ SG_ 1020 FRM_49_DetnRngRadial_161 "Detection point radial distance
Front Radar Moudle_X_Detection Range Radial
前雷达探测点径向距离";
CM_ SG_ 1020 FRM_49_DetnAziAngle_161 "Detection point azimuth angle
Front Radar Moudle_X_Detection Azimuth Angle
前雷达探测点水平方位角";
CM_ SG_ 1020 FRM_49_DetnElevnAngle_161 "Detection point elevation angle
Front Radar Moudle_X_Detection Elevation Angle
前雷达探测点俯仰角";
CM_ SG_ 1020 FRM_49_DetnRelVelRadial_161 "Detection point radial relative velocity
Front Radar Moudle_X_Detection Relative Velocity Radial 
前雷达探测点在径向上的相对速度";
CM_ SG_ 1020 FRM_49_DetnSNR_161 "Detection point signal noise ratio
Front Radar Moudle_X_Detection Signal Noise Ratio
前雷达探测点信号噪声比";
CM_ SG_ 1020 FRM_49_DetnRCS_161 "Detection point radar cross section
Front Radar Moudle_X_Detection Radar Cross Section
前雷达探测点雷达散射截面积";
CM_ SG_ 1020 FRM_49_DetnQuality_161 "Detection point quality
Front Radar Moudle_X_Detection Quality
前雷达探测点质量";
CM_ SG_ 1020 FRM_49_Loc156_Valid "the valid flag of each location 
每一点云的有效状态";
CM_ SG_ 1020 FRM_49_Loc157_Valid "the valid flag of each location 
每一点云的有效状态";
CM_ SG_ 1020 FRM_49_Loc158_Valid "the valid flag of each location 
每一点云的有效状态";
CM_ SG_ 1020 FRM_49_Loc159_Valid "the valid flag of each location 
每一点云的有效状态";
CM_ SG_ 1020 FRM_49_Loc160_Valid "the valid flag of each location 
每一点云的有效状态";
CM_ SG_ 1020 FRM_49_Loc161_Valid "the valid flag of each location 
每一点云的有效状态";
CM_ SG_ 1021 FRM_50_CRC "Profile5:E2E CRC16 (polynomial:0x1021)       
DataID:Use CANID,other bits Fill with 0";
CM_ SG_ 1021 FRM_50_RollgCntr "Profile5:E2E Rolling message counter";
CM_ SG_ 1021 FRM_50_DetnBlockCounter "Front Radar Moudle_X_Detection Block Counter
前雷达探测点块计数";
CM_ SG_ 1021 FRM_50_DetnMotionSts_162 "Detection point motion status
Front Radar Moudle_X_Detection Motion Status
前雷达探测点运动状态";
CM_ SG_ 1021 FRM_50_DetnRngRadial_162 "Detection point radial distance
Front Radar Moudle_X_Detection Range Radial
前雷达探测点径向距离";
CM_ SG_ 1021 FRM_50_DetnAziAngle_162 "Detection point azimuth angle
Front Radar Moudle_X_Detection Azimuth Angle
前雷达探测点水平方位角";
CM_ SG_ 1021 FRM_50_DetnElevnAngle_162 "Detection point elevation angle
Front Radar Moudle_X_Detection Elevation Angle
前雷达探测点俯仰角";
CM_ SG_ 1021 FRM_50_DetnRelVelRadial_162 "Detection point radial relative velocity
Front Radar Moudle_X_Detection Relative Velocity Radial 
前雷达探测点在径向上的相对速度";
CM_ SG_ 1021 FRM_50_DetnSNR_162 "Detection point signal noise ratio
Front Radar Moudle_X_Detection Signal Noise Ratio
前雷达探测点信号噪声比";
CM_ SG_ 1021 FRM_50_DetnRCS_162 "Detection point radar cross section
Front Radar Moudle_X_Detection Radar Cross Section
前雷达探测点雷达散射截面积";
CM_ SG_ 1021 FRM_50_DetnQuality_162 "Detection point quality
Front Radar Moudle_X_Detection Quality
前雷达探测点质量";
CM_ SG_ 1021 FRM_50_DetnMotionSts_163 "Detection point motion status
Front Radar Moudle_X_Detection Motion Status
前雷达探测点运动状态";
CM_ SG_ 1021 FRM_50_DetnRngRadial_163 "Detection point radial distance
Front Radar Moudle_X_Detection Range Radial
前雷达探测点径向距离";
CM_ SG_ 1021 FRM_50_DetnAziAngle_163 "Detection point azimuth angle
Front Radar Moudle_X_Detection Azimuth Angle
前雷达探测点水平方位角";
CM_ SG_ 1021 FRM_50_DetnElevnAngle_163 "Detection point elevation angle
Front Radar Moudle_X_Detection Elevation Angle
前雷达探测点俯仰角";
CM_ SG_ 1021 FRM_50_DetnRelVelRadial_163 "Detection point radial relative velocity
Front Radar Moudle_X_Detection Relative Velocity Radial 
前雷达探测点在径向上的相对速度";
CM_ SG_ 1021 FRM_50_DetnSNR_163 "Detection point signal noise ratio
Front Radar Moudle_X_Detection Signal Noise Ratio
前雷达探测点信号噪声比";
CM_ SG_ 1021 FRM_50_DetnRCS_163 "Detection point radar cross section
Front Radar Moudle_X_Detection Radar Cross Section
前雷达探测点雷达散射截面积";
CM_ SG_ 1021 FRM_50_DetnQuality_163 "Detection point quality
Front Radar Moudle_X_Detection Quality
前雷达探测点质量";
CM_ SG_ 1021 FRM_50_DetnMotionSts_164 "Detection point motion status
Front Radar Moudle_X_Detection Motion Status
前雷达探测点运动状态";
CM_ SG_ 1021 FRM_50_DetnRngRadial_164 "Detection point radial distance
Front Radar Moudle_X_Detection Range Radial
前雷达探测点径向距离";
CM_ SG_ 1021 FRM_50_DetnAziAngle_164 "Detection point azimuth angle
Front Radar Moudle_X_Detection Azimuth Angle
前雷达探测点水平方位角";
CM_ SG_ 1021 FRM_50_DetnElevnAngle_164 "Detection point elevation angle
Front Radar Moudle_X_Detection Elevation Angle
前雷达探测点俯仰角";
CM_ SG_ 1021 FRM_50_DetnRelVelRadial_164 "Detection point radial relative velocity
Front Radar Moudle_X_Detection Relative Velocity Radial 
前雷达探测点在径向上的相对速度";
CM_ SG_ 1021 FRM_50_DetnSNR_164 "Detection point signal noise ratio
Front Radar Moudle_X_Detection Signal Noise Ratio
前雷达探测点信号噪声比";
CM_ SG_ 1021 FRM_50_DetnRCS_164 "Detection point radar cross section
Front Radar Moudle_X_Detection Radar Cross Section
前雷达探测点雷达散射截面积";
CM_ SG_ 1021 FRM_50_DetnQuality_164 "Detection point quality
Front Radar Moudle_X_Detection Quality
前雷达探测点质量";
CM_ SG_ 1021 FRM_50_DetnMotionSts_165 "Detection point motion status
Front Radar Moudle_X_Detection Motion Status
前雷达探测点运动状态";
CM_ SG_ 1021 FRM_50_DetnRngRadial_165 "Detection point radial distance
Front Radar Moudle_X_Detection Range Radial
前雷达探测点径向距离";
CM_ SG_ 1021 FRM_50_DetnAziAngle_165 "Detection point azimuth angle
Front Radar Moudle_X_Detection Azimuth Angle
前雷达探测点水平方位角";
CM_ SG_ 1021 FRM_50_DetnElevnAngle_165 "Detection point elevation angle
Front Radar Moudle_X_Detection Elevation Angle
前雷达探测点俯仰角";
CM_ SG_ 1021 FRM_50_DetnRelVelRadial_165 "Detection point radial relative velocity
Front Radar Moudle_X_Detection Relative Velocity Radial 
前雷达探测点在径向上的相对速度";
CM_ SG_ 1021 FRM_50_DetnSNR_165 "Detection point signal noise ratio
Front Radar Moudle_X_Detection Signal Noise Ratio
前雷达探测点信号噪声比";
CM_ SG_ 1021 FRM_50_DetnRCS_165 "Detection point radar cross section
Front Radar Moudle_X_Detection Radar Cross Section
前雷达探测点雷达散射截面积";
CM_ SG_ 1021 FRM_50_DetnQuality_165 "Detection point quality
Front Radar Moudle_X_Detection Quality
前雷达探测点质量";
CM_ SG_ 1021 FRM_50_DetnMotionSts_166 "Detection point motion status
Front Radar Moudle_X_Detection Motion Status
前雷达探测点运动状态";
CM_ SG_ 1021 FRM_50_DetnRngRadial_166 "Detection point radial distance
Front Radar Moudle_X_Detection Range Radial
前雷达探测点径向距离";
CM_ SG_ 1021 FRM_50_DetnAziAngle_166 "Detection point azimuth angle
Front Radar Moudle_X_Detection Azimuth Angle
前雷达探测点水平方位角";
CM_ SG_ 1021 FRM_50_DetnElevnAngle_166 "Detection point elevation angle
Front Radar Moudle_X_Detection Elevation Angle
前雷达探测点俯仰角";
CM_ SG_ 1021 FRM_50_DetnRelVelRadial_166 "Detection point radial relative velocity
Front Radar Moudle_X_Detection Relative Velocity Radial 
前雷达探测点在径向上的相对速度";
CM_ SG_ 1021 FRM_50_DetnSNR_166 "Detection point signal noise ratio
Front Radar Moudle_X_Detection Signal Noise Ratio
前雷达探测点信号噪声比";
CM_ SG_ 1021 FRM_50_DetnRCS_166 "Detection point radar cross section
Front Radar Moudle_X_Detection Radar Cross Section
前雷达探测点雷达散射截面积";
CM_ SG_ 1021 FRM_50_DetnQuality_166 "Detection point quality
Front Radar Moudle_X_Detection Quality
前雷达探测点质量";
CM_ SG_ 1021 FRM_50_DetnMotionSts_167 "Detection point motion status
Front Radar Moudle_X_Detection Motion Status
前雷达探测点运动状态";
CM_ SG_ 1021 FRM_50_DetnRngRadial_167 "Detection point radial distance
Front Radar Moudle_X_Detection Range Radial
前雷达探测点径向距离";
CM_ SG_ 1021 FRM_50_DetnAziAngle_167 "Detection point azimuth angle
Front Radar Moudle_X_Detection Azimuth Angle
前雷达探测点水平方位角";
CM_ SG_ 1021 FRM_50_DetnElevnAngle_167 "Detection point elevation angle
Front Radar Moudle_X_Detection Elevation Angle
前雷达探测点俯仰角";
CM_ SG_ 1021 FRM_50_DetnRelVelRadial_167 "Detection point radial relative velocity
Front Radar Moudle_X_Detection Relative Velocity Radial 
前雷达探测点在径向上的相对速度";
CM_ SG_ 1021 FRM_50_DetnSNR_167 "Detection point signal noise ratio
Front Radar Moudle_X_Detection Signal Noise Ratio
前雷达探测点信号噪声比";
CM_ SG_ 1021 FRM_50_DetnRCS_167 "Detection point radar cross section
Front Radar Moudle_X_Detection Radar Cross Section
前雷达探测点雷达散射截面积";
CM_ SG_ 1021 FRM_50_DetnQuality_167 "Detection point quality
Front Radar Moudle_X_Detection Quality
前雷达探测点质量";
CM_ SG_ 1021 FRM_50_Loc162_Valid "the valid flag of each location 
每一点云的有效状态";
CM_ SG_ 1021 FRM_50_Loc163_Valid "the valid flag of each location 
每一点云的有效状态";
CM_ SG_ 1021 FRM_50_Loc164_Valid "the valid flag of each location 
每一点云的有效状态";
CM_ SG_ 1021 FRM_50_Loc165_Valid "the valid flag of each location 
每一点云的有效状态";
CM_ SG_ 1021 FRM_50_Loc166_Valid "the valid flag of each location 
每一点云的有效状态";
CM_ SG_ 1021 FRM_50_Loc167_Valid "the valid flag of each location 
每一点云的有效状态";
CM_ SG_ 1022 FRM_51_CRC "Profile5:E2E CRC16 (polynomial:0x1021)       
DataID:Use CANID,other bits Fill with 0";
CM_ SG_ 1022 FRM_51_RollgCntr "Profile5:E2E Rolling message counter";
CM_ SG_ 1022 FRM_51_DetnBlockCounter "Front Radar Moudle_X_Detection Block Counter
前雷达探测点块计数";
CM_ SG_ 1022 FRM_51_DetnMotionSts_168 "Detection point motion status
Front Radar Moudle_X_Detection Motion Status
前雷达探测点运动状态";
CM_ SG_ 1022 FRM_51_DetnRngRadial_168 "Detection point radial distance
Front Radar Moudle_X_Detection Range Radial
前雷达探测点径向距离";
CM_ SG_ 1022 FRM_51_DetnAziAngle_168 "Detection point azimuth angle
Front Radar Moudle_X_Detection Azimuth Angle
前雷达探测点水平方位角";
CM_ SG_ 1022 FRM_51_DetnElevnAngle_168 "Detection point elevation angle
Front Radar Moudle_X_Detection Elevation Angle
前雷达探测点俯仰角";
CM_ SG_ 1022 FRM_51_DetnRelVelRadial_168 "Detection point radial relative velocity
Front Radar Moudle_X_Detection Relative Velocity Radial 
前雷达探测点在径向上的相对速度";
CM_ SG_ 1022 FRM_51_DetnSNR_168 "Detection point signal noise ratio
Front Radar Moudle_X_Detection Signal Noise Ratio
前雷达探测点信号噪声比";
CM_ SG_ 1022 FRM_51_DetnRCS_168 "Detection point radar cross section
Front Radar Moudle_X_Detection Radar Cross Section
前雷达探测点雷达散射截面积";
CM_ SG_ 1022 FRM_51_DetnQuality_168 "Detection point quality
Front Radar Moudle_X_Detection Quality
前雷达探测点质量";
CM_ SG_ 1022 FRM_51_DetnMotionSts_169 "Detection point motion status
Front Radar Moudle_X_Detection Motion Status
前雷达探测点运动状态";
CM_ SG_ 1022 FRM_51_DetnRngRadial_169 "Detection point radial distance
Front Radar Moudle_X_Detection Range Radial
前雷达探测点径向距离";
CM_ SG_ 1022 FRM_51_DetnAziAngle_169 "Detection point azimuth angle
Front Radar Moudle_X_Detection Azimuth Angle
前雷达探测点水平方位角";
CM_ SG_ 1022 FRM_51_DetnElevnAngle_169 "Detection point elevation angle
Front Radar Moudle_X_Detection Elevation Angle
前雷达探测点俯仰角";
CM_ SG_ 1022 FRM_51_DetnRelVelRadial_169 "Detection point radial relative velocity
Front Radar Moudle_X_Detection Relative Velocity Radial 
前雷达探测点在径向上的相对速度";
CM_ SG_ 1022 FRM_51_DetnSNR_169 "Detection point signal noise ratio
Front Radar Moudle_X_Detection Signal Noise Ratio
前雷达探测点信号噪声比";
CM_ SG_ 1022 FRM_51_DetnRCS_169 "Detection point radar cross section
Front Radar Moudle_X_Detection Radar Cross Section
前雷达探测点雷达散射截面积";
CM_ SG_ 1022 FRM_51_DetnQuality_169 "Detection point quality
Front Radar Moudle_X_Detection Quality
前雷达探测点质量";
CM_ SG_ 1022 FRM_51_DetnMotionSts_170 "Detection point motion status
Front Radar Moudle_X_Detection Motion Status
前雷达探测点运动状态";
CM_ SG_ 1022 FRM_51_DetnRngRadial_170 "Detection point radial distance
Front Radar Moudle_X_Detection Range Radial
前雷达探测点径向距离";
CM_ SG_ 1022 FRM_51_DetnAziAngle_170 "Detection point azimuth angle
Front Radar Moudle_X_Detection Azimuth Angle
前雷达探测点水平方位角";
CM_ SG_ 1022 FRM_51_DetnElevnAngle_170 "Detection point elevation angle
Front Radar Moudle_X_Detection Elevation Angle
前雷达探测点俯仰角";
CM_ SG_ 1022 FRM_51_DetnRelVelRadial_170 "Detection point radial relative velocity
Front Radar Moudle_X_Detection Relative Velocity Radial 
前雷达探测点在径向上的相对速度";
CM_ SG_ 1022 FRM_51_DetnSNR_170 "Detection point signal noise ratio
Front Radar Moudle_X_Detection Signal Noise Ratio
前雷达探测点信号噪声比";
CM_ SG_ 1022 FRM_51_DetnRCS_170 "Detection point radar cross section
Front Radar Moudle_X_Detection Radar Cross Section
前雷达探测点雷达散射截面积";
CM_ SG_ 1022 FRM_51_DetnQuality_170 "Detection point quality
Front Radar Moudle_X_Detection Quality
前雷达探测点质量";
CM_ SG_ 1022 FRM_51_DetnMotionSts_171 "Detection point motion status
Front Radar Moudle_X_Detection Motion Status
前雷达探测点运动状态";
CM_ SG_ 1022 FRM_51_DetnRngRadial_171 "Detection point radial distance
Front Radar Moudle_X_Detection Range Radial
前雷达探测点径向距离";
CM_ SG_ 1022 FRM_51_DetnAziAngle_171 "Detection point azimuth angle
Front Radar Moudle_X_Detection Azimuth Angle
前雷达探测点水平方位角";
CM_ SG_ 1022 FRM_51_DetnElevnAngle_171 "Detection point elevation angle
Front Radar Moudle_X_Detection Elevation Angle
前雷达探测点俯仰角";
CM_ SG_ 1022 FRM_51_DetnRelVelRadial_171 "Detection point radial relative velocity
Front Radar Moudle_X_Detection Relative Velocity Radial 
前雷达探测点在径向上的相对速度";
CM_ SG_ 1022 FRM_51_DetnSNR_171 "Detection point signal noise ratio
Front Radar Moudle_X_Detection Signal Noise Ratio
前雷达探测点信号噪声比";
CM_ SG_ 1022 FRM_51_DetnRCS_171 "Detection point radar cross section
Front Radar Moudle_X_Detection Radar Cross Section
前雷达探测点雷达散射截面积";
CM_ SG_ 1022 FRM_51_DetnQuality_171 "Detection point quality
Front Radar Moudle_X_Detection Quality
前雷达探测点质量";
CM_ SG_ 1022 FRM_51_DetnMotionSts_172 "Detection point motion status
Front Radar Moudle_X_Detection Motion Status
前雷达探测点运动状态";
CM_ SG_ 1022 FRM_51_DetnRngRadial_172 "Detection point radial distance
Front Radar Moudle_X_Detection Range Radial
前雷达探测点径向距离";
CM_ SG_ 1022 FRM_51_DetnAziAngle_172 "Detection point azimuth angle
Front Radar Moudle_X_Detection Azimuth Angle
前雷达探测点水平方位角";
CM_ SG_ 1022 FRM_51_DetnElevnAngle_172 "Detection point elevation angle
Front Radar Moudle_X_Detection Elevation Angle
前雷达探测点俯仰角";
CM_ SG_ 1022 FRM_51_DetnRelVelRadial_172 "Detection point radial relative velocity
Front Radar Moudle_X_Detection Relative Velocity Radial 
前雷达探测点在径向上的相对速度";
CM_ SG_ 1022 FRM_51_DetnSNR_172 "Detection point signal noise ratio
Front Radar Moudle_X_Detection Signal Noise Ratio
前雷达探测点信号噪声比";
CM_ SG_ 1022 FRM_51_DetnRCS_172 "Detection point radar cross section
Front Radar Moudle_X_Detection Radar Cross Section
前雷达探测点雷达散射截面积";
CM_ SG_ 1022 FRM_51_DetnQuality_172 "Detection point quality
Front Radar Moudle_X_Detection Quality
前雷达探测点质量";
CM_ SG_ 1022 FRM_51_DetnMotionSts_173 "Detection point motion status
Front Radar Moudle_X_Detection Motion Status
前雷达探测点运动状态";
CM_ SG_ 1022 FRM_51_DetnRngRadial_173 "Detection point radial distance
Front Radar Moudle_X_Detection Range Radial
前雷达探测点径向距离";
CM_ SG_ 1022 FRM_51_DetnAziAngle_173 "Detection point azimuth angle
Front Radar Moudle_X_Detection Azimuth Angle
前雷达探测点水平方位角";
CM_ SG_ 1022 FRM_51_DetnElevnAngle_173 "Detection point elevation angle
Front Radar Moudle_X_Detection Elevation Angle
前雷达探测点俯仰角";
CM_ SG_ 1022 FRM_51_DetnRelVelRadial_173 "Detection point radial relative velocity
Front Radar Moudle_X_Detection Relative Velocity Radial 
前雷达探测点在径向上的相对速度";
CM_ SG_ 1022 FRM_51_DetnSNR_173 "Detection point signal noise ratio
Front Radar Moudle_X_Detection Signal Noise Ratio
前雷达探测点信号噪声比";
CM_ SG_ 1022 FRM_51_DetnRCS_173 "Detection point radar cross section
Front Radar Moudle_X_Detection Radar Cross Section
前雷达探测点雷达散射截面积";
CM_ SG_ 1022 FRM_51_DetnQuality_173 "Detection point quality
Front Radar Moudle_X_Detection Quality
前雷达探测点质量";
CM_ SG_ 1022 FRM_51_Loc168_Valid "the valid flag of each location 
每一点云的有效状态";
CM_ SG_ 1022 FRM_51_Loc169_Valid "the valid flag of each location 
每一点云的有效状态";
CM_ SG_ 1022 FRM_51_Loc170_Valid "the valid flag of each location 
每一点云的有效状态";
CM_ SG_ 1022 FRM_51_Loc171_Valid "the valid flag of each location 
每一点云的有效状态";
CM_ SG_ 1022 FRM_51_Loc172_Valid "the valid flag of each location 
每一点云的有效状态";
CM_ SG_ 1022 FRM_51_Loc173_Valid "the valid flag of each location 
每一点云的有效状态";
CM_ SG_ 1023 FRM_52_CRC "Profile5:E2E CRC16 (polynomial:0x1021)       
DataID:Use CANID,other bits Fill with 0";
CM_ SG_ 1023 FRM_52_RollgCntr "Profile5:E2E Rolling message counter";
CM_ SG_ 1023 FRM_52_DetnBlockCounter "Front Radar Moudle_X_Detection Block Counter
前雷达探测点块计数";
CM_ SG_ 1023 FRM_52_DetnMotionSts_174 "Detection point motion status
Front Radar Moudle_X_Detection Motion Status
前雷达探测点运动状态";
CM_ SG_ 1023 FRM_52_DetnRngRadial_174 "Detection point radial distance
Front Radar Moudle_X_Detection Range Radial
前雷达探测点径向距离";
CM_ SG_ 1023 FRM_52_DetnAziAngle_174 "Detection point azimuth angle
Front Radar Moudle_X_Detection Azimuth Angle
前雷达探测点水平方位角";
CM_ SG_ 1023 FRM_52_DetnElevnAngle_174 "Detection point elevation angle
Front Radar Moudle_X_Detection Elevation Angle
前雷达探测点俯仰角";
CM_ SG_ 1023 FRM_52_DetnRelVelRadial_174 "Detection point radial relative velocity
Front Radar Moudle_X_Detection Relative Velocity Radial 
前雷达探测点在径向上的相对速度";
CM_ SG_ 1023 FRM_52_DetnSNR_174 "Detection point signal noise ratio
Front Radar Moudle_X_Detection Signal Noise Ratio
前雷达探测点信号噪声比";
CM_ SG_ 1023 FRM_52_DetnRCS_174 "Detection point radar cross section
Front Radar Moudle_X_Detection Radar Cross Section
前雷达探测点雷达散射截面积";
CM_ SG_ 1023 FRM_52_DetnQuality_174 "Detection point quality
Front Radar Moudle_X_Detection Quality
前雷达探测点质量";
CM_ SG_ 1023 FRM_52_DetnMotionSts_175 "Detection point motion status
Front Radar Moudle_X_Detection Motion Status
前雷达探测点运动状态";
CM_ SG_ 1023 FRM_52_DetnRngRadial_175 "Detection point radial distance
Front Radar Moudle_X_Detection Range Radial
前雷达探测点径向距离";
CM_ SG_ 1023 FRM_52_DetnAziAngle_175 "Detection point azimuth angle
Front Radar Moudle_X_Detection Azimuth Angle
前雷达探测点水平方位角";
CM_ SG_ 1023 FRM_52_DetnElevnAngle_175 "Detection point elevation angle
Front Radar Moudle_X_Detection Elevation Angle
前雷达探测点俯仰角";
CM_ SG_ 1023 FRM_52_DetnRelVelRadial_175 "Detection point radial relative velocity
Front Radar Moudle_X_Detection Relative Velocity Radial 
前雷达探测点在径向上的相对速度";
CM_ SG_ 1023 FRM_52_DetnSNR_175 "Detection point signal noise ratio
Front Radar Moudle_X_Detection Signal Noise Ratio
前雷达探测点信号噪声比";
CM_ SG_ 1023 FRM_52_DetnRCS_175 "Detection point radar cross section
Front Radar Moudle_X_Detection Radar Cross Section
前雷达探测点雷达散射截面积";
CM_ SG_ 1023 FRM_52_DetnQuality_175 "Detection point quality
Front Radar Moudle_X_Detection Quality
前雷达探测点质量";
CM_ SG_ 1023 FRM_52_DetnMotionSts_176 "Detection point motion status
Front Radar Moudle_X_Detection Motion Status
前雷达探测点运动状态";
CM_ SG_ 1023 FRM_52_DetnRngRadial_176 "Detection point radial distance
Front Radar Moudle_X_Detection Range Radial
前雷达探测点径向距离";
CM_ SG_ 1023 FRM_52_DetnAziAngle_176 "Detection point azimuth angle
Front Radar Moudle_X_Detection Azimuth Angle
前雷达探测点水平方位角";
CM_ SG_ 1023 FRM_52_DetnElevnAngle_176 "Detection point elevation angle
Front Radar Moudle_X_Detection Elevation Angle
前雷达探测点俯仰角";
CM_ SG_ 1023 FRM_52_DetnRelVelRadial_176 "Detection point radial relative velocity
Front Radar Moudle_X_Detection Relative Velocity Radial 
前雷达探测点在径向上的相对速度";
CM_ SG_ 1023 FRM_52_DetnSNR_176 "Detection point signal noise ratio
Front Radar Moudle_X_Detection Signal Noise Ratio
前雷达探测点信号噪声比";
CM_ SG_ 1023 FRM_52_DetnRCS_176 "Detection point radar cross section
Front Radar Moudle_X_Detection Radar Cross Section
前雷达探测点雷达散射截面积";
CM_ SG_ 1023 FRM_52_DetnQuality_176 "Detection point quality
Front Radar Moudle_X_Detection Quality
前雷达探测点质量";
CM_ SG_ 1023 FRM_52_DetnMotionSts_177 "Detection point motion status
Front Radar Moudle_X_Detection Motion Status
前雷达探测点运动状态";
CM_ SG_ 1023 FRM_52_DetnRngRadial_177 "Detection point radial distance
Front Radar Moudle_X_Detection Range Radial
前雷达探测点径向距离";
CM_ SG_ 1023 FRM_52_DetnAziAngle_177 "Detection point azimuth angle
Front Radar Moudle_X_Detection Azimuth Angle
前雷达探测点水平方位角";
CM_ SG_ 1023 FRM_52_DetnElevnAngle_177 "Detection point elevation angle
Front Radar Moudle_X_Detection Elevation Angle
前雷达探测点俯仰角";
CM_ SG_ 1023 FRM_52_DetnRelVelRadial_177 "Detection point radial relative velocity
Front Radar Moudle_X_Detection Relative Velocity Radial 
前雷达探测点在径向上的相对速度";
CM_ SG_ 1023 FRM_52_DetnSNR_177 "Detection point signal noise ratio
Front Radar Moudle_X_Detection Signal Noise Ratio
前雷达探测点信号噪声比";
CM_ SG_ 1023 FRM_52_DetnRCS_177 "Detection point radar cross section
Front Radar Moudle_X_Detection Radar Cross Section
前雷达探测点雷达散射截面积";
CM_ SG_ 1023 FRM_52_DetnQuality_177 "Detection point quality
Front Radar Moudle_X_Detection Quality
前雷达探测点质量";
CM_ SG_ 1023 FRM_52_DetnMotionSts_178 "Detection point motion status
Front Radar Moudle_X_Detection Motion Status
前雷达探测点运动状态";
CM_ SG_ 1023 FRM_52_DetnRngRadial_178 "Detection point radial distance
Front Radar Moudle_X_Detection Range Radial
前雷达探测点径向距离";
CM_ SG_ 1023 FRM_52_DetnAziAngle_178 "Detection point azimuth angle
Front Radar Moudle_X_Detection Azimuth Angle
前雷达探测点水平方位角";
CM_ SG_ 1023 FRM_52_DetnElevnAngle_178 "Detection point elevation angle
Front Radar Moudle_X_Detection Elevation Angle
前雷达探测点俯仰角";
CM_ SG_ 1023 FRM_52_DetnRelVelRadial_178 "Detection point radial relative velocity
Front Radar Moudle_X_Detection Relative Velocity Radial 
前雷达探测点在径向上的相对速度";
CM_ SG_ 1023 FRM_52_DetnSNR_178 "Detection point signal noise ratio
Front Radar Moudle_X_Detection Signal Noise Ratio
前雷达探测点信号噪声比";
CM_ SG_ 1023 FRM_52_DetnRCS_178 "Detection point radar cross section
Front Radar Moudle_X_Detection Radar Cross Section
前雷达探测点雷达散射截面积";
CM_ SG_ 1023 FRM_52_DetnQuality_178 "Detection point quality
Front Radar Moudle_X_Detection Quality
前雷达探测点质量";
CM_ SG_ 1023 FRM_52_DetnMotionSts_179 "Detection point motion status
Front Radar Moudle_X_Detection Motion Status
前雷达探测点运动状态";
CM_ SG_ 1023 FRM_52_DetnRngRadial_179 "Detection point radial distance
Front Radar Moudle_X_Detection Range Radial
前雷达探测点径向距离";
CM_ SG_ 1023 FRM_52_DetnAziAngle_179 "Detection point azimuth angle
Front Radar Moudle_X_Detection Azimuth Angle
前雷达探测点水平方位角";
CM_ SG_ 1023 FRM_52_DetnElevnAngle_179 "Detection point elevation angle
Front Radar Moudle_X_Detection Elevation Angle
前雷达探测点俯仰角";
CM_ SG_ 1023 FRM_52_DetnRelVelRadial_179 "Detection point radial relative velocity
Front Radar Moudle_X_Detection Relative Velocity Radial 
前雷达探测点在径向上的相对速度";
CM_ SG_ 1023 FRM_52_DetnSNR_179 "Detection point signal noise ratio
Front Radar Moudle_X_Detection Signal Noise Ratio
前雷达探测点信号噪声比";
CM_ SG_ 1023 FRM_52_DetnRCS_179 "Detection point radar cross section
Front Radar Moudle_X_Detection Radar Cross Section
前雷达探测点雷达散射截面积";
CM_ SG_ 1023 FRM_52_DetnQuality_179 "Detection point quality
Front Radar Moudle_X_Detection Quality
前雷达探测点质量";
CM_ SG_ 1023 FRM_52_Loc174_Valid "the valid flag of each location 
每一点云的有效状态";
CM_ SG_ 1023 FRM_52_Loc175_Valid "the valid flag of each location 
每一点云的有效状态";
CM_ SG_ 1023 FRM_52_Loc176_Valid "the valid flag of each location 
每一点云的有效状态";
CM_ SG_ 1023 FRM_52_Loc177_Valid "the valid flag of each location 
每一点云的有效状态";
CM_ SG_ 1023 FRM_52_Loc178_Valid "the valid flag of each location 
每一点云的有效状态";
CM_ SG_ 1023 FRM_52_Loc179_Valid "the valid flag of each location 
每一点云的有效状态";
CM_ SG_ 1024 FRM_53_CRC "Profile5:E2E CRC16 (polynomial:0x1021)       
DataID:Use CANID,other bits Fill with 0";
CM_ SG_ 1024 FRM_53_RollgCntr "Profile5:E2E Rolling message counter";
CM_ SG_ 1024 FRM_53_DetnBlockCounter "Front Radar Moudle_X_Detection Block Counter
前雷达探测点块计数";
CM_ SG_ 1024 FRM_53_DetnMotionSts_180 "Detection point motion status
Front Radar Moudle_X_Detection Motion Status
前雷达探测点运动状态";
CM_ SG_ 1024 FRM_53_DetnRngRadial_180 "Detection point radial distance
Front Radar Moudle_X_Detection Range Radial
前雷达探测点径向距离";
CM_ SG_ 1024 FRM_53_DetnAziAngle_180 "Detection point azimuth angle
Front Radar Moudle_X_Detection Azimuth Angle
前雷达探测点水平方位角";
CM_ SG_ 1024 FRM_53_DetnElevnAngle_180 "Detection point elevation angle
Front Radar Moudle_X_Detection Elevation Angle
前雷达探测点俯仰角";
CM_ SG_ 1024 FRM_53_DetnRelVelRadial_180 "Detection point radial relative velocity
Front Radar Moudle_X_Detection Relative Velocity Radial 
前雷达探测点在径向上的相对速度";
CM_ SG_ 1024 FRM_53_DetnSNR_180 "Detection point signal noise ratio
Front Radar Moudle_X_Detection Signal Noise Ratio
前雷达探测点信号噪声比";
CM_ SG_ 1024 FRM_53_DetnRCS_180 "Detection point radar cross section
Front Radar Moudle_X_Detection Radar Cross Section
前雷达探测点雷达散射截面积";
CM_ SG_ 1024 FRM_53_DetnQuality_180 "Detection point quality
Front Radar Moudle_X_Detection Quality
前雷达探测点质量";
CM_ SG_ 1024 FRM_53_DetnMotionSts_181 "Detection point motion status
Front Radar Moudle_X_Detection Motion Status
前雷达探测点运动状态";
CM_ SG_ 1024 FRM_53_DetnRngRadial_181 "Detection point radial distance
Front Radar Moudle_X_Detection Range Radial
前雷达探测点径向距离";
CM_ SG_ 1024 FRM_53_DetnAziAngle_181 "Detection point azimuth angle
Front Radar Moudle_X_Detection Azimuth Angle
前雷达探测点水平方位角";
CM_ SG_ 1024 FRM_53_DetnElevnAngle_181 "Detection point elevation angle
Front Radar Moudle_X_Detection Elevation Angle
前雷达探测点俯仰角";
CM_ SG_ 1024 FRM_53_DetnRelVelRadial_181 "Detection point radial relative velocity
Front Radar Moudle_X_Detection Relative Velocity Radial 
前雷达探测点在径向上的相对速度";
CM_ SG_ 1024 FRM_53_DetnSNR_181 "Detection point signal noise ratio
Front Radar Moudle_X_Detection Signal Noise Ratio
前雷达探测点信号噪声比";
CM_ SG_ 1024 FRM_53_DetnRCS_181 "Detection point radar cross section
Front Radar Moudle_X_Detection Radar Cross Section
前雷达探测点雷达散射截面积";
CM_ SG_ 1024 FRM_53_DetnQuality_181 "Detection point quality
Front Radar Moudle_X_Detection Quality
前雷达探测点质量";
CM_ SG_ 1024 FRM_53_DetnMotionSts_182 "Detection point motion status
Front Radar Moudle_X_Detection Motion Status
前雷达探测点运动状态";
CM_ SG_ 1024 FRM_53_DetnRngRadial_182 "Detection point radial distance
Front Radar Moudle_X_Detection Range Radial
前雷达探测点径向距离";
CM_ SG_ 1024 FRM_53_DetnAziAngle_182 "Detection point azimuth angle
Front Radar Moudle_X_Detection Azimuth Angle
前雷达探测点水平方位角";
CM_ SG_ 1024 FRM_53_DetnElevnAngle_182 "Detection point elevation angle
Front Radar Moudle_X_Detection Elevation Angle
前雷达探测点俯仰角";
CM_ SG_ 1024 FRM_53_DetnRelVelRadial_182 "Detection point radial relative velocity
Front Radar Moudle_X_Detection Relative Velocity Radial 
前雷达探测点在径向上的相对速度";
CM_ SG_ 1024 FRM_53_DetnSNR_182 "Detection point signal noise ratio
Front Radar Moudle_X_Detection Signal Noise Ratio
前雷达探测点信号噪声比";
CM_ SG_ 1024 FRM_53_DetnRCS_182 "Detection point radar cross section
Front Radar Moudle_X_Detection Radar Cross Section
前雷达探测点雷达散射截面积";
CM_ SG_ 1024 FRM_53_DetnQuality_182 "Detection point quality
Front Radar Moudle_X_Detection Quality
前雷达探测点质量";
CM_ SG_ 1024 FRM_53_DetnMotionSts_183 "Detection point motion status
Front Radar Moudle_X_Detection Motion Status
前雷达探测点运动状态";
CM_ SG_ 1024 FRM_53_DetnRngRadial_183 "Detection point radial distance
Front Radar Moudle_X_Detection Range Radial
前雷达探测点径向距离";
CM_ SG_ 1024 FRM_53_DetnAziAngle_183 "Detection point azimuth angle
Front Radar Moudle_X_Detection Azimuth Angle
前雷达探测点水平方位角";
CM_ SG_ 1024 FRM_53_DetnElevnAngle_183 "Detection point elevation angle
Front Radar Moudle_X_Detection Elevation Angle
前雷达探测点俯仰角";
CM_ SG_ 1024 FRM_53_DetnRelVelRadial_183 "Detection point radial relative velocity
Front Radar Moudle_X_Detection Relative Velocity Radial 
前雷达探测点在径向上的相对速度";
CM_ SG_ 1024 FRM_53_DetnSNR_183 "Detection point signal noise ratio
Front Radar Moudle_X_Detection Signal Noise Ratio
前雷达探测点信号噪声比";
CM_ SG_ 1024 FRM_53_DetnRCS_183 "Detection point radar cross section
Front Radar Moudle_X_Detection Radar Cross Section
前雷达探测点雷达散射截面积";
CM_ SG_ 1024 FRM_53_DetnQuality_183 "Detection point quality
Front Radar Moudle_X_Detection Quality
前雷达探测点质量";
CM_ SG_ 1024 FRM_53_DetnMotionSts_184 "Detection point motion status
Front Radar Moudle_X_Detection Motion Status
前雷达探测点运动状态";
CM_ SG_ 1024 FRM_53_DetnRngRadial_184 "Detection point radial distance
Front Radar Moudle_X_Detection Range Radial
前雷达探测点径向距离";
CM_ SG_ 1024 FRM_53_DetnAziAngle_184 "Detection point azimuth angle
Front Radar Moudle_X_Detection Azimuth Angle
前雷达探测点水平方位角";
CM_ SG_ 1024 FRM_53_DetnElevnAngle_184 "Detection point elevation angle
Front Radar Moudle_X_Detection Elevation Angle
前雷达探测点俯仰角";
CM_ SG_ 1024 FRM_53_DetnRelVelRadial_184 "Detection point radial relative velocity
Front Radar Moudle_X_Detection Relative Velocity Radial 
前雷达探测点在径向上的相对速度";
CM_ SG_ 1024 FRM_53_DetnSNR_184 "Detection point signal noise ratio
Front Radar Moudle_X_Detection Signal Noise Ratio
前雷达探测点信号噪声比";
CM_ SG_ 1024 FRM_53_DetnRCS_184 "Detection point radar cross section
Front Radar Moudle_X_Detection Radar Cross Section
前雷达探测点雷达散射截面积";
CM_ SG_ 1024 FRM_53_DetnQuality_184 "Detection point quality
Front Radar Moudle_X_Detection Quality
前雷达探测点质量";
CM_ SG_ 1024 FRM_53_DetnMotionSts_185 "Detection point motion status
Front Radar Moudle_X_Detection Motion Status
前雷达探测点运动状态";
CM_ SG_ 1024 FRM_53_DetnRngRadial_185 "Detection point radial distance
Front Radar Moudle_X_Detection Range Radial
前雷达探测点径向距离";
CM_ SG_ 1024 FRM_53_DetnAziAngle_185 "Detection point azimuth angle
Front Radar Moudle_X_Detection Azimuth Angle
前雷达探测点水平方位角";
CM_ SG_ 1024 FRM_53_DetnElevnAngle_185 "Detection point elevation angle
Front Radar Moudle_X_Detection Elevation Angle
前雷达探测点俯仰角";
CM_ SG_ 1024 FRM_53_DetnRelVelRadial_185 "Detection point radial relative velocity
Front Radar Moudle_X_Detection Relative Velocity Radial 
前雷达探测点在径向上的相对速度";
CM_ SG_ 1024 FRM_53_DetnSNR_185 "Detection point signal noise ratio
Front Radar Moudle_X_Detection Signal Noise Ratio
前雷达探测点信号噪声比";
CM_ SG_ 1024 FRM_53_DetnRCS_185 "Detection point radar cross section
Front Radar Moudle_X_Detection Radar Cross Section
前雷达探测点雷达散射截面积";
CM_ SG_ 1024 FRM_53_DetnQuality_185 "Detection point quality
Front Radar Moudle_X_Detection Quality
前雷达探测点质量";
CM_ SG_ 1024 FRM_53_Loc180_Valid "the valid flag of each location 
每一点云的有效状态";
CM_ SG_ 1024 FRM_53_Loc181_Valid "the valid flag of each location 
每一点云的有效状态";
CM_ SG_ 1024 FRM_53_Loc182_Valid "the valid flag of each location 
每一点云的有效状态";
CM_ SG_ 1024 FRM_53_Loc183_Valid "the valid flag of each location 
每一点云的有效状态";
CM_ SG_ 1024 FRM_53_Loc184_Valid "the valid flag of each location 
每一点云的有效状态";
CM_ SG_ 1024 FRM_53_Loc185_Valid "the valid flag of each location 
每一点云的有效状态";
CM_ SG_ 1025 FRM_54_CRC "Profile5:E2E CRC16 (polynomial:0x1021)       
DataID:Use CANID,other bits Fill with 0";
CM_ SG_ 1025 FRM_54_RollgCntr "Profile5:E2E Rolling message counter";
CM_ SG_ 1025 FRM_54_DetnBlockCounter "Front Radar Moudle_X_Detection Block Counter
前雷达探测点块计数";
CM_ SG_ 1025 FRM_54_DetnMotionSts_186 "Detection point motion status
Front Radar Moudle_X_Detection Motion Status
前雷达探测点运动状态";
CM_ SG_ 1025 FRM_54_DetnRngRadial_186 "Detection point radial distance
Front Radar Moudle_X_Detection Range Radial
前雷达探测点径向距离";
CM_ SG_ 1025 FRM_54_DetnAziAngle_186 "Detection point azimuth angle
Front Radar Moudle_X_Detection Azimuth Angle
前雷达探测点水平方位角";
CM_ SG_ 1025 FRM_54_DetnElevnAngle_186 "Detection point elevation angle
Front Radar Moudle_X_Detection Elevation Angle
前雷达探测点俯仰角";
CM_ SG_ 1025 FRM_54_DetnRelVelRadial_186 "Detection point radial relative velocity
Front Radar Moudle_X_Detection Relative Velocity Radial 
前雷达探测点在径向上的相对速度";
CM_ SG_ 1025 FRM_54_DetnSNR_186 "Detection point signal noise ratio
Front Radar Moudle_X_Detection Signal Noise Ratio
前雷达探测点信号噪声比";
CM_ SG_ 1025 FRM_54_DetnRCS_186 "Detection point radar cross section
Front Radar Moudle_X_Detection Radar Cross Section
前雷达探测点雷达散射截面积";
CM_ SG_ 1025 FRM_54_DetnQuality_186 "Detection point quality
Front Radar Moudle_X_Detection Quality
前雷达探测点质量";
CM_ SG_ 1025 FRM_54_DetnMotionSts_187 "Detection point motion status
Front Radar Moudle_X_Detection Motion Status
前雷达探测点运动状态";
CM_ SG_ 1025 FRM_54_DetnRngRadial_187 "Detection point radial distance
Front Radar Moudle_X_Detection Range Radial
前雷达探测点径向距离";
CM_ SG_ 1025 FRM_54_DetnAziAngle_187 "Detection point azimuth angle
Front Radar Moudle_X_Detection Azimuth Angle
前雷达探测点水平方位角";
CM_ SG_ 1025 FRM_54_DetnElevnAngle_187 "Detection point elevation angle
Front Radar Moudle_X_Detection Elevation Angle
前雷达探测点俯仰角";
CM_ SG_ 1025 FRM_54_DetnRelVelRadial_187 "Detection point radial relative velocity
Front Radar Moudle_X_Detection Relative Velocity Radial 
前雷达探测点在径向上的相对速度";
CM_ SG_ 1025 FRM_54_DetnSNR_187 "Detection point signal noise ratio
Front Radar Moudle_X_Detection Signal Noise Ratio
前雷达探测点信号噪声比";
CM_ SG_ 1025 FRM_54_DetnRCS_187 "Detection point radar cross section
Front Radar Moudle_X_Detection Radar Cross Section
前雷达探测点雷达散射截面积";
CM_ SG_ 1025 FRM_54_DetnQuality_187 "Detection point quality
Front Radar Moudle_X_Detection Quality
前雷达探测点质量";
CM_ SG_ 1025 FRM_54_DetnMotionSts_188 "Detection point motion status
Front Radar Moudle_X_Detection Motion Status
前雷达探测点运动状态";
CM_ SG_ 1025 FRM_54_DetnRngRadial_188 "Detection point radial distance
Front Radar Moudle_X_Detection Range Radial
前雷达探测点径向距离";
CM_ SG_ 1025 FRM_54_DetnAziAngle_188 "Detection point azimuth angle
Front Radar Moudle_X_Detection Azimuth Angle
前雷达探测点水平方位角";
CM_ SG_ 1025 FRM_54_DetnElevnAngle_188 "Detection point elevation angle
Front Radar Moudle_X_Detection Elevation Angle
前雷达探测点俯仰角";
CM_ SG_ 1025 FRM_54_DetnRelVelRadial_188 "Detection point radial relative velocity
Front Radar Moudle_X_Detection Relative Velocity Radial 
前雷达探测点在径向上的相对速度";
CM_ SG_ 1025 FRM_54_DetnSNR_188 "Detection point signal noise ratio
Front Radar Moudle_X_Detection Signal Noise Ratio
前雷达探测点信号噪声比";
CM_ SG_ 1025 FRM_54_DetnRCS_188 "Detection point radar cross section
Front Radar Moudle_X_Detection Radar Cross Section
前雷达探测点雷达散射截面积";
CM_ SG_ 1025 FRM_54_DetnQuality_188 "Detection point quality
Front Radar Moudle_X_Detection Quality
前雷达探测点质量";
CM_ SG_ 1025 FRM_54_DetnMotionSts_189 "Detection point motion status
Front Radar Moudle_X_Detection Motion Status
前雷达探测点运动状态";
CM_ SG_ 1025 FRM_54_DetnRngRadial_189 "Detection point radial distance
Front Radar Moudle_X_Detection Range Radial
前雷达探测点径向距离";
CM_ SG_ 1025 FRM_54_DetnAziAngle_189 "Detection point azimuth angle
Front Radar Moudle_X_Detection Azimuth Angle
前雷达探测点水平方位角";
CM_ SG_ 1025 FRM_54_DetnElevnAngle_189 "Detection point elevation angle
Front Radar Moudle_X_Detection Elevation Angle
前雷达探测点俯仰角";
CM_ SG_ 1025 FRM_54_DetnRelVelRadial_189 "Detection point radial relative velocity
Front Radar Moudle_X_Detection Relative Velocity Radial 
前雷达探测点在径向上的相对速度";
CM_ SG_ 1025 FRM_54_DetnSNR_189 "Detection point signal noise ratio
Front Radar Moudle_X_Detection Signal Noise Ratio
前雷达探测点信号噪声比";
CM_ SG_ 1025 FRM_54_DetnRCS_189 "Detection point radar cross section
Front Radar Moudle_X_Detection Radar Cross Section
前雷达探测点雷达散射截面积";
CM_ SG_ 1025 FRM_54_DetnQuality_189 "Detection point quality
Front Radar Moudle_X_Detection Quality
前雷达探测点质量";
CM_ SG_ 1025 FRM_54_DetnMotionSts_190 "Detection point motion status
Front Radar Moudle_X_Detection Motion Status
前雷达探测点运动状态";
CM_ SG_ 1025 FRM_54_DetnRngRadial_190 "Detection point radial distance
Front Radar Moudle_X_Detection Range Radial
前雷达探测点径向距离";
CM_ SG_ 1025 FRM_54_DetnAziAngle_190 "Detection point azimuth angle
Front Radar Moudle_X_Detection Azimuth Angle
前雷达探测点水平方位角";
CM_ SG_ 1025 FRM_54_DetnElevnAngle_190 "Detection point elevation angle
Front Radar Moudle_X_Detection Elevation Angle
前雷达探测点俯仰角";
CM_ SG_ 1025 FRM_54_DetnRelVelRadial_190 "Detection point radial relative velocity
Front Radar Moudle_X_Detection Relative Velocity Radial 
前雷达探测点在径向上的相对速度";
CM_ SG_ 1025 FRM_54_DetnSNR_190 "Detection point signal noise ratio
Front Radar Moudle_X_Detection Signal Noise Ratio
前雷达探测点信号噪声比";
CM_ SG_ 1025 FRM_54_DetnRCS_190 "Detection point radar cross section
Front Radar Moudle_X_Detection Radar Cross Section
前雷达探测点雷达散射截面积";
CM_ SG_ 1025 FRM_54_DetnQuality_190 "Detection point quality
Front Radar Moudle_X_Detection Quality
前雷达探测点质量";
CM_ SG_ 1025 FRM_54_DetnMotionSts_191 "Detection point motion status
Front Radar Moudle_X_Detection Motion Status
前雷达探测点运动状态";
CM_ SG_ 1025 FRM_54_DetnRngRadial_191 "Detection point radial distance
Front Radar Moudle_X_Detection Range Radial
前雷达探测点径向距离";
CM_ SG_ 1025 FRM_54_DetnAziAngle_191 "Detection point azimuth angle
Front Radar Moudle_X_Detection Azimuth Angle
前雷达探测点水平方位角";
CM_ SG_ 1025 FRM_54_DetnElevnAngle_191 "Detection point elevation angle
Front Radar Moudle_X_Detection Elevation Angle
前雷达探测点俯仰角";
CM_ SG_ 1025 FRM_54_DetnRelVelRadial_191 "Detection point radial relative velocity
Front Radar Moudle_X_Detection Relative Velocity Radial 
前雷达探测点在径向上的相对速度";
CM_ SG_ 1025 FRM_54_DetnSNR_191 "Detection point signal noise ratio
Front Radar Moudle_X_Detection Signal Noise Ratio
前雷达探测点信号噪声比";
CM_ SG_ 1025 FRM_54_DetnRCS_191 "Detection point radar cross section
Front Radar Moudle_X_Detection Radar Cross Section
前雷达探测点雷达散射截面积";
CM_ SG_ 1025 FRM_54_DetnQuality_191 "Detection point quality
Front Radar Moudle_X_Detection Quality
前雷达探测点质量";
CM_ SG_ 1025 FRM_54_Loc186_Valid "the valid flag of each location 
每一点云的有效状态";
CM_ SG_ 1025 FRM_54_Loc187_Valid "the valid flag of each location 
每一点云的有效状态";
CM_ SG_ 1025 FRM_54_Loc188_Valid "the valid flag of each location 
每一点云的有效状态";
CM_ SG_ 1025 FRM_54_Loc189_Valid "the valid flag of each location 
每一点云的有效状态";
CM_ SG_ 1025 FRM_54_Loc190_Valid "the valid flag of each location 
每一点云的有效状态";
CM_ SG_ 1025 FRM_54_Loc191_Valid "the valid flag of each location 
每一点云的有效状态";
CM_ SG_ 1026 FRM_55_CRC "Profile5:E2E CRC16 (polynomial:0x1021)       
DataID:Use CANID,other bits Fill with 0";
CM_ SG_ 1026 FRM_55_RollgCntr "Profile5:E2E Rolling message counter";
CM_ SG_ 1026 FRM_55_DetnBlockCounter "Front Radar Moudle_X_Detection Block Counter
前雷达探测点块计数";
CM_ SG_ 1026 FRM_55_DetnMotionSts_192 "Detection point motion status
Front Radar Moudle_X_Detection Motion Status
前雷达探测点运动状态";
CM_ SG_ 1026 FRM_55_DetnRngRadial_192 "Detection point radial distance
Front Radar Moudle_X_Detection Range Radial
前雷达探测点径向距离";
CM_ SG_ 1026 FRM_55_DetnAziAngle_192 "Detection point azimuth angle
Front Radar Moudle_X_Detection Azimuth Angle
前雷达探测点水平方位角";
CM_ SG_ 1026 FRM_55_DetnElevnAngle_192 "Detection point elevation angle
Front Radar Moudle_X_Detection Elevation Angle
前雷达探测点俯仰角";
CM_ SG_ 1026 FRM_55_DetnRelVelRadial_192 "Detection point radial relative velocity
Front Radar Moudle_X_Detection Relative Velocity Radial 
前雷达探测点在径向上的相对速度";
CM_ SG_ 1026 FRM_55_DetnSNR_192 "Detection point signal noise ratio
Front Radar Moudle_X_Detection Signal Noise Ratio
前雷达探测点信号噪声比";
CM_ SG_ 1026 FRM_55_DetnRCS_192 "Detection point radar cross section
Front Radar Moudle_X_Detection Radar Cross Section
前雷达探测点雷达散射截面积";
CM_ SG_ 1026 FRM_55_DetnQuality_192 "Detection point quality
Front Radar Moudle_X_Detection Quality
前雷达探测点质量";
CM_ SG_ 1026 FRM_55_DetnMotionSts_193 "Detection point motion status
Front Radar Moudle_X_Detection Motion Status
前雷达探测点运动状态";
CM_ SG_ 1026 FRM_55_DetnRngRadial_193 "Detection point radial distance
Front Radar Moudle_X_Detection Range Radial
前雷达探测点径向距离";
CM_ SG_ 1026 FRM_55_DetnAziAngle_193 "Detection point azimuth angle
Front Radar Moudle_X_Detection Azimuth Angle
前雷达探测点水平方位角";
CM_ SG_ 1026 FRM_55_DetnElevnAngle_193 "Detection point elevation angle
Front Radar Moudle_X_Detection Elevation Angle
前雷达探测点俯仰角";
CM_ SG_ 1026 FRM_55_DetnRelVelRadial_193 "Detection point radial relative velocity
Front Radar Moudle_X_Detection Relative Velocity Radial 
前雷达探测点在径向上的相对速度";
CM_ SG_ 1026 FRM_55_DetnSNR_193 "Detection point signal noise ratio
Front Radar Moudle_X_Detection Signal Noise Ratio
前雷达探测点信号噪声比";
CM_ SG_ 1026 FRM_55_DetnRCS_193 "Detection point radar cross section
Front Radar Moudle_X_Detection Radar Cross Section
前雷达探测点雷达散射截面积";
CM_ SG_ 1026 FRM_55_DetnQuality_193 "Detection point quality
Front Radar Moudle_X_Detection Quality
前雷达探测点质量";
CM_ SG_ 1026 FRM_55_DetnMotionSts_194 "Detection point motion status
Front Radar Moudle_X_Detection Motion Status
前雷达探测点运动状态";
CM_ SG_ 1026 FRM_55_DetnRngRadial_194 "Detection point radial distance
Front Radar Moudle_X_Detection Range Radial
前雷达探测点径向距离";
CM_ SG_ 1026 FRM_55_DetnAziAngle_194 "Detection point azimuth angle
Front Radar Moudle_X_Detection Azimuth Angle
前雷达探测点水平方位角";
CM_ SG_ 1026 FRM_55_DetnElevnAngle_194 "Detection point elevation angle
Front Radar Moudle_X_Detection Elevation Angle
前雷达探测点俯仰角";
CM_ SG_ 1026 FRM_55_DetnRelVelRadial_194 "Detection point radial relative velocity
Front Radar Moudle_X_Detection Relative Velocity Radial 
前雷达探测点在径向上的相对速度";
CM_ SG_ 1026 FRM_55_DetnSNR_194 "Detection point signal noise ratio
Front Radar Moudle_X_Detection Signal Noise Ratio
前雷达探测点信号噪声比";
CM_ SG_ 1026 FRM_55_DetnRCS_194 "Detection point radar cross section
Front Radar Moudle_X_Detection Radar Cross Section
前雷达探测点雷达散射截面积";
CM_ SG_ 1026 FRM_55_DetnQuality_194 "Detection point quality
Front Radar Moudle_X_Detection Quality
前雷达探测点质量";
CM_ SG_ 1026 FRM_55_DetnMotionSts_195 "Detection point motion status
Front Radar Moudle_X_Detection Motion Status
前雷达探测点运动状态";
CM_ SG_ 1026 FRM_55_DetnRngRadial_195 "Detection point radial distance
Front Radar Moudle_X_Detection Range Radial
前雷达探测点径向距离";
CM_ SG_ 1026 FRM_55_DetnAziAngle_195 "Detection point azimuth angle
Front Radar Moudle_X_Detection Azimuth Angle
前雷达探测点水平方位角";
CM_ SG_ 1026 FRM_55_DetnElevnAngle_195 "Detection point elevation angle
Front Radar Moudle_X_Detection Elevation Angle
前雷达探测点俯仰角";
CM_ SG_ 1026 FRM_55_DetnRelVelRadial_195 "Detection point radial relative velocity
Front Radar Moudle_X_Detection Relative Velocity Radial 
前雷达探测点在径向上的相对速度";
CM_ SG_ 1026 FRM_55_DetnSNR_195 "Detection point signal noise ratio
Front Radar Moudle_X_Detection Signal Noise Ratio
前雷达探测点信号噪声比";
CM_ SG_ 1026 FRM_55_DetnRCS_195 "Detection point radar cross section
Front Radar Moudle_X_Detection Radar Cross Section
前雷达探测点雷达散射截面积";
CM_ SG_ 1026 FRM_55_DetnQuality_195 "Detection point quality
Front Radar Moudle_X_Detection Quality
前雷达探测点质量";
CM_ SG_ 1026 FRM_55_DetnMotionSts_196 "Detection point motion status
Front Radar Moudle_X_Detection Motion Status
前雷达探测点运动状态";
CM_ SG_ 1026 FRM_55_DetnRngRadial_196 "Detection point radial distance
Front Radar Moudle_X_Detection Range Radial
前雷达探测点径向距离";
CM_ SG_ 1026 FRM_55_DetnAziAngle_196 "Detection point azimuth angle
Front Radar Moudle_X_Detection Azimuth Angle
前雷达探测点水平方位角";
CM_ SG_ 1026 FRM_55_DetnElevnAngle_196 "Detection point elevation angle
Front Radar Moudle_X_Detection Elevation Angle
前雷达探测点俯仰角";
CM_ SG_ 1026 FRM_55_DetnRelVelRadial_196 "Detection point radial relative velocity
Front Radar Moudle_X_Detection Relative Velocity Radial 
前雷达探测点在径向上的相对速度";
CM_ SG_ 1026 FRM_55_DetnSNR_196 "Detection point signal noise ratio
Front Radar Moudle_X_Detection Signal Noise Ratio
前雷达探测点信号噪声比";
CM_ SG_ 1026 FRM_55_DetnRCS_196 "Detection point radar cross section
Front Radar Moudle_X_Detection Radar Cross Section
前雷达探测点雷达散射截面积";
CM_ SG_ 1026 FRM_55_DetnQuality_196 "Detection point quality
Front Radar Moudle_X_Detection Quality
前雷达探测点质量";
CM_ SG_ 1026 FRM_55_DetnMotionSts_197 "Detection point motion status
Front Radar Moudle_X_Detection Motion Status
前雷达探测点运动状态";
CM_ SG_ 1026 FRM_55_DetnRngRadial_197 "Detection point radial distance
Front Radar Moudle_X_Detection Range Radial
前雷达探测点径向距离";
CM_ SG_ 1026 FRM_55_DetnAziAngle_197 "Detection point azimuth angle
Front Radar Moudle_X_Detection Azimuth Angle
前雷达探测点水平方位角";
CM_ SG_ 1026 FRM_55_DetnElevnAngle_197 "Detection point elevation angle
Front Radar Moudle_X_Detection Elevation Angle
前雷达探测点俯仰角";
CM_ SG_ 1026 FRM_55_DetnRelVelRadial_197 "Detection point radial relative velocity
Front Radar Moudle_X_Detection Relative Velocity Radial 
前雷达探测点在径向上的相对速度";
CM_ SG_ 1026 FRM_55_DetnSNR_197 "Detection point signal noise ratio
Front Radar Moudle_X_Detection Signal Noise Ratio
前雷达探测点信号噪声比";
CM_ SG_ 1026 FRM_55_DetnRCS_197 "Detection point radar cross section
Front Radar Moudle_X_Detection Radar Cross Section
前雷达探测点雷达散射截面积";
CM_ SG_ 1026 FRM_55_DetnQuality_197 "Detection point quality
Front Radar Moudle_X_Detection Quality
前雷达探测点质量";
CM_ SG_ 1026 FRM_55_Loc192_Valid "the valid flag of each location 
每一点云的有效状态";
CM_ SG_ 1026 FRM_55_Loc193_Valid "the valid flag of each location 
每一点云的有效状态";
CM_ SG_ 1026 FRM_55_Loc194_Valid "the valid flag of each location 
每一点云的有效状态";
CM_ SG_ 1026 FRM_55_Loc195_Valid "the valid flag of each location 
每一点云的有效状态";
CM_ SG_ 1026 FRM_55_Loc196_Valid "the valid flag of each location 
每一点云的有效状态";
CM_ SG_ 1026 FRM_55_Loc197_Valid "the valid flag of each location 
每一点云的有效状态";

BA_DEF_ BO_  "GenMsgSendType" ENUM  "Cyclic","Event","IfActive","CE","CA","NoMsgSendType";
BA_DEF_ BO_  "GenMsgCycleTime" INT 0 0;
BA_DEF_ SG_  "GenSigSendType" ENUM  "Cyclic","OnChange","OnWrite","IfActive","OnChangeWithRepetition","OnWriteWithRepetition","IfActiveWithRepetition","NoSigSendType","OnChangeAndIfActive","OnChangeAndIfActiveWithRepetition","CA","CE","Event";
BA_DEF_ SG_  "GenSigStartValue" INT 0 0;
BA_DEF_ BO_  "GenMsgCycleTimeFast" INT 0 0;
BA_DEF_ BO_  "GenMsgNrOfRepetition" INT 0 0;
BA_DEF_ BO_  "GenMsgDelayTime" INT 0 0;
BA_DEF_ BO_  "CANFD_BRS" ENUM  "0","1";
BA_DEF_ BO_  "VFrameFormat" ENUM  "StandardCAN","ExtendedCAN","reserved","reserved","reserved","reserved","reserved","reserved","reserved","reserved","reserved","reserved","reserved","reserved","StandardCAN_FD","ExtendedCAN_FD";
BA_DEF_ BO_  "GenMsgILSupport" ENUM  "No","Yes";
BA_DEF_ SG_ "GenSigASIL" ENUM "QM","A","B","C","D","";
BA_DEF_DEF_  "GenMsgSendType" "Cyclic";
BA_DEF_DEF_  "GenMsgCycleTime" 0;
BA_DEF_DEF_  "GenSigSendType" "Cyclic";
BA_DEF_DEF_  "GenSigStartValue" 0;
BA_DEF_DEF_  "GenMsgCycleTimeFast" 0;
BA_DEF_DEF_  "GenMsgNrOfRepetition" 0;
BA_DEF_DEF_  "GenMsgDelayTime" 0;
BA_DEF_DEF_  "CANFD_BRS" "1";
BA_DEF_DEF_  "VFrameFormat" "StandardCAN_FD";
BA_DEF_DEF_  "GenMsgILSupport" "No";
BA_DEF_DEF_ "GenSigASIL" "QM";
BA_ "GenMsgILSupport" BO_ 1016 1;
BA_ "GenMsgCycleTime" BO_ 1016 50;
BA_ "GenSigASIL"  SG_ 1016 FRM_45_CRC 5;
BA_ "GenSigASIL"  SG_ 1016 FRM_45_RollgCntr 5;
BA_ "GenSigASIL"  SG_ 1016 FRM_45_DetnBlockCounter 2;
BA_ "GenSigASIL"  SG_ 1016 FRM_45_DetnMotionSts_132 2;
BA_ "GenSigASIL"  SG_ 1016 FRM_45_DetnRngRadial_132 2;
BA_ "GenSigStartValue" SG_ 1016 FRM_45_DetnAziAngle_132 900;
BA_ "GenSigASIL"  SG_ 1016 FRM_45_DetnAziAngle_132 2;
BA_ "GenSigStartValue" SG_ 1016 FRM_45_DetnElevnAngle_132 100;
BA_ "GenSigASIL"  SG_ 1016 FRM_45_DetnElevnAngle_132 2;
BA_ "GenSigStartValue" SG_ 1016 FRM_45_DetnRelVelRadial_132 10000;
BA_ "GenSigASIL"  SG_ 1016 FRM_45_DetnRelVelRadial_132 2;
BA_ "GenSigASIL"  SG_ 1016 FRM_45_DetnSNR_132 2;
BA_ "GenSigStartValue" SG_ 1016 FRM_45_DetnRCS_132 5000;
BA_ "GenSigASIL"  SG_ 1016 FRM_45_DetnRCS_132 2;
BA_ "GenSigASIL"  SG_ 1016 FRM_45_DetnQuality_132 2;
BA_ "GenSigASIL"  SG_ 1016 FRM_45_DetnMotionSts_133 2;
BA_ "GenSigASIL"  SG_ 1016 FRM_45_DetnRngRadial_133 2;
BA_ "GenSigStartValue" SG_ 1016 FRM_45_DetnAziAngle_133 900;
BA_ "GenSigASIL"  SG_ 1016 FRM_45_DetnAziAngle_133 2;
BA_ "GenSigStartValue" SG_ 1016 FRM_45_DetnElevnAngle_133 100;
BA_ "GenSigASIL"  SG_ 1016 FRM_45_DetnElevnAngle_133 2;
BA_ "GenSigStartValue" SG_ 1016 FRM_45_DetnRelVelRadial_133 10000;
BA_ "GenSigASIL"  SG_ 1016 FRM_45_DetnRelVelRadial_133 2;
BA_ "GenSigASIL"  SG_ 1016 FRM_45_DetnSNR_133 2;
BA_ "GenSigStartValue" SG_ 1016 FRM_45_DetnRCS_133 5000;
BA_ "GenSigASIL"  SG_ 1016 FRM_45_DetnRCS_133 2;
BA_ "GenSigASIL"  SG_ 1016 FRM_45_DetnQuality_133 2;
BA_ "GenSigASIL"  SG_ 1016 FRM_45_DetnMotionSts_134 2;
BA_ "GenSigASIL"  SG_ 1016 FRM_45_DetnRngRadial_134 2;
BA_ "GenSigStartValue" SG_ 1016 FRM_45_DetnAziAngle_134 900;
BA_ "GenSigASIL"  SG_ 1016 FRM_45_DetnAziAngle_134 2;
BA_ "GenSigStartValue" SG_ 1016 FRM_45_DetnElevnAngle_134 100;
BA_ "GenSigASIL"  SG_ 1016 FRM_45_DetnElevnAngle_134 2;
BA_ "GenSigStartValue" SG_ 1016 FRM_45_DetnRelVelRadial_134 10000;
BA_ "GenSigASIL"  SG_ 1016 FRM_45_DetnRelVelRadial_134 2;
BA_ "GenSigASIL"  SG_ 1016 FRM_45_DetnSNR_134 2;
BA_ "GenSigStartValue" SG_ 1016 FRM_45_DetnRCS_134 5000;
BA_ "GenSigASIL"  SG_ 1016 FRM_45_DetnRCS_134 2;
BA_ "GenSigASIL"  SG_ 1016 FRM_45_DetnQuality_134 2;
BA_ "GenSigASIL"  SG_ 1016 FRM_45_DetnMotionSts_135 2;
BA_ "GenSigASIL"  SG_ 1016 FRM_45_DetnRngRadial_135 2;
BA_ "GenSigStartValue" SG_ 1016 FRM_45_DetnAziAngle_135 900;
BA_ "GenSigASIL"  SG_ 1016 FRM_45_DetnAziAngle_135 2;
BA_ "GenSigStartValue" SG_ 1016 FRM_45_DetnElevnAngle_135 100;
BA_ "GenSigASIL"  SG_ 1016 FRM_45_DetnElevnAngle_135 2;
BA_ "GenSigStartValue" SG_ 1016 FRM_45_DetnRelVelRadial_135 10000;
BA_ "GenSigASIL"  SG_ 1016 FRM_45_DetnRelVelRadial_135 2;
BA_ "GenSigASIL"  SG_ 1016 FRM_45_DetnSNR_135 2;
BA_ "GenSigStartValue" SG_ 1016 FRM_45_DetnRCS_135 5000;
BA_ "GenSigASIL"  SG_ 1016 FRM_45_DetnRCS_135 2;
BA_ "GenSigASIL"  SG_ 1016 FRM_45_DetnQuality_135 2;
BA_ "GenSigASIL"  SG_ 1016 FRM_45_DetnMotionSts_136 2;
BA_ "GenSigASIL"  SG_ 1016 FRM_45_DetnRngRadial_136 2;
BA_ "GenSigStartValue" SG_ 1016 FRM_45_DetnAziAngle_136 900;
BA_ "GenSigASIL"  SG_ 1016 FRM_45_DetnAziAngle_136 2;
BA_ "GenSigStartValue" SG_ 1016 FRM_45_DetnElevnAngle_136 100;
BA_ "GenSigASIL"  SG_ 1016 FRM_45_DetnElevnAngle_136 2;
BA_ "GenSigStartValue" SG_ 1016 FRM_45_DetnRelVelRadial_136 10000;
BA_ "GenSigASIL"  SG_ 1016 FRM_45_DetnRelVelRadial_136 2;
BA_ "GenSigASIL"  SG_ 1016 FRM_45_DetnSNR_136 2;
BA_ "GenSigStartValue" SG_ 1016 FRM_45_DetnRCS_136 5000;
BA_ "GenSigASIL"  SG_ 1016 FRM_45_DetnRCS_136 2;
BA_ "GenSigASIL"  SG_ 1016 FRM_45_DetnQuality_136 2;
BA_ "GenSigASIL"  SG_ 1016 FRM_45_DetnMotionSts_137 2;
BA_ "GenSigASIL"  SG_ 1016 FRM_45_DetnRngRadial_137 2;
BA_ "GenSigStartValue" SG_ 1016 FRM_45_DetnAziAngle_137 900;
BA_ "GenSigASIL"  SG_ 1016 FRM_45_DetnAziAngle_137 2;
BA_ "GenSigStartValue" SG_ 1016 FRM_45_DetnElevnAngle_137 100;
BA_ "GenSigASIL"  SG_ 1016 FRM_45_DetnElevnAngle_137 2;
BA_ "GenSigStartValue" SG_ 1016 FRM_45_DetnRelVelRadial_137 10000;
BA_ "GenSigASIL"  SG_ 1016 FRM_45_DetnRelVelRadial_137 2;
BA_ "GenSigASIL"  SG_ 1016 FRM_45_DetnSNR_137 2;
BA_ "GenSigStartValue" SG_ 1016 FRM_45_DetnRCS_137 5000;
BA_ "GenSigASIL"  SG_ 1016 FRM_45_DetnRCS_137 2;
BA_ "GenSigASIL"  SG_ 1016 FRM_45_DetnQuality_137 2;
BA_ "GenMsgILSupport" BO_ 1017 1;
BA_ "GenMsgCycleTime" BO_ 1017 50;
BA_ "GenSigASIL"  SG_ 1017 FRM_46_CRC 5;
BA_ "GenSigASIL"  SG_ 1017 FRM_46_RollgCntr 5;
BA_ "GenSigASIL"  SG_ 1017 FRM_46_DetnBlockCounter 2;
BA_ "GenSigASIL"  SG_ 1017 FRM_46_DetnMotionSts_138 2;
BA_ "GenSigASIL"  SG_ 1017 FRM_46_DetnRngRadial_138 2;
BA_ "GenSigStartValue" SG_ 1017 FRM_46_DetnAziAngle_138 900;
BA_ "GenSigASIL"  SG_ 1017 FRM_46_DetnAziAngle_138 2;
BA_ "GenSigStartValue" SG_ 1017 FRM_46_DetnElevnAngle_138 100;
BA_ "GenSigASIL"  SG_ 1017 FRM_46_DetnElevnAngle_138 2;
BA_ "GenSigStartValue" SG_ 1017 FRM_46_DetnRelVelRadial_138 10000;
BA_ "GenSigASIL"  SG_ 1017 FRM_46_DetnRelVelRadial_138 2;
BA_ "GenSigASIL"  SG_ 1017 FRM_46_DetnSNR_138 2;
BA_ "GenSigStartValue" SG_ 1017 FRM_46_DetnRCS_138 5000;
BA_ "GenSigASIL"  SG_ 1017 FRM_46_DetnRCS_138 2;
BA_ "GenSigASIL"  SG_ 1017 FRM_46_DetnQuality_138 2;
BA_ "GenSigASIL"  SG_ 1017 FRM_46_DetnMotionSts_139 2;
BA_ "GenSigASIL"  SG_ 1017 FRM_46_DetnRngRadial_139 2;
BA_ "GenSigStartValue" SG_ 1017 FRM_46_DetnAziAngle_139 900;
BA_ "GenSigASIL"  SG_ 1017 FRM_46_DetnAziAngle_139 2;
BA_ "GenSigStartValue" SG_ 1017 FRM_46_DetnElevnAngle_139 100;
BA_ "GenSigASIL"  SG_ 1017 FRM_46_DetnElevnAngle_139 2;
BA_ "GenSigStartValue" SG_ 1017 FRM_46_DetnRelVelRadial_139 10000;
BA_ "GenSigASIL"  SG_ 1017 FRM_46_DetnRelVelRadial_139 2;
BA_ "GenSigASIL"  SG_ 1017 FRM_46_DetnSNR_139 2;
BA_ "GenSigStartValue" SG_ 1017 FRM_46_DetnRCS_139 5000;
BA_ "GenSigASIL"  SG_ 1017 FRM_46_DetnRCS_139 2;
BA_ "GenSigASIL"  SG_ 1017 FRM_46_DetnQuality_139 2;
BA_ "GenSigASIL"  SG_ 1017 FRM_46_DetnMotionSts_140 2;
BA_ "GenSigASIL"  SG_ 1017 FRM_46_DetnRngRadial_140 2;
BA_ "GenSigStartValue" SG_ 1017 FRM_46_DetnAziAngle_140 900;
BA_ "GenSigASIL"  SG_ 1017 FRM_46_DetnAziAngle_140 2;
BA_ "GenSigStartValue" SG_ 1017 FRM_46_DetnElevnAngle_140 100;
BA_ "GenSigASIL"  SG_ 1017 FRM_46_DetnElevnAngle_140 2;
BA_ "GenSigStartValue" SG_ 1017 FRM_46_DetnRelVelRadial_140 10000;
BA_ "GenSigASIL"  SG_ 1017 FRM_46_DetnRelVelRadial_140 2;
BA_ "GenSigASIL"  SG_ 1017 FRM_46_DetnSNR_140 2;
BA_ "GenSigStartValue" SG_ 1017 FRM_46_DetnRCS_140 5000;
BA_ "GenSigASIL"  SG_ 1017 FRM_46_DetnRCS_140 2;
BA_ "GenSigASIL"  SG_ 1017 FRM_46_DetnQuality_140 2;
BA_ "GenSigASIL"  SG_ 1017 FRM_46_DetnMotionSts_141 2;
BA_ "GenSigASIL"  SG_ 1017 FRM_46_DetnRngRadial_141 2;
BA_ "GenSigStartValue" SG_ 1017 FRM_46_DetnAziAngle_141 900;
BA_ "GenSigASIL"  SG_ 1017 FRM_46_DetnAziAngle_141 2;
BA_ "GenSigStartValue" SG_ 1017 FRM_46_DetnElevnAngle_141 100;
BA_ "GenSigASIL"  SG_ 1017 FRM_46_DetnElevnAngle_141 2;
BA_ "GenSigStartValue" SG_ 1017 FRM_46_DetnRelVelRadial_141 10000;
BA_ "GenSigASIL"  SG_ 1017 FRM_46_DetnRelVelRadial_141 2;
BA_ "GenSigASIL"  SG_ 1017 FRM_46_DetnSNR_141 2;
BA_ "GenSigStartValue" SG_ 1017 FRM_46_DetnRCS_141 5000;
BA_ "GenSigASIL"  SG_ 1017 FRM_46_DetnRCS_141 2;
BA_ "GenSigASIL"  SG_ 1017 FRM_46_DetnQuality_141 2;
BA_ "GenSigASIL"  SG_ 1017 FRM_46_DetnMotionSts_142 2;
BA_ "GenSigASIL"  SG_ 1017 FRM_46_DetnRngRadial_142 2;
BA_ "GenSigStartValue" SG_ 1017 FRM_46_DetnAziAngle_142 900;
BA_ "GenSigASIL"  SG_ 1017 FRM_46_DetnAziAngle_142 2;
BA_ "GenSigStartValue" SG_ 1017 FRM_46_DetnElevnAngle_142 100;
BA_ "GenSigASIL"  SG_ 1017 FRM_46_DetnElevnAngle_142 2;
BA_ "GenSigStartValue" SG_ 1017 FRM_46_DetnRelVelRadial_142 10000;
BA_ "GenSigASIL"  SG_ 1017 FRM_46_DetnRelVelRadial_142 2;
BA_ "GenSigASIL"  SG_ 1017 FRM_46_DetnSNR_142 2;
BA_ "GenSigStartValue" SG_ 1017 FRM_46_DetnRCS_142 5000;
BA_ "GenSigASIL"  SG_ 1017 FRM_46_DetnRCS_142 2;
BA_ "GenSigASIL"  SG_ 1017 FRM_46_DetnQuality_142 2;
BA_ "GenSigASIL"  SG_ 1017 FRM_46_DetnMotionSts_143 2;
BA_ "GenSigASIL"  SG_ 1017 FRM_46_DetnRngRadial_143 2;
BA_ "GenSigStartValue" SG_ 1017 FRM_46_DetnAziAngle_143 900;
BA_ "GenSigASIL"  SG_ 1017 FRM_46_DetnAziAngle_143 2;
BA_ "GenSigStartValue" SG_ 1017 FRM_46_DetnElevnAngle_143 100;
BA_ "GenSigASIL"  SG_ 1017 FRM_46_DetnElevnAngle_143 2;
BA_ "GenSigStartValue" SG_ 1017 FRM_46_DetnRelVelRadial_143 10000;
BA_ "GenSigASIL"  SG_ 1017 FRM_46_DetnRelVelRadial_143 2;
BA_ "GenSigASIL"  SG_ 1017 FRM_46_DetnSNR_143 2;
BA_ "GenSigStartValue" SG_ 1017 FRM_46_DetnRCS_143 5000;
BA_ "GenSigASIL"  SG_ 1017 FRM_46_DetnRCS_143 2;
BA_ "GenSigASIL"  SG_ 1017 FRM_46_DetnQuality_143 2;
BA_ "GenMsgILSupport" BO_ 1018 1;
BA_ "GenMsgCycleTime" BO_ 1018 50;
BA_ "GenSigASIL"  SG_ 1018 FRM_47_CRC 5;
BA_ "GenSigASIL"  SG_ 1018 FRM_47_RollgCntr 5;
BA_ "GenSigASIL"  SG_ 1018 FRM_47_DetnBlockCounter 2;
BA_ "GenSigASIL"  SG_ 1018 FRM_47_DetnMotionSts_144 2;
BA_ "GenSigASIL"  SG_ 1018 FRM_47_DetnRngRadial_144 2;
BA_ "GenSigStartValue" SG_ 1018 FRM_47_DetnAziAngle_144 900;
BA_ "GenSigASIL"  SG_ 1018 FRM_47_DetnAziAngle_144 2;
BA_ "GenSigStartValue" SG_ 1018 FRM_47_DetnElevnAngle_144 100;
BA_ "GenSigASIL"  SG_ 1018 FRM_47_DetnElevnAngle_144 2;
BA_ "GenSigStartValue" SG_ 1018 FRM_47_DetnRelVelRadial_144 10000;
BA_ "GenSigASIL"  SG_ 1018 FRM_47_DetnRelVelRadial_144 2;
BA_ "GenSigASIL"  SG_ 1018 FRM_47_DetnSNR_144 2;
BA_ "GenSigStartValue" SG_ 1018 FRM_47_DetnRCS_144 5000;
BA_ "GenSigASIL"  SG_ 1018 FRM_47_DetnRCS_144 2;
BA_ "GenSigASIL"  SG_ 1018 FRM_47_DetnQuality_144 2;
BA_ "GenSigASIL"  SG_ 1018 FRM_47_DetnMotionSts_145 2;
BA_ "GenSigASIL"  SG_ 1018 FRM_47_DetnRngRadial_145 2;
BA_ "GenSigStartValue" SG_ 1018 FRM_47_DetnAziAngle_145 900;
BA_ "GenSigASIL"  SG_ 1018 FRM_47_DetnAziAngle_145 2;
BA_ "GenSigStartValue" SG_ 1018 FRM_47_DetnElevnAngle_145 100;
BA_ "GenSigASIL"  SG_ 1018 FRM_47_DetnElevnAngle_145 2;
BA_ "GenSigStartValue" SG_ 1018 FRM_47_DetnRelVelRadial_145 10000;
BA_ "GenSigASIL"  SG_ 1018 FRM_47_DetnRelVelRadial_145 2;
BA_ "GenSigASIL"  SG_ 1018 FRM_47_DetnSNR_145 2;
BA_ "GenSigStartValue" SG_ 1018 FRM_47_DetnRCS_145 5000;
BA_ "GenSigASIL"  SG_ 1018 FRM_47_DetnRCS_145 2;
BA_ "GenSigASIL"  SG_ 1018 FRM_47_DetnQuality_145 2;
BA_ "GenSigASIL"  SG_ 1018 FRM_47_DetnMotionSts_146 2;
BA_ "GenSigASIL"  SG_ 1018 FRM_47_DetnRngRadial_146 2;
BA_ "GenSigStartValue" SG_ 1018 FRM_47_DetnAziAngle_146 900;
BA_ "GenSigASIL"  SG_ 1018 FRM_47_DetnAziAngle_146 2;
BA_ "GenSigStartValue" SG_ 1018 FRM_47_DetnElevnAngle_146 100;
BA_ "GenSigASIL"  SG_ 1018 FRM_47_DetnElevnAngle_146 2;
BA_ "GenSigStartValue" SG_ 1018 FRM_47_DetnRelVelRadial_146 10000;
BA_ "GenSigASIL"  SG_ 1018 FRM_47_DetnRelVelRadial_146 2;
BA_ "GenSigASIL"  SG_ 1018 FRM_47_DetnSNR_146 2;
BA_ "GenSigStartValue" SG_ 1018 FRM_47_DetnRCS_146 5000;
BA_ "GenSigASIL"  SG_ 1018 FRM_47_DetnRCS_146 2;
BA_ "GenSigASIL"  SG_ 1018 FRM_47_DetnQuality_146 2;
BA_ "GenSigASIL"  SG_ 1018 FRM_47_DetnMotionSts_147 2;
BA_ "GenSigASIL"  SG_ 1018 FRM_47_DetnRngRadial_147 2;
BA_ "GenSigStartValue" SG_ 1018 FRM_47_DetnAziAngle_147 900;
BA_ "GenSigASIL"  SG_ 1018 FRM_47_DetnAziAngle_147 2;
BA_ "GenSigStartValue" SG_ 1018 FRM_47_DetnElevnAngle_147 100;
BA_ "GenSigASIL"  SG_ 1018 FRM_47_DetnElevnAngle_147 2;
BA_ "GenSigStartValue" SG_ 1018 FRM_47_DetnRelVelRadial_147 10000;
BA_ "GenSigASIL"  SG_ 1018 FRM_47_DetnRelVelRadial_147 2;
BA_ "GenSigASIL"  SG_ 1018 FRM_47_DetnSNR_147 2;
BA_ "GenSigStartValue" SG_ 1018 FRM_47_DetnRCS_147 5000;
BA_ "GenSigASIL"  SG_ 1018 FRM_47_DetnRCS_147 2;
BA_ "GenSigASIL"  SG_ 1018 FRM_47_DetnQuality_147 2;
BA_ "GenSigASIL"  SG_ 1018 FRM_47_DetnMotionSts_148 2;
BA_ "GenSigASIL"  SG_ 1018 FRM_47_DetnRngRadial_148 2;
BA_ "GenSigStartValue" SG_ 1018 FRM_47_DetnAziAngle_148 900;
BA_ "GenSigASIL"  SG_ 1018 FRM_47_DetnAziAngle_148 2;
BA_ "GenSigStartValue" SG_ 1018 FRM_47_DetnElevnAngle_148 100;
BA_ "GenSigASIL"  SG_ 1018 FRM_47_DetnElevnAngle_148 2;
BA_ "GenSigStartValue" SG_ 1018 FRM_47_DetnRelVelRadial_148 10000;
BA_ "GenSigASIL"  SG_ 1018 FRM_47_DetnRelVelRadial_148 2;
BA_ "GenSigASIL"  SG_ 1018 FRM_47_DetnSNR_148 2;
BA_ "GenSigStartValue" SG_ 1018 FRM_47_DetnRCS_148 5000;
BA_ "GenSigASIL"  SG_ 1018 FRM_47_DetnRCS_148 2;
BA_ "GenSigASIL"  SG_ 1018 FRM_47_DetnQuality_148 2;
BA_ "GenSigASIL"  SG_ 1018 FRM_47_DetnMotionSts_149 2;
BA_ "GenSigASIL"  SG_ 1018 FRM_47_DetnRngRadial_149 2;
BA_ "GenSigStartValue" SG_ 1018 FRM_47_DetnAziAngle_149 900;
BA_ "GenSigASIL"  SG_ 1018 FRM_47_DetnAziAngle_149 2;
BA_ "GenSigStartValue" SG_ 1018 FRM_47_DetnElevnAngle_149 100;
BA_ "GenSigASIL"  SG_ 1018 FRM_47_DetnElevnAngle_149 2;
BA_ "GenSigStartValue" SG_ 1018 FRM_47_DetnRelVelRadial_149 10000;
BA_ "GenSigASIL"  SG_ 1018 FRM_47_DetnRelVelRadial_149 2;
BA_ "GenSigASIL"  SG_ 1018 FRM_47_DetnSNR_149 2;
BA_ "GenSigStartValue" SG_ 1018 FRM_47_DetnRCS_149 5000;
BA_ "GenSigASIL"  SG_ 1018 FRM_47_DetnRCS_149 2;
BA_ "GenSigASIL"  SG_ 1018 FRM_47_DetnQuality_149 2;
BA_ "GenMsgILSupport" BO_ 1019 1;
BA_ "GenMsgCycleTime" BO_ 1019 50;
BA_ "GenSigASIL"  SG_ 1019 FRM_48_CRC 5;
BA_ "GenSigASIL"  SG_ 1019 FRM_48_RollgCntr 5;
BA_ "GenSigASIL"  SG_ 1019 FRM_48_DetnBlockCounter 2;
BA_ "GenSigASIL"  SG_ 1019 FRM_48_DetnMotionSts_150 2;
BA_ "GenSigASIL"  SG_ 1019 FRM_48_DetnRngRadial_150 2;
BA_ "GenSigStartValue" SG_ 1019 FRM_48_DetnAziAngle_150 900;
BA_ "GenSigASIL"  SG_ 1019 FRM_48_DetnAziAngle_150 2;
BA_ "GenSigStartValue" SG_ 1019 FRM_48_DetnElevnAngle_150 100;
BA_ "GenSigASIL"  SG_ 1019 FRM_48_DetnElevnAngle_150 2;
BA_ "GenSigStartValue" SG_ 1019 FRM_48_DetnRelVelRadial_150 10000;
BA_ "GenSigASIL"  SG_ 1019 FRM_48_DetnRelVelRadial_150 2;
BA_ "GenSigASIL"  SG_ 1019 FRM_48_DetnSNR_150 2;
BA_ "GenSigStartValue" SG_ 1019 FRM_48_DetnRCS_150 5000;
BA_ "GenSigASIL"  SG_ 1019 FRM_48_DetnRCS_150 2;
BA_ "GenSigASIL"  SG_ 1019 FRM_48_DetnQuality_150 2;
BA_ "GenSigASIL"  SG_ 1019 FRM_48_DetnMotionSts_151 2;
BA_ "GenSigASIL"  SG_ 1019 FRM_48_DetnRngRadial_151 2;
BA_ "GenSigStartValue" SG_ 1019 FRM_48_DetnAziAngle_151 900;
BA_ "GenSigASIL"  SG_ 1019 FRM_48_DetnAziAngle_151 2;
BA_ "GenSigStartValue" SG_ 1019 FRM_48_DetnElevnAngle_151 100;
BA_ "GenSigASIL"  SG_ 1019 FRM_48_DetnElevnAngle_151 2;
BA_ "GenSigStartValue" SG_ 1019 FRM_48_DetnRelVelRadial_151 10000;
BA_ "GenSigASIL"  SG_ 1019 FRM_48_DetnRelVelRadial_151 2;
BA_ "GenSigASIL"  SG_ 1019 FRM_48_DetnSNR_151 2;
BA_ "GenSigStartValue" SG_ 1019 FRM_48_DetnRCS_151 5000;
BA_ "GenSigASIL"  SG_ 1019 FRM_48_DetnRCS_151 2;
BA_ "GenSigASIL"  SG_ 1019 FRM_48_DetnQuality_151 2;
BA_ "GenSigASIL"  SG_ 1019 FRM_48_DetnMotionSts_152 2;
BA_ "GenSigASIL"  SG_ 1019 FRM_48_DetnRngRadial_152 2;
BA_ "GenSigStartValue" SG_ 1019 FRM_48_DetnAziAngle_152 900;
BA_ "GenSigASIL"  SG_ 1019 FRM_48_DetnAziAngle_152 2;
BA_ "GenSigStartValue" SG_ 1019 FRM_48_DetnElevnAngle_152 100;
BA_ "GenSigASIL"  SG_ 1019 FRM_48_DetnElevnAngle_152 2;
BA_ "GenSigStartValue" SG_ 1019 FRM_48_DetnRelVelRadial_152 10000;
BA_ "GenSigASIL"  SG_ 1019 FRM_48_DetnRelVelRadial_152 2;
BA_ "GenSigASIL"  SG_ 1019 FRM_48_DetnSNR_152 2;
BA_ "GenSigStartValue" SG_ 1019 FRM_48_DetnRCS_152 5000;
BA_ "GenSigASIL"  SG_ 1019 FRM_48_DetnRCS_152 2;
BA_ "GenSigASIL"  SG_ 1019 FRM_48_DetnQuality_152 2;
BA_ "GenSigASIL"  SG_ 1019 FRM_48_DetnMotionSts_153 2;
BA_ "GenSigASIL"  SG_ 1019 FRM_48_DetnRngRadial_153 2;
BA_ "GenSigStartValue" SG_ 1019 FRM_48_DetnAziAngle_153 900;
BA_ "GenSigASIL"  SG_ 1019 FRM_48_DetnAziAngle_153 2;
BA_ "GenSigStartValue" SG_ 1019 FRM_48_DetnElevnAngle_153 100;
BA_ "GenSigASIL"  SG_ 1019 FRM_48_DetnElevnAngle_153 2;
BA_ "GenSigStartValue" SG_ 1019 FRM_48_DetnRelVelRadial_153 10000;
BA_ "GenSigASIL"  SG_ 1019 FRM_48_DetnRelVelRadial_153 2;
BA_ "GenSigASIL"  SG_ 1019 FRM_48_DetnSNR_153 2;
BA_ "GenSigStartValue" SG_ 1019 FRM_48_DetnRCS_153 5000;
BA_ "GenSigASIL"  SG_ 1019 FRM_48_DetnRCS_153 2;
BA_ "GenSigASIL"  SG_ 1019 FRM_48_DetnQuality_153 2;
BA_ "GenSigASIL"  SG_ 1019 FRM_48_DetnMotionSts_154 2;
BA_ "GenSigASIL"  SG_ 1019 FRM_48_DetnRngRadial_154 2;
BA_ "GenSigStartValue" SG_ 1019 FRM_48_DetnAziAngle_154 900;
BA_ "GenSigASIL"  SG_ 1019 FRM_48_DetnAziAngle_154 2;
BA_ "GenSigStartValue" SG_ 1019 FRM_48_DetnElevnAngle_154 100;
BA_ "GenSigASIL"  SG_ 1019 FRM_48_DetnElevnAngle_154 2;
BA_ "GenSigStartValue" SG_ 1019 FRM_48_DetnRelVelRadial_154 10000;
BA_ "GenSigASIL"  SG_ 1019 FRM_48_DetnRelVelRadial_154 2;
BA_ "GenSigASIL"  SG_ 1019 FRM_48_DetnSNR_154 2;
BA_ "GenSigStartValue" SG_ 1019 FRM_48_DetnRCS_154 5000;
BA_ "GenSigASIL"  SG_ 1019 FRM_48_DetnRCS_154 2;
BA_ "GenSigASIL"  SG_ 1019 FRM_48_DetnQuality_154 2;
BA_ "GenSigASIL"  SG_ 1019 FRM_48_DetnMotionSts_155 2;
BA_ "GenSigASIL"  SG_ 1019 FRM_48_DetnRngRadial_155 2;
BA_ "GenSigStartValue" SG_ 1019 FRM_48_DetnAziAngle_155 900;
BA_ "GenSigASIL"  SG_ 1019 FRM_48_DetnAziAngle_155 2;
BA_ "GenSigStartValue" SG_ 1019 FRM_48_DetnElevnAngle_155 100;
BA_ "GenSigASIL"  SG_ 1019 FRM_48_DetnElevnAngle_155 2;
BA_ "GenSigStartValue" SG_ 1019 FRM_48_DetnRelVelRadial_155 10000;
BA_ "GenSigASIL"  SG_ 1019 FRM_48_DetnRelVelRadial_155 2;
BA_ "GenSigASIL"  SG_ 1019 FRM_48_DetnSNR_155 2;
BA_ "GenSigStartValue" SG_ 1019 FRM_48_DetnRCS_155 5000;
BA_ "GenSigASIL"  SG_ 1019 FRM_48_DetnRCS_155 2;
BA_ "GenSigASIL"  SG_ 1019 FRM_48_DetnQuality_155 2;
BA_ "GenMsgILSupport" BO_ 1020 1;
BA_ "GenMsgCycleTime" BO_ 1020 50;
BA_ "GenSigASIL"  SG_ 1020 FRM_49_CRC 5;
BA_ "GenSigASIL"  SG_ 1020 FRM_49_RollgCntr 5;
BA_ "GenSigASIL"  SG_ 1020 FRM_49_DetnBlockCounter 2;
BA_ "GenSigASIL"  SG_ 1020 FRM_49_DetnMotionSts_156 2;
BA_ "GenSigASIL"  SG_ 1020 FRM_49_DetnRngRadial_156 2;
BA_ "GenSigStartValue" SG_ 1020 FRM_49_DetnAziAngle_156 900;
BA_ "GenSigASIL"  SG_ 1020 FRM_49_DetnAziAngle_156 2;
BA_ "GenSigStartValue" SG_ 1020 FRM_49_DetnElevnAngle_156 100;
BA_ "GenSigASIL"  SG_ 1020 FRM_49_DetnElevnAngle_156 2;
BA_ "GenSigStartValue" SG_ 1020 FRM_49_DetnRelVelRadial_156 10000;
BA_ "GenSigASIL"  SG_ 1020 FRM_49_DetnRelVelRadial_156 2;
BA_ "GenSigASIL"  SG_ 1020 FRM_49_DetnSNR_156 2;
BA_ "GenSigStartValue" SG_ 1020 FRM_49_DetnRCS_156 5000;
BA_ "GenSigASIL"  SG_ 1020 FRM_49_DetnRCS_156 2;
BA_ "GenSigASIL"  SG_ 1020 FRM_49_DetnQuality_156 2;
BA_ "GenSigASIL"  SG_ 1020 FRM_49_DetnMotionSts_157 2;
BA_ "GenSigASIL"  SG_ 1020 FRM_49_DetnRngRadial_157 2;
BA_ "GenSigStartValue" SG_ 1020 FRM_49_DetnAziAngle_157 900;
BA_ "GenSigASIL"  SG_ 1020 FRM_49_DetnAziAngle_157 2;
BA_ "GenSigStartValue" SG_ 1020 FRM_49_DetnElevnAngle_157 100;
BA_ "GenSigASIL"  SG_ 1020 FRM_49_DetnElevnAngle_157 2;
BA_ "GenSigStartValue" SG_ 1020 FRM_49_DetnRelVelRadial_157 10000;
BA_ "GenSigASIL"  SG_ 1020 FRM_49_DetnRelVelRadial_157 2;
BA_ "GenSigASIL"  SG_ 1020 FRM_49_DetnSNR_157 2;
BA_ "GenSigStartValue" SG_ 1020 FRM_49_DetnRCS_157 5000;
BA_ "GenSigASIL"  SG_ 1020 FRM_49_DetnRCS_157 2;
BA_ "GenSigASIL"  SG_ 1020 FRM_49_DetnQuality_157 2;
BA_ "GenSigASIL"  SG_ 1020 FRM_49_DetnMotionSts_158 2;
BA_ "GenSigASIL"  SG_ 1020 FRM_49_DetnRngRadial_158 2;
BA_ "GenSigStartValue" SG_ 1020 FRM_49_DetnAziAngle_158 900;
BA_ "GenSigASIL"  SG_ 1020 FRM_49_DetnAziAngle_158 2;
BA_ "GenSigStartValue" SG_ 1020 FRM_49_DetnElevnAngle_158 100;
BA_ "GenSigASIL"  SG_ 1020 FRM_49_DetnElevnAngle_158 2;
BA_ "GenSigStartValue" SG_ 1020 FRM_49_DetnRelVelRadial_158 10000;
BA_ "GenSigASIL"  SG_ 1020 FRM_49_DetnRelVelRadial_158 2;
BA_ "GenSigASIL"  SG_ 1020 FRM_49_DetnSNR_158 2;
BA_ "GenSigStartValue" SG_ 1020 FRM_49_DetnRCS_158 5000;
BA_ "GenSigASIL"  SG_ 1020 FRM_49_DetnRCS_158 2;
BA_ "GenSigASIL"  SG_ 1020 FRM_49_DetnQuality_158 2;
BA_ "GenSigASIL"  SG_ 1020 FRM_49_DetnMotionSts_159 2;
BA_ "GenSigASIL"  SG_ 1020 FRM_49_DetnRngRadial_159 2;
BA_ "GenSigStartValue" SG_ 1020 FRM_49_DetnAziAngle_159 900;
BA_ "GenSigASIL"  SG_ 1020 FRM_49_DetnAziAngle_159 2;
BA_ "GenSigStartValue" SG_ 1020 FRM_49_DetnElevnAngle_159 100;
BA_ "GenSigASIL"  SG_ 1020 FRM_49_DetnElevnAngle_159 2;
BA_ "GenSigStartValue" SG_ 1020 FRM_49_DetnRelVelRadial_159 10000;
BA_ "GenSigASIL"  SG_ 1020 FRM_49_DetnRelVelRadial_159 2;
BA_ "GenSigASIL"  SG_ 1020 FRM_49_DetnSNR_159 2;
BA_ "GenSigStartValue" SG_ 1020 FRM_49_DetnRCS_159 5000;
BA_ "GenSigASIL"  SG_ 1020 FRM_49_DetnRCS_159 2;
BA_ "GenSigASIL"  SG_ 1020 FRM_49_DetnQuality_159 2;
BA_ "GenSigASIL"  SG_ 1020 FRM_49_DetnMotionSts_160 2;
BA_ "GenSigASIL"  SG_ 1020 FRM_49_DetnRngRadial_160 2;
BA_ "GenSigStartValue" SG_ 1020 FRM_49_DetnAziAngle_160 900;
BA_ "GenSigASIL"  SG_ 1020 FRM_49_DetnAziAngle_160 2;
BA_ "GenSigStartValue" SG_ 1020 FRM_49_DetnElevnAngle_160 100;
BA_ "GenSigASIL"  SG_ 1020 FRM_49_DetnElevnAngle_160 2;
BA_ "GenSigStartValue" SG_ 1020 FRM_49_DetnRelVelRadial_160 10000;
BA_ "GenSigASIL"  SG_ 1020 FRM_49_DetnRelVelRadial_160 2;
BA_ "GenSigASIL"  SG_ 1020 FRM_49_DetnSNR_160 2;
BA_ "GenSigStartValue" SG_ 1020 FRM_49_DetnRCS_160 5000;
BA_ "GenSigASIL"  SG_ 1020 FRM_49_DetnRCS_160 2;
BA_ "GenSigASIL"  SG_ 1020 FRM_49_DetnQuality_160 2;
BA_ "GenSigASIL"  SG_ 1020 FRM_49_DetnMotionSts_161 2;
BA_ "GenSigASIL"  SG_ 1020 FRM_49_DetnRngRadial_161 2;
BA_ "GenSigStartValue" SG_ 1020 FRM_49_DetnAziAngle_161 900;
BA_ "GenSigASIL"  SG_ 1020 FRM_49_DetnAziAngle_161 2;
BA_ "GenSigStartValue" SG_ 1020 FRM_49_DetnElevnAngle_161 100;
BA_ "GenSigASIL"  SG_ 1020 FRM_49_DetnElevnAngle_161 2;
BA_ "GenSigStartValue" SG_ 1020 FRM_49_DetnRelVelRadial_161 10000;
BA_ "GenSigASIL"  SG_ 1020 FRM_49_DetnRelVelRadial_161 2;
BA_ "GenSigASIL"  SG_ 1020 FRM_49_DetnSNR_161 2;
BA_ "GenSigStartValue" SG_ 1020 FRM_49_DetnRCS_161 5000;
BA_ "GenSigASIL"  SG_ 1020 FRM_49_DetnRCS_161 2;
BA_ "GenSigASIL"  SG_ 1020 FRM_49_DetnQuality_161 2;
BA_ "GenMsgILSupport" BO_ 1021 1;
BA_ "GenMsgCycleTime" BO_ 1021 50;
BA_ "GenSigASIL"  SG_ 1021 FRM_50_CRC 5;
BA_ "GenSigASIL"  SG_ 1021 FRM_50_RollgCntr 5;
BA_ "GenSigASIL"  SG_ 1021 FRM_50_DetnBlockCounter 2;
BA_ "GenSigASIL"  SG_ 1021 FRM_50_DetnMotionSts_162 2;
BA_ "GenSigASIL"  SG_ 1021 FRM_50_DetnRngRadial_162 2;
BA_ "GenSigStartValue" SG_ 1021 FRM_50_DetnAziAngle_162 900;
BA_ "GenSigASIL"  SG_ 1021 FRM_50_DetnAziAngle_162 2;
BA_ "GenSigStartValue" SG_ 1021 FRM_50_DetnElevnAngle_162 100;
BA_ "GenSigASIL"  SG_ 1021 FRM_50_DetnElevnAngle_162 2;
BA_ "GenSigStartValue" SG_ 1021 FRM_50_DetnRelVelRadial_162 10000;
BA_ "GenSigASIL"  SG_ 1021 FRM_50_DetnRelVelRadial_162 2;
BA_ "GenSigASIL"  SG_ 1021 FRM_50_DetnSNR_162 2;
BA_ "GenSigStartValue" SG_ 1021 FRM_50_DetnRCS_162 5000;
BA_ "GenSigASIL"  SG_ 1021 FRM_50_DetnRCS_162 2;
BA_ "GenSigASIL"  SG_ 1021 FRM_50_DetnQuality_162 2;
BA_ "GenSigASIL"  SG_ 1021 FRM_50_DetnMotionSts_163 2;
BA_ "GenSigASIL"  SG_ 1021 FRM_50_DetnRngRadial_163 2;
BA_ "GenSigStartValue" SG_ 1021 FRM_50_DetnAziAngle_163 900;
BA_ "GenSigASIL"  SG_ 1021 FRM_50_DetnAziAngle_163 2;
BA_ "GenSigStartValue" SG_ 1021 FRM_50_DetnElevnAngle_163 100;
BA_ "GenSigASIL"  SG_ 1021 FRM_50_DetnElevnAngle_163 2;
BA_ "GenSigStartValue" SG_ 1021 FRM_50_DetnRelVelRadial_163 10000;
BA_ "GenSigASIL"  SG_ 1021 FRM_50_DetnRelVelRadial_163 2;
BA_ "GenSigASIL"  SG_ 1021 FRM_50_DetnSNR_163 2;
BA_ "GenSigStartValue" SG_ 1021 FRM_50_DetnRCS_163 5000;
BA_ "GenSigASIL"  SG_ 1021 FRM_50_DetnRCS_163 2;
BA_ "GenSigASIL"  SG_ 1021 FRM_50_DetnQuality_163 2;
BA_ "GenSigASIL"  SG_ 1021 FRM_50_DetnMotionSts_164 2;
BA_ "GenSigASIL"  SG_ 1021 FRM_50_DetnRngRadial_164 2;
BA_ "GenSigStartValue" SG_ 1021 FRM_50_DetnAziAngle_164 900;
BA_ "GenSigASIL"  SG_ 1021 FRM_50_DetnAziAngle_164 2;
BA_ "GenSigStartValue" SG_ 1021 FRM_50_DetnElevnAngle_164 100;
BA_ "GenSigASIL"  SG_ 1021 FRM_50_DetnElevnAngle_164 2;
BA_ "GenSigStartValue" SG_ 1021 FRM_50_DetnRelVelRadial_164 10000;
BA_ "GenSigASIL"  SG_ 1021 FRM_50_DetnRelVelRadial_164 2;
BA_ "GenSigASIL"  SG_ 1021 FRM_50_DetnSNR_164 2;
BA_ "GenSigStartValue" SG_ 1021 FRM_50_DetnRCS_164 5000;
BA_ "GenSigASIL"  SG_ 1021 FRM_50_DetnRCS_164 2;
BA_ "GenSigASIL"  SG_ 1021 FRM_50_DetnQuality_164 2;
BA_ "GenSigASIL"  SG_ 1021 FRM_50_DetnMotionSts_165 2;
BA_ "GenSigASIL"  SG_ 1021 FRM_50_DetnRngRadial_165 2;
BA_ "GenSigStartValue" SG_ 1021 FRM_50_DetnAziAngle_165 900;
BA_ "GenSigASIL"  SG_ 1021 FRM_50_DetnAziAngle_165 2;
BA_ "GenSigStartValue" SG_ 1021 FRM_50_DetnElevnAngle_165 100;
BA_ "GenSigASIL"  SG_ 1021 FRM_50_DetnElevnAngle_165 2;
BA_ "GenSigStartValue" SG_ 1021 FRM_50_DetnRelVelRadial_165 10000;
BA_ "GenSigASIL"  SG_ 1021 FRM_50_DetnRelVelRadial_165 2;
BA_ "GenSigASIL"  SG_ 1021 FRM_50_DetnSNR_165 2;
BA_ "GenSigStartValue" SG_ 1021 FRM_50_DetnRCS_165 5000;
BA_ "GenSigASIL"  SG_ 1021 FRM_50_DetnRCS_165 2;
BA_ "GenSigASIL"  SG_ 1021 FRM_50_DetnQuality_165 2;
BA_ "GenSigASIL"  SG_ 1021 FRM_50_DetnMotionSts_166 2;
BA_ "GenSigASIL"  SG_ 1021 FRM_50_DetnRngRadial_166 2;
BA_ "GenSigStartValue" SG_ 1021 FRM_50_DetnAziAngle_166 900;
BA_ "GenSigASIL"  SG_ 1021 FRM_50_DetnAziAngle_166 2;
BA_ "GenSigStartValue" SG_ 1021 FRM_50_DetnElevnAngle_166 100;
BA_ "GenSigASIL"  SG_ 1021 FRM_50_DetnElevnAngle_166 2;
BA_ "GenSigStartValue" SG_ 1021 FRM_50_DetnRelVelRadial_166 10000;
BA_ "GenSigASIL"  SG_ 1021 FRM_50_DetnRelVelRadial_166 2;
BA_ "GenSigASIL"  SG_ 1021 FRM_50_DetnSNR_166 2;
BA_ "GenSigStartValue" SG_ 1021 FRM_50_DetnRCS_166 5000;
BA_ "GenSigASIL"  SG_ 1021 FRM_50_DetnRCS_166 2;
BA_ "GenSigASIL"  SG_ 1021 FRM_50_DetnQuality_166 2;
BA_ "GenSigASIL"  SG_ 1021 FRM_50_DetnMotionSts_167 2;
BA_ "GenSigASIL"  SG_ 1021 FRM_50_DetnRngRadial_167 2;
BA_ "GenSigStartValue" SG_ 1021 FRM_50_DetnAziAngle_167 900;
BA_ "GenSigASIL"  SG_ 1021 FRM_50_DetnAziAngle_167 2;
BA_ "GenSigStartValue" SG_ 1021 FRM_50_DetnElevnAngle_167 100;
BA_ "GenSigASIL"  SG_ 1021 FRM_50_DetnElevnAngle_167 2;
BA_ "GenSigStartValue" SG_ 1021 FRM_50_DetnRelVelRadial_167 10000;
BA_ "GenSigASIL"  SG_ 1021 FRM_50_DetnRelVelRadial_167 2;
BA_ "GenSigASIL"  SG_ 1021 FRM_50_DetnSNR_167 2;
BA_ "GenSigStartValue" SG_ 1021 FRM_50_DetnRCS_167 5000;
BA_ "GenSigASIL"  SG_ 1021 FRM_50_DetnRCS_167 2;
BA_ "GenSigASIL"  SG_ 1021 FRM_50_DetnQuality_167 2;
BA_ "GenMsgILSupport" BO_ 1022 1;
BA_ "GenMsgCycleTime" BO_ 1022 50;
BA_ "GenSigASIL"  SG_ 1022 FRM_51_CRC 5;
BA_ "GenSigASIL"  SG_ 1022 FRM_51_RollgCntr 5;
BA_ "GenSigASIL"  SG_ 1022 FRM_51_DetnBlockCounter 2;
BA_ "GenSigASIL"  SG_ 1022 FRM_51_DetnMotionSts_168 2;
BA_ "GenSigASIL"  SG_ 1022 FRM_51_DetnRngRadial_168 2;
BA_ "GenSigStartValue" SG_ 1022 FRM_51_DetnAziAngle_168 900;
BA_ "GenSigASIL"  SG_ 1022 FRM_51_DetnAziAngle_168 2;
BA_ "GenSigStartValue" SG_ 1022 FRM_51_DetnElevnAngle_168 100;
BA_ "GenSigASIL"  SG_ 1022 FRM_51_DetnElevnAngle_168 2;
BA_ "GenSigStartValue" SG_ 1022 FRM_51_DetnRelVelRadial_168 10000;
BA_ "GenSigASIL"  SG_ 1022 FRM_51_DetnRelVelRadial_168 2;
BA_ "GenSigASIL"  SG_ 1022 FRM_51_DetnSNR_168 2;
BA_ "GenSigStartValue" SG_ 1022 FRM_51_DetnRCS_168 5000;
BA_ "GenSigASIL"  SG_ 1022 FRM_51_DetnRCS_168 2;
BA_ "GenSigASIL"  SG_ 1022 FRM_51_DetnQuality_168 2;
BA_ "GenSigASIL"  SG_ 1022 FRM_51_DetnMotionSts_169 2;
BA_ "GenSigASIL"  SG_ 1022 FRM_51_DetnRngRadial_169 2;
BA_ "GenSigStartValue" SG_ 1022 FRM_51_DetnAziAngle_169 900;
BA_ "GenSigASIL"  SG_ 1022 FRM_51_DetnAziAngle_169 2;
BA_ "GenSigStartValue" SG_ 1022 FRM_51_DetnElevnAngle_169 100;
BA_ "GenSigASIL"  SG_ 1022 FRM_51_DetnElevnAngle_169 2;
BA_ "GenSigStartValue" SG_ 1022 FRM_51_DetnRelVelRadial_169 10000;
BA_ "GenSigASIL"  SG_ 1022 FRM_51_DetnRelVelRadial_169 2;
BA_ "GenSigASIL"  SG_ 1022 FRM_51_DetnSNR_169 2;
BA_ "GenSigStartValue" SG_ 1022 FRM_51_DetnRCS_169 5000;
BA_ "GenSigASIL"  SG_ 1022 FRM_51_DetnRCS_169 2;
BA_ "GenSigASIL"  SG_ 1022 FRM_51_DetnQuality_169 2;
BA_ "GenSigASIL"  SG_ 1022 FRM_51_DetnMotionSts_170 2;
BA_ "GenSigASIL"  SG_ 1022 FRM_51_DetnRngRadial_170 2;
BA_ "GenSigStartValue" SG_ 1022 FRM_51_DetnAziAngle_170 900;
BA_ "GenSigASIL"  SG_ 1022 FRM_51_DetnAziAngle_170 2;
BA_ "GenSigStartValue" SG_ 1022 FRM_51_DetnElevnAngle_170 100;
BA_ "GenSigASIL"  SG_ 1022 FRM_51_DetnElevnAngle_170 2;
BA_ "GenSigStartValue" SG_ 1022 FRM_51_DetnRelVelRadial_170 10000;
BA_ "GenSigASIL"  SG_ 1022 FRM_51_DetnRelVelRadial_170 2;
BA_ "GenSigASIL"  SG_ 1022 FRM_51_DetnSNR_170 2;
BA_ "GenSigStartValue" SG_ 1022 FRM_51_DetnRCS_170 5000;
BA_ "GenSigASIL"  SG_ 1022 FRM_51_DetnRCS_170 2;
BA_ "GenSigASIL"  SG_ 1022 FRM_51_DetnQuality_170 2;
BA_ "GenSigASIL"  SG_ 1022 FRM_51_DetnMotionSts_171 2;
BA_ "GenSigASIL"  SG_ 1022 FRM_51_DetnRngRadial_171 2;
BA_ "GenSigStartValue" SG_ 1022 FRM_51_DetnAziAngle_171 900;
BA_ "GenSigASIL"  SG_ 1022 FRM_51_DetnAziAngle_171 2;
BA_ "GenSigStartValue" SG_ 1022 FRM_51_DetnElevnAngle_171 100;
BA_ "GenSigASIL"  SG_ 1022 FRM_51_DetnElevnAngle_171 2;
BA_ "GenSigStartValue" SG_ 1022 FRM_51_DetnRelVelRadial_171 10000;
BA_ "GenSigASIL"  SG_ 1022 FRM_51_DetnRelVelRadial_171 2;
BA_ "GenSigASIL"  SG_ 1022 FRM_51_DetnSNR_171 2;
BA_ "GenSigStartValue" SG_ 1022 FRM_51_DetnRCS_171 5000;
BA_ "GenSigASIL"  SG_ 1022 FRM_51_DetnRCS_171 2;
BA_ "GenSigASIL"  SG_ 1022 FRM_51_DetnQuality_171 2;
BA_ "GenSigASIL"  SG_ 1022 FRM_51_DetnMotionSts_172 2;
BA_ "GenSigASIL"  SG_ 1022 FRM_51_DetnRngRadial_172 2;
BA_ "GenSigStartValue" SG_ 1022 FRM_51_DetnAziAngle_172 900;
BA_ "GenSigASIL"  SG_ 1022 FRM_51_DetnAziAngle_172 2;
BA_ "GenSigStartValue" SG_ 1022 FRM_51_DetnElevnAngle_172 100;
BA_ "GenSigASIL"  SG_ 1022 FRM_51_DetnElevnAngle_172 2;
BA_ "GenSigStartValue" SG_ 1022 FRM_51_DetnRelVelRadial_172 10000;
BA_ "GenSigASIL"  SG_ 1022 FRM_51_DetnRelVelRadial_172 2;
BA_ "GenSigASIL"  SG_ 1022 FRM_51_DetnSNR_172 2;
BA_ "GenSigStartValue" SG_ 1022 FRM_51_DetnRCS_172 5000;
BA_ "GenSigASIL"  SG_ 1022 FRM_51_DetnRCS_172 2;
BA_ "GenSigASIL"  SG_ 1022 FRM_51_DetnQuality_172 2;
BA_ "GenSigASIL"  SG_ 1022 FRM_51_DetnMotionSts_173 2;
BA_ "GenSigASIL"  SG_ 1022 FRM_51_DetnRngRadial_173 2;
BA_ "GenSigStartValue" SG_ 1022 FRM_51_DetnAziAngle_173 900;
BA_ "GenSigASIL"  SG_ 1022 FRM_51_DetnAziAngle_173 2;
BA_ "GenSigStartValue" SG_ 1022 FRM_51_DetnElevnAngle_173 100;
BA_ "GenSigASIL"  SG_ 1022 FRM_51_DetnElevnAngle_173 2;
BA_ "GenSigStartValue" SG_ 1022 FRM_51_DetnRelVelRadial_173 10000;
BA_ "GenSigASIL"  SG_ 1022 FRM_51_DetnRelVelRadial_173 2;
BA_ "GenSigASIL"  SG_ 1022 FRM_51_DetnSNR_173 2;
BA_ "GenSigStartValue" SG_ 1022 FRM_51_DetnRCS_173 5000;
BA_ "GenSigASIL"  SG_ 1022 FRM_51_DetnRCS_173 2;
BA_ "GenSigASIL"  SG_ 1022 FRM_51_DetnQuality_173 2;
BA_ "GenMsgILSupport" BO_ 1023 1;
BA_ "GenMsgCycleTime" BO_ 1023 50;
BA_ "GenSigASIL"  SG_ 1023 FRM_52_CRC 5;
BA_ "GenSigASIL"  SG_ 1023 FRM_52_RollgCntr 5;
BA_ "GenSigASIL"  SG_ 1023 FRM_52_DetnBlockCounter 2;
BA_ "GenSigASIL"  SG_ 1023 FRM_52_DetnMotionSts_174 2;
BA_ "GenSigASIL"  SG_ 1023 FRM_52_DetnRngRadial_174 2;
BA_ "GenSigStartValue" SG_ 1023 FRM_52_DetnAziAngle_174 900;
BA_ "GenSigASIL"  SG_ 1023 FRM_52_DetnAziAngle_174 2;
BA_ "GenSigStartValue" SG_ 1023 FRM_52_DetnElevnAngle_174 100;
BA_ "GenSigASIL"  SG_ 1023 FRM_52_DetnElevnAngle_174 2;
BA_ "GenSigStartValue" SG_ 1023 FRM_52_DetnRelVelRadial_174 10000;
BA_ "GenSigASIL"  SG_ 1023 FRM_52_DetnRelVelRadial_174 2;
BA_ "GenSigASIL"  SG_ 1023 FRM_52_DetnSNR_174 2;
BA_ "GenSigStartValue" SG_ 1023 FRM_52_DetnRCS_174 5000;
BA_ "GenSigASIL"  SG_ 1023 FRM_52_DetnRCS_174 2;
BA_ "GenSigASIL"  SG_ 1023 FRM_52_DetnQuality_174 2;
BA_ "GenSigASIL"  SG_ 1023 FRM_52_DetnMotionSts_175 2;
BA_ "GenSigASIL"  SG_ 1023 FRM_52_DetnRngRadial_175 2;
BA_ "GenSigStartValue" SG_ 1023 FRM_52_DetnAziAngle_175 900;
BA_ "GenSigASIL"  SG_ 1023 FRM_52_DetnAziAngle_175 2;
BA_ "GenSigStartValue" SG_ 1023 FRM_52_DetnElevnAngle_175 100;
BA_ "GenSigASIL"  SG_ 1023 FRM_52_DetnElevnAngle_175 2;
BA_ "GenSigStartValue" SG_ 1023 FRM_52_DetnRelVelRadial_175 10000;
BA_ "GenSigASIL"  SG_ 1023 FRM_52_DetnRelVelRadial_175 2;
BA_ "GenSigASIL"  SG_ 1023 FRM_52_DetnSNR_175 2;
BA_ "GenSigStartValue" SG_ 1023 FRM_52_DetnRCS_175 5000;
BA_ "GenSigASIL"  SG_ 1023 FRM_52_DetnRCS_175 2;
BA_ "GenSigASIL"  SG_ 1023 FRM_52_DetnQuality_175 2;
BA_ "GenSigASIL"  SG_ 1023 FRM_52_DetnMotionSts_176 2;
BA_ "GenSigASIL"  SG_ 1023 FRM_52_DetnRngRadial_176 2;
BA_ "GenSigStartValue" SG_ 1023 FRM_52_DetnAziAngle_176 900;
BA_ "GenSigASIL"  SG_ 1023 FRM_52_DetnAziAngle_176 2;
BA_ "GenSigStartValue" SG_ 1023 FRM_52_DetnElevnAngle_176 100;
BA_ "GenSigASIL"  SG_ 1023 FRM_52_DetnElevnAngle_176 2;
BA_ "GenSigStartValue" SG_ 1023 FRM_52_DetnRelVelRadial_176 10000;
BA_ "GenSigASIL"  SG_ 1023 FRM_52_DetnRelVelRadial_176 2;
BA_ "GenSigASIL"  SG_ 1023 FRM_52_DetnSNR_176 2;
BA_ "GenSigStartValue" SG_ 1023 FRM_52_DetnRCS_176 5000;
BA_ "GenSigASIL"  SG_ 1023 FRM_52_DetnRCS_176 2;
BA_ "GenSigASIL"  SG_ 1023 FRM_52_DetnQuality_176 2;
BA_ "GenSigASIL"  SG_ 1023 FRM_52_DetnMotionSts_177 2;
BA_ "GenSigASIL"  SG_ 1023 FRM_52_DetnRngRadial_177 2;
BA_ "GenSigStartValue" SG_ 1023 FRM_52_DetnAziAngle_177 900;
BA_ "GenSigASIL"  SG_ 1023 FRM_52_DetnAziAngle_177 2;
BA_ "GenSigStartValue" SG_ 1023 FRM_52_DetnElevnAngle_177 100;
BA_ "GenSigASIL"  SG_ 1023 FRM_52_DetnElevnAngle_177 2;
BA_ "GenSigStartValue" SG_ 1023 FRM_52_DetnRelVelRadial_177 10000;
BA_ "GenSigASIL"  SG_ 1023 FRM_52_DetnRelVelRadial_177 2;
BA_ "GenSigASIL"  SG_ 1023 FRM_52_DetnSNR_177 2;
BA_ "GenSigStartValue" SG_ 1023 FRM_52_DetnRCS_177 5000;
BA_ "GenSigASIL"  SG_ 1023 FRM_52_DetnRCS_177 2;
BA_ "GenSigASIL"  SG_ 1023 FRM_52_DetnQuality_177 2;
BA_ "GenSigASIL"  SG_ 1023 FRM_52_DetnMotionSts_178 2;
BA_ "GenSigASIL"  SG_ 1023 FRM_52_DetnRngRadial_178 2;
BA_ "GenSigStartValue" SG_ 1023 FRM_52_DetnAziAngle_178 900;
BA_ "GenSigASIL"  SG_ 1023 FRM_52_DetnAziAngle_178 2;
BA_ "GenSigStartValue" SG_ 1023 FRM_52_DetnElevnAngle_178 100;
BA_ "GenSigASIL"  SG_ 1023 FRM_52_DetnElevnAngle_178 2;
BA_ "GenSigStartValue" SG_ 1023 FRM_52_DetnRelVelRadial_178 10000;
BA_ "GenSigASIL"  SG_ 1023 FRM_52_DetnRelVelRadial_178 2;
BA_ "GenSigASIL"  SG_ 1023 FRM_52_DetnSNR_178 2;
BA_ "GenSigStartValue" SG_ 1023 FRM_52_DetnRCS_178 5000;
BA_ "GenSigASIL"  SG_ 1023 FRM_52_DetnRCS_178 2;
BA_ "GenSigASIL"  SG_ 1023 FRM_52_DetnQuality_178 2;
BA_ "GenSigASIL"  SG_ 1023 FRM_52_DetnMotionSts_179 2;
BA_ "GenSigASIL"  SG_ 1023 FRM_52_DetnRngRadial_179 2;
BA_ "GenSigStartValue" SG_ 1023 FRM_52_DetnAziAngle_179 900;
BA_ "GenSigASIL"  SG_ 1023 FRM_52_DetnAziAngle_179 2;
BA_ "GenSigStartValue" SG_ 1023 FRM_52_DetnElevnAngle_179 100;
BA_ "GenSigASIL"  SG_ 1023 FRM_52_DetnElevnAngle_179 2;
BA_ "GenSigStartValue" SG_ 1023 FRM_52_DetnRelVelRadial_179 10000;
BA_ "GenSigASIL"  SG_ 1023 FRM_52_DetnRelVelRadial_179 2;
BA_ "GenSigASIL"  SG_ 1023 FRM_52_DetnSNR_179 2;
BA_ "GenSigStartValue" SG_ 1023 FRM_52_DetnRCS_179 5000;
BA_ "GenSigASIL"  SG_ 1023 FRM_52_DetnRCS_179 2;
BA_ "GenSigASIL"  SG_ 1023 FRM_52_DetnQuality_179 2;
BA_ "GenMsgILSupport" BO_ 1024 1;
BA_ "GenMsgCycleTime" BO_ 1024 50;
BA_ "GenSigASIL"  SG_ 1024 FRM_53_CRC 5;
BA_ "GenSigASIL"  SG_ 1024 FRM_53_RollgCntr 5;
BA_ "GenSigASIL"  SG_ 1024 FRM_53_DetnBlockCounter 2;
BA_ "GenSigASIL"  SG_ 1024 FRM_53_DetnMotionSts_180 2;
BA_ "GenSigASIL"  SG_ 1024 FRM_53_DetnRngRadial_180 2;
BA_ "GenSigStartValue" SG_ 1024 FRM_53_DetnAziAngle_180 900;
BA_ "GenSigASIL"  SG_ 1024 FRM_53_DetnAziAngle_180 2;
BA_ "GenSigStartValue" SG_ 1024 FRM_53_DetnElevnAngle_180 100;
BA_ "GenSigASIL"  SG_ 1024 FRM_53_DetnElevnAngle_180 2;
BA_ "GenSigStartValue" SG_ 1024 FRM_53_DetnRelVelRadial_180 10000;
BA_ "GenSigASIL"  SG_ 1024 FRM_53_DetnRelVelRadial_180 2;
BA_ "GenSigASIL"  SG_ 1024 FRM_53_DetnSNR_180 2;
BA_ "GenSigStartValue" SG_ 1024 FRM_53_DetnRCS_180 5000;
BA_ "GenSigASIL"  SG_ 1024 FRM_53_DetnRCS_180 2;
BA_ "GenSigASIL"  SG_ 1024 FRM_53_DetnQuality_180 2;
BA_ "GenSigASIL"  SG_ 1024 FRM_53_DetnMotionSts_181 2;
BA_ "GenSigASIL"  SG_ 1024 FRM_53_DetnRngRadial_181 2;
BA_ "GenSigStartValue" SG_ 1024 FRM_53_DetnAziAngle_181 900;
BA_ "GenSigASIL"  SG_ 1024 FRM_53_DetnAziAngle_181 2;
BA_ "GenSigStartValue" SG_ 1024 FRM_53_DetnElevnAngle_181 100;
BA_ "GenSigASIL"  SG_ 1024 FRM_53_DetnElevnAngle_181 2;
BA_ "GenSigStartValue" SG_ 1024 FRM_53_DetnRelVelRadial_181 10000;
BA_ "GenSigASIL"  SG_ 1024 FRM_53_DetnRelVelRadial_181 2;
BA_ "GenSigASIL"  SG_ 1024 FRM_53_DetnSNR_181 2;
BA_ "GenSigStartValue" SG_ 1024 FRM_53_DetnRCS_181 5000;
BA_ "GenSigASIL"  SG_ 1024 FRM_53_DetnRCS_181 2;
BA_ "GenSigASIL"  SG_ 1024 FRM_53_DetnQuality_181 2;
BA_ "GenSigASIL"  SG_ 1024 FRM_53_DetnMotionSts_182 2;
BA_ "GenSigASIL"  SG_ 1024 FRM_53_DetnRngRadial_182 2;
BA_ "GenSigStartValue" SG_ 1024 FRM_53_DetnAziAngle_182 900;
BA_ "GenSigASIL"  SG_ 1024 FRM_53_DetnAziAngle_182 2;
BA_ "GenSigStartValue" SG_ 1024 FRM_53_DetnElevnAngle_182 100;
BA_ "GenSigASIL"  SG_ 1024 FRM_53_DetnElevnAngle_182 2;
BA_ "GenSigStartValue" SG_ 1024 FRM_53_DetnRelVelRadial_182 10000;
BA_ "GenSigASIL"  SG_ 1024 FRM_53_DetnRelVelRadial_182 2;
BA_ "GenSigASIL"  SG_ 1024 FRM_53_DetnSNR_182 2;
BA_ "GenSigStartValue" SG_ 1024 FRM_53_DetnRCS_182 5000;
BA_ "GenSigASIL"  SG_ 1024 FRM_53_DetnRCS_182 2;
BA_ "GenSigASIL"  SG_ 1024 FRM_53_DetnQuality_182 2;
BA_ "GenSigASIL"  SG_ 1024 FRM_53_DetnMotionSts_183 2;
BA_ "GenSigASIL"  SG_ 1024 FRM_53_DetnRngRadial_183 2;
BA_ "GenSigStartValue" SG_ 1024 FRM_53_DetnAziAngle_183 900;
BA_ "GenSigASIL"  SG_ 1024 FRM_53_DetnAziAngle_183 2;
BA_ "GenSigStartValue" SG_ 1024 FRM_53_DetnElevnAngle_183 100;
BA_ "GenSigASIL"  SG_ 1024 FRM_53_DetnElevnAngle_183 2;
BA_ "GenSigStartValue" SG_ 1024 FRM_53_DetnRelVelRadial_183 10000;
BA_ "GenSigASIL"  SG_ 1024 FRM_53_DetnRelVelRadial_183 2;
BA_ "GenSigASIL"  SG_ 1024 FRM_53_DetnSNR_183 2;
BA_ "GenSigStartValue" SG_ 1024 FRM_53_DetnRCS_183 5000;
BA_ "GenSigASIL"  SG_ 1024 FRM_53_DetnRCS_183 2;
BA_ "GenSigASIL"  SG_ 1024 FRM_53_DetnQuality_183 2;
BA_ "GenSigASIL"  SG_ 1024 FRM_53_DetnMotionSts_184 2;
BA_ "GenSigASIL"  SG_ 1024 FRM_53_DetnRngRadial_184 2;
BA_ "GenSigStartValue" SG_ 1024 FRM_53_DetnAziAngle_184 900;
BA_ "GenSigASIL"  SG_ 1024 FRM_53_DetnAziAngle_184 2;
BA_ "GenSigStartValue" SG_ 1024 FRM_53_DetnElevnAngle_184 100;
BA_ "GenSigASIL"  SG_ 1024 FRM_53_DetnElevnAngle_184 2;
BA_ "GenSigStartValue" SG_ 1024 FRM_53_DetnRelVelRadial_184 10000;
BA_ "GenSigASIL"  SG_ 1024 FRM_53_DetnRelVelRadial_184 2;
BA_ "GenSigASIL"  SG_ 1024 FRM_53_DetnSNR_184 2;
BA_ "GenSigStartValue" SG_ 1024 FRM_53_DetnRCS_184 5000;
BA_ "GenSigASIL"  SG_ 1024 FRM_53_DetnRCS_184 2;
BA_ "GenSigASIL"  SG_ 1024 FRM_53_DetnQuality_184 2;
BA_ "GenSigASIL"  SG_ 1024 FRM_53_DetnMotionSts_185 2;
BA_ "GenSigASIL"  SG_ 1024 FRM_53_DetnRngRadial_185 2;
BA_ "GenSigStartValue" SG_ 1024 FRM_53_DetnAziAngle_185 900;
BA_ "GenSigASIL"  SG_ 1024 FRM_53_DetnAziAngle_185 2;
BA_ "GenSigStartValue" SG_ 1024 FRM_53_DetnElevnAngle_185 100;
BA_ "GenSigASIL"  SG_ 1024 FRM_53_DetnElevnAngle_185 2;
BA_ "GenSigStartValue" SG_ 1024 FRM_53_DetnRelVelRadial_185 10000;
BA_ "GenSigASIL"  SG_ 1024 FRM_53_DetnRelVelRadial_185 2;
BA_ "GenSigASIL"  SG_ 1024 FRM_53_DetnSNR_185 2;
BA_ "GenSigStartValue" SG_ 1024 FRM_53_DetnRCS_185 5000;
BA_ "GenSigASIL"  SG_ 1024 FRM_53_DetnRCS_185 2;
BA_ "GenSigASIL"  SG_ 1024 FRM_53_DetnQuality_185 2;
BA_ "GenMsgILSupport" BO_ 1025 1;
BA_ "GenMsgCycleTime" BO_ 1025 50;
BA_ "GenSigASIL"  SG_ 1025 FRM_54_CRC 5;
BA_ "GenSigASIL"  SG_ 1025 FRM_54_RollgCntr 5;
BA_ "GenSigASIL"  SG_ 1025 FRM_54_DetnBlockCounter 2;
BA_ "GenSigASIL"  SG_ 1025 FRM_54_DetnMotionSts_186 2;
BA_ "GenSigASIL"  SG_ 1025 FRM_54_DetnRngRadial_186 2;
BA_ "GenSigStartValue" SG_ 1025 FRM_54_DetnAziAngle_186 900;
BA_ "GenSigASIL"  SG_ 1025 FRM_54_DetnAziAngle_186 2;
BA_ "GenSigStartValue" SG_ 1025 FRM_54_DetnElevnAngle_186 100;
BA_ "GenSigASIL"  SG_ 1025 FRM_54_DetnElevnAngle_186 2;
BA_ "GenSigStartValue" SG_ 1025 FRM_54_DetnRelVelRadial_186 10000;
BA_ "GenSigASIL"  SG_ 1025 FRM_54_DetnRelVelRadial_186 2;
BA_ "GenSigASIL"  SG_ 1025 FRM_54_DetnSNR_186 2;
BA_ "GenSigStartValue" SG_ 1025 FRM_54_DetnRCS_186 5000;
BA_ "GenSigASIL"  SG_ 1025 FRM_54_DetnRCS_186 2;
BA_ "GenSigASIL"  SG_ 1025 FRM_54_DetnQuality_186 2;
BA_ "GenSigASIL"  SG_ 1025 FRM_54_DetnMotionSts_187 2;
BA_ "GenSigASIL"  SG_ 1025 FRM_54_DetnRngRadial_187 2;
BA_ "GenSigStartValue" SG_ 1025 FRM_54_DetnAziAngle_187 900;
BA_ "GenSigASIL"  SG_ 1025 FRM_54_DetnAziAngle_187 2;
BA_ "GenSigStartValue" SG_ 1025 FRM_54_DetnElevnAngle_187 100;
BA_ "GenSigASIL"  SG_ 1025 FRM_54_DetnElevnAngle_187 2;
BA_ "GenSigStartValue" SG_ 1025 FRM_54_DetnRelVelRadial_187 10000;
BA_ "GenSigASIL"  SG_ 1025 FRM_54_DetnRelVelRadial_187 2;
BA_ "GenSigASIL"  SG_ 1025 FRM_54_DetnSNR_187 2;
BA_ "GenSigStartValue" SG_ 1025 FRM_54_DetnRCS_187 5000;
BA_ "GenSigASIL"  SG_ 1025 FRM_54_DetnRCS_187 2;
BA_ "GenSigASIL"  SG_ 1025 FRM_54_DetnQuality_187 2;
BA_ "GenSigASIL"  SG_ 1025 FRM_54_DetnMotionSts_188 2;
BA_ "GenSigASIL"  SG_ 1025 FRM_54_DetnRngRadial_188 2;
BA_ "GenSigStartValue" SG_ 1025 FRM_54_DetnAziAngle_188 900;
BA_ "GenSigASIL"  SG_ 1025 FRM_54_DetnAziAngle_188 2;
BA_ "GenSigStartValue" SG_ 1025 FRM_54_DetnElevnAngle_188 100;
BA_ "GenSigASIL"  SG_ 1025 FRM_54_DetnElevnAngle_188 2;
BA_ "GenSigStartValue" SG_ 1025 FRM_54_DetnRelVelRadial_188 10000;
BA_ "GenSigASIL"  SG_ 1025 FRM_54_DetnRelVelRadial_188 2;
BA_ "GenSigASIL"  SG_ 1025 FRM_54_DetnSNR_188 2;
BA_ "GenSigStartValue" SG_ 1025 FRM_54_DetnRCS_188 5000;
BA_ "GenSigASIL"  SG_ 1025 FRM_54_DetnRCS_188 2;
BA_ "GenSigASIL"  SG_ 1025 FRM_54_DetnQuality_188 2;
BA_ "GenSigASIL"  SG_ 1025 FRM_54_DetnMotionSts_189 2;
BA_ "GenSigASIL"  SG_ 1025 FRM_54_DetnRngRadial_189 2;
BA_ "GenSigStartValue" SG_ 1025 FRM_54_DetnAziAngle_189 900;
BA_ "GenSigASIL"  SG_ 1025 FRM_54_DetnAziAngle_189 2;
BA_ "GenSigStartValue" SG_ 1025 FRM_54_DetnElevnAngle_189 100;
BA_ "GenSigASIL"  SG_ 1025 FRM_54_DetnElevnAngle_189 2;
BA_ "GenSigStartValue" SG_ 1025 FRM_54_DetnRelVelRadial_189 10000;
BA_ "GenSigASIL"  SG_ 1025 FRM_54_DetnRelVelRadial_189 2;
BA_ "GenSigASIL"  SG_ 1025 FRM_54_DetnSNR_189 2;
BA_ "GenSigStartValue" SG_ 1025 FRM_54_DetnRCS_189 5000;
BA_ "GenSigASIL"  SG_ 1025 FRM_54_DetnRCS_189 2;
BA_ "GenSigASIL"  SG_ 1025 FRM_54_DetnQuality_189 2;
BA_ "GenSigASIL"  SG_ 1025 FRM_54_DetnMotionSts_190 2;
BA_ "GenSigASIL"  SG_ 1025 FRM_54_DetnRngRadial_190 2;
BA_ "GenSigStartValue" SG_ 1025 FRM_54_DetnAziAngle_190 900;
BA_ "GenSigASIL"  SG_ 1025 FRM_54_DetnAziAngle_190 2;
BA_ "GenSigStartValue" SG_ 1025 FRM_54_DetnElevnAngle_190 100;
BA_ "GenSigASIL"  SG_ 1025 FRM_54_DetnElevnAngle_190 2;
BA_ "GenSigStartValue" SG_ 1025 FRM_54_DetnRelVelRadial_190 10000;
BA_ "GenSigASIL"  SG_ 1025 FRM_54_DetnRelVelRadial_190 2;
BA_ "GenSigASIL"  SG_ 1025 FRM_54_DetnSNR_190 2;
BA_ "GenSigStartValue" SG_ 1025 FRM_54_DetnRCS_190 5000;
BA_ "GenSigASIL"  SG_ 1025 FRM_54_DetnRCS_190 2;
BA_ "GenSigASIL"  SG_ 1025 FRM_54_DetnQuality_190 2;
BA_ "GenSigASIL"  SG_ 1025 FRM_54_DetnMotionSts_191 2;
BA_ "GenSigASIL"  SG_ 1025 FRM_54_DetnRngRadial_191 2;
BA_ "GenSigStartValue" SG_ 1025 FRM_54_DetnAziAngle_191 900;
BA_ "GenSigASIL"  SG_ 1025 FRM_54_DetnAziAngle_191 2;
BA_ "GenSigStartValue" SG_ 1025 FRM_54_DetnElevnAngle_191 100;
BA_ "GenSigASIL"  SG_ 1025 FRM_54_DetnElevnAngle_191 2;
BA_ "GenSigStartValue" SG_ 1025 FRM_54_DetnRelVelRadial_191 10000;
BA_ "GenSigASIL"  SG_ 1025 FRM_54_DetnRelVelRadial_191 2;
BA_ "GenSigASIL"  SG_ 1025 FRM_54_DetnSNR_191 2;
BA_ "GenSigStartValue" SG_ 1025 FRM_54_DetnRCS_191 5000;
BA_ "GenSigASIL"  SG_ 1025 FRM_54_DetnRCS_191 2;
BA_ "GenSigASIL"  SG_ 1025 FRM_54_DetnQuality_191 2;
BA_ "GenMsgILSupport" BO_ 1026 1;
BA_ "GenMsgCycleTime" BO_ 1026 50;
BA_ "GenSigASIL"  SG_ 1026 FRM_55_CRC 5;
BA_ "GenSigASIL"  SG_ 1026 FRM_55_RollgCntr 5;
BA_ "GenSigASIL"  SG_ 1026 FRM_55_DetnBlockCounter 2;
BA_ "GenSigASIL"  SG_ 1026 FRM_55_DetnMotionSts_192 2;
BA_ "GenSigASIL"  SG_ 1026 FRM_55_DetnRngRadial_192 2;
BA_ "GenSigStartValue" SG_ 1026 FRM_55_DetnAziAngle_192 900;
BA_ "GenSigASIL"  SG_ 1026 FRM_55_DetnAziAngle_192 2;
BA_ "GenSigStartValue" SG_ 1026 FRM_55_DetnElevnAngle_192 100;
BA_ "GenSigASIL"  SG_ 1026 FRM_55_DetnElevnAngle_192 2;
BA_ "GenSigStartValue" SG_ 1026 FRM_55_DetnRelVelRadial_192 10000;
BA_ "GenSigASIL"  SG_ 1026 FRM_55_DetnRelVelRadial_192 2;
BA_ "GenSigASIL"  SG_ 1026 FRM_55_DetnSNR_192 2;
BA_ "GenSigStartValue" SG_ 1026 FRM_55_DetnRCS_192 5000;
BA_ "GenSigASIL"  SG_ 1026 FRM_55_DetnRCS_192 2;
BA_ "GenSigASIL"  SG_ 1026 FRM_55_DetnQuality_192 2;
BA_ "GenSigASIL"  SG_ 1026 FRM_55_DetnMotionSts_193 2;
BA_ "GenSigASIL"  SG_ 1026 FRM_55_DetnRngRadial_193 2;
BA_ "GenSigStartValue" SG_ 1026 FRM_55_DetnAziAngle_193 900;
BA_ "GenSigASIL"  SG_ 1026 FRM_55_DetnAziAngle_193 2;
BA_ "GenSigStartValue" SG_ 1026 FRM_55_DetnElevnAngle_193 100;
BA_ "GenSigASIL"  SG_ 1026 FRM_55_DetnElevnAngle_193 2;
BA_ "GenSigStartValue" SG_ 1026 FRM_55_DetnRelVelRadial_193 10000;
BA_ "GenSigASIL"  SG_ 1026 FRM_55_DetnRelVelRadial_193 2;
BA_ "GenSigASIL"  SG_ 1026 FRM_55_DetnSNR_193 2;
BA_ "GenSigStartValue" SG_ 1026 FRM_55_DetnRCS_193 5000;
BA_ "GenSigASIL"  SG_ 1026 FRM_55_DetnRCS_193 2;
BA_ "GenSigASIL"  SG_ 1026 FRM_55_DetnQuality_193 2;
BA_ "GenSigASIL"  SG_ 1026 FRM_55_DetnMotionSts_194 2;
BA_ "GenSigASIL"  SG_ 1026 FRM_55_DetnRngRadial_194 2;
BA_ "GenSigStartValue" SG_ 1026 FRM_55_DetnAziAngle_194 900;
BA_ "GenSigASIL"  SG_ 1026 FRM_55_DetnAziAngle_194 2;
BA_ "GenSigStartValue" SG_ 1026 FRM_55_DetnElevnAngle_194 100;
BA_ "GenSigASIL"  SG_ 1026 FRM_55_DetnElevnAngle_194 2;
BA_ "GenSigStartValue" SG_ 1026 FRM_55_DetnRelVelRadial_194 10000;
BA_ "GenSigASIL"  SG_ 1026 FRM_55_DetnRelVelRadial_194 2;
BA_ "GenSigASIL"  SG_ 1026 FRM_55_DetnSNR_194 2;
BA_ "GenSigStartValue" SG_ 1026 FRM_55_DetnRCS_194 5000;
BA_ "GenSigASIL"  SG_ 1026 FRM_55_DetnRCS_194 2;
BA_ "GenSigASIL"  SG_ 1026 FRM_55_DetnQuality_194 2;
BA_ "GenSigASIL"  SG_ 1026 FRM_55_DetnMotionSts_195 2;
BA_ "GenSigASIL"  SG_ 1026 FRM_55_DetnRngRadial_195 2;
BA_ "GenSigStartValue" SG_ 1026 FRM_55_DetnAziAngle_195 900;
BA_ "GenSigASIL"  SG_ 1026 FRM_55_DetnAziAngle_195 2;
BA_ "GenSigStartValue" SG_ 1026 FRM_55_DetnElevnAngle_195 100;
BA_ "GenSigASIL"  SG_ 1026 FRM_55_DetnElevnAngle_195 2;
BA_ "GenSigStartValue" SG_ 1026 FRM_55_DetnRelVelRadial_195 10000;
BA_ "GenSigASIL"  SG_ 1026 FRM_55_DetnRelVelRadial_195 2;
BA_ "GenSigASIL"  SG_ 1026 FRM_55_DetnSNR_195 2;
BA_ "GenSigStartValue" SG_ 1026 FRM_55_DetnRCS_195 5000;
BA_ "GenSigASIL"  SG_ 1026 FRM_55_DetnRCS_195 2;
BA_ "GenSigASIL"  SG_ 1026 FRM_55_DetnQuality_195 2;
BA_ "GenSigASIL"  SG_ 1026 FRM_55_DetnMotionSts_196 2;
BA_ "GenSigASIL"  SG_ 1026 FRM_55_DetnRngRadial_196 2;
BA_ "GenSigStartValue" SG_ 1026 FRM_55_DetnAziAngle_196 900;
BA_ "GenSigASIL"  SG_ 1026 FRM_55_DetnAziAngle_196 2;
BA_ "GenSigStartValue" SG_ 1026 FRM_55_DetnElevnAngle_196 100;
BA_ "GenSigASIL"  SG_ 1026 FRM_55_DetnElevnAngle_196 2;
BA_ "GenSigStartValue" SG_ 1026 FRM_55_DetnRelVelRadial_196 10000;
BA_ "GenSigASIL"  SG_ 1026 FRM_55_DetnRelVelRadial_196 2;
BA_ "GenSigASIL"  SG_ 1026 FRM_55_DetnSNR_196 2;
BA_ "GenSigStartValue" SG_ 1026 FRM_55_DetnRCS_196 5000;
BA_ "GenSigASIL"  SG_ 1026 FRM_55_DetnRCS_196 2;
BA_ "GenSigASIL"  SG_ 1026 FRM_55_DetnQuality_196 2;
BA_ "GenSigASIL"  SG_ 1026 FRM_55_DetnMotionSts_197 2;
BA_ "GenSigASIL"  SG_ 1026 FRM_55_DetnRngRadial_197 2;
BA_ "GenSigStartValue" SG_ 1026 FRM_55_DetnAziAngle_197 900;
BA_ "GenSigASIL"  SG_ 1026 FRM_55_DetnAziAngle_197 2;
BA_ "GenSigStartValue" SG_ 1026 FRM_55_DetnElevnAngle_197 100;
BA_ "GenSigASIL"  SG_ 1026 FRM_55_DetnElevnAngle_197 2;
BA_ "GenSigStartValue" SG_ 1026 FRM_55_DetnRelVelRadial_197 10000;
BA_ "GenSigASIL"  SG_ 1026 FRM_55_DetnRelVelRadial_197 2;
BA_ "GenSigASIL"  SG_ 1026 FRM_55_DetnSNR_197 2;
BA_ "GenSigStartValue" SG_ 1026 FRM_55_DetnRCS_197 5000;
BA_ "GenSigASIL"  SG_ 1026 FRM_55_DetnRCS_197 2;
BA_ "GenSigASIL"  SG_ 1026 FRM_55_DetnQuality_197 2;
VAL_ 1016 FRM_45_DetnMotionSts_132 3 "Invalid" 2 "Static" 1 "Moving" 0 "NoTarget" ;
VAL_ 1016 FRM_45_DetnMotionSts_133 3 "Invalid" 2 "Static" 1 "Moving" 0 "NoTarget" ;
VAL_ 1016 FRM_45_DetnMotionSts_134 3 "Invalid" 2 "Static" 1 "Moving" 0 "NoTarget" ;
VAL_ 1016 FRM_45_DetnMotionSts_135 3 "Invalid" 2 "Static" 1 "Moving" 0 "NoTarget" ;
VAL_ 1016 FRM_45_DetnMotionSts_136 3 "Invalid" 2 "Static" 1 "Moving" 0 "NoTarget" ;
VAL_ 1016 FRM_45_DetnMotionSts_137 3 "Invalid" 2 "Static" 1 "Moving" 0 "NoTarget" ;
VAL_ 1017 FRM_46_DetnMotionSts_138 3 "Invalid" 2 "Static" 1 "Moving" 0 "NoTarget" ;
VAL_ 1017 FRM_46_DetnMotionSts_139 3 "Invalid" 2 "Static" 1 "Moving" 0 "NoTarget" ;
VAL_ 1017 FRM_46_DetnMotionSts_140 3 "Invalid" 2 "Static" 1 "Moving" 0 "NoTarget" ;
VAL_ 1017 FRM_46_DetnMotionSts_141 3 "Invalid" 2 "Static" 1 "Moving" 0 "NoTarget" ;
VAL_ 1017 FRM_46_DetnMotionSts_142 3 "Invalid" 2 "Static" 1 "Moving" 0 "NoTarget" ;
VAL_ 1017 FRM_46_DetnMotionSts_143 3 "Invalid" 2 "Static" 1 "Moving" 0 "NoTarget" ;
VAL_ 1018 FRM_47_DetnMotionSts_144 3 "Invalid" 2 "Static" 1 "Moving" 0 "NoTarget" ;
VAL_ 1018 FRM_47_DetnMotionSts_145 3 "Invalid" 2 "Static" 1 "Moving" 0 "NoTarget" ;
VAL_ 1018 FRM_47_DetnMotionSts_146 3 "Invalid" 2 "Static" 1 "Moving" 0 "NoTarget" ;
VAL_ 1018 FRM_47_DetnMotionSts_147 3 "Invalid" 2 "Static" 1 "Moving" 0 "NoTarget" ;
VAL_ 1018 FRM_47_DetnMotionSts_148 3 "Invalid" 2 "Static" 1 "Moving" 0 "NoTarget" ;
VAL_ 1018 FRM_47_DetnMotionSts_149 3 "Invalid" 2 "Static" 1 "Moving" 0 "NoTarget" ;
VAL_ 1019 FRM_48_DetnMotionSts_150 3 "Invalid" 2 "Static" 1 "Moving" 0 "NoTarget" ;
VAL_ 1019 FRM_48_DetnMotionSts_151 3 "Invalid" 2 "Static" 1 "Moving" 0 "NoTarget" ;
VAL_ 1019 FRM_48_DetnMotionSts_152 3 "Invalid" 2 "Static" 1 "Moving" 0 "NoTarget" ;
VAL_ 1019 FRM_48_DetnMotionSts_153 3 "Invalid" 2 "Static" 1 "Moving" 0 "NoTarget" ;
VAL_ 1019 FRM_48_DetnMotionSts_154 3 "Invalid" 2 "Static" 1 "Moving" 0 "NoTarget" ;
VAL_ 1019 FRM_48_DetnMotionSts_155 3 "Invalid" 2 "Static" 1 "Moving" 0 "NoTarget" ;
VAL_ 1020 FRM_49_DetnMotionSts_156 3 "Invalid" 2 "Static" 1 "Moving" 0 "NoTarget" ;
VAL_ 1020 FRM_49_DetnMotionSts_157 3 "Invalid" 2 "Static" 1 "Moving" 0 "NoTarget" ;
VAL_ 1020 FRM_49_DetnMotionSts_158 3 "Invalid" 2 "Static" 1 "Moving" 0 "NoTarget" ;
VAL_ 1020 FRM_49_DetnMotionSts_159 3 "Invalid" 2 "Static" 1 "Moving" 0 "NoTarget" ;
VAL_ 1020 FRM_49_DetnMotionSts_160 3 "Invalid" 2 "Static" 1 "Moving" 0 "NoTarget" ;
VAL_ 1020 FRM_49_DetnMotionSts_161 3 "Invalid" 2 "Static" 1 "Moving" 0 "NoTarget" ;
VAL_ 1021 FRM_50_DetnMotionSts_162 3 "Invalid" 2 "Static" 1 "Moving" 0 "NoTarget" ;
VAL_ 1021 FRM_50_DetnMotionSts_163 3 "Invalid" 2 "Static" 1 "Moving" 0 "NoTarget" ;
VAL_ 1021 FRM_50_DetnMotionSts_164 3 "Invalid" 2 "Static" 1 "Moving" 0 "NoTarget" ;
VAL_ 1021 FRM_50_DetnMotionSts_165 3 "Invalid" 2 "Static" 1 "Moving" 0 "NoTarget" ;
VAL_ 1021 FRM_50_DetnMotionSts_166 3 "Invalid" 2 "Static" 1 "Moving" 0 "NoTarget" ;
VAL_ 1021 FRM_50_DetnMotionSts_167 3 "Invalid" 2 "Static" 1 "Moving" 0 "NoTarget" ;
VAL_ 1022 FRM_51_DetnMotionSts_168 3 "Invalid" 2 "Static" 1 "Moving" 0 "NoTarget" ;
VAL_ 1022 FRM_51_DetnMotionSts_169 3 "Invalid" 2 "Static" 1 "Moving" 0 "NoTarget" ;
VAL_ 1022 FRM_51_DetnMotionSts_170 3 "Invalid" 2 "Static" 1 "Moving" 0 "NoTarget" ;
VAL_ 1022 FRM_51_DetnMotionSts_171 3 "Invalid" 2 "Static" 1 "Moving" 0 "NoTarget" ;
VAL_ 1022 FRM_51_DetnMotionSts_172 3 "Invalid" 2 "Static" 1 "Moving" 0 "NoTarget" ;
VAL_ 1022 FRM_51_DetnMotionSts_173 3 "Invalid" 2 "Static" 1 "Moving" 0 "NoTarget" ;
VAL_ 1023 FRM_52_DetnMotionSts_174 3 "Invalid" 2 "Static" 1 "Moving" 0 "NoTarget" ;
VAL_ 1023 FRM_52_DetnMotionSts_175 3 "Invalid" 2 "Static" 1 "Moving" 0 "NoTarget" ;
VAL_ 1023 FRM_52_DetnMotionSts_176 3 "Invalid" 2 "Static" 1 "Moving" 0 "NoTarget" ;
VAL_ 1023 FRM_52_DetnMotionSts_177 3 "Invalid" 2 "Static" 1 "Moving" 0 "NoTarget" ;
VAL_ 1023 FRM_52_DetnMotionSts_178 3 "Invalid" 2 "Static" 1 "Moving" 0 "NoTarget" ;
VAL_ 1023 FRM_52_DetnMotionSts_179 3 "Invalid" 2 "Static" 1 "Moving" 0 "NoTarget" ;
VAL_ 1024 FRM_53_DetnMotionSts_180 3 "Invalid" 2 "Static" 1 "Moving" 0 "NoTarget" ;
VAL_ 1024 FRM_53_DetnMotionSts_181 3 "Invalid" 2 "Static" 1 "Moving" 0 "NoTarget" ;
VAL_ 1024 FRM_53_DetnMotionSts_182 3 "Invalid" 2 "Static" 1 "Moving" 0 "NoTarget" ;
VAL_ 1024 FRM_53_DetnMotionSts_183 3 "Invalid" 2 "Static" 1 "Moving" 0 "NoTarget" ;
VAL_ 1024 FRM_53_DetnMotionSts_184 3 "Invalid" 2 "Static" 1 "Moving" 0 "NoTarget" ;
VAL_ 1024 FRM_53_DetnMotionSts_185 3 "Invalid" 2 "Static" 1 "Moving" 0 "NoTarget" ;
VAL_ 1025 FRM_54_DetnMotionSts_186 3 "Invalid" 2 "Static" 1 "Moving" 0 "NoTarget" ;
VAL_ 1025 FRM_54_DetnMotionSts_187 3 "Invalid" 2 "Static" 1 "Moving" 0 "NoTarget" ;
VAL_ 1025 FRM_54_DetnMotionSts_188 3 "Invalid" 2 "Static" 1 "Moving" 0 "NoTarget" ;
VAL_ 1025 FRM_54_DetnMotionSts_189 3 "Invalid" 2 "Static" 1 "Moving" 0 "NoTarget" ;
VAL_ 1025 FRM_54_DetnMotionSts_190 3 "Invalid" 2 "Static" 1 "Moving" 0 "NoTarget" ;
VAL_ 1025 FRM_54_DetnMotionSts_191 3 "Invalid" 2 "Static" 1 "Moving" 0 "NoTarget" ;
VAL_ 1026 FRM_55_DetnMotionSts_192 3 "Invalid" 2 "Static" 1 "Moving" 0 "NoTarget" ;
VAL_ 1026 FRM_55_DetnMotionSts_193 3 "Invalid" 2 "Static" 1 "Moving" 0 "NoTarget" ;
VAL_ 1026 FRM_55_DetnMotionSts_194 3 "Invalid" 2 "Static" 1 "Moving" 0 "NoTarget" ;
VAL_ 1026 FRM_55_DetnMotionSts_195 3 "Invalid" 2 "Static" 1 "Moving" 0 "NoTarget" ;
VAL_ 1026 FRM_55_DetnMotionSts_196 3 "Invalid" 2 "Static" 1 "Moving" 0 "NoTarget" ;
VAL_ 1026 FRM_55_DetnMotionSts_197 3 "Invalid" 2 "Static" 1 "Moving" 0 "NoTarget" ;
