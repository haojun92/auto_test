VERSION ""

NS_ :

BS_:

BU_: ADCC_FM_4X

BO_ 994 FRM_23: 64 Vector__XXX
 SG_ FRM_23_CRC : 7|16@0+ (1,0) [0|65535] ""  ADCC_FM_4X
 SG_ FRM_23_RollgCntr : 23|8@0+ (1,0) [0|255] ""  ADCC_FM_4X
 SG_ FRM_23_DetnBlockCounter : 27|4@0+ (1,0) [0|15] ""  ADCC_FM_4X
 SG_ FRM_23_DetnMotionSts_000 : 29|2@0+ (1,0) [0|3] ""  ADCC_FM_4X
 SG_ FRM_23_DetnRngRadial_000 : 39|15@0+ (0.01,0) [0|200] "m"  ADCC_FM_4X
 SG_ FRM_23_DetnAziAngle_000 : 40|11@0+ (0.1,-90) [-90|90] "deg"  ADCC_FM_4X
 SG_ FRM_23_DetnElevnAngle_000 : 61|8@0+ (0.1,-10) [-10|10] "deg"  ADCC_FM_4X
 SG_ FRM_23_DetnRelVelRadial_000 : 69|15@0+ (0.01,-100) [-100|80] "m/s"  ADCC_FM_4X
 SG_ FRM_23_DetnSNR_000 : 86|7@0+ (1,0) [0|100] "dB"  ADCC_FM_4X
 SG_ FRM_23_DetnRCS_000 : 95|15@0+ (0.01,-50) [-50|128] "dBsm"  ADCC_FM_4X
 SG_ FRM_23_DetnQuality_000 : 96|4@0+ (10,0) [0|100] "%"  ADCC_FM_4X
 SG_ FRM_23_DetnMotionSts_001 : 31|2@0+ (1,0) [0|3] ""  ADCC_FM_4X
 SG_ FRM_23_DetnRngRadial_001 : 108|15@0+ (0.01,0) [0|200] "m"  ADCC_FM_4X
 SG_ FRM_23_DetnAziAngle_001 : 125|11@0+ (0.1,-90) [-90|90] "deg"  ADCC_FM_4X
 SG_ FRM_23_DetnElevnAngle_001 : 130|8@0+ (0.1,-10) [-10|10] "deg"  ADCC_FM_4X
 SG_ FRM_23_DetnRelVelRadial_001 : 138|15@0+ (0.01,-100) [-100|80] "m/s"  ADCC_FM_4X
 SG_ FRM_23_DetnSNR_001 : 155|7@0+ (1,0) [0|100] "dB"  ADCC_FM_4X
 SG_ FRM_23_DetnRCS_001 : 164|15@0+ (0.01,-50) [-50|128] "dBsm"  ADCC_FM_4X
 SG_ FRM_23_DetnQuality_001 : 181|4@0+ (10,0) [0|100] "%"  ADCC_FM_4X
 SG_ FRM_23_DetnMotionSts_002 : 177|2@0+ (1,0) [0|3] ""  ADCC_FM_4X
 SG_ FRM_23_DetnRngRadial_002 : 191|15@0+ (0.01,0) [0|200] "m"  ADCC_FM_4X
 SG_ FRM_23_DetnAziAngle_002 : 192|11@0+ (0.1,-90) [-90|90] "deg"  ADCC_FM_4X
 SG_ FRM_23_DetnElevnAngle_002 : 213|8@0+ (0.1,-10) [-10|10] "deg"  ADCC_FM_4X
 SG_ FRM_23_DetnRelVelRadial_002 : 221|15@0+ (0.01,-100) [-100|80] "m/s"  ADCC_FM_4X
 SG_ FRM_23_DetnSNR_002 : 238|7@0+ (1,0) [0|100] "dB"  ADCC_FM_4X
 SG_ FRM_23_DetnRCS_002 : 247|15@0+ (0.01,-50) [-50|128] "dBsm"  ADCC_FM_4X
 SG_ FRM_23_DetnQuality_002 : 248|4@0+ (10,0) [0|100] "%"  ADCC_FM_4X
 SG_ FRM_23_DetnMotionSts_003 : 260|2@0+ (1,0) [0|3] ""  ADCC_FM_4X
 SG_ FRM_23_DetnRngRadial_003 : 258|15@0+ (0.01,0) [0|200] "m"  ADCC_FM_4X
 SG_ FRM_23_DetnAziAngle_003 : 275|11@0+ (0.1,-90) [-90|90] "deg"  ADCC_FM_4X
 SG_ FRM_23_DetnElevnAngle_003 : 280|8@0+ (0.1,-10) [-10|10] "deg"  ADCC_FM_4X
 SG_ FRM_23_DetnRelVelRadial_003 : 288|15@0+ (0.01,-100) [-100|80] "m/s"  ADCC_FM_4X
 SG_ FRM_23_DetnSNR_003 : 305|7@0+ (1,0) [0|100] "dB"  ADCC_FM_4X
 SG_ FRM_23_DetnRCS_003 : 314|15@0+ (0.01,-50) [-50|128] "dBsm"  ADCC_FM_4X
 SG_ FRM_23_DetnQuality_003 : 331|4@0+ (10,0) [0|100] "%"  ADCC_FM_4X
 SG_ FRM_23_DetnMotionSts_004 : 343|2@0+ (1,0) [0|3] ""  ADCC_FM_4X
 SG_ FRM_23_DetnRngRadial_004 : 341|15@0+ (0.01,0) [0|200] "m"  ADCC_FM_4X
 SG_ FRM_23_DetnAziAngle_004 : 358|11@0+ (0.1,-90) [-90|90] "deg"  ADCC_FM_4X
 SG_ FRM_23_DetnElevnAngle_004 : 363|8@0+ (0.1,-10) [-10|10] "deg"  ADCC_FM_4X
 SG_ FRM_23_DetnRelVelRadial_004 : 371|15@0+ (0.01,-100) [-100|80] "m/s"  ADCC_FM_4X
 SG_ FRM_23_DetnSNR_004 : 388|7@0+ (1,0) [0|100] "dB"  ADCC_FM_4X
 SG_ FRM_23_DetnRCS_004 : 397|15@0+ (0.01,-50) [-50|128] "dBsm"  ADCC_FM_4X
 SG_ FRM_23_DetnQuality_004 : 414|4@0+ (10,0) [0|100] "%"  ADCC_FM_4X
 SG_ FRM_23_DetnMotionSts_005 : 410|2@0+ (1,0) [0|3] ""  ADCC_FM_4X
 SG_ FRM_23_DetnRngRadial_005 : 408|15@0+ (0.01,0) [0|200] "m"  ADCC_FM_4X
 SG_ FRM_23_DetnAziAngle_005 : 425|11@0+ (0.1,-90) [-90|90] "deg"  ADCC_FM_4X
 SG_ FRM_23_DetnElevnAngle_005 : 446|8@0+ (0.1,-10) [-10|10] "deg"  ADCC_FM_4X
 SG_ FRM_23_DetnRelVelRadial_005 : 454|15@0+ (0.01,-100) [-100|80] "m/s"  ADCC_FM_4X
 SG_ FRM_23_DetnSNR_005 : 471|7@0+ (1,0) [0|100] "dB"  ADCC_FM_4X
 SG_ FRM_23_DetnRCS_005 : 464|15@0+ (0.01,-50) [-50|128] "dBsm"  ADCC_FM_4X
 SG_ FRM_23_DetnQuality_005 : 481|4@0+ (10,0) [0|100] "%"  ADCC_FM_4X
 SG_ FRM_23_Loc000_Valid : 488|1@0+ (1,0) [0|1] ""  ADCC_FM_4X
 SG_ FRM_23_Loc001_Valid : 489|1@0+ (1,0) [0|1] ""  ADCC_FM_4X
 SG_ FRM_23_Loc002_Valid : 490|1@0+ (1,0) [0|1] ""  ADCC_FM_4X
 SG_ FRM_23_Loc003_Valid : 491|1@0+ (1,0) [0|1] ""  ADCC_FM_4X
 SG_ FRM_23_Loc004_Valid : 492|1@0+ (1,0) [0|1] ""  ADCC_FM_4X
 SG_ FRM_23_Loc005_Valid : 493|1@0+ (1,0) [0|1] ""  ADCC_FM_4X

BO_ 995 FRM_24: 64 Vector__XXX
 SG_ FRM_24_CRC : 7|16@0+ (1,0) [0|65535] ""  ADCC_FM_4X
 SG_ FRM_24_RollgCntr : 23|8@0+ (1,0) [0|255] ""  ADCC_FM_4X
 SG_ FRM_24_DetnBlockCounter : 27|4@0+ (1,0) [0|15] ""  ADCC_FM_4X
 SG_ FRM_24_DetnMotionSts_006 : 29|2@0+ (1,0) [0|3] ""  ADCC_FM_4X
 SG_ FRM_24_DetnRngRadial_006 : 39|15@0+ (0.01,0) [0|200] "m"  ADCC_FM_4X
 SG_ FRM_24_DetnAziAngle_006 : 40|11@0+ (0.1,-90) [-90|90] "deg"  ADCC_FM_4X
 SG_ FRM_24_DetnElevnAngle_006 : 61|8@0+ (0.1,-10) [-10|10] "deg"  ADCC_FM_4X
 SG_ FRM_24_DetnRelVelRadial_006 : 69|15@0+ (0.01,-100) [-100|80] "m/s"  ADCC_FM_4X
 SG_ FRM_24_DetnSNR_006 : 86|7@0+ (1,0) [0|100] "dB"  ADCC_FM_4X
 SG_ FRM_24_DetnRCS_006 : 95|15@0+ (0.01,-50) [-50|128] "dBsm"  ADCC_FM_4X
 SG_ FRM_24_DetnQuality_006 : 96|4@0+ (10,0) [0|100] "%"  ADCC_FM_4X
 SG_ FRM_24_DetnMotionSts_007 : 31|2@0+ (1,0) [0|3] ""  ADCC_FM_4X
 SG_ FRM_24_DetnRngRadial_007 : 108|15@0+ (0.01,0) [0|200] "m"  ADCC_FM_4X
 SG_ FRM_24_DetnAziAngle_007 : 125|11@0+ (0.1,-90) [-90|90] "deg"  ADCC_FM_4X
 SG_ FRM_24_DetnElevnAngle_007 : 130|8@0+ (0.1,-10) [-10|10] "deg"  ADCC_FM_4X
 SG_ FRM_24_DetnRelVelRadial_007 : 138|15@0+ (0.01,-100) [-100|80] "m/s"  ADCC_FM_4X
 SG_ FRM_24_DetnSNR_007 : 155|7@0+ (1,0) [0|100] "dB"  ADCC_FM_4X
 SG_ FRM_24_DetnRCS_007 : 164|15@0+ (0.01,-50) [-50|128] "dBsm"  ADCC_FM_4X
 SG_ FRM_24_DetnQuality_007 : 181|4@0+ (10,0) [0|100] "%"  ADCC_FM_4X
 SG_ FRM_24_DetnMotionSts_008 : 177|2@0+ (1,0) [0|3] ""  ADCC_FM_4X
 SG_ FRM_24_DetnRngRadial_008 : 191|15@0+ (0.01,0) [0|200] "m"  ADCC_FM_4X
 SG_ FRM_24_DetnAziAngle_008 : 192|11@0+ (0.1,-90) [-90|90] "deg"  ADCC_FM_4X
 SG_ FRM_24_DetnElevnAngle_008 : 213|8@0+ (0.1,-10) [-10|10] "deg"  ADCC_FM_4X
 SG_ FRM_24_DetnRelVelRadial_008 : 221|15@0+ (0.01,-100) [-100|80] "m/s"  ADCC_FM_4X
 SG_ FRM_24_DetnSNR_008 : 238|7@0+ (1,0) [0|100] "dB"  ADCC_FM_4X
 SG_ FRM_24_DetnRCS_008 : 247|15@0+ (0.01,-50) [-50|128] "dBsm"  ADCC_FM_4X
 SG_ FRM_24_DetnQuality_008 : 248|4@0+ (10,0) [0|100] "%"  ADCC_FM_4X
 SG_ FRM_24_DetnMotionSts_009 : 260|2@0+ (1,0) [0|3] ""  ADCC_FM_4X
 SG_ FRM_24_DetnRngRadial_009 : 258|15@0+ (0.01,0) [0|200] "m"  ADCC_FM_4X
 SG_ FRM_24_DetnAziAngle_009 : 275|11@0+ (0.1,-90) [-90|90] "deg"  ADCC_FM_4X
 SG_ FRM_24_DetnElevnAngle_009 : 280|8@0+ (0.1,-10) [-10|10] "deg"  ADCC_FM_4X
 SG_ FRM_24_DetnRelVelRadial_009 : 288|15@0+ (0.01,-100) [-100|80] "m/s"  ADCC_FM_4X
 SG_ FRM_24_DetnSNR_009 : 305|7@0+ (1,0) [0|100] "dB"  ADCC_FM_4X
 SG_ FRM_24_DetnRCS_009 : 314|15@0+ (0.01,-50) [-50|128] "dBsm"  ADCC_FM_4X
 SG_ FRM_24_DetnQuality_009 : 331|4@0+ (10,0) [0|100] "%"  ADCC_FM_4X
 SG_ FRM_24_DetnMotionSts_010 : 343|2@0+ (1,0) [0|3] ""  ADCC_FM_4X
 SG_ FRM_24_DetnRngRadial_010 : 341|15@0+ (0.01,0) [0|200] "m"  ADCC_FM_4X
 SG_ FRM_24_DetnAziAngle_010 : 358|11@0+ (0.1,-90) [-90|90] "deg"  ADCC_FM_4X
 SG_ FRM_24_DetnElevnAngle_010 : 363|8@0+ (0.1,-10) [-10|10] "deg"  ADCC_FM_4X
 SG_ FRM_24_DetnRelVelRadial_010 : 371|15@0+ (0.01,-100) [-100|80] "m/s"  ADCC_FM_4X
 SG_ FRM_24_DetnSNR_010 : 388|7@0+ (1,0) [0|100] "dB"  ADCC_FM_4X
 SG_ FRM_24_DetnRCS_010 : 397|15@0+ (0.01,-50) [-50|128] "dBsm"  ADCC_FM_4X
 SG_ FRM_24_DetnQuality_010 : 414|4@0+ (10,0) [0|100] "%"  ADCC_FM_4X
 SG_ FRM_24_DetnMotionSts_011 : 410|2@0+ (1,0) [0|3] ""  ADCC_FM_4X
 SG_ FRM_24_DetnRngRadial_011 : 408|15@0+ (0.01,0) [0|200] "m"  ADCC_FM_4X
 SG_ FRM_24_DetnAziAngle_011 : 425|11@0+ (0.1,-90) [-90|90] "deg"  ADCC_FM_4X
 SG_ FRM_24_DetnElevnAngle_011 : 446|8@0+ (0.1,-10) [-10|10] "deg"  ADCC_FM_4X
 SG_ FRM_24_DetnRelVelRadial_011 : 454|15@0+ (0.01,-100) [-100|80] "m/s"  ADCC_FM_4X
 SG_ FRM_24_DetnSNR_011 : 471|7@0+ (1,0) [0|100] "dB"  ADCC_FM_4X
 SG_ FRM_24_DetnRCS_011 : 464|15@0+ (0.01,-50) [-50|128] "dBsm"  ADCC_FM_4X
 SG_ FRM_24_DetnQuality_011 : 481|4@0+ (10,0) [0|100] "%"  ADCC_FM_4X
 SG_ FRM_24_Loc006_Valid : 488|1@0+ (1,0) [0|1] ""  ADCC_FM_4X
 SG_ FRM_24_Loc007_Valid : 489|1@0+ (1,0) [0|1] ""  ADCC_FM_4X
 SG_ FRM_24_Loc008_Valid : 490|1@0+ (1,0) [0|1] ""  ADCC_FM_4X
 SG_ FRM_24_Loc009_Valid : 491|1@0+ (1,0) [0|1] ""  ADCC_FM_4X
 SG_ FRM_24_Loc010_Valid : 492|1@0+ (1,0) [0|1] ""  ADCC_FM_4X
 SG_ FRM_24_Loc011_Valid : 493|1@0+ (1,0) [0|1] ""  ADCC_FM_4X

BO_ 996 FRM_25: 64 Vector__XXX
 SG_ FRM_25_CRC : 7|16@0+ (1,0) [0|65535] ""  ADCC_FM_4X
 SG_ FRM_25_RollgCntr : 23|8@0+ (1,0) [0|255] ""  ADCC_FM_4X
 SG_ FRM_25_DetnBlockCounter : 27|4@0+ (1,0) [0|15] ""  ADCC_FM_4X
 SG_ FRM_25_DetnMotionSts_012 : 29|2@0+ (1,0) [0|3] ""  ADCC_FM_4X
 SG_ FRM_25_DetnRngRadial_012 : 39|15@0+ (0.01,0) [0|200] "m"  ADCC_FM_4X
 SG_ FRM_25_DetnAziAngle_012 : 40|11@0+ (0.1,-90) [-90|90] "deg"  ADCC_FM_4X
 SG_ FRM_25_DetnElevnAngle_012 : 61|8@0+ (0.1,-10) [-10|10] "deg"  ADCC_FM_4X
 SG_ FRM_25_DetnRelVelRadial_012 : 69|15@0+ (0.01,-100) [-100|80] "m/s"  ADCC_FM_4X
 SG_ FRM_25_DetnSNR_012 : 86|7@0+ (1,0) [0|100] "dB"  ADCC_FM_4X
 SG_ FRM_25_DetnRCS_012 : 95|15@0+ (0.01,-50) [-50|128] "dBsm"  ADCC_FM_4X
 SG_ FRM_25_DetnQuality_012 : 96|4@0+ (10,0) [0|100] "%"  ADCC_FM_4X
 SG_ FRM_25_DetnMotionSts_013 : 31|2@0+ (1,0) [0|3] ""  ADCC_FM_4X
 SG_ FRM_25_DetnRngRadial_013 : 108|15@0+ (0.01,0) [0|200] "m"  ADCC_FM_4X
 SG_ FRM_25_DetnAziAngle_013 : 125|11@0+ (0.1,-90) [-90|90] "deg"  ADCC_FM_4X
 SG_ FRM_25_DetnElevnAngle_013 : 130|8@0+ (0.1,-10) [-10|10] "deg"  ADCC_FM_4X
 SG_ FRM_25_DetnRelVelRadial_013 : 138|15@0+ (0.01,-100) [-100|80] "m/s"  ADCC_FM_4X
 SG_ FRM_25_DetnSNR_013 : 155|7@0+ (1,0) [0|100] "dB"  ADCC_FM_4X
 SG_ FRM_25_DetnRCS_013 : 164|15@0+ (0.01,-50) [-50|128] "dBsm"  ADCC_FM_4X
 SG_ FRM_25_DetnQuality_013 : 181|4@0+ (10,0) [0|100] "%"  ADCC_FM_4X
 SG_ FRM_25_DetnMotionSts_014 : 177|2@0+ (1,0) [0|3] ""  ADCC_FM_4X
 SG_ FRM_25_DetnRngRadial_014 : 191|15@0+ (0.01,0) [0|200] "m"  ADCC_FM_4X
 SG_ FRM_25_DetnAziAngle_014 : 192|11@0+ (0.1,-90) [-90|90] "deg"  ADCC_FM_4X
 SG_ FRM_25_DetnElevnAngle_014 : 213|8@0+ (0.1,-10) [-10|10] "deg"  ADCC_FM_4X
 SG_ FRM_25_DetnRelVelRadial_014 : 221|15@0+ (0.01,-100) [-100|80] "m/s"  ADCC_FM_4X
 SG_ FRM_25_DetnSNR_014 : 238|7@0+ (1,0) [0|100] "dB"  ADCC_FM_4X
 SG_ FRM_25_DetnRCS_014 : 247|15@0+ (0.01,-50) [-50|128] "dBsm"  ADCC_FM_4X
 SG_ FRM_25_DetnQuality_014 : 248|4@0+ (10,0) [0|100] "%"  ADCC_FM_4X
 SG_ FRM_25_DetnMotionSts_015 : 260|2@0+ (1,0) [0|3] ""  ADCC_FM_4X
 SG_ FRM_25_DetnRngRadial_015 : 258|15@0+ (0.01,0) [0|200] "m"  ADCC_FM_4X
 SG_ FRM_25_DetnAziAngle_015 : 275|11@0+ (0.1,-90) [-90|90] "deg"  ADCC_FM_4X
 SG_ FRM_25_DetnElevnAngle_015 : 280|8@0+ (0.1,-10) [-10|10] "deg"  ADCC_FM_4X
 SG_ FRM_25_DetnRelVelRadial_015 : 288|15@0+ (0.01,-100) [-100|80] "m/s"  ADCC_FM_4X
 SG_ FRM_25_DetnSNR_015 : 305|7@0+ (1,0) [0|100] "dB"  ADCC_FM_4X
 SG_ FRM_25_DetnRCS_015 : 314|15@0+ (0.01,-50) [-50|128] "dBsm"  ADCC_FM_4X
 SG_ FRM_25_DetnQuality_015 : 331|4@0+ (10,0) [0|100] "%"  ADCC_FM_4X
 SG_ FRM_25_DetnMotionSts_016 : 343|2@0+ (1,0) [0|3] ""  ADCC_FM_4X
 SG_ FRM_25_DetnRngRadial_016 : 341|15@0+ (0.01,0) [0|200] "m"  ADCC_FM_4X
 SG_ FRM_25_DetnAziAngle_016 : 358|11@0+ (0.1,-90) [-90|90] "deg"  ADCC_FM_4X
 SG_ FRM_25_DetnElevnAngle_016 : 363|8@0+ (0.1,-10) [-10|10] "deg"  ADCC_FM_4X
 SG_ FRM_25_DetnRelVelRadial_016 : 371|15@0+ (0.01,-100) [-100|80] "m/s"  ADCC_FM_4X
 SG_ FRM_25_DetnSNR_016 : 388|7@0+ (1,0) [0|100] "dB"  ADCC_FM_4X
 SG_ FRM_25_DetnRCS_016 : 397|15@0+ (0.01,-50) [-50|128] "dBsm"  ADCC_FM_4X
 SG_ FRM_25_DetnQuality_016 : 414|4@0+ (10,0) [0|100] "%"  ADCC_FM_4X
 SG_ FRM_25_DetnMotionSts_017 : 410|2@0+ (1,0) [0|3] ""  ADCC_FM_4X
 SG_ FRM_25_DetnRngRadial_017 : 408|15@0+ (0.01,0) [0|200] "m"  ADCC_FM_4X
 SG_ FRM_25_DetnAziAngle_017 : 425|11@0+ (0.1,-90) [-90|90] "deg"  ADCC_FM_4X
 SG_ FRM_25_DetnElevnAngle_017 : 446|8@0+ (0.1,-10) [-10|10] "deg"  ADCC_FM_4X
 SG_ FRM_25_DetnRelVelRadial_017 : 454|15@0+ (0.01,-100) [-100|80] "m/s"  ADCC_FM_4X
 SG_ FRM_25_DetnSNR_017 : 471|7@0+ (1,0) [0|100] "dB"  ADCC_FM_4X
 SG_ FRM_25_DetnRCS_017 : 464|15@0+ (0.01,-50) [-50|128] "dBsm"  ADCC_FM_4X
 SG_ FRM_25_DetnQuality_017 : 481|4@0+ (10,0) [0|100] "%"  ADCC_FM_4X
 SG_ FRM_25_Loc012_Valid : 488|1@0+ (1,0) [0|1] ""  ADCC_FM_4X
 SG_ FRM_25_Loc013_Valid : 489|1@0+ (1,0) [0|1] ""  ADCC_FM_4X
 SG_ FRM_25_Loc014_Valid : 490|1@0+ (1,0) [0|1] ""  ADCC_FM_4X
 SG_ FRM_25_Loc015_Valid : 491|1@0+ (1,0) [0|1] ""  ADCC_FM_4X
 SG_ FRM_25_Loc016_Valid : 492|1@0+ (1,0) [0|1] ""  ADCC_FM_4X
 SG_ FRM_25_Loc017_Valid : 493|1@0+ (1,0) [0|1] ""  ADCC_FM_4X

BO_ 997 FRM_26: 64 Vector__XXX
 SG_ FRM_26_CRC : 7|16@0+ (1,0) [0|65535] ""  ADCC_FM_4X
 SG_ FRM_26_RollgCntr : 23|8@0+ (1,0) [0|255] ""  ADCC_FM_4X
 SG_ FRM_26_DetnBlockCounter : 27|4@0+ (1,0) [0|15] ""  ADCC_FM_4X
 SG_ FRM_26_DetnMotionSts_018 : 29|2@0+ (1,0) [0|3] ""  ADCC_FM_4X
 SG_ FRM_26_DetnRngRadial_018 : 39|15@0+ (0.01,0) [0|200] "m"  ADCC_FM_4X
 SG_ FRM_26_DetnAziAngle_018 : 40|11@0+ (0.1,-90) [-90|90] "deg"  ADCC_FM_4X
 SG_ FRM_26_DetnElevnAngle_018 : 61|8@0+ (0.1,-10) [-10|10] "deg"  ADCC_FM_4X
 SG_ FRM_26_DetnRelVelRadial_018 : 69|15@0+ (0.01,-100) [-100|80] "m/s"  ADCC_FM_4X
 SG_ FRM_26_DetnSNR_018 : 86|7@0+ (1,0) [0|100] "dB"  ADCC_FM_4X
 SG_ FRM_26_DetnRCS_018 : 95|15@0+ (0.01,-50) [-50|128] "dBsm"  ADCC_FM_4X
 SG_ FRM_26_DetnQuality_018 : 96|4@0+ (10,0) [0|100] "%"  ADCC_FM_4X
 SG_ FRM_26_DetnMotionSts_019 : 31|2@0+ (1,0) [0|3] ""  ADCC_FM_4X
 SG_ FRM_26_DetnRngRadial_019 : 108|15@0+ (0.01,0) [0|200] "m"  ADCC_FM_4X
 SG_ FRM_26_DetnAziAngle_019 : 125|11@0+ (0.1,-90) [-90|90] "deg"  ADCC_FM_4X
 SG_ FRM_26_DetnElevnAngle_019 : 130|8@0+ (0.1,-10) [-10|10] "deg"  ADCC_FM_4X
 SG_ FRM_26_DetnRelVelRadial_019 : 138|15@0+ (0.01,-100) [-100|80] "m/s"  ADCC_FM_4X
 SG_ FRM_26_DetnSNR_019 : 155|7@0+ (1,0) [0|100] "dB"  ADCC_FM_4X
 SG_ FRM_26_DetnRCS_019 : 164|15@0+ (0.01,-50) [-50|128] "dBsm"  ADCC_FM_4X
 SG_ FRM_26_DetnQuality_019 : 181|4@0+ (10,0) [0|100] "%"  ADCC_FM_4X
 SG_ FRM_26_DetnMotionSts_020 : 177|2@0+ (1,0) [0|3] ""  ADCC_FM_4X
 SG_ FRM_26_DetnRngRadial_020 : 191|15@0+ (0.01,0) [0|200] "m"  ADCC_FM_4X
 SG_ FRM_26_DetnAziAngle_020 : 192|11@0+ (0.1,-90) [-90|90] "deg"  ADCC_FM_4X
 SG_ FRM_26_DetnElevnAngle_020 : 213|8@0+ (0.1,-10) [-10|10] "deg"  ADCC_FM_4X
 SG_ FRM_26_DetnRelVelRadial_020 : 221|15@0+ (0.01,-100) [-100|80] "m/s"  ADCC_FM_4X
 SG_ FRM_26_DetnSNR_020 : 238|7@0+ (1,0) [0|100] "dB"  ADCC_FM_4X
 SG_ FRM_26_DetnRCS_020 : 247|15@0+ (0.01,-50) [-50|128] "dBsm"  ADCC_FM_4X
 SG_ FRM_26_DetnQuality_020 : 248|4@0+ (10,0) [0|100] "%"  ADCC_FM_4X
 SG_ FRM_26_DetnMotionSts_021 : 260|2@0+ (1,0) [0|3] ""  ADCC_FM_4X
 SG_ FRM_26_DetnRngRadial_021 : 258|15@0+ (0.01,0) [0|200] "m"  ADCC_FM_4X
 SG_ FRM_26_DetnAziAngle_021 : 275|11@0+ (0.1,-90) [-90|90] "deg"  ADCC_FM_4X
 SG_ FRM_26_DetnElevnAngle_021 : 280|8@0+ (0.1,-10) [-10|10] "deg"  ADCC_FM_4X
 SG_ FRM_26_DetnRelVelRadial_021 : 288|15@0+ (0.01,-100) [-100|80] "m/s"  ADCC_FM_4X
 SG_ FRM_26_DetnSNR_021 : 305|7@0+ (1,0) [0|100] "dB"  ADCC_FM_4X
 SG_ FRM_26_DetnRCS_021 : 314|15@0+ (0.01,-50) [-50|128] "dBsm"  ADCC_FM_4X
 SG_ FRM_26_DetnQuality_021 : 331|4@0+ (10,0) [0|100] "%"  ADCC_FM_4X
 SG_ FRM_26_DetnMotionSts_022 : 343|2@0+ (1,0) [0|3] ""  ADCC_FM_4X
 SG_ FRM_26_DetnRngRadial_022 : 341|15@0+ (0.01,0) [0|200] "m"  ADCC_FM_4X
 SG_ FRM_26_DetnAziAngle_022 : 358|11@0+ (0.1,-90) [-90|90] "deg"  ADCC_FM_4X
 SG_ FRM_26_DetnElevnAngle_022 : 363|8@0+ (0.1,-10) [-10|10] "deg"  ADCC_FM_4X
 SG_ FRM_26_DetnRelVelRadial_022 : 371|15@0+ (0.01,-100) [-100|80] "m/s"  ADCC_FM_4X
 SG_ FRM_26_DetnSNR_022 : 388|7@0+ (1,0) [0|100] "dB"  ADCC_FM_4X
 SG_ FRM_26_DetnRCS_022 : 397|15@0+ (0.01,-50) [-50|128] "dBsm"  ADCC_FM_4X
 SG_ FRM_26_DetnQuality_022 : 414|4@0+ (10,0) [0|100] "%"  ADCC_FM_4X
 SG_ FRM_26_DetnMotionSts_023 : 410|2@0+ (1,0) [0|3] ""  ADCC_FM_4X
 SG_ FRM_26_DetnRngRadial_023 : 408|15@0+ (0.01,0) [0|200] "m"  ADCC_FM_4X
 SG_ FRM_26_DetnAziAngle_023 : 425|11@0+ (0.1,-90) [-90|90] "deg"  ADCC_FM_4X
 SG_ FRM_26_DetnElevnAngle_023 : 446|8@0+ (0.1,-10) [-10|10] "deg"  ADCC_FM_4X
 SG_ FRM_26_DetnRelVelRadial_023 : 454|15@0+ (0.01,-100) [-100|80] "m/s"  ADCC_FM_4X
 SG_ FRM_26_DetnSNR_023 : 471|7@0+ (1,0) [0|100] "dB"  ADCC_FM_4X
 SG_ FRM_26_DetnRCS_023 : 464|15@0+ (0.01,-50) [-50|128] "dBsm"  ADCC_FM_4X
 SG_ FRM_26_DetnQuality_023 : 481|4@0+ (10,0) [0|100] "%"  ADCC_FM_4X
 SG_ FRM_26_Loc018_Valid : 488|1@0+ (1,0) [0|1] ""  ADCC_FM_4X
 SG_ FRM_26_Loc019_Valid : 489|1@0+ (1,0) [0|1] ""  ADCC_FM_4X
 SG_ FRM_26_Loc020_Valid : 490|1@0+ (1,0) [0|1] ""  ADCC_FM_4X
 SG_ FRM_26_Loc021_Valid : 491|1@0+ (1,0) [0|1] ""  ADCC_FM_4X
 SG_ FRM_26_Loc022_Valid : 492|1@0+ (1,0) [0|1] ""  ADCC_FM_4X
 SG_ FRM_26_Loc023_Valid : 493|1@0+ (1,0) [0|1] ""  ADCC_FM_4X

BO_ 998 FRM_27: 64 Vector__XXX
 SG_ FRM_27_CRC : 7|16@0+ (1,0) [0|65535] ""  ADCC_FM_4X
 SG_ FRM_27_RollgCntr : 23|8@0+ (1,0) [0|255] ""  ADCC_FM_4X
 SG_ FRM_27_DetnBlockCounter : 27|4@0+ (1,0) [0|15] ""  ADCC_FM_4X
 SG_ FRM_27_DetnMotionSts_024 : 29|2@0+ (1,0) [0|3] ""  ADCC_FM_4X
 SG_ FRM_27_DetnRngRadial_024 : 39|15@0+ (0.01,0) [0|200] "m"  ADCC_FM_4X
 SG_ FRM_27_DetnAziAngle_024 : 40|11@0+ (0.1,-90) [-90|90] "deg"  ADCC_FM_4X
 SG_ FRM_27_DetnElevnAngle_024 : 61|8@0+ (0.1,-10) [-10|10] "deg"  ADCC_FM_4X
 SG_ FRM_27_DetnRelVelRadial_024 : 69|15@0+ (0.01,-100) [-100|80] "m/s"  ADCC_FM_4X
 SG_ FRM_27_DetnSNR_024 : 86|7@0+ (1,0) [0|100] "dB"  ADCC_FM_4X
 SG_ FRM_27_DetnRCS_024 : 95|15@0+ (0.01,-50) [-50|128] "dBsm"  ADCC_FM_4X
 SG_ FRM_27_DetnQuality_024 : 96|4@0+ (10,0) [0|100] "%"  ADCC_FM_4X
 SG_ FRM_27_DetnMotionSts_025 : 31|2@0+ (1,0) [0|3] ""  ADCC_FM_4X
 SG_ FRM_27_DetnRngRadial_025 : 108|15@0+ (0.01,0) [0|200] "m"  ADCC_FM_4X
 SG_ FRM_27_DetnAziAngle_025 : 125|11@0+ (0.1,-90) [-90|90] "deg"  ADCC_FM_4X
 SG_ FRM_27_DetnElevnAngle_025 : 130|8@0+ (0.1,-10) [-10|10] "deg"  ADCC_FM_4X
 SG_ FRM_27_DetnRelVelRadial_025 : 138|15@0+ (0.01,-100) [-100|80] "m/s"  ADCC_FM_4X
 SG_ FRM_27_DetnSNR_025 : 155|7@0+ (1,0) [0|100] "dB"  ADCC_FM_4X
 SG_ FRM_27_DetnRCS_025 : 164|15@0+ (0.01,-50) [-50|128] "dBsm"  ADCC_FM_4X
 SG_ FRM_27_DetnQuality_025 : 181|4@0+ (10,0) [0|100] "%"  ADCC_FM_4X
 SG_ FRM_27_DetnMotionSts_026 : 177|2@0+ (1,0) [0|3] ""  ADCC_FM_4X
 SG_ FRM_27_DetnRngRadial_026 : 191|15@0+ (0.01,0) [0|200] "m"  ADCC_FM_4X
 SG_ FRM_27_DetnAziAngle_026 : 192|11@0+ (0.1,-90) [-90|90] "deg"  ADCC_FM_4X
 SG_ FRM_27_DetnElevnAngle_026 : 213|8@0+ (0.1,-10) [-10|10] "deg"  ADCC_FM_4X
 SG_ FRM_27_DetnRelVelRadial_026 : 221|15@0+ (0.01,-100) [-100|80] "m/s"  ADCC_FM_4X
 SG_ FRM_27_DetnSNR_026 : 238|7@0+ (1,0) [0|100] "dB"  ADCC_FM_4X
 SG_ FRM_27_DetnRCS_026 : 247|15@0+ (0.01,-50) [-50|128] "dBsm"  ADCC_FM_4X
 SG_ FRM_27_DetnQuality_026 : 248|4@0+ (10,0) [0|100] "%"  ADCC_FM_4X
 SG_ FRM_27_DetnMotionSts_027 : 260|2@0+ (1,0) [0|3] ""  ADCC_FM_4X
 SG_ FRM_27_DetnRngRadial_027 : 258|15@0+ (0.01,0) [0|200] "m"  ADCC_FM_4X
 SG_ FRM_27_DetnAziAngle_027 : 275|11@0+ (0.1,-90) [-90|90] "deg"  ADCC_FM_4X
 SG_ FRM_27_DetnElevnAngle_027 : 280|8@0+ (0.1,-10) [-10|10] "deg"  ADCC_FM_4X
 SG_ FRM_27_DetnRelVelRadial_027 : 288|15@0+ (0.01,-100) [-100|80] "m/s"  ADCC_FM_4X
 SG_ FRM_27_DetnSNR_027 : 305|7@0+ (1,0) [0|100] "dB"  ADCC_FM_4X
 SG_ FRM_27_DetnRCS_027 : 314|15@0+ (0.01,-50) [-50|128] "dBsm"  ADCC_FM_4X
 SG_ FRM_27_DetnQuality_027 : 331|4@0+ (10,0) [0|100] "%"  ADCC_FM_4X
 SG_ FRM_27_DetnMotionSts_028 : 343|2@0+ (1,0) [0|3] ""  ADCC_FM_4X
 SG_ FRM_27_DetnRngRadial_028 : 341|15@0+ (0.01,0) [0|200] "m"  ADCC_FM_4X
 SG_ FRM_27_DetnAziAngle_028 : 358|11@0+ (0.1,-90) [-90|90] "deg"  ADCC_FM_4X
 SG_ FRM_27_DetnElevnAngle_028 : 363|8@0+ (0.1,-10) [-10|10] "deg"  ADCC_FM_4X
 SG_ FRM_27_DetnRelVelRadial_028 : 371|15@0+ (0.01,-100) [-100|80] "m/s"  ADCC_FM_4X
 SG_ FRM_27_DetnSNR_028 : 388|7@0+ (1,0) [0|100] "dB"  ADCC_FM_4X
 SG_ FRM_27_DetnRCS_028 : 397|15@0+ (0.01,-50) [-50|128] "dBsm"  ADCC_FM_4X
 SG_ FRM_27_DetnQuality_028 : 414|4@0+ (10,0) [0|100] "%"  ADCC_FM_4X
 SG_ FRM_27_DetnMotionSts_029 : 410|2@0+ (1,0) [0|3] ""  ADCC_FM_4X
 SG_ FRM_27_DetnRngRadial_029 : 408|15@0+ (0.01,0) [0|200] "m"  ADCC_FM_4X
 SG_ FRM_27_DetnAziAngle_029 : 425|11@0+ (0.1,-90) [-90|90] "deg"  ADCC_FM_4X
 SG_ FRM_27_DetnElevnAngle_029 : 446|8@0+ (0.1,-10) [-10|10] "deg"  ADCC_FM_4X
 SG_ FRM_27_DetnRelVelRadial_029 : 454|15@0+ (0.01,-100) [-100|80] "m/s"  ADCC_FM_4X
 SG_ FRM_27_DetnSNR_029 : 471|7@0+ (1,0) [0|100] "dB"  ADCC_FM_4X
 SG_ FRM_27_DetnRCS_029 : 464|15@0+ (0.01,-50) [-50|128] "dBsm"  ADCC_FM_4X
 SG_ FRM_27_DetnQuality_029 : 481|4@0+ (10,0) [0|100] "%"  ADCC_FM_4X
 SG_ FRM_27_Loc024_Valid : 488|1@0+ (1,0) [0|1] ""  ADCC_FM_4X
 SG_ FRM_27_Loc025_Valid : 489|1@0+ (1,0) [0|1] ""  ADCC_FM_4X
 SG_ FRM_27_Loc026_Valid : 490|1@0+ (1,0) [0|1] ""  ADCC_FM_4X
 SG_ FRM_27_Loc027_Valid : 491|1@0+ (1,0) [0|1] ""  ADCC_FM_4X
 SG_ FRM_27_Loc028_Valid : 492|1@0+ (1,0) [0|1] ""  ADCC_FM_4X
 SG_ FRM_27_Loc029_Valid : 493|1@0+ (1,0) [0|1] ""  ADCC_FM_4X

BO_ 999 FRM_28: 64 Vector__XXX
 SG_ FRM_28_CRC : 7|16@0+ (1,0) [0|65535] ""  ADCC_FM_4X
 SG_ FRM_28_RollgCntr : 23|8@0+ (1,0) [0|255] ""  ADCC_FM_4X
 SG_ FRM_28_DetnBlockCounter : 27|4@0+ (1,0) [0|15] ""  ADCC_FM_4X
 SG_ FRM_28_DetnMotionSts_030 : 29|2@0+ (1,0) [0|3] ""  ADCC_FM_4X
 SG_ FRM_28_DetnRngRadial_030 : 39|15@0+ (0.01,0) [0|200] "m"  ADCC_FM_4X
 SG_ FRM_28_DetnAziAngle_030 : 40|11@0+ (0.1,-90) [-90|90] "deg"  ADCC_FM_4X
 SG_ FRM_28_DetnElevnAngle_030 : 61|8@0+ (0.1,-10) [-10|10] "deg"  ADCC_FM_4X
 SG_ FRM_28_DetnRelVelRadial_030 : 69|15@0+ (0.01,-100) [-100|80] "m/s"  ADCC_FM_4X
 SG_ FRM_28_DetnSNR_030 : 86|7@0+ (1,0) [0|100] "dB"  ADCC_FM_4X
 SG_ FRM_28_DetnRCS_030 : 95|15@0+ (0.01,-50) [-50|128] "dBsm"  ADCC_FM_4X
 SG_ FRM_28_DetnQuality_030 : 96|4@0+ (10,0) [0|100] "%"  ADCC_FM_4X
 SG_ FRM_28_DetnMotionSts_031 : 31|2@0+ (1,0) [0|3] ""  ADCC_FM_4X
 SG_ FRM_28_DetnRngRadial_031 : 108|15@0+ (0.01,0) [0|200] "m"  ADCC_FM_4X
 SG_ FRM_28_DetnAziAngle_031 : 125|11@0+ (0.1,-90) [-90|90] "deg"  ADCC_FM_4X
 SG_ FRM_28_DetnElevnAngle_031 : 130|8@0+ (0.1,-10) [-10|10] "deg"  ADCC_FM_4X
 SG_ FRM_28_DetnRelVelRadial_031 : 138|15@0+ (0.01,-100) [-100|80] "m/s"  ADCC_FM_4X
 SG_ FRM_28_DetnSNR_031 : 155|7@0+ (1,0) [0|100] "dB"  ADCC_FM_4X
 SG_ FRM_28_DetnRCS_031 : 164|15@0+ (0.01,-50) [-50|128] "dBsm"  ADCC_FM_4X
 SG_ FRM_28_DetnQuality_031 : 181|4@0+ (10,0) [0|100] "%"  ADCC_FM_4X
 SG_ FRM_28_DetnMotionSts_032 : 177|2@0+ (1,0) [0|3] ""  ADCC_FM_4X
 SG_ FRM_28_DetnRngRadial_032 : 191|15@0+ (0.01,0) [0|200] "m"  ADCC_FM_4X
 SG_ FRM_28_DetnAziAngle_032 : 192|11@0+ (0.1,-90) [-90|90] "deg"  ADCC_FM_4X
 SG_ FRM_28_DetnElevnAngle_032 : 213|8@0+ (0.1,-10) [-10|10] "deg"  ADCC_FM_4X
 SG_ FRM_28_DetnRelVelRadial_032 : 221|15@0+ (0.01,-100) [-100|80] "m/s"  ADCC_FM_4X
 SG_ FRM_28_DetnSNR_032 : 238|7@0+ (1,0) [0|100] "dB"  ADCC_FM_4X
 SG_ FRM_28_DetnRCS_032 : 247|15@0+ (0.01,-50) [-50|128] "dBsm"  ADCC_FM_4X
 SG_ FRM_28_DetnQuality_032 : 248|4@0+ (10,0) [0|100] "%"  ADCC_FM_4X
 SG_ FRM_28_DetnMotionSts_033 : 260|2@0+ (1,0) [0|3] ""  ADCC_FM_4X
 SG_ FRM_28_DetnRngRadial_033 : 258|15@0+ (0.01,0) [0|200] "m"  ADCC_FM_4X
 SG_ FRM_28_DetnAziAngle_033 : 275|11@0+ (0.1,-90) [-90|90] "deg"  ADCC_FM_4X
 SG_ FRM_28_DetnElevnAngle_033 : 280|8@0+ (0.1,-10) [-10|10] "deg"  ADCC_FM_4X
 SG_ FRM_28_DetnRelVelRadial_033 : 288|15@0+ (0.01,-100) [-100|80] "m/s"  ADCC_FM_4X
 SG_ FRM_28_DetnSNR_033 : 305|7@0+ (1,0) [0|100] "dB"  ADCC_FM_4X
 SG_ FRM_28_DetnRCS_033 : 314|15@0+ (0.01,-50) [-50|128] "dBsm"  ADCC_FM_4X
 SG_ FRM_28_DetnQuality_033 : 331|4@0+ (10,0) [0|100] "%"  ADCC_FM_4X
 SG_ FRM_28_DetnMotionSts_034 : 343|2@0+ (1,0) [0|3] ""  ADCC_FM_4X
 SG_ FRM_28_DetnRngRadial_034 : 341|15@0+ (0.01,0) [0|200] "m"  ADCC_FM_4X
 SG_ FRM_28_DetnAziAngle_034 : 358|11@0+ (0.1,-90) [-90|90] "deg"  ADCC_FM_4X
 SG_ FRM_28_DetnElevnAngle_034 : 363|8@0+ (0.1,-10) [-10|10] "deg"  ADCC_FM_4X
 SG_ FRM_28_DetnRelVelRadial_034 : 371|15@0+ (0.01,-100) [-100|80] "m/s"  ADCC_FM_4X
 SG_ FRM_28_DetnSNR_034 : 388|7@0+ (1,0) [0|100] "dB"  ADCC_FM_4X
 SG_ FRM_28_DetnRCS_034 : 397|15@0+ (0.01,-50) [-50|128] "dBsm"  ADCC_FM_4X
 SG_ FRM_28_DetnQuality_034 : 414|4@0+ (10,0) [0|100] "%"  ADCC_FM_4X
 SG_ FRM_28_DetnMotionSts_035 : 410|2@0+ (1,0) [0|3] ""  ADCC_FM_4X
 SG_ FRM_28_DetnRngRadial_035 : 408|15@0+ (0.01,0) [0|200] "m"  ADCC_FM_4X
 SG_ FRM_28_DetnAziAngle_035 : 425|11@0+ (0.1,-90) [-90|90] "deg"  ADCC_FM_4X
 SG_ FRM_28_DetnElevnAngle_035 : 446|8@0+ (0.1,-10) [-10|10] "deg"  ADCC_FM_4X
 SG_ FRM_28_DetnRelVelRadial_035 : 454|15@0+ (0.01,-100) [-100|80] "m/s"  ADCC_FM_4X
 SG_ FRM_28_DetnSNR_035 : 471|7@0+ (1,0) [0|100] "dB"  ADCC_FM_4X
 SG_ FRM_28_DetnRCS_035 : 464|15@0+ (0.01,-50) [-50|128] "dBsm"  ADCC_FM_4X
 SG_ FRM_28_DetnQuality_035 : 481|4@0+ (10,0) [0|100] "%"  ADCC_FM_4X
 SG_ FRM_28_Loc030_Valid : 488|1@0+ (1,0) [0|1] ""  ADCC_FM_4X
 SG_ FRM_28_Loc031_Valid : 489|1@0+ (1,0) [0|1] ""  ADCC_FM_4X
 SG_ FRM_28_Loc032_Valid : 490|1@0+ (1,0) [0|1] ""  ADCC_FM_4X
 SG_ FRM_28_Loc033_Valid : 491|1@0+ (1,0) [0|1] ""  ADCC_FM_4X
 SG_ FRM_28_Loc034_Valid : 492|1@0+ (1,0) [0|1] ""  ADCC_FM_4X
 SG_ FRM_28_Loc035_Valid : 493|1@0+ (1,0) [0|1] ""  ADCC_FM_4X

BO_ 1000 FRM_29: 64 Vector__XXX
 SG_ FRM_29_CRC : 7|16@0+ (1,0) [0|65535] ""  ADCC_FM_4X
 SG_ FRM_29_RollgCntr : 23|8@0+ (1,0) [0|255] ""  ADCC_FM_4X
 SG_ FRM_29_DetnBlockCounter : 27|4@0+ (1,0) [0|15] ""  ADCC_FM_4X
 SG_ FRM_29_DetnMotionSts_036 : 29|2@0+ (1,0) [0|3] ""  ADCC_FM_4X
 SG_ FRM_29_DetnRngRadial_036 : 39|15@0+ (0.01,0) [0|200] "m"  ADCC_FM_4X
 SG_ FRM_29_DetnAziAngle_036 : 40|11@0+ (0.1,-90) [-90|90] "deg"  ADCC_FM_4X
 SG_ FRM_29_DetnElevnAngle_036 : 61|8@0+ (0.1,-10) [-10|10] "deg"  ADCC_FM_4X
 SG_ FRM_29_DetnRelVelRadial_036 : 69|15@0+ (0.01,-100) [-100|80] "m/s"  ADCC_FM_4X
 SG_ FRM_29_DetnSNR_036 : 86|7@0+ (1,0) [0|100] "dB"  ADCC_FM_4X
 SG_ FRM_29_DetnRCS_036 : 95|15@0+ (0.01,-50) [-50|128] "dBsm"  ADCC_FM_4X
 SG_ FRM_29_DetnQuality_036 : 96|4@0+ (10,0) [0|100] "%"  ADCC_FM_4X
 SG_ FRM_29_DetnMotionSts_037 : 31|2@0+ (1,0) [0|3] ""  ADCC_FM_4X
 SG_ FRM_29_DetnRngRadial_037 : 108|15@0+ (0.01,0) [0|200] "m"  ADCC_FM_4X
 SG_ FRM_29_DetnAziAngle_037 : 125|11@0+ (0.1,-90) [-90|90] "deg"  ADCC_FM_4X
 SG_ FRM_29_DetnElevnAngle_037 : 130|8@0+ (0.1,-10) [-10|10] "deg"  ADCC_FM_4X
 SG_ FRM_29_DetnRelVelRadial_037 : 138|15@0+ (0.01,-100) [-100|80] "m/s"  ADCC_FM_4X
 SG_ FRM_29_DetnSNR_037 : 155|7@0+ (1,0) [0|100] "dB"  ADCC_FM_4X
 SG_ FRM_29_DetnRCS_037 : 164|15@0+ (0.01,-50) [-50|128] "dBsm"  ADCC_FM_4X
 SG_ FRM_29_DetnQuality_037 : 181|4@0+ (10,0) [0|100] "%"  ADCC_FM_4X
 SG_ FRM_29_DetnMotionSts_038 : 177|2@0+ (1,0) [0|3] ""  ADCC_FM_4X
 SG_ FRM_29_DetnRngRadial_038 : 191|15@0+ (0.01,0) [0|200] "m"  ADCC_FM_4X
 SG_ FRM_29_DetnAziAngle_038 : 192|11@0+ (0.1,-90) [-90|90] "deg"  ADCC_FM_4X
 SG_ FRM_29_DetnElevnAngle_038 : 213|8@0+ (0.1,-10) [-10|10] "deg"  ADCC_FM_4X
 SG_ FRM_29_DetnRelVelRadial_038 : 221|15@0+ (0.01,-100) [-100|80] "m/s"  ADCC_FM_4X
 SG_ FRM_29_DetnSNR_038 : 238|7@0+ (1,0) [0|100] "dB"  ADCC_FM_4X
 SG_ FRM_29_DetnRCS_038 : 247|15@0+ (0.01,-50) [-50|128] "dBsm"  ADCC_FM_4X
 SG_ FRM_29_DetnQuality_038 : 248|4@0+ (10,0) [0|100] "%"  ADCC_FM_4X
 SG_ FRM_29_DetnMotionSts_039 : 260|2@0+ (1,0) [0|3] ""  ADCC_FM_4X
 SG_ FRM_29_DetnRngRadial_039 : 258|15@0+ (0.01,0) [0|200] "m"  ADCC_FM_4X
 SG_ FRM_29_DetnAziAngle_039 : 275|11@0+ (0.1,-90) [-90|90] "deg"  ADCC_FM_4X
 SG_ FRM_29_DetnElevnAngle_039 : 280|8@0+ (0.1,-10) [-10|10] "deg"  ADCC_FM_4X
 SG_ FRM_29_DetnRelVelRadial_039 : 288|15@0+ (0.01,-100) [-100|80] "m/s"  ADCC_FM_4X
 SG_ FRM_29_DetnSNR_039 : 305|7@0+ (1,0) [0|100] "dB"  ADCC_FM_4X
 SG_ FRM_29_DetnRCS_039 : 314|15@0+ (0.01,-50) [-50|128] "dBsm"  ADCC_FM_4X
 SG_ FRM_29_DetnQuality_039 : 331|4@0+ (10,0) [0|100] "%"  ADCC_FM_4X
 SG_ FRM_29_DetnMotionSts_040 : 343|2@0+ (1,0) [0|3] ""  ADCC_FM_4X
 SG_ FRM_29_DetnRngRadial_040 : 341|15@0+ (0.01,0) [0|200] "m"  ADCC_FM_4X
 SG_ FRM_29_DetnAziAngle_040 : 358|11@0+ (0.1,-90) [-90|90] "deg"  ADCC_FM_4X
 SG_ FRM_29_DetnElevnAngle_040 : 363|8@0+ (0.1,-10) [-10|10] "deg"  ADCC_FM_4X
 SG_ FRM_29_DetnRelVelRadial_040 : 371|15@0+ (0.01,-100) [-100|80] "m/s"  ADCC_FM_4X
 SG_ FRM_29_DetnSNR_040 : 388|7@0+ (1,0) [0|100] "dB"  ADCC_FM_4X
 SG_ FRM_29_DetnRCS_040 : 397|15@0+ (0.01,-50) [-50|128] "dBsm"  ADCC_FM_4X
 SG_ FRM_29_DetnQuality_040 : 414|4@0+ (10,0) [0|100] "%"  ADCC_FM_4X
 SG_ FRM_29_DetnMotionSts_041 : 410|2@0+ (1,0) [0|3] ""  ADCC_FM_4X
 SG_ FRM_29_DetnRngRadial_041 : 408|15@0+ (0.01,0) [0|200] "m"  ADCC_FM_4X
 SG_ FRM_29_DetnAziAngle_041 : 425|11@0+ (0.1,-90) [-90|90] "deg"  ADCC_FM_4X
 SG_ FRM_29_DetnElevnAngle_041 : 446|8@0+ (0.1,-10) [-10|10] "deg"  ADCC_FM_4X
 SG_ FRM_29_DetnRelVelRadial_041 : 454|15@0+ (0.01,-100) [-100|80] "m/s"  ADCC_FM_4X
 SG_ FRM_29_DetnSNR_041 : 471|7@0+ (1,0) [0|100] "dB"  ADCC_FM_4X
 SG_ FRM_29_DetnRCS_041 : 464|15@0+ (0.01,-50) [-50|128] "dBsm"  ADCC_FM_4X
 SG_ FRM_29_DetnQuality_041 : 481|4@0+ (10,0) [0|100] "%"  ADCC_FM_4X
 SG_ FRM_29_Loc036_Valid : 488|1@0+ (1,0) [0|1] ""  ADCC_FM_4X
 SG_ FRM_29_Loc037_Valid : 489|1@0+ (1,0) [0|1] ""  ADCC_FM_4X
 SG_ FRM_29_Loc038_Valid : 490|1@0+ (1,0) [0|1] ""  ADCC_FM_4X
 SG_ FRM_29_Loc039_Valid : 491|1@0+ (1,0) [0|1] ""  ADCC_FM_4X
 SG_ FRM_29_Loc040_Valid : 492|1@0+ (1,0) [0|1] ""  ADCC_FM_4X
 SG_ FRM_29_Loc041_Valid : 493|1@0+ (1,0) [0|1] ""  ADCC_FM_4X

BO_ 1001 FRM_30: 64 Vector__XXX
 SG_ FRM_30_CRC : 7|16@0+ (1,0) [0|65535] ""  ADCC_FM_4X
 SG_ FRM_30_RollgCntr : 23|8@0+ (1,0) [0|255] ""  ADCC_FM_4X
 SG_ FRM_30_DetnBlockCounter : 27|4@0+ (1,0) [0|15] ""  ADCC_FM_4X
 SG_ FRM_30_DetnMotionSts_042 : 29|2@0+ (1,0) [0|3] ""  ADCC_FM_4X
 SG_ FRM_30_DetnRngRadial_042 : 39|15@0+ (0.01,0) [0|200] "m"  ADCC_FM_4X
 SG_ FRM_30_DetnAziAngle_042 : 40|11@0+ (0.1,-90) [-90|90] "deg"  ADCC_FM_4X
 SG_ FRM_30_DetnElevnAngle_042 : 61|8@0+ (0.1,-10) [-10|10] "deg"  ADCC_FM_4X
 SG_ FRM_30_DetnRelVelRadial_042 : 69|15@0+ (0.01,-100) [-100|80] "m/s"  ADCC_FM_4X
 SG_ FRM_30_DetnSNR_042 : 86|7@0+ (1,0) [0|100] "dB"  ADCC_FM_4X
 SG_ FRM_30_DetnRCS_042 : 95|15@0+ (0.01,-50) [-50|128] "dBsm"  ADCC_FM_4X
 SG_ FRM_30_DetnQuality_042 : 96|4@0+ (10,0) [0|100] "%"  ADCC_FM_4X
 SG_ FRM_30_DetnMotionSts_043 : 31|2@0+ (1,0) [0|3] ""  ADCC_FM_4X
 SG_ FRM_30_DetnRngRadial_043 : 108|15@0+ (0.01,0) [0|200] "m"  ADCC_FM_4X
 SG_ FRM_30_DetnAziAngle_043 : 125|11@0+ (0.1,-90) [-90|90] "deg"  ADCC_FM_4X
 SG_ FRM_30_DetnElevnAngle_043 : 130|8@0+ (0.1,-10) [-10|10] "deg"  ADCC_FM_4X
 SG_ FRM_30_DetnRelVelRadial_043 : 138|15@0+ (0.01,-100) [-100|80] "m/s"  ADCC_FM_4X
 SG_ FRM_30_DetnSNR_043 : 155|7@0+ (1,0) [0|100] "dB"  ADCC_FM_4X
 SG_ FRM_30_DetnRCS_043 : 164|15@0+ (0.01,-50) [-50|128] "dBsm"  ADCC_FM_4X
 SG_ FRM_30_DetnQuality_043 : 181|4@0+ (10,0) [0|100] "%"  ADCC_FM_4X
 SG_ FRM_30_DetnMotionSts_044 : 177|2@0+ (1,0) [0|3] ""  ADCC_FM_4X
 SG_ FRM_30_DetnRngRadial_044 : 191|15@0+ (0.01,0) [0|200] "m"  ADCC_FM_4X
 SG_ FRM_30_DetnAziAngle_044 : 192|11@0+ (0.1,-90) [-90|90] "deg"  ADCC_FM_4X
 SG_ FRM_30_DetnElevnAngle_044 : 213|8@0+ (0.1,-10) [-10|10] "deg"  ADCC_FM_4X
 SG_ FRM_30_DetnRelVelRadial_044 : 221|15@0+ (0.01,-100) [-100|80] "m/s"  ADCC_FM_4X
 SG_ FRM_30_DetnSNR_044 : 238|7@0+ (1,0) [0|100] "dB"  ADCC_FM_4X
 SG_ FRM_30_DetnRCS_044 : 247|15@0+ (0.01,-50) [-50|128] "dBsm"  ADCC_FM_4X
 SG_ FRM_30_DetnQuality_044 : 248|4@0+ (10,0) [0|100] "%"  ADCC_FM_4X
 SG_ FRM_30_DetnMotionSts_045 : 260|2@0+ (1,0) [0|3] ""  ADCC_FM_4X
 SG_ FRM_30_DetnRngRadial_045 : 258|15@0+ (0.01,0) [0|200] "m"  ADCC_FM_4X
 SG_ FRM_30_DetnAziAngle_045 : 275|11@0+ (0.1,-90) [-90|90] "deg"  ADCC_FM_4X
 SG_ FRM_30_DetnElevnAngle_045 : 280|8@0+ (0.1,-10) [-10|10] "deg"  ADCC_FM_4X
 SG_ FRM_30_DetnRelVelRadial_045 : 288|15@0+ (0.01,-100) [-100|80] "m/s"  ADCC_FM_4X
 SG_ FRM_30_DetnSNR_045 : 305|7@0+ (1,0) [0|100] "dB"  ADCC_FM_4X
 SG_ FRM_30_DetnRCS_045 : 314|15@0+ (0.01,-50) [-50|128] "dBsm"  ADCC_FM_4X
 SG_ FRM_30_DetnQuality_045 : 331|4@0+ (10,0) [0|100] "%"  ADCC_FM_4X
 SG_ FRM_30_DetnMotionSts_046 : 343|2@0+ (1,0) [0|3] ""  ADCC_FM_4X
 SG_ FRM_30_DetnRngRadial_046 : 341|15@0+ (0.01,0) [0|200] "m"  ADCC_FM_4X
 SG_ FRM_30_DetnAziAngle_046 : 358|11@0+ (0.1,-90) [-90|90] "deg"  ADCC_FM_4X
 SG_ FRM_30_DetnElevnAngle_046 : 363|8@0+ (0.1,-10) [-10|10] "deg"  ADCC_FM_4X
 SG_ FRM_30_DetnRelVelRadial_046 : 371|15@0+ (0.01,-100) [-100|80] "m/s"  ADCC_FM_4X
 SG_ FRM_30_DetnSNR_046 : 388|7@0+ (1,0) [0|100] "dB"  ADCC_FM_4X
 SG_ FRM_30_DetnRCS_046 : 397|15@0+ (0.01,-50) [-50|128] "dBsm"  ADCC_FM_4X
 SG_ FRM_30_DetnQuality_046 : 414|4@0+ (10,0) [0|100] "%"  ADCC_FM_4X
 SG_ FRM_30_DetnMotionSts_047 : 410|2@0+ (1,0) [0|3] ""  ADCC_FM_4X
 SG_ FRM_30_DetnRngRadial_047 : 408|15@0+ (0.01,0) [0|200] "m"  ADCC_FM_4X
 SG_ FRM_30_DetnAziAngle_047 : 425|11@0+ (0.1,-90) [-90|90] "deg"  ADCC_FM_4X
 SG_ FRM_30_DetnElevnAngle_047 : 446|8@0+ (0.1,-10) [-10|10] "deg"  ADCC_FM_4X
 SG_ FRM_30_DetnRelVelRadial_047 : 454|15@0+ (0.01,-100) [-100|80] "m/s"  ADCC_FM_4X
 SG_ FRM_30_DetnSNR_047 : 471|7@0+ (1,0) [0|100] "dB"  ADCC_FM_4X
 SG_ FRM_30_DetnRCS_047 : 464|15@0+ (0.01,-50) [-50|128] "dBsm"  ADCC_FM_4X
 SG_ FRM_30_DetnQuality_047 : 481|4@0+ (10,0) [0|100] "%"  ADCC_FM_4X
 SG_ FRM_30_Loc042_Valid : 488|1@0+ (1,0) [0|1] ""  ADCC_FM_4X
 SG_ FRM_30_Loc043_Valid : 489|1@0+ (1,0) [0|1] ""  ADCC_FM_4X
 SG_ FRM_30_Loc044_Valid : 490|1@0+ (1,0) [0|1] ""  ADCC_FM_4X
 SG_ FRM_30_Loc045_Valid : 491|1@0+ (1,0) [0|1] ""  ADCC_FM_4X
 SG_ FRM_30_Loc046_Valid : 492|1@0+ (1,0) [0|1] ""  ADCC_FM_4X
 SG_ FRM_30_Loc047_Valid : 493|1@0+ (1,0) [0|1] ""  ADCC_FM_4X

BO_ 1002 FRM_31: 64 Vector__XXX
 SG_ FRM_31_CRC : 7|16@0+ (1,0) [0|65535] ""  ADCC_FM_4X
 SG_ FRM_31_RollgCntr : 23|8@0+ (1,0) [0|255] ""  ADCC_FM_4X
 SG_ FRM_31_DetnBlockCounter : 27|4@0+ (1,0) [0|15] ""  ADCC_FM_4X
 SG_ FRM_31_DetnMotionSts_048 : 29|2@0+ (1,0) [0|3] ""  ADCC_FM_4X
 SG_ FRM_31_DetnRngRadial_048 : 39|15@0+ (0.01,0) [0|200] "m"  ADCC_FM_4X
 SG_ FRM_31_DetnAziAngle_048 : 40|11@0+ (0.1,-90) [-90|90] "deg"  ADCC_FM_4X
 SG_ FRM_31_DetnElevnAngle_048 : 61|8@0+ (0.1,-10) [-10|10] "deg"  ADCC_FM_4X
 SG_ FRM_31_DetnRelVelRadial_048 : 69|15@0+ (0.01,-100) [-100|80] "m/s"  ADCC_FM_4X
 SG_ FRM_31_DetnSNR_048 : 86|7@0+ (1,0) [0|100] "dB"  ADCC_FM_4X
 SG_ FRM_31_DetnRCS_048 : 95|15@0+ (0.01,-50) [-50|128] "dBsm"  ADCC_FM_4X
 SG_ FRM_31_DetnQuality_048 : 96|4@0+ (10,0) [0|100] "%"  ADCC_FM_4X
 SG_ FRM_31_DetnMotionSts_049 : 31|2@0+ (1,0) [0|3] ""  ADCC_FM_4X
 SG_ FRM_31_DetnRngRadial_049 : 108|15@0+ (0.01,0) [0|200] "m"  ADCC_FM_4X
 SG_ FRM_31_DetnAziAngle_049 : 125|11@0+ (0.1,-90) [-90|90] "deg"  ADCC_FM_4X
 SG_ FRM_31_DetnElevnAngle_049 : 130|8@0+ (0.1,-10) [-10|10] "deg"  ADCC_FM_4X
 SG_ FRM_31_DetnRelVelRadial_049 : 138|15@0+ (0.01,-100) [-100|80] "m/s"  ADCC_FM_4X
 SG_ FRM_31_DetnSNR_049 : 155|7@0+ (1,0) [0|100] "dB"  ADCC_FM_4X
 SG_ FRM_31_DetnRCS_049 : 164|15@0+ (0.01,-50) [-50|128] "dBsm"  ADCC_FM_4X
 SG_ FRM_31_DetnQuality_049 : 181|4@0+ (10,0) [0|100] "%"  ADCC_FM_4X
 SG_ FRM_31_DetnMotionSts_050 : 177|2@0+ (1,0) [0|3] ""  ADCC_FM_4X
 SG_ FRM_31_DetnRngRadial_050 : 191|15@0+ (0.01,0) [0|200] "m"  ADCC_FM_4X
 SG_ FRM_31_DetnAziAngle_050 : 192|11@0+ (0.1,-90) [-90|90] "deg"  ADCC_FM_4X
 SG_ FRM_31_DetnElevnAngle_050 : 213|8@0+ (0.1,-10) [-10|10] "deg"  ADCC_FM_4X
 SG_ FRM_31_DetnRelVelRadial_050 : 221|15@0+ (0.01,-100) [-100|80] "m/s"  ADCC_FM_4X
 SG_ FRM_31_DetnSNR_050 : 238|7@0+ (1,0) [0|100] "dB"  ADCC_FM_4X
 SG_ FRM_31_DetnRCS_050 : 247|15@0+ (0.01,-50) [-50|128] "dBsm"  ADCC_FM_4X
 SG_ FRM_31_DetnQuality_050 : 248|4@0+ (10,0) [0|100] "%"  ADCC_FM_4X
 SG_ FRM_31_DetnMotionSts_051 : 260|2@0+ (1,0) [0|3] ""  ADCC_FM_4X
 SG_ FRM_31_DetnRngRadial_051 : 258|15@0+ (0.01,0) [0|200] "m"  ADCC_FM_4X
 SG_ FRM_31_DetnAziAngle_051 : 275|11@0+ (0.1,-90) [-90|90] "deg"  ADCC_FM_4X
 SG_ FRM_31_DetnElevnAngle_051 : 280|8@0+ (0.1,-10) [-10|10] "deg"  ADCC_FM_4X
 SG_ FRM_31_DetnRelVelRadial_051 : 288|15@0+ (0.01,-100) [-100|80] "m/s"  ADCC_FM_4X
 SG_ FRM_31_DetnSNR_051 : 305|7@0+ (1,0) [0|100] "dB"  ADCC_FM_4X
 SG_ FRM_31_DetnRCS_051 : 314|15@0+ (0.01,-50) [-50|128] "dBsm"  ADCC_FM_4X
 SG_ FRM_31_DetnQuality_051 : 331|4@0+ (10,0) [0|100] "%"  ADCC_FM_4X
 SG_ FRM_31_DetnMotionSts_052 : 343|2@0+ (1,0) [0|3] ""  ADCC_FM_4X
 SG_ FRM_31_DetnRngRadial_052 : 341|15@0+ (0.01,0) [0|200] "m"  ADCC_FM_4X
 SG_ FRM_31_DetnAziAngle_052 : 358|11@0+ (0.1,-90) [-90|90] "deg"  ADCC_FM_4X
 SG_ FRM_31_DetnElevnAngle_052 : 363|8@0+ (0.1,-10) [-10|10] "deg"  ADCC_FM_4X
 SG_ FRM_31_DetnRelVelRadial_052 : 371|15@0+ (0.01,-100) [-100|80] "m/s"  ADCC_FM_4X
 SG_ FRM_31_DetnSNR_052 : 388|7@0+ (1,0) [0|100] "dB"  ADCC_FM_4X
 SG_ FRM_31_DetnRCS_052 : 397|15@0+ (0.01,-50) [-50|128] "dBsm"  ADCC_FM_4X
 SG_ FRM_31_DetnQuality_052 : 414|4@0+ (10,0) [0|100] "%"  ADCC_FM_4X
 SG_ FRM_31_DetnMotionSts_053 : 410|2@0+ (1,0) [0|3] ""  ADCC_FM_4X
 SG_ FRM_31_DetnRngRadial_053 : 408|15@0+ (0.01,0) [0|200] "m"  ADCC_FM_4X
 SG_ FRM_31_DetnAziAngle_053 : 425|11@0+ (0.1,-90) [-90|90] "deg"  ADCC_FM_4X
 SG_ FRM_31_DetnElevnAngle_053 : 446|8@0+ (0.1,-10) [-10|10] "deg"  ADCC_FM_4X
 SG_ FRM_31_DetnRelVelRadial_053 : 454|15@0+ (0.01,-100) [-100|80] "m/s"  ADCC_FM_4X
 SG_ FRM_31_DetnSNR_053 : 471|7@0+ (1,0) [0|100] "dB"  ADCC_FM_4X
 SG_ FRM_31_DetnRCS_053 : 464|15@0+ (0.01,-50) [-50|128] "dBsm"  ADCC_FM_4X
 SG_ FRM_31_DetnQuality_053 : 481|4@0+ (10,0) [0|100] "%"  ADCC_FM_4X
 SG_ FRM_31_Loc048_Valid : 488|1@0+ (1,0) [0|1] ""  ADCC_FM_4X
 SG_ FRM_31_Loc049_Valid : 489|1@0+ (1,0) [0|1] ""  ADCC_FM_4X
 SG_ FRM_31_Loc050_Valid : 490|1@0+ (1,0) [0|1] ""  ADCC_FM_4X
 SG_ FRM_31_Loc051_Valid : 491|1@0+ (1,0) [0|1] ""  ADCC_FM_4X
 SG_ FRM_31_Loc052_Valid : 492|1@0+ (1,0) [0|1] ""  ADCC_FM_4X
 SG_ FRM_31_Loc053_Valid : 493|1@0+ (1,0) [0|1] ""  ADCC_FM_4X

BO_ 1003 FRM_32: 64 Vector__XXX
 SG_ FRM_32_CRC : 7|16@0+ (1,0) [0|65535] ""  ADCC_FM_4X
 SG_ FRM_32_RollgCntr : 23|8@0+ (1,0) [0|255] ""  ADCC_FM_4X
 SG_ FRM_32_DetnBlockCounter : 27|4@0+ (1,0) [0|15] ""  ADCC_FM_4X
 SG_ FRM_32_DetnMotionSts_054 : 29|2@0+ (1,0) [0|3] ""  ADCC_FM_4X
 SG_ FRM_32_DetnRngRadial_054 : 39|15@0+ (0.01,0) [0|200] "m"  ADCC_FM_4X
 SG_ FRM_32_DetnAziAngle_054 : 40|11@0+ (0.1,-90) [-90|90] "deg"  ADCC_FM_4X
 SG_ FRM_32_DetnElevnAngle_054 : 61|8@0+ (0.1,-10) [-10|10] "deg"  ADCC_FM_4X
 SG_ FRM_32_DetnRelVelRadial_054 : 69|15@0+ (0.01,-100) [-100|80] "m/s"  ADCC_FM_4X
 SG_ FRM_32_DetnSNR_054 : 86|7@0+ (1,0) [0|100] "dB"  ADCC_FM_4X
 SG_ FRM_32_DetnRCS_054 : 95|15@0+ (0.01,-50) [-50|128] "dBsm"  ADCC_FM_4X
 SG_ FRM_32_DetnQuality_054 : 96|4@0+ (10,0) [0|100] "%"  ADCC_FM_4X
 SG_ FRM_32_DetnMotionSts_055 : 31|2@0+ (1,0) [0|3] ""  ADCC_FM_4X
 SG_ FRM_32_DetnRngRadial_055 : 108|15@0+ (0.01,0) [0|200] "m"  ADCC_FM_4X
 SG_ FRM_32_DetnAziAngle_055 : 125|11@0+ (0.1,-90) [-90|90] "deg"  ADCC_FM_4X
 SG_ FRM_32_DetnElevnAngle_055 : 130|8@0+ (0.1,-10) [-10|10] "deg"  ADCC_FM_4X
 SG_ FRM_32_DetnRelVelRadial_055 : 138|15@0+ (0.01,-100) [-100|80] "m/s"  ADCC_FM_4X
 SG_ FRM_32_DetnSNR_055 : 155|7@0+ (1,0) [0|100] "dB"  ADCC_FM_4X
 SG_ FRM_32_DetnRCS_055 : 164|15@0+ (0.01,-50) [-50|128] "dBsm"  ADCC_FM_4X
 SG_ FRM_32_DetnQuality_055 : 181|4@0+ (10,0) [0|100] "%"  ADCC_FM_4X
 SG_ FRM_32_DetnMotionSts_056 : 177|2@0+ (1,0) [0|3] ""  ADCC_FM_4X
 SG_ FRM_32_DetnRngRadial_056 : 191|15@0+ (0.01,0) [0|200] "m"  ADCC_FM_4X
 SG_ FRM_32_DetnAziAngle_056 : 192|11@0+ (0.1,-90) [-90|90] "deg"  ADCC_FM_4X
 SG_ FRM_32_DetnElevnAngle_056 : 213|8@0+ (0.1,-10) [-10|10] "deg"  ADCC_FM_4X
 SG_ FRM_32_DetnRelVelRadial_056 : 221|15@0+ (0.01,-100) [-100|80] "m/s"  ADCC_FM_4X
 SG_ FRM_32_DetnSNR_056 : 238|7@0+ (1,0) [0|100] "dB"  ADCC_FM_4X
 SG_ FRM_32_DetnRCS_056 : 247|15@0+ (0.01,-50) [-50|128] "dBsm"  ADCC_FM_4X
 SG_ FRM_32_DetnQuality_056 : 248|4@0+ (10,0) [0|100] "%"  ADCC_FM_4X
 SG_ FRM_32_DetnMotionSts_057 : 260|2@0+ (1,0) [0|3] ""  ADCC_FM_4X
 SG_ FRM_32_DetnRngRadial_057 : 258|15@0+ (0.01,0) [0|200] "m"  ADCC_FM_4X
 SG_ FRM_32_DetnAziAngle_057 : 275|11@0+ (0.1,-90) [-90|90] "deg"  ADCC_FM_4X
 SG_ FRM_32_DetnElevnAngle_057 : 280|8@0+ (0.1,-10) [-10|10] "deg"  ADCC_FM_4X
 SG_ FRM_32_DetnRelVelRadial_057 : 288|15@0+ (0.01,-100) [-100|80] "m/s"  ADCC_FM_4X
 SG_ FRM_32_DetnSNR_057 : 305|7@0+ (1,0) [0|100] "dB"  ADCC_FM_4X
 SG_ FRM_32_DetnRCS_057 : 314|15@0+ (0.01,-50) [-50|128] "dBsm"  ADCC_FM_4X
 SG_ FRM_32_DetnQuality_057 : 331|4@0+ (10,0) [0|100] "%"  ADCC_FM_4X
 SG_ FRM_32_DetnMotionSts_058 : 343|2@0+ (1,0) [0|3] ""  ADCC_FM_4X
 SG_ FRM_32_DetnRngRadial_058 : 341|15@0+ (0.01,0) [0|200] "m"  ADCC_FM_4X
 SG_ FRM_32_DetnAziAngle_058 : 358|11@0+ (0.1,-90) [-90|90] "deg"  ADCC_FM_4X
 SG_ FRM_32_DetnElevnAngle_058 : 363|8@0+ (0.1,-10) [-10|10] "deg"  ADCC_FM_4X
 SG_ FRM_32_DetnRelVelRadial_058 : 371|15@0+ (0.01,-100) [-100|80] "m/s"  ADCC_FM_4X
 SG_ FRM_32_DetnSNR_058 : 388|7@0+ (1,0) [0|100] "dB"  ADCC_FM_4X
 SG_ FRM_32_DetnRCS_058 : 397|15@0+ (0.01,-50) [-50|128] "dBsm"  ADCC_FM_4X
 SG_ FRM_32_DetnQuality_058 : 414|4@0+ (10,0) [0|100] "%"  ADCC_FM_4X
 SG_ FRM_32_DetnMotionSts_059 : 410|2@0+ (1,0) [0|3] ""  ADCC_FM_4X
 SG_ FRM_32_DetnRngRadial_059 : 408|15@0+ (0.01,0) [0|200] "m"  ADCC_FM_4X
 SG_ FRM_32_DetnAziAngle_059 : 425|11@0+ (0.1,-90) [-90|90] "deg"  ADCC_FM_4X
 SG_ FRM_32_DetnElevnAngle_059 : 446|8@0+ (0.1,-10) [-10|10] "deg"  ADCC_FM_4X
 SG_ FRM_32_DetnRelVelRadial_059 : 454|15@0+ (0.01,-100) [-100|80] "m/s"  ADCC_FM_4X
 SG_ FRM_32_DetnSNR_059 : 471|7@0+ (1,0) [0|100] "dB"  ADCC_FM_4X
 SG_ FRM_32_DetnRCS_059 : 464|15@0+ (0.01,-50) [-50|128] "dBsm"  ADCC_FM_4X
 SG_ FRM_32_DetnQuality_059 : 481|4@0+ (10,0) [0|100] "%"  ADCC_FM_4X
 SG_ FRM_32_Loc054_Valid : 488|1@0+ (1,0) [0|1] ""  ADCC_FM_4X
 SG_ FRM_32_Loc055_Valid : 489|1@0+ (1,0) [0|1] ""  ADCC_FM_4X
 SG_ FRM_32_Loc056_Valid : 490|1@0+ (1,0) [0|1] ""  ADCC_FM_4X
 SG_ FRM_32_Loc057_Valid : 491|1@0+ (1,0) [0|1] ""  ADCC_FM_4X
 SG_ FRM_32_Loc058_Valid : 492|1@0+ (1,0) [0|1] ""  ADCC_FM_4X
 SG_ FRM_32_Loc059_Valid : 493|1@0+ (1,0) [0|1] ""  ADCC_FM_4X

BO_ 1004 FRM_33: 64 Vector__XXX
 SG_ FRM_33_CRC : 7|16@0+ (1,0) [0|65535] ""  ADCC_FM_4X
 SG_ FRM_33_RollgCntr : 23|8@0+ (1,0) [0|255] ""  ADCC_FM_4X
 SG_ FRM_33_DetnBlockCounter : 27|4@0+ (1,0) [0|15] ""  ADCC_FM_4X
 SG_ FRM_33_DetnMotionSts_060 : 29|2@0+ (1,0) [0|3] ""  ADCC_FM_4X
 SG_ FRM_33_DetnRngRadial_060 : 39|15@0+ (0.01,0) [0|200] "m"  ADCC_FM_4X
 SG_ FRM_33_DetnAziAngle_060 : 40|11@0+ (0.1,-90) [-90|90] "deg"  ADCC_FM_4X
 SG_ FRM_33_DetnElevnAngle_060 : 61|8@0+ (0.1,-10) [-10|10] "deg"  ADCC_FM_4X
 SG_ FRM_33_DetnRelVelRadial_060 : 69|15@0+ (0.01,-100) [-100|80] "m/s"  ADCC_FM_4X
 SG_ FRM_33_DetnSNR_060 : 86|7@0+ (1,0) [0|100] "dB"  ADCC_FM_4X
 SG_ FRM_33_DetnRCS_060 : 95|15@0+ (0.01,-50) [-50|128] "dBsm"  ADCC_FM_4X
 SG_ FRM_33_DetnQuality_060 : 96|4@0+ (10,0) [0|100] "%"  ADCC_FM_4X
 SG_ FRM_33_DetnMotionSts_061 : 31|2@0+ (1,0) [0|3] ""  ADCC_FM_4X
 SG_ FRM_33_DetnRngRadial_061 : 108|15@0+ (0.01,0) [0|200] "m"  ADCC_FM_4X
 SG_ FRM_33_DetnAziAngle_061 : 125|11@0+ (0.1,-90) [-90|90] "deg"  ADCC_FM_4X
 SG_ FRM_33_DetnElevnAngle_061 : 130|8@0+ (0.1,-10) [-10|10] "deg"  ADCC_FM_4X
 SG_ FRM_33_DetnRelVelRadial_061 : 138|15@0+ (0.01,-100) [-100|80] "m/s"  ADCC_FM_4X
 SG_ FRM_33_DetnSNR_061 : 155|7@0+ (1,0) [0|100] "dB"  ADCC_FM_4X
 SG_ FRM_33_DetnRCS_061 : 164|15@0+ (0.01,-50) [-50|128] "dBsm"  ADCC_FM_4X
 SG_ FRM_33_DetnQuality_061 : 181|4@0+ (10,0) [0|100] "%"  ADCC_FM_4X
 SG_ FRM_33_DetnMotionSts_062 : 177|2@0+ (1,0) [0|3] ""  ADCC_FM_4X
 SG_ FRM_33_DetnRngRadial_062 : 191|15@0+ (0.01,0) [0|200] "m"  ADCC_FM_4X
 SG_ FRM_33_DetnAziAngle_062 : 192|11@0+ (0.1,-90) [-90|90] "deg"  ADCC_FM_4X
 SG_ FRM_33_DetnElevnAngle_062 : 213|8@0+ (0.1,-10) [-10|10] "deg"  ADCC_FM_4X
 SG_ FRM_33_DetnRelVelRadial_062 : 221|15@0+ (0.01,-100) [-100|80] "m/s"  ADCC_FM_4X
 SG_ FRM_33_DetnSNR_062 : 238|7@0+ (1,0) [0|100] "dB"  ADCC_FM_4X
 SG_ FRM_33_DetnRCS_062 : 247|15@0+ (0.01,-50) [-50|128] "dBsm"  ADCC_FM_4X
 SG_ FRM_33_DetnQuality_062 : 248|4@0+ (10,0) [0|100] "%"  ADCC_FM_4X
 SG_ FRM_33_DetnMotionSts_063 : 260|2@0+ (1,0) [0|3] ""  ADCC_FM_4X
 SG_ FRM_33_DetnRngRadial_063 : 258|15@0+ (0.01,0) [0|200] "m"  ADCC_FM_4X
 SG_ FRM_33_DetnAziAngle_063 : 275|11@0+ (0.1,-90) [-90|90] "deg"  ADCC_FM_4X
 SG_ FRM_33_DetnElevnAngle_063 : 280|8@0+ (0.1,-10) [-10|10] "deg"  ADCC_FM_4X
 SG_ FRM_33_DetnRelVelRadial_063 : 288|15@0+ (0.01,-100) [-100|80] "m/s"  ADCC_FM_4X
 SG_ FRM_33_DetnSNR_063 : 305|7@0+ (1,0) [0|100] "dB"  ADCC_FM_4X
 SG_ FRM_33_DetnRCS_063 : 314|15@0+ (0.01,-50) [-50|128] "dBsm"  ADCC_FM_4X
 SG_ FRM_33_DetnQuality_063 : 331|4@0+ (10,0) [0|100] "%"  ADCC_FM_4X
 SG_ FRM_33_DetnMotionSts_064 : 343|2@0+ (1,0) [0|3] ""  ADCC_FM_4X
 SG_ FRM_33_DetnRngRadial_064 : 341|15@0+ (0.01,0) [0|200] "m"  ADCC_FM_4X
 SG_ FRM_33_DetnAziAngle_064 : 358|11@0+ (0.1,-90) [-90|90] "deg"  ADCC_FM_4X
 SG_ FRM_33_DetnElevnAngle_064 : 363|8@0+ (0.1,-10) [-10|10] "deg"  ADCC_FM_4X
 SG_ FRM_33_DetnRelVelRadial_064 : 371|15@0+ (0.01,-100) [-100|80] "m/s"  ADCC_FM_4X
 SG_ FRM_33_DetnSNR_064 : 388|7@0+ (1,0) [0|100] "dB"  ADCC_FM_4X
 SG_ FRM_33_DetnRCS_064 : 397|15@0+ (0.01,-50) [-50|128] "dBsm"  ADCC_FM_4X
 SG_ FRM_33_DetnQuality_064 : 414|4@0+ (10,0) [0|100] "%"  ADCC_FM_4X
 SG_ FRM_33_DetnMotionSts_065 : 410|2@0+ (1,0) [0|3] ""  ADCC_FM_4X
 SG_ FRM_33_DetnRngRadial_065 : 408|15@0+ (0.01,0) [0|200] "m"  ADCC_FM_4X
 SG_ FRM_33_DetnAziAngle_065 : 425|11@0+ (0.1,-90) [-90|90] "deg"  ADCC_FM_4X
 SG_ FRM_33_DetnElevnAngle_065 : 446|8@0+ (0.1,-10) [-10|10] "deg"  ADCC_FM_4X
 SG_ FRM_33_DetnRelVelRadial_065 : 454|15@0+ (0.01,-100) [-100|80] "m/s"  ADCC_FM_4X
 SG_ FRM_33_DetnSNR_065 : 471|7@0+ (1,0) [0|100] "dB"  ADCC_FM_4X
 SG_ FRM_33_DetnRCS_065 : 464|15@0+ (0.01,-50) [-50|128] "dBsm"  ADCC_FM_4X
 SG_ FRM_33_DetnQuality_065 : 481|4@0+ (10,0) [0|100] "%"  ADCC_FM_4X
 SG_ FRM_33_Loc060_Valid : 488|1@0+ (1,0) [0|1] ""  ADCC_FM_4X
 SG_ FRM_33_Loc061_Valid : 489|1@0+ (1,0) [0|1] ""  ADCC_FM_4X
 SG_ FRM_33_Loc062_Valid : 490|1@0+ (1,0) [0|1] ""  ADCC_FM_4X
 SG_ FRM_33_Loc063_Valid : 491|1@0+ (1,0) [0|1] ""  ADCC_FM_4X
 SG_ FRM_33_Loc064_Valid : 492|1@0+ (1,0) [0|1] ""  ADCC_FM_4X
 SG_ FRM_33_Loc065_Valid : 493|1@0+ (1,0) [0|1] ""  ADCC_FM_4X

CM_ BO_ 994 "禾多配置不发此帧报文";
CM_ BO_ 995 "禾多配置不发此帧报文";
CM_ BO_ 996 "禾多配置不发此帧报文";
CM_ BO_ 997 "禾多配置不发此帧报文";
CM_ BO_ 998 "禾多配置不发此帧报文";
CM_ BO_ 999 "禾多配置不发此帧报文";
CM_ BO_ 1000 "禾多配置不发此帧报文";
CM_ BO_ 1001 "禾多配置不发此帧报文";
CM_ BO_ 1002 "禾多配置不发此帧报文";
CM_ BO_ 1003 "禾多配置不发此帧报文";
CM_ BO_ 1004 "禾多配置不发此帧报文";
CM_ SG_ 994 FRM_23_CRC "Profile5:E2E CRC16 (polynomial:0x1021)       
DataID:Use CANID,other bits Fill with 0";
CM_ SG_ 994 FRM_23_RollgCntr "Profile5:E2E Rolling message counter";
CM_ SG_ 994 FRM_23_DetnBlockCounter "Front Radar Moudle_X_Detection Block Counter
前雷达探测点块计数";
CM_ SG_ 994 FRM_23_DetnMotionSts_000 "Detection point motion status
Front Radar Moudle_X_Detection Motion Status
前雷达探测点运动状态";
CM_ SG_ 994 FRM_23_DetnRngRadial_000 "Detection point radial distance
Front Radar Moudle_X_Detection Range Radial
前雷达探测点径向距离";
CM_ SG_ 994 FRM_23_DetnAziAngle_000 "Detection point azimuth angle
Front Radar Moudle_X_Detection Azimuth Angle
前雷达探测点水平方位角";
CM_ SG_ 994 FRM_23_DetnElevnAngle_000 "Detection point elevation angle
Front Radar Moudle_X_Detection Elevation Angle
前雷达探测点俯仰角";
CM_ SG_ 994 FRM_23_DetnRelVelRadial_000 "Detection point radial relative velocity
Front Radar Moudle_X_Detection Relative Velocity Radial 
前雷达探测点在径向上的相对速度";
CM_ SG_ 994 FRM_23_DetnSNR_000 "Detection point signal noise ratio
Front Radar Moudle_X_Detection Signal Noise Ratio
前雷达探测点信号噪声比";
CM_ SG_ 994 FRM_23_DetnRCS_000 "Detection point radar cross section
Front Radar Moudle_X_Detection Radar Cross Section
前雷达探测点雷达散射截面积";
CM_ SG_ 994 FRM_23_DetnQuality_000 "Detection point quality
Front Radar Moudle_X_Detection Quality
前雷达探测点质量";
CM_ SG_ 994 FRM_23_DetnMotionSts_001 "Detection point motion status
Front Radar Moudle_X_Detection Motion Status
前雷达探测点运动状态";
CM_ SG_ 994 FRM_23_DetnRngRadial_001 "Detection point radial distance
Front Radar Moudle_X_Detection Range Radial
前雷达探测点径向距离";
CM_ SG_ 994 FRM_23_DetnAziAngle_001 "Detection point azimuth angle
Front Radar Moudle_X_Detection Azimuth Angle
前雷达探测点水平方位角";
CM_ SG_ 994 FRM_23_DetnElevnAngle_001 "Detection point elevation angle
Front Radar Moudle_X_Detection Elevation Angle
前雷达探测点俯仰角";
CM_ SG_ 994 FRM_23_DetnRelVelRadial_001 "Detection point radial relative velocity
Front Radar Moudle_X_Detection Relative Velocity Radial 
前雷达探测点在径向上的相对速度";
CM_ SG_ 994 FRM_23_DetnSNR_001 "Detection point signal noise ratio
Front Radar Moudle_X_Detection Signal Noise Ratio
前雷达探测点信号噪声比";
CM_ SG_ 994 FRM_23_DetnRCS_001 "Detection point radar cross section
Front Radar Moudle_X_Detection Radar Cross Section
前雷达探测点雷达散射截面积";
CM_ SG_ 994 FRM_23_DetnQuality_001 "Detection point quality
Front Radar Moudle_X_Detection Quality
前雷达探测点质量";
CM_ SG_ 994 FRM_23_DetnMotionSts_002 "Detection point motion status
Front Radar Moudle_X_Detection Motion Status
前雷达探测点运动状态";
CM_ SG_ 994 FRM_23_DetnRngRadial_002 "Detection point radial distance
Front Radar Moudle_X_Detection Range Radial
前雷达探测点径向距离";
CM_ SG_ 994 FRM_23_DetnAziAngle_002 "Detection point azimuth angle
Front Radar Moudle_X_Detection Azimuth Angle
前雷达探测点水平方位角";
CM_ SG_ 994 FRM_23_DetnElevnAngle_002 "Detection point elevation angle
Front Radar Moudle_X_Detection Elevation Angle
前雷达探测点俯仰角";
CM_ SG_ 994 FRM_23_DetnRelVelRadial_002 "Detection point radial relative velocity
Front Radar Moudle_X_Detection Relative Velocity Radial 
前雷达探测点在径向上的相对速度";
CM_ SG_ 994 FRM_23_DetnSNR_002 "Detection point signal noise ratio
Front Radar Moudle_X_Detection Signal Noise Ratio
前雷达探测点信号噪声比";
CM_ SG_ 994 FRM_23_DetnRCS_002 "Detection point radar cross section
Front Radar Moudle_X_Detection Radar Cross Section
前雷达探测点雷达散射截面积";
CM_ SG_ 994 FRM_23_DetnQuality_002 "Detection point quality
Front Radar Moudle_X_Detection Quality
前雷达探测点质量";
CM_ SG_ 994 FRM_23_DetnMotionSts_003 "Detection point motion status
Front Radar Moudle_X_Detection Motion Status
前雷达探测点运动状态";
CM_ SG_ 994 FRM_23_DetnRngRadial_003 "Detection point radial distance
Front Radar Moudle_X_Detection Range Radial
前雷达探测点径向距离";
CM_ SG_ 994 FRM_23_DetnAziAngle_003 "Detection point azimuth angle
Front Radar Moudle_X_Detection Azimuth Angle
前雷达探测点水平方位角";
CM_ SG_ 994 FRM_23_DetnElevnAngle_003 "Detection point elevation angle
Front Radar Moudle_X_Detection Elevation Angle
前雷达探测点俯仰角";
CM_ SG_ 994 FRM_23_DetnRelVelRadial_003 "Detection point radial relative velocity
Front Radar Moudle_X_Detection Relative Velocity Radial 
前雷达探测点在径向上的相对速度";
CM_ SG_ 994 FRM_23_DetnSNR_003 "Detection point signal noise ratio
Front Radar Moudle_X_Detection Signal Noise Ratio
前雷达探测点信号噪声比";
CM_ SG_ 994 FRM_23_DetnRCS_003 "Detection point radar cross section
Front Radar Moudle_X_Detection Radar Cross Section
前雷达探测点雷达散射截面积";
CM_ SG_ 994 FRM_23_DetnQuality_003 "Detection point quality
Front Radar Moudle_X_Detection Quality
前雷达探测点质量";
CM_ SG_ 994 FRM_23_DetnMotionSts_004 "Detection point motion status
Front Radar Moudle_X_Detection Motion Status
前雷达探测点运动状态";
CM_ SG_ 994 FRM_23_DetnRngRadial_004 "Detection point radial distance
Front Radar Moudle_X_Detection Range Radial
前雷达探测点径向距离";
CM_ SG_ 994 FRM_23_DetnAziAngle_004 "Detection point azimuth angle
Front Radar Moudle_X_Detection Azimuth Angle
前雷达探测点水平方位角";
CM_ SG_ 994 FRM_23_DetnElevnAngle_004 "Detection point elevation angle
Front Radar Moudle_X_Detection Elevation Angle
前雷达探测点俯仰角";
CM_ SG_ 994 FRM_23_DetnRelVelRadial_004 "Detection point radial relative velocity
Front Radar Moudle_X_Detection Relative Velocity Radial 
前雷达探测点在径向上的相对速度";
CM_ SG_ 994 FRM_23_DetnSNR_004 "Detection point signal noise ratio
Front Radar Moudle_X_Detection Signal Noise Ratio
前雷达探测点信号噪声比";
CM_ SG_ 994 FRM_23_DetnRCS_004 "Detection point radar cross section
Front Radar Moudle_X_Detection Radar Cross Section
前雷达探测点雷达散射截面积";
CM_ SG_ 994 FRM_23_DetnQuality_004 "Detection point quality
Front Radar Moudle_X_Detection Quality
前雷达探测点质量";
CM_ SG_ 994 FRM_23_DetnMotionSts_005 "Detection point motion status
Front Radar Moudle_X_Detection Motion Status
前雷达探测点运动状态";
CM_ SG_ 994 FRM_23_DetnRngRadial_005 "Detection point radial distance
Front Radar Moudle_X_Detection Range Radial
前雷达探测点径向距离";
CM_ SG_ 994 FRM_23_DetnAziAngle_005 "Detection point azimuth angle
Front Radar Moudle_X_Detection Azimuth Angle
前雷达探测点水平方位角";
CM_ SG_ 994 FRM_23_DetnElevnAngle_005 "Detection point elevation angle
Front Radar Moudle_X_Detection Elevation Angle
前雷达探测点俯仰角";
CM_ SG_ 994 FRM_23_DetnRelVelRadial_005 "Detection point radial relative velocity
Front Radar Moudle_X_Detection Relative Velocity Radial 
前雷达探测点在径向上的相对速度";
CM_ SG_ 994 FRM_23_DetnSNR_005 "Detection point signal noise ratio
Front Radar Moudle_X_Detection Signal Noise Ratio
前雷达探测点信号噪声比";
CM_ SG_ 994 FRM_23_DetnRCS_005 "Detection point radar cross section
Front Radar Moudle_X_Detection Radar Cross Section
前雷达探测点雷达散射截面积";
CM_ SG_ 994 FRM_23_DetnQuality_005 "Detection point quality
Front Radar Moudle_X_Detection Quality
前雷达探测点质量";
CM_ SG_ 994 FRM_23_Loc000_Valid "the valid flag of each location";
CM_ SG_ 994 FRM_23_Loc001_Valid "the valid flag of each location";
CM_ SG_ 994 FRM_23_Loc002_Valid "the valid flag of each location";
CM_ SG_ 994 FRM_23_Loc003_Valid "the valid flag of each location";
CM_ SG_ 994 FRM_23_Loc004_Valid "the valid flag of each location";
CM_ SG_ 994 FRM_23_Loc005_Valid "the valid flag of each location";
CM_ SG_ 995 FRM_24_CRC "Profile5:E2E CRC16 (polynomial:0x1021)       
DataID:Use CANID,other bits Fill with 0";
CM_ SG_ 995 FRM_24_RollgCntr "Profile5:E2E Rolling message counter";
CM_ SG_ 995 FRM_24_DetnBlockCounter "Front Radar Moudle_X_Detection Block Counter
前雷达探测点块计数";
CM_ SG_ 995 FRM_24_DetnMotionSts_006 "Detection point motion status
Front Radar Moudle_X_Detection Motion Status
前雷达探测点运动状态";
CM_ SG_ 995 FRM_24_DetnRngRadial_006 "Detection point radial distance
Front Radar Moudle_X_Detection Range Radial
前雷达探测点径向距离";
CM_ SG_ 995 FRM_24_DetnAziAngle_006 "Detection point azimuth angle
Front Radar Moudle_X_Detection Azimuth Angle
前雷达探测点水平方位角";
CM_ SG_ 995 FRM_24_DetnElevnAngle_006 "Detection point elevation angle
Front Radar Moudle_X_Detection Elevation Angle
前雷达探测点俯仰角";
CM_ SG_ 995 FRM_24_DetnRelVelRadial_006 "Detection point radial relative velocity
Front Radar Moudle_X_Detection Relative Velocity Radial 
前雷达探测点在径向上的相对速度";
CM_ SG_ 995 FRM_24_DetnSNR_006 "Detection point signal noise ratio
Front Radar Moudle_X_Detection Signal Noise Ratio
前雷达探测点信号噪声比";
CM_ SG_ 995 FRM_24_DetnRCS_006 "Detection point radar cross section
Front Radar Moudle_X_Detection Radar Cross Section
前雷达探测点雷达散射截面积";
CM_ SG_ 995 FRM_24_DetnQuality_006 "Detection point quality
Front Radar Moudle_X_Detection Quality
前雷达探测点质量";
CM_ SG_ 995 FRM_24_DetnMotionSts_007 "Detection point motion status
Front Radar Moudle_X_Detection Motion Status
前雷达探测点运动状态";
CM_ SG_ 995 FRM_24_DetnRngRadial_007 "Detection point radial distance
Front Radar Moudle_X_Detection Range Radial
前雷达探测点径向距离";
CM_ SG_ 995 FRM_24_DetnAziAngle_007 "Detection point azimuth angle
Front Radar Moudle_X_Detection Azimuth Angle
前雷达探测点水平方位角";
CM_ SG_ 995 FRM_24_DetnElevnAngle_007 "Detection point elevation angle
Front Radar Moudle_X_Detection Elevation Angle
前雷达探测点俯仰角";
CM_ SG_ 995 FRM_24_DetnRelVelRadial_007 "Detection point radial relative velocity
Front Radar Moudle_X_Detection Relative Velocity Radial 
前雷达探测点在径向上的相对速度";
CM_ SG_ 995 FRM_24_DetnSNR_007 "Detection point signal noise ratio
Front Radar Moudle_X_Detection Signal Noise Ratio
前雷达探测点信号噪声比";
CM_ SG_ 995 FRM_24_DetnRCS_007 "Detection point radar cross section
Front Radar Moudle_X_Detection Radar Cross Section
前雷达探测点雷达散射截面积";
CM_ SG_ 995 FRM_24_DetnQuality_007 "Detection point quality
Front Radar Moudle_X_Detection Quality
前雷达探测点质量";
CM_ SG_ 995 FRM_24_DetnMotionSts_008 "Detection point motion status
Front Radar Moudle_X_Detection Motion Status
前雷达探测点运动状态";
CM_ SG_ 995 FRM_24_DetnRngRadial_008 "Detection point radial distance
Front Radar Moudle_X_Detection Range Radial
前雷达探测点径向距离";
CM_ SG_ 995 FRM_24_DetnAziAngle_008 "Detection point azimuth angle
Front Radar Moudle_X_Detection Azimuth Angle
前雷达探测点水平方位角";
CM_ SG_ 995 FRM_24_DetnElevnAngle_008 "Detection point elevation angle
Front Radar Moudle_X_Detection Elevation Angle
前雷达探测点俯仰角";
CM_ SG_ 995 FRM_24_DetnRelVelRadial_008 "Detection point radial relative velocity
Front Radar Moudle_X_Detection Relative Velocity Radial 
前雷达探测点在径向上的相对速度";
CM_ SG_ 995 FRM_24_DetnSNR_008 "Detection point signal noise ratio
Front Radar Moudle_X_Detection Signal Noise Ratio
前雷达探测点信号噪声比";
CM_ SG_ 995 FRM_24_DetnRCS_008 "Detection point radar cross section
Front Radar Moudle_X_Detection Radar Cross Section
前雷达探测点雷达散射截面积";
CM_ SG_ 995 FRM_24_DetnQuality_008 "Detection point quality
Front Radar Moudle_X_Detection Quality
前雷达探测点质量";
CM_ SG_ 995 FRM_24_DetnMotionSts_009 "Detection point motion status
Front Radar Moudle_X_Detection Motion Status
前雷达探测点运动状态";
CM_ SG_ 995 FRM_24_DetnRngRadial_009 "Detection point radial distance
Front Radar Moudle_X_Detection Range Radial
前雷达探测点径向距离";
CM_ SG_ 995 FRM_24_DetnAziAngle_009 "Detection point azimuth angle
Front Radar Moudle_X_Detection Azimuth Angle
前雷达探测点水平方位角";
CM_ SG_ 995 FRM_24_DetnElevnAngle_009 "Detection point elevation angle
Front Radar Moudle_X_Detection Elevation Angle
前雷达探测点俯仰角";
CM_ SG_ 995 FRM_24_DetnRelVelRadial_009 "Detection point radial relative velocity
Front Radar Moudle_X_Detection Relative Velocity Radial 
前雷达探测点在径向上的相对速度";
CM_ SG_ 995 FRM_24_DetnSNR_009 "Detection point signal noise ratio
Front Radar Moudle_X_Detection Signal Noise Ratio
前雷达探测点信号噪声比";
CM_ SG_ 995 FRM_24_DetnRCS_009 "Detection point radar cross section
Front Radar Moudle_X_Detection Radar Cross Section
前雷达探测点雷达散射截面积";
CM_ SG_ 995 FRM_24_DetnQuality_009 "Detection point quality
Front Radar Moudle_X_Detection Quality
前雷达探测点质量";
CM_ SG_ 995 FRM_24_DetnMotionSts_010 "Detection point motion status
Front Radar Moudle_X_Detection Motion Status
前雷达探测点运动状态";
CM_ SG_ 995 FRM_24_DetnRngRadial_010 "Detection point radial distance
Front Radar Moudle_X_Detection Range Radial
前雷达探测点径向距离";
CM_ SG_ 995 FRM_24_DetnAziAngle_010 "Detection point azimuth angle
Front Radar Moudle_X_Detection Azimuth Angle
前雷达探测点水平方位角";
CM_ SG_ 995 FRM_24_DetnElevnAngle_010 "Detection point elevation angle
Front Radar Moudle_X_Detection Elevation Angle
前雷达探测点俯仰角";
CM_ SG_ 995 FRM_24_DetnRelVelRadial_010 "Detection point radial relative velocity
Front Radar Moudle_X_Detection Relative Velocity Radial 
前雷达探测点在径向上的相对速度";
CM_ SG_ 995 FRM_24_DetnSNR_010 "Detection point signal noise ratio
Front Radar Moudle_X_Detection Signal Noise Ratio
前雷达探测点信号噪声比";
CM_ SG_ 995 FRM_24_DetnRCS_010 "Detection point radar cross section
Front Radar Moudle_X_Detection Radar Cross Section
前雷达探测点雷达散射截面积";
CM_ SG_ 995 FRM_24_DetnQuality_010 "Detection point quality
Front Radar Moudle_X_Detection Quality
前雷达探测点质量";
CM_ SG_ 995 FRM_24_DetnMotionSts_011 "Detection point motion status
Front Radar Moudle_X_Detection Motion Status
前雷达探测点运动状态";
CM_ SG_ 995 FRM_24_DetnRngRadial_011 "Detection point radial distance
Front Radar Moudle_X_Detection Range Radial
前雷达探测点径向距离";
CM_ SG_ 995 FRM_24_DetnAziAngle_011 "Detection point azimuth angle
Front Radar Moudle_X_Detection Azimuth Angle
前雷达探测点水平方位角";
CM_ SG_ 995 FRM_24_DetnElevnAngle_011 "Detection point elevation angle
Front Radar Moudle_X_Detection Elevation Angle
前雷达探测点俯仰角";
CM_ SG_ 995 FRM_24_DetnRelVelRadial_011 "Detection point radial relative velocity
Front Radar Moudle_X_Detection Relative Velocity Radial 
前雷达探测点在径向上的相对速度";
CM_ SG_ 995 FRM_24_DetnSNR_011 "Detection point signal noise ratio
Front Radar Moudle_X_Detection Signal Noise Ratio
前雷达探测点信号噪声比";
CM_ SG_ 995 FRM_24_DetnRCS_011 "Detection point radar cross section
Front Radar Moudle_X_Detection Radar Cross Section
前雷达探测点雷达散射截面积";
CM_ SG_ 995 FRM_24_DetnQuality_011 "Detection point quality
Front Radar Moudle_X_Detection Quality
前雷达探测点质量";
CM_ SG_ 995 FRM_24_Loc006_Valid "the valid flag of each location";
CM_ SG_ 995 FRM_24_Loc007_Valid "the valid flag of each location";
CM_ SG_ 995 FRM_24_Loc008_Valid "the valid flag of each location";
CM_ SG_ 995 FRM_24_Loc009_Valid "the valid flag of each location";
CM_ SG_ 995 FRM_24_Loc010_Valid "the valid flag of each location";
CM_ SG_ 995 FRM_24_Loc011_Valid "the valid flag of each location";
CM_ SG_ 996 FRM_25_CRC "Profile5:E2E CRC16 (polynomial:0x1021)       
DataID:Use CANID,other bits Fill with 0";
CM_ SG_ 996 FRM_25_RollgCntr "Profile5:E2E Rolling message counter";
CM_ SG_ 996 FRM_25_DetnBlockCounter "Front Radar Moudle_X_Detection Block Counter
前雷达探测点块计数";
CM_ SG_ 996 FRM_25_DetnMotionSts_012 "Detection point motion status
Front Radar Moudle_X_Detection Motion Status
前雷达探测点运动状态";
CM_ SG_ 996 FRM_25_DetnRngRadial_012 "Detection point radial distance
Front Radar Moudle_X_Detection Range Radial
前雷达探测点径向距离";
CM_ SG_ 996 FRM_25_DetnAziAngle_012 "Detection point azimuth angle
Front Radar Moudle_X_Detection Azimuth Angle
前雷达探测点水平方位角";
CM_ SG_ 996 FRM_25_DetnElevnAngle_012 "Detection point elevation angle
Front Radar Moudle_X_Detection Elevation Angle
前雷达探测点俯仰角";
CM_ SG_ 996 FRM_25_DetnRelVelRadial_012 "Detection point radial relative velocity
Front Radar Moudle_X_Detection Relative Velocity Radial 
前雷达探测点在径向上的相对速度";
CM_ SG_ 996 FRM_25_DetnSNR_012 "Detection point signal noise ratio
Front Radar Moudle_X_Detection Signal Noise Ratio
前雷达探测点信号噪声比";
CM_ SG_ 996 FRM_25_DetnRCS_012 "Detection point radar cross section
Front Radar Moudle_X_Detection Radar Cross Section
前雷达探测点雷达散射截面积";
CM_ SG_ 996 FRM_25_DetnQuality_012 "Detection point quality
Front Radar Moudle_X_Detection Quality
前雷达探测点质量";
CM_ SG_ 996 FRM_25_DetnMotionSts_013 "Detection point motion status
Front Radar Moudle_X_Detection Motion Status
前雷达探测点运动状态";
CM_ SG_ 996 FRM_25_DetnRngRadial_013 "Detection point radial distance
Front Radar Moudle_X_Detection Range Radial
前雷达探测点径向距离";
CM_ SG_ 996 FRM_25_DetnAziAngle_013 "Detection point azimuth angle
Front Radar Moudle_X_Detection Azimuth Angle
前雷达探测点水平方位角";
CM_ SG_ 996 FRM_25_DetnElevnAngle_013 "Detection point elevation angle
Front Radar Moudle_X_Detection Elevation Angle
前雷达探测点俯仰角";
CM_ SG_ 996 FRM_25_DetnRelVelRadial_013 "Detection point radial relative velocity
Front Radar Moudle_X_Detection Relative Velocity Radial 
前雷达探测点在径向上的相对速度";
CM_ SG_ 996 FRM_25_DetnSNR_013 "Detection point signal noise ratio
Front Radar Moudle_X_Detection Signal Noise Ratio
前雷达探测点信号噪声比";
CM_ SG_ 996 FRM_25_DetnRCS_013 "Detection point radar cross section
Front Radar Moudle_X_Detection Radar Cross Section
前雷达探测点雷达散射截面积";
CM_ SG_ 996 FRM_25_DetnQuality_013 "Detection point quality
Front Radar Moudle_X_Detection Quality
前雷达探测点质量";
CM_ SG_ 996 FRM_25_DetnMotionSts_014 "Detection point motion status
Front Radar Moudle_X_Detection Motion Status
前雷达探测点运动状态";
CM_ SG_ 996 FRM_25_DetnRngRadial_014 "Detection point radial distance
Front Radar Moudle_X_Detection Range Radial
前雷达探测点径向距离";
CM_ SG_ 996 FRM_25_DetnAziAngle_014 "Detection point azimuth angle
Front Radar Moudle_X_Detection Azimuth Angle
前雷达探测点水平方位角";
CM_ SG_ 996 FRM_25_DetnElevnAngle_014 "Detection point elevation angle
Front Radar Moudle_X_Detection Elevation Angle
前雷达探测点俯仰角";
CM_ SG_ 996 FRM_25_DetnRelVelRadial_014 "Detection point radial relative velocity
Front Radar Moudle_X_Detection Relative Velocity Radial 
前雷达探测点在径向上的相对速度";
CM_ SG_ 996 FRM_25_DetnSNR_014 "Detection point signal noise ratio
Front Radar Moudle_X_Detection Signal Noise Ratio
前雷达探测点信号噪声比";
CM_ SG_ 996 FRM_25_DetnRCS_014 "Detection point radar cross section
Front Radar Moudle_X_Detection Radar Cross Section
前雷达探测点雷达散射截面积";
CM_ SG_ 996 FRM_25_DetnQuality_014 "Detection point quality
Front Radar Moudle_X_Detection Quality
前雷达探测点质量";
CM_ SG_ 996 FRM_25_DetnMotionSts_015 "Detection point motion status
Front Radar Moudle_X_Detection Motion Status
前雷达探测点运动状态";
CM_ SG_ 996 FRM_25_DetnRngRadial_015 "Detection point radial distance
Front Radar Moudle_X_Detection Range Radial
前雷达探测点径向距离";
CM_ SG_ 996 FRM_25_DetnAziAngle_015 "Detection point azimuth angle
Front Radar Moudle_X_Detection Azimuth Angle
前雷达探测点水平方位角";
CM_ SG_ 996 FRM_25_DetnElevnAngle_015 "Detection point elevation angle
Front Radar Moudle_X_Detection Elevation Angle
前雷达探测点俯仰角";
CM_ SG_ 996 FRM_25_DetnRelVelRadial_015 "Detection point radial relative velocity
Front Radar Moudle_X_Detection Relative Velocity Radial 
前雷达探测点在径向上的相对速度";
CM_ SG_ 996 FRM_25_DetnSNR_015 "Detection point signal noise ratio
Front Radar Moudle_X_Detection Signal Noise Ratio
前雷达探测点信号噪声比";
CM_ SG_ 996 FRM_25_DetnRCS_015 "Detection point radar cross section
Front Radar Moudle_X_Detection Radar Cross Section
前雷达探测点雷达散射截面积";
CM_ SG_ 996 FRM_25_DetnQuality_015 "Detection point quality
Front Radar Moudle_X_Detection Quality
前雷达探测点质量";
CM_ SG_ 996 FRM_25_DetnMotionSts_016 "Detection point motion status
Front Radar Moudle_X_Detection Motion Status
前雷达探测点运动状态";
CM_ SG_ 996 FRM_25_DetnRngRadial_016 "Detection point radial distance
Front Radar Moudle_X_Detection Range Radial
前雷达探测点径向距离";
CM_ SG_ 996 FRM_25_DetnAziAngle_016 "Detection point azimuth angle
Front Radar Moudle_X_Detection Azimuth Angle
前雷达探测点水平方位角";
CM_ SG_ 996 FRM_25_DetnElevnAngle_016 "Detection point elevation angle
Front Radar Moudle_X_Detection Elevation Angle
前雷达探测点俯仰角";
CM_ SG_ 996 FRM_25_DetnRelVelRadial_016 "Detection point radial relative velocity
Front Radar Moudle_X_Detection Relative Velocity Radial 
前雷达探测点在径向上的相对速度";
CM_ SG_ 996 FRM_25_DetnSNR_016 "Detection point signal noise ratio
Front Radar Moudle_X_Detection Signal Noise Ratio
前雷达探测点信号噪声比";
CM_ SG_ 996 FRM_25_DetnRCS_016 "Detection point radar cross section
Front Radar Moudle_X_Detection Radar Cross Section
前雷达探测点雷达散射截面积";
CM_ SG_ 996 FRM_25_DetnQuality_016 "Detection point quality
Front Radar Moudle_X_Detection Quality
前雷达探测点质量";
CM_ SG_ 996 FRM_25_DetnMotionSts_017 "Detection point motion status
Front Radar Moudle_X_Detection Motion Status
前雷达探测点运动状态";
CM_ SG_ 996 FRM_25_DetnRngRadial_017 "Detection point radial distance
Front Radar Moudle_X_Detection Range Radial
前雷达探测点径向距离";
CM_ SG_ 996 FRM_25_DetnAziAngle_017 "Detection point azimuth angle
Front Radar Moudle_X_Detection Azimuth Angle
前雷达探测点水平方位角";
CM_ SG_ 996 FRM_25_DetnElevnAngle_017 "Detection point elevation angle
Front Radar Moudle_X_Detection Elevation Angle
前雷达探测点俯仰角";
CM_ SG_ 996 FRM_25_DetnRelVelRadial_017 "Detection point radial relative velocity
Front Radar Moudle_X_Detection Relative Velocity Radial 
前雷达探测点在径向上的相对速度";
CM_ SG_ 996 FRM_25_DetnSNR_017 "Detection point signal noise ratio
Front Radar Moudle_X_Detection Signal Noise Ratio
前雷达探测点信号噪声比";
CM_ SG_ 996 FRM_25_DetnRCS_017 "Detection point radar cross section
Front Radar Moudle_X_Detection Radar Cross Section
前雷达探测点雷达散射截面积";
CM_ SG_ 996 FRM_25_DetnQuality_017 "Detection point quality
Front Radar Moudle_X_Detection Quality
前雷达探测点质量";
CM_ SG_ 996 FRM_25_Loc012_Valid "the valid flag of each location";
CM_ SG_ 996 FRM_25_Loc013_Valid "the valid flag of each location";
CM_ SG_ 996 FRM_25_Loc014_Valid "the valid flag of each location";
CM_ SG_ 996 FRM_25_Loc015_Valid "the valid flag of each location";
CM_ SG_ 996 FRM_25_Loc016_Valid "the valid flag of each location";
CM_ SG_ 996 FRM_25_Loc017_Valid "the valid flag of each location";
CM_ SG_ 997 FRM_26_CRC "Profile5:E2E CRC16 (polynomial:0x1021)       
DataID:Use CANID,other bits Fill with 0";
CM_ SG_ 997 FRM_26_RollgCntr "Profile5:E2E Rolling message counter";
CM_ SG_ 997 FRM_26_DetnBlockCounter "Front Radar Moudle_X_Detection Block Counter
前雷达探测点块计数";
CM_ SG_ 997 FRM_26_DetnMotionSts_018 "Detection point motion status
Front Radar Moudle_X_Detection Motion Status
前雷达探测点运动状态";
CM_ SG_ 997 FRM_26_DetnRngRadial_018 "Detection point radial distance
Front Radar Moudle_X_Detection Range Radial
前雷达探测点径向距离";
CM_ SG_ 997 FRM_26_DetnAziAngle_018 "Detection point azimuth angle
Front Radar Moudle_X_Detection Azimuth Angle
前雷达探测点水平方位角";
CM_ SG_ 997 FRM_26_DetnElevnAngle_018 "Detection point elevation angle
Front Radar Moudle_X_Detection Elevation Angle
前雷达探测点俯仰角";
CM_ SG_ 997 FRM_26_DetnRelVelRadial_018 "Detection point radial relative velocity
Front Radar Moudle_X_Detection Relative Velocity Radial 
前雷达探测点在径向上的相对速度";
CM_ SG_ 997 FRM_26_DetnSNR_018 "Detection point signal noise ratio
Front Radar Moudle_X_Detection Signal Noise Ratio
前雷达探测点信号噪声比";
CM_ SG_ 997 FRM_26_DetnRCS_018 "Detection point radar cross section
Front Radar Moudle_X_Detection Radar Cross Section
前雷达探测点雷达散射截面积";
CM_ SG_ 997 FRM_26_DetnQuality_018 "Detection point quality
Front Radar Moudle_X_Detection Quality
前雷达探测点质量";
CM_ SG_ 997 FRM_26_DetnMotionSts_019 "Detection point motion status
Front Radar Moudle_X_Detection Motion Status
前雷达探测点运动状态";
CM_ SG_ 997 FRM_26_DetnRngRadial_019 "Detection point radial distance
Front Radar Moudle_X_Detection Range Radial
前雷达探测点径向距离";
CM_ SG_ 997 FRM_26_DetnAziAngle_019 "Detection point azimuth angle
Front Radar Moudle_X_Detection Azimuth Angle
前雷达探测点水平方位角";
CM_ SG_ 997 FRM_26_DetnElevnAngle_019 "Detection point elevation angle
Front Radar Moudle_X_Detection Elevation Angle
前雷达探测点俯仰角";
CM_ SG_ 997 FRM_26_DetnRelVelRadial_019 "Detection point radial relative velocity
Front Radar Moudle_X_Detection Relative Velocity Radial 
前雷达探测点在径向上的相对速度";
CM_ SG_ 997 FRM_26_DetnSNR_019 "Detection point signal noise ratio
Front Radar Moudle_X_Detection Signal Noise Ratio
前雷达探测点信号噪声比";
CM_ SG_ 997 FRM_26_DetnRCS_019 "Detection point radar cross section
Front Radar Moudle_X_Detection Radar Cross Section
前雷达探测点雷达散射截面积";
CM_ SG_ 997 FRM_26_DetnQuality_019 "Detection point quality
Front Radar Moudle_X_Detection Quality
前雷达探测点质量";
CM_ SG_ 997 FRM_26_DetnMotionSts_020 "Detection point motion status
Front Radar Moudle_X_Detection Motion Status
前雷达探测点运动状态";
CM_ SG_ 997 FRM_26_DetnRngRadial_020 "Detection point radial distance
Front Radar Moudle_X_Detection Range Radial
前雷达探测点径向距离";
CM_ SG_ 997 FRM_26_DetnAziAngle_020 "Detection point azimuth angle
Front Radar Moudle_X_Detection Azimuth Angle
前雷达探测点水平方位角";
CM_ SG_ 997 FRM_26_DetnElevnAngle_020 "Detection point elevation angle
Front Radar Moudle_X_Detection Elevation Angle
前雷达探测点俯仰角";
CM_ SG_ 997 FRM_26_DetnRelVelRadial_020 "Detection point radial relative velocity
Front Radar Moudle_X_Detection Relative Velocity Radial 
前雷达探测点在径向上的相对速度";
CM_ SG_ 997 FRM_26_DetnSNR_020 "Detection point signal noise ratio
Front Radar Moudle_X_Detection Signal Noise Ratio
前雷达探测点信号噪声比";
CM_ SG_ 997 FRM_26_DetnRCS_020 "Detection point radar cross section
Front Radar Moudle_X_Detection Radar Cross Section
前雷达探测点雷达散射截面积";
CM_ SG_ 997 FRM_26_DetnQuality_020 "Detection point quality
Front Radar Moudle_X_Detection Quality
前雷达探测点质量";
CM_ SG_ 997 FRM_26_DetnMotionSts_021 "Detection point motion status
Front Radar Moudle_X_Detection Motion Status
前雷达探测点运动状态";
CM_ SG_ 997 FRM_26_DetnRngRadial_021 "Detection point radial distance
Front Radar Moudle_X_Detection Range Radial
前雷达探测点径向距离";
CM_ SG_ 997 FRM_26_DetnAziAngle_021 "Detection point azimuth angle
Front Radar Moudle_X_Detection Azimuth Angle
前雷达探测点水平方位角";
CM_ SG_ 997 FRM_26_DetnElevnAngle_021 "Detection point elevation angle
Front Radar Moudle_X_Detection Elevation Angle
前雷达探测点俯仰角";
CM_ SG_ 997 FRM_26_DetnRelVelRadial_021 "Detection point radial relative velocity
Front Radar Moudle_X_Detection Relative Velocity Radial 
前雷达探测点在径向上的相对速度";
CM_ SG_ 997 FRM_26_DetnSNR_021 "Detection point signal noise ratio
Front Radar Moudle_X_Detection Signal Noise Ratio
前雷达探测点信号噪声比";
CM_ SG_ 997 FRM_26_DetnRCS_021 "Detection point radar cross section
Front Radar Moudle_X_Detection Radar Cross Section
前雷达探测点雷达散射截面积";
CM_ SG_ 997 FRM_26_DetnQuality_021 "Detection point quality
Front Radar Moudle_X_Detection Quality
前雷达探测点质量";
CM_ SG_ 997 FRM_26_DetnMotionSts_022 "Detection point motion status
Front Radar Moudle_X_Detection Motion Status
前雷达探测点运动状态";
CM_ SG_ 997 FRM_26_DetnRngRadial_022 "Detection point radial distance
Front Radar Moudle_X_Detection Range Radial
前雷达探测点径向距离";
CM_ SG_ 997 FRM_26_DetnAziAngle_022 "Detection point azimuth angle
Front Radar Moudle_X_Detection Azimuth Angle
前雷达探测点水平方位角";
CM_ SG_ 997 FRM_26_DetnElevnAngle_022 "Detection point elevation angle
Front Radar Moudle_X_Detection Elevation Angle
前雷达探测点俯仰角";
CM_ SG_ 997 FRM_26_DetnRelVelRadial_022 "Detection point radial relative velocity
Front Radar Moudle_X_Detection Relative Velocity Radial 
前雷达探测点在径向上的相对速度";
CM_ SG_ 997 FRM_26_DetnSNR_022 "Detection point signal noise ratio
Front Radar Moudle_X_Detection Signal Noise Ratio
前雷达探测点信号噪声比";
CM_ SG_ 997 FRM_26_DetnRCS_022 "Detection point radar cross section
Front Radar Moudle_X_Detection Radar Cross Section
前雷达探测点雷达散射截面积";
CM_ SG_ 997 FRM_26_DetnQuality_022 "Detection point quality
Front Radar Moudle_X_Detection Quality
前雷达探测点质量";
CM_ SG_ 997 FRM_26_DetnMotionSts_023 "Detection point motion status
Front Radar Moudle_X_Detection Motion Status
前雷达探测点运动状态";
CM_ SG_ 997 FRM_26_DetnRngRadial_023 "Detection point radial distance
Front Radar Moudle_X_Detection Range Radial
前雷达探测点径向距离";
CM_ SG_ 997 FRM_26_DetnAziAngle_023 "Detection point azimuth angle
Front Radar Moudle_X_Detection Azimuth Angle
前雷达探测点水平方位角";
CM_ SG_ 997 FRM_26_DetnElevnAngle_023 "Detection point elevation angle
Front Radar Moudle_X_Detection Elevation Angle
前雷达探测点俯仰角";
CM_ SG_ 997 FRM_26_DetnRelVelRadial_023 "Detection point radial relative velocity
Front Radar Moudle_X_Detection Relative Velocity Radial 
前雷达探测点在径向上的相对速度";
CM_ SG_ 997 FRM_26_DetnSNR_023 "Detection point signal noise ratio
Front Radar Moudle_X_Detection Signal Noise Ratio
前雷达探测点信号噪声比";
CM_ SG_ 997 FRM_26_DetnRCS_023 "Detection point radar cross section
Front Radar Moudle_X_Detection Radar Cross Section
前雷达探测点雷达散射截面积";
CM_ SG_ 997 FRM_26_DetnQuality_023 "Detection point quality
Front Radar Moudle_X_Detection Quality
前雷达探测点质量";
CM_ SG_ 997 FRM_26_Loc018_Valid "the valid flag of each location";
CM_ SG_ 997 FRM_26_Loc019_Valid "the valid flag of each location";
CM_ SG_ 997 FRM_26_Loc020_Valid "the valid flag of each location";
CM_ SG_ 997 FRM_26_Loc021_Valid "the valid flag of each location";
CM_ SG_ 997 FRM_26_Loc022_Valid "the valid flag of each location";
CM_ SG_ 997 FRM_26_Loc023_Valid "the valid flag of each location";
CM_ SG_ 998 FRM_27_CRC "Profile5:E2E CRC16 (polynomial:0x1021)       
DataID:Use CANID,other bits Fill with 0";
CM_ SG_ 998 FRM_27_RollgCntr "Profile5:E2E Rolling message counter";
CM_ SG_ 998 FRM_27_DetnBlockCounter "Front Radar Moudle_X_Detection Block Counter
前雷达探测点块计数";
CM_ SG_ 998 FRM_27_DetnMotionSts_024 "Detection point motion status
Front Radar Moudle_X_Detection Motion Status
前雷达探测点运动状态";
CM_ SG_ 998 FRM_27_DetnRngRadial_024 "Detection point radial distance
Front Radar Moudle_X_Detection Range Radial
前雷达探测点径向距离";
CM_ SG_ 998 FRM_27_DetnAziAngle_024 "Detection point azimuth angle
Front Radar Moudle_X_Detection Azimuth Angle
前雷达探测点水平方位角";
CM_ SG_ 998 FRM_27_DetnElevnAngle_024 "Detection point elevation angle
Front Radar Moudle_X_Detection Elevation Angle
前雷达探测点俯仰角";
CM_ SG_ 998 FRM_27_DetnRelVelRadial_024 "Detection point radial relative velocity
Front Radar Moudle_X_Detection Relative Velocity Radial 
前雷达探测点在径向上的相对速度";
CM_ SG_ 998 FRM_27_DetnSNR_024 "Detection point signal noise ratio
Front Radar Moudle_X_Detection Signal Noise Ratio
前雷达探测点信号噪声比";
CM_ SG_ 998 FRM_27_DetnRCS_024 "Detection point radar cross section
Front Radar Moudle_X_Detection Radar Cross Section
前雷达探测点雷达散射截面积";
CM_ SG_ 998 FRM_27_DetnQuality_024 "Detection point quality
Front Radar Moudle_X_Detection Quality
前雷达探测点质量";
CM_ SG_ 998 FRM_27_DetnMotionSts_025 "Detection point motion status
Front Radar Moudle_X_Detection Motion Status
前雷达探测点运动状态";
CM_ SG_ 998 FRM_27_DetnRngRadial_025 "Detection point radial distance
Front Radar Moudle_X_Detection Range Radial
前雷达探测点径向距离";
CM_ SG_ 998 FRM_27_DetnAziAngle_025 "Detection point azimuth angle
Front Radar Moudle_X_Detection Azimuth Angle
前雷达探测点水平方位角";
CM_ SG_ 998 FRM_27_DetnElevnAngle_025 "Detection point elevation angle
Front Radar Moudle_X_Detection Elevation Angle
前雷达探测点俯仰角";
CM_ SG_ 998 FRM_27_DetnRelVelRadial_025 "Detection point radial relative velocity
Front Radar Moudle_X_Detection Relative Velocity Radial 
前雷达探测点在径向上的相对速度";
CM_ SG_ 998 FRM_27_DetnSNR_025 "Detection point signal noise ratio
Front Radar Moudle_X_Detection Signal Noise Ratio
前雷达探测点信号噪声比";
CM_ SG_ 998 FRM_27_DetnRCS_025 "Detection point radar cross section
Front Radar Moudle_X_Detection Radar Cross Section
前雷达探测点雷达散射截面积";
CM_ SG_ 998 FRM_27_DetnQuality_025 "Detection point quality
Front Radar Moudle_X_Detection Quality
前雷达探测点质量";
CM_ SG_ 998 FRM_27_DetnMotionSts_026 "Detection point motion status
Front Radar Moudle_X_Detection Motion Status
前雷达探测点运动状态";
CM_ SG_ 998 FRM_27_DetnRngRadial_026 "Detection point radial distance
Front Radar Moudle_X_Detection Range Radial
前雷达探测点径向距离";
CM_ SG_ 998 FRM_27_DetnAziAngle_026 "Detection point azimuth angle
Front Radar Moudle_X_Detection Azimuth Angle
前雷达探测点水平方位角";
CM_ SG_ 998 FRM_27_DetnElevnAngle_026 "Detection point elevation angle
Front Radar Moudle_X_Detection Elevation Angle
前雷达探测点俯仰角";
CM_ SG_ 998 FRM_27_DetnRelVelRadial_026 "Detection point radial relative velocity
Front Radar Moudle_X_Detection Relative Velocity Radial 
前雷达探测点在径向上的相对速度";
CM_ SG_ 998 FRM_27_DetnSNR_026 "Detection point signal noise ratio
Front Radar Moudle_X_Detection Signal Noise Ratio
前雷达探测点信号噪声比";
CM_ SG_ 998 FRM_27_DetnRCS_026 "Detection point radar cross section
Front Radar Moudle_X_Detection Radar Cross Section
前雷达探测点雷达散射截面积";
CM_ SG_ 998 FRM_27_DetnQuality_026 "Detection point quality
Front Radar Moudle_X_Detection Quality
前雷达探测点质量";
CM_ SG_ 998 FRM_27_DetnMotionSts_027 "Detection point motion status
Front Radar Moudle_X_Detection Motion Status
前雷达探测点运动状态";
CM_ SG_ 998 FRM_27_DetnRngRadial_027 "Detection point radial distance
Front Radar Moudle_X_Detection Range Radial
前雷达探测点径向距离";
CM_ SG_ 998 FRM_27_DetnAziAngle_027 "Detection point azimuth angle
Front Radar Moudle_X_Detection Azimuth Angle
前雷达探测点水平方位角";
CM_ SG_ 998 FRM_27_DetnElevnAngle_027 "Detection point elevation angle
Front Radar Moudle_X_Detection Elevation Angle
前雷达探测点俯仰角";
CM_ SG_ 998 FRM_27_DetnRelVelRadial_027 "Detection point radial relative velocity
Front Radar Moudle_X_Detection Relative Velocity Radial 
前雷达探测点在径向上的相对速度";
CM_ SG_ 998 FRM_27_DetnSNR_027 "Detection point signal noise ratio
Front Radar Moudle_X_Detection Signal Noise Ratio
前雷达探测点信号噪声比";
CM_ SG_ 998 FRM_27_DetnRCS_027 "Detection point radar cross section
Front Radar Moudle_X_Detection Radar Cross Section
前雷达探测点雷达散射截面积";
CM_ SG_ 998 FRM_27_DetnQuality_027 "Detection point quality
Front Radar Moudle_X_Detection Quality
前雷达探测点质量";
CM_ SG_ 998 FRM_27_DetnMotionSts_028 "Detection point motion status
Front Radar Moudle_X_Detection Motion Status
前雷达探测点运动状态";
CM_ SG_ 998 FRM_27_DetnRngRadial_028 "Detection point radial distance
Front Radar Moudle_X_Detection Range Radial
前雷达探测点径向距离";
CM_ SG_ 998 FRM_27_DetnAziAngle_028 "Detection point azimuth angle
Front Radar Moudle_X_Detection Azimuth Angle
前雷达探测点水平方位角";
CM_ SG_ 998 FRM_27_DetnElevnAngle_028 "Detection point elevation angle
Front Radar Moudle_X_Detection Elevation Angle
前雷达探测点俯仰角";
CM_ SG_ 998 FRM_27_DetnRelVelRadial_028 "Detection point radial relative velocity
Front Radar Moudle_X_Detection Relative Velocity Radial 
前雷达探测点在径向上的相对速度";
CM_ SG_ 998 FRM_27_DetnSNR_028 "Detection point signal noise ratio
Front Radar Moudle_X_Detection Signal Noise Ratio
前雷达探测点信号噪声比";
CM_ SG_ 998 FRM_27_DetnRCS_028 "Detection point radar cross section
Front Radar Moudle_X_Detection Radar Cross Section
前雷达探测点雷达散射截面积";
CM_ SG_ 998 FRM_27_DetnQuality_028 "Detection point quality
Front Radar Moudle_X_Detection Quality
前雷达探测点质量";
CM_ SG_ 998 FRM_27_DetnMotionSts_029 "Detection point motion status
Front Radar Moudle_X_Detection Motion Status
前雷达探测点运动状态";
CM_ SG_ 998 FRM_27_DetnRngRadial_029 "Detection point radial distance
Front Radar Moudle_X_Detection Range Radial
前雷达探测点径向距离";
CM_ SG_ 998 FRM_27_DetnAziAngle_029 "Detection point azimuth angle
Front Radar Moudle_X_Detection Azimuth Angle
前雷达探测点水平方位角";
CM_ SG_ 998 FRM_27_DetnElevnAngle_029 "Detection point elevation angle
Front Radar Moudle_X_Detection Elevation Angle
前雷达探测点俯仰角";
CM_ SG_ 998 FRM_27_DetnRelVelRadial_029 "Detection point radial relative velocity
Front Radar Moudle_X_Detection Relative Velocity Radial 
前雷达探测点在径向上的相对速度";
CM_ SG_ 998 FRM_27_DetnSNR_029 "Detection point signal noise ratio
Front Radar Moudle_X_Detection Signal Noise Ratio
前雷达探测点信号噪声比";
CM_ SG_ 998 FRM_27_DetnRCS_029 "Detection point radar cross section
Front Radar Moudle_X_Detection Radar Cross Section
前雷达探测点雷达散射截面积";
CM_ SG_ 998 FRM_27_DetnQuality_029 "Detection point quality
Front Radar Moudle_X_Detection Quality
前雷达探测点质量";
CM_ SG_ 998 FRM_27_Loc024_Valid "the valid flag of each location";
CM_ SG_ 998 FRM_27_Loc025_Valid "the valid flag of each location";
CM_ SG_ 998 FRM_27_Loc026_Valid "the valid flag of each location";
CM_ SG_ 998 FRM_27_Loc027_Valid "the valid flag of each location";
CM_ SG_ 998 FRM_27_Loc028_Valid "the valid flag of each location";
CM_ SG_ 998 FRM_27_Loc029_Valid "the valid flag of each location";
CM_ SG_ 999 FRM_28_CRC "Profile5:E2E CRC16 (polynomial:0x1021)       
DataID:Use CANID,other bits Fill with 0";
CM_ SG_ 999 FRM_28_RollgCntr "Profile5:E2E Rolling message counter";
CM_ SG_ 999 FRM_28_DetnBlockCounter "Front Radar Moudle_X_Detection Block Counter
前雷达探测点块计数";
CM_ SG_ 999 FRM_28_DetnMotionSts_030 "Detection point motion status
Front Radar Moudle_X_Detection Motion Status
前雷达探测点运动状态";
CM_ SG_ 999 FRM_28_DetnRngRadial_030 "Detection point radial distance
Front Radar Moudle_X_Detection Range Radial
前雷达探测点径向距离";
CM_ SG_ 999 FRM_28_DetnAziAngle_030 "Detection point azimuth angle
Front Radar Moudle_X_Detection Azimuth Angle
前雷达探测点水平方位角";
CM_ SG_ 999 FRM_28_DetnElevnAngle_030 "Detection point elevation angle
Front Radar Moudle_X_Detection Elevation Angle
前雷达探测点俯仰角";
CM_ SG_ 999 FRM_28_DetnRelVelRadial_030 "Detection point radial relative velocity
Front Radar Moudle_X_Detection Relative Velocity Radial 
前雷达探测点在径向上的相对速度";
CM_ SG_ 999 FRM_28_DetnSNR_030 "Detection point signal noise ratio
Front Radar Moudle_X_Detection Signal Noise Ratio
前雷达探测点信号噪声比";
CM_ SG_ 999 FRM_28_DetnRCS_030 "Detection point radar cross section
Front Radar Moudle_X_Detection Radar Cross Section
前雷达探测点雷达散射截面积";
CM_ SG_ 999 FRM_28_DetnQuality_030 "Detection point quality
Front Radar Moudle_X_Detection Quality
前雷达探测点质量";
CM_ SG_ 999 FRM_28_DetnMotionSts_031 "Detection point motion status
Front Radar Moudle_X_Detection Motion Status
前雷达探测点运动状态";
CM_ SG_ 999 FRM_28_DetnRngRadial_031 "Detection point radial distance
Front Radar Moudle_X_Detection Range Radial
前雷达探测点径向距离";
CM_ SG_ 999 FRM_28_DetnAziAngle_031 "Detection point azimuth angle
Front Radar Moudle_X_Detection Azimuth Angle
前雷达探测点水平方位角";
CM_ SG_ 999 FRM_28_DetnElevnAngle_031 "Detection point elevation angle
Front Radar Moudle_X_Detection Elevation Angle
前雷达探测点俯仰角";
CM_ SG_ 999 FRM_28_DetnRelVelRadial_031 "Detection point radial relative velocity
Front Radar Moudle_X_Detection Relative Velocity Radial 
前雷达探测点在径向上的相对速度";
CM_ SG_ 999 FRM_28_DetnSNR_031 "Detection point signal noise ratio
Front Radar Moudle_X_Detection Signal Noise Ratio
前雷达探测点信号噪声比";
CM_ SG_ 999 FRM_28_DetnRCS_031 "Detection point radar cross section
Front Radar Moudle_X_Detection Radar Cross Section
前雷达探测点雷达散射截面积";
CM_ SG_ 999 FRM_28_DetnQuality_031 "Detection point quality
Front Radar Moudle_X_Detection Quality
前雷达探测点质量";
CM_ SG_ 999 FRM_28_DetnMotionSts_032 "Detection point motion status
Front Radar Moudle_X_Detection Motion Status
前雷达探测点运动状态";
CM_ SG_ 999 FRM_28_DetnRngRadial_032 "Detection point radial distance
Front Radar Moudle_X_Detection Range Radial
前雷达探测点径向距离";
CM_ SG_ 999 FRM_28_DetnAziAngle_032 "Detection point azimuth angle
Front Radar Moudle_X_Detection Azimuth Angle
前雷达探测点水平方位角";
CM_ SG_ 999 FRM_28_DetnElevnAngle_032 "Detection point elevation angle
Front Radar Moudle_X_Detection Elevation Angle
前雷达探测点俯仰角";
CM_ SG_ 999 FRM_28_DetnRelVelRadial_032 "Detection point radial relative velocity
Front Radar Moudle_X_Detection Relative Velocity Radial 
前雷达探测点在径向上的相对速度";
CM_ SG_ 999 FRM_28_DetnSNR_032 "Detection point signal noise ratio
Front Radar Moudle_X_Detection Signal Noise Ratio
前雷达探测点信号噪声比";
CM_ SG_ 999 FRM_28_DetnRCS_032 "Detection point radar cross section
Front Radar Moudle_X_Detection Radar Cross Section
前雷达探测点雷达散射截面积";
CM_ SG_ 999 FRM_28_DetnQuality_032 "Detection point quality
Front Radar Moudle_X_Detection Quality
前雷达探测点质量";
CM_ SG_ 999 FRM_28_DetnMotionSts_033 "Detection point motion status
Front Radar Moudle_X_Detection Motion Status
前雷达探测点运动状态";
CM_ SG_ 999 FRM_28_DetnRngRadial_033 "Detection point radial distance
Front Radar Moudle_X_Detection Range Radial
前雷达探测点径向距离";
CM_ SG_ 999 FRM_28_DetnAziAngle_033 "Detection point azimuth angle
Front Radar Moudle_X_Detection Azimuth Angle
前雷达探测点水平方位角";
CM_ SG_ 999 FRM_28_DetnElevnAngle_033 "Detection point elevation angle
Front Radar Moudle_X_Detection Elevation Angle
前雷达探测点俯仰角";
CM_ SG_ 999 FRM_28_DetnRelVelRadial_033 "Detection point radial relative velocity
Front Radar Moudle_X_Detection Relative Velocity Radial 
前雷达探测点在径向上的相对速度";
CM_ SG_ 999 FRM_28_DetnSNR_033 "Detection point signal noise ratio
Front Radar Moudle_X_Detection Signal Noise Ratio
前雷达探测点信号噪声比";
CM_ SG_ 999 FRM_28_DetnRCS_033 "Detection point radar cross section
Front Radar Moudle_X_Detection Radar Cross Section
前雷达探测点雷达散射截面积";
CM_ SG_ 999 FRM_28_DetnQuality_033 "Detection point quality
Front Radar Moudle_X_Detection Quality
前雷达探测点质量";
CM_ SG_ 999 FRM_28_DetnMotionSts_034 "Detection point motion status
Front Radar Moudle_X_Detection Motion Status
前雷达探测点运动状态";
CM_ SG_ 999 FRM_28_DetnRngRadial_034 "Detection point radial distance
Front Radar Moudle_X_Detection Range Radial
前雷达探测点径向距离";
CM_ SG_ 999 FRM_28_DetnAziAngle_034 "Detection point azimuth angle
Front Radar Moudle_X_Detection Azimuth Angle
前雷达探测点水平方位角";
CM_ SG_ 999 FRM_28_DetnElevnAngle_034 "Detection point elevation angle
Front Radar Moudle_X_Detection Elevation Angle
前雷达探测点俯仰角";
CM_ SG_ 999 FRM_28_DetnRelVelRadial_034 "Detection point radial relative velocity
Front Radar Moudle_X_Detection Relative Velocity Radial 
前雷达探测点在径向上的相对速度";
CM_ SG_ 999 FRM_28_DetnSNR_034 "Detection point signal noise ratio
Front Radar Moudle_X_Detection Signal Noise Ratio
前雷达探测点信号噪声比";
CM_ SG_ 999 FRM_28_DetnRCS_034 "Detection point radar cross section
Front Radar Moudle_X_Detection Radar Cross Section
前雷达探测点雷达散射截面积";
CM_ SG_ 999 FRM_28_DetnQuality_034 "Detection point quality
Front Radar Moudle_X_Detection Quality
前雷达探测点质量";
CM_ SG_ 999 FRM_28_DetnMotionSts_035 "Detection point motion status
Front Radar Moudle_X_Detection Motion Status
前雷达探测点运动状态";
CM_ SG_ 999 FRM_28_DetnRngRadial_035 "Detection point radial distance
Front Radar Moudle_X_Detection Range Radial
前雷达探测点径向距离";
CM_ SG_ 999 FRM_28_DetnAziAngle_035 "Detection point azimuth angle
Front Radar Moudle_X_Detection Azimuth Angle
前雷达探测点水平方位角";
CM_ SG_ 999 FRM_28_DetnElevnAngle_035 "Detection point elevation angle
Front Radar Moudle_X_Detection Elevation Angle
前雷达探测点俯仰角";
CM_ SG_ 999 FRM_28_DetnRelVelRadial_035 "Detection point radial relative velocity
Front Radar Moudle_X_Detection Relative Velocity Radial 
前雷达探测点在径向上的相对速度";
CM_ SG_ 999 FRM_28_DetnSNR_035 "Detection point signal noise ratio
Front Radar Moudle_X_Detection Signal Noise Ratio
前雷达探测点信号噪声比";
CM_ SG_ 999 FRM_28_DetnRCS_035 "Detection point radar cross section
Front Radar Moudle_X_Detection Radar Cross Section
前雷达探测点雷达散射截面积";
CM_ SG_ 999 FRM_28_DetnQuality_035 "Detection point quality
Front Radar Moudle_X_Detection Quality
前雷达探测点质量";
CM_ SG_ 999 FRM_28_Loc030_Valid "the valid flag of each location";
CM_ SG_ 999 FRM_28_Loc031_Valid "the valid flag of each location";
CM_ SG_ 999 FRM_28_Loc032_Valid "the valid flag of each location";
CM_ SG_ 999 FRM_28_Loc033_Valid "the valid flag of each location";
CM_ SG_ 999 FRM_28_Loc034_Valid "the valid flag of each location";
CM_ SG_ 999 FRM_28_Loc035_Valid "the valid flag of each location";
CM_ SG_ 1000 FRM_29_CRC "Profile5:E2E CRC16 (polynomial:0x1021)       
DataID:Use CANID,other bits Fill with 0";
CM_ SG_ 1000 FRM_29_RollgCntr "Profile5:E2E Rolling message counter";
CM_ SG_ 1000 FRM_29_DetnBlockCounter "Front Radar Moudle_X_Detection Block Counter
前雷达探测点块计数";
CM_ SG_ 1000 FRM_29_DetnMotionSts_036 "Detection point motion status
Front Radar Moudle_X_Detection Motion Status
前雷达探测点运动状态";
CM_ SG_ 1000 FRM_29_DetnRngRadial_036 "Detection point radial distance
Front Radar Moudle_X_Detection Range Radial
前雷达探测点径向距离";
CM_ SG_ 1000 FRM_29_DetnAziAngle_036 "Detection point azimuth angle
Front Radar Moudle_X_Detection Azimuth Angle
前雷达探测点水平方位角";
CM_ SG_ 1000 FRM_29_DetnElevnAngle_036 "Detection point elevation angle
Front Radar Moudle_X_Detection Elevation Angle
前雷达探测点俯仰角";
CM_ SG_ 1000 FRM_29_DetnRelVelRadial_036 "Detection point radial relative velocity
Front Radar Moudle_X_Detection Relative Velocity Radial 
前雷达探测点在径向上的相对速度";
CM_ SG_ 1000 FRM_29_DetnSNR_036 "Detection point signal noise ratio
Front Radar Moudle_X_Detection Signal Noise Ratio
前雷达探测点信号噪声比";
CM_ SG_ 1000 FRM_29_DetnRCS_036 "Detection point radar cross section
Front Radar Moudle_X_Detection Radar Cross Section
前雷达探测点雷达散射截面积";
CM_ SG_ 1000 FRM_29_DetnQuality_036 "Detection point quality
Front Radar Moudle_X_Detection Quality
前雷达探测点质量";
CM_ SG_ 1000 FRM_29_DetnMotionSts_037 "Detection point motion status
Front Radar Moudle_X_Detection Motion Status
前雷达探测点运动状态";
CM_ SG_ 1000 FRM_29_DetnRngRadial_037 "Detection point radial distance
Front Radar Moudle_X_Detection Range Radial
前雷达探测点径向距离";
CM_ SG_ 1000 FRM_29_DetnAziAngle_037 "Detection point azimuth angle
Front Radar Moudle_X_Detection Azimuth Angle
前雷达探测点水平方位角";
CM_ SG_ 1000 FRM_29_DetnElevnAngle_037 "Detection point elevation angle
Front Radar Moudle_X_Detection Elevation Angle
前雷达探测点俯仰角";
CM_ SG_ 1000 FRM_29_DetnRelVelRadial_037 "Detection point radial relative velocity
Front Radar Moudle_X_Detection Relative Velocity Radial 
前雷达探测点在径向上的相对速度";
CM_ SG_ 1000 FRM_29_DetnSNR_037 "Detection point signal noise ratio
Front Radar Moudle_X_Detection Signal Noise Ratio
前雷达探测点信号噪声比";
CM_ SG_ 1000 FRM_29_DetnRCS_037 "Detection point radar cross section
Front Radar Moudle_X_Detection Radar Cross Section
前雷达探测点雷达散射截面积";
CM_ SG_ 1000 FRM_29_DetnQuality_037 "Detection point quality
Front Radar Moudle_X_Detection Quality
前雷达探测点质量";
CM_ SG_ 1000 FRM_29_DetnMotionSts_038 "Detection point motion status
Front Radar Moudle_X_Detection Motion Status
前雷达探测点运动状态";
CM_ SG_ 1000 FRM_29_DetnRngRadial_038 "Detection point radial distance
Front Radar Moudle_X_Detection Range Radial
前雷达探测点径向距离";
CM_ SG_ 1000 FRM_29_DetnAziAngle_038 "Detection point azimuth angle
Front Radar Moudle_X_Detection Azimuth Angle
前雷达探测点水平方位角";
CM_ SG_ 1000 FRM_29_DetnElevnAngle_038 "Detection point elevation angle
Front Radar Moudle_X_Detection Elevation Angle
前雷达探测点俯仰角";
CM_ SG_ 1000 FRM_29_DetnRelVelRadial_038 "Detection point radial relative velocity
Front Radar Moudle_X_Detection Relative Velocity Radial 
前雷达探测点在径向上的相对速度";
CM_ SG_ 1000 FRM_29_DetnSNR_038 "Detection point signal noise ratio
Front Radar Moudle_X_Detection Signal Noise Ratio
前雷达探测点信号噪声比";
CM_ SG_ 1000 FRM_29_DetnRCS_038 "Detection point radar cross section
Front Radar Moudle_X_Detection Radar Cross Section
前雷达探测点雷达散射截面积";
CM_ SG_ 1000 FRM_29_DetnQuality_038 "Detection point quality
Front Radar Moudle_X_Detection Quality
前雷达探测点质量";
CM_ SG_ 1000 FRM_29_DetnMotionSts_039 "Detection point motion status
Front Radar Moudle_X_Detection Motion Status
前雷达探测点运动状态";
CM_ SG_ 1000 FRM_29_DetnRngRadial_039 "Detection point radial distance
Front Radar Moudle_X_Detection Range Radial
前雷达探测点径向距离";
CM_ SG_ 1000 FRM_29_DetnAziAngle_039 "Detection point azimuth angle
Front Radar Moudle_X_Detection Azimuth Angle
前雷达探测点水平方位角";
CM_ SG_ 1000 FRM_29_DetnElevnAngle_039 "Detection point elevation angle
Front Radar Moudle_X_Detection Elevation Angle
前雷达探测点俯仰角";
CM_ SG_ 1000 FRM_29_DetnRelVelRadial_039 "Detection point radial relative velocity
Front Radar Moudle_X_Detection Relative Velocity Radial 
前雷达探测点在径向上的相对速度";
CM_ SG_ 1000 FRM_29_DetnSNR_039 "Detection point signal noise ratio
Front Radar Moudle_X_Detection Signal Noise Ratio
前雷达探测点信号噪声比";
CM_ SG_ 1000 FRM_29_DetnRCS_039 "Detection point radar cross section
Front Radar Moudle_X_Detection Radar Cross Section
前雷达探测点雷达散射截面积";
CM_ SG_ 1000 FRM_29_DetnQuality_039 "Detection point quality
Front Radar Moudle_X_Detection Quality
前雷达探测点质量";
CM_ SG_ 1000 FRM_29_DetnMotionSts_040 "Detection point motion status
Front Radar Moudle_X_Detection Motion Status
前雷达探测点运动状态";
CM_ SG_ 1000 FRM_29_DetnRngRadial_040 "Detection point radial distance
Front Radar Moudle_X_Detection Range Radial
前雷达探测点径向距离";
CM_ SG_ 1000 FRM_29_DetnAziAngle_040 "Detection point azimuth angle
Front Radar Moudle_X_Detection Azimuth Angle
前雷达探测点水平方位角";
CM_ SG_ 1000 FRM_29_DetnElevnAngle_040 "Detection point elevation angle
Front Radar Moudle_X_Detection Elevation Angle
前雷达探测点俯仰角";
CM_ SG_ 1000 FRM_29_DetnRelVelRadial_040 "Detection point radial relative velocity
Front Radar Moudle_X_Detection Relative Velocity Radial 
前雷达探测点在径向上的相对速度";
CM_ SG_ 1000 FRM_29_DetnSNR_040 "Detection point signal noise ratio
Front Radar Moudle_X_Detection Signal Noise Ratio
前雷达探测点信号噪声比";
CM_ SG_ 1000 FRM_29_DetnRCS_040 "Detection point radar cross section
Front Radar Moudle_X_Detection Radar Cross Section
前雷达探测点雷达散射截面积";
CM_ SG_ 1000 FRM_29_DetnQuality_040 "Detection point quality
Front Radar Moudle_X_Detection Quality
前雷达探测点质量";
CM_ SG_ 1000 FRM_29_DetnMotionSts_041 "Detection point motion status
Front Radar Moudle_X_Detection Motion Status
前雷达探测点运动状态";
CM_ SG_ 1000 FRM_29_DetnRngRadial_041 "Detection point radial distance
Front Radar Moudle_X_Detection Range Radial
前雷达探测点径向距离";
CM_ SG_ 1000 FRM_29_DetnAziAngle_041 "Detection point azimuth angle
Front Radar Moudle_X_Detection Azimuth Angle
前雷达探测点水平方位角";
CM_ SG_ 1000 FRM_29_DetnElevnAngle_041 "Detection point elevation angle
Front Radar Moudle_X_Detection Elevation Angle
前雷达探测点俯仰角";
CM_ SG_ 1000 FRM_29_DetnRelVelRadial_041 "Detection point radial relative velocity
Front Radar Moudle_X_Detection Relative Velocity Radial 
前雷达探测点在径向上的相对速度";
CM_ SG_ 1000 FRM_29_DetnSNR_041 "Detection point signal noise ratio
Front Radar Moudle_X_Detection Signal Noise Ratio
前雷达探测点信号噪声比";
CM_ SG_ 1000 FRM_29_DetnRCS_041 "Detection point radar cross section
Front Radar Moudle_X_Detection Radar Cross Section
前雷达探测点雷达散射截面积";
CM_ SG_ 1000 FRM_29_DetnQuality_041 "Detection point quality
Front Radar Moudle_X_Detection Quality
前雷达探测点质量";
CM_ SG_ 1000 FRM_29_Loc036_Valid "the valid flag of each location 
每一点云的有效状态";
CM_ SG_ 1000 FRM_29_Loc037_Valid "the valid flag of each location 
每一点云的有效状态";
CM_ SG_ 1000 FRM_29_Loc038_Valid "the valid flag of each location 
每一点云的有效状态";
CM_ SG_ 1000 FRM_29_Loc039_Valid "the valid flag of each location 
每一点云的有效状态";
CM_ SG_ 1000 FRM_29_Loc040_Valid "the valid flag of each location 
每一点云的有效状态";
CM_ SG_ 1000 FRM_29_Loc041_Valid "the valid flag of each location 
每一点云的有效状态";
CM_ SG_ 1001 FRM_30_CRC "Profile5:E2E CRC16 (polynomial:0x1021)       
DataID:Use CANID,other bits Fill with 0";
CM_ SG_ 1001 FRM_30_RollgCntr "Profile5:E2E Rolling message counter";
CM_ SG_ 1001 FRM_30_DetnBlockCounter "Front Radar Moudle_X_Detection Block Counter
前雷达探测点块计数";
CM_ SG_ 1001 FRM_30_DetnMotionSts_042 "Detection point motion status
Front Radar Moudle_X_Detection Motion Status
前雷达探测点运动状态";
CM_ SG_ 1001 FRM_30_DetnRngRadial_042 "Detection point radial distance
Front Radar Moudle_X_Detection Range Radial
前雷达探测点径向距离";
CM_ SG_ 1001 FRM_30_DetnAziAngle_042 "Detection point azimuth angle
Front Radar Moudle_X_Detection Azimuth Angle
前雷达探测点水平方位角";
CM_ SG_ 1001 FRM_30_DetnElevnAngle_042 "Detection point elevation angle
Front Radar Moudle_X_Detection Elevation Angle
前雷达探测点俯仰角";
CM_ SG_ 1001 FRM_30_DetnRelVelRadial_042 "Detection point radial relative velocity
Front Radar Moudle_X_Detection Relative Velocity Radial 
前雷达探测点在径向上的相对速度";
CM_ SG_ 1001 FRM_30_DetnSNR_042 "Detection point signal noise ratio
Front Radar Moudle_X_Detection Signal Noise Ratio
前雷达探测点信号噪声比";
CM_ SG_ 1001 FRM_30_DetnRCS_042 "Detection point radar cross section
Front Radar Moudle_X_Detection Radar Cross Section
前雷达探测点雷达散射截面积";
CM_ SG_ 1001 FRM_30_DetnQuality_042 "Detection point quality
Front Radar Moudle_X_Detection Quality
前雷达探测点质量";
CM_ SG_ 1001 FRM_30_DetnMotionSts_043 "Detection point motion status
Front Radar Moudle_X_Detection Motion Status
前雷达探测点运动状态";
CM_ SG_ 1001 FRM_30_DetnRngRadial_043 "Detection point radial distance
Front Radar Moudle_X_Detection Range Radial
前雷达探测点径向距离";
CM_ SG_ 1001 FRM_30_DetnAziAngle_043 "Detection point azimuth angle
Front Radar Moudle_X_Detection Azimuth Angle
前雷达探测点水平方位角";
CM_ SG_ 1001 FRM_30_DetnElevnAngle_043 "Detection point elevation angle
Front Radar Moudle_X_Detection Elevation Angle
前雷达探测点俯仰角";
CM_ SG_ 1001 FRM_30_DetnRelVelRadial_043 "Detection point radial relative velocity
Front Radar Moudle_X_Detection Relative Velocity Radial 
前雷达探测点在径向上的相对速度";
CM_ SG_ 1001 FRM_30_DetnSNR_043 "Detection point signal noise ratio
Front Radar Moudle_X_Detection Signal Noise Ratio
前雷达探测点信号噪声比";
CM_ SG_ 1001 FRM_30_DetnRCS_043 "Detection point radar cross section
Front Radar Moudle_X_Detection Radar Cross Section
前雷达探测点雷达散射截面积";
CM_ SG_ 1001 FRM_30_DetnQuality_043 "Detection point quality
Front Radar Moudle_X_Detection Quality
前雷达探测点质量";
CM_ SG_ 1001 FRM_30_DetnMotionSts_044 "Detection point motion status
Front Radar Moudle_X_Detection Motion Status
前雷达探测点运动状态";
CM_ SG_ 1001 FRM_30_DetnRngRadial_044 "Detection point radial distance
Front Radar Moudle_X_Detection Range Radial
前雷达探测点径向距离";
CM_ SG_ 1001 FRM_30_DetnAziAngle_044 "Detection point azimuth angle
Front Radar Moudle_X_Detection Azimuth Angle
前雷达探测点水平方位角";
CM_ SG_ 1001 FRM_30_DetnElevnAngle_044 "Detection point elevation angle
Front Radar Moudle_X_Detection Elevation Angle
前雷达探测点俯仰角";
CM_ SG_ 1001 FRM_30_DetnRelVelRadial_044 "Detection point radial relative velocity
Front Radar Moudle_X_Detection Relative Velocity Radial 
前雷达探测点在径向上的相对速度";
CM_ SG_ 1001 FRM_30_DetnSNR_044 "Detection point signal noise ratio
Front Radar Moudle_X_Detection Signal Noise Ratio
前雷达探测点信号噪声比";
CM_ SG_ 1001 FRM_30_DetnRCS_044 "Detection point radar cross section
Front Radar Moudle_X_Detection Radar Cross Section
前雷达探测点雷达散射截面积";
CM_ SG_ 1001 FRM_30_DetnQuality_044 "Detection point quality
Front Radar Moudle_X_Detection Quality
前雷达探测点质量";
CM_ SG_ 1001 FRM_30_DetnMotionSts_045 "Detection point motion status
Front Radar Moudle_X_Detection Motion Status
前雷达探测点运动状态";
CM_ SG_ 1001 FRM_30_DetnRngRadial_045 "Detection point radial distance
Front Radar Moudle_X_Detection Range Radial
前雷达探测点径向距离";
CM_ SG_ 1001 FRM_30_DetnAziAngle_045 "Detection point azimuth angle
Front Radar Moudle_X_Detection Azimuth Angle
前雷达探测点水平方位角";
CM_ SG_ 1001 FRM_30_DetnElevnAngle_045 "Detection point elevation angle
Front Radar Moudle_X_Detection Elevation Angle
前雷达探测点俯仰角";
CM_ SG_ 1001 FRM_30_DetnRelVelRadial_045 "Detection point radial relative velocity
Front Radar Moudle_X_Detection Relative Velocity Radial 
前雷达探测点在径向上的相对速度";
CM_ SG_ 1001 FRM_30_DetnSNR_045 "Detection point signal noise ratio
Front Radar Moudle_X_Detection Signal Noise Ratio
前雷达探测点信号噪声比";
CM_ SG_ 1001 FRM_30_DetnRCS_045 "Detection point radar cross section
Front Radar Moudle_X_Detection Radar Cross Section
前雷达探测点雷达散射截面积";
CM_ SG_ 1001 FRM_30_DetnQuality_045 "Detection point quality
Front Radar Moudle_X_Detection Quality
前雷达探测点质量";
CM_ SG_ 1001 FRM_30_DetnMotionSts_046 "Detection point motion status
Front Radar Moudle_X_Detection Motion Status
前雷达探测点运动状态";
CM_ SG_ 1001 FRM_30_DetnRngRadial_046 "Detection point radial distance
Front Radar Moudle_X_Detection Range Radial
前雷达探测点径向距离";
CM_ SG_ 1001 FRM_30_DetnAziAngle_046 "Detection point azimuth angle
Front Radar Moudle_X_Detection Azimuth Angle
前雷达探测点水平方位角";
CM_ SG_ 1001 FRM_30_DetnElevnAngle_046 "Detection point elevation angle
Front Radar Moudle_X_Detection Elevation Angle
前雷达探测点俯仰角";
CM_ SG_ 1001 FRM_30_DetnRelVelRadial_046 "Detection point radial relative velocity
Front Radar Moudle_X_Detection Relative Velocity Radial 
前雷达探测点在径向上的相对速度";
CM_ SG_ 1001 FRM_30_DetnSNR_046 "Detection point signal noise ratio
Front Radar Moudle_X_Detection Signal Noise Ratio
前雷达探测点信号噪声比";
CM_ SG_ 1001 FRM_30_DetnRCS_046 "Detection point radar cross section
Front Radar Moudle_X_Detection Radar Cross Section
前雷达探测点雷达散射截面积";
CM_ SG_ 1001 FRM_30_DetnQuality_046 "Detection point quality
Front Radar Moudle_X_Detection Quality
前雷达探测点质量";
CM_ SG_ 1001 FRM_30_DetnMotionSts_047 "Detection point motion status
Front Radar Moudle_X_Detection Motion Status
前雷达探测点运动状态";
CM_ SG_ 1001 FRM_30_DetnRngRadial_047 "Detection point radial distance
Front Radar Moudle_X_Detection Range Radial
前雷达探测点径向距离";
CM_ SG_ 1001 FRM_30_DetnAziAngle_047 "Detection point azimuth angle
Front Radar Moudle_X_Detection Azimuth Angle
前雷达探测点水平方位角";
CM_ SG_ 1001 FRM_30_DetnElevnAngle_047 "Detection point elevation angle
Front Radar Moudle_X_Detection Elevation Angle
前雷达探测点俯仰角";
CM_ SG_ 1001 FRM_30_DetnRelVelRadial_047 "Detection point radial relative velocity
Front Radar Moudle_X_Detection Relative Velocity Radial 
前雷达探测点在径向上的相对速度";
CM_ SG_ 1001 FRM_30_DetnSNR_047 "Detection point signal noise ratio
Front Radar Moudle_X_Detection Signal Noise Ratio
前雷达探测点信号噪声比";
CM_ SG_ 1001 FRM_30_DetnRCS_047 "Detection point radar cross section
Front Radar Moudle_X_Detection Radar Cross Section
前雷达探测点雷达散射截面积";
CM_ SG_ 1001 FRM_30_DetnQuality_047 "Detection point quality
Front Radar Moudle_X_Detection Quality
前雷达探测点质量";
CM_ SG_ 1001 FRM_30_Loc042_Valid "the valid flag of each location 
每一点云的有效状态";
CM_ SG_ 1001 FRM_30_Loc043_Valid "the valid flag of each location 
每一点云的有效状态";
CM_ SG_ 1001 FRM_30_Loc044_Valid "the valid flag of each location 
每一点云的有效状态";
CM_ SG_ 1001 FRM_30_Loc045_Valid "the valid flag of each location 
每一点云的有效状态";
CM_ SG_ 1001 FRM_30_Loc046_Valid "the valid flag of each location 
每一点云的有效状态";
CM_ SG_ 1001 FRM_30_Loc047_Valid "the valid flag of each location 
每一点云的有效状态";
CM_ SG_ 1002 FRM_31_CRC "Profile5:E2E CRC16 (polynomial:0x1021)       
DataID:Use CANID,other bits Fill with 0";
CM_ SG_ 1002 FRM_31_RollgCntr "Profile5:E2E Rolling message counter";
CM_ SG_ 1002 FRM_31_DetnBlockCounter "Front Radar Moudle_X_Detection Block Counter
前雷达探测点块计数";
CM_ SG_ 1002 FRM_31_DetnMotionSts_048 "Detection point motion status
Front Radar Moudle_X_Detection Motion Status
前雷达探测点运动状态";
CM_ SG_ 1002 FRM_31_DetnRngRadial_048 "Detection point radial distance
Front Radar Moudle_X_Detection Range Radial
前雷达探测点径向距离";
CM_ SG_ 1002 FRM_31_DetnAziAngle_048 "Detection point azimuth angle
Front Radar Moudle_X_Detection Azimuth Angle
前雷达探测点水平方位角";
CM_ SG_ 1002 FRM_31_DetnElevnAngle_048 "Detection point elevation angle
Front Radar Moudle_X_Detection Elevation Angle
前雷达探测点俯仰角";
CM_ SG_ 1002 FRM_31_DetnRelVelRadial_048 "Detection point radial relative velocity
Front Radar Moudle_X_Detection Relative Velocity Radial 
前雷达探测点在径向上的相对速度";
CM_ SG_ 1002 FRM_31_DetnSNR_048 "Detection point signal noise ratio
Front Radar Moudle_X_Detection Signal Noise Ratio
前雷达探测点信号噪声比";
CM_ SG_ 1002 FRM_31_DetnRCS_048 "Detection point radar cross section
Front Radar Moudle_X_Detection Radar Cross Section
前雷达探测点雷达散射截面积";
CM_ SG_ 1002 FRM_31_DetnQuality_048 "Detection point quality
Front Radar Moudle_X_Detection Quality
前雷达探测点质量";
CM_ SG_ 1002 FRM_31_DetnMotionSts_049 "Detection point motion status
Front Radar Moudle_X_Detection Motion Status
前雷达探测点运动状态";
CM_ SG_ 1002 FRM_31_DetnRngRadial_049 "Detection point radial distance
Front Radar Moudle_X_Detection Range Radial
前雷达探测点径向距离";
CM_ SG_ 1002 FRM_31_DetnAziAngle_049 "Detection point azimuth angle
Front Radar Moudle_X_Detection Azimuth Angle
前雷达探测点水平方位角";
CM_ SG_ 1002 FRM_31_DetnElevnAngle_049 "Detection point elevation angle
Front Radar Moudle_X_Detection Elevation Angle
前雷达探测点俯仰角";
CM_ SG_ 1002 FRM_31_DetnRelVelRadial_049 "Detection point radial relative velocity
Front Radar Moudle_X_Detection Relative Velocity Radial 
前雷达探测点在径向上的相对速度";
CM_ SG_ 1002 FRM_31_DetnSNR_049 "Detection point signal noise ratio
Front Radar Moudle_X_Detection Signal Noise Ratio
前雷达探测点信号噪声比";
CM_ SG_ 1002 FRM_31_DetnRCS_049 "Detection point radar cross section
Front Radar Moudle_X_Detection Radar Cross Section
前雷达探测点雷达散射截面积";
CM_ SG_ 1002 FRM_31_DetnQuality_049 "Detection point quality
Front Radar Moudle_X_Detection Quality
前雷达探测点质量";
CM_ SG_ 1002 FRM_31_DetnMotionSts_050 "Detection point motion status
Front Radar Moudle_X_Detection Motion Status
前雷达探测点运动状态";
CM_ SG_ 1002 FRM_31_DetnRngRadial_050 "Detection point radial distance
Front Radar Moudle_X_Detection Range Radial
前雷达探测点径向距离";
CM_ SG_ 1002 FRM_31_DetnAziAngle_050 "Detection point azimuth angle
Front Radar Moudle_X_Detection Azimuth Angle
前雷达探测点水平方位角";
CM_ SG_ 1002 FRM_31_DetnElevnAngle_050 "Detection point elevation angle
Front Radar Moudle_X_Detection Elevation Angle
前雷达探测点俯仰角";
CM_ SG_ 1002 FRM_31_DetnRelVelRadial_050 "Detection point radial relative velocity
Front Radar Moudle_X_Detection Relative Velocity Radial 
前雷达探测点在径向上的相对速度";
CM_ SG_ 1002 FRM_31_DetnSNR_050 "Detection point signal noise ratio
Front Radar Moudle_X_Detection Signal Noise Ratio
前雷达探测点信号噪声比";
CM_ SG_ 1002 FRM_31_DetnRCS_050 "Detection point radar cross section
Front Radar Moudle_X_Detection Radar Cross Section
前雷达探测点雷达散射截面积";
CM_ SG_ 1002 FRM_31_DetnQuality_050 "Detection point quality
Front Radar Moudle_X_Detection Quality
前雷达探测点质量";
CM_ SG_ 1002 FRM_31_DetnMotionSts_051 "Detection point motion status
Front Radar Moudle_X_Detection Motion Status
前雷达探测点运动状态";
CM_ SG_ 1002 FRM_31_DetnRngRadial_051 "Detection point radial distance
Front Radar Moudle_X_Detection Range Radial
前雷达探测点径向距离";
CM_ SG_ 1002 FRM_31_DetnAziAngle_051 "Detection point azimuth angle
Front Radar Moudle_X_Detection Azimuth Angle
前雷达探测点水平方位角";
CM_ SG_ 1002 FRM_31_DetnElevnAngle_051 "Detection point elevation angle
Front Radar Moudle_X_Detection Elevation Angle
前雷达探测点俯仰角";
CM_ SG_ 1002 FRM_31_DetnRelVelRadial_051 "Detection point radial relative velocity
Front Radar Moudle_X_Detection Relative Velocity Radial 
前雷达探测点在径向上的相对速度";
CM_ SG_ 1002 FRM_31_DetnSNR_051 "Detection point signal noise ratio
Front Radar Moudle_X_Detection Signal Noise Ratio
前雷达探测点信号噪声比";
CM_ SG_ 1002 FRM_31_DetnRCS_051 "Detection point radar cross section
Front Radar Moudle_X_Detection Radar Cross Section
前雷达探测点雷达散射截面积";
CM_ SG_ 1002 FRM_31_DetnQuality_051 "Detection point quality
Front Radar Moudle_X_Detection Quality
前雷达探测点质量";
CM_ SG_ 1002 FRM_31_DetnMotionSts_052 "Detection point motion status
Front Radar Moudle_X_Detection Motion Status
前雷达探测点运动状态";
CM_ SG_ 1002 FRM_31_DetnRngRadial_052 "Detection point radial distance
Front Radar Moudle_X_Detection Range Radial
前雷达探测点径向距离";
CM_ SG_ 1002 FRM_31_DetnAziAngle_052 "Detection point azimuth angle
Front Radar Moudle_X_Detection Azimuth Angle
前雷达探测点水平方位角";
CM_ SG_ 1002 FRM_31_DetnElevnAngle_052 "Detection point elevation angle
Front Radar Moudle_X_Detection Elevation Angle
前雷达探测点俯仰角";
CM_ SG_ 1002 FRM_31_DetnRelVelRadial_052 "Detection point radial relative velocity
Front Radar Moudle_X_Detection Relative Velocity Radial 
前雷达探测点在径向上的相对速度";
CM_ SG_ 1002 FRM_31_DetnSNR_052 "Detection point signal noise ratio
Front Radar Moudle_X_Detection Signal Noise Ratio
前雷达探测点信号噪声比";
CM_ SG_ 1002 FRM_31_DetnRCS_052 "Detection point radar cross section
Front Radar Moudle_X_Detection Radar Cross Section
前雷达探测点雷达散射截面积";
CM_ SG_ 1002 FRM_31_DetnQuality_052 "Detection point quality
Front Radar Moudle_X_Detection Quality
前雷达探测点质量";
CM_ SG_ 1002 FRM_31_DetnMotionSts_053 "Detection point motion status
Front Radar Moudle_X_Detection Motion Status
前雷达探测点运动状态";
CM_ SG_ 1002 FRM_31_DetnRngRadial_053 "Detection point radial distance
Front Radar Moudle_X_Detection Range Radial
前雷达探测点径向距离";
CM_ SG_ 1002 FRM_31_DetnAziAngle_053 "Detection point azimuth angle
Front Radar Moudle_X_Detection Azimuth Angle
前雷达探测点水平方位角";
CM_ SG_ 1002 FRM_31_DetnElevnAngle_053 "Detection point elevation angle
Front Radar Moudle_X_Detection Elevation Angle
前雷达探测点俯仰角";
CM_ SG_ 1002 FRM_31_DetnRelVelRadial_053 "Detection point radial relative velocity
Front Radar Moudle_X_Detection Relative Velocity Radial 
前雷达探测点在径向上的相对速度";
CM_ SG_ 1002 FRM_31_DetnSNR_053 "Detection point signal noise ratio
Front Radar Moudle_X_Detection Signal Noise Ratio
前雷达探测点信号噪声比";
CM_ SG_ 1002 FRM_31_DetnRCS_053 "Detection point radar cross section
Front Radar Moudle_X_Detection Radar Cross Section
前雷达探测点雷达散射截面积";
CM_ SG_ 1002 FRM_31_DetnQuality_053 "Detection point quality
Front Radar Moudle_X_Detection Quality
前雷达探测点质量";
CM_ SG_ 1002 FRM_31_Loc048_Valid "the valid flag of each location 
每一点云的有效状态";
CM_ SG_ 1002 FRM_31_Loc049_Valid "the valid flag of each location 
每一点云的有效状态";
CM_ SG_ 1002 FRM_31_Loc050_Valid "the valid flag of each location 
每一点云的有效状态";
CM_ SG_ 1002 FRM_31_Loc051_Valid "the valid flag of each location 
每一点云的有效状态";
CM_ SG_ 1002 FRM_31_Loc052_Valid "the valid flag of each location 
每一点云的有效状态";
CM_ SG_ 1002 FRM_31_Loc053_Valid "the valid flag of each location 
每一点云的有效状态";
CM_ SG_ 1003 FRM_32_CRC "Profile5:E2E CRC16 (polynomial:0x1021)       
DataID:Use CANID,other bits Fill with 0";
CM_ SG_ 1003 FRM_32_RollgCntr "Profile5:E2E Rolling message counter";
CM_ SG_ 1003 FRM_32_DetnBlockCounter "Front Radar Moudle_X_Detection Block Counter
前雷达探测点块计数";
CM_ SG_ 1003 FRM_32_DetnMotionSts_054 "Detection point motion status
Front Radar Moudle_X_Detection Motion Status
前雷达探测点运动状态";
CM_ SG_ 1003 FRM_32_DetnRngRadial_054 "Detection point radial distance
Front Radar Moudle_X_Detection Range Radial
前雷达探测点径向距离";
CM_ SG_ 1003 FRM_32_DetnAziAngle_054 "Detection point azimuth angle
Front Radar Moudle_X_Detection Azimuth Angle
前雷达探测点水平方位角";
CM_ SG_ 1003 FRM_32_DetnElevnAngle_054 "Detection point elevation angle
Front Radar Moudle_X_Detection Elevation Angle
前雷达探测点俯仰角";
CM_ SG_ 1003 FRM_32_DetnRelVelRadial_054 "Detection point radial relative velocity
Front Radar Moudle_X_Detection Relative Velocity Radial 
前雷达探测点在径向上的相对速度";
CM_ SG_ 1003 FRM_32_DetnSNR_054 "Detection point signal noise ratio
Front Radar Moudle_X_Detection Signal Noise Ratio
前雷达探测点信号噪声比";
CM_ SG_ 1003 FRM_32_DetnRCS_054 "Detection point radar cross section
Front Radar Moudle_X_Detection Radar Cross Section
前雷达探测点雷达散射截面积";
CM_ SG_ 1003 FRM_32_DetnQuality_054 "Detection point quality
Front Radar Moudle_X_Detection Quality
前雷达探测点质量";
CM_ SG_ 1003 FRM_32_DetnMotionSts_055 "Detection point motion status
Front Radar Moudle_X_Detection Motion Status
前雷达探测点运动状态";
CM_ SG_ 1003 FRM_32_DetnRngRadial_055 "Detection point radial distance
Front Radar Moudle_X_Detection Range Radial
前雷达探测点径向距离";
CM_ SG_ 1003 FRM_32_DetnAziAngle_055 "Detection point azimuth angle
Front Radar Moudle_X_Detection Azimuth Angle
前雷达探测点水平方位角";
CM_ SG_ 1003 FRM_32_DetnElevnAngle_055 "Detection point elevation angle
Front Radar Moudle_X_Detection Elevation Angle
前雷达探测点俯仰角";
CM_ SG_ 1003 FRM_32_DetnRelVelRadial_055 "Detection point radial relative velocity
Front Radar Moudle_X_Detection Relative Velocity Radial 
前雷达探测点在径向上的相对速度";
CM_ SG_ 1003 FRM_32_DetnSNR_055 "Detection point signal noise ratio
Front Radar Moudle_X_Detection Signal Noise Ratio
前雷达探测点信号噪声比";
CM_ SG_ 1003 FRM_32_DetnRCS_055 "Detection point radar cross section
Front Radar Moudle_X_Detection Radar Cross Section
前雷达探测点雷达散射截面积";
CM_ SG_ 1003 FRM_32_DetnQuality_055 "Detection point quality
Front Radar Moudle_X_Detection Quality
前雷达探测点质量";
CM_ SG_ 1003 FRM_32_DetnMotionSts_056 "Detection point motion status
Front Radar Moudle_X_Detection Motion Status
前雷达探测点运动状态";
CM_ SG_ 1003 FRM_32_DetnRngRadial_056 "Detection point radial distance
Front Radar Moudle_X_Detection Range Radial
前雷达探测点径向距离";
CM_ SG_ 1003 FRM_32_DetnAziAngle_056 "Detection point azimuth angle
Front Radar Moudle_X_Detection Azimuth Angle
前雷达探测点水平方位角";
CM_ SG_ 1003 FRM_32_DetnElevnAngle_056 "Detection point elevation angle
Front Radar Moudle_X_Detection Elevation Angle
前雷达探测点俯仰角";
CM_ SG_ 1003 FRM_32_DetnRelVelRadial_056 "Detection point radial relative velocity
Front Radar Moudle_X_Detection Relative Velocity Radial 
前雷达探测点在径向上的相对速度";
CM_ SG_ 1003 FRM_32_DetnSNR_056 "Detection point signal noise ratio
Front Radar Moudle_X_Detection Signal Noise Ratio
前雷达探测点信号噪声比";
CM_ SG_ 1003 FRM_32_DetnRCS_056 "Detection point radar cross section
Front Radar Moudle_X_Detection Radar Cross Section
前雷达探测点雷达散射截面积";
CM_ SG_ 1003 FRM_32_DetnQuality_056 "Detection point quality
Front Radar Moudle_X_Detection Quality
前雷达探测点质量";
CM_ SG_ 1003 FRM_32_DetnMotionSts_057 "Detection point motion status
Front Radar Moudle_X_Detection Motion Status
前雷达探测点运动状态";
CM_ SG_ 1003 FRM_32_DetnRngRadial_057 "Detection point radial distance
Front Radar Moudle_X_Detection Range Radial
前雷达探测点径向距离";
CM_ SG_ 1003 FRM_32_DetnAziAngle_057 "Detection point azimuth angle
Front Radar Moudle_X_Detection Azimuth Angle
前雷达探测点水平方位角";
CM_ SG_ 1003 FRM_32_DetnElevnAngle_057 "Detection point elevation angle
Front Radar Moudle_X_Detection Elevation Angle
前雷达探测点俯仰角";
CM_ SG_ 1003 FRM_32_DetnRelVelRadial_057 "Detection point radial relative velocity
Front Radar Moudle_X_Detection Relative Velocity Radial 
前雷达探测点在径向上的相对速度";
CM_ SG_ 1003 FRM_32_DetnSNR_057 "Detection point signal noise ratio
Front Radar Moudle_X_Detection Signal Noise Ratio
前雷达探测点信号噪声比";
CM_ SG_ 1003 FRM_32_DetnRCS_057 "Detection point radar cross section
Front Radar Moudle_X_Detection Radar Cross Section
前雷达探测点雷达散射截面积";
CM_ SG_ 1003 FRM_32_DetnQuality_057 "Detection point quality
Front Radar Moudle_X_Detection Quality
前雷达探测点质量";
CM_ SG_ 1003 FRM_32_DetnMotionSts_058 "Detection point motion status
Front Radar Moudle_X_Detection Motion Status
前雷达探测点运动状态";
CM_ SG_ 1003 FRM_32_DetnRngRadial_058 "Detection point radial distance
Front Radar Moudle_X_Detection Range Radial
前雷达探测点径向距离";
CM_ SG_ 1003 FRM_32_DetnAziAngle_058 "Detection point azimuth angle
Front Radar Moudle_X_Detection Azimuth Angle
前雷达探测点水平方位角";
CM_ SG_ 1003 FRM_32_DetnElevnAngle_058 "Detection point elevation angle
Front Radar Moudle_X_Detection Elevation Angle
前雷达探测点俯仰角";
CM_ SG_ 1003 FRM_32_DetnRelVelRadial_058 "Detection point radial relative velocity
Front Radar Moudle_X_Detection Relative Velocity Radial 
前雷达探测点在径向上的相对速度";
CM_ SG_ 1003 FRM_32_DetnSNR_058 "Detection point signal noise ratio
Front Radar Moudle_X_Detection Signal Noise Ratio
前雷达探测点信号噪声比";
CM_ SG_ 1003 FRM_32_DetnRCS_058 "Detection point radar cross section
Front Radar Moudle_X_Detection Radar Cross Section
前雷达探测点雷达散射截面积";
CM_ SG_ 1003 FRM_32_DetnQuality_058 "Detection point quality
Front Radar Moudle_X_Detection Quality
前雷达探测点质量";
CM_ SG_ 1003 FRM_32_DetnMotionSts_059 "Detection point motion status
Front Radar Moudle_X_Detection Motion Status
前雷达探测点运动状态";
CM_ SG_ 1003 FRM_32_DetnRngRadial_059 "Detection point radial distance
Front Radar Moudle_X_Detection Range Radial
前雷达探测点径向距离";
CM_ SG_ 1003 FRM_32_DetnAziAngle_059 "Detection point azimuth angle
Front Radar Moudle_X_Detection Azimuth Angle
前雷达探测点水平方位角";
CM_ SG_ 1003 FRM_32_DetnElevnAngle_059 "Detection point elevation angle
Front Radar Moudle_X_Detection Elevation Angle
前雷达探测点俯仰角";
CM_ SG_ 1003 FRM_32_DetnRelVelRadial_059 "Detection point radial relative velocity
Front Radar Moudle_X_Detection Relative Velocity Radial 
前雷达探测点在径向上的相对速度";
CM_ SG_ 1003 FRM_32_DetnSNR_059 "Detection point signal noise ratio
Front Radar Moudle_X_Detection Signal Noise Ratio
前雷达探测点信号噪声比";
CM_ SG_ 1003 FRM_32_DetnRCS_059 "Detection point radar cross section
Front Radar Moudle_X_Detection Radar Cross Section
前雷达探测点雷达散射截面积";
CM_ SG_ 1003 FRM_32_DetnQuality_059 "Detection point quality
Front Radar Moudle_X_Detection Quality
前雷达探测点质量";
CM_ SG_ 1003 FRM_32_Loc054_Valid "the valid flag of each location 
每一点云的有效状态";
CM_ SG_ 1003 FRM_32_Loc055_Valid "the valid flag of each location 
每一点云的有效状态";
CM_ SG_ 1003 FRM_32_Loc056_Valid "the valid flag of each location 
每一点云的有效状态";
CM_ SG_ 1003 FRM_32_Loc057_Valid "the valid flag of each location 
每一点云的有效状态";
CM_ SG_ 1003 FRM_32_Loc058_Valid "the valid flag of each location 
每一点云的有效状态";
CM_ SG_ 1003 FRM_32_Loc059_Valid "the valid flag of each location 
每一点云的有效状态";
CM_ SG_ 1004 FRM_33_CRC "Profile5:E2E CRC16 (polynomial:0x1021)       
DataID:Use CANID,other bits Fill with 0";
CM_ SG_ 1004 FRM_33_RollgCntr "Profile5:E2E Rolling message counter";
CM_ SG_ 1004 FRM_33_DetnBlockCounter "Front Radar Moudle_X_Detection Block Counter
前雷达探测点块计数";
CM_ SG_ 1004 FRM_33_DetnMotionSts_060 "Detection point motion status
Front Radar Moudle_X_Detection Motion Status
前雷达探测点运动状态";
CM_ SG_ 1004 FRM_33_DetnRngRadial_060 "Detection point radial distance
Front Radar Moudle_X_Detection Range Radial
前雷达探测点径向距离";
CM_ SG_ 1004 FRM_33_DetnAziAngle_060 "Detection point azimuth angle
Front Radar Moudle_X_Detection Azimuth Angle
前雷达探测点水平方位角";
CM_ SG_ 1004 FRM_33_DetnElevnAngle_060 "Detection point elevation angle
Front Radar Moudle_X_Detection Elevation Angle
前雷达探测点俯仰角";
CM_ SG_ 1004 FRM_33_DetnRelVelRadial_060 "Detection point radial relative velocity
Front Radar Moudle_X_Detection Relative Velocity Radial 
前雷达探测点在径向上的相对速度";
CM_ SG_ 1004 FRM_33_DetnSNR_060 "Detection point signal noise ratio
Front Radar Moudle_X_Detection Signal Noise Ratio
前雷达探测点信号噪声比";
CM_ SG_ 1004 FRM_33_DetnRCS_060 "Detection point radar cross section
Front Radar Moudle_X_Detection Radar Cross Section
前雷达探测点雷达散射截面积";
CM_ SG_ 1004 FRM_33_DetnQuality_060 "Detection point quality
Front Radar Moudle_X_Detection Quality
前雷达探测点质量";
CM_ SG_ 1004 FRM_33_DetnMotionSts_061 "Detection point motion status
Front Radar Moudle_X_Detection Motion Status
前雷达探测点运动状态";
CM_ SG_ 1004 FRM_33_DetnRngRadial_061 "Detection point radial distance
Front Radar Moudle_X_Detection Range Radial
前雷达探测点径向距离";
CM_ SG_ 1004 FRM_33_DetnAziAngle_061 "Detection point azimuth angle
Front Radar Moudle_X_Detection Azimuth Angle
前雷达探测点水平方位角";
CM_ SG_ 1004 FRM_33_DetnElevnAngle_061 "Detection point elevation angle
Front Radar Moudle_X_Detection Elevation Angle
前雷达探测点俯仰角";
CM_ SG_ 1004 FRM_33_DetnRelVelRadial_061 "Detection point radial relative velocity
Front Radar Moudle_X_Detection Relative Velocity Radial 
前雷达探测点在径向上的相对速度";
CM_ SG_ 1004 FRM_33_DetnSNR_061 "Detection point signal noise ratio
Front Radar Moudle_X_Detection Signal Noise Ratio
前雷达探测点信号噪声比";
CM_ SG_ 1004 FRM_33_DetnRCS_061 "Detection point radar cross section
Front Radar Moudle_X_Detection Radar Cross Section
前雷达探测点雷达散射截面积";
CM_ SG_ 1004 FRM_33_DetnQuality_061 "Detection point quality
Front Radar Moudle_X_Detection Quality
前雷达探测点质量";
CM_ SG_ 1004 FRM_33_DetnMotionSts_062 "Detection point motion status
Front Radar Moudle_X_Detection Motion Status
前雷达探测点运动状态";
CM_ SG_ 1004 FRM_33_DetnRngRadial_062 "Detection point radial distance
Front Radar Moudle_X_Detection Range Radial
前雷达探测点径向距离";
CM_ SG_ 1004 FRM_33_DetnAziAngle_062 "Detection point azimuth angle
Front Radar Moudle_X_Detection Azimuth Angle
前雷达探测点水平方位角";
CM_ SG_ 1004 FRM_33_DetnElevnAngle_062 "Detection point elevation angle
Front Radar Moudle_X_Detection Elevation Angle
前雷达探测点俯仰角";
CM_ SG_ 1004 FRM_33_DetnRelVelRadial_062 "Detection point radial relative velocity
Front Radar Moudle_X_Detection Relative Velocity Radial 
前雷达探测点在径向上的相对速度";
CM_ SG_ 1004 FRM_33_DetnSNR_062 "Detection point signal noise ratio
Front Radar Moudle_X_Detection Signal Noise Ratio
前雷达探测点信号噪声比";
CM_ SG_ 1004 FRM_33_DetnRCS_062 "Detection point radar cross section
Front Radar Moudle_X_Detection Radar Cross Section
前雷达探测点雷达散射截面积";
CM_ SG_ 1004 FRM_33_DetnQuality_062 "Detection point quality
Front Radar Moudle_X_Detection Quality
前雷达探测点质量";
CM_ SG_ 1004 FRM_33_DetnMotionSts_063 "Detection point motion status
Front Radar Moudle_X_Detection Motion Status
前雷达探测点运动状态";
CM_ SG_ 1004 FRM_33_DetnRngRadial_063 "Detection point radial distance
Front Radar Moudle_X_Detection Range Radial
前雷达探测点径向距离";
CM_ SG_ 1004 FRM_33_DetnAziAngle_063 "Detection point azimuth angle
Front Radar Moudle_X_Detection Azimuth Angle
前雷达探测点水平方位角";
CM_ SG_ 1004 FRM_33_DetnElevnAngle_063 "Detection point elevation angle
Front Radar Moudle_X_Detection Elevation Angle
前雷达探测点俯仰角";
CM_ SG_ 1004 FRM_33_DetnRelVelRadial_063 "Detection point radial relative velocity
Front Radar Moudle_X_Detection Relative Velocity Radial 
前雷达探测点在径向上的相对速度";
CM_ SG_ 1004 FRM_33_DetnSNR_063 "Detection point signal noise ratio
Front Radar Moudle_X_Detection Signal Noise Ratio
前雷达探测点信号噪声比";
CM_ SG_ 1004 FRM_33_DetnRCS_063 "Detection point radar cross section
Front Radar Moudle_X_Detection Radar Cross Section
前雷达探测点雷达散射截面积";
CM_ SG_ 1004 FRM_33_DetnQuality_063 "Detection point quality
Front Radar Moudle_X_Detection Quality
前雷达探测点质量";
CM_ SG_ 1004 FRM_33_DetnMotionSts_064 "Detection point motion status
Front Radar Moudle_X_Detection Motion Status
前雷达探测点运动状态";
CM_ SG_ 1004 FRM_33_DetnRngRadial_064 "Detection point radial distance
Front Radar Moudle_X_Detection Range Radial
前雷达探测点径向距离";
CM_ SG_ 1004 FRM_33_DetnAziAngle_064 "Detection point azimuth angle
Front Radar Moudle_X_Detection Azimuth Angle
前雷达探测点水平方位角";
CM_ SG_ 1004 FRM_33_DetnElevnAngle_064 "Detection point elevation angle
Front Radar Moudle_X_Detection Elevation Angle
前雷达探测点俯仰角";
CM_ SG_ 1004 FRM_33_DetnRelVelRadial_064 "Detection point radial relative velocity
Front Radar Moudle_X_Detection Relative Velocity Radial 
前雷达探测点在径向上的相对速度";
CM_ SG_ 1004 FRM_33_DetnSNR_064 "Detection point signal noise ratio
Front Radar Moudle_X_Detection Signal Noise Ratio
前雷达探测点信号噪声比";
CM_ SG_ 1004 FRM_33_DetnRCS_064 "Detection point radar cross section
Front Radar Moudle_X_Detection Radar Cross Section
前雷达探测点雷达散射截面积";
CM_ SG_ 1004 FRM_33_DetnQuality_064 "Detection point quality
Front Radar Moudle_X_Detection Quality
前雷达探测点质量";
CM_ SG_ 1004 FRM_33_DetnMotionSts_065 "Detection point motion status
Front Radar Moudle_X_Detection Motion Status
前雷达探测点运动状态";
CM_ SG_ 1004 FRM_33_DetnRngRadial_065 "Detection point radial distance
Front Radar Moudle_X_Detection Range Radial
前雷达探测点径向距离";
CM_ SG_ 1004 FRM_33_DetnAziAngle_065 "Detection point azimuth angle
Front Radar Moudle_X_Detection Azimuth Angle
前雷达探测点水平方位角";
CM_ SG_ 1004 FRM_33_DetnElevnAngle_065 "Detection point elevation angle
Front Radar Moudle_X_Detection Elevation Angle
前雷达探测点俯仰角";
CM_ SG_ 1004 FRM_33_DetnRelVelRadial_065 "Detection point radial relative velocity
Front Radar Moudle_X_Detection Relative Velocity Radial 
前雷达探测点在径向上的相对速度";
CM_ SG_ 1004 FRM_33_DetnSNR_065 "Detection point signal noise ratio
Front Radar Moudle_X_Detection Signal Noise Ratio
前雷达探测点信号噪声比";
CM_ SG_ 1004 FRM_33_DetnRCS_065 "Detection point radar cross section
Front Radar Moudle_X_Detection Radar Cross Section
前雷达探测点雷达散射截面积";
CM_ SG_ 1004 FRM_33_DetnQuality_065 "Detection point quality
Front Radar Moudle_X_Detection Quality
前雷达探测点质量";
CM_ SG_ 1004 FRM_33_Loc060_Valid "the valid flag of each location 
每一点云的有效状态";
CM_ SG_ 1004 FRM_33_Loc061_Valid "the valid flag of each location 
每一点云的有效状态";
CM_ SG_ 1004 FRM_33_Loc062_Valid "the valid flag of each location 
每一点云的有效状态";
CM_ SG_ 1004 FRM_33_Loc063_Valid "the valid flag of each location 
每一点云的有效状态";
CM_ SG_ 1004 FRM_33_Loc064_Valid "the valid flag of each location 
每一点云的有效状态";
CM_ SG_ 1004 FRM_33_Loc065_Valid "the valid flag of each location 
每一点云的有效状态";

BA_DEF_ BO_  "GenMsgSendType" ENUM  "Cyclic","Event","IfActive","CE","CA","NoMsgSendType";
BA_DEF_ BO_  "GenMsgCycleTime" INT 0 0;
BA_DEF_ SG_  "GenSigSendType" ENUM  "Cyclic","OnChange","OnWrite","IfActive","OnChangeWithRepetition","OnWriteWithRepetition","IfActiveWithRepetition","NoSigSendType","OnChangeAndIfActive","OnChangeAndIfActiveWithRepetition","CA","CE","Event";
BA_DEF_ SG_  "GenSigStartValue" INT 0 0;
BA_DEF_ BO_  "GenMsgCycleTimeFast" INT 0 0;
BA_DEF_ BO_  "GenMsgNrOfRepetition" INT 0 0;
BA_DEF_ BO_  "GenMsgDelayTime" INT 0 0;
BA_DEF_ BO_  "CANFD_BRS" ENUM  "0","1";
BA_DEF_ BO_  "VFrameFormat" ENUM  "StandardCAN","ExtendedCAN","reserved","reserved","reserved","reserved","reserved","reserved","reserved","reserved","reserved","reserved","reserved","reserved","StandardCAN_FD","ExtendedCAN_FD";
BA_DEF_ BO_  "GenMsgILSupport" ENUM  "No","Yes";
BA_DEF_ SG_ "GenSigASIL" ENUM "QM","A","B","C","D","";
BA_DEF_DEF_  "GenMsgSendType" "Cyclic";
BA_DEF_DEF_  "GenMsgCycleTime" 0;
BA_DEF_DEF_  "GenSigSendType" "Cyclic";
BA_DEF_DEF_  "GenSigStartValue" 0;
BA_DEF_DEF_  "GenMsgCycleTimeFast" 0;
BA_DEF_DEF_  "GenMsgNrOfRepetition" 0;
BA_DEF_DEF_  "GenMsgDelayTime" 0;
BA_DEF_DEF_  "CANFD_BRS" "1";
BA_DEF_DEF_  "VFrameFormat" "StandardCAN_FD";
BA_DEF_DEF_  "GenMsgILSupport" "No";
BA_DEF_DEF_ "GenSigASIL" "QM";
BA_ "GenMsgILSupport" BO_ 994 1;
BA_ "GenMsgCycleTime" BO_ 994 50;
BA_ "GenSigASIL"  SG_ 994 FRM_23_CRC 5;
BA_ "GenSigASIL"  SG_ 994 FRM_23_RollgCntr 5;
BA_ "GenSigASIL"  SG_ 994 FRM_23_DetnBlockCounter 2;
BA_ "GenSigASIL"  SG_ 994 FRM_23_DetnMotionSts_000 2;
BA_ "GenSigASIL"  SG_ 994 FRM_23_DetnRngRadial_000 2;
BA_ "GenSigStartValue" SG_ 994 FRM_23_DetnAziAngle_000 900;
BA_ "GenSigASIL"  SG_ 994 FRM_23_DetnAziAngle_000 2;
BA_ "GenSigStartValue" SG_ 994 FRM_23_DetnElevnAngle_000 100;
BA_ "GenSigASIL"  SG_ 994 FRM_23_DetnElevnAngle_000 2;
BA_ "GenSigStartValue" SG_ 994 FRM_23_DetnRelVelRadial_000 10000;
BA_ "GenSigASIL"  SG_ 994 FRM_23_DetnRelVelRadial_000 2;
BA_ "GenSigASIL"  SG_ 994 FRM_23_DetnSNR_000 2;
BA_ "GenSigStartValue" SG_ 994 FRM_23_DetnRCS_000 5000;
BA_ "GenSigASIL"  SG_ 994 FRM_23_DetnRCS_000 2;
BA_ "GenSigASIL"  SG_ 994 FRM_23_DetnQuality_000 2;
BA_ "GenSigASIL"  SG_ 994 FRM_23_DetnMotionSts_001 2;
BA_ "GenSigASIL"  SG_ 994 FRM_23_DetnRngRadial_001 2;
BA_ "GenSigStartValue" SG_ 994 FRM_23_DetnAziAngle_001 900;
BA_ "GenSigASIL"  SG_ 994 FRM_23_DetnAziAngle_001 2;
BA_ "GenSigStartValue" SG_ 994 FRM_23_DetnElevnAngle_001 100;
BA_ "GenSigASIL"  SG_ 994 FRM_23_DetnElevnAngle_001 2;
BA_ "GenSigStartValue" SG_ 994 FRM_23_DetnRelVelRadial_001 10000;
BA_ "GenSigASIL"  SG_ 994 FRM_23_DetnRelVelRadial_001 2;
BA_ "GenSigASIL"  SG_ 994 FRM_23_DetnSNR_001 2;
BA_ "GenSigStartValue" SG_ 994 FRM_23_DetnRCS_001 5000;
BA_ "GenSigASIL"  SG_ 994 FRM_23_DetnRCS_001 2;
BA_ "GenSigASIL"  SG_ 994 FRM_23_DetnQuality_001 2;
BA_ "GenSigASIL"  SG_ 994 FRM_23_DetnMotionSts_002 2;
BA_ "GenSigASIL"  SG_ 994 FRM_23_DetnRngRadial_002 2;
BA_ "GenSigStartValue" SG_ 994 FRM_23_DetnAziAngle_002 900;
BA_ "GenSigASIL"  SG_ 994 FRM_23_DetnAziAngle_002 2;
BA_ "GenSigStartValue" SG_ 994 FRM_23_DetnElevnAngle_002 100;
BA_ "GenSigASIL"  SG_ 994 FRM_23_DetnElevnAngle_002 2;
BA_ "GenSigStartValue" SG_ 994 FRM_23_DetnRelVelRadial_002 10000;
BA_ "GenSigASIL"  SG_ 994 FRM_23_DetnRelVelRadial_002 2;
BA_ "GenSigASIL"  SG_ 994 FRM_23_DetnSNR_002 2;
BA_ "GenSigStartValue" SG_ 994 FRM_23_DetnRCS_002 5000;
BA_ "GenSigASIL"  SG_ 994 FRM_23_DetnRCS_002 2;
BA_ "GenSigASIL"  SG_ 994 FRM_23_DetnQuality_002 2;
BA_ "GenSigASIL"  SG_ 994 FRM_23_DetnMotionSts_003 2;
BA_ "GenSigASIL"  SG_ 994 FRM_23_DetnRngRadial_003 2;
BA_ "GenSigStartValue" SG_ 994 FRM_23_DetnAziAngle_003 900;
BA_ "GenSigASIL"  SG_ 994 FRM_23_DetnAziAngle_003 2;
BA_ "GenSigStartValue" SG_ 994 FRM_23_DetnElevnAngle_003 100;
BA_ "GenSigASIL"  SG_ 994 FRM_23_DetnElevnAngle_003 2;
BA_ "GenSigStartValue" SG_ 994 FRM_23_DetnRelVelRadial_003 10000;
BA_ "GenSigASIL"  SG_ 994 FRM_23_DetnRelVelRadial_003 2;
BA_ "GenSigASIL"  SG_ 994 FRM_23_DetnSNR_003 2;
BA_ "GenSigStartValue" SG_ 994 FRM_23_DetnRCS_003 5000;
BA_ "GenSigASIL"  SG_ 994 FRM_23_DetnRCS_003 2;
BA_ "GenSigASIL"  SG_ 994 FRM_23_DetnQuality_003 2;
BA_ "GenSigASIL"  SG_ 994 FRM_23_DetnMotionSts_004 2;
BA_ "GenSigASIL"  SG_ 994 FRM_23_DetnRngRadial_004 2;
BA_ "GenSigStartValue" SG_ 994 FRM_23_DetnAziAngle_004 900;
BA_ "GenSigASIL"  SG_ 994 FRM_23_DetnAziAngle_004 2;
BA_ "GenSigStartValue" SG_ 994 FRM_23_DetnElevnAngle_004 100;
BA_ "GenSigASIL"  SG_ 994 FRM_23_DetnElevnAngle_004 2;
BA_ "GenSigStartValue" SG_ 994 FRM_23_DetnRelVelRadial_004 10000;
BA_ "GenSigASIL"  SG_ 994 FRM_23_DetnRelVelRadial_004 2;
BA_ "GenSigASIL"  SG_ 994 FRM_23_DetnSNR_004 2;
BA_ "GenSigStartValue" SG_ 994 FRM_23_DetnRCS_004 5000;
BA_ "GenSigASIL"  SG_ 994 FRM_23_DetnRCS_004 2;
BA_ "GenSigASIL"  SG_ 994 FRM_23_DetnQuality_004 2;
BA_ "GenSigASIL"  SG_ 994 FRM_23_DetnMotionSts_005 2;
BA_ "GenSigASIL"  SG_ 994 FRM_23_DetnRngRadial_005 2;
BA_ "GenSigStartValue" SG_ 994 FRM_23_DetnAziAngle_005 900;
BA_ "GenSigASIL"  SG_ 994 FRM_23_DetnAziAngle_005 2;
BA_ "GenSigStartValue" SG_ 994 FRM_23_DetnElevnAngle_005 100;
BA_ "GenSigASIL"  SG_ 994 FRM_23_DetnElevnAngle_005 2;
BA_ "GenSigStartValue" SG_ 994 FRM_23_DetnRelVelRadial_005 10000;
BA_ "GenSigASIL"  SG_ 994 FRM_23_DetnRelVelRadial_005 2;
BA_ "GenSigASIL"  SG_ 994 FRM_23_DetnSNR_005 2;
BA_ "GenSigStartValue" SG_ 994 FRM_23_DetnRCS_005 5000;
BA_ "GenSigASIL"  SG_ 994 FRM_23_DetnRCS_005 2;
BA_ "GenSigASIL"  SG_ 994 FRM_23_DetnQuality_005 2;
BA_ "GenMsgILSupport" BO_ 995 1;
BA_ "GenMsgCycleTime" BO_ 995 50;
BA_ "GenSigASIL"  SG_ 995 FRM_24_CRC 5;
BA_ "GenSigASIL"  SG_ 995 FRM_24_RollgCntr 5;
BA_ "GenSigASIL"  SG_ 995 FRM_24_DetnBlockCounter 2;
BA_ "GenSigASIL"  SG_ 995 FRM_24_DetnMotionSts_006 2;
BA_ "GenSigASIL"  SG_ 995 FRM_24_DetnRngRadial_006 2;
BA_ "GenSigStartValue" SG_ 995 FRM_24_DetnAziAngle_006 900;
BA_ "GenSigASIL"  SG_ 995 FRM_24_DetnAziAngle_006 2;
BA_ "GenSigStartValue" SG_ 995 FRM_24_DetnElevnAngle_006 100;
BA_ "GenSigASIL"  SG_ 995 FRM_24_DetnElevnAngle_006 2;
BA_ "GenSigStartValue" SG_ 995 FRM_24_DetnRelVelRadial_006 10000;
BA_ "GenSigASIL"  SG_ 995 FRM_24_DetnRelVelRadial_006 2;
BA_ "GenSigASIL"  SG_ 995 FRM_24_DetnSNR_006 2;
BA_ "GenSigStartValue" SG_ 995 FRM_24_DetnRCS_006 5000;
BA_ "GenSigASIL"  SG_ 995 FRM_24_DetnRCS_006 2;
BA_ "GenSigASIL"  SG_ 995 FRM_24_DetnQuality_006 2;
BA_ "GenSigASIL"  SG_ 995 FRM_24_DetnMotionSts_007 2;
BA_ "GenSigASIL"  SG_ 995 FRM_24_DetnRngRadial_007 2;
BA_ "GenSigStartValue" SG_ 995 FRM_24_DetnAziAngle_007 900;
BA_ "GenSigASIL"  SG_ 995 FRM_24_DetnAziAngle_007 2;
BA_ "GenSigStartValue" SG_ 995 FRM_24_DetnElevnAngle_007 100;
BA_ "GenSigASIL"  SG_ 995 FRM_24_DetnElevnAngle_007 2;
BA_ "GenSigStartValue" SG_ 995 FRM_24_DetnRelVelRadial_007 10000;
BA_ "GenSigASIL"  SG_ 995 FRM_24_DetnRelVelRadial_007 2;
BA_ "GenSigASIL"  SG_ 995 FRM_24_DetnSNR_007 2;
BA_ "GenSigStartValue" SG_ 995 FRM_24_DetnRCS_007 5000;
BA_ "GenSigASIL"  SG_ 995 FRM_24_DetnRCS_007 2;
BA_ "GenSigASIL"  SG_ 995 FRM_24_DetnQuality_007 2;
BA_ "GenSigASIL"  SG_ 995 FRM_24_DetnMotionSts_008 2;
BA_ "GenSigASIL"  SG_ 995 FRM_24_DetnRngRadial_008 2;
BA_ "GenSigStartValue" SG_ 995 FRM_24_DetnAziAngle_008 900;
BA_ "GenSigASIL"  SG_ 995 FRM_24_DetnAziAngle_008 2;
BA_ "GenSigStartValue" SG_ 995 FRM_24_DetnElevnAngle_008 100;
BA_ "GenSigASIL"  SG_ 995 FRM_24_DetnElevnAngle_008 2;
BA_ "GenSigStartValue" SG_ 995 FRM_24_DetnRelVelRadial_008 10000;
BA_ "GenSigASIL"  SG_ 995 FRM_24_DetnRelVelRadial_008 2;
BA_ "GenSigASIL"  SG_ 995 FRM_24_DetnSNR_008 2;
BA_ "GenSigStartValue" SG_ 995 FRM_24_DetnRCS_008 5000;
BA_ "GenSigASIL"  SG_ 995 FRM_24_DetnRCS_008 2;
BA_ "GenSigASIL"  SG_ 995 FRM_24_DetnQuality_008 2;
BA_ "GenSigASIL"  SG_ 995 FRM_24_DetnMotionSts_009 2;
BA_ "GenSigASIL"  SG_ 995 FRM_24_DetnRngRadial_009 2;
BA_ "GenSigStartValue" SG_ 995 FRM_24_DetnAziAngle_009 900;
BA_ "GenSigASIL"  SG_ 995 FRM_24_DetnAziAngle_009 2;
BA_ "GenSigStartValue" SG_ 995 FRM_24_DetnElevnAngle_009 100;
BA_ "GenSigASIL"  SG_ 995 FRM_24_DetnElevnAngle_009 2;
BA_ "GenSigStartValue" SG_ 995 FRM_24_DetnRelVelRadial_009 10000;
BA_ "GenSigASIL"  SG_ 995 FRM_24_DetnRelVelRadial_009 2;
BA_ "GenSigASIL"  SG_ 995 FRM_24_DetnSNR_009 2;
BA_ "GenSigStartValue" SG_ 995 FRM_24_DetnRCS_009 5000;
BA_ "GenSigASIL"  SG_ 995 FRM_24_DetnRCS_009 2;
BA_ "GenSigASIL"  SG_ 995 FRM_24_DetnQuality_009 2;
BA_ "GenSigASIL"  SG_ 995 FRM_24_DetnMotionSts_010 2;
BA_ "GenSigASIL"  SG_ 995 FRM_24_DetnRngRadial_010 2;
BA_ "GenSigStartValue" SG_ 995 FRM_24_DetnAziAngle_010 900;
BA_ "GenSigASIL"  SG_ 995 FRM_24_DetnAziAngle_010 2;
BA_ "GenSigStartValue" SG_ 995 FRM_24_DetnElevnAngle_010 100;
BA_ "GenSigASIL"  SG_ 995 FRM_24_DetnElevnAngle_010 2;
BA_ "GenSigStartValue" SG_ 995 FRM_24_DetnRelVelRadial_010 10000;
BA_ "GenSigASIL"  SG_ 995 FRM_24_DetnRelVelRadial_010 2;
BA_ "GenSigASIL"  SG_ 995 FRM_24_DetnSNR_010 2;
BA_ "GenSigStartValue" SG_ 995 FRM_24_DetnRCS_010 5000;
BA_ "GenSigASIL"  SG_ 995 FRM_24_DetnRCS_010 2;
BA_ "GenSigASIL"  SG_ 995 FRM_24_DetnQuality_010 2;
BA_ "GenSigASIL"  SG_ 995 FRM_24_DetnMotionSts_011 2;
BA_ "GenSigASIL"  SG_ 995 FRM_24_DetnRngRadial_011 2;
BA_ "GenSigStartValue" SG_ 995 FRM_24_DetnAziAngle_011 900;
BA_ "GenSigASIL"  SG_ 995 FRM_24_DetnAziAngle_011 2;
BA_ "GenSigStartValue" SG_ 995 FRM_24_DetnElevnAngle_011 100;
BA_ "GenSigASIL"  SG_ 995 FRM_24_DetnElevnAngle_011 2;
BA_ "GenSigStartValue" SG_ 995 FRM_24_DetnRelVelRadial_011 10000;
BA_ "GenSigASIL"  SG_ 995 FRM_24_DetnRelVelRadial_011 2;
BA_ "GenSigASIL"  SG_ 995 FRM_24_DetnSNR_011 2;
BA_ "GenSigStartValue" SG_ 995 FRM_24_DetnRCS_011 5000;
BA_ "GenSigASIL"  SG_ 995 FRM_24_DetnRCS_011 2;
BA_ "GenSigASIL"  SG_ 995 FRM_24_DetnQuality_011 2;
BA_ "GenMsgILSupport" BO_ 996 1;
BA_ "GenMsgCycleTime" BO_ 996 50;
BA_ "GenSigASIL"  SG_ 996 FRM_25_CRC 5;
BA_ "GenSigASIL"  SG_ 996 FRM_25_RollgCntr 5;
BA_ "GenSigASIL"  SG_ 996 FRM_25_DetnBlockCounter 2;
BA_ "GenSigASIL"  SG_ 996 FRM_25_DetnMotionSts_012 2;
BA_ "GenSigASIL"  SG_ 996 FRM_25_DetnRngRadial_012 2;
BA_ "GenSigStartValue" SG_ 996 FRM_25_DetnAziAngle_012 900;
BA_ "GenSigASIL"  SG_ 996 FRM_25_DetnAziAngle_012 2;
BA_ "GenSigStartValue" SG_ 996 FRM_25_DetnElevnAngle_012 100;
BA_ "GenSigASIL"  SG_ 996 FRM_25_DetnElevnAngle_012 2;
BA_ "GenSigStartValue" SG_ 996 FRM_25_DetnRelVelRadial_012 10000;
BA_ "GenSigASIL"  SG_ 996 FRM_25_DetnRelVelRadial_012 2;
BA_ "GenSigASIL"  SG_ 996 FRM_25_DetnSNR_012 2;
BA_ "GenSigStartValue" SG_ 996 FRM_25_DetnRCS_012 5000;
BA_ "GenSigASIL"  SG_ 996 FRM_25_DetnRCS_012 2;
BA_ "GenSigASIL"  SG_ 996 FRM_25_DetnQuality_012 2;
BA_ "GenSigASIL"  SG_ 996 FRM_25_DetnMotionSts_013 2;
BA_ "GenSigASIL"  SG_ 996 FRM_25_DetnRngRadial_013 2;
BA_ "GenSigStartValue" SG_ 996 FRM_25_DetnAziAngle_013 900;
BA_ "GenSigASIL"  SG_ 996 FRM_25_DetnAziAngle_013 2;
BA_ "GenSigStartValue" SG_ 996 FRM_25_DetnElevnAngle_013 100;
BA_ "GenSigASIL"  SG_ 996 FRM_25_DetnElevnAngle_013 2;
BA_ "GenSigStartValue" SG_ 996 FRM_25_DetnRelVelRadial_013 10000;
BA_ "GenSigASIL"  SG_ 996 FRM_25_DetnRelVelRadial_013 2;
BA_ "GenSigASIL"  SG_ 996 FRM_25_DetnSNR_013 2;
BA_ "GenSigStartValue" SG_ 996 FRM_25_DetnRCS_013 5000;
BA_ "GenSigASIL"  SG_ 996 FRM_25_DetnRCS_013 2;
BA_ "GenSigASIL"  SG_ 996 FRM_25_DetnQuality_013 2;
BA_ "GenSigASIL"  SG_ 996 FRM_25_DetnMotionSts_014 2;
BA_ "GenSigASIL"  SG_ 996 FRM_25_DetnRngRadial_014 2;
BA_ "GenSigStartValue" SG_ 996 FRM_25_DetnAziAngle_014 900;
BA_ "GenSigASIL"  SG_ 996 FRM_25_DetnAziAngle_014 2;
BA_ "GenSigStartValue" SG_ 996 FRM_25_DetnElevnAngle_014 100;
BA_ "GenSigASIL"  SG_ 996 FRM_25_DetnElevnAngle_014 2;
BA_ "GenSigStartValue" SG_ 996 FRM_25_DetnRelVelRadial_014 10000;
BA_ "GenSigASIL"  SG_ 996 FRM_25_DetnRelVelRadial_014 2;
BA_ "GenSigASIL"  SG_ 996 FRM_25_DetnSNR_014 2;
BA_ "GenSigStartValue" SG_ 996 FRM_25_DetnRCS_014 5000;
BA_ "GenSigASIL"  SG_ 996 FRM_25_DetnRCS_014 2;
BA_ "GenSigASIL"  SG_ 996 FRM_25_DetnQuality_014 2;
BA_ "GenSigASIL"  SG_ 996 FRM_25_DetnMotionSts_015 2;
BA_ "GenSigASIL"  SG_ 996 FRM_25_DetnRngRadial_015 2;
BA_ "GenSigStartValue" SG_ 996 FRM_25_DetnAziAngle_015 900;
BA_ "GenSigASIL"  SG_ 996 FRM_25_DetnAziAngle_015 2;
BA_ "GenSigStartValue" SG_ 996 FRM_25_DetnElevnAngle_015 100;
BA_ "GenSigASIL"  SG_ 996 FRM_25_DetnElevnAngle_015 2;
BA_ "GenSigStartValue" SG_ 996 FRM_25_DetnRelVelRadial_015 10000;
BA_ "GenSigASIL"  SG_ 996 FRM_25_DetnRelVelRadial_015 2;
BA_ "GenSigASIL"  SG_ 996 FRM_25_DetnSNR_015 2;
BA_ "GenSigStartValue" SG_ 996 FRM_25_DetnRCS_015 5000;
BA_ "GenSigASIL"  SG_ 996 FRM_25_DetnRCS_015 2;
BA_ "GenSigASIL"  SG_ 996 FRM_25_DetnQuality_015 2;
BA_ "GenSigASIL"  SG_ 996 FRM_25_DetnMotionSts_016 2;
BA_ "GenSigASIL"  SG_ 996 FRM_25_DetnRngRadial_016 2;
BA_ "GenSigStartValue" SG_ 996 FRM_25_DetnAziAngle_016 900;
BA_ "GenSigASIL"  SG_ 996 FRM_25_DetnAziAngle_016 2;
BA_ "GenSigStartValue" SG_ 996 FRM_25_DetnElevnAngle_016 100;
BA_ "GenSigASIL"  SG_ 996 FRM_25_DetnElevnAngle_016 2;
BA_ "GenSigStartValue" SG_ 996 FRM_25_DetnRelVelRadial_016 10000;
BA_ "GenSigASIL"  SG_ 996 FRM_25_DetnRelVelRadial_016 2;
BA_ "GenSigASIL"  SG_ 996 FRM_25_DetnSNR_016 2;
BA_ "GenSigStartValue" SG_ 996 FRM_25_DetnRCS_016 5000;
BA_ "GenSigASIL"  SG_ 996 FRM_25_DetnRCS_016 2;
BA_ "GenSigASIL"  SG_ 996 FRM_25_DetnQuality_016 2;
BA_ "GenSigASIL"  SG_ 996 FRM_25_DetnMotionSts_017 2;
BA_ "GenSigASIL"  SG_ 996 FRM_25_DetnRngRadial_017 2;
BA_ "GenSigStartValue" SG_ 996 FRM_25_DetnAziAngle_017 900;
BA_ "GenSigASIL"  SG_ 996 FRM_25_DetnAziAngle_017 2;
BA_ "GenSigStartValue" SG_ 996 FRM_25_DetnElevnAngle_017 100;
BA_ "GenSigASIL"  SG_ 996 FRM_25_DetnElevnAngle_017 2;
BA_ "GenSigStartValue" SG_ 996 FRM_25_DetnRelVelRadial_017 10000;
BA_ "GenSigASIL"  SG_ 996 FRM_25_DetnRelVelRadial_017 2;
BA_ "GenSigASIL"  SG_ 996 FRM_25_DetnSNR_017 2;
BA_ "GenSigStartValue" SG_ 996 FRM_25_DetnRCS_017 5000;
BA_ "GenSigASIL"  SG_ 996 FRM_25_DetnRCS_017 2;
BA_ "GenSigASIL"  SG_ 996 FRM_25_DetnQuality_017 2;
BA_ "GenMsgILSupport" BO_ 997 1;
BA_ "GenMsgCycleTime" BO_ 997 50;
BA_ "GenSigASIL"  SG_ 997 FRM_26_CRC 5;
BA_ "GenSigASIL"  SG_ 997 FRM_26_RollgCntr 5;
BA_ "GenSigASIL"  SG_ 997 FRM_26_DetnBlockCounter 2;
BA_ "GenSigASIL"  SG_ 997 FRM_26_DetnMotionSts_018 2;
BA_ "GenSigASIL"  SG_ 997 FRM_26_DetnRngRadial_018 2;
BA_ "GenSigStartValue" SG_ 997 FRM_26_DetnAziAngle_018 900;
BA_ "GenSigASIL"  SG_ 997 FRM_26_DetnAziAngle_018 2;
BA_ "GenSigStartValue" SG_ 997 FRM_26_DetnElevnAngle_018 100;
BA_ "GenSigASIL"  SG_ 997 FRM_26_DetnElevnAngle_018 2;
BA_ "GenSigStartValue" SG_ 997 FRM_26_DetnRelVelRadial_018 10000;
BA_ "GenSigASIL"  SG_ 997 FRM_26_DetnRelVelRadial_018 2;
BA_ "GenSigASIL"  SG_ 997 FRM_26_DetnSNR_018 2;
BA_ "GenSigStartValue" SG_ 997 FRM_26_DetnRCS_018 5000;
BA_ "GenSigASIL"  SG_ 997 FRM_26_DetnRCS_018 2;
BA_ "GenSigASIL"  SG_ 997 FRM_26_DetnQuality_018 2;
BA_ "GenSigASIL"  SG_ 997 FRM_26_DetnMotionSts_019 2;
BA_ "GenSigASIL"  SG_ 997 FRM_26_DetnRngRadial_019 2;
BA_ "GenSigStartValue" SG_ 997 FRM_26_DetnAziAngle_019 900;
BA_ "GenSigASIL"  SG_ 997 FRM_26_DetnAziAngle_019 2;
BA_ "GenSigStartValue" SG_ 997 FRM_26_DetnElevnAngle_019 100;
BA_ "GenSigASIL"  SG_ 997 FRM_26_DetnElevnAngle_019 2;
BA_ "GenSigStartValue" SG_ 997 FRM_26_DetnRelVelRadial_019 10000;
BA_ "GenSigASIL"  SG_ 997 FRM_26_DetnRelVelRadial_019 2;
BA_ "GenSigASIL"  SG_ 997 FRM_26_DetnSNR_019 2;
BA_ "GenSigStartValue" SG_ 997 FRM_26_DetnRCS_019 5000;
BA_ "GenSigASIL"  SG_ 997 FRM_26_DetnRCS_019 2;
BA_ "GenSigASIL"  SG_ 997 FRM_26_DetnQuality_019 2;
BA_ "GenSigASIL"  SG_ 997 FRM_26_DetnMotionSts_020 2;
BA_ "GenSigASIL"  SG_ 997 FRM_26_DetnRngRadial_020 2;
BA_ "GenSigStartValue" SG_ 997 FRM_26_DetnAziAngle_020 900;
BA_ "GenSigASIL"  SG_ 997 FRM_26_DetnAziAngle_020 2;
BA_ "GenSigStartValue" SG_ 997 FRM_26_DetnElevnAngle_020 100;
BA_ "GenSigASIL"  SG_ 997 FRM_26_DetnElevnAngle_020 2;
BA_ "GenSigStartValue" SG_ 997 FRM_26_DetnRelVelRadial_020 10000;
BA_ "GenSigASIL"  SG_ 997 FRM_26_DetnRelVelRadial_020 2;
BA_ "GenSigASIL"  SG_ 997 FRM_26_DetnSNR_020 2;
BA_ "GenSigStartValue" SG_ 997 FRM_26_DetnRCS_020 5000;
BA_ "GenSigASIL"  SG_ 997 FRM_26_DetnRCS_020 2;
BA_ "GenSigASIL"  SG_ 997 FRM_26_DetnQuality_020 2;
BA_ "GenSigASIL"  SG_ 997 FRM_26_DetnMotionSts_021 2;
BA_ "GenSigASIL"  SG_ 997 FRM_26_DetnRngRadial_021 2;
BA_ "GenSigStartValue" SG_ 997 FRM_26_DetnAziAngle_021 900;
BA_ "GenSigASIL"  SG_ 997 FRM_26_DetnAziAngle_021 2;
BA_ "GenSigStartValue" SG_ 997 FRM_26_DetnElevnAngle_021 100;
BA_ "GenSigASIL"  SG_ 997 FRM_26_DetnElevnAngle_021 2;
BA_ "GenSigStartValue" SG_ 997 FRM_26_DetnRelVelRadial_021 10000;
BA_ "GenSigASIL"  SG_ 997 FRM_26_DetnRelVelRadial_021 2;
BA_ "GenSigASIL"  SG_ 997 FRM_26_DetnSNR_021 2;
BA_ "GenSigStartValue" SG_ 997 FRM_26_DetnRCS_021 5000;
BA_ "GenSigASIL"  SG_ 997 FRM_26_DetnRCS_021 2;
BA_ "GenSigASIL"  SG_ 997 FRM_26_DetnQuality_021 2;
BA_ "GenSigASIL"  SG_ 997 FRM_26_DetnMotionSts_022 2;
BA_ "GenSigASIL"  SG_ 997 FRM_26_DetnRngRadial_022 2;
BA_ "GenSigStartValue" SG_ 997 FRM_26_DetnAziAngle_022 900;
BA_ "GenSigASIL"  SG_ 997 FRM_26_DetnAziAngle_022 2;
BA_ "GenSigStartValue" SG_ 997 FRM_26_DetnElevnAngle_022 100;
BA_ "GenSigASIL"  SG_ 997 FRM_26_DetnElevnAngle_022 2;
BA_ "GenSigStartValue" SG_ 997 FRM_26_DetnRelVelRadial_022 10000;
BA_ "GenSigASIL"  SG_ 997 FRM_26_DetnRelVelRadial_022 2;
BA_ "GenSigASIL"  SG_ 997 FRM_26_DetnSNR_022 2;
BA_ "GenSigStartValue" SG_ 997 FRM_26_DetnRCS_022 5000;
BA_ "GenSigASIL"  SG_ 997 FRM_26_DetnRCS_022 2;
BA_ "GenSigASIL"  SG_ 997 FRM_26_DetnQuality_022 2;
BA_ "GenSigASIL"  SG_ 997 FRM_26_DetnMotionSts_023 2;
BA_ "GenSigASIL"  SG_ 997 FRM_26_DetnRngRadial_023 2;
BA_ "GenSigStartValue" SG_ 997 FRM_26_DetnAziAngle_023 900;
BA_ "GenSigASIL"  SG_ 997 FRM_26_DetnAziAngle_023 2;
BA_ "GenSigStartValue" SG_ 997 FRM_26_DetnElevnAngle_023 100;
BA_ "GenSigASIL"  SG_ 997 FRM_26_DetnElevnAngle_023 2;
BA_ "GenSigStartValue" SG_ 997 FRM_26_DetnRelVelRadial_023 10000;
BA_ "GenSigASIL"  SG_ 997 FRM_26_DetnRelVelRadial_023 2;
BA_ "GenSigASIL"  SG_ 997 FRM_26_DetnSNR_023 2;
BA_ "GenSigStartValue" SG_ 997 FRM_26_DetnRCS_023 5000;
BA_ "GenSigASIL"  SG_ 997 FRM_26_DetnRCS_023 2;
BA_ "GenSigASIL"  SG_ 997 FRM_26_DetnQuality_023 2;
BA_ "GenMsgILSupport" BO_ 998 1;
BA_ "GenMsgCycleTime" BO_ 998 50;
BA_ "GenSigASIL"  SG_ 998 FRM_27_CRC 5;
BA_ "GenSigASIL"  SG_ 998 FRM_27_RollgCntr 5;
BA_ "GenSigASIL"  SG_ 998 FRM_27_DetnBlockCounter 2;
BA_ "GenSigASIL"  SG_ 998 FRM_27_DetnMotionSts_024 2;
BA_ "GenSigASIL"  SG_ 998 FRM_27_DetnRngRadial_024 2;
BA_ "GenSigStartValue" SG_ 998 FRM_27_DetnAziAngle_024 900;
BA_ "GenSigASIL"  SG_ 998 FRM_27_DetnAziAngle_024 2;
BA_ "GenSigStartValue" SG_ 998 FRM_27_DetnElevnAngle_024 100;
BA_ "GenSigASIL"  SG_ 998 FRM_27_DetnElevnAngle_024 2;
BA_ "GenSigStartValue" SG_ 998 FRM_27_DetnRelVelRadial_024 10000;
BA_ "GenSigASIL"  SG_ 998 FRM_27_DetnRelVelRadial_024 2;
BA_ "GenSigASIL"  SG_ 998 FRM_27_DetnSNR_024 2;
BA_ "GenSigStartValue" SG_ 998 FRM_27_DetnRCS_024 5000;
BA_ "GenSigASIL"  SG_ 998 FRM_27_DetnRCS_024 2;
BA_ "GenSigASIL"  SG_ 998 FRM_27_DetnQuality_024 2;
BA_ "GenSigASIL"  SG_ 998 FRM_27_DetnMotionSts_025 2;
BA_ "GenSigASIL"  SG_ 998 FRM_27_DetnRngRadial_025 2;
BA_ "GenSigStartValue" SG_ 998 FRM_27_DetnAziAngle_025 900;
BA_ "GenSigASIL"  SG_ 998 FRM_27_DetnAziAngle_025 2;
BA_ "GenSigStartValue" SG_ 998 FRM_27_DetnElevnAngle_025 100;
BA_ "GenSigASIL"  SG_ 998 FRM_27_DetnElevnAngle_025 2;
BA_ "GenSigStartValue" SG_ 998 FRM_27_DetnRelVelRadial_025 10000;
BA_ "GenSigASIL"  SG_ 998 FRM_27_DetnRelVelRadial_025 2;
BA_ "GenSigASIL"  SG_ 998 FRM_27_DetnSNR_025 2;
BA_ "GenSigStartValue" SG_ 998 FRM_27_DetnRCS_025 5000;
BA_ "GenSigASIL"  SG_ 998 FRM_27_DetnRCS_025 2;
BA_ "GenSigASIL"  SG_ 998 FRM_27_DetnQuality_025 2;
BA_ "GenSigASIL"  SG_ 998 FRM_27_DetnMotionSts_026 2;
BA_ "GenSigASIL"  SG_ 998 FRM_27_DetnRngRadial_026 2;
BA_ "GenSigStartValue" SG_ 998 FRM_27_DetnAziAngle_026 900;
BA_ "GenSigASIL"  SG_ 998 FRM_27_DetnAziAngle_026 2;
BA_ "GenSigStartValue" SG_ 998 FRM_27_DetnElevnAngle_026 100;
BA_ "GenSigASIL"  SG_ 998 FRM_27_DetnElevnAngle_026 2;
BA_ "GenSigStartValue" SG_ 998 FRM_27_DetnRelVelRadial_026 10000;
BA_ "GenSigASIL"  SG_ 998 FRM_27_DetnRelVelRadial_026 2;
BA_ "GenSigASIL"  SG_ 998 FRM_27_DetnSNR_026 2;
BA_ "GenSigStartValue" SG_ 998 FRM_27_DetnRCS_026 5000;
BA_ "GenSigASIL"  SG_ 998 FRM_27_DetnRCS_026 2;
BA_ "GenSigASIL"  SG_ 998 FRM_27_DetnQuality_026 2;
BA_ "GenSigASIL"  SG_ 998 FRM_27_DetnMotionSts_027 2;
BA_ "GenSigASIL"  SG_ 998 FRM_27_DetnRngRadial_027 2;
BA_ "GenSigStartValue" SG_ 998 FRM_27_DetnAziAngle_027 900;
BA_ "GenSigASIL"  SG_ 998 FRM_27_DetnAziAngle_027 2;
BA_ "GenSigStartValue" SG_ 998 FRM_27_DetnElevnAngle_027 100;
BA_ "GenSigASIL"  SG_ 998 FRM_27_DetnElevnAngle_027 2;
BA_ "GenSigStartValue" SG_ 998 FRM_27_DetnRelVelRadial_027 10000;
BA_ "GenSigASIL"  SG_ 998 FRM_27_DetnRelVelRadial_027 2;
BA_ "GenSigASIL"  SG_ 998 FRM_27_DetnSNR_027 2;
BA_ "GenSigStartValue" SG_ 998 FRM_27_DetnRCS_027 5000;
BA_ "GenSigASIL"  SG_ 998 FRM_27_DetnRCS_027 2;
BA_ "GenSigASIL"  SG_ 998 FRM_27_DetnQuality_027 2;
BA_ "GenSigASIL"  SG_ 998 FRM_27_DetnMotionSts_028 2;
BA_ "GenSigASIL"  SG_ 998 FRM_27_DetnRngRadial_028 2;
BA_ "GenSigStartValue" SG_ 998 FRM_27_DetnAziAngle_028 900;
BA_ "GenSigASIL"  SG_ 998 FRM_27_DetnAziAngle_028 2;
BA_ "GenSigStartValue" SG_ 998 FRM_27_DetnElevnAngle_028 100;
BA_ "GenSigASIL"  SG_ 998 FRM_27_DetnElevnAngle_028 2;
BA_ "GenSigStartValue" SG_ 998 FRM_27_DetnRelVelRadial_028 10000;
BA_ "GenSigASIL"  SG_ 998 FRM_27_DetnRelVelRadial_028 2;
BA_ "GenSigASIL"  SG_ 998 FRM_27_DetnSNR_028 2;
BA_ "GenSigStartValue" SG_ 998 FRM_27_DetnRCS_028 5000;
BA_ "GenSigASIL"  SG_ 998 FRM_27_DetnRCS_028 2;
BA_ "GenSigASIL"  SG_ 998 FRM_27_DetnQuality_028 2;
BA_ "GenSigASIL"  SG_ 998 FRM_27_DetnMotionSts_029 2;
BA_ "GenSigASIL"  SG_ 998 FRM_27_DetnRngRadial_029 2;
BA_ "GenSigStartValue" SG_ 998 FRM_27_DetnAziAngle_029 900;
BA_ "GenSigASIL"  SG_ 998 FRM_27_DetnAziAngle_029 2;
BA_ "GenSigStartValue" SG_ 998 FRM_27_DetnElevnAngle_029 100;
BA_ "GenSigASIL"  SG_ 998 FRM_27_DetnElevnAngle_029 2;
BA_ "GenSigStartValue" SG_ 998 FRM_27_DetnRelVelRadial_029 10000;
BA_ "GenSigASIL"  SG_ 998 FRM_27_DetnRelVelRadial_029 2;
BA_ "GenSigASIL"  SG_ 998 FRM_27_DetnSNR_029 2;
BA_ "GenSigStartValue" SG_ 998 FRM_27_DetnRCS_029 5000;
BA_ "GenSigASIL"  SG_ 998 FRM_27_DetnRCS_029 2;
BA_ "GenSigASIL"  SG_ 998 FRM_27_DetnQuality_029 2;
BA_ "GenMsgILSupport" BO_ 999 1;
BA_ "GenMsgCycleTime" BO_ 999 50;
BA_ "GenSigASIL"  SG_ 999 FRM_28_CRC 5;
BA_ "GenSigASIL"  SG_ 999 FRM_28_RollgCntr 5;
BA_ "GenSigASIL"  SG_ 999 FRM_28_DetnBlockCounter 2;
BA_ "GenSigASIL"  SG_ 999 FRM_28_DetnMotionSts_030 2;
BA_ "GenSigASIL"  SG_ 999 FRM_28_DetnRngRadial_030 2;
BA_ "GenSigStartValue" SG_ 999 FRM_28_DetnAziAngle_030 900;
BA_ "GenSigASIL"  SG_ 999 FRM_28_DetnAziAngle_030 2;
BA_ "GenSigStartValue" SG_ 999 FRM_28_DetnElevnAngle_030 100;
BA_ "GenSigASIL"  SG_ 999 FRM_28_DetnElevnAngle_030 2;
BA_ "GenSigStartValue" SG_ 999 FRM_28_DetnRelVelRadial_030 10000;
BA_ "GenSigASIL"  SG_ 999 FRM_28_DetnRelVelRadial_030 2;
BA_ "GenSigASIL"  SG_ 999 FRM_28_DetnSNR_030 2;
BA_ "GenSigStartValue" SG_ 999 FRM_28_DetnRCS_030 5000;
BA_ "GenSigASIL"  SG_ 999 FRM_28_DetnRCS_030 2;
BA_ "GenSigASIL"  SG_ 999 FRM_28_DetnQuality_030 2;
BA_ "GenSigASIL"  SG_ 999 FRM_28_DetnMotionSts_031 2;
BA_ "GenSigASIL"  SG_ 999 FRM_28_DetnRngRadial_031 2;
BA_ "GenSigStartValue" SG_ 999 FRM_28_DetnAziAngle_031 900;
BA_ "GenSigASIL"  SG_ 999 FRM_28_DetnAziAngle_031 2;
BA_ "GenSigStartValue" SG_ 999 FRM_28_DetnElevnAngle_031 100;
BA_ "GenSigASIL"  SG_ 999 FRM_28_DetnElevnAngle_031 2;
BA_ "GenSigStartValue" SG_ 999 FRM_28_DetnRelVelRadial_031 10000;
BA_ "GenSigASIL"  SG_ 999 FRM_28_DetnRelVelRadial_031 2;
BA_ "GenSigASIL"  SG_ 999 FRM_28_DetnSNR_031 2;
BA_ "GenSigStartValue" SG_ 999 FRM_28_DetnRCS_031 5000;
BA_ "GenSigASIL"  SG_ 999 FRM_28_DetnRCS_031 2;
BA_ "GenSigASIL"  SG_ 999 FRM_28_DetnQuality_031 2;
BA_ "GenSigASIL"  SG_ 999 FRM_28_DetnMotionSts_032 2;
BA_ "GenSigASIL"  SG_ 999 FRM_28_DetnRngRadial_032 2;
BA_ "GenSigStartValue" SG_ 999 FRM_28_DetnAziAngle_032 900;
BA_ "GenSigASIL"  SG_ 999 FRM_28_DetnAziAngle_032 2;
BA_ "GenSigStartValue" SG_ 999 FRM_28_DetnElevnAngle_032 100;
BA_ "GenSigASIL"  SG_ 999 FRM_28_DetnElevnAngle_032 2;
BA_ "GenSigStartValue" SG_ 999 FRM_28_DetnRelVelRadial_032 10000;
BA_ "GenSigASIL"  SG_ 999 FRM_28_DetnRelVelRadial_032 2;
BA_ "GenSigASIL"  SG_ 999 FRM_28_DetnSNR_032 2;
BA_ "GenSigStartValue" SG_ 999 FRM_28_DetnRCS_032 5000;
BA_ "GenSigASIL"  SG_ 999 FRM_28_DetnRCS_032 2;
BA_ "GenSigASIL"  SG_ 999 FRM_28_DetnQuality_032 2;
BA_ "GenSigASIL"  SG_ 999 FRM_28_DetnMotionSts_033 2;
BA_ "GenSigASIL"  SG_ 999 FRM_28_DetnRngRadial_033 2;
BA_ "GenSigStartValue" SG_ 999 FRM_28_DetnAziAngle_033 900;
BA_ "GenSigASIL"  SG_ 999 FRM_28_DetnAziAngle_033 2;
BA_ "GenSigStartValue" SG_ 999 FRM_28_DetnElevnAngle_033 100;
BA_ "GenSigASIL"  SG_ 999 FRM_28_DetnElevnAngle_033 2;
BA_ "GenSigStartValue" SG_ 999 FRM_28_DetnRelVelRadial_033 10000;
BA_ "GenSigASIL"  SG_ 999 FRM_28_DetnRelVelRadial_033 2;
BA_ "GenSigASIL"  SG_ 999 FRM_28_DetnSNR_033 2;
BA_ "GenSigStartValue" SG_ 999 FRM_28_DetnRCS_033 5000;
BA_ "GenSigASIL"  SG_ 999 FRM_28_DetnRCS_033 2;
BA_ "GenSigASIL"  SG_ 999 FRM_28_DetnQuality_033 2;
BA_ "GenSigASIL"  SG_ 999 FRM_28_DetnMotionSts_034 2;
BA_ "GenSigASIL"  SG_ 999 FRM_28_DetnRngRadial_034 2;
BA_ "GenSigStartValue" SG_ 999 FRM_28_DetnAziAngle_034 900;
BA_ "GenSigASIL"  SG_ 999 FRM_28_DetnAziAngle_034 2;
BA_ "GenSigStartValue" SG_ 999 FRM_28_DetnElevnAngle_034 100;
BA_ "GenSigASIL"  SG_ 999 FRM_28_DetnElevnAngle_034 2;
BA_ "GenSigStartValue" SG_ 999 FRM_28_DetnRelVelRadial_034 10000;
BA_ "GenSigASIL"  SG_ 999 FRM_28_DetnRelVelRadial_034 2;
BA_ "GenSigASIL"  SG_ 999 FRM_28_DetnSNR_034 2;
BA_ "GenSigStartValue" SG_ 999 FRM_28_DetnRCS_034 5000;
BA_ "GenSigASIL"  SG_ 999 FRM_28_DetnRCS_034 2;
BA_ "GenSigASIL"  SG_ 999 FRM_28_DetnQuality_034 2;
BA_ "GenSigASIL"  SG_ 999 FRM_28_DetnMotionSts_035 2;
BA_ "GenSigASIL"  SG_ 999 FRM_28_DetnRngRadial_035 2;
BA_ "GenSigStartValue" SG_ 999 FRM_28_DetnAziAngle_035 900;
BA_ "GenSigASIL"  SG_ 999 FRM_28_DetnAziAngle_035 2;
BA_ "GenSigStartValue" SG_ 999 FRM_28_DetnElevnAngle_035 100;
BA_ "GenSigASIL"  SG_ 999 FRM_28_DetnElevnAngle_035 2;
BA_ "GenSigStartValue" SG_ 999 FRM_28_DetnRelVelRadial_035 10000;
BA_ "GenSigASIL"  SG_ 999 FRM_28_DetnRelVelRadial_035 2;
BA_ "GenSigASIL"  SG_ 999 FRM_28_DetnSNR_035 2;
BA_ "GenSigStartValue" SG_ 999 FRM_28_DetnRCS_035 5000;
BA_ "GenSigASIL"  SG_ 999 FRM_28_DetnRCS_035 2;
BA_ "GenSigASIL"  SG_ 999 FRM_28_DetnQuality_035 2;
BA_ "GenMsgILSupport" BO_ 1000 1;
BA_ "GenMsgCycleTime" BO_ 1000 50;
BA_ "GenSigASIL"  SG_ 1000 FRM_29_CRC 5;
BA_ "GenSigASIL"  SG_ 1000 FRM_29_RollgCntr 5;
BA_ "GenSigASIL"  SG_ 1000 FRM_29_DetnBlockCounter 2;
BA_ "GenSigASIL"  SG_ 1000 FRM_29_DetnMotionSts_036 2;
BA_ "GenSigASIL"  SG_ 1000 FRM_29_DetnRngRadial_036 2;
BA_ "GenSigStartValue" SG_ 1000 FRM_29_DetnAziAngle_036 900;
BA_ "GenSigASIL"  SG_ 1000 FRM_29_DetnAziAngle_036 2;
BA_ "GenSigStartValue" SG_ 1000 FRM_29_DetnElevnAngle_036 100;
BA_ "GenSigASIL"  SG_ 1000 FRM_29_DetnElevnAngle_036 2;
BA_ "GenSigStartValue" SG_ 1000 FRM_29_DetnRelVelRadial_036 10000;
BA_ "GenSigASIL"  SG_ 1000 FRM_29_DetnRelVelRadial_036 2;
BA_ "GenSigASIL"  SG_ 1000 FRM_29_DetnSNR_036 2;
BA_ "GenSigStartValue" SG_ 1000 FRM_29_DetnRCS_036 5000;
BA_ "GenSigASIL"  SG_ 1000 FRM_29_DetnRCS_036 2;
BA_ "GenSigASIL"  SG_ 1000 FRM_29_DetnQuality_036 2;
BA_ "GenSigASIL"  SG_ 1000 FRM_29_DetnMotionSts_037 2;
BA_ "GenSigASIL"  SG_ 1000 FRM_29_DetnRngRadial_037 2;
BA_ "GenSigStartValue" SG_ 1000 FRM_29_DetnAziAngle_037 900;
BA_ "GenSigASIL"  SG_ 1000 FRM_29_DetnAziAngle_037 2;
BA_ "GenSigStartValue" SG_ 1000 FRM_29_DetnElevnAngle_037 100;
BA_ "GenSigASIL"  SG_ 1000 FRM_29_DetnElevnAngle_037 2;
BA_ "GenSigStartValue" SG_ 1000 FRM_29_DetnRelVelRadial_037 10000;
BA_ "GenSigASIL"  SG_ 1000 FRM_29_DetnRelVelRadial_037 2;
BA_ "GenSigASIL"  SG_ 1000 FRM_29_DetnSNR_037 2;
BA_ "GenSigStartValue" SG_ 1000 FRM_29_DetnRCS_037 5000;
BA_ "GenSigASIL"  SG_ 1000 FRM_29_DetnRCS_037 2;
BA_ "GenSigASIL"  SG_ 1000 FRM_29_DetnQuality_037 2;
BA_ "GenSigASIL"  SG_ 1000 FRM_29_DetnMotionSts_038 2;
BA_ "GenSigASIL"  SG_ 1000 FRM_29_DetnRngRadial_038 2;
BA_ "GenSigStartValue" SG_ 1000 FRM_29_DetnAziAngle_038 900;
BA_ "GenSigASIL"  SG_ 1000 FRM_29_DetnAziAngle_038 2;
BA_ "GenSigStartValue" SG_ 1000 FRM_29_DetnElevnAngle_038 100;
BA_ "GenSigASIL"  SG_ 1000 FRM_29_DetnElevnAngle_038 2;
BA_ "GenSigStartValue" SG_ 1000 FRM_29_DetnRelVelRadial_038 10000;
BA_ "GenSigASIL"  SG_ 1000 FRM_29_DetnRelVelRadial_038 2;
BA_ "GenSigASIL"  SG_ 1000 FRM_29_DetnSNR_038 2;
BA_ "GenSigStartValue" SG_ 1000 FRM_29_DetnRCS_038 5000;
BA_ "GenSigASIL"  SG_ 1000 FRM_29_DetnRCS_038 2;
BA_ "GenSigASIL"  SG_ 1000 FRM_29_DetnQuality_038 2;
BA_ "GenSigASIL"  SG_ 1000 FRM_29_DetnMotionSts_039 2;
BA_ "GenSigASIL"  SG_ 1000 FRM_29_DetnRngRadial_039 2;
BA_ "GenSigStartValue" SG_ 1000 FRM_29_DetnAziAngle_039 900;
BA_ "GenSigASIL"  SG_ 1000 FRM_29_DetnAziAngle_039 2;
BA_ "GenSigStartValue" SG_ 1000 FRM_29_DetnElevnAngle_039 100;
BA_ "GenSigASIL"  SG_ 1000 FRM_29_DetnElevnAngle_039 2;
BA_ "GenSigStartValue" SG_ 1000 FRM_29_DetnRelVelRadial_039 10000;
BA_ "GenSigASIL"  SG_ 1000 FRM_29_DetnRelVelRadial_039 2;
BA_ "GenSigASIL"  SG_ 1000 FRM_29_DetnSNR_039 2;
BA_ "GenSigStartValue" SG_ 1000 FRM_29_DetnRCS_039 5000;
BA_ "GenSigASIL"  SG_ 1000 FRM_29_DetnRCS_039 2;
BA_ "GenSigASIL"  SG_ 1000 FRM_29_DetnQuality_039 2;
BA_ "GenSigASIL"  SG_ 1000 FRM_29_DetnMotionSts_040 2;
BA_ "GenSigASIL"  SG_ 1000 FRM_29_DetnRngRadial_040 2;
BA_ "GenSigStartValue" SG_ 1000 FRM_29_DetnAziAngle_040 900;
BA_ "GenSigASIL"  SG_ 1000 FRM_29_DetnAziAngle_040 2;
BA_ "GenSigStartValue" SG_ 1000 FRM_29_DetnElevnAngle_040 100;
BA_ "GenSigASIL"  SG_ 1000 FRM_29_DetnElevnAngle_040 2;
BA_ "GenSigStartValue" SG_ 1000 FRM_29_DetnRelVelRadial_040 10000;
BA_ "GenSigASIL"  SG_ 1000 FRM_29_DetnRelVelRadial_040 2;
BA_ "GenSigASIL"  SG_ 1000 FRM_29_DetnSNR_040 2;
BA_ "GenSigStartValue" SG_ 1000 FRM_29_DetnRCS_040 5000;
BA_ "GenSigASIL"  SG_ 1000 FRM_29_DetnRCS_040 2;
BA_ "GenSigASIL"  SG_ 1000 FRM_29_DetnQuality_040 2;
BA_ "GenSigASIL"  SG_ 1000 FRM_29_DetnMotionSts_041 2;
BA_ "GenSigASIL"  SG_ 1000 FRM_29_DetnRngRadial_041 2;
BA_ "GenSigStartValue" SG_ 1000 FRM_29_DetnAziAngle_041 900;
BA_ "GenSigASIL"  SG_ 1000 FRM_29_DetnAziAngle_041 2;
BA_ "GenSigStartValue" SG_ 1000 FRM_29_DetnElevnAngle_041 100;
BA_ "GenSigASIL"  SG_ 1000 FRM_29_DetnElevnAngle_041 2;
BA_ "GenSigStartValue" SG_ 1000 FRM_29_DetnRelVelRadial_041 10000;
BA_ "GenSigASIL"  SG_ 1000 FRM_29_DetnRelVelRadial_041 2;
BA_ "GenSigASIL"  SG_ 1000 FRM_29_DetnSNR_041 2;
BA_ "GenSigStartValue" SG_ 1000 FRM_29_DetnRCS_041 5000;
BA_ "GenSigASIL"  SG_ 1000 FRM_29_DetnRCS_041 2;
BA_ "GenSigASIL"  SG_ 1000 FRM_29_DetnQuality_041 2;
BA_ "GenMsgILSupport" BO_ 1001 1;
BA_ "GenMsgCycleTime" BO_ 1001 50;
BA_ "GenSigASIL"  SG_ 1001 FRM_30_CRC 5;
BA_ "GenSigASIL"  SG_ 1001 FRM_30_RollgCntr 5;
BA_ "GenSigASIL"  SG_ 1001 FRM_30_DetnBlockCounter 2;
BA_ "GenSigASIL"  SG_ 1001 FRM_30_DetnMotionSts_042 2;
BA_ "GenSigASIL"  SG_ 1001 FRM_30_DetnRngRadial_042 2;
BA_ "GenSigStartValue" SG_ 1001 FRM_30_DetnAziAngle_042 900;
BA_ "GenSigASIL"  SG_ 1001 FRM_30_DetnAziAngle_042 2;
BA_ "GenSigStartValue" SG_ 1001 FRM_30_DetnElevnAngle_042 100;
BA_ "GenSigASIL"  SG_ 1001 FRM_30_DetnElevnAngle_042 2;
BA_ "GenSigStartValue" SG_ 1001 FRM_30_DetnRelVelRadial_042 10000;
BA_ "GenSigASIL"  SG_ 1001 FRM_30_DetnRelVelRadial_042 2;
BA_ "GenSigASIL"  SG_ 1001 FRM_30_DetnSNR_042 2;
BA_ "GenSigStartValue" SG_ 1001 FRM_30_DetnRCS_042 5000;
BA_ "GenSigASIL"  SG_ 1001 FRM_30_DetnRCS_042 2;
BA_ "GenSigASIL"  SG_ 1001 FRM_30_DetnQuality_042 2;
BA_ "GenSigASIL"  SG_ 1001 FRM_30_DetnMotionSts_043 2;
BA_ "GenSigASIL"  SG_ 1001 FRM_30_DetnRngRadial_043 2;
BA_ "GenSigStartValue" SG_ 1001 FRM_30_DetnAziAngle_043 900;
BA_ "GenSigASIL"  SG_ 1001 FRM_30_DetnAziAngle_043 2;
BA_ "GenSigStartValue" SG_ 1001 FRM_30_DetnElevnAngle_043 100;
BA_ "GenSigASIL"  SG_ 1001 FRM_30_DetnElevnAngle_043 2;
BA_ "GenSigStartValue" SG_ 1001 FRM_30_DetnRelVelRadial_043 10000;
BA_ "GenSigASIL"  SG_ 1001 FRM_30_DetnRelVelRadial_043 2;
BA_ "GenSigASIL"  SG_ 1001 FRM_30_DetnSNR_043 2;
BA_ "GenSigStartValue" SG_ 1001 FRM_30_DetnRCS_043 5000;
BA_ "GenSigASIL"  SG_ 1001 FRM_30_DetnRCS_043 2;
BA_ "GenSigASIL"  SG_ 1001 FRM_30_DetnQuality_043 2;
BA_ "GenSigASIL"  SG_ 1001 FRM_30_DetnMotionSts_044 2;
BA_ "GenSigASIL"  SG_ 1001 FRM_30_DetnRngRadial_044 2;
BA_ "GenSigStartValue" SG_ 1001 FRM_30_DetnAziAngle_044 900;
BA_ "GenSigASIL"  SG_ 1001 FRM_30_DetnAziAngle_044 2;
BA_ "GenSigStartValue" SG_ 1001 FRM_30_DetnElevnAngle_044 100;
BA_ "GenSigASIL"  SG_ 1001 FRM_30_DetnElevnAngle_044 2;
BA_ "GenSigStartValue" SG_ 1001 FRM_30_DetnRelVelRadial_044 10000;
BA_ "GenSigASIL"  SG_ 1001 FRM_30_DetnRelVelRadial_044 2;
BA_ "GenSigASIL"  SG_ 1001 FRM_30_DetnSNR_044 2;
BA_ "GenSigStartValue" SG_ 1001 FRM_30_DetnRCS_044 5000;
BA_ "GenSigASIL"  SG_ 1001 FRM_30_DetnRCS_044 2;
BA_ "GenSigASIL"  SG_ 1001 FRM_30_DetnQuality_044 2;
BA_ "GenSigASIL"  SG_ 1001 FRM_30_DetnMotionSts_045 2;
BA_ "GenSigASIL"  SG_ 1001 FRM_30_DetnRngRadial_045 2;
BA_ "GenSigStartValue" SG_ 1001 FRM_30_DetnAziAngle_045 900;
BA_ "GenSigASIL"  SG_ 1001 FRM_30_DetnAziAngle_045 2;
BA_ "GenSigStartValue" SG_ 1001 FRM_30_DetnElevnAngle_045 100;
BA_ "GenSigASIL"  SG_ 1001 FRM_30_DetnElevnAngle_045 2;
BA_ "GenSigStartValue" SG_ 1001 FRM_30_DetnRelVelRadial_045 10000;
BA_ "GenSigASIL"  SG_ 1001 FRM_30_DetnRelVelRadial_045 2;
BA_ "GenSigASIL"  SG_ 1001 FRM_30_DetnSNR_045 2;
BA_ "GenSigStartValue" SG_ 1001 FRM_30_DetnRCS_045 5000;
BA_ "GenSigASIL"  SG_ 1001 FRM_30_DetnRCS_045 2;
BA_ "GenSigASIL"  SG_ 1001 FRM_30_DetnQuality_045 2;
BA_ "GenSigASIL"  SG_ 1001 FRM_30_DetnMotionSts_046 2;
BA_ "GenSigASIL"  SG_ 1001 FRM_30_DetnRngRadial_046 2;
BA_ "GenSigStartValue" SG_ 1001 FRM_30_DetnAziAngle_046 900;
BA_ "GenSigASIL"  SG_ 1001 FRM_30_DetnAziAngle_046 2;
BA_ "GenSigStartValue" SG_ 1001 FRM_30_DetnElevnAngle_046 100;
BA_ "GenSigASIL"  SG_ 1001 FRM_30_DetnElevnAngle_046 2;
BA_ "GenSigStartValue" SG_ 1001 FRM_30_DetnRelVelRadial_046 10000;
BA_ "GenSigASIL"  SG_ 1001 FRM_30_DetnRelVelRadial_046 2;
BA_ "GenSigASIL"  SG_ 1001 FRM_30_DetnSNR_046 2;
BA_ "GenSigStartValue" SG_ 1001 FRM_30_DetnRCS_046 5000;
BA_ "GenSigASIL"  SG_ 1001 FRM_30_DetnRCS_046 2;
BA_ "GenSigASIL"  SG_ 1001 FRM_30_DetnQuality_046 2;
BA_ "GenSigASIL"  SG_ 1001 FRM_30_DetnMotionSts_047 2;
BA_ "GenSigASIL"  SG_ 1001 FRM_30_DetnRngRadial_047 2;
BA_ "GenSigStartValue" SG_ 1001 FRM_30_DetnAziAngle_047 900;
BA_ "GenSigASIL"  SG_ 1001 FRM_30_DetnAziAngle_047 2;
BA_ "GenSigStartValue" SG_ 1001 FRM_30_DetnElevnAngle_047 100;
BA_ "GenSigASIL"  SG_ 1001 FRM_30_DetnElevnAngle_047 2;
BA_ "GenSigStartValue" SG_ 1001 FRM_30_DetnRelVelRadial_047 10000;
BA_ "GenSigASIL"  SG_ 1001 FRM_30_DetnRelVelRadial_047 2;
BA_ "GenSigASIL"  SG_ 1001 FRM_30_DetnSNR_047 2;
BA_ "GenSigStartValue" SG_ 1001 FRM_30_DetnRCS_047 5000;
BA_ "GenSigASIL"  SG_ 1001 FRM_30_DetnRCS_047 2;
BA_ "GenSigASIL"  SG_ 1001 FRM_30_DetnQuality_047 2;
BA_ "GenMsgILSupport" BO_ 1002 1;
BA_ "GenMsgCycleTime" BO_ 1002 50;
BA_ "GenSigASIL"  SG_ 1002 FRM_31_CRC 5;
BA_ "GenSigASIL"  SG_ 1002 FRM_31_RollgCntr 5;
BA_ "GenSigASIL"  SG_ 1002 FRM_31_DetnBlockCounter 2;
BA_ "GenSigASIL"  SG_ 1002 FRM_31_DetnMotionSts_048 2;
BA_ "GenSigASIL"  SG_ 1002 FRM_31_DetnRngRadial_048 2;
BA_ "GenSigStartValue" SG_ 1002 FRM_31_DetnAziAngle_048 900;
BA_ "GenSigASIL"  SG_ 1002 FRM_31_DetnAziAngle_048 2;
BA_ "GenSigStartValue" SG_ 1002 FRM_31_DetnElevnAngle_048 100;
BA_ "GenSigASIL"  SG_ 1002 FRM_31_DetnElevnAngle_048 2;
BA_ "GenSigStartValue" SG_ 1002 FRM_31_DetnRelVelRadial_048 10000;
BA_ "GenSigASIL"  SG_ 1002 FRM_31_DetnRelVelRadial_048 2;
BA_ "GenSigASIL"  SG_ 1002 FRM_31_DetnSNR_048 2;
BA_ "GenSigStartValue" SG_ 1002 FRM_31_DetnRCS_048 5000;
BA_ "GenSigASIL"  SG_ 1002 FRM_31_DetnRCS_048 2;
BA_ "GenSigASIL"  SG_ 1002 FRM_31_DetnQuality_048 2;
BA_ "GenSigASIL"  SG_ 1002 FRM_31_DetnMotionSts_049 2;
BA_ "GenSigASIL"  SG_ 1002 FRM_31_DetnRngRadial_049 2;
BA_ "GenSigStartValue" SG_ 1002 FRM_31_DetnAziAngle_049 900;
BA_ "GenSigASIL"  SG_ 1002 FRM_31_DetnAziAngle_049 2;
BA_ "GenSigStartValue" SG_ 1002 FRM_31_DetnElevnAngle_049 100;
BA_ "GenSigASIL"  SG_ 1002 FRM_31_DetnElevnAngle_049 2;
BA_ "GenSigStartValue" SG_ 1002 FRM_31_DetnRelVelRadial_049 10000;
BA_ "GenSigASIL"  SG_ 1002 FRM_31_DetnRelVelRadial_049 2;
BA_ "GenSigASIL"  SG_ 1002 FRM_31_DetnSNR_049 2;
BA_ "GenSigStartValue" SG_ 1002 FRM_31_DetnRCS_049 5000;
BA_ "GenSigASIL"  SG_ 1002 FRM_31_DetnRCS_049 2;
BA_ "GenSigASIL"  SG_ 1002 FRM_31_DetnQuality_049 2;
BA_ "GenSigASIL"  SG_ 1002 FRM_31_DetnMotionSts_050 2;
BA_ "GenSigASIL"  SG_ 1002 FRM_31_DetnRngRadial_050 2;
BA_ "GenSigStartValue" SG_ 1002 FRM_31_DetnAziAngle_050 900;
BA_ "GenSigASIL"  SG_ 1002 FRM_31_DetnAziAngle_050 2;
BA_ "GenSigStartValue" SG_ 1002 FRM_31_DetnElevnAngle_050 100;
BA_ "GenSigASIL"  SG_ 1002 FRM_31_DetnElevnAngle_050 2;
BA_ "GenSigStartValue" SG_ 1002 FRM_31_DetnRelVelRadial_050 10000;
BA_ "GenSigASIL"  SG_ 1002 FRM_31_DetnRelVelRadial_050 2;
BA_ "GenSigASIL"  SG_ 1002 FRM_31_DetnSNR_050 2;
BA_ "GenSigStartValue" SG_ 1002 FRM_31_DetnRCS_050 5000;
BA_ "GenSigASIL"  SG_ 1002 FRM_31_DetnRCS_050 2;
BA_ "GenSigASIL"  SG_ 1002 FRM_31_DetnQuality_050 2;
BA_ "GenSigASIL"  SG_ 1002 FRM_31_DetnMotionSts_051 2;
BA_ "GenSigASIL"  SG_ 1002 FRM_31_DetnRngRadial_051 2;
BA_ "GenSigStartValue" SG_ 1002 FRM_31_DetnAziAngle_051 900;
BA_ "GenSigASIL"  SG_ 1002 FRM_31_DetnAziAngle_051 2;
BA_ "GenSigStartValue" SG_ 1002 FRM_31_DetnElevnAngle_051 100;
BA_ "GenSigASIL"  SG_ 1002 FRM_31_DetnElevnAngle_051 2;
BA_ "GenSigStartValue" SG_ 1002 FRM_31_DetnRelVelRadial_051 10000;
BA_ "GenSigASIL"  SG_ 1002 FRM_31_DetnRelVelRadial_051 2;
BA_ "GenSigASIL"  SG_ 1002 FRM_31_DetnSNR_051 2;
BA_ "GenSigStartValue" SG_ 1002 FRM_31_DetnRCS_051 5000;
BA_ "GenSigASIL"  SG_ 1002 FRM_31_DetnRCS_051 2;
BA_ "GenSigASIL"  SG_ 1002 FRM_31_DetnQuality_051 2;
BA_ "GenSigASIL"  SG_ 1002 FRM_31_DetnMotionSts_052 2;
BA_ "GenSigASIL"  SG_ 1002 FRM_31_DetnRngRadial_052 2;
BA_ "GenSigStartValue" SG_ 1002 FRM_31_DetnAziAngle_052 900;
BA_ "GenSigASIL"  SG_ 1002 FRM_31_DetnAziAngle_052 2;
BA_ "GenSigStartValue" SG_ 1002 FRM_31_DetnElevnAngle_052 100;
BA_ "GenSigASIL"  SG_ 1002 FRM_31_DetnElevnAngle_052 2;
BA_ "GenSigStartValue" SG_ 1002 FRM_31_DetnRelVelRadial_052 10000;
BA_ "GenSigASIL"  SG_ 1002 FRM_31_DetnRelVelRadial_052 2;
BA_ "GenSigASIL"  SG_ 1002 FRM_31_DetnSNR_052 2;
BA_ "GenSigStartValue" SG_ 1002 FRM_31_DetnRCS_052 5000;
BA_ "GenSigASIL"  SG_ 1002 FRM_31_DetnRCS_052 2;
BA_ "GenSigASIL"  SG_ 1002 FRM_31_DetnQuality_052 2;
BA_ "GenSigASIL"  SG_ 1002 FRM_31_DetnMotionSts_053 2;
BA_ "GenSigASIL"  SG_ 1002 FRM_31_DetnRngRadial_053 2;
BA_ "GenSigStartValue" SG_ 1002 FRM_31_DetnAziAngle_053 900;
BA_ "GenSigASIL"  SG_ 1002 FRM_31_DetnAziAngle_053 2;
BA_ "GenSigStartValue" SG_ 1002 FRM_31_DetnElevnAngle_053 100;
BA_ "GenSigASIL"  SG_ 1002 FRM_31_DetnElevnAngle_053 2;
BA_ "GenSigStartValue" SG_ 1002 FRM_31_DetnRelVelRadial_053 10000;
BA_ "GenSigASIL"  SG_ 1002 FRM_31_DetnRelVelRadial_053 2;
BA_ "GenSigASIL"  SG_ 1002 FRM_31_DetnSNR_053 2;
BA_ "GenSigStartValue" SG_ 1002 FRM_31_DetnRCS_053 5000;
BA_ "GenSigASIL"  SG_ 1002 FRM_31_DetnRCS_053 2;
BA_ "GenSigASIL"  SG_ 1002 FRM_31_DetnQuality_053 2;
BA_ "GenMsgILSupport" BO_ 1003 1;
BA_ "GenMsgCycleTime" BO_ 1003 50;
BA_ "GenSigASIL"  SG_ 1003 FRM_32_CRC 5;
BA_ "GenSigASIL"  SG_ 1003 FRM_32_RollgCntr 5;
BA_ "GenSigASIL"  SG_ 1003 FRM_32_DetnBlockCounter 2;
BA_ "GenSigASIL"  SG_ 1003 FRM_32_DetnMotionSts_054 2;
BA_ "GenSigASIL"  SG_ 1003 FRM_32_DetnRngRadial_054 2;
BA_ "GenSigStartValue" SG_ 1003 FRM_32_DetnAziAngle_054 900;
BA_ "GenSigASIL"  SG_ 1003 FRM_32_DetnAziAngle_054 2;
BA_ "GenSigStartValue" SG_ 1003 FRM_32_DetnElevnAngle_054 100;
BA_ "GenSigASIL"  SG_ 1003 FRM_32_DetnElevnAngle_054 2;
BA_ "GenSigStartValue" SG_ 1003 FRM_32_DetnRelVelRadial_054 10000;
BA_ "GenSigASIL"  SG_ 1003 FRM_32_DetnRelVelRadial_054 2;
BA_ "GenSigASIL"  SG_ 1003 FRM_32_DetnSNR_054 2;
BA_ "GenSigStartValue" SG_ 1003 FRM_32_DetnRCS_054 5000;
BA_ "GenSigASIL"  SG_ 1003 FRM_32_DetnRCS_054 2;
BA_ "GenSigASIL"  SG_ 1003 FRM_32_DetnQuality_054 2;
BA_ "GenSigASIL"  SG_ 1003 FRM_32_DetnMotionSts_055 2;
BA_ "GenSigASIL"  SG_ 1003 FRM_32_DetnRngRadial_055 2;
BA_ "GenSigStartValue" SG_ 1003 FRM_32_DetnAziAngle_055 900;
BA_ "GenSigASIL"  SG_ 1003 FRM_32_DetnAziAngle_055 2;
BA_ "GenSigStartValue" SG_ 1003 FRM_32_DetnElevnAngle_055 100;
BA_ "GenSigASIL"  SG_ 1003 FRM_32_DetnElevnAngle_055 2;
BA_ "GenSigStartValue" SG_ 1003 FRM_32_DetnRelVelRadial_055 10000;
BA_ "GenSigASIL"  SG_ 1003 FRM_32_DetnRelVelRadial_055 2;
BA_ "GenSigASIL"  SG_ 1003 FRM_32_DetnSNR_055 2;
BA_ "GenSigStartValue" SG_ 1003 FRM_32_DetnRCS_055 5000;
BA_ "GenSigASIL"  SG_ 1003 FRM_32_DetnRCS_055 2;
BA_ "GenSigASIL"  SG_ 1003 FRM_32_DetnQuality_055 2;
BA_ "GenSigASIL"  SG_ 1003 FRM_32_DetnMotionSts_056 2;
BA_ "GenSigASIL"  SG_ 1003 FRM_32_DetnRngRadial_056 2;
BA_ "GenSigStartValue" SG_ 1003 FRM_32_DetnAziAngle_056 900;
BA_ "GenSigASIL"  SG_ 1003 FRM_32_DetnAziAngle_056 2;
BA_ "GenSigStartValue" SG_ 1003 FRM_32_DetnElevnAngle_056 100;
BA_ "GenSigASIL"  SG_ 1003 FRM_32_DetnElevnAngle_056 2;
BA_ "GenSigStartValue" SG_ 1003 FRM_32_DetnRelVelRadial_056 10000;
BA_ "GenSigASIL"  SG_ 1003 FRM_32_DetnRelVelRadial_056 2;
BA_ "GenSigASIL"  SG_ 1003 FRM_32_DetnSNR_056 2;
BA_ "GenSigStartValue" SG_ 1003 FRM_32_DetnRCS_056 5000;
BA_ "GenSigASIL"  SG_ 1003 FRM_32_DetnRCS_056 2;
BA_ "GenSigASIL"  SG_ 1003 FRM_32_DetnQuality_056 2;
BA_ "GenSigASIL"  SG_ 1003 FRM_32_DetnMotionSts_057 2;
BA_ "GenSigASIL"  SG_ 1003 FRM_32_DetnRngRadial_057 2;
BA_ "GenSigStartValue" SG_ 1003 FRM_32_DetnAziAngle_057 900;
BA_ "GenSigASIL"  SG_ 1003 FRM_32_DetnAziAngle_057 2;
BA_ "GenSigStartValue" SG_ 1003 FRM_32_DetnElevnAngle_057 100;
BA_ "GenSigASIL"  SG_ 1003 FRM_32_DetnElevnAngle_057 2;
BA_ "GenSigStartValue" SG_ 1003 FRM_32_DetnRelVelRadial_057 10000;
BA_ "GenSigASIL"  SG_ 1003 FRM_32_DetnRelVelRadial_057 2;
BA_ "GenSigASIL"  SG_ 1003 FRM_32_DetnSNR_057 2;
BA_ "GenSigStartValue" SG_ 1003 FRM_32_DetnRCS_057 5000;
BA_ "GenSigASIL"  SG_ 1003 FRM_32_DetnRCS_057 2;
BA_ "GenSigASIL"  SG_ 1003 FRM_32_DetnQuality_057 2;
BA_ "GenSigASIL"  SG_ 1003 FRM_32_DetnMotionSts_058 2;
BA_ "GenSigASIL"  SG_ 1003 FRM_32_DetnRngRadial_058 2;
BA_ "GenSigStartValue" SG_ 1003 FRM_32_DetnAziAngle_058 900;
BA_ "GenSigASIL"  SG_ 1003 FRM_32_DetnAziAngle_058 2;
BA_ "GenSigStartValue" SG_ 1003 FRM_32_DetnElevnAngle_058 100;
BA_ "GenSigASIL"  SG_ 1003 FRM_32_DetnElevnAngle_058 2;
BA_ "GenSigStartValue" SG_ 1003 FRM_32_DetnRelVelRadial_058 10000;
BA_ "GenSigASIL"  SG_ 1003 FRM_32_DetnRelVelRadial_058 2;
BA_ "GenSigASIL"  SG_ 1003 FRM_32_DetnSNR_058 2;
BA_ "GenSigStartValue" SG_ 1003 FRM_32_DetnRCS_058 5000;
BA_ "GenSigASIL"  SG_ 1003 FRM_32_DetnRCS_058 2;
BA_ "GenSigASIL"  SG_ 1003 FRM_32_DetnQuality_058 2;
BA_ "GenSigASIL"  SG_ 1003 FRM_32_DetnMotionSts_059 2;
BA_ "GenSigASIL"  SG_ 1003 FRM_32_DetnRngRadial_059 2;
BA_ "GenSigStartValue" SG_ 1003 FRM_32_DetnAziAngle_059 900;
BA_ "GenSigASIL"  SG_ 1003 FRM_32_DetnAziAngle_059 2;
BA_ "GenSigStartValue" SG_ 1003 FRM_32_DetnElevnAngle_059 100;
BA_ "GenSigASIL"  SG_ 1003 FRM_32_DetnElevnAngle_059 2;
BA_ "GenSigStartValue" SG_ 1003 FRM_32_DetnRelVelRadial_059 10000;
BA_ "GenSigASIL"  SG_ 1003 FRM_32_DetnRelVelRadial_059 2;
BA_ "GenSigASIL"  SG_ 1003 FRM_32_DetnSNR_059 2;
BA_ "GenSigStartValue" SG_ 1003 FRM_32_DetnRCS_059 5000;
BA_ "GenSigASIL"  SG_ 1003 FRM_32_DetnRCS_059 2;
BA_ "GenSigASIL"  SG_ 1003 FRM_32_DetnQuality_059 2;
BA_ "GenMsgILSupport" BO_ 1004 1;
BA_ "GenMsgCycleTime" BO_ 1004 50;
BA_ "GenSigASIL"  SG_ 1004 FRM_33_CRC 5;
BA_ "GenSigASIL"  SG_ 1004 FRM_33_RollgCntr 5;
BA_ "GenSigASIL"  SG_ 1004 FRM_33_DetnBlockCounter 2;
BA_ "GenSigASIL"  SG_ 1004 FRM_33_DetnMotionSts_060 2;
BA_ "GenSigASIL"  SG_ 1004 FRM_33_DetnRngRadial_060 2;
BA_ "GenSigStartValue" SG_ 1004 FRM_33_DetnAziAngle_060 900;
BA_ "GenSigASIL"  SG_ 1004 FRM_33_DetnAziAngle_060 2;
BA_ "GenSigStartValue" SG_ 1004 FRM_33_DetnElevnAngle_060 100;
BA_ "GenSigASIL"  SG_ 1004 FRM_33_DetnElevnAngle_060 2;
BA_ "GenSigStartValue" SG_ 1004 FRM_33_DetnRelVelRadial_060 10000;
BA_ "GenSigASIL"  SG_ 1004 FRM_33_DetnRelVelRadial_060 2;
BA_ "GenSigASIL"  SG_ 1004 FRM_33_DetnSNR_060 2;
BA_ "GenSigStartValue" SG_ 1004 FRM_33_DetnRCS_060 5000;
BA_ "GenSigASIL"  SG_ 1004 FRM_33_DetnRCS_060 2;
BA_ "GenSigASIL"  SG_ 1004 FRM_33_DetnQuality_060 2;
BA_ "GenSigASIL"  SG_ 1004 FRM_33_DetnMotionSts_061 2;
BA_ "GenSigASIL"  SG_ 1004 FRM_33_DetnRngRadial_061 2;
BA_ "GenSigStartValue" SG_ 1004 FRM_33_DetnAziAngle_061 900;
BA_ "GenSigASIL"  SG_ 1004 FRM_33_DetnAziAngle_061 2;
BA_ "GenSigStartValue" SG_ 1004 FRM_33_DetnElevnAngle_061 100;
BA_ "GenSigASIL"  SG_ 1004 FRM_33_DetnElevnAngle_061 2;
BA_ "GenSigStartValue" SG_ 1004 FRM_33_DetnRelVelRadial_061 10000;
BA_ "GenSigASIL"  SG_ 1004 FRM_33_DetnRelVelRadial_061 2;
BA_ "GenSigASIL"  SG_ 1004 FRM_33_DetnSNR_061 2;
BA_ "GenSigStartValue" SG_ 1004 FRM_33_DetnRCS_061 5000;
BA_ "GenSigASIL"  SG_ 1004 FRM_33_DetnRCS_061 2;
BA_ "GenSigASIL"  SG_ 1004 FRM_33_DetnQuality_061 2;
BA_ "GenSigASIL"  SG_ 1004 FRM_33_DetnMotionSts_062 2;
BA_ "GenSigASIL"  SG_ 1004 FRM_33_DetnRngRadial_062 2;
BA_ "GenSigStartValue" SG_ 1004 FRM_33_DetnAziAngle_062 900;
BA_ "GenSigASIL"  SG_ 1004 FRM_33_DetnAziAngle_062 2;
BA_ "GenSigStartValue" SG_ 1004 FRM_33_DetnElevnAngle_062 100;
BA_ "GenSigASIL"  SG_ 1004 FRM_33_DetnElevnAngle_062 2;
BA_ "GenSigStartValue" SG_ 1004 FRM_33_DetnRelVelRadial_062 10000;
BA_ "GenSigASIL"  SG_ 1004 FRM_33_DetnRelVelRadial_062 2;
BA_ "GenSigASIL"  SG_ 1004 FRM_33_DetnSNR_062 2;
BA_ "GenSigStartValue" SG_ 1004 FRM_33_DetnRCS_062 5000;
BA_ "GenSigASIL"  SG_ 1004 FRM_33_DetnRCS_062 2;
BA_ "GenSigASIL"  SG_ 1004 FRM_33_DetnQuality_062 2;
BA_ "GenSigASIL"  SG_ 1004 FRM_33_DetnMotionSts_063 2;
BA_ "GenSigASIL"  SG_ 1004 FRM_33_DetnRngRadial_063 2;
BA_ "GenSigStartValue" SG_ 1004 FRM_33_DetnAziAngle_063 900;
BA_ "GenSigASIL"  SG_ 1004 FRM_33_DetnAziAngle_063 2;
BA_ "GenSigStartValue" SG_ 1004 FRM_33_DetnElevnAngle_063 100;
BA_ "GenSigASIL"  SG_ 1004 FRM_33_DetnElevnAngle_063 2;
BA_ "GenSigStartValue" SG_ 1004 FRM_33_DetnRelVelRadial_063 10000;
BA_ "GenSigASIL"  SG_ 1004 FRM_33_DetnRelVelRadial_063 2;
BA_ "GenSigASIL"  SG_ 1004 FRM_33_DetnSNR_063 2;
BA_ "GenSigStartValue" SG_ 1004 FRM_33_DetnRCS_063 5000;
BA_ "GenSigASIL"  SG_ 1004 FRM_33_DetnRCS_063 2;
BA_ "GenSigASIL"  SG_ 1004 FRM_33_DetnQuality_063 2;
BA_ "GenSigASIL"  SG_ 1004 FRM_33_DetnMotionSts_064 2;
BA_ "GenSigASIL"  SG_ 1004 FRM_33_DetnRngRadial_064 2;
BA_ "GenSigStartValue" SG_ 1004 FRM_33_DetnAziAngle_064 900;
BA_ "GenSigASIL"  SG_ 1004 FRM_33_DetnAziAngle_064 2;
BA_ "GenSigStartValue" SG_ 1004 FRM_33_DetnElevnAngle_064 100;
BA_ "GenSigASIL"  SG_ 1004 FRM_33_DetnElevnAngle_064 2;
BA_ "GenSigStartValue" SG_ 1004 FRM_33_DetnRelVelRadial_064 10000;
BA_ "GenSigASIL"  SG_ 1004 FRM_33_DetnRelVelRadial_064 2;
BA_ "GenSigASIL"  SG_ 1004 FRM_33_DetnSNR_064 2;
BA_ "GenSigStartValue" SG_ 1004 FRM_33_DetnRCS_064 5000;
BA_ "GenSigASIL"  SG_ 1004 FRM_33_DetnRCS_064 2;
BA_ "GenSigASIL"  SG_ 1004 FRM_33_DetnQuality_064 2;
BA_ "GenSigASIL"  SG_ 1004 FRM_33_DetnMotionSts_065 2;
BA_ "GenSigASIL"  SG_ 1004 FRM_33_DetnRngRadial_065 2;
BA_ "GenSigStartValue" SG_ 1004 FRM_33_DetnAziAngle_065 900;
BA_ "GenSigASIL"  SG_ 1004 FRM_33_DetnAziAngle_065 2;
BA_ "GenSigStartValue" SG_ 1004 FRM_33_DetnElevnAngle_065 100;
BA_ "GenSigASIL"  SG_ 1004 FRM_33_DetnElevnAngle_065 2;
BA_ "GenSigStartValue" SG_ 1004 FRM_33_DetnRelVelRadial_065 10000;
BA_ "GenSigASIL"  SG_ 1004 FRM_33_DetnRelVelRadial_065 2;
BA_ "GenSigASIL"  SG_ 1004 FRM_33_DetnSNR_065 2;
BA_ "GenSigStartValue" SG_ 1004 FRM_33_DetnRCS_065 5000;
BA_ "GenSigASIL"  SG_ 1004 FRM_33_DetnRCS_065 2;
BA_ "GenSigASIL"  SG_ 1004 FRM_33_DetnQuality_065 2;
VAL_ 994 FRM_23_DetnMotionSts_000 3 "Invalid" 2 "Static" 1 "Moving" 0 "NoTarget" ;
VAL_ 994 FRM_23_DetnMotionSts_001 3 "Invalid" 2 "Static" 1 "Moving" 0 "NoTarget" ;
VAL_ 994 FRM_23_DetnMotionSts_002 3 "Invalid" 2 "Static" 1 "Moving" 0 "NoTarget" ;
VAL_ 994 FRM_23_DetnMotionSts_003 3 "Invalid" 2 "Static" 1 "Moving" 0 "NoTarget" ;
VAL_ 994 FRM_23_DetnMotionSts_004 3 "Invalid" 2 "Static" 1 "Moving" 0 "NoTarget" ;
VAL_ 994 FRM_23_DetnMotionSts_005 3 "Invalid" 2 "Static" 1 "Moving" 0 "NoTarget" ;
VAL_ 995 FRM_24_DetnMotionSts_006 3 "Invalid" 2 "Static" 1 "Moving" 0 "NoTarget" ;
VAL_ 995 FRM_24_DetnMotionSts_007 3 "Invalid" 2 "Static" 1 "Moving" 0 "NoTarget" ;
VAL_ 995 FRM_24_DetnMotionSts_008 3 "Invalid" 2 "Static" 1 "Moving" 0 "NoTarget" ;
VAL_ 995 FRM_24_DetnMotionSts_009 3 "Invalid" 2 "Static" 1 "Moving" 0 "NoTarget" ;
VAL_ 995 FRM_24_DetnMotionSts_010 3 "Invalid" 2 "Static" 1 "Moving" 0 "NoTarget" ;
VAL_ 995 FRM_24_DetnMotionSts_011 3 "Invalid" 2 "Static" 1 "Moving" 0 "NoTarget" ;
VAL_ 996 FRM_25_DetnMotionSts_012 3 "Invalid" 2 "Static" 1 "Moving" 0 "NoTarget" ;
VAL_ 996 FRM_25_DetnMotionSts_013 3 "Invalid" 2 "Static" 1 "Moving" 0 "NoTarget" ;
VAL_ 996 FRM_25_DetnMotionSts_014 3 "Invalid" 2 "Static" 1 "Moving" 0 "NoTarget" ;
VAL_ 996 FRM_25_DetnMotionSts_015 3 "Invalid" 2 "Static" 1 "Moving" 0 "NoTarget" ;
VAL_ 996 FRM_25_DetnMotionSts_016 3 "Invalid" 2 "Static" 1 "Moving" 0 "NoTarget" ;
VAL_ 996 FRM_25_DetnMotionSts_017 3 "Invalid" 2 "Static" 1 "Moving" 0 "NoTarget" ;
VAL_ 997 FRM_26_DetnMotionSts_018 3 "Invalid" 2 "Static" 1 "Moving" 0 "NoTarget" ;
VAL_ 997 FRM_26_DetnMotionSts_019 3 "Invalid" 2 "Static" 1 "Moving" 0 "NoTarget" ;
VAL_ 997 FRM_26_DetnMotionSts_020 3 "Invalid" 2 "Static" 1 "Moving" 0 "NoTarget" ;
VAL_ 997 FRM_26_DetnMotionSts_021 3 "Invalid" 2 "Static" 1 "Moving" 0 "NoTarget" ;
VAL_ 997 FRM_26_DetnMotionSts_022 3 "Invalid" 2 "Static" 1 "Moving" 0 "NoTarget" ;
VAL_ 997 FRM_26_DetnMotionSts_023 3 "Invalid" 2 "Static" 1 "Moving" 0 "NoTarget" ;
VAL_ 998 FRM_27_DetnMotionSts_024 3 "Invalid" 2 "Static" 1 "Moving" 0 "NoTarget" ;
VAL_ 998 FRM_27_DetnMotionSts_025 3 "Invalid" 2 "Static" 1 "Moving" 0 "NoTarget" ;
VAL_ 998 FRM_27_DetnMotionSts_026 3 "Invalid" 2 "Static" 1 "Moving" 0 "NoTarget" ;
VAL_ 998 FRM_27_DetnMotionSts_027 3 "Invalid" 2 "Static" 1 "Moving" 0 "NoTarget" ;
VAL_ 998 FRM_27_DetnMotionSts_028 3 "Invalid" 2 "Static" 1 "Moving" 0 "NoTarget" ;
VAL_ 998 FRM_27_DetnMotionSts_029 3 "Invalid" 2 "Static" 1 "Moving" 0 "NoTarget" ;
VAL_ 999 FRM_28_DetnMotionSts_030 3 "Invalid" 2 "Static" 1 "Moving" 0 "NoTarget" ;
VAL_ 999 FRM_28_DetnMotionSts_031 3 "Invalid" 2 "Static" 1 "Moving" 0 "NoTarget" ;
VAL_ 999 FRM_28_DetnMotionSts_032 3 "Invalid" 2 "Static" 1 "Moving" 0 "NoTarget" ;
VAL_ 999 FRM_28_DetnMotionSts_033 3 "Invalid" 2 "Static" 1 "Moving" 0 "NoTarget" ;
VAL_ 999 FRM_28_DetnMotionSts_034 3 "Invalid" 2 "Static" 1 "Moving" 0 "NoTarget" ;
VAL_ 999 FRM_28_DetnMotionSts_035 3 "Invalid" 2 "Static" 1 "Moving" 0 "NoTarget" ;
VAL_ 1000 FRM_29_DetnMotionSts_036 3 "Invalid" 2 "Static" 1 "Moving" 0 "NoTarget" ;
VAL_ 1000 FRM_29_DetnMotionSts_037 3 "Invalid" 2 "Static" 1 "Moving" 0 "NoTarget" ;
VAL_ 1000 FRM_29_DetnMotionSts_038 3 "Invalid" 2 "Static" 1 "Moving" 0 "NoTarget" ;
VAL_ 1000 FRM_29_DetnMotionSts_039 3 "Invalid" 2 "Static" 1 "Moving" 0 "NoTarget" ;
VAL_ 1000 FRM_29_DetnMotionSts_040 3 "Invalid" 2 "Static" 1 "Moving" 0 "NoTarget" ;
VAL_ 1000 FRM_29_DetnMotionSts_041 3 "Invalid" 2 "Static" 1 "Moving" 0 "NoTarget" ;
VAL_ 1001 FRM_30_DetnMotionSts_042 3 "Invalid" 2 "Static" 1 "Moving" 0 "NoTarget" ;
VAL_ 1001 FRM_30_DetnMotionSts_043 3 "Invalid" 2 "Static" 1 "Moving" 0 "NoTarget" ;
VAL_ 1001 FRM_30_DetnMotionSts_044 3 "Invalid" 2 "Static" 1 "Moving" 0 "NoTarget" ;
VAL_ 1001 FRM_30_DetnMotionSts_045 3 "Invalid" 2 "Static" 1 "Moving" 0 "NoTarget" ;
VAL_ 1001 FRM_30_DetnMotionSts_046 3 "Invalid" 2 "Static" 1 "Moving" 0 "NoTarget" ;
VAL_ 1001 FRM_30_DetnMotionSts_047 3 "Invalid" 2 "Static" 1 "Moving" 0 "NoTarget" ;
VAL_ 1002 FRM_31_DetnMotionSts_048 3 "Invalid" 2 "Static" 1 "Moving" 0 "NoTarget" ;
VAL_ 1002 FRM_31_DetnMotionSts_049 3 "Invalid" 2 "Static" 1 "Moving" 0 "NoTarget" ;
VAL_ 1002 FRM_31_DetnMotionSts_050 3 "Invalid" 2 "Static" 1 "Moving" 0 "NoTarget" ;
VAL_ 1002 FRM_31_DetnMotionSts_051 3 "Invalid" 2 "Static" 1 "Moving" 0 "NoTarget" ;
VAL_ 1002 FRM_31_DetnMotionSts_052 3 "Invalid" 2 "Static" 1 "Moving" 0 "NoTarget" ;
VAL_ 1002 FRM_31_DetnMotionSts_053 3 "Invalid" 2 "Static" 1 "Moving" 0 "NoTarget" ;
VAL_ 1003 FRM_32_DetnMotionSts_054 3 "Invalid" 2 "Static" 1 "Moving" 0 "NoTarget" ;
VAL_ 1003 FRM_32_DetnMotionSts_055 3 "Invalid" 2 "Static" 1 "Moving" 0 "NoTarget" ;
VAL_ 1003 FRM_32_DetnMotionSts_056 3 "Invalid" 2 "Static" 1 "Moving" 0 "NoTarget" ;
VAL_ 1003 FRM_32_DetnMotionSts_057 3 "Invalid" 2 "Static" 1 "Moving" 0 "NoTarget" ;
VAL_ 1003 FRM_32_DetnMotionSts_058 3 "Invalid" 2 "Static" 1 "Moving" 0 "NoTarget" ;
VAL_ 1003 FRM_32_DetnMotionSts_059 3 "Invalid" 2 "Static" 1 "Moving" 0 "NoTarget" ;
VAL_ 1004 FRM_33_DetnMotionSts_060 3 "Invalid" 2 "Static" 1 "Moving" 0 "NoTarget" ;
VAL_ 1004 FRM_33_DetnMotionSts_061 3 "Invalid" 2 "Static" 1 "Moving" 0 "NoTarget" ;
VAL_ 1004 FRM_33_DetnMotionSts_062 3 "Invalid" 2 "Static" 1 "Moving" 0 "NoTarget" ;
VAL_ 1004 FRM_33_DetnMotionSts_063 3 "Invalid" 2 "Static" 1 "Moving" 0 "NoTarget" ;
VAL_ 1004 FRM_33_DetnMotionSts_064 3 "Invalid" 2 "Static" 1 "Moving" 0 "NoTarget" ;
VAL_ 1004 FRM_33_DetnMotionSts_065 3 "Invalid" 2 "Static" 1 "Moving" 0 "NoTarget" ;
