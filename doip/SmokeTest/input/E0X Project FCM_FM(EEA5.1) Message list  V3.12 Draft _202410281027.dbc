VERSION ""

NS_ :

BS_:

BU_: FRM_FM_4X

BO_ 979 FRM_20: 64 FRM_FM_4X
 SG_ FRM_20_CRC : 7|16@0+ (1,0) [0|65535] ""  Vector__XXX
 SG_ FRM_20_RollgCntr : 23|8@0+ (1,0) [0|255] ""  Vector__XXX
 SG_ FRM_20_ObjBlockCounter : 31|4@0+ (1,0) [0|15] ""  Vector__XXX
 SG_ FRM_20_ObjID_34 : 39|8@0+ (1,0) [0|255] ""  Vector__XXX
 SG_ FRM_20_ObjClosestDistX_34 : 47|15@0+ (0.01,0) [0|200] "m"  Vector__XXX
 SG_ FRM_20_ObjClosestDistY_34 : 63|15@0+ (0.01,-100) [-100|100] "m"  Vector__XXX
 SG_ FRM_20_ObjRelVelX_34 : 79|15@0+ (0.01,-100) [-100|80] "m/s"  Vector__XXX
 SG_ FRM_20_ObjRelVelY_34 : 95|15@0+ (0.01,-100) [-100|80] "m/s"  Vector__XXX
 SG_ FRM_20_ObjAccelX_34 : 111|13@0+ (0.01,-25) [-25|25] "m/s^2"  Vector__XXX
 SG_ FRM_20_ObjAccelY_34 : 114|13@0+ (0.01,-25) [-25|25] "m/s^2"  Vector__XXX
 SG_ FRM_20_ObjClosestDistXStd_34 : 133|6@0+ (0.1,0) [0|5] ""  Vector__XXX
 SG_ FRM_20_ObjClosestDistYStd_34 : 143|6@0+ (0.1,0) [0|5] ""  Vector__XXX
 SG_ FRM_20_ObjRelVelXStd_34 : 137|7@0+ (0.05,0) [0|4] ""  Vector__XXX
 SG_ FRM_20_ObjRelVelYStd_34 : 146|7@0+ (0.05,0) [0|4] ""  Vector__XXX
 SG_ FRM_20_ObjRelAccelXStd_34 : 155|6@0+ (0.05,0) [0|3] ""  Vector__XXX
 SG_ FRM_20_ObjRelAccelYStd_34 : 165|6@0+ (0.05,0) [0|3] ""  Vector__XXX
 SG_ FRM_20_ObjExistProb_34 : 175|7@0+ (1,0) [0|100] "%"  Vector__XXX
 SG_ FRM_20_ObjType_34 : 168|2@0+ (1,0) [0|3] ""  Vector__XXX
 SG_ FRM_20_ObjTypeConf_34 : 182|7@0+ (1,0) [0|100] "%"  Vector__XXX
 SG_ FRM_20_ObjTrackSts_34 : 191|2@0+ (1,0) [0|3] ""  Vector__XXX
 SG_ FRM_20_ObjMotionSts_34 : 189|2@0+ (1,0) [0|3] ""  Vector__XXX
 SG_ FRM_20_ObjMotionDirection_34 : 187|2@0+ (1,0) [0|3] ""  Vector__XXX
 SG_ FRM_20_ObjCenterDistX_34 : 199|15@0+ (0.01,0) [0|200] "m"  Vector__XXX
 SG_ FRM_20_ObjCenterDistY_34 : 215|15@0+ (0.01,-100) [-100|100] "m"  Vector__XXX
 SG_ FRM_20_ObjLength_34 : 216|9@0+ (0.1,0) [0|50] "m"  Vector__XXX
 SG_ FRM_20_ObjWidth_34 : 239|9@0+ (0.1,0) [0|30] "m"  Vector__XXX
 SG_ FRM_20_ObjElevnSts_34 : 246|2@0+ (1,0) [0|3] ""  Vector__XXX
 SG_ FRM_20_ObjElevnStsConf_34 : 244|7@0+ (1,0) [0|100] "%"  Vector__XXX
 SG_ FRM_20_ObjHeading_34 : 253|12@0+ (0.1,-180) [-180|180] "deg"  Vector__XXX
 SG_ FRM_20_ObjID_35 : 271|8@0+ (1,0) [0|255] ""  Vector__XXX
 SG_ FRM_20_ObjClosestDistX_35 : 279|15@0+ (0.01,0) [0|200] "m"  Vector__XXX
 SG_ FRM_20_ObjClosestDistY_35 : 295|15@0+ (0.01,-100) [-100|100] "m"  Vector__XXX
 SG_ FRM_20_ObjRelVelX_35 : 311|15@0+ (0.01,-100) [-100|80] "m/s"  Vector__XXX
 SG_ FRM_20_ObjRelVelY_35 : 327|15@0+ (0.01,-100) [-100|80] "m/s"  Vector__XXX
 SG_ FRM_20_ObjAccelX_35 : 343|13@0+ (0.01,-25) [-25|25] "m/s^2"  Vector__XXX
 SG_ FRM_20_ObjAccelY_35 : 346|13@0+ (0.01,-25) [-25|25] "m/s^2"  Vector__XXX
 SG_ FRM_20_ObjClosestDistXStd_35 : 365|6@0+ (0.1,0) [0|5] ""  Vector__XXX
 SG_ FRM_20_ObjClosestDistYStd_35 : 375|6@0+ (0.1,0) [0|5] ""  Vector__XXX
 SG_ FRM_20_ObjRelVelXStd_35 : 369|7@0+ (0.05,0) [0|4] ""  Vector__XXX
 SG_ FRM_20_ObjRelVelYStd_35 : 378|7@0+ (0.05,0) [0|4] ""  Vector__XXX
 SG_ FRM_20_ObjRelAccelXStd_35 : 387|6@0+ (0.05,0) [0|3] ""  Vector__XXX
 SG_ FRM_20_ObjRelAccelYStd_35 : 397|6@0+ (0.05,0) [0|3] ""  Vector__XXX
 SG_ FRM_20_ObjExistProb_35 : 407|7@0+ (1,0) [0|100] "%"  Vector__XXX
 SG_ FRM_20_ObjType_35 : 400|2@0+ (1,0) [0|3] ""  Vector__XXX
 SG_ FRM_20_ObjTypeConf_35 : 414|7@0+ (1,0) [0|100] "%"  Vector__XXX
 SG_ FRM_20_ObjTrackSts_35 : 423|2@0+ (1,0) [0|3] ""  Vector__XXX
 SG_ FRM_20_ObjMotionSts_35 : 421|2@0+ (1,0) [0|3] ""  Vector__XXX
 SG_ FRM_20_ObjMotionDirection_35 : 419|2@0+ (1,0) [0|3] ""  Vector__XXX
 SG_ FRM_20_ObjCenterDistX_35 : 431|15@0+ (0.01,0) [0|200] "m"  Vector__XXX
 SG_ FRM_20_ObjCenterDistY_35 : 447|15@0+ (0.01,-100) [-100|100] "m"  Vector__XXX
 SG_ FRM_20_ObjLength_35 : 448|9@0+ (0.1,0) [0|50] "m"  Vector__XXX
 SG_ FRM_20_ObjWidth_35 : 471|9@0+ (0.1,0) [0|30] "m"  Vector__XXX
 SG_ FRM_20_ObjElevnSts_35 : 478|2@0+ (1,0) [0|3] ""  Vector__XXX
 SG_ FRM_20_ObjElevnStsConf_35 : 476|7@0+ (1,0) [0|100] "%"  Vector__XXX
 SG_ FRM_20_ObjHeading_35 : 485|12@0+ (0.1,-180) [-180|180] "deg"  Vector__XXX

BO_ 992 FRM_21: 64 FRM_FM_4X
 SG_ FRM_21_CRC : 7|16@0+ (1,0) [0|65535] ""  Vector__XXX
 SG_ FRM_21_RollgCntr : 23|8@0+ (1,0) [0|255] ""  Vector__XXX
 SG_ FRM_21_ObjBlockCounter : 31|4@0+ (1,0) [0|15] ""  Vector__XXX
 SG_ FRM_21_ObjID_36 : 39|8@0+ (1,0) [0|255] ""  Vector__XXX
 SG_ FRM_21_ObjClosestDistX_36 : 47|15@0+ (0.01,0) [0|200] "m"  Vector__XXX
 SG_ FRM_21_ObjClosestDistY_36 : 63|15@0+ (0.01,-100) [-100|100] "m"  Vector__XXX
 SG_ FRM_21_ObjRelVelX_36 : 79|15@0+ (0.01,-100) [-100|80] "m/s"  Vector__XXX
 SG_ FRM_21_ObjRelVelY_36 : 95|15@0+ (0.01,-100) [-100|80] "m/s"  Vector__XXX
 SG_ FRM_21_ObjAccelX_36 : 111|13@0+ (0.01,-25) [-25|25] "m/s^2"  Vector__XXX
 SG_ FRM_21_ObjAccelY_36 : 114|13@0+ (0.01,-25) [-25|25] "m/s^2"  Vector__XXX
 SG_ FRM_21_ObjClosestDistXStd_36 : 133|6@0+ (0.1,0) [0|5] ""  Vector__XXX
 SG_ FRM_21_ObjClosestDistYStd_36 : 143|6@0+ (0.1,0) [0|5] ""  Vector__XXX
 SG_ FRM_21_ObjRelVelXStd_36 : 137|7@0+ (0.05,0) [0|4] ""  Vector__XXX
 SG_ FRM_21_ObjRelVelYStd_36 : 146|7@0+ (0.05,0) [0|4] ""  Vector__XXX
 SG_ FRM_21_ObjRelAccelXStd_36 : 155|6@0+ (0.05,0) [0|3] ""  Vector__XXX
 SG_ FRM_21_ObjRelAccelYStd_36 : 165|6@0+ (0.05,0) [0|3] ""  Vector__XXX
 SG_ FRM_21_ObjExistProb_36 : 175|7@0+ (1,0) [0|100] "%"  Vector__XXX
 SG_ FRM_21_ObjType_36 : 168|2@0+ (1,0) [0|3] ""  Vector__XXX
 SG_ FRM_21_ObjTypeConf_36 : 182|7@0+ (1,0) [0|100] "%"  Vector__XXX
 SG_ FRM_21_ObjTrackSts_36 : 191|2@0+ (1,0) [0|3] ""  Vector__XXX
 SG_ FRM_21_ObjMotionSts_36 : 189|2@0+ (1,0) [0|3] ""  Vector__XXX
 SG_ FRM_21_ObjMotionDirection_36 : 187|2@0+ (1,0) [0|3] ""  Vector__XXX
 SG_ FRM_21_ObjCenterDistX_36 : 199|15@0+ (0.01,0) [0|200] "m"  Vector__XXX
 SG_ FRM_21_ObjCenterDistY_36 : 215|15@0+ (0.01,-100) [-100|100] "m"  Vector__XXX
 SG_ FRM_21_ObjLength_36 : 216|9@0+ (0.1,0) [0|50] "m"  Vector__XXX
 SG_ FRM_21_ObjWidth_36 : 239|9@0+ (0.1,0) [0|30] "m"  Vector__XXX
 SG_ FRM_21_ObjElevnSts_36 : 246|2@0+ (1,0) [0|3] ""  Vector__XXX
 SG_ FRM_21_ObjElevnStsConf_36 : 244|7@0+ (1,0) [0|100] "%"  Vector__XXX
 SG_ FRM_21_ObjHeading_36 : 253|12@0+ (0.1,-180) [-180|180] "deg"  Vector__XXX
 SG_ FRM_21_ObjID_37 : 271|8@0+ (1,0) [0|255] ""  Vector__XXX
 SG_ FRM_21_ObjClosestDistX_37 : 279|15@0+ (0.01,0) [0|200] "m"  Vector__XXX
 SG_ FRM_21_ObjClosestDistY_37 : 295|15@0+ (0.01,-100) [-100|100] "m"  Vector__XXX
 SG_ FRM_21_ObjRelVelX_37 : 311|15@0+ (0.01,-100) [-100|80] "m/s"  Vector__XXX
 SG_ FRM_21_ObjRelVelY_37 : 327|15@0+ (0.01,-100) [-100|80] "m/s"  Vector__XXX
 SG_ FRM_21_ObjAccelX_37 : 343|13@0+ (0.01,-25) [-25|25] "m/s^2"  Vector__XXX
 SG_ FRM_21_ObjAccelY_37 : 346|13@0+ (0.01,-25) [-25|25] "m/s^2"  Vector__XXX
 SG_ FRM_21_ObjClosestDistXStd_37 : 365|6@0+ (0.1,0) [0|5] ""  Vector__XXX
 SG_ FRM_21_ObjClosestDistYStd_37 : 375|6@0+ (0.1,0) [0|5] ""  Vector__XXX
 SG_ FRM_21_ObjRelVelXStd_37 : 369|7@0+ (0.05,0) [0|4] ""  Vector__XXX
 SG_ FRM_21_ObjRelVelYStd_37 : 378|7@0+ (0.05,0) [0|4] ""  Vector__XXX
 SG_ FRM_21_ObjRelAccelXStd_37 : 387|6@0+ (0.05,0) [0|3] ""  Vector__XXX
 SG_ FRM_21_ObjRelAccelYStd_37 : 397|6@0+ (0.05,0) [0|3] ""  Vector__XXX
 SG_ FRM_21_ObjExistProb_37 : 407|7@0+ (1,0) [0|100] "%"  Vector__XXX
 SG_ FRM_21_ObjType_37 : 400|2@0+ (1,0) [0|3] ""  Vector__XXX
 SG_ FRM_21_ObjTypeConf_37 : 414|7@0+ (1,0) [0|100] "%"  Vector__XXX
 SG_ FRM_21_ObjTrackSts_37 : 423|2@0+ (1,0) [0|3] ""  Vector__XXX
 SG_ FRM_21_ObjMotionSts_37 : 421|2@0+ (1,0) [0|3] ""  Vector__XXX
 SG_ FRM_21_ObjMotionDirection_37 : 419|2@0+ (1,0) [0|3] ""  Vector__XXX
 SG_ FRM_21_ObjCenterDistX_37 : 431|15@0+ (0.01,0) [0|200] "m"  Vector__XXX
 SG_ FRM_21_ObjCenterDistY_37 : 447|15@0+ (0.01,-100) [-100|100] "m"  Vector__XXX
 SG_ FRM_21_ObjLength_37 : 448|9@0+ (0.1,0) [0|50] "m"  Vector__XXX
 SG_ FRM_21_ObjWidth_37 : 471|9@0+ (0.1,0) [0|30] "m"  Vector__XXX
 SG_ FRM_21_ObjElevnSts_37 : 478|2@0+ (1,0) [0|3] ""  Vector__XXX
 SG_ FRM_21_ObjElevnStsConf_37 : 476|7@0+ (1,0) [0|100] "%"  Vector__XXX
 SG_ FRM_21_ObjHeading_37 : 485|12@0+ (0.1,-180) [-180|180] "deg"  Vector__XXX

BO_ 993 FRM_22: 64 FRM_FM_4X
 SG_ FRM_22_CRC : 7|16@0+ (1,0) [0|65535] ""  Vector__XXX
 SG_ FRM_22_RollgCntr : 23|8@0+ (1,0) [0|255] ""  Vector__XXX
 SG_ FRM_22_ObjBlockCounter : 31|4@0+ (1,0) [0|15] ""  Vector__XXX
 SG_ FRM_22_ObjID_38 : 39|8@0+ (1,0) [0|255] ""  Vector__XXX
 SG_ FRM_22_ObjClosestDistX_38 : 47|15@0+ (0.01,0) [0|200] "m"  Vector__XXX
 SG_ FRM_22_ObjClosestDistY_38 : 63|15@0+ (0.01,-100) [-100|100] "m"  Vector__XXX
 SG_ FRM_22_ObjRelVelX_38 : 79|15@0+ (0.01,-100) [-100|80] "m/s"  Vector__XXX
 SG_ FRM_22_ObjRelVelY_38 : 95|15@0+ (0.01,-100) [-100|80] "m/s"  Vector__XXX
 SG_ FRM_22_ObjAccelX_38 : 111|13@0+ (0.01,-25) [-25|25] "m/s^2"  Vector__XXX
 SG_ FRM_22_ObjAccelY_38 : 114|13@0+ (0.01,-25) [-25|25] "m/s^2"  Vector__XXX
 SG_ FRM_22_ObjClosestDistXStd_38 : 133|6@0+ (0.1,0) [0|5] ""  Vector__XXX
 SG_ FRM_22_ObjClosestDistYStd_38 : 143|6@0+ (0.1,0) [0|5] ""  Vector__XXX
 SG_ FRM_22_ObjRelVelXStd_38 : 137|7@0+ (0.05,0) [0|4] ""  Vector__XXX
 SG_ FRM_22_ObjRelVelYStd_38 : 146|7@0+ (0.05,0) [0|4] ""  Vector__XXX
 SG_ FRM_22_ObjRelAccelXStd_38 : 155|6@0+ (0.05,0) [0|3] ""  Vector__XXX
 SG_ FRM_22_ObjRelAccelYStd_38 : 165|6@0+ (0.05,0) [0|3] ""  Vector__XXX
 SG_ FRM_22_ObjExistProb_38 : 175|7@0+ (1,0) [0|100] "%"  Vector__XXX
 SG_ FRM_22_ObjType_38 : 168|2@0+ (1,0) [0|3] ""  Vector__XXX
 SG_ FRM_22_ObjTypeConf_38 : 182|7@0+ (1,0) [0|100] "%"  Vector__XXX
 SG_ FRM_22_ObjTrackSts_38 : 191|2@0+ (1,0) [0|3] ""  Vector__XXX
 SG_ FRM_22_ObjMotionSts_38 : 189|2@0+ (1,0) [0|3] ""  Vector__XXX
 SG_ FRM_22_ObjMotionDirection_38 : 187|2@0+ (1,0) [0|3] ""  Vector__XXX
 SG_ FRM_22_ObjCenterDistX_38 : 199|15@0+ (0.01,0) [0|200] "m"  Vector__XXX
 SG_ FRM_22_ObjCenterDistY_38 : 215|15@0+ (0.01,-100) [-100|100] "m"  Vector__XXX
 SG_ FRM_22_ObjLength_38 : 216|9@0+ (0.1,0) [0|50] "m"  Vector__XXX
 SG_ FRM_22_ObjWidth_38 : 239|9@0+ (0.1,0) [0|30] "m"  Vector__XXX
 SG_ FRM_22_ObjElevnSts_38 : 246|2@0+ (1,0) [0|3] ""  Vector__XXX
 SG_ FRM_22_ObjElevnStsConf_38 : 244|7@0+ (1,0) [0|100] "%"  Vector__XXX
 SG_ FRM_22_ObjHeading_38 : 253|12@0+ (0.1,-180) [-180|180] "deg"  Vector__XXX
 SG_ FRM_22_ObjID_39 : 271|8@0+ (1,0) [0|255] ""  Vector__XXX
 SG_ FRM_22_ObjClosestDistX_39 : 279|15@0+ (0.01,0) [0|200] "m"  Vector__XXX
 SG_ FRM_22_ObjClosestDistY_39 : 295|15@0+ (0.01,-100) [-100|100] "m"  Vector__XXX
 SG_ FRM_22_ObjRelVelX_39 : 311|15@0+ (0.01,-100) [-100|80] "m/s"  Vector__XXX
 SG_ FRM_22_ObjRelVelY_39 : 327|15@0+ (0.01,-100) [-100|80] "m/s"  Vector__XXX
 SG_ FRM_22_ObjAccelX_39 : 343|13@0+ (0.01,-25) [-25|25] "m/s^2"  Vector__XXX
 SG_ FRM_22_ObjAccelY_39 : 346|13@0+ (0.01,-25) [-25|25] "m/s^2"  Vector__XXX
 SG_ FRM_22_ObjClosestDistXStd_39 : 365|6@0+ (0.1,0) [0|5] ""  Vector__XXX
 SG_ FRM_22_ObjClosestDistYStd_39 : 375|6@0+ (0.1,0) [0|5] ""  Vector__XXX
 SG_ FRM_22_ObjRelVelXStd_39 : 369|7@0+ (0.05,0) [0|4] ""  Vector__XXX
 SG_ FRM_22_ObjRelVelYStd_39 : 378|7@0+ (0.05,0) [0|4] ""  Vector__XXX
 SG_ FRM_22_ObjRelAccelXStd_39 : 387|6@0+ (0.05,0) [0|3] ""  Vector__XXX
 SG_ FRM_22_ObjRelAccelYStd_39 : 397|6@0+ (0.05,0) [0|3] ""  Vector__XXX
 SG_ FRM_22_ObjExistProb_39 : 407|7@0+ (1,0) [0|100] "%"  Vector__XXX
 SG_ FRM_22_ObjType_39 : 400|2@0+ (1,0) [0|3] ""  Vector__XXX
 SG_ FRM_22_ObjTypeConf_39 : 414|7@0+ (1,0) [0|100] "%"  Vector__XXX
 SG_ FRM_22_ObjTrackSts_39 : 423|2@0+ (1,0) [0|3] ""  Vector__XXX
 SG_ FRM_22_ObjMotionSts_39 : 421|2@0+ (1,0) [0|3] ""  Vector__XXX
 SG_ FRM_22_ObjMotionDirection_39 : 419|2@0+ (1,0) [0|3] ""  Vector__XXX
 SG_ FRM_22_ObjCenterDistX_39 : 431|15@0+ (0.01,0) [0|200] "m"  Vector__XXX
 SG_ FRM_22_ObjCenterDistY_39 : 447|15@0+ (0.01,-100) [-100|100] "m"  Vector__XXX
 SG_ FRM_22_ObjLength_39 : 448|9@0+ (0.1,0) [0|50] "m"  Vector__XXX
 SG_ FRM_22_ObjWidth_39 : 471|9@0+ (0.1,0) [0|30] "m"  Vector__XXX
 SG_ FRM_22_ObjElevnSts_39 : 478|2@0+ (1,0) [0|3] ""  Vector__XXX
 SG_ FRM_22_ObjElevnStsConf_39 : 476|7@0+ (1,0) [0|100] "%"  Vector__XXX
 SG_ FRM_22_ObjHeading_39 : 485|12@0+ (0.1,-180) [-180|180] "deg"  Vector__XXX

BO_ 994 FRM_23: 64 FRM_FM_4X
 SG_ FRM_23_CRC : 7|16@0+ (1,0) [0|65535] ""  Vector__XXX
 SG_ FRM_23_RollgCntr : 23|8@0+ (1,0) [0|255] ""  Vector__XXX
 SG_ FRM_23_DetnBlockCounter : 27|4@0+ (1,0) [0|15] ""  Vector__XXX
 SG_ FRM_23_DetnMotionSts_000 : 29|2@0+ (1,0) [0|3] ""  Vector__XXX
 SG_ FRM_23_DetnRngRadial_000 : 39|15@0+ (0.01,0) [0|200] "m"  Vector__XXX
 SG_ FRM_23_DetnAziAngle_000 : 40|11@0+ (0.1,-90) [-90|90] "deg"  Vector__XXX
 SG_ FRM_23_DetnElevnAngle_000 : 61|8@0+ (0.1,-10) [-10|10] "deg"  Vector__XXX
 SG_ FRM_23_DetnRelVelRadial_000 : 69|15@0+ (0.01,-100) [-100|80] "m/s"  Vector__XXX
 SG_ FRM_23_DetnSNR_000 : 86|7@0+ (1,0) [0|100] "dB"  Vector__XXX
 SG_ FRM_23_DetnRCS_000 : 95|15@0+ (0.01,-50) [-50|128] "dBsm"  Vector__XXX
 SG_ FRM_23_DetnQuality_000 : 96|4@0+ (10,0) [0|100] "%"  Vector__XXX
 SG_ FRM_23_DetnMotionSts_001 : 31|2@0+ (1,0) [0|3] ""  Vector__XXX
 SG_ FRM_23_DetnRngRadial_001 : 108|15@0+ (0.01,0) [0|200] "m"  Vector__XXX
 SG_ FRM_23_DetnAziAngle_001 : 125|11@0+ (0.1,-90) [-90|90] "deg"  Vector__XXX
 SG_ FRM_23_DetnElevnAngle_001 : 130|8@0+ (0.1,-10) [-10|10] "deg"  Vector__XXX
 SG_ FRM_23_DetnRelVelRadial_001 : 138|15@0+ (0.01,-100) [-100|80] "m/s"  Vector__XXX
 SG_ FRM_23_DetnSNR_001 : 155|7@0+ (1,0) [0|100] "dB"  Vector__XXX
 SG_ FRM_23_DetnRCS_001 : 164|15@0+ (0.01,-50) [-50|128] "dBsm"  Vector__XXX
 SG_ FRM_23_DetnQuality_001 : 181|4@0+ (10,0) [0|100] "%"  Vector__XXX
 SG_ FRM_23_DetnMotionSts_002 : 177|2@0+ (1,0) [0|3] ""  Vector__XXX
 SG_ FRM_23_DetnRngRadial_002 : 191|15@0+ (0.01,0) [0|200] "m"  Vector__XXX
 SG_ FRM_23_DetnAziAngle_002 : 192|11@0+ (0.1,-90) [-90|90] "deg"  Vector__XXX
 SG_ FRM_23_DetnElevnAngle_002 : 213|8@0+ (0.1,-10) [-10|10] "deg"  Vector__XXX
 SG_ FRM_23_DetnRelVelRadial_002 : 221|15@0+ (0.01,-100) [-100|80] "m/s"  Vector__XXX
 SG_ FRM_23_DetnSNR_002 : 238|7@0+ (1,0) [0|100] "dB"  Vector__XXX
 SG_ FRM_23_DetnRCS_002 : 247|15@0+ (0.01,-50) [-50|128] "dBsm"  Vector__XXX
 SG_ FRM_23_DetnQuality_002 : 248|4@0+ (10,0) [0|100] "%"  Vector__XXX
 SG_ FRM_23_DetnMotionSts_003 : 260|2@0+ (1,0) [0|3] ""  Vector__XXX
 SG_ FRM_23_DetnRngRadial_003 : 258|15@0+ (0.01,0) [0|200] "m"  Vector__XXX
 SG_ FRM_23_DetnAziAngle_003 : 275|11@0+ (0.1,-90) [-90|90] "deg"  Vector__XXX
 SG_ FRM_23_DetnElevnAngle_003 : 280|8@0+ (0.1,-10) [-10|10] "deg"  Vector__XXX
 SG_ FRM_23_DetnRelVelRadial_003 : 288|15@0+ (0.01,-100) [-100|80] "m/s"  Vector__XXX
 SG_ FRM_23_DetnSNR_003 : 305|7@0+ (1,0) [0|100] "dB"  Vector__XXX
 SG_ FRM_23_DetnRCS_003 : 314|15@0+ (0.01,-50) [-50|128] "dBsm"  Vector__XXX
 SG_ FRM_23_DetnQuality_003 : 331|4@0+ (10,0) [0|100] "%"  Vector__XXX
 SG_ FRM_23_DetnMotionSts_004 : 343|2@0+ (1,0) [0|3] ""  Vector__XXX
 SG_ FRM_23_DetnRngRadial_004 : 341|15@0+ (0.01,0) [0|200] "m"  Vector__XXX
 SG_ FRM_23_DetnAziAngle_004 : 358|11@0+ (0.1,-90) [-90|90] "deg"  Vector__XXX
 SG_ FRM_23_DetnElevnAngle_004 : 363|8@0+ (0.1,-10) [-10|10] "deg"  Vector__XXX
 SG_ FRM_23_DetnRelVelRadial_004 : 371|15@0+ (0.01,-100) [-100|80] "m/s"  Vector__XXX
 SG_ FRM_23_DetnSNR_004 : 388|7@0+ (1,0) [0|100] "dB"  Vector__XXX
 SG_ FRM_23_DetnRCS_004 : 397|15@0+ (0.01,-50) [-50|128] "dBsm"  Vector__XXX
 SG_ FRM_23_DetnQuality_004 : 414|4@0+ (10,0) [0|100] "%"  Vector__XXX
 SG_ FRM_23_DetnMotionSts_005 : 410|2@0+ (1,0) [0|3] ""  Vector__XXX
 SG_ FRM_23_DetnRngRadial_005 : 408|15@0+ (0.01,0) [0|200] "m"  Vector__XXX
 SG_ FRM_23_DetnAziAngle_005 : 425|11@0+ (0.1,-90) [-90|90] "deg"  Vector__XXX
 SG_ FRM_23_DetnElevnAngle_005 : 446|8@0+ (0.1,-10) [-10|10] "deg"  Vector__XXX
 SG_ FRM_23_DetnRelVelRadial_005 : 454|15@0+ (0.01,-100) [-100|80] "m/s"  Vector__XXX
 SG_ FRM_23_DetnSNR_005 : 471|7@0+ (1,0) [0|100] "dB"  Vector__XXX
 SG_ FRM_23_DetnRCS_005 : 464|15@0+ (0.01,-50) [-50|128] "dBsm"  Vector__XXX
 SG_ FRM_23_DetnQuality_005 : 481|4@0+ (10,0) [0|100] "%"  Vector__XXX

BO_ 995 FRM_24: 64 FRM_FM_4X
 SG_ FRM_24_CRC : 7|16@0+ (1,0) [0|65535] ""  Vector__XXX
 SG_ FRM_24_RollgCntr : 23|8@0+ (1,0) [0|255] ""  Vector__XXX
 SG_ FRM_24_DetnBlockCounter : 27|4@0+ (1,0) [0|15] ""  Vector__XXX
 SG_ FRM_24_DetnMotionSts_006 : 29|2@0+ (1,0) [0|3] ""  Vector__XXX
 SG_ FRM_24_DetnRngRadial_006 : 39|15@0+ (0.01,0) [0|200] "m"  Vector__XXX
 SG_ FRM_24_DetnAziAngle_006 : 40|11@0+ (0.1,-90) [-90|90] "deg"  Vector__XXX
 SG_ FRM_24_DetnElevnAngle_006 : 61|8@0+ (0.1,-10) [-10|10] "deg"  Vector__XXX
 SG_ FRM_24_DetnRelVelRadial_006 : 69|15@0+ (0.01,-100) [-100|80] "m/s"  Vector__XXX
 SG_ FRM_24_DetnSNR_006 : 86|7@0+ (1,0) [0|100] "dB"  Vector__XXX
 SG_ FRM_24_DetnRCS_006 : 95|15@0+ (0.01,-50) [-50|128] "dBsm"  Vector__XXX
 SG_ FRM_24_DetnQuality_006 : 96|4@0+ (10,0) [0|100] "%"  Vector__XXX
 SG_ FRM_24_DetnMotionSts_007 : 31|2@0+ (1,0) [0|3] ""  Vector__XXX
 SG_ FRM_24_DetnRngRadial_007 : 108|15@0+ (0.01,0) [0|200] "m"  Vector__XXX
 SG_ FRM_24_DetnAziAngle_007 : 125|11@0+ (0.1,-90) [-90|90] "deg"  Vector__XXX
 SG_ FRM_24_DetnElevnAngle_007 : 130|8@0+ (0.1,-10) [-10|10] "deg"  Vector__XXX
 SG_ FRM_24_DetnRelVelRadial_007 : 138|15@0+ (0.01,-100) [-100|80] "m/s"  Vector__XXX
 SG_ FRM_24_DetnSNR_007 : 155|7@0+ (1,0) [0|100] "dB"  Vector__XXX
 SG_ FRM_24_DetnRCS_007 : 164|15@0+ (0.01,-50) [-50|128] "dBsm"  Vector__XXX
 SG_ FRM_24_DetnQuality_007 : 181|4@0+ (10,0) [0|100] "%"  Vector__XXX
 SG_ FRM_24_DetnMotionSts_008 : 177|2@0+ (1,0) [0|3] ""  Vector__XXX
 SG_ FRM_24_DetnRngRadial_008 : 191|15@0+ (0.01,0) [0|200] "m"  Vector__XXX
 SG_ FRM_24_DetnAziAngle_008 : 192|11@0+ (0.1,-90) [-90|90] "deg"  Vector__XXX
 SG_ FRM_24_DetnElevnAngle_008 : 213|8@0+ (0.1,-10) [-10|10] "deg"  Vector__XXX
 SG_ FRM_24_DetnRelVelRadial_008 : 221|15@0+ (0.01,-100) [-100|80] "m/s"  Vector__XXX
 SG_ FRM_24_DetnSNR_008 : 238|7@0+ (1,0) [0|100] "dB"  Vector__XXX
 SG_ FRM_24_DetnRCS_008 : 247|15@0+ (0.01,-50) [-50|128] "dBsm"  Vector__XXX
 SG_ FRM_24_DetnQuality_008 : 248|4@0+ (10,0) [0|100] "%"  Vector__XXX
 SG_ FRM_24_DetnMotionSts_009 : 260|2@0+ (1,0) [0|3] ""  Vector__XXX
 SG_ FRM_24_DetnRngRadial_009 : 258|15@0+ (0.01,0) [0|200] "m"  Vector__XXX
 SG_ FRM_24_DetnAziAngle_009 : 275|11@0+ (0.1,-90) [-90|90] "deg"  Vector__XXX
 SG_ FRM_24_DetnElevnAngle_009 : 280|8@0+ (0.1,-10) [-10|10] "deg"  Vector__XXX
 SG_ FRM_24_DetnRelVelRadial_009 : 288|15@0+ (0.01,-100) [-100|80] "m/s"  Vector__XXX
 SG_ FRM_24_DetnSNR_009 : 305|7@0+ (1,0) [0|100] "dB"  Vector__XXX
 SG_ FRM_24_DetnRCS_009 : 314|15@0+ (0.01,-50) [-50|128] "dBsm"  Vector__XXX
 SG_ FRM_24_DetnQuality_009 : 331|4@0+ (10,0) [0|100] "%"  Vector__XXX
 SG_ FRM_24_DetnMotionSts_010 : 343|2@0+ (1,0) [0|3] ""  Vector__XXX
 SG_ FRM_24_DetnRngRadial_010 : 341|15@0+ (0.01,0) [0|200] "m"  Vector__XXX
 SG_ FRM_24_DetnAziAngle_010 : 358|11@0+ (0.1,-90) [-90|90] "deg"  Vector__XXX
 SG_ FRM_24_DetnElevnAngle_010 : 363|8@0+ (0.1,-10) [-10|10] "deg"  Vector__XXX
 SG_ FRM_24_DetnRelVelRadial_010 : 371|15@0+ (0.01,-100) [-100|80] "m/s"  Vector__XXX
 SG_ FRM_24_DetnSNR_010 : 388|7@0+ (1,0) [0|100] "dB"  Vector__XXX
 SG_ FRM_24_DetnRCS_010 : 397|15@0+ (0.01,-50) [-50|128] "dBsm"  Vector__XXX
 SG_ FRM_24_DetnQuality_010 : 414|4@0+ (10,0) [0|100] "%"  Vector__XXX
 SG_ FRM_24_DetnMotionSts_011 : 410|2@0+ (1,0) [0|3] ""  Vector__XXX
 SG_ FRM_24_DetnRngRadial_011 : 408|15@0+ (0.01,0) [0|200] "m"  Vector__XXX
 SG_ FRM_24_DetnAziAngle_011 : 425|11@0+ (0.1,-90) [-90|90] "deg"  Vector__XXX
 SG_ FRM_24_DetnElevnAngle_011 : 446|8@0+ (0.1,-10) [-10|10] "deg"  Vector__XXX
 SG_ FRM_24_DetnRelVelRadial_011 : 454|15@0+ (0.01,-100) [-100|80] "m/s"  Vector__XXX
 SG_ FRM_24_DetnSNR_011 : 471|7@0+ (1,0) [0|100] "dB"  Vector__XXX
 SG_ FRM_24_DetnRCS_011 : 464|15@0+ (0.01,-50) [-50|128] "dBsm"  Vector__XXX
 SG_ FRM_24_DetnQuality_011 : 481|4@0+ (10,0) [0|100] "%"  Vector__XXX

BO_ 996 FRM_25: 64 FRM_FM_4X
 SG_ FRM_25_CRC : 7|16@0+ (1,0) [0|65535] ""  Vector__XXX
 SG_ FRM_25_RollgCntr : 23|8@0+ (1,0) [0|255] ""  Vector__XXX
 SG_ FRM_25_DetnBlockCounter : 27|4@0+ (1,0) [0|15] ""  Vector__XXX
 SG_ FRM_25_DetnMotionSts_012 : 29|2@0+ (1,0) [0|3] ""  Vector__XXX
 SG_ FRM_25_DetnRngRadial_012 : 39|15@0+ (0.01,0) [0|200] "m"  Vector__XXX
 SG_ FRM_25_DetnAziAngle_012 : 40|11@0+ (0.1,-90) [-90|90] "deg"  Vector__XXX
 SG_ FRM_25_DetnElevnAngle_012 : 61|8@0+ (0.1,-10) [-10|10] "deg"  Vector__XXX
 SG_ FRM_25_DetnRelVelRadial_012 : 69|15@0+ (0.01,-100) [-100|80] "m/s"  Vector__XXX
 SG_ FRM_25_DetnSNR_012 : 86|7@0+ (1,0) [0|100] "dB"  Vector__XXX
 SG_ FRM_25_DetnRCS_012 : 95|15@0+ (0.01,-50) [-50|128] "dBsm"  Vector__XXX
 SG_ FRM_25_DetnQuality_012 : 96|4@0+ (10,0) [0|100] "%"  Vector__XXX
 SG_ FRM_25_DetnMotionSts_013 : 31|2@0+ (1,0) [0|3] ""  Vector__XXX
 SG_ FRM_25_DetnRngRadial_013 : 108|15@0+ (0.01,0) [0|200] "m"  Vector__XXX
 SG_ FRM_25_DetnAziAngle_013 : 125|11@0+ (0.1,-90) [-90|90] "deg"  Vector__XXX
 SG_ FRM_25_DetnElevnAngle_013 : 130|8@0+ (0.1,-10) [-10|10] "deg"  Vector__XXX
 SG_ FRM_25_DetnRelVelRadial_013 : 138|15@0+ (0.01,-100) [-100|80] "m/s"  Vector__XXX
 SG_ FRM_25_DetnSNR_013 : 155|7@0+ (1,0) [0|100] "dB"  Vector__XXX
 SG_ FRM_25_DetnRCS_013 : 164|15@0+ (0.01,-50) [-50|128] "dBsm"  Vector__XXX
 SG_ FRM_25_DetnQuality_013 : 181|4@0+ (10,0) [0|100] "%"  Vector__XXX
 SG_ FRM_25_DetnMotionSts_014 : 177|2@0+ (1,0) [0|3] ""  Vector__XXX
 SG_ FRM_25_DetnRngRadial_014 : 191|15@0+ (0.01,0) [0|200] "m"  Vector__XXX
 SG_ FRM_25_DetnAziAngle_014 : 192|11@0+ (0.1,-90) [-90|90] "deg"  Vector__XXX
 SG_ FRM_25_DetnElevnAngle_014 : 213|8@0+ (0.1,-10) [-10|10] "deg"  Vector__XXX
 SG_ FRM_25_DetnRelVelRadial_014 : 221|15@0+ (0.01,-100) [-100|80] "m/s"  Vector__XXX
 SG_ FRM_25_DetnSNR_014 : 238|7@0+ (1,0) [0|100] "dB"  Vector__XXX
 SG_ FRM_25_DetnRCS_014 : 247|15@0+ (0.01,-50) [-50|128] "dBsm"  Vector__XXX
 SG_ FRM_25_DetnQuality_014 : 248|4@0+ (10,0) [0|100] "%"  Vector__XXX
 SG_ FRM_25_DetnMotionSts_015 : 260|2@0+ (1,0) [0|3] ""  Vector__XXX
 SG_ FRM_25_DetnRngRadial_015 : 258|15@0+ (0.01,0) [0|200] "m"  Vector__XXX
 SG_ FRM_25_DetnAziAngle_015 : 275|11@0+ (0.1,-90) [-90|90] "deg"  Vector__XXX
 SG_ FRM_25_DetnElevnAngle_015 : 280|8@0+ (0.1,-10) [-10|10] "deg"  Vector__XXX
 SG_ FRM_25_DetnRelVelRadial_015 : 288|15@0+ (0.01,-100) [-100|80] "m/s"  Vector__XXX
 SG_ FRM_25_DetnSNR_015 : 305|7@0+ (1,0) [0|100] "dB"  Vector__XXX
 SG_ FRM_25_DetnRCS_015 : 314|15@0+ (0.01,-50) [-50|128] "dBsm"  Vector__XXX
 SG_ FRM_25_DetnQuality_015 : 331|4@0+ (10,0) [0|100] "%"  Vector__XXX
 SG_ FRM_25_DetnMotionSts_016 : 343|2@0+ (1,0) [0|3] ""  Vector__XXX
 SG_ FRM_25_DetnRngRadial_016 : 341|15@0+ (0.01,0) [0|200] "m"  Vector__XXX
 SG_ FRM_25_DetnAziAngle_016 : 358|11@0+ (0.1,-90) [-90|90] "deg"  Vector__XXX
 SG_ FRM_25_DetnElevnAngle_016 : 363|8@0+ (0.1,-10) [-10|10] "deg"  Vector__XXX
 SG_ FRM_25_DetnRelVelRadial_016 : 371|15@0+ (0.01,-100) [-100|80] "m/s"  Vector__XXX
 SG_ FRM_25_DetnSNR_016 : 388|7@0+ (1,0) [0|100] "dB"  Vector__XXX
 SG_ FRM_25_DetnRCS_016 : 397|15@0+ (0.01,-50) [-50|128] "dBsm"  Vector__XXX
 SG_ FRM_25_DetnQuality_016 : 414|4@0+ (10,0) [0|100] "%"  Vector__XXX
 SG_ FRM_25_DetnMotionSts_017 : 410|2@0+ (1,0) [0|3] ""  Vector__XXX
 SG_ FRM_25_DetnRngRadial_017 : 408|15@0+ (0.01,0) [0|200] "m"  Vector__XXX
 SG_ FRM_25_DetnAziAngle_017 : 425|11@0+ (0.1,-90) [-90|90] "deg"  Vector__XXX
 SG_ FRM_25_DetnElevnAngle_017 : 446|8@0+ (0.1,-10) [-10|10] "deg"  Vector__XXX
 SG_ FRM_25_DetnRelVelRadial_017 : 454|15@0+ (0.01,-100) [-100|80] "m/s"  Vector__XXX
 SG_ FRM_25_DetnSNR_017 : 471|7@0+ (1,0) [0|100] "dB"  Vector__XXX
 SG_ FRM_25_DetnRCS_017 : 464|15@0+ (0.01,-50) [-50|128] "dBsm"  Vector__XXX
 SG_ FRM_25_DetnQuality_017 : 481|4@0+ (10,0) [0|100] "%"  Vector__XXX

BO_ 997 FRM_26: 64 FRM_FM_4X
 SG_ FRM_26_CRC : 7|16@0+ (1,0) [0|65535] ""  Vector__XXX
 SG_ FRM_26_RollgCntr : 23|8@0+ (1,0) [0|255] ""  Vector__XXX
 SG_ FRM_26_DetnBlockCounter : 27|4@0+ (1,0) [0|15] ""  Vector__XXX
 SG_ FRM_26_DetnMotionSts_018 : 29|2@0+ (1,0) [0|3] ""  Vector__XXX
 SG_ FRM_26_DetnRngRadial_018 : 39|15@0+ (0.01,0) [0|200] "m"  Vector__XXX
 SG_ FRM_26_DetnAziAngle_018 : 40|11@0+ (0.1,-90) [-90|90] "deg"  Vector__XXX
 SG_ FRM_26_DetnElevnAngle_018 : 61|8@0+ (0.1,-10) [-10|10] "deg"  Vector__XXX
 SG_ FRM_26_DetnRelVelRadial_018 : 69|15@0+ (0.01,-100) [-100|80] "m/s"  Vector__XXX
 SG_ FRM_26_DetnSNR_018 : 86|7@0+ (1,0) [0|100] "dB"  Vector__XXX
 SG_ FRM_26_DetnRCS_018 : 95|15@0+ (0.01,-50) [-50|128] "dBsm"  Vector__XXX
 SG_ FRM_26_DetnQuality_018 : 96|4@0+ (10,0) [0|100] "%"  Vector__XXX
 SG_ FRM_26_DetnMotionSts_019 : 31|2@0+ (1,0) [0|3] ""  Vector__XXX
 SG_ FRM_26_DetnRngRadial_019 : 108|15@0+ (0.01,0) [0|200] "m"  Vector__XXX
 SG_ FRM_26_DetnAziAngle_019 : 125|11@0+ (0.1,-90) [-90|90] "deg"  Vector__XXX
 SG_ FRM_26_DetnElevnAngle_019 : 130|8@0+ (0.1,-10) [-10|10] "deg"  Vector__XXX
 SG_ FRM_26_DetnRelVelRadial_019 : 138|15@0+ (0.01,-100) [-100|80] "m/s"  Vector__XXX
 SG_ FRM_26_DetnSNR_019 : 155|7@0+ (1,0) [0|100] "dB"  Vector__XXX
 SG_ FRM_26_DetnRCS_019 : 164|15@0+ (0.01,-50) [-50|128] "dBsm"  Vector__XXX
 SG_ FRM_26_DetnQuality_019 : 181|4@0+ (10,0) [0|100] "%"  Vector__XXX
 SG_ FRM_26_DetnMotionSts_020 : 177|2@0+ (1,0) [0|3] ""  Vector__XXX
 SG_ FRM_26_DetnRngRadial_020 : 191|15@0+ (0.01,0) [0|200] "m"  Vector__XXX
 SG_ FRM_26_DetnAziAngle_020 : 192|11@0+ (0.1,-90) [-90|90] "deg"  Vector__XXX
 SG_ FRM_26_DetnElevnAngle_020 : 213|8@0+ (0.1,-10) [-10|10] "deg"  Vector__XXX
 SG_ FRM_26_DetnRelVelRadial_020 : 221|15@0+ (0.01,-100) [-100|80] "m/s"  Vector__XXX
 SG_ FRM_26_DetnSNR_020 : 238|7@0+ (1,0) [0|100] "dB"  Vector__XXX
 SG_ FRM_26_DetnRCS_020 : 247|15@0+ (0.01,-50) [-50|128] "dBsm"  Vector__XXX
 SG_ FRM_26_DetnQuality_020 : 248|4@0+ (10,0) [0|100] "%"  Vector__XXX
 SG_ FRM_26_DetnMotionSts_021 : 260|2@0+ (1,0) [0|3] ""  Vector__XXX
 SG_ FRM_26_DetnRngRadial_021 : 258|15@0+ (0.01,0) [0|200] "m"  Vector__XXX
 SG_ FRM_26_DetnAziAngle_021 : 275|11@0+ (0.1,-90) [-90|90] "deg"  Vector__XXX
 SG_ FRM_26_DetnElevnAngle_021 : 280|8@0+ (0.1,-10) [-10|10] "deg"  Vector__XXX
 SG_ FRM_26_DetnRelVelRadial_021 : 288|15@0+ (0.01,-100) [-100|80] "m/s"  Vector__XXX
 SG_ FRM_26_DetnSNR_021 : 305|7@0+ (1,0) [0|100] "dB"  Vector__XXX
 SG_ FRM_26_DetnRCS_021 : 314|15@0+ (0.01,-50) [-50|128] "dBsm"  Vector__XXX
 SG_ FRM_26_DetnQuality_021 : 331|4@0+ (10,0) [0|100] "%"  Vector__XXX
 SG_ FRM_26_DetnMotionSts_022 : 343|2@0+ (1,0) [0|3] ""  Vector__XXX
 SG_ FRM_26_DetnRngRadial_022 : 341|15@0+ (0.01,0) [0|200] "m"  Vector__XXX
 SG_ FRM_26_DetnAziAngle_022 : 358|11@0+ (0.1,-90) [-90|90] "deg"  Vector__XXX
 SG_ FRM_26_DetnElevnAngle_022 : 363|8@0+ (0.1,-10) [-10|10] "deg"  Vector__XXX
 SG_ FRM_26_DetnRelVelRadial_022 : 371|15@0+ (0.01,-100) [-100|80] "m/s"  Vector__XXX
 SG_ FRM_26_DetnSNR_022 : 388|7@0+ (1,0) [0|100] "dB"  Vector__XXX
 SG_ FRM_26_DetnRCS_022 : 397|15@0+ (0.01,-50) [-50|128] "dBsm"  Vector__XXX
 SG_ FRM_26_DetnQuality_022 : 414|4@0+ (10,0) [0|100] "%"  Vector__XXX
 SG_ FRM_26_DetnMotionSts_023 : 410|2@0+ (1,0) [0|3] ""  Vector__XXX
 SG_ FRM_26_DetnRngRadial_023 : 408|15@0+ (0.01,0) [0|200] "m"  Vector__XXX
 SG_ FRM_26_DetnAziAngle_023 : 425|11@0+ (0.1,-90) [-90|90] "deg"  Vector__XXX
 SG_ FRM_26_DetnElevnAngle_023 : 446|8@0+ (0.1,-10) [-10|10] "deg"  Vector__XXX
 SG_ FRM_26_DetnRelVelRadial_023 : 454|15@0+ (0.01,-100) [-100|80] "m/s"  Vector__XXX
 SG_ FRM_26_DetnSNR_023 : 471|7@0+ (1,0) [0|100] "dB"  Vector__XXX
 SG_ FRM_26_DetnRCS_023 : 464|15@0+ (0.01,-50) [-50|128] "dBsm"  Vector__XXX
 SG_ FRM_26_DetnQuality_023 : 481|4@0+ (10,0) [0|100] "%"  Vector__XXX

BO_ 998 FRM_27: 64 FRM_FM_4X
 SG_ FRM_27_CRC : 7|16@0+ (1,0) [0|65535] ""  Vector__XXX
 SG_ FRM_27_RollgCntr : 23|8@0+ (1,0) [0|255] ""  Vector__XXX
 SG_ FRM_27_DetnBlockCounter : 27|4@0+ (1,0) [0|15] ""  Vector__XXX
 SG_ FRM_27_DetnMotionSts_024 : 29|2@0+ (1,0) [0|3] ""  Vector__XXX
 SG_ FRM_27_DetnRngRadial_024 : 39|15@0+ (0.01,0) [0|200] "m"  Vector__XXX
 SG_ FRM_27_DetnAziAngle_024 : 40|11@0+ (0.1,-90) [-90|90] "deg"  Vector__XXX
 SG_ FRM_27_DetnElevnAngle_024 : 61|8@0+ (0.1,-10) [-10|10] "deg"  Vector__XXX
 SG_ FRM_27_DetnRelVelRadial_024 : 69|15@0+ (0.01,-100) [-100|80] "m/s"  Vector__XXX
 SG_ FRM_27_DetnSNR_024 : 86|7@0+ (1,0) [0|100] "dB"  Vector__XXX
 SG_ FRM_27_DetnRCS_024 : 95|15@0+ (0.01,-50) [-50|128] "dBsm"  Vector__XXX
 SG_ FRM_27_DetnQuality_024 : 96|4@0+ (10,0) [0|100] "%"  Vector__XXX
 SG_ FRM_27_DetnMotionSts_025 : 31|2@0+ (1,0) [0|3] ""  Vector__XXX
 SG_ FRM_27_DetnRngRadial_025 : 108|15@0+ (0.01,0) [0|200] "m"  Vector__XXX
 SG_ FRM_27_DetnAziAngle_025 : 125|11@0+ (0.1,-90) [-90|90] "deg"  Vector__XXX
 SG_ FRM_27_DetnElevnAngle_025 : 130|8@0+ (0.1,-10) [-10|10] "deg"  Vector__XXX
 SG_ FRM_27_DetnRelVelRadial_025 : 138|15@0+ (0.01,-100) [-100|80] "m/s"  Vector__XXX
 SG_ FRM_27_DetnSNR_025 : 155|7@0+ (1,0) [0|100] "dB"  Vector__XXX
 SG_ FRM_27_DetnRCS_025 : 164|15@0+ (0.01,-50) [-50|128] "dBsm"  Vector__XXX
 SG_ FRM_27_DetnQuality_025 : 181|4@0+ (10,0) [0|100] "%"  Vector__XXX
 SG_ FRM_27_DetnMotionSts_026 : 177|2@0+ (1,0) [0|3] ""  Vector__XXX
 SG_ FRM_27_DetnRngRadial_026 : 191|15@0+ (0.01,0) [0|200] "m"  Vector__XXX
 SG_ FRM_27_DetnAziAngle_026 : 192|11@0+ (0.1,-90) [-90|90] "deg"  Vector__XXX
 SG_ FRM_27_DetnElevnAngle_026 : 213|8@0+ (0.1,-10) [-10|10] "deg"  Vector__XXX
 SG_ FRM_27_DetnRelVelRadial_026 : 221|15@0+ (0.01,-100) [-100|80] "m/s"  Vector__XXX
 SG_ FRM_27_DetnSNR_026 : 238|7@0+ (1,0) [0|100] "dB"  Vector__XXX
 SG_ FRM_27_DetnRCS_026 : 247|15@0+ (0.01,-50) [-50|128] "dBsm"  Vector__XXX
 SG_ FRM_27_DetnQuality_026 : 248|4@0+ (10,0) [0|100] "%"  Vector__XXX
 SG_ FRM_27_DetnMotionSts_027 : 260|2@0+ (1,0) [0|3] ""  Vector__XXX
 SG_ FRM_27_DetnRngRadial_027 : 258|15@0+ (0.01,0) [0|200] "m"  Vector__XXX
 SG_ FRM_27_DetnAziAngle_027 : 275|11@0+ (0.1,-90) [-90|90] "deg"  Vector__XXX
 SG_ FRM_27_DetnElevnAngle_027 : 280|8@0+ (0.1,-10) [-10|10] "deg"  Vector__XXX
 SG_ FRM_27_DetnRelVelRadial_027 : 288|15@0+ (0.01,-100) [-100|80] "m/s"  Vector__XXX
 SG_ FRM_27_DetnSNR_027 : 305|7@0+ (1,0) [0|100] "dB"  Vector__XXX
 SG_ FRM_27_DetnRCS_027 : 314|15@0+ (0.01,-50) [-50|128] "dBsm"  Vector__XXX
 SG_ FRM_27_DetnQuality_027 : 331|4@0+ (10,0) [0|100] "%"  Vector__XXX
 SG_ FRM_27_DetnMotionSts_028 : 343|2@0+ (1,0) [0|3] ""  Vector__XXX
 SG_ FRM_27_DetnRngRadial_028 : 341|15@0+ (0.01,0) [0|200] "m"  Vector__XXX
 SG_ FRM_27_DetnAziAngle_028 : 358|11@0+ (0.1,-90) [-90|90] "deg"  Vector__XXX
 SG_ FRM_27_DetnElevnAngle_028 : 363|8@0+ (0.1,-10) [-10|10] "deg"  Vector__XXX
 SG_ FRM_27_DetnRelVelRadial_028 : 371|15@0+ (0.01,-100) [-100|80] "m/s"  Vector__XXX
 SG_ FRM_27_DetnSNR_028 : 388|7@0+ (1,0) [0|100] "dB"  Vector__XXX
 SG_ FRM_27_DetnRCS_028 : 397|15@0+ (0.01,-50) [-50|128] "dBsm"  Vector__XXX
 SG_ FRM_27_DetnQuality_028 : 414|4@0+ (10,0) [0|100] "%"  Vector__XXX
 SG_ FRM_27_DetnMotionSts_029 : 410|2@0+ (1,0) [0|3] ""  Vector__XXX
 SG_ FRM_27_DetnRngRadial_029 : 408|15@0+ (0.01,0) [0|200] "m"  Vector__XXX
 SG_ FRM_27_DetnAziAngle_029 : 425|11@0+ (0.1,-90) [-90|90] "deg"  Vector__XXX
 SG_ FRM_27_DetnElevnAngle_029 : 446|8@0+ (0.1,-10) [-10|10] "deg"  Vector__XXX
 SG_ FRM_27_DetnRelVelRadial_029 : 454|15@0+ (0.01,-100) [-100|80] "m/s"  Vector__XXX
 SG_ FRM_27_DetnSNR_029 : 471|7@0+ (1,0) [0|100] "dB"  Vector__XXX
 SG_ FRM_27_DetnRCS_029 : 464|15@0+ (0.01,-50) [-50|128] "dBsm"  Vector__XXX
 SG_ FRM_27_DetnQuality_029 : 481|4@0+ (10,0) [0|100] "%"  Vector__XXX

BO_ 999 FRM_28: 64 FRM_FM_4X
 SG_ FRM_28_CRC : 7|16@0+ (1,0) [0|65535] ""  Vector__XXX
 SG_ FRM_28_RollgCntr : 23|8@0+ (1,0) [0|255] ""  Vector__XXX
 SG_ FRM_28_DetnBlockCounter : 27|4@0+ (1,0) [0|15] ""  Vector__XXX
 SG_ FRM_28_DetnMotionSts_030 : 29|2@0+ (1,0) [0|3] ""  Vector__XXX
 SG_ FRM_28_DetnRngRadial_030 : 39|15@0+ (0.01,0) [0|200] "m"  Vector__XXX
 SG_ FRM_28_DetnAziAngle_030 : 40|11@0+ (0.1,-90) [-90|90] "deg"  Vector__XXX
 SG_ FRM_28_DetnElevnAngle_030 : 61|8@0+ (0.1,-10) [-10|10] "deg"  Vector__XXX
 SG_ FRM_28_DetnRelVelRadial_030 : 69|15@0+ (0.01,-100) [-100|80] "m/s"  Vector__XXX
 SG_ FRM_28_DetnSNR_030 : 86|7@0+ (1,0) [0|100] "dB"  Vector__XXX
 SG_ FRM_28_DetnRCS_030 : 95|15@0+ (0.01,-50) [-50|128] "dBsm"  Vector__XXX
 SG_ FRM_28_DetnQuality_030 : 96|4@0+ (10,0) [0|100] "%"  Vector__XXX
 SG_ FRM_28_DetnMotionSts_031 : 31|2@0+ (1,0) [0|3] ""  Vector__XXX
 SG_ FRM_28_DetnRngRadial_031 : 108|15@0+ (0.01,0) [0|200] "m"  Vector__XXX
 SG_ FRM_28_DetnAziAngle_031 : 125|11@0+ (0.1,-90) [-90|90] "deg"  Vector__XXX
 SG_ FRM_28_DetnElevnAngle_031 : 130|8@0+ (0.1,-10) [-10|10] "deg"  Vector__XXX
 SG_ FRM_28_DetnRelVelRadial_031 : 138|15@0+ (0.01,-100) [-100|80] "m/s"  Vector__XXX
 SG_ FRM_28_DetnSNR_031 : 155|7@0+ (1,0) [0|100] "dB"  Vector__XXX
 SG_ FRM_28_DetnRCS_031 : 164|15@0+ (0.01,-50) [-50|128] "dBsm"  Vector__XXX
 SG_ FRM_28_DetnQuality_031 : 181|4@0+ (10,0) [0|100] "%"  Vector__XXX
 SG_ FRM_28_DetnMotionSts_032 : 177|2@0+ (1,0) [0|3] ""  Vector__XXX
 SG_ FRM_28_DetnRngRadial_032 : 191|15@0+ (0.01,0) [0|200] "m"  Vector__XXX
 SG_ FRM_28_DetnAziAngle_032 : 192|11@0+ (0.1,-90) [-90|90] "deg"  Vector__XXX
 SG_ FRM_28_DetnElevnAngle_032 : 213|8@0+ (0.1,-10) [-10|10] "deg"  Vector__XXX
 SG_ FRM_28_DetnRelVelRadial_032 : 221|15@0+ (0.01,-100) [-100|80] "m/s"  Vector__XXX
 SG_ FRM_28_DetnSNR_032 : 238|7@0+ (1,0) [0|100] "dB"  Vector__XXX
 SG_ FRM_28_DetnRCS_032 : 247|15@0+ (0.01,-50) [-50|128] "dBsm"  Vector__XXX
 SG_ FRM_28_DetnQuality_032 : 248|4@0+ (10,0) [0|100] "%"  Vector__XXX
 SG_ FRM_28_DetnMotionSts_033 : 260|2@0+ (1,0) [0|3] ""  Vector__XXX
 SG_ FRM_28_DetnRngRadial_033 : 258|15@0+ (0.01,0) [0|200] "m"  Vector__XXX
 SG_ FRM_28_DetnAziAngle_033 : 275|11@0+ (0.1,-90) [-90|90] "deg"  Vector__XXX
 SG_ FRM_28_DetnElevnAngle_033 : 280|8@0+ (0.1,-10) [-10|10] "deg"  Vector__XXX
 SG_ FRM_28_DetnRelVelRadial_033 : 288|15@0+ (0.01,-100) [-100|80] "m/s"  Vector__XXX
 SG_ FRM_28_DetnSNR_033 : 305|7@0+ (1,0) [0|100] "dB"  Vector__XXX
 SG_ FRM_28_DetnRCS_033 : 314|15@0+ (0.01,-50) [-50|128] "dBsm"  Vector__XXX
 SG_ FRM_28_DetnQuality_033 : 331|4@0+ (10,0) [0|100] "%"  Vector__XXX
 SG_ FRM_28_DetnMotionSts_034 : 343|2@0+ (1,0) [0|3] ""  Vector__XXX
 SG_ FRM_28_DetnRngRadial_034 : 341|15@0+ (0.01,0) [0|200] "m"  Vector__XXX
 SG_ FRM_28_DetnAziAngle_034 : 358|11@0+ (0.1,-90) [-90|90] "deg"  Vector__XXX
 SG_ FRM_28_DetnElevnAngle_034 : 363|8@0+ (0.1,-10) [-10|10] "deg"  Vector__XXX
 SG_ FRM_28_DetnRelVelRadial_034 : 371|15@0+ (0.01,-100) [-100|80] "m/s"  Vector__XXX
 SG_ FRM_28_DetnSNR_034 : 388|7@0+ (1,0) [0|100] "dB"  Vector__XXX
 SG_ FRM_28_DetnRCS_034 : 397|15@0+ (0.01,-50) [-50|128] "dBsm"  Vector__XXX
 SG_ FRM_28_DetnQuality_034 : 414|4@0+ (10,0) [0|100] "%"  Vector__XXX
 SG_ FRM_28_DetnMotionSts_035 : 410|2@0+ (1,0) [0|3] ""  Vector__XXX
 SG_ FRM_28_DetnRngRadial_035 : 408|15@0+ (0.01,0) [0|200] "m"  Vector__XXX
 SG_ FRM_28_DetnAziAngle_035 : 425|11@0+ (0.1,-90) [-90|90] "deg"  Vector__XXX
 SG_ FRM_28_DetnElevnAngle_035 : 446|8@0+ (0.1,-10) [-10|10] "deg"  Vector__XXX
 SG_ FRM_28_DetnRelVelRadial_035 : 454|15@0+ (0.01,-100) [-100|80] "m/s"  Vector__XXX
 SG_ FRM_28_DetnSNR_035 : 471|7@0+ (1,0) [0|100] "dB"  Vector__XXX
 SG_ FRM_28_DetnRCS_035 : 464|15@0+ (0.01,-50) [-50|128] "dBsm"  Vector__XXX
 SG_ FRM_28_DetnQuality_035 : 481|4@0+ (10,0) [0|100] "%"  Vector__XXX

BO_ 1000 FRM_29: 64 FRM_FM_4X
 SG_ FRM_29_CRC : 7|16@0+ (1,0) [0|65535] ""  Vector__XXX
 SG_ FRM_29_RollgCntr : 23|8@0+ (1,0) [0|255] ""  Vector__XXX
 SG_ FRM_29_DetnBlockCounter : 27|4@0+ (1,0) [0|15] ""  Vector__XXX
 SG_ FRM_29_DetnMotionSts_036 : 29|2@0+ (1,0) [0|3] ""  Vector__XXX
 SG_ FRM_29_DetnRngRadial_036 : 39|15@0+ (0.01,0) [0|200] "m"  Vector__XXX
 SG_ FRM_29_DetnAziAngle_036 : 40|11@0+ (0.1,-90) [-90|90] "deg"  Vector__XXX
 SG_ FRM_29_DetnElevnAngle_036 : 61|8@0+ (0.1,-10) [-10|10] "deg"  Vector__XXX
 SG_ FRM_29_DetnRelVelRadial_036 : 69|15@0+ (0.01,-100) [-100|80] "m/s"  Vector__XXX
 SG_ FRM_29_DetnSNR_036 : 86|7@0+ (1,0) [0|100] "dB"  Vector__XXX
 SG_ FRM_29_DetnRCS_036 : 95|15@0+ (0.01,-50) [-50|128] "dBsm"  Vector__XXX
 SG_ FRM_29_DetnQuality_036 : 96|4@0+ (10,0) [0|100] "%"  Vector__XXX
 SG_ FRM_29_DetnMotionSts_037 : 31|2@0+ (1,0) [0|3] ""  Vector__XXX
 SG_ FRM_29_DetnRngRadial_037 : 108|15@0+ (0.01,0) [0|200] "m"  Vector__XXX
 SG_ FRM_29_DetnAziAngle_037 : 125|11@0+ (0.1,-90) [-90|90] "deg"  Vector__XXX
 SG_ FRM_29_DetnElevnAngle_037 : 130|8@0+ (0.1,-10) [-10|10] "deg"  Vector__XXX
 SG_ FRM_29_DetnRelVelRadial_037 : 138|15@0+ (0.01,-100) [-100|80] "m/s"  Vector__XXX
 SG_ FRM_29_DetnSNR_037 : 155|7@0+ (1,0) [0|100] "dB"  Vector__XXX
 SG_ FRM_29_DetnRCS_037 : 164|15@0+ (0.01,-50) [-50|128] "dBsm"  Vector__XXX
 SG_ FRM_29_DetnQuality_037 : 181|4@0+ (10,0) [0|100] "%"  Vector__XXX
 SG_ FRM_29_DetnMotionSts_038 : 177|2@0+ (1,0) [0|3] ""  Vector__XXX
 SG_ FRM_29_DetnRngRadial_038 : 191|15@0+ (0.01,0) [0|200] "m"  Vector__XXX
 SG_ FRM_29_DetnAziAngle_038 : 192|11@0+ (0.1,-90) [-90|90] "deg"  Vector__XXX
 SG_ FRM_29_DetnElevnAngle_038 : 213|8@0+ (0.1,-10) [-10|10] "deg"  Vector__XXX
 SG_ FRM_29_DetnRelVelRadial_038 : 221|15@0+ (0.01,-100) [-100|80] "m/s"  Vector__XXX
 SG_ FRM_29_DetnSNR_038 : 238|7@0+ (1,0) [0|100] "dB"  Vector__XXX
 SG_ FRM_29_DetnRCS_038 : 247|15@0+ (0.01,-50) [-50|128] "dBsm"  Vector__XXX
 SG_ FRM_29_DetnQuality_038 : 248|4@0+ (10,0) [0|100] "%"  Vector__XXX
 SG_ FRM_29_DetnMotionSts_039 : 260|2@0+ (1,0) [0|3] ""  Vector__XXX
 SG_ FRM_29_DetnRngRadial_039 : 258|15@0+ (0.01,0) [0|200] "m"  Vector__XXX
 SG_ FRM_29_DetnAziAngle_039 : 275|11@0+ (0.1,-90) [-90|90] "deg"  Vector__XXX
 SG_ FRM_29_DetnElevnAngle_039 : 280|8@0+ (0.1,-10) [-10|10] "deg"  Vector__XXX
 SG_ FRM_29_DetnRelVelRadial_039 : 288|15@0+ (0.01,-100) [-100|80] "m/s"  Vector__XXX
 SG_ FRM_29_DetnSNR_039 : 305|7@0+ (1,0) [0|100] "dB"  Vector__XXX
 SG_ FRM_29_DetnRCS_039 : 314|15@0+ (0.01,-50) [-50|128] "dBsm"  Vector__XXX
 SG_ FRM_29_DetnQuality_039 : 331|4@0+ (10,0) [0|100] "%"  Vector__XXX
 SG_ FRM_29_DetnMotionSts_040 : 343|2@0+ (1,0) [0|3] ""  Vector__XXX
 SG_ FRM_29_DetnRngRadial_040 : 341|15@0+ (0.01,0) [0|200] "m"  Vector__XXX
 SG_ FRM_29_DetnAziAngle_040 : 358|11@0+ (0.1,-90) [-90|90] "deg"  Vector__XXX
 SG_ FRM_29_DetnElevnAngle_040 : 363|8@0+ (0.1,-10) [-10|10] "deg"  Vector__XXX
 SG_ FRM_29_DetnRelVelRadial_040 : 371|15@0+ (0.01,-100) [-100|80] "m/s"  Vector__XXX
 SG_ FRM_29_DetnSNR_040 : 388|7@0+ (1,0) [0|100] "dB"  Vector__XXX
 SG_ FRM_29_DetnRCS_040 : 397|15@0+ (0.01,-50) [-50|128] "dBsm"  Vector__XXX
 SG_ FRM_29_DetnQuality_040 : 414|4@0+ (10,0) [0|100] "%"  Vector__XXX
 SG_ FRM_29_DetnMotionSts_041 : 410|2@0+ (1,0) [0|3] ""  Vector__XXX
 SG_ FRM_29_DetnRngRadial_041 : 408|15@0+ (0.01,0) [0|200] "m"  Vector__XXX
 SG_ FRM_29_DetnAziAngle_041 : 425|11@0+ (0.1,-90) [-90|90] "deg"  Vector__XXX
 SG_ FRM_29_DetnElevnAngle_041 : 446|8@0+ (0.1,-10) [-10|10] "deg"  Vector__XXX
 SG_ FRM_29_DetnRelVelRadial_041 : 454|15@0+ (0.01,-100) [-100|80] "m/s"  Vector__XXX
 SG_ FRM_29_DetnSNR_041 : 471|7@0+ (1,0) [0|100] "dB"  Vector__XXX
 SG_ FRM_29_DetnRCS_041 : 464|15@0+ (0.01,-50) [-50|128] "dBsm"  Vector__XXX
 SG_ FRM_29_DetnQuality_041 : 481|4@0+ (10,0) [0|100] "%"  Vector__XXX

BO_ 1001 FRM_30: 64 FRM_FM_4X
 SG_ FRM_30_CRC : 7|16@0+ (1,0) [0|65535] ""  Vector__XXX
 SG_ FRM_30_RollgCntr : 23|8@0+ (1,0) [0|255] ""  Vector__XXX
 SG_ FRM_30_DetnBlockCounter : 27|4@0+ (1,0) [0|15] ""  Vector__XXX
 SG_ FRM_30_DetnMotionSts_042 : 29|2@0+ (1,0) [0|3] ""  Vector__XXX
 SG_ FRM_30_DetnRngRadial_042 : 39|15@0+ (0.01,0) [0|200] "m"  Vector__XXX
 SG_ FRM_30_DetnAziAngle_042 : 40|11@0+ (0.1,-90) [-90|90] "deg"  Vector__XXX
 SG_ FRM_30_DetnElevnAngle_042 : 61|8@0+ (0.1,-10) [-10|10] "deg"  Vector__XXX
 SG_ FRM_30_DetnRelVelRadial_042 : 69|15@0+ (0.01,-100) [-100|80] "m/s"  Vector__XXX
 SG_ FRM_30_DetnSNR_042 : 86|7@0+ (1,0) [0|100] "dB"  Vector__XXX
 SG_ FRM_30_DetnRCS_042 : 95|15@0+ (0.01,-50) [-50|128] "dBsm"  Vector__XXX
 SG_ FRM_30_DetnQuality_042 : 96|4@0+ (10,0) [0|100] "%"  Vector__XXX
 SG_ FRM_30_DetnMotionSts_043 : 31|2@0+ (1,0) [0|3] ""  Vector__XXX
 SG_ FRM_30_DetnRngRadial_043 : 108|15@0+ (0.01,0) [0|200] "m"  Vector__XXX
 SG_ FRM_30_DetnAziAngle_043 : 125|11@0+ (0.1,-90) [-90|90] "deg"  Vector__XXX
 SG_ FRM_30_DetnElevnAngle_043 : 130|8@0+ (0.1,-10) [-10|10] "deg"  Vector__XXX
 SG_ FRM_30_DetnRelVelRadial_043 : 138|15@0+ (0.01,-100) [-100|80] "m/s"  Vector__XXX
 SG_ FRM_30_DetnSNR_043 : 155|7@0+ (1,0) [0|100] "dB"  Vector__XXX
 SG_ FRM_30_DetnRCS_043 : 164|15@0+ (0.01,-50) [-50|128] "dBsm"  Vector__XXX
 SG_ FRM_30_DetnQuality_043 : 181|4@0+ (10,0) [0|100] "%"  Vector__XXX
 SG_ FRM_30_DetnMotionSts_044 : 177|2@0+ (1,0) [0|3] ""  Vector__XXX
 SG_ FRM_30_DetnRngRadial_044 : 191|15@0+ (0.01,0) [0|200] "m"  Vector__XXX
 SG_ FRM_30_DetnAziAngle_044 : 192|11@0+ (0.1,-90) [-90|90] "deg"  Vector__XXX
 SG_ FRM_30_DetnElevnAngle_044 : 213|8@0+ (0.1,-10) [-10|10] "deg"  Vector__XXX
 SG_ FRM_30_DetnRelVelRadial_044 : 221|15@0+ (0.01,-100) [-100|80] "m/s"  Vector__XXX
 SG_ FRM_30_DetnSNR_044 : 238|7@0+ (1,0) [0|100] "dB"  Vector__XXX
 SG_ FRM_30_DetnRCS_044 : 247|15@0+ (0.01,-50) [-50|128] "dBsm"  Vector__XXX
 SG_ FRM_30_DetnQuality_044 : 248|4@0+ (10,0) [0|100] "%"  Vector__XXX
 SG_ FRM_30_DetnMotionSts_045 : 260|2@0+ (1,0) [0|3] ""  Vector__XXX
 SG_ FRM_30_DetnRngRadial_045 : 258|15@0+ (0.01,0) [0|200] "m"  Vector__XXX
 SG_ FRM_30_DetnAziAngle_045 : 275|11@0+ (0.1,-90) [-90|90] "deg"  Vector__XXX
 SG_ FRM_30_DetnElevnAngle_045 : 280|8@0+ (0.1,-10) [-10|10] "deg"  Vector__XXX
 SG_ FRM_30_DetnRelVelRadial_045 : 288|15@0+ (0.01,-100) [-100|80] "m/s"  Vector__XXX
 SG_ FRM_30_DetnSNR_045 : 305|7@0+ (1,0) [0|100] "dB"  Vector__XXX
 SG_ FRM_30_DetnRCS_045 : 314|15@0+ (0.01,-50) [-50|128] "dBsm"  Vector__XXX
 SG_ FRM_30_DetnQuality_045 : 331|4@0+ (10,0) [0|100] "%"  Vector__XXX
 SG_ FRM_30_DetnMotionSts_046 : 343|2@0+ (1,0) [0|3] ""  Vector__XXX
 SG_ FRM_30_DetnRngRadial_046 : 341|15@0+ (0.01,0) [0|200] "m"  Vector__XXX
 SG_ FRM_30_DetnAziAngle_046 : 358|11@0+ (0.1,-90) [-90|90] "deg"  Vector__XXX
 SG_ FRM_30_DetnElevnAngle_046 : 363|8@0+ (0.1,-10) [-10|10] "deg"  Vector__XXX
 SG_ FRM_30_DetnRelVelRadial_046 : 371|15@0+ (0.01,-100) [-100|80] "m/s"  Vector__XXX
 SG_ FRM_30_DetnSNR_046 : 388|7@0+ (1,0) [0|100] "dB"  Vector__XXX
 SG_ FRM_30_DetnRCS_046 : 397|15@0+ (0.01,-50) [-50|128] "dBsm"  Vector__XXX
 SG_ FRM_30_DetnQuality_046 : 414|4@0+ (10,0) [0|100] "%"  Vector__XXX
 SG_ FRM_30_DetnMotionSts_047 : 410|2@0+ (1,0) [0|3] ""  Vector__XXX
 SG_ FRM_30_DetnRngRadial_047 : 408|15@0+ (0.01,0) [0|200] "m"  Vector__XXX
 SG_ FRM_30_DetnAziAngle_047 : 425|11@0+ (0.1,-90) [-90|90] "deg"  Vector__XXX
 SG_ FRM_30_DetnElevnAngle_047 : 446|8@0+ (0.1,-10) [-10|10] "deg"  Vector__XXX
 SG_ FRM_30_DetnRelVelRadial_047 : 454|15@0+ (0.01,-100) [-100|80] "m/s"  Vector__XXX
 SG_ FRM_30_DetnSNR_047 : 471|7@0+ (1,0) [0|100] "dB"  Vector__XXX
 SG_ FRM_30_DetnRCS_047 : 464|15@0+ (0.01,-50) [-50|128] "dBsm"  Vector__XXX
 SG_ FRM_30_DetnQuality_047 : 481|4@0+ (10,0) [0|100] "%"  Vector__XXX

CM_ BO_ 994 "禾多配置不发此帧报文";
CM_ BO_ 995 "禾多配置不发此帧报文";
CM_ BO_ 996 "禾多配置不发此帧报文";
CM_ BO_ 997 "禾多配置不发此帧报文";
CM_ BO_ 998 "禾多配置不发此帧报文";
CM_ BO_ 999 "禾多配置不发此帧报文";
CM_ BO_ 1000 "禾多配置不发此帧报文";
CM_ BO_ 1001 "禾多配置不发此帧报文";
CM_ SG_ 979 FRM_20_CRC "Profile5:E2E CRC16 (polynomial:0x1021)       
DataID:Use CANID,other bits Fill with 0";
CM_ SG_ 979 FRM_20_RollgCntr "Profile5:E2E Rolling message counter";
CM_ SG_ 979 FRM_20_ObjBlockCounter "Front Radar Moudle_X_Object Block Counter
前雷达目标物块计数值";
CM_ SG_ 979 FRM_20_ObjID_34 "Front Radar Moudle_X_Object ID_00
前雷达目标物身份标识码_00
ID Is An Identifier Number That Allows For Tracking Of Persistent Objects Over Time
Note:A value of 0 indicates 'no object'";
CM_ SG_ 979 FRM_20_ObjClosestDistX_34 "Front Radar Moudle_X_Object Closest Distance X_00
前雷达目标物最近点在X轴上的距离_00
Closest Position Of Target Vehicle In X Direction
The rear axle center coordinate system is used";
CM_ SG_ 979 FRM_20_ObjClosestDistY_34 "Front Radar Moudle_X_Object Closest Distance Y_00
前雷达距目标物最近点在Y轴上的距离_00
Closest Position Of Target Vehicle In Y Direction
The rear axle center coordinate system is used";
CM_ SG_ 979 FRM_20_ObjRelVelX_34 "Front Radar Moudle_X_Object Relative Velocity X_00
前雷达目标物在X轴上的相对速度_00
Relative Target Object Velocity In X Direction";
CM_ SG_ 979 FRM_20_ObjRelVelY_34 "Front Radar Moudle_X_Object Relative Velocity Y_00
前雷达目标物在Y轴上的相对速度_00
Relative Target Object Velocity In Y Direction";
CM_ SG_ 979 FRM_20_ObjAccelX_34 "Front Radar Moudle_X_Object Acceleration X_00
前雷达目标物在X轴上的加速度_00
Relative Target Object Acceleration In X Direction";
CM_ SG_ 979 FRM_20_ObjAccelY_34 "Front Radar Moudle_X_Object Acceleration Y_00
前雷达目标物在Y轴上的加速度_00
Relative Target Object Acceleration In Y Direction";
CM_ SG_ 979 FRM_20_ObjClosestDistXStd_34 "Front Radar Moudle_X_Object Closest Distance X Standard_00
前雷达目标物最近点在X轴上的距离的标准差_00
Standard Deviation Of Closest Position Of Target Vehicle in X Direction";
CM_ SG_ 979 FRM_20_ObjClosestDistYStd_34 "Front Radar Moudle_X_Object Closest Distance Y Standard_00
前雷达目标物最近点在Y轴上的距离的标准差_00
Standard Deviation Of Closest Position Of Target Vehicle in Y Direction";
CM_ SG_ 979 FRM_20_ObjRelVelXStd_34 "Front Radar Moudle_X_Object Relative Velocity X Standard_00
前雷达目标物在X轴上的相对速度的标准差_00
Standard Deviation Of Relative Velocity X";
CM_ SG_ 979 FRM_20_ObjRelVelYStd_34 "Front Radar Moudle_X_Object Relative Velocity Y Standard_00
前雷达目标物在Y轴上的相对速度的标准差_00
Standard Deviation Of Relative Velocity Y";
CM_ SG_ 979 FRM_20_ObjRelAccelXStd_34 "Front Radar Moudle_X_Object Relative  Acceleration X Standard_00
前雷达目标物在X轴上的相对加速度的标准差_00
Standard Deviation Of Relative Acceleration X";
CM_ SG_ 979 FRM_20_ObjRelAccelYStd_34 "Front Radar Moudle_X_Object Relative  Acceleration Y Standard_00
前雷达目标物相对加速度在Y轴上的标准差_00
Standard Deviation Of Relative Acceleration Y";
CM_ SG_ 979 FRM_20_ObjExistProb_34 "Front Radar Moudle_X_Object Exist Probability_00
前雷达目标物存在的可能性_00
The Probability Of An Object To Exist In Reality";
CM_ SG_ 979 FRM_20_ObjType_34 "Front Radar Moudle_X_Object Type_00
前雷达目标物的分类_00
Class Of Object Type
Note: Type of static object shall always be 0x0: unknown";
CM_ SG_ 979 FRM_20_ObjTypeConf_34 "Front Radar Moudle_X_Object Type Confidence_00
前雷达目标物分类的置信度_00
The Class Confidence Of Object Type";
CM_ SG_ 979 FRM_20_ObjTrackSts_34 "Front Radar Moudle_X_Object Track Status_00
前雷达目标物的跟踪状态_00
Signal To Indicate The Object Track Status";
CM_ SG_ 979 FRM_20_ObjMotionSts_34 "Front Radar Moudle_X_Object Motion Status_00
前雷达目标物的运动状态_00
Signal To Indicate The Object Whether Moving or Stopped or Static";
CM_ SG_ 979 FRM_20_ObjMotionDirection_34 "Front Radar Moudle_X_Object Motion Direction_00
前雷达目标物的运动方向_00
Signal To Indicate The Object Moving Direction.
Note: Moving direction of static object or stopped object shall always be 0x0: Unknown";
CM_ SG_ 979 FRM_20_ObjCenterDistX_34 "Front Radar Moudle_X_Object Center Distance X_00
前雷达目标物中心点在X轴方向的距离_00
Center Position Of Target Vehicle In X Direction
The rear axle center coordinate system is used";
CM_ SG_ 979 FRM_20_ObjCenterDistY_34 "Front Radar Moudle_X_Object Center Distance Y_00
前雷达目标物中心点在Y轴方向的距离_00
Center Position Of Target Vehicle In Y Direction
The rear axle center coordinate system is used";
CM_ SG_ 979 FRM_20_ObjLength_34 "Front Radar Moudle_X_Object Length_00
前雷达目标物的长度_00
Length Of Target
Note: Length of static object shall always be 0";
CM_ SG_ 979 FRM_20_ObjWidth_34 "Front Radar Moudle_X_Object Width_00
前雷达目标物的宽度_00
Width Of Target
Note: Width of static object shall always be 0";
CM_ SG_ 979 FRM_20_ObjElevnSts_34 "Front Radar Moudle_X_Object Elevation Status_00
前雷达目标物的高度状态_00
The Elevation Status Of An Object
Note: Elevation Status of moving object or stopped object shall always be 0x2: Obstacle";
CM_ SG_ 979 FRM_20_ObjElevnStsConf_34 "Front Radar Moudle_X_Object Elevation Status Confidence_00
前雷达目标物的高度状态的置信度_00
The Confidence Of An Object Elevation Status
Note: Elevation Status Confidence of moving object or stopped object shall always be 100%";
CM_ SG_ 979 FRM_20_ObjHeading_34 "Front Radar Moudle_X_Object Heading_00
前雷达目标物朝向_00
Heading of object 
Note: A rotation vector with anticlock-rotating as positive +π shall be used instead of -π when obect vertically backward
Note: Heading of static object shall always be 0";
CM_ SG_ 979 FRM_20_ObjID_35 "Front Radar Moudle_X_Object ID_01
前雷达目标物身份标识码_01
ID Is An Identifier Number That Allows For Tracking Of Persistent Objects Over Time
Note:A value of 0 indicates 'no object'";
CM_ SG_ 979 FRM_20_ObjClosestDistX_35 "Front Radar Moudle_X_Object Closest Distance X_01
前雷达目标物最近点在X轴上的距离_01
Closest Position Of Target Vehicle In X Direction
The rear axle center coordinate system is used";
CM_ SG_ 979 FRM_20_ObjClosestDistY_35 "Front Radar Moudle_X_Object Closest Distance Y_01
前雷达距目标物最近点在Y轴上的距离_01
Closest Position Of Target Vehicle In Y Direction
The rear axle center coordinate system is used";
CM_ SG_ 979 FRM_20_ObjRelVelX_35 "Front Radar Moudle_X_Object Relative Velocity X_01
前雷达目标物在X轴上的相对速度_01
Relative Target Object Velocity In X Direction";
CM_ SG_ 979 FRM_20_ObjRelVelY_35 "Front Radar Moudle_X_Object Relative Velocity Y_01
前雷达目标物在Y轴上的相对速度_01
Relative Target Object Velocity In Y Direction";
CM_ SG_ 979 FRM_20_ObjAccelX_35 "Front Radar Moudle_X_Object Acceleration X_01
前雷达目标物在X轴上的加速度_01
Relative Target Object Acceleration In X Direction";
CM_ SG_ 979 FRM_20_ObjAccelY_35 "Front Radar Moudle_X_Object Acceleration Y_01
前雷达目标物在Y轴上的加速度_01
Relative Target Object Acceleration In Y Direction";
CM_ SG_ 979 FRM_20_ObjClosestDistXStd_35 "Front Radar Moudle_X_Object Closest Distance X Standard_01
前雷达目标物最近点在X轴上的距离的标准差_01
Standard Deviation Of Closest Position Of Target Vehicle in X Direction";
CM_ SG_ 979 FRM_20_ObjClosestDistYStd_35 "Front Radar Moudle_X_Object Closest Distance Y Standard_01
前雷达目标物最近点在Y轴上的距离的标准差_01
Standard Deviation Of Closest Position Of Target Vehicle in Y Direction";
CM_ SG_ 979 FRM_20_ObjRelVelXStd_35 "Front Radar Moudle_X_Object Relative Velocity X Standard_01
前雷达目标物在X轴上的相对速度的标准差_01
Standard Deviation Of Relative Velocity X";
CM_ SG_ 979 FRM_20_ObjRelVelYStd_35 "Front Radar Moudle_X_Object Relative Velocity Y Standard_01
前雷达目标物在Y轴上的相对速度的标准差_01
Standard Deviation Of Relative Velocity Y";
CM_ SG_ 979 FRM_20_ObjRelAccelXStd_35 "Front Radar Moudle_X_Object Relative  Acceleration X Standard_01
前雷达目标物在X轴上的相对加速度的标准差_01
Standard Deviation Of Relative Acceleration X";
CM_ SG_ 979 FRM_20_ObjRelAccelYStd_35 "Front Radar Moudle_X_Object Relative  Acceleration Y Standard_01
前雷达目标物相对加速度在Y轴上的标准差_01
Standard Deviation Of Relative Acceleration Y";
CM_ SG_ 979 FRM_20_ObjExistProb_35 "Front Radar Moudle_X_Object Exist Probability_01
前雷达目标物存在的可能性_01
The Probability Of An Object To Exist In Reality";
CM_ SG_ 979 FRM_20_ObjType_35 "Front Radar Moudle_X_Object Type_01
前雷达目标物的分类_01
Class Of Object Type
Note: Type of static object shall always be 0x0: unknown";
CM_ SG_ 979 FRM_20_ObjTypeConf_35 "Front Radar Moudle_X_Object Type Confidence_01
前雷达目标物分类的置信度_01
The Class Confidence Of Object Type";
CM_ SG_ 979 FRM_20_ObjTrackSts_35 "Front Radar Moudle_X_Object Track Status_01
前雷达目标物的跟踪状态_01
Signal To Indicate The Object Track Status";
CM_ SG_ 979 FRM_20_ObjMotionSts_35 "Front Radar Moudle_X_Object Motion Status_01
前雷达目标物的运动状态_01
Signal To Indicate The Object Whether Moving or Stopped or Static";
CM_ SG_ 979 FRM_20_ObjMotionDirection_35 "Front Radar Moudle_X_Object Motion Direction_01
前雷达目标物的运动方向_01
Signal To Indicate The Object Moving Direction.
Note: Moving direction of static object or stopped object shall always be 0x0: Unknown";
CM_ SG_ 979 FRM_20_ObjCenterDistX_35 "Front Radar Moudle_X_Object Center Distance X_01
前雷达目标物中心点在X轴方向的距离_01
Center Position Of Target Vehicle In X Direction
The rear axle center coordinate system is used";
CM_ SG_ 979 FRM_20_ObjCenterDistY_35 "Front Radar Moudle_X_Object Center Distance Y_01
前雷达目标物中心点在Y轴方向的距离_01
Center Position Of Target Vehicle In Y Direction
The rear axle center coordinate system is used";
CM_ SG_ 979 FRM_20_ObjLength_35 "Front Radar Moudle_X_Object Length_01
前雷达目标物的长度_01
Length Of Target
Note: Length of static object shall always be 0";
CM_ SG_ 979 FRM_20_ObjWidth_35 "Front Radar Moudle_X_Object Width_01
前雷达目标物的宽度_01
Width Of Target
Note: Width of static object shall always be 0";
CM_ SG_ 979 FRM_20_ObjElevnSts_35 "Front Radar Moudle_X_Object Elevation Status_01
前雷达目标物的高度状态_01
The Elevation Status Of An Object
Note: Elevation Status of moving object or stopped object shall always be 0x2: Obstacle";
CM_ SG_ 979 FRM_20_ObjElevnStsConf_35 "Front Radar Moudle_X_Object Elevation Status Confidence_01
前雷达目标物的高度状态的置信度_01
The Confidence Of An Object Elevation Status
Note: Elevation Status Confidence of moving object or stopped object shall always be 100%";
CM_ SG_ 979 FRM_20_ObjHeading_35 "Front Radar Moudle_X_Object Heading_01
前雷达目标物朝向_01
Heading of object 
Note: A rotation vector with anticlock-rotating as positive +π shall be used instead of -π when obect vertically backward
Note: Heading of static object shall always be 0";
CM_ SG_ 992 FRM_21_CRC "Profile5:E2E CRC16 (polynomial:0x1021)       
DataID:Use CANID,other bits Fill with 0";
CM_ SG_ 992 FRM_21_RollgCntr "Profile5:E2E Rolling message counter";
CM_ SG_ 992 FRM_21_ObjBlockCounter "Front Radar Moudle_X_Object Block Counter
前雷达目标物块计数值";
CM_ SG_ 992 FRM_21_ObjID_36 "Front Radar Moudle_X_Object ID_00
前雷达目标物身份标识码_00
ID Is An Identifier Number That Allows For Tracking Of Persistent Objects Over Time
Note:A value of 0 indicates 'no object'";
CM_ SG_ 992 FRM_21_ObjClosestDistX_36 "Front Radar Moudle_X_Object Closest Distance X_00
前雷达目标物最近点在X轴上的距离_00
Closest Position Of Target Vehicle In X Direction
The rear axle center coordinate system is used";
CM_ SG_ 992 FRM_21_ObjClosestDistY_36 "Front Radar Moudle_X_Object Closest Distance Y_00
前雷达距目标物最近点在Y轴上的距离_00
Closest Position Of Target Vehicle In Y Direction
The rear axle center coordinate system is used";
CM_ SG_ 992 FRM_21_ObjRelVelX_36 "Front Radar Moudle_X_Object Relative Velocity X_00
前雷达目标物在X轴上的相对速度_00
Relative Target Object Velocity In X Direction";
CM_ SG_ 992 FRM_21_ObjRelVelY_36 "Front Radar Moudle_X_Object Relative Velocity Y_00
前雷达目标物在Y轴上的相对速度_00
Relative Target Object Velocity In Y Direction";
CM_ SG_ 992 FRM_21_ObjAccelX_36 "Front Radar Moudle_X_Object Acceleration X_00
前雷达目标物在X轴上的加速度_00
Relative Target Object Acceleration In X Direction";
CM_ SG_ 992 FRM_21_ObjAccelY_36 "Front Radar Moudle_X_Object Acceleration Y_00
前雷达目标物在Y轴上的加速度_00
Relative Target Object Acceleration In Y Direction";
CM_ SG_ 992 FRM_21_ObjClosestDistXStd_36 "Front Radar Moudle_X_Object Closest Distance X Standard_00
前雷达目标物最近点在X轴上的距离的标准差_00
Standard Deviation Of Closest Position Of Target Vehicle in X Direction";
CM_ SG_ 992 FRM_21_ObjClosestDistYStd_36 "Front Radar Moudle_X_Object Closest Distance Y Standard_00
前雷达目标物最近点在Y轴上的距离的标准差_00
Standard Deviation Of Closest Position Of Target Vehicle in Y Direction";
CM_ SG_ 992 FRM_21_ObjRelVelXStd_36 "Front Radar Moudle_X_Object Relative Velocity X Standard_00
前雷达目标物在X轴上的相对速度的标准差_00
Standard Deviation Of Relative Velocity X";
CM_ SG_ 992 FRM_21_ObjRelVelYStd_36 "Front Radar Moudle_X_Object Relative Velocity Y Standard_00
前雷达目标物在Y轴上的相对速度的标准差_00
Standard Deviation Of Relative Velocity Y";
CM_ SG_ 992 FRM_21_ObjRelAccelXStd_36 "Front Radar Moudle_X_Object Relative  Acceleration X Standard_00
前雷达目标物在X轴上的相对加速度的标准差_00
Standard Deviation Of Relative Acceleration X";
CM_ SG_ 992 FRM_21_ObjRelAccelYStd_36 "Front Radar Moudle_X_Object Relative  Acceleration Y Standard_00
前雷达目标物相对加速度在Y轴上的标准差_00
Standard Deviation Of Relative Acceleration Y";
CM_ SG_ 992 FRM_21_ObjExistProb_36 "Front Radar Moudle_X_Object Exist Probability_00
前雷达目标物存在的可能性_00
The Probability Of An Object To Exist In Reality";
CM_ SG_ 992 FRM_21_ObjType_36 "Front Radar Moudle_X_Object Type_00
前雷达目标物的分类_00
Class Of Object Type
Note: Type of static object shall always be 0x0: unknown";
CM_ SG_ 992 FRM_21_ObjTypeConf_36 "Front Radar Moudle_X_Object Type Confidence_00
前雷达目标物分类的置信度_00
The Class Confidence Of Object Type";
CM_ SG_ 992 FRM_21_ObjTrackSts_36 "Front Radar Moudle_X_Object Track Status_00
前雷达目标物的跟踪状态_00
Signal To Indicate The Object Track Status";
CM_ SG_ 992 FRM_21_ObjMotionSts_36 "Front Radar Moudle_X_Object Motion Status_00
前雷达目标物的运动状态_00
Signal To Indicate The Object Whether Moving or Stopped or Static";
CM_ SG_ 992 FRM_21_ObjMotionDirection_36 "Front Radar Moudle_X_Object Motion Direction_00
前雷达目标物的运动方向_00
Signal To Indicate The Object Moving Direction.
Note: Moving direction of static object or stopped object shall always be 0x0: Unknown";
CM_ SG_ 992 FRM_21_ObjCenterDistX_36 "Front Radar Moudle_X_Object Center Distance X_00
前雷达目标物中心点在X轴方向的距离_00
Center Position Of Target Vehicle In X Direction
The rear axle center coordinate system is used";
CM_ SG_ 992 FRM_21_ObjCenterDistY_36 "Front Radar Moudle_X_Object Center Distance Y_00
前雷达目标物中心点在Y轴方向的距离_00
Center Position Of Target Vehicle In Y Direction
The rear axle center coordinate system is used";
CM_ SG_ 992 FRM_21_ObjLength_36 "Front Radar Moudle_X_Object Length_00
前雷达目标物的长度_00
Length Of Target
Note: Length of static object shall always be 0";
CM_ SG_ 992 FRM_21_ObjWidth_36 "Front Radar Moudle_X_Object Width_00
前雷达目标物的宽度_00
Width Of Target
Note: Width of static object shall always be 0";
CM_ SG_ 992 FRM_21_ObjElevnSts_36 "Front Radar Moudle_X_Object Elevation Status_00
前雷达目标物的高度状态_00
The Elevation Status Of An Object
Note: Elevation Status of moving object or stopped object shall always be 0x2: Obstacle";
CM_ SG_ 992 FRM_21_ObjElevnStsConf_36 "Front Radar Moudle_X_Object Elevation Status Confidence_00
前雷达目标物的高度状态的置信度_00
The Confidence Of An Object Elevation Status
Note: Elevation Status Confidence of moving object or stopped object shall always be 100%";
CM_ SG_ 992 FRM_21_ObjHeading_36 "Front Radar Moudle_X_Object Heading_00
前雷达目标物朝向_00
Heading of object 
Note: A rotation vector with anticlock-rotating as positive +π shall be used instead of -π when obect vertically backward
Note: Heading of static object shall always be 0";
CM_ SG_ 992 FRM_21_ObjID_37 "Front Radar Moudle_X_Object ID_01
前雷达目标物身份标识码_01
ID Is An Identifier Number That Allows For Tracking Of Persistent Objects Over Time
Note:A value of 0 indicates 'no object'";
CM_ SG_ 992 FRM_21_ObjClosestDistX_37 "Front Radar Moudle_X_Object Closest Distance X_01
前雷达目标物最近点在X轴上的距离_01
Closest Position Of Target Vehicle In X Direction
The rear axle center coordinate system is used";
CM_ SG_ 992 FRM_21_ObjClosestDistY_37 "Front Radar Moudle_X_Object Closest Distance Y_01
前雷达距目标物最近点在Y轴上的距离_01
Closest Position Of Target Vehicle In Y Direction
The rear axle center coordinate system is used";
CM_ SG_ 992 FRM_21_ObjRelVelX_37 "Front Radar Moudle_X_Object Relative Velocity X_01
前雷达目标物在X轴上的相对速度_01
Relative Target Object Velocity In X Direction";
CM_ SG_ 992 FRM_21_ObjRelVelY_37 "Front Radar Moudle_X_Object Relative Velocity Y_01
前雷达目标物在Y轴上的相对速度_01
Relative Target Object Velocity In Y Direction";
CM_ SG_ 992 FRM_21_ObjAccelX_37 "Front Radar Moudle_X_Object Acceleration X_01
前雷达目标物在X轴上的加速度_01
Relative Target Object Acceleration In X Direction";
CM_ SG_ 992 FRM_21_ObjAccelY_37 "Front Radar Moudle_X_Object Acceleration Y_01
前雷达目标物在Y轴上的加速度_01
Relative Target Object Acceleration In Y Direction";
CM_ SG_ 992 FRM_21_ObjClosestDistXStd_37 "Front Radar Moudle_X_Object Closest Distance X Standard_01
前雷达目标物最近点在X轴上的距离的标准差_01
Standard Deviation Of Closest Position Of Target Vehicle in X Direction";
CM_ SG_ 992 FRM_21_ObjClosestDistYStd_37 "Front Radar Moudle_X_Object Closest Distance Y Standard_01
前雷达目标物最近点在Y轴上的距离的标准差_01
Standard Deviation Of Closest Position Of Target Vehicle in Y Direction";
CM_ SG_ 992 FRM_21_ObjRelVelXStd_37 "Front Radar Moudle_X_Object Relative Velocity X Standard_01
前雷达目标物在X轴上的相对速度的标准差_01
Standard Deviation Of Relative Velocity X";
CM_ SG_ 992 FRM_21_ObjRelVelYStd_37 "Front Radar Moudle_X_Object Relative Velocity Y Standard_01
前雷达目标物在Y轴上的相对速度的标准差_01
Standard Deviation Of Relative Velocity Y";
CM_ SG_ 992 FRM_21_ObjRelAccelXStd_37 "Front Radar Moudle_X_Object Relative  Acceleration X Standard_01
前雷达目标物在X轴上的相对加速度的标准差_01
Standard Deviation Of Relative Acceleration X";
CM_ SG_ 992 FRM_21_ObjRelAccelYStd_37 "Front Radar Moudle_X_Object Relative  Acceleration Y Standard_01
前雷达目标物相对加速度在Y轴上的标准差_01
Standard Deviation Of Relative Acceleration Y";
CM_ SG_ 992 FRM_21_ObjExistProb_37 "Front Radar Moudle_X_Object Exist Probability_01
前雷达目标物存在的可能性_01
The Probability Of An Object To Exist In Reality";
CM_ SG_ 992 FRM_21_ObjType_37 "Front Radar Moudle_X_Object Type_01
前雷达目标物的分类_01
Class Of Object Type
Note: Type of static object shall always be 0x0: unknown";
CM_ SG_ 992 FRM_21_ObjTypeConf_37 "Front Radar Moudle_X_Object Type Confidence_01
前雷达目标物分类的置信度_01
The Class Confidence Of Object Type";
CM_ SG_ 992 FRM_21_ObjTrackSts_37 "Front Radar Moudle_X_Object Track Status_01
前雷达目标物的跟踪状态_01
Signal To Indicate The Object Track Status";
CM_ SG_ 992 FRM_21_ObjMotionSts_37 "Front Radar Moudle_X_Object Motion Status_01
前雷达目标物的运动状态_01
Signal To Indicate The Object Whether Moving or Stopped or Static";
CM_ SG_ 992 FRM_21_ObjMotionDirection_37 "Front Radar Moudle_X_Object Motion Direction_01
前雷达目标物的运动方向_01
Signal To Indicate The Object Moving Direction.
Note: Moving direction of static object or stopped object shall always be 0x0: Unknown";
CM_ SG_ 992 FRM_21_ObjCenterDistX_37 "Front Radar Moudle_X_Object Center Distance X_01
前雷达目标物中心点在X轴方向的距离_01
Center Position Of Target Vehicle In X Direction
The rear axle center coordinate system is used";
CM_ SG_ 992 FRM_21_ObjCenterDistY_37 "Front Radar Moudle_X_Object Center Distance Y_01
前雷达目标物中心点在Y轴方向的距离_01
Center Position Of Target Vehicle In Y Direction
The rear axle center coordinate system is used";
CM_ SG_ 992 FRM_21_ObjLength_37 "Front Radar Moudle_X_Object Length_01
前雷达目标物的长度_01
Length Of Target
Note: Length of static object shall always be 0";
CM_ SG_ 992 FRM_21_ObjWidth_37 "Front Radar Moudle_X_Object Width_01
前雷达目标物的宽度_01
Width Of Target
Note: Width of static object shall always be 0";
CM_ SG_ 992 FRM_21_ObjElevnSts_37 "Front Radar Moudle_X_Object Elevation Status_01
前雷达目标物的高度状态_01
The Elevation Status Of An Object
Note: Elevation Status of moving object or stopped object shall always be 0x2: Obstacle";
CM_ SG_ 992 FRM_21_ObjElevnStsConf_37 "Front Radar Moudle_X_Object Elevation Status Confidence_01
前雷达目标物的高度状态的置信度_01
The Confidence Of An Object Elevation Status
Note: Elevation Status Confidence of moving object or stopped object shall always be 100%";
CM_ SG_ 992 FRM_21_ObjHeading_37 "Front Radar Moudle_X_Object Heading_01
前雷达目标物朝向_01
Heading of object 
Note: A rotation vector with anticlock-rotating as positive +π shall be used instead of -π when obect vertically backward
Note: Heading of static object shall always be 0";
CM_ SG_ 993 FRM_22_CRC "Profile5:E2E CRC16 (polynomial:0x1021)       
DataID:Use CANID,other bits Fill with 0";
CM_ SG_ 993 FRM_22_RollgCntr "Profile5:E2E Rolling message counter";
CM_ SG_ 993 FRM_22_ObjBlockCounter "Front Radar Moudle_X_Object Block Counter
前雷达目标物块计数值";
CM_ SG_ 993 FRM_22_ObjID_38 "Front Radar Moudle_X_Object ID_00
前雷达目标物身份标识码_00
ID Is An Identifier Number That Allows For Tracking Of Persistent Objects Over Time
Note:A value of 0 indicates 'no object'";
CM_ SG_ 993 FRM_22_ObjClosestDistX_38 "Front Radar Moudle_X_Object Closest Distance X_00
前雷达目标物最近点在X轴上的距离_00
Closest Position Of Target Vehicle In X Direction
The rear axle center coordinate system is used";
CM_ SG_ 993 FRM_22_ObjClosestDistY_38 "Front Radar Moudle_X_Object Closest Distance Y_00
前雷达距目标物最近点在Y轴上的距离_00
Closest Position Of Target Vehicle In Y Direction
The rear axle center coordinate system is used";
CM_ SG_ 993 FRM_22_ObjRelVelX_38 "Front Radar Moudle_X_Object Relative Velocity X_00
前雷达目标物在X轴上的相对速度_00
Relative Target Object Velocity In X Direction";
CM_ SG_ 993 FRM_22_ObjRelVelY_38 "Front Radar Moudle_X_Object Relative Velocity Y_00
前雷达目标物在Y轴上的相对速度_00
Relative Target Object Velocity In Y Direction";
CM_ SG_ 993 FRM_22_ObjAccelX_38 "Front Radar Moudle_X_Object Acceleration X_00
前雷达目标物在X轴上的加速度_00
Relative Target Object Acceleration In X Direction";
CM_ SG_ 993 FRM_22_ObjAccelY_38 "Front Radar Moudle_X_Object Acceleration Y_00
前雷达目标物在Y轴上的加速度_00
Relative Target Object Acceleration In Y Direction";
CM_ SG_ 993 FRM_22_ObjClosestDistXStd_38 "Front Radar Moudle_X_Object Closest Distance X Standard_00
前雷达目标物最近点在X轴上的距离的标准差_00
Standard Deviation Of Closest Position Of Target Vehicle in X Direction";
CM_ SG_ 993 FRM_22_ObjClosestDistYStd_38 "Front Radar Moudle_X_Object Closest Distance Y Standard_00
前雷达目标物最近点在Y轴上的距离的标准差_00
Standard Deviation Of Closest Position Of Target Vehicle in Y Direction";
CM_ SG_ 993 FRM_22_ObjRelVelXStd_38 "Front Radar Moudle_X_Object Relative Velocity X Standard_00
前雷达目标物在X轴上的相对速度的标准差_00
Standard Deviation Of Relative Velocity X";
CM_ SG_ 993 FRM_22_ObjRelVelYStd_38 "Front Radar Moudle_X_Object Relative Velocity Y Standard_00
前雷达目标物在Y轴上的相对速度的标准差_00
Standard Deviation Of Relative Velocity Y";
CM_ SG_ 993 FRM_22_ObjRelAccelXStd_38 "Front Radar Moudle_X_Object Relative  Acceleration X Standard_00
前雷达目标物在X轴上的相对加速度的标准差_00
Standard Deviation Of Relative Acceleration X";
CM_ SG_ 993 FRM_22_ObjRelAccelYStd_38 "Front Radar Moudle_X_Object Relative  Acceleration Y Standard_00
前雷达目标物相对加速度在Y轴上的标准差_00
Standard Deviation Of Relative Acceleration Y";
CM_ SG_ 993 FRM_22_ObjExistProb_38 "Front Radar Moudle_X_Object Exist Probability_00
前雷达目标物存在的可能性_00
The Probability Of An Object To Exist In Reality";
CM_ SG_ 993 FRM_22_ObjType_38 "Front Radar Moudle_X_Object Type_00
前雷达目标物的分类_00
Class Of Object Type
Note: Type of static object shall always be 0x0: unknown";
CM_ SG_ 993 FRM_22_ObjTypeConf_38 "Front Radar Moudle_X_Object Type Confidence_00
前雷达目标物分类的置信度_00
The Class Confidence Of Object Type";
CM_ SG_ 993 FRM_22_ObjTrackSts_38 "Front Radar Moudle_X_Object Track Status_00
前雷达目标物的跟踪状态_00
Signal To Indicate The Object Track Status";
CM_ SG_ 993 FRM_22_ObjMotionSts_38 "Front Radar Moudle_X_Object Motion Status_00
前雷达目标物的运动状态_00
Signal To Indicate The Object Whether Moving or Stopped or Static";
CM_ SG_ 993 FRM_22_ObjMotionDirection_38 "Front Radar Moudle_X_Object Motion Direction_00
前雷达目标物的运动方向_00
Signal To Indicate The Object Moving Direction.
Note: Moving direction of static object or stopped object shall always be 0x0: Unknown";
CM_ SG_ 993 FRM_22_ObjCenterDistX_38 "Front Radar Moudle_X_Object Center Distance X_00
前雷达目标物中心点在X轴方向的距离_00
Center Position Of Target Vehicle In X Direction
The rear axle center coordinate system is used";
CM_ SG_ 993 FRM_22_ObjCenterDistY_38 "Front Radar Moudle_X_Object Center Distance Y_00
前雷达目标物中心点在Y轴方向的距离_00
Center Position Of Target Vehicle In Y Direction
The rear axle center coordinate system is used";
CM_ SG_ 993 FRM_22_ObjLength_38 "Front Radar Moudle_X_Object Length_00
前雷达目标物的长度_00
Length Of Target
Note: Length of static object shall always be 0";
CM_ SG_ 993 FRM_22_ObjWidth_38 "Front Radar Moudle_X_Object Width_00
前雷达目标物的宽度_00
Width Of Target
Note: Width of static object shall always be 0";
CM_ SG_ 993 FRM_22_ObjElevnSts_38 "Front Radar Moudle_X_Object Elevation Status_00
前雷达目标物的高度状态_00
The Elevation Status Of An Object
Note: Elevation Status of moving object or stopped object shall always be 0x2: Obstacle";
CM_ SG_ 993 FRM_22_ObjElevnStsConf_38 "Front Radar Moudle_X_Object Elevation Status Confidence_00
前雷达目标物的高度状态的置信度_00
The Confidence Of An Object Elevation Status
Note: Elevation Status Confidence of moving object or stopped object shall always be 100%";
CM_ SG_ 993 FRM_22_ObjHeading_38 "Front Radar Moudle_X_Object Heading_00
前雷达目标物朝向_00
Heading of object 
Note: A rotation vector with anticlock-rotating as positive +π shall be used instead of -π when obect vertically backward
Note: Heading of static object shall always be 0";
CM_ SG_ 993 FRM_22_ObjID_39 "Front Radar Moudle_X_Object ID_01
前雷达目标物身份标识码_01
ID Is An Identifier Number That Allows For Tracking Of Persistent Objects Over Time
Note:A value of 0 indicates 'no object'";
CM_ SG_ 993 FRM_22_ObjClosestDistX_39 "Front Radar Moudle_X_Object Closest Distance X_01
前雷达目标物最近点在X轴上的距离_01
Closest Position Of Target Vehicle In X Direction
The rear axle center coordinate system is used";
CM_ SG_ 993 FRM_22_ObjClosestDistY_39 "Front Radar Moudle_X_Object Closest Distance Y_01
前雷达距目标物最近点在Y轴上的距离_01
Closest Position Of Target Vehicle In Y Direction
The rear axle center coordinate system is used";
CM_ SG_ 993 FRM_22_ObjRelVelX_39 "Front Radar Moudle_X_Object Relative Velocity X_01
前雷达目标物在X轴上的相对速度_01
Relative Target Object Velocity In X Direction";
CM_ SG_ 993 FRM_22_ObjRelVelY_39 "Front Radar Moudle_X_Object Relative Velocity Y_01
前雷达目标物在Y轴上的相对速度_01
Relative Target Object Velocity In Y Direction";
CM_ SG_ 993 FRM_22_ObjAccelX_39 "Front Radar Moudle_X_Object Acceleration X_01
前雷达目标物在X轴上的加速度_01
Relative Target Object Acceleration In X Direction";
CM_ SG_ 993 FRM_22_ObjAccelY_39 "Front Radar Moudle_X_Object Acceleration Y_01
前雷达目标物在Y轴上的加速度_01
Relative Target Object Acceleration In Y Direction";
CM_ SG_ 993 FRM_22_ObjClosestDistXStd_39 "Front Radar Moudle_X_Object Closest Distance X Standard_01
前雷达目标物最近点在X轴上的距离的标准差_01
Standard Deviation Of Closest Position Of Target Vehicle in X Direction";
CM_ SG_ 993 FRM_22_ObjClosestDistYStd_39 "Front Radar Moudle_X_Object Closest Distance Y Standard_01
前雷达目标物最近点在Y轴上的距离的标准差_01
Standard Deviation Of Closest Position Of Target Vehicle in Y Direction";
CM_ SG_ 993 FRM_22_ObjRelVelXStd_39 "Front Radar Moudle_X_Object Relative Velocity X Standard_01
前雷达目标物在X轴上的相对速度的标准差_01
Standard Deviation Of Relative Velocity X";
CM_ SG_ 993 FRM_22_ObjRelVelYStd_39 "Front Radar Moudle_X_Object Relative Velocity Y Standard_01
前雷达目标物在Y轴上的相对速度的标准差_01
Standard Deviation Of Relative Velocity Y";
CM_ SG_ 993 FRM_22_ObjRelAccelXStd_39 "Front Radar Moudle_X_Object Relative  Acceleration X Standard_01
前雷达目标物在X轴上的相对加速度的标准差_01
Standard Deviation Of Relative Acceleration X";
CM_ SG_ 993 FRM_22_ObjRelAccelYStd_39 "Front Radar Moudle_X_Object Relative  Acceleration Y Standard_01
前雷达目标物相对加速度在Y轴上的标准差_01
Standard Deviation Of Relative Acceleration Y";
CM_ SG_ 993 FRM_22_ObjExistProb_39 "Front Radar Moudle_X_Object Exist Probability_01
前雷达目标物存在的可能性_01
The Probability Of An Object To Exist In Reality";
CM_ SG_ 993 FRM_22_ObjType_39 "Front Radar Moudle_X_Object Type_01
前雷达目标物的分类_01
Class Of Object Type
Note: Type of static object shall always be 0x0: unknown";
CM_ SG_ 993 FRM_22_ObjTypeConf_39 "Front Radar Moudle_X_Object Type Confidence_01
前雷达目标物分类的置信度_01
The Class Confidence Of Object Type";
CM_ SG_ 993 FRM_22_ObjTrackSts_39 "Front Radar Moudle_X_Object Track Status_01
前雷达目标物的跟踪状态_01
Signal To Indicate The Object Track Status";
CM_ SG_ 993 FRM_22_ObjMotionSts_39 "Front Radar Moudle_X_Object Motion Status_01
前雷达目标物的运动状态_01
Signal To Indicate The Object Whether Moving or Stopped or Static";
CM_ SG_ 993 FRM_22_ObjMotionDirection_39 "Front Radar Moudle_X_Object Motion Direction_01
前雷达目标物的运动方向_01
Signal To Indicate The Object Moving Direction.
Note: Moving direction of static object or stopped object shall always be 0x0: Unknown";
CM_ SG_ 993 FRM_22_ObjCenterDistX_39 "Front Radar Moudle_X_Object Center Distance X_01
前雷达目标物中心点在X轴方向的距离_01
Center Position Of Target Vehicle In X Direction
The rear axle center coordinate system is used";
CM_ SG_ 993 FRM_22_ObjCenterDistY_39 "Front Radar Moudle_X_Object Center Distance Y_01
前雷达目标物中心点在Y轴方向的距离_01
Center Position Of Target Vehicle In Y Direction
The rear axle center coordinate system is used";
CM_ SG_ 993 FRM_22_ObjLength_39 "Front Radar Moudle_X_Object Length_01
前雷达目标物的长度_01
Length Of Target
Note: Length of static object shall always be 0";
CM_ SG_ 993 FRM_22_ObjWidth_39 "Front Radar Moudle_X_Object Width_01
前雷达目标物的宽度_01
Width Of Target
Note: Width of static object shall always be 0";
CM_ SG_ 993 FRM_22_ObjElevnSts_39 "Front Radar Moudle_X_Object Elevation Status_01
前雷达目标物的高度状态_01
The Elevation Status Of An Object
Note: Elevation Status of moving object or stopped object shall always be 0x2: Obstacle";
CM_ SG_ 993 FRM_22_ObjElevnStsConf_39 "Front Radar Moudle_X_Object Elevation Status Confidence_01
前雷达目标物的高度状态的置信度_01
The Confidence Of An Object Elevation Status
Note: Elevation Status Confidence of moving object or stopped object shall always be 100%";
CM_ SG_ 993 FRM_22_ObjHeading_39 "Front Radar Moudle_X_Object Heading_01
前雷达目标物朝向_01
Heading of object 
Note: A rotation vector with anticlock-rotating as positive +π shall be used instead of -π when obect vertically backward
Note: Heading of static object shall always be 0";
CM_ SG_ 994 FRM_23_CRC "Profile5:E2E CRC16 (polynomial:0x1021)       
DataID:Use CANID,other bits Fill with 0";
CM_ SG_ 994 FRM_23_RollgCntr "Profile5:E2E Rolling message counter";
CM_ SG_ 994 FRM_23_DetnBlockCounter "Front Radar Moudle_X_Detection Block Counter
前雷达探测点块计数";
CM_ SG_ 994 FRM_23_DetnMotionSts_000 "Detection point motion status
Front Radar Moudle_X_Detection Motion Status
前雷达探测点运动状态";
CM_ SG_ 994 FRM_23_DetnRngRadial_000 "Detection point radial distance
Front Radar Moudle_X_Detection Range Radial
前雷达探测点径向距离";
CM_ SG_ 994 FRM_23_DetnAziAngle_000 "Detection point azimuth angle
Front Radar Moudle_X_Detection Azimuth Angle
前雷达探测点水平方位角";
CM_ SG_ 994 FRM_23_DetnElevnAngle_000 "Detection point elevation angle
Front Radar Moudle_X_Detection Elevation Angle
前雷达探测点俯仰角";
CM_ SG_ 994 FRM_23_DetnRelVelRadial_000 "Detection point radial relative velocity
Front Radar Moudle_X_Detection Relative Velocity Radial 
前雷达探测点在径向上的相对速度";
CM_ SG_ 994 FRM_23_DetnSNR_000 "Detection point signal noise ratio
Front Radar Moudle_X_Detection Signal Noise Ratio
前雷达探测点信号噪声比";
CM_ SG_ 994 FRM_23_DetnRCS_000 "Detection point radar cross section
Front Radar Moudle_X_Detection Radar Cross Section
前雷达探测点雷达散射截面积";
CM_ SG_ 994 FRM_23_DetnQuality_000 "Detection point quality
Front Radar Moudle_X_Detection Quality
前雷达探测点质量";
CM_ SG_ 994 FRM_23_DetnMotionSts_001 "Detection point motion status
Front Radar Moudle_X_Detection Motion Status
前雷达探测点运动状态";
CM_ SG_ 994 FRM_23_DetnRngRadial_001 "Detection point radial distance
Front Radar Moudle_X_Detection Range Radial
前雷达探测点径向距离";
CM_ SG_ 994 FRM_23_DetnAziAngle_001 "Detection point azimuth angle
Front Radar Moudle_X_Detection Azimuth Angle
前雷达探测点水平方位角";
CM_ SG_ 994 FRM_23_DetnElevnAngle_001 "Detection point elevation angle
Front Radar Moudle_X_Detection Elevation Angle
前雷达探测点俯仰角";
CM_ SG_ 994 FRM_23_DetnRelVelRadial_001 "Detection point radial relative velocity
Front Radar Moudle_X_Detection Relative Velocity Radial 
前雷达探测点在径向上的相对速度";
CM_ SG_ 994 FRM_23_DetnSNR_001 "Detection point signal noise ratio
Front Radar Moudle_X_Detection Signal Noise Ratio
前雷达探测点信号噪声比";
CM_ SG_ 994 FRM_23_DetnRCS_001 "Detection point radar cross section
Front Radar Moudle_X_Detection Radar Cross Section
前雷达探测点雷达散射截面积";
CM_ SG_ 994 FRM_23_DetnQuality_001 "Detection point quality
Front Radar Moudle_X_Detection Quality
前雷达探测点质量";
CM_ SG_ 994 FRM_23_DetnMotionSts_002 "Detection point motion status
Front Radar Moudle_X_Detection Motion Status
前雷达探测点运动状态";
CM_ SG_ 994 FRM_23_DetnRngRadial_002 "Detection point radial distance
Front Radar Moudle_X_Detection Range Radial
前雷达探测点径向距离";
CM_ SG_ 994 FRM_23_DetnAziAngle_002 "Detection point azimuth angle
Front Radar Moudle_X_Detection Azimuth Angle
前雷达探测点水平方位角";
CM_ SG_ 994 FRM_23_DetnElevnAngle_002 "Detection point elevation angle
Front Radar Moudle_X_Detection Elevation Angle
前雷达探测点俯仰角";
CM_ SG_ 994 FRM_23_DetnRelVelRadial_002 "Detection point radial relative velocity
Front Radar Moudle_X_Detection Relative Velocity Radial 
前雷达探测点在径向上的相对速度";
CM_ SG_ 994 FRM_23_DetnSNR_002 "Detection point signal noise ratio
Front Radar Moudle_X_Detection Signal Noise Ratio
前雷达探测点信号噪声比";
CM_ SG_ 994 FRM_23_DetnRCS_002 "Detection point radar cross section
Front Radar Moudle_X_Detection Radar Cross Section
前雷达探测点雷达散射截面积";
CM_ SG_ 994 FRM_23_DetnQuality_002 "Detection point quality
Front Radar Moudle_X_Detection Quality
前雷达探测点质量";
CM_ SG_ 994 FRM_23_DetnMotionSts_003 "Detection point motion status
Front Radar Moudle_X_Detection Motion Status
前雷达探测点运动状态";
CM_ SG_ 994 FRM_23_DetnRngRadial_003 "Detection point radial distance
Front Radar Moudle_X_Detection Range Radial
前雷达探测点径向距离";
CM_ SG_ 994 FRM_23_DetnAziAngle_003 "Detection point azimuth angle
Front Radar Moudle_X_Detection Azimuth Angle
前雷达探测点水平方位角";
CM_ SG_ 994 FRM_23_DetnElevnAngle_003 "Detection point elevation angle
Front Radar Moudle_X_Detection Elevation Angle
前雷达探测点俯仰角";
CM_ SG_ 994 FRM_23_DetnRelVelRadial_003 "Detection point radial relative velocity
Front Radar Moudle_X_Detection Relative Velocity Radial 
前雷达探测点在径向上的相对速度";
CM_ SG_ 994 FRM_23_DetnSNR_003 "Detection point signal noise ratio
Front Radar Moudle_X_Detection Signal Noise Ratio
前雷达探测点信号噪声比";
CM_ SG_ 994 FRM_23_DetnRCS_003 "Detection point radar cross section
Front Radar Moudle_X_Detection Radar Cross Section
前雷达探测点雷达散射截面积";
CM_ SG_ 994 FRM_23_DetnQuality_003 "Detection point quality
Front Radar Moudle_X_Detection Quality
前雷达探测点质量";
CM_ SG_ 994 FRM_23_DetnMotionSts_004 "Detection point motion status
Front Radar Moudle_X_Detection Motion Status
前雷达探测点运动状态";
CM_ SG_ 994 FRM_23_DetnRngRadial_004 "Detection point radial distance
Front Radar Moudle_X_Detection Range Radial
前雷达探测点径向距离";
CM_ SG_ 994 FRM_23_DetnAziAngle_004 "Detection point azimuth angle
Front Radar Moudle_X_Detection Azimuth Angle
前雷达探测点水平方位角";
CM_ SG_ 994 FRM_23_DetnElevnAngle_004 "Detection point elevation angle
Front Radar Moudle_X_Detection Elevation Angle
前雷达探测点俯仰角";
CM_ SG_ 994 FRM_23_DetnRelVelRadial_004 "Detection point radial relative velocity
Front Radar Moudle_X_Detection Relative Velocity Radial 
前雷达探测点在径向上的相对速度";
CM_ SG_ 994 FRM_23_DetnSNR_004 "Detection point signal noise ratio
Front Radar Moudle_X_Detection Signal Noise Ratio
前雷达探测点信号噪声比";
CM_ SG_ 994 FRM_23_DetnRCS_004 "Detection point radar cross section
Front Radar Moudle_X_Detection Radar Cross Section
前雷达探测点雷达散射截面积";
CM_ SG_ 994 FRM_23_DetnQuality_004 "Detection point quality
Front Radar Moudle_X_Detection Quality
前雷达探测点质量";
CM_ SG_ 994 FRM_23_DetnMotionSts_005 "Detection point motion status
Front Radar Moudle_X_Detection Motion Status
前雷达探测点运动状态";
CM_ SG_ 994 FRM_23_DetnRngRadial_005 "Detection point radial distance
Front Radar Moudle_X_Detection Range Radial
前雷达探测点径向距离";
CM_ SG_ 994 FRM_23_DetnAziAngle_005 "Detection point azimuth angle
Front Radar Moudle_X_Detection Azimuth Angle
前雷达探测点水平方位角";
CM_ SG_ 994 FRM_23_DetnElevnAngle_005 "Detection point elevation angle
Front Radar Moudle_X_Detection Elevation Angle
前雷达探测点俯仰角";
CM_ SG_ 994 FRM_23_DetnRelVelRadial_005 "Detection point radial relative velocity
Front Radar Moudle_X_Detection Relative Velocity Radial 
前雷达探测点在径向上的相对速度";
CM_ SG_ 994 FRM_23_DetnSNR_005 "Detection point signal noise ratio
Front Radar Moudle_X_Detection Signal Noise Ratio
前雷达探测点信号噪声比";
CM_ SG_ 994 FRM_23_DetnRCS_005 "Detection point radar cross section
Front Radar Moudle_X_Detection Radar Cross Section
前雷达探测点雷达散射截面积";
CM_ SG_ 994 FRM_23_DetnQuality_005 "Detection point quality
Front Radar Moudle_X_Detection Quality
前雷达探测点质量";
CM_ SG_ 995 FRM_24_CRC "Profile5:E2E CRC16 (polynomial:0x1021)       
DataID:Use CANID,other bits Fill with 0";
CM_ SG_ 995 FRM_24_RollgCntr "Profile5:E2E Rolling message counter";
CM_ SG_ 995 FRM_24_DetnBlockCounter "Front Radar Moudle_X_Detection Block Counter
前雷达探测点块计数";
CM_ SG_ 995 FRM_24_DetnMotionSts_006 "Detection point motion status
Front Radar Moudle_X_Detection Motion Status
前雷达探测点运动状态";
CM_ SG_ 995 FRM_24_DetnRngRadial_006 "Detection point radial distance
Front Radar Moudle_X_Detection Range Radial
前雷达探测点径向距离";
CM_ SG_ 995 FRM_24_DetnAziAngle_006 "Detection point azimuth angle
Front Radar Moudle_X_Detection Azimuth Angle
前雷达探测点水平方位角";
CM_ SG_ 995 FRM_24_DetnElevnAngle_006 "Detection point elevation angle
Front Radar Moudle_X_Detection Elevation Angle
前雷达探测点俯仰角";
CM_ SG_ 995 FRM_24_DetnRelVelRadial_006 "Detection point radial relative velocity
Front Radar Moudle_X_Detection Relative Velocity Radial 
前雷达探测点在径向上的相对速度";
CM_ SG_ 995 FRM_24_DetnSNR_006 "Detection point signal noise ratio
Front Radar Moudle_X_Detection Signal Noise Ratio
前雷达探测点信号噪声比";
CM_ SG_ 995 FRM_24_DetnRCS_006 "Detection point radar cross section
Front Radar Moudle_X_Detection Radar Cross Section
前雷达探测点雷达散射截面积";
CM_ SG_ 995 FRM_24_DetnQuality_006 "Detection point quality
Front Radar Moudle_X_Detection Quality
前雷达探测点质量";
CM_ SG_ 995 FRM_24_DetnMotionSts_007 "Detection point motion status
Front Radar Moudle_X_Detection Motion Status
前雷达探测点运动状态";
CM_ SG_ 995 FRM_24_DetnRngRadial_007 "Detection point radial distance
Front Radar Moudle_X_Detection Range Radial
前雷达探测点径向距离";
CM_ SG_ 995 FRM_24_DetnAziAngle_007 "Detection point azimuth angle
Front Radar Moudle_X_Detection Azimuth Angle
前雷达探测点水平方位角";
CM_ SG_ 995 FRM_24_DetnElevnAngle_007 "Detection point elevation angle
Front Radar Moudle_X_Detection Elevation Angle
前雷达探测点俯仰角";
CM_ SG_ 995 FRM_24_DetnRelVelRadial_007 "Detection point radial relative velocity
Front Radar Moudle_X_Detection Relative Velocity Radial 
前雷达探测点在径向上的相对速度";
CM_ SG_ 995 FRM_24_DetnSNR_007 "Detection point signal noise ratio
Front Radar Moudle_X_Detection Signal Noise Ratio
前雷达探测点信号噪声比";
CM_ SG_ 995 FRM_24_DetnRCS_007 "Detection point radar cross section
Front Radar Moudle_X_Detection Radar Cross Section
前雷达探测点雷达散射截面积";
CM_ SG_ 995 FRM_24_DetnQuality_007 "Detection point quality
Front Radar Moudle_X_Detection Quality
前雷达探测点质量";
CM_ SG_ 995 FRM_24_DetnMotionSts_008 "Detection point motion status
Front Radar Moudle_X_Detection Motion Status
前雷达探测点运动状态";
CM_ SG_ 995 FRM_24_DetnRngRadial_008 "Detection point radial distance
Front Radar Moudle_X_Detection Range Radial
前雷达探测点径向距离";
CM_ SG_ 995 FRM_24_DetnAziAngle_008 "Detection point azimuth angle
Front Radar Moudle_X_Detection Azimuth Angle
前雷达探测点水平方位角";
CM_ SG_ 995 FRM_24_DetnElevnAngle_008 "Detection point elevation angle
Front Radar Moudle_X_Detection Elevation Angle
前雷达探测点俯仰角";
CM_ SG_ 995 FRM_24_DetnRelVelRadial_008 "Detection point radial relative velocity
Front Radar Moudle_X_Detection Relative Velocity Radial 
前雷达探测点在径向上的相对速度";
CM_ SG_ 995 FRM_24_DetnSNR_008 "Detection point signal noise ratio
Front Radar Moudle_X_Detection Signal Noise Ratio
前雷达探测点信号噪声比";
CM_ SG_ 995 FRM_24_DetnRCS_008 "Detection point radar cross section
Front Radar Moudle_X_Detection Radar Cross Section
前雷达探测点雷达散射截面积";
CM_ SG_ 995 FRM_24_DetnQuality_008 "Detection point quality
Front Radar Moudle_X_Detection Quality
前雷达探测点质量";
CM_ SG_ 995 FRM_24_DetnMotionSts_009 "Detection point motion status
Front Radar Moudle_X_Detection Motion Status
前雷达探测点运动状态";
CM_ SG_ 995 FRM_24_DetnRngRadial_009 "Detection point radial distance
Front Radar Moudle_X_Detection Range Radial
前雷达探测点径向距离";
CM_ SG_ 995 FRM_24_DetnAziAngle_009 "Detection point azimuth angle
Front Radar Moudle_X_Detection Azimuth Angle
前雷达探测点水平方位角";
CM_ SG_ 995 FRM_24_DetnElevnAngle_009 "Detection point elevation angle
Front Radar Moudle_X_Detection Elevation Angle
前雷达探测点俯仰角";
CM_ SG_ 995 FRM_24_DetnRelVelRadial_009 "Detection point radial relative velocity
Front Radar Moudle_X_Detection Relative Velocity Radial 
前雷达探测点在径向上的相对速度";
CM_ SG_ 995 FRM_24_DetnSNR_009 "Detection point signal noise ratio
Front Radar Moudle_X_Detection Signal Noise Ratio
前雷达探测点信号噪声比";
CM_ SG_ 995 FRM_24_DetnRCS_009 "Detection point radar cross section
Front Radar Moudle_X_Detection Radar Cross Section
前雷达探测点雷达散射截面积";
CM_ SG_ 995 FRM_24_DetnQuality_009 "Detection point quality
Front Radar Moudle_X_Detection Quality
前雷达探测点质量";
CM_ SG_ 995 FRM_24_DetnMotionSts_010 "Detection point motion status
Front Radar Moudle_X_Detection Motion Status
前雷达探测点运动状态";
CM_ SG_ 995 FRM_24_DetnRngRadial_010 "Detection point radial distance
Front Radar Moudle_X_Detection Range Radial
前雷达探测点径向距离";
CM_ SG_ 995 FRM_24_DetnAziAngle_010 "Detection point azimuth angle
Front Radar Moudle_X_Detection Azimuth Angle
前雷达探测点水平方位角";
CM_ SG_ 995 FRM_24_DetnElevnAngle_010 "Detection point elevation angle
Front Radar Moudle_X_Detection Elevation Angle
前雷达探测点俯仰角";
CM_ SG_ 995 FRM_24_DetnRelVelRadial_010 "Detection point radial relative velocity
Front Radar Moudle_X_Detection Relative Velocity Radial 
前雷达探测点在径向上的相对速度";
CM_ SG_ 995 FRM_24_DetnSNR_010 "Detection point signal noise ratio
Front Radar Moudle_X_Detection Signal Noise Ratio
前雷达探测点信号噪声比";
CM_ SG_ 995 FRM_24_DetnRCS_010 "Detection point radar cross section
Front Radar Moudle_X_Detection Radar Cross Section
前雷达探测点雷达散射截面积";
CM_ SG_ 995 FRM_24_DetnQuality_010 "Detection point quality
Front Radar Moudle_X_Detection Quality
前雷达探测点质量";
CM_ SG_ 995 FRM_24_DetnMotionSts_011 "Detection point motion status
Front Radar Moudle_X_Detection Motion Status
前雷达探测点运动状态";
CM_ SG_ 995 FRM_24_DetnRngRadial_011 "Detection point radial distance
Front Radar Moudle_X_Detection Range Radial
前雷达探测点径向距离";
CM_ SG_ 995 FRM_24_DetnAziAngle_011 "Detection point azimuth angle
Front Radar Moudle_X_Detection Azimuth Angle
前雷达探测点水平方位角";
CM_ SG_ 995 FRM_24_DetnElevnAngle_011 "Detection point elevation angle
Front Radar Moudle_X_Detection Elevation Angle
前雷达探测点俯仰角";
CM_ SG_ 995 FRM_24_DetnRelVelRadial_011 "Detection point radial relative velocity
Front Radar Moudle_X_Detection Relative Velocity Radial 
前雷达探测点在径向上的相对速度";
CM_ SG_ 995 FRM_24_DetnSNR_011 "Detection point signal noise ratio
Front Radar Moudle_X_Detection Signal Noise Ratio
前雷达探测点信号噪声比";
CM_ SG_ 995 FRM_24_DetnRCS_011 "Detection point radar cross section
Front Radar Moudle_X_Detection Radar Cross Section
前雷达探测点雷达散射截面积";
CM_ SG_ 995 FRM_24_DetnQuality_011 "Detection point quality
Front Radar Moudle_X_Detection Quality
前雷达探测点质量";
CM_ SG_ 996 FRM_25_CRC "Profile5:E2E CRC16 (polynomial:0x1021)       
DataID:Use CANID,other bits Fill with 0";
CM_ SG_ 996 FRM_25_RollgCntr "Profile5:E2E Rolling message counter";
CM_ SG_ 996 FRM_25_DetnBlockCounter "Front Radar Moudle_X_Detection Block Counter
前雷达探测点块计数";
CM_ SG_ 996 FRM_25_DetnMotionSts_012 "Detection point motion status
Front Radar Moudle_X_Detection Motion Status
前雷达探测点运动状态";
CM_ SG_ 996 FRM_25_DetnRngRadial_012 "Detection point radial distance
Front Radar Moudle_X_Detection Range Radial
前雷达探测点径向距离";
CM_ SG_ 996 FRM_25_DetnAziAngle_012 "Detection point azimuth angle
Front Radar Moudle_X_Detection Azimuth Angle
前雷达探测点水平方位角";
CM_ SG_ 996 FRM_25_DetnElevnAngle_012 "Detection point elevation angle
Front Radar Moudle_X_Detection Elevation Angle
前雷达探测点俯仰角";
CM_ SG_ 996 FRM_25_DetnRelVelRadial_012 "Detection point radial relative velocity
Front Radar Moudle_X_Detection Relative Velocity Radial 
前雷达探测点在径向上的相对速度";
CM_ SG_ 996 FRM_25_DetnSNR_012 "Detection point signal noise ratio
Front Radar Moudle_X_Detection Signal Noise Ratio
前雷达探测点信号噪声比";
CM_ SG_ 996 FRM_25_DetnRCS_012 "Detection point radar cross section
Front Radar Moudle_X_Detection Radar Cross Section
前雷达探测点雷达散射截面积";
CM_ SG_ 996 FRM_25_DetnQuality_012 "Detection point quality
Front Radar Moudle_X_Detection Quality
前雷达探测点质量";
CM_ SG_ 996 FRM_25_DetnMotionSts_013 "Detection point motion status
Front Radar Moudle_X_Detection Motion Status
前雷达探测点运动状态";
CM_ SG_ 996 FRM_25_DetnRngRadial_013 "Detection point radial distance
Front Radar Moudle_X_Detection Range Radial
前雷达探测点径向距离";
CM_ SG_ 996 FRM_25_DetnAziAngle_013 "Detection point azimuth angle
Front Radar Moudle_X_Detection Azimuth Angle
前雷达探测点水平方位角";
CM_ SG_ 996 FRM_25_DetnElevnAngle_013 "Detection point elevation angle
Front Radar Moudle_X_Detection Elevation Angle
前雷达探测点俯仰角";
CM_ SG_ 996 FRM_25_DetnRelVelRadial_013 "Detection point radial relative velocity
Front Radar Moudle_X_Detection Relative Velocity Radial 
前雷达探测点在径向上的相对速度";
CM_ SG_ 996 FRM_25_DetnSNR_013 "Detection point signal noise ratio
Front Radar Moudle_X_Detection Signal Noise Ratio
前雷达探测点信号噪声比";
CM_ SG_ 996 FRM_25_DetnRCS_013 "Detection point radar cross section
Front Radar Moudle_X_Detection Radar Cross Section
前雷达探测点雷达散射截面积";
CM_ SG_ 996 FRM_25_DetnQuality_013 "Detection point quality
Front Radar Moudle_X_Detection Quality
前雷达探测点质量";
CM_ SG_ 996 FRM_25_DetnMotionSts_014 "Detection point motion status
Front Radar Moudle_X_Detection Motion Status
前雷达探测点运动状态";
CM_ SG_ 996 FRM_25_DetnRngRadial_014 "Detection point radial distance
Front Radar Moudle_X_Detection Range Radial
前雷达探测点径向距离";
CM_ SG_ 996 FRM_25_DetnAziAngle_014 "Detection point azimuth angle
Front Radar Moudle_X_Detection Azimuth Angle
前雷达探测点水平方位角";
CM_ SG_ 996 FRM_25_DetnElevnAngle_014 "Detection point elevation angle
Front Radar Moudle_X_Detection Elevation Angle
前雷达探测点俯仰角";
CM_ SG_ 996 FRM_25_DetnRelVelRadial_014 "Detection point radial relative velocity
Front Radar Moudle_X_Detection Relative Velocity Radial 
前雷达探测点在径向上的相对速度";
CM_ SG_ 996 FRM_25_DetnSNR_014 "Detection point signal noise ratio
Front Radar Moudle_X_Detection Signal Noise Ratio
前雷达探测点信号噪声比";
CM_ SG_ 996 FRM_25_DetnRCS_014 "Detection point radar cross section
Front Radar Moudle_X_Detection Radar Cross Section
前雷达探测点雷达散射截面积";
CM_ SG_ 996 FRM_25_DetnQuality_014 "Detection point quality
Front Radar Moudle_X_Detection Quality
前雷达探测点质量";
CM_ SG_ 996 FRM_25_DetnMotionSts_015 "Detection point motion status
Front Radar Moudle_X_Detection Motion Status
前雷达探测点运动状态";
CM_ SG_ 996 FRM_25_DetnRngRadial_015 "Detection point radial distance
Front Radar Moudle_X_Detection Range Radial
前雷达探测点径向距离";
CM_ SG_ 996 FRM_25_DetnAziAngle_015 "Detection point azimuth angle
Front Radar Moudle_X_Detection Azimuth Angle
前雷达探测点水平方位角";
CM_ SG_ 996 FRM_25_DetnElevnAngle_015 "Detection point elevation angle
Front Radar Moudle_X_Detection Elevation Angle
前雷达探测点俯仰角";
CM_ SG_ 996 FRM_25_DetnRelVelRadial_015 "Detection point radial relative velocity
Front Radar Moudle_X_Detection Relative Velocity Radial 
前雷达探测点在径向上的相对速度";
CM_ SG_ 996 FRM_25_DetnSNR_015 "Detection point signal noise ratio
Front Radar Moudle_X_Detection Signal Noise Ratio
前雷达探测点信号噪声比";
CM_ SG_ 996 FRM_25_DetnRCS_015 "Detection point radar cross section
Front Radar Moudle_X_Detection Radar Cross Section
前雷达探测点雷达散射截面积";
CM_ SG_ 996 FRM_25_DetnQuality_015 "Detection point quality
Front Radar Moudle_X_Detection Quality
前雷达探测点质量";
CM_ SG_ 996 FRM_25_DetnMotionSts_016 "Detection point motion status
Front Radar Moudle_X_Detection Motion Status
前雷达探测点运动状态";
CM_ SG_ 996 FRM_25_DetnRngRadial_016 "Detection point radial distance
Front Radar Moudle_X_Detection Range Radial
前雷达探测点径向距离";
CM_ SG_ 996 FRM_25_DetnAziAngle_016 "Detection point azimuth angle
Front Radar Moudle_X_Detection Azimuth Angle
前雷达探测点水平方位角";
CM_ SG_ 996 FRM_25_DetnElevnAngle_016 "Detection point elevation angle
Front Radar Moudle_X_Detection Elevation Angle
前雷达探测点俯仰角";
CM_ SG_ 996 FRM_25_DetnRelVelRadial_016 "Detection point radial relative velocity
Front Radar Moudle_X_Detection Relative Velocity Radial 
前雷达探测点在径向上的相对速度";
CM_ SG_ 996 FRM_25_DetnSNR_016 "Detection point signal noise ratio
Front Radar Moudle_X_Detection Signal Noise Ratio
前雷达探测点信号噪声比";
CM_ SG_ 996 FRM_25_DetnRCS_016 "Detection point radar cross section
Front Radar Moudle_X_Detection Radar Cross Section
前雷达探测点雷达散射截面积";
CM_ SG_ 996 FRM_25_DetnQuality_016 "Detection point quality
Front Radar Moudle_X_Detection Quality
前雷达探测点质量";
CM_ SG_ 996 FRM_25_DetnMotionSts_017 "Detection point motion status
Front Radar Moudle_X_Detection Motion Status
前雷达探测点运动状态";
CM_ SG_ 996 FRM_25_DetnRngRadial_017 "Detection point radial distance
Front Radar Moudle_X_Detection Range Radial
前雷达探测点径向距离";
CM_ SG_ 996 FRM_25_DetnAziAngle_017 "Detection point azimuth angle
Front Radar Moudle_X_Detection Azimuth Angle
前雷达探测点水平方位角";
CM_ SG_ 996 FRM_25_DetnElevnAngle_017 "Detection point elevation angle
Front Radar Moudle_X_Detection Elevation Angle
前雷达探测点俯仰角";
CM_ SG_ 996 FRM_25_DetnRelVelRadial_017 "Detection point radial relative velocity
Front Radar Moudle_X_Detection Relative Velocity Radial 
前雷达探测点在径向上的相对速度";
CM_ SG_ 996 FRM_25_DetnSNR_017 "Detection point signal noise ratio
Front Radar Moudle_X_Detection Signal Noise Ratio
前雷达探测点信号噪声比";
CM_ SG_ 996 FRM_25_DetnRCS_017 "Detection point radar cross section
Front Radar Moudle_X_Detection Radar Cross Section
前雷达探测点雷达散射截面积";
CM_ SG_ 996 FRM_25_DetnQuality_017 "Detection point quality
Front Radar Moudle_X_Detection Quality
前雷达探测点质量";
CM_ SG_ 997 FRM_26_CRC "Profile5:E2E CRC16 (polynomial:0x1021)       
DataID:Use CANID,other bits Fill with 0";
CM_ SG_ 997 FRM_26_RollgCntr "Profile5:E2E Rolling message counter";
CM_ SG_ 997 FRM_26_DetnBlockCounter "Front Radar Moudle_X_Detection Block Counter
前雷达探测点块计数";
CM_ SG_ 997 FRM_26_DetnMotionSts_018 "Detection point motion status
Front Radar Moudle_X_Detection Motion Status
前雷达探测点运动状态";
CM_ SG_ 997 FRM_26_DetnRngRadial_018 "Detection point radial distance
Front Radar Moudle_X_Detection Range Radial
前雷达探测点径向距离";
CM_ SG_ 997 FRM_26_DetnAziAngle_018 "Detection point azimuth angle
Front Radar Moudle_X_Detection Azimuth Angle
前雷达探测点水平方位角";
CM_ SG_ 997 FRM_26_DetnElevnAngle_018 "Detection point elevation angle
Front Radar Moudle_X_Detection Elevation Angle
前雷达探测点俯仰角";
CM_ SG_ 997 FRM_26_DetnRelVelRadial_018 "Detection point radial relative velocity
Front Radar Moudle_X_Detection Relative Velocity Radial 
前雷达探测点在径向上的相对速度";
CM_ SG_ 997 FRM_26_DetnSNR_018 "Detection point signal noise ratio
Front Radar Moudle_X_Detection Signal Noise Ratio
前雷达探测点信号噪声比";
CM_ SG_ 997 FRM_26_DetnRCS_018 "Detection point radar cross section
Front Radar Moudle_X_Detection Radar Cross Section
前雷达探测点雷达散射截面积";
CM_ SG_ 997 FRM_26_DetnQuality_018 "Detection point quality
Front Radar Moudle_X_Detection Quality
前雷达探测点质量";
CM_ SG_ 997 FRM_26_DetnMotionSts_019 "Detection point motion status
Front Radar Moudle_X_Detection Motion Status
前雷达探测点运动状态";
CM_ SG_ 997 FRM_26_DetnRngRadial_019 "Detection point radial distance
Front Radar Moudle_X_Detection Range Radial
前雷达探测点径向距离";
CM_ SG_ 997 FRM_26_DetnAziAngle_019 "Detection point azimuth angle
Front Radar Moudle_X_Detection Azimuth Angle
前雷达探测点水平方位角";
CM_ SG_ 997 FRM_26_DetnElevnAngle_019 "Detection point elevation angle
Front Radar Moudle_X_Detection Elevation Angle
前雷达探测点俯仰角";
CM_ SG_ 997 FRM_26_DetnRelVelRadial_019 "Detection point radial relative velocity
Front Radar Moudle_X_Detection Relative Velocity Radial 
前雷达探测点在径向上的相对速度";
CM_ SG_ 997 FRM_26_DetnSNR_019 "Detection point signal noise ratio
Front Radar Moudle_X_Detection Signal Noise Ratio
前雷达探测点信号噪声比";
CM_ SG_ 997 FRM_26_DetnRCS_019 "Detection point radar cross section
Front Radar Moudle_X_Detection Radar Cross Section
前雷达探测点雷达散射截面积";
CM_ SG_ 997 FRM_26_DetnQuality_019 "Detection point quality
Front Radar Moudle_X_Detection Quality
前雷达探测点质量";
CM_ SG_ 997 FRM_26_DetnMotionSts_020 "Detection point motion status
Front Radar Moudle_X_Detection Motion Status
前雷达探测点运动状态";
CM_ SG_ 997 FRM_26_DetnRngRadial_020 "Detection point radial distance
Front Radar Moudle_X_Detection Range Radial
前雷达探测点径向距离";
CM_ SG_ 997 FRM_26_DetnAziAngle_020 "Detection point azimuth angle
Front Radar Moudle_X_Detection Azimuth Angle
前雷达探测点水平方位角";
CM_ SG_ 997 FRM_26_DetnElevnAngle_020 "Detection point elevation angle
Front Radar Moudle_X_Detection Elevation Angle
前雷达探测点俯仰角";
CM_ SG_ 997 FRM_26_DetnRelVelRadial_020 "Detection point radial relative velocity
Front Radar Moudle_X_Detection Relative Velocity Radial 
前雷达探测点在径向上的相对速度";
CM_ SG_ 997 FRM_26_DetnSNR_020 "Detection point signal noise ratio
Front Radar Moudle_X_Detection Signal Noise Ratio
前雷达探测点信号噪声比";
CM_ SG_ 997 FRM_26_DetnRCS_020 "Detection point radar cross section
Front Radar Moudle_X_Detection Radar Cross Section
前雷达探测点雷达散射截面积";
CM_ SG_ 997 FRM_26_DetnQuality_020 "Detection point quality
Front Radar Moudle_X_Detection Quality
前雷达探测点质量";
CM_ SG_ 997 FRM_26_DetnMotionSts_021 "Detection point motion status
Front Radar Moudle_X_Detection Motion Status
前雷达探测点运动状态";
CM_ SG_ 997 FRM_26_DetnRngRadial_021 "Detection point radial distance
Front Radar Moudle_X_Detection Range Radial
前雷达探测点径向距离";
CM_ SG_ 997 FRM_26_DetnAziAngle_021 "Detection point azimuth angle
Front Radar Moudle_X_Detection Azimuth Angle
前雷达探测点水平方位角";
CM_ SG_ 997 FRM_26_DetnElevnAngle_021 "Detection point elevation angle
Front Radar Moudle_X_Detection Elevation Angle
前雷达探测点俯仰角";
CM_ SG_ 997 FRM_26_DetnRelVelRadial_021 "Detection point radial relative velocity
Front Radar Moudle_X_Detection Relative Velocity Radial 
前雷达探测点在径向上的相对速度";
CM_ SG_ 997 FRM_26_DetnSNR_021 "Detection point signal noise ratio
Front Radar Moudle_X_Detection Signal Noise Ratio
前雷达探测点信号噪声比";
CM_ SG_ 997 FRM_26_DetnRCS_021 "Detection point radar cross section
Front Radar Moudle_X_Detection Radar Cross Section
前雷达探测点雷达散射截面积";
CM_ SG_ 997 FRM_26_DetnQuality_021 "Detection point quality
Front Radar Moudle_X_Detection Quality
前雷达探测点质量";
CM_ SG_ 997 FRM_26_DetnMotionSts_022 "Detection point motion status
Front Radar Moudle_X_Detection Motion Status
前雷达探测点运动状态";
CM_ SG_ 997 FRM_26_DetnRngRadial_022 "Detection point radial distance
Front Radar Moudle_X_Detection Range Radial
前雷达探测点径向距离";
CM_ SG_ 997 FRM_26_DetnAziAngle_022 "Detection point azimuth angle
Front Radar Moudle_X_Detection Azimuth Angle
前雷达探测点水平方位角";
CM_ SG_ 997 FRM_26_DetnElevnAngle_022 "Detection point elevation angle
Front Radar Moudle_X_Detection Elevation Angle
前雷达探测点俯仰角";
CM_ SG_ 997 FRM_26_DetnRelVelRadial_022 "Detection point radial relative velocity
Front Radar Moudle_X_Detection Relative Velocity Radial 
前雷达探测点在径向上的相对速度";
CM_ SG_ 997 FRM_26_DetnSNR_022 "Detection point signal noise ratio
Front Radar Moudle_X_Detection Signal Noise Ratio
前雷达探测点信号噪声比";
CM_ SG_ 997 FRM_26_DetnRCS_022 "Detection point radar cross section
Front Radar Moudle_X_Detection Radar Cross Section
前雷达探测点雷达散射截面积";
CM_ SG_ 997 FRM_26_DetnQuality_022 "Detection point quality
Front Radar Moudle_X_Detection Quality
前雷达探测点质量";
CM_ SG_ 997 FRM_26_DetnMotionSts_023 "Detection point motion status
Front Radar Moudle_X_Detection Motion Status
前雷达探测点运动状态";
CM_ SG_ 997 FRM_26_DetnRngRadial_023 "Detection point radial distance
Front Radar Moudle_X_Detection Range Radial
前雷达探测点径向距离";
CM_ SG_ 997 FRM_26_DetnAziAngle_023 "Detection point azimuth angle
Front Radar Moudle_X_Detection Azimuth Angle
前雷达探测点水平方位角";
CM_ SG_ 997 FRM_26_DetnElevnAngle_023 "Detection point elevation angle
Front Radar Moudle_X_Detection Elevation Angle
前雷达探测点俯仰角";
CM_ SG_ 997 FRM_26_DetnRelVelRadial_023 "Detection point radial relative velocity
Front Radar Moudle_X_Detection Relative Velocity Radial 
前雷达探测点在径向上的相对速度";
CM_ SG_ 997 FRM_26_DetnSNR_023 "Detection point signal noise ratio
Front Radar Moudle_X_Detection Signal Noise Ratio
前雷达探测点信号噪声比";
CM_ SG_ 997 FRM_26_DetnRCS_023 "Detection point radar cross section
Front Radar Moudle_X_Detection Radar Cross Section
前雷达探测点雷达散射截面积";
CM_ SG_ 997 FRM_26_DetnQuality_023 "Detection point quality
Front Radar Moudle_X_Detection Quality
前雷达探测点质量";
CM_ SG_ 998 FRM_27_CRC "Profile5:E2E CRC16 (polynomial:0x1021)       
DataID:Use CANID,other bits Fill with 0";
CM_ SG_ 998 FRM_27_RollgCntr "Profile5:E2E Rolling message counter";
CM_ SG_ 998 FRM_27_DetnBlockCounter "Front Radar Moudle_X_Detection Block Counter
前雷达探测点块计数";
CM_ SG_ 998 FRM_27_DetnMotionSts_024 "Detection point motion status
Front Radar Moudle_X_Detection Motion Status
前雷达探测点运动状态";
CM_ SG_ 998 FRM_27_DetnRngRadial_024 "Detection point radial distance
Front Radar Moudle_X_Detection Range Radial
前雷达探测点径向距离";
CM_ SG_ 998 FRM_27_DetnAziAngle_024 "Detection point azimuth angle
Front Radar Moudle_X_Detection Azimuth Angle
前雷达探测点水平方位角";
CM_ SG_ 998 FRM_27_DetnElevnAngle_024 "Detection point elevation angle
Front Radar Moudle_X_Detection Elevation Angle
前雷达探测点俯仰角";
CM_ SG_ 998 FRM_27_DetnRelVelRadial_024 "Detection point radial relative velocity
Front Radar Moudle_X_Detection Relative Velocity Radial 
前雷达探测点在径向上的相对速度";
CM_ SG_ 998 FRM_27_DetnSNR_024 "Detection point signal noise ratio
Front Radar Moudle_X_Detection Signal Noise Ratio
前雷达探测点信号噪声比";
CM_ SG_ 998 FRM_27_DetnRCS_024 "Detection point radar cross section
Front Radar Moudle_X_Detection Radar Cross Section
前雷达探测点雷达散射截面积";
CM_ SG_ 998 FRM_27_DetnQuality_024 "Detection point quality
Front Radar Moudle_X_Detection Quality
前雷达探测点质量";
CM_ SG_ 998 FRM_27_DetnMotionSts_025 "Detection point motion status
Front Radar Moudle_X_Detection Motion Status
前雷达探测点运动状态";
CM_ SG_ 998 FRM_27_DetnRngRadial_025 "Detection point radial distance
Front Radar Moudle_X_Detection Range Radial
前雷达探测点径向距离";
CM_ SG_ 998 FRM_27_DetnAziAngle_025 "Detection point azimuth angle
Front Radar Moudle_X_Detection Azimuth Angle
前雷达探测点水平方位角";
CM_ SG_ 998 FRM_27_DetnElevnAngle_025 "Detection point elevation angle
Front Radar Moudle_X_Detection Elevation Angle
前雷达探测点俯仰角";
CM_ SG_ 998 FRM_27_DetnRelVelRadial_025 "Detection point radial relative velocity
Front Radar Moudle_X_Detection Relative Velocity Radial 
前雷达探测点在径向上的相对速度";
CM_ SG_ 998 FRM_27_DetnSNR_025 "Detection point signal noise ratio
Front Radar Moudle_X_Detection Signal Noise Ratio
前雷达探测点信号噪声比";
CM_ SG_ 998 FRM_27_DetnRCS_025 "Detection point radar cross section
Front Radar Moudle_X_Detection Radar Cross Section
前雷达探测点雷达散射截面积";
CM_ SG_ 998 FRM_27_DetnQuality_025 "Detection point quality
Front Radar Moudle_X_Detection Quality
前雷达探测点质量";
CM_ SG_ 998 FRM_27_DetnMotionSts_026 "Detection point motion status
Front Radar Moudle_X_Detection Motion Status
前雷达探测点运动状态";
CM_ SG_ 998 FRM_27_DetnRngRadial_026 "Detection point radial distance
Front Radar Moudle_X_Detection Range Radial
前雷达探测点径向距离";
CM_ SG_ 998 FRM_27_DetnAziAngle_026 "Detection point azimuth angle
Front Radar Moudle_X_Detection Azimuth Angle
前雷达探测点水平方位角";
CM_ SG_ 998 FRM_27_DetnElevnAngle_026 "Detection point elevation angle
Front Radar Moudle_X_Detection Elevation Angle
前雷达探测点俯仰角";
CM_ SG_ 998 FRM_27_DetnRelVelRadial_026 "Detection point radial relative velocity
Front Radar Moudle_X_Detection Relative Velocity Radial 
前雷达探测点在径向上的相对速度";
CM_ SG_ 998 FRM_27_DetnSNR_026 "Detection point signal noise ratio
Front Radar Moudle_X_Detection Signal Noise Ratio
前雷达探测点信号噪声比";
CM_ SG_ 998 FRM_27_DetnRCS_026 "Detection point radar cross section
Front Radar Moudle_X_Detection Radar Cross Section
前雷达探测点雷达散射截面积";
CM_ SG_ 998 FRM_27_DetnQuality_026 "Detection point quality
Front Radar Moudle_X_Detection Quality
前雷达探测点质量";
CM_ SG_ 998 FRM_27_DetnMotionSts_027 "Detection point motion status
Front Radar Moudle_X_Detection Motion Status
前雷达探测点运动状态";
CM_ SG_ 998 FRM_27_DetnRngRadial_027 "Detection point radial distance
Front Radar Moudle_X_Detection Range Radial
前雷达探测点径向距离";
CM_ SG_ 998 FRM_27_DetnAziAngle_027 "Detection point azimuth angle
Front Radar Moudle_X_Detection Azimuth Angle
前雷达探测点水平方位角";
CM_ SG_ 998 FRM_27_DetnElevnAngle_027 "Detection point elevation angle
Front Radar Moudle_X_Detection Elevation Angle
前雷达探测点俯仰角";
CM_ SG_ 998 FRM_27_DetnRelVelRadial_027 "Detection point radial relative velocity
Front Radar Moudle_X_Detection Relative Velocity Radial 
前雷达探测点在径向上的相对速度";
CM_ SG_ 998 FRM_27_DetnSNR_027 "Detection point signal noise ratio
Front Radar Moudle_X_Detection Signal Noise Ratio
前雷达探测点信号噪声比";
CM_ SG_ 998 FRM_27_DetnRCS_027 "Detection point radar cross section
Front Radar Moudle_X_Detection Radar Cross Section
前雷达探测点雷达散射截面积";
CM_ SG_ 998 FRM_27_DetnQuality_027 "Detection point quality
Front Radar Moudle_X_Detection Quality
前雷达探测点质量";
CM_ SG_ 998 FRM_27_DetnMotionSts_028 "Detection point motion status
Front Radar Moudle_X_Detection Motion Status
前雷达探测点运动状态";
CM_ SG_ 998 FRM_27_DetnRngRadial_028 "Detection point radial distance
Front Radar Moudle_X_Detection Range Radial
前雷达探测点径向距离";
CM_ SG_ 998 FRM_27_DetnAziAngle_028 "Detection point azimuth angle
Front Radar Moudle_X_Detection Azimuth Angle
前雷达探测点水平方位角";
CM_ SG_ 998 FRM_27_DetnElevnAngle_028 "Detection point elevation angle
Front Radar Moudle_X_Detection Elevation Angle
前雷达探测点俯仰角";
CM_ SG_ 998 FRM_27_DetnRelVelRadial_028 "Detection point radial relative velocity
Front Radar Moudle_X_Detection Relative Velocity Radial 
前雷达探测点在径向上的相对速度";
CM_ SG_ 998 FRM_27_DetnSNR_028 "Detection point signal noise ratio
Front Radar Moudle_X_Detection Signal Noise Ratio
前雷达探测点信号噪声比";
CM_ SG_ 998 FRM_27_DetnRCS_028 "Detection point radar cross section
Front Radar Moudle_X_Detection Radar Cross Section
前雷达探测点雷达散射截面积";
CM_ SG_ 998 FRM_27_DetnQuality_028 "Detection point quality
Front Radar Moudle_X_Detection Quality
前雷达探测点质量";
CM_ SG_ 998 FRM_27_DetnMotionSts_029 "Detection point motion status
Front Radar Moudle_X_Detection Motion Status
前雷达探测点运动状态";
CM_ SG_ 998 FRM_27_DetnRngRadial_029 "Detection point radial distance
Front Radar Moudle_X_Detection Range Radial
前雷达探测点径向距离";
CM_ SG_ 998 FRM_27_DetnAziAngle_029 "Detection point azimuth angle
Front Radar Moudle_X_Detection Azimuth Angle
前雷达探测点水平方位角";
CM_ SG_ 998 FRM_27_DetnElevnAngle_029 "Detection point elevation angle
Front Radar Moudle_X_Detection Elevation Angle
前雷达探测点俯仰角";
CM_ SG_ 998 FRM_27_DetnRelVelRadial_029 "Detection point radial relative velocity
Front Radar Moudle_X_Detection Relative Velocity Radial 
前雷达探测点在径向上的相对速度";
CM_ SG_ 998 FRM_27_DetnSNR_029 "Detection point signal noise ratio
Front Radar Moudle_X_Detection Signal Noise Ratio
前雷达探测点信号噪声比";
CM_ SG_ 998 FRM_27_DetnRCS_029 "Detection point radar cross section
Front Radar Moudle_X_Detection Radar Cross Section
前雷达探测点雷达散射截面积";
CM_ SG_ 998 FRM_27_DetnQuality_029 "Detection point quality
Front Radar Moudle_X_Detection Quality
前雷达探测点质量";
CM_ SG_ 999 FRM_28_CRC "Profile5:E2E CRC16 (polynomial:0x1021)       
DataID:Use CANID,other bits Fill with 0";
CM_ SG_ 999 FRM_28_RollgCntr "Profile5:E2E Rolling message counter";
CM_ SG_ 999 FRM_28_DetnBlockCounter "Front Radar Moudle_X_Detection Block Counter
前雷达探测点块计数";
CM_ SG_ 999 FRM_28_DetnMotionSts_030 "Detection point motion status
Front Radar Moudle_X_Detection Motion Status
前雷达探测点运动状态";
CM_ SG_ 999 FRM_28_DetnRngRadial_030 "Detection point radial distance
Front Radar Moudle_X_Detection Range Radial
前雷达探测点径向距离";
CM_ SG_ 999 FRM_28_DetnAziAngle_030 "Detection point azimuth angle
Front Radar Moudle_X_Detection Azimuth Angle
前雷达探测点水平方位角";
CM_ SG_ 999 FRM_28_DetnElevnAngle_030 "Detection point elevation angle
Front Radar Moudle_X_Detection Elevation Angle
前雷达探测点俯仰角";
CM_ SG_ 999 FRM_28_DetnRelVelRadial_030 "Detection point radial relative velocity
Front Radar Moudle_X_Detection Relative Velocity Radial 
前雷达探测点在径向上的相对速度";
CM_ SG_ 999 FRM_28_DetnSNR_030 "Detection point signal noise ratio
Front Radar Moudle_X_Detection Signal Noise Ratio
前雷达探测点信号噪声比";
CM_ SG_ 999 FRM_28_DetnRCS_030 "Detection point radar cross section
Front Radar Moudle_X_Detection Radar Cross Section
前雷达探测点雷达散射截面积";
CM_ SG_ 999 FRM_28_DetnQuality_030 "Detection point quality
Front Radar Moudle_X_Detection Quality
前雷达探测点质量";
CM_ SG_ 999 FRM_28_DetnMotionSts_031 "Detection point motion status
Front Radar Moudle_X_Detection Motion Status
前雷达探测点运动状态";
CM_ SG_ 999 FRM_28_DetnRngRadial_031 "Detection point radial distance
Front Radar Moudle_X_Detection Range Radial
前雷达探测点径向距离";
CM_ SG_ 999 FRM_28_DetnAziAngle_031 "Detection point azimuth angle
Front Radar Moudle_X_Detection Azimuth Angle
前雷达探测点水平方位角";
CM_ SG_ 999 FRM_28_DetnElevnAngle_031 "Detection point elevation angle
Front Radar Moudle_X_Detection Elevation Angle
前雷达探测点俯仰角";
CM_ SG_ 999 FRM_28_DetnRelVelRadial_031 "Detection point radial relative velocity
Front Radar Moudle_X_Detection Relative Velocity Radial 
前雷达探测点在径向上的相对速度";
CM_ SG_ 999 FRM_28_DetnSNR_031 "Detection point signal noise ratio
Front Radar Moudle_X_Detection Signal Noise Ratio
前雷达探测点信号噪声比";
CM_ SG_ 999 FRM_28_DetnRCS_031 "Detection point radar cross section
Front Radar Moudle_X_Detection Radar Cross Section
前雷达探测点雷达散射截面积";
CM_ SG_ 999 FRM_28_DetnQuality_031 "Detection point quality
Front Radar Moudle_X_Detection Quality
前雷达探测点质量";
CM_ SG_ 999 FRM_28_DetnMotionSts_032 "Detection point motion status
Front Radar Moudle_X_Detection Motion Status
前雷达探测点运动状态";
CM_ SG_ 999 FRM_28_DetnRngRadial_032 "Detection point radial distance
Front Radar Moudle_X_Detection Range Radial
前雷达探测点径向距离";
CM_ SG_ 999 FRM_28_DetnAziAngle_032 "Detection point azimuth angle
Front Radar Moudle_X_Detection Azimuth Angle
前雷达探测点水平方位角";
CM_ SG_ 999 FRM_28_DetnElevnAngle_032 "Detection point elevation angle
Front Radar Moudle_X_Detection Elevation Angle
前雷达探测点俯仰角";
CM_ SG_ 999 FRM_28_DetnRelVelRadial_032 "Detection point radial relative velocity
Front Radar Moudle_X_Detection Relative Velocity Radial 
前雷达探测点在径向上的相对速度";
CM_ SG_ 999 FRM_28_DetnSNR_032 "Detection point signal noise ratio
Front Radar Moudle_X_Detection Signal Noise Ratio
前雷达探测点信号噪声比";
CM_ SG_ 999 FRM_28_DetnRCS_032 "Detection point radar cross section
Front Radar Moudle_X_Detection Radar Cross Section
前雷达探测点雷达散射截面积";
CM_ SG_ 999 FRM_28_DetnQuality_032 "Detection point quality
Front Radar Moudle_X_Detection Quality
前雷达探测点质量";
CM_ SG_ 999 FRM_28_DetnMotionSts_033 "Detection point motion status
Front Radar Moudle_X_Detection Motion Status
前雷达探测点运动状态";
CM_ SG_ 999 FRM_28_DetnRngRadial_033 "Detection point radial distance
Front Radar Moudle_X_Detection Range Radial
前雷达探测点径向距离";
CM_ SG_ 999 FRM_28_DetnAziAngle_033 "Detection point azimuth angle
Front Radar Moudle_X_Detection Azimuth Angle
前雷达探测点水平方位角";
CM_ SG_ 999 FRM_28_DetnElevnAngle_033 "Detection point elevation angle
Front Radar Moudle_X_Detection Elevation Angle
前雷达探测点俯仰角";
CM_ SG_ 999 FRM_28_DetnRelVelRadial_033 "Detection point radial relative velocity
Front Radar Moudle_X_Detection Relative Velocity Radial 
前雷达探测点在径向上的相对速度";
CM_ SG_ 999 FRM_28_DetnSNR_033 "Detection point signal noise ratio
Front Radar Moudle_X_Detection Signal Noise Ratio
前雷达探测点信号噪声比";
CM_ SG_ 999 FRM_28_DetnRCS_033 "Detection point radar cross section
Front Radar Moudle_X_Detection Radar Cross Section
前雷达探测点雷达散射截面积";
CM_ SG_ 999 FRM_28_DetnQuality_033 "Detection point quality
Front Radar Moudle_X_Detection Quality
前雷达探测点质量";
CM_ SG_ 999 FRM_28_DetnMotionSts_034 "Detection point motion status
Front Radar Moudle_X_Detection Motion Status
前雷达探测点运动状态";
CM_ SG_ 999 FRM_28_DetnRngRadial_034 "Detection point radial distance
Front Radar Moudle_X_Detection Range Radial
前雷达探测点径向距离";
CM_ SG_ 999 FRM_28_DetnAziAngle_034 "Detection point azimuth angle
Front Radar Moudle_X_Detection Azimuth Angle
前雷达探测点水平方位角";
CM_ SG_ 999 FRM_28_DetnElevnAngle_034 "Detection point elevation angle
Front Radar Moudle_X_Detection Elevation Angle
前雷达探测点俯仰角";
CM_ SG_ 999 FRM_28_DetnRelVelRadial_034 "Detection point radial relative velocity
Front Radar Moudle_X_Detection Relative Velocity Radial 
前雷达探测点在径向上的相对速度";
CM_ SG_ 999 FRM_28_DetnSNR_034 "Detection point signal noise ratio
Front Radar Moudle_X_Detection Signal Noise Ratio
前雷达探测点信号噪声比";
CM_ SG_ 999 FRM_28_DetnRCS_034 "Detection point radar cross section
Front Radar Moudle_X_Detection Radar Cross Section
前雷达探测点雷达散射截面积";
CM_ SG_ 999 FRM_28_DetnQuality_034 "Detection point quality
Front Radar Moudle_X_Detection Quality
前雷达探测点质量";
CM_ SG_ 999 FRM_28_DetnMotionSts_035 "Detection point motion status
Front Radar Moudle_X_Detection Motion Status
前雷达探测点运动状态";
CM_ SG_ 999 FRM_28_DetnRngRadial_035 "Detection point radial distance
Front Radar Moudle_X_Detection Range Radial
前雷达探测点径向距离";
CM_ SG_ 999 FRM_28_DetnAziAngle_035 "Detection point azimuth angle
Front Radar Moudle_X_Detection Azimuth Angle
前雷达探测点水平方位角";
CM_ SG_ 999 FRM_28_DetnElevnAngle_035 "Detection point elevation angle
Front Radar Moudle_X_Detection Elevation Angle
前雷达探测点俯仰角";
CM_ SG_ 999 FRM_28_DetnRelVelRadial_035 "Detection point radial relative velocity
Front Radar Moudle_X_Detection Relative Velocity Radial 
前雷达探测点在径向上的相对速度";
CM_ SG_ 999 FRM_28_DetnSNR_035 "Detection point signal noise ratio
Front Radar Moudle_X_Detection Signal Noise Ratio
前雷达探测点信号噪声比";
CM_ SG_ 999 FRM_28_DetnRCS_035 "Detection point radar cross section
Front Radar Moudle_X_Detection Radar Cross Section
前雷达探测点雷达散射截面积";
CM_ SG_ 999 FRM_28_DetnQuality_035 "Detection point quality
Front Radar Moudle_X_Detection Quality
前雷达探测点质量";
CM_ SG_ 1000 FRM_29_CRC "Profile5:E2E CRC16 (polynomial:0x1021)       
DataID:Use CANID,other bits Fill with 0";
CM_ SG_ 1000 FRM_29_RollgCntr "Profile5:E2E Rolling message counter";
CM_ SG_ 1000 FRM_29_DetnBlockCounter "Front Radar Moudle_X_Detection Block Counter
前雷达探测点块计数";
CM_ SG_ 1000 FRM_29_DetnMotionSts_036 "Detection point motion status
Front Radar Moudle_X_Detection Motion Status
前雷达探测点运动状态";
CM_ SG_ 1000 FRM_29_DetnRngRadial_036 "Detection point radial distance
Front Radar Moudle_X_Detection Range Radial
前雷达探测点径向距离";
CM_ SG_ 1000 FRM_29_DetnAziAngle_036 "Detection point azimuth angle
Front Radar Moudle_X_Detection Azimuth Angle
前雷达探测点水平方位角";
CM_ SG_ 1000 FRM_29_DetnElevnAngle_036 "Detection point elevation angle
Front Radar Moudle_X_Detection Elevation Angle
前雷达探测点俯仰角";
CM_ SG_ 1000 FRM_29_DetnRelVelRadial_036 "Detection point radial relative velocity
Front Radar Moudle_X_Detection Relative Velocity Radial 
前雷达探测点在径向上的相对速度";
CM_ SG_ 1000 FRM_29_DetnSNR_036 "Detection point signal noise ratio
Front Radar Moudle_X_Detection Signal Noise Ratio
前雷达探测点信号噪声比";
CM_ SG_ 1000 FRM_29_DetnRCS_036 "Detection point radar cross section
Front Radar Moudle_X_Detection Radar Cross Section
前雷达探测点雷达散射截面积";
CM_ SG_ 1000 FRM_29_DetnQuality_036 "Detection point quality
Front Radar Moudle_X_Detection Quality
前雷达探测点质量";
CM_ SG_ 1000 FRM_29_DetnMotionSts_037 "Detection point motion status
Front Radar Moudle_X_Detection Motion Status
前雷达探测点运动状态";
CM_ SG_ 1000 FRM_29_DetnRngRadial_037 "Detection point radial distance
Front Radar Moudle_X_Detection Range Radial
前雷达探测点径向距离";
CM_ SG_ 1000 FRM_29_DetnAziAngle_037 "Detection point azimuth angle
Front Radar Moudle_X_Detection Azimuth Angle
前雷达探测点水平方位角";
CM_ SG_ 1000 FRM_29_DetnElevnAngle_037 "Detection point elevation angle
Front Radar Moudle_X_Detection Elevation Angle
前雷达探测点俯仰角";
CM_ SG_ 1000 FRM_29_DetnRelVelRadial_037 "Detection point radial relative velocity
Front Radar Moudle_X_Detection Relative Velocity Radial 
前雷达探测点在径向上的相对速度";
CM_ SG_ 1000 FRM_29_DetnSNR_037 "Detection point signal noise ratio
Front Radar Moudle_X_Detection Signal Noise Ratio
前雷达探测点信号噪声比";
CM_ SG_ 1000 FRM_29_DetnRCS_037 "Detection point radar cross section
Front Radar Moudle_X_Detection Radar Cross Section
前雷达探测点雷达散射截面积";
CM_ SG_ 1000 FRM_29_DetnQuality_037 "Detection point quality
Front Radar Moudle_X_Detection Quality
前雷达探测点质量";
CM_ SG_ 1000 FRM_29_DetnMotionSts_038 "Detection point motion status
Front Radar Moudle_X_Detection Motion Status
前雷达探测点运动状态";
CM_ SG_ 1000 FRM_29_DetnRngRadial_038 "Detection point radial distance
Front Radar Moudle_X_Detection Range Radial
前雷达探测点径向距离";
CM_ SG_ 1000 FRM_29_DetnAziAngle_038 "Detection point azimuth angle
Front Radar Moudle_X_Detection Azimuth Angle
前雷达探测点水平方位角";
CM_ SG_ 1000 FRM_29_DetnElevnAngle_038 "Detection point elevation angle
Front Radar Moudle_X_Detection Elevation Angle
前雷达探测点俯仰角";
CM_ SG_ 1000 FRM_29_DetnRelVelRadial_038 "Detection point radial relative velocity
Front Radar Moudle_X_Detection Relative Velocity Radial 
前雷达探测点在径向上的相对速度";
CM_ SG_ 1000 FRM_29_DetnSNR_038 "Detection point signal noise ratio
Front Radar Moudle_X_Detection Signal Noise Ratio
前雷达探测点信号噪声比";
CM_ SG_ 1000 FRM_29_DetnRCS_038 "Detection point radar cross section
Front Radar Moudle_X_Detection Radar Cross Section
前雷达探测点雷达散射截面积";
CM_ SG_ 1000 FRM_29_DetnQuality_038 "Detection point quality
Front Radar Moudle_X_Detection Quality
前雷达探测点质量";
CM_ SG_ 1000 FRM_29_DetnMotionSts_039 "Detection point motion status
Front Radar Moudle_X_Detection Motion Status
前雷达探测点运动状态";
CM_ SG_ 1000 FRM_29_DetnRngRadial_039 "Detection point radial distance
Front Radar Moudle_X_Detection Range Radial
前雷达探测点径向距离";
CM_ SG_ 1000 FRM_29_DetnAziAngle_039 "Detection point azimuth angle
Front Radar Moudle_X_Detection Azimuth Angle
前雷达探测点水平方位角";
CM_ SG_ 1000 FRM_29_DetnElevnAngle_039 "Detection point elevation angle
Front Radar Moudle_X_Detection Elevation Angle
前雷达探测点俯仰角";
CM_ SG_ 1000 FRM_29_DetnRelVelRadial_039 "Detection point radial relative velocity
Front Radar Moudle_X_Detection Relative Velocity Radial 
前雷达探测点在径向上的相对速度";
CM_ SG_ 1000 FRM_29_DetnSNR_039 "Detection point signal noise ratio
Front Radar Moudle_X_Detection Signal Noise Ratio
前雷达探测点信号噪声比";
CM_ SG_ 1000 FRM_29_DetnRCS_039 "Detection point radar cross section
Front Radar Moudle_X_Detection Radar Cross Section
前雷达探测点雷达散射截面积";
CM_ SG_ 1000 FRM_29_DetnQuality_039 "Detection point quality
Front Radar Moudle_X_Detection Quality
前雷达探测点质量";
CM_ SG_ 1000 FRM_29_DetnMotionSts_040 "Detection point motion status
Front Radar Moudle_X_Detection Motion Status
前雷达探测点运动状态";
CM_ SG_ 1000 FRM_29_DetnRngRadial_040 "Detection point radial distance
Front Radar Moudle_X_Detection Range Radial
前雷达探测点径向距离";
CM_ SG_ 1000 FRM_29_DetnAziAngle_040 "Detection point azimuth angle
Front Radar Moudle_X_Detection Azimuth Angle
前雷达探测点水平方位角";
CM_ SG_ 1000 FRM_29_DetnElevnAngle_040 "Detection point elevation angle
Front Radar Moudle_X_Detection Elevation Angle
前雷达探测点俯仰角";
CM_ SG_ 1000 FRM_29_DetnRelVelRadial_040 "Detection point radial relative velocity
Front Radar Moudle_X_Detection Relative Velocity Radial 
前雷达探测点在径向上的相对速度";
CM_ SG_ 1000 FRM_29_DetnSNR_040 "Detection point signal noise ratio
Front Radar Moudle_X_Detection Signal Noise Ratio
前雷达探测点信号噪声比";
CM_ SG_ 1000 FRM_29_DetnRCS_040 "Detection point radar cross section
Front Radar Moudle_X_Detection Radar Cross Section
前雷达探测点雷达散射截面积";
CM_ SG_ 1000 FRM_29_DetnQuality_040 "Detection point quality
Front Radar Moudle_X_Detection Quality
前雷达探测点质量";
CM_ SG_ 1000 FRM_29_DetnMotionSts_041 "Detection point motion status
Front Radar Moudle_X_Detection Motion Status
前雷达探测点运动状态";
CM_ SG_ 1000 FRM_29_DetnRngRadial_041 "Detection point radial distance
Front Radar Moudle_X_Detection Range Radial
前雷达探测点径向距离";
CM_ SG_ 1000 FRM_29_DetnAziAngle_041 "Detection point azimuth angle
Front Radar Moudle_X_Detection Azimuth Angle
前雷达探测点水平方位角";
CM_ SG_ 1000 FRM_29_DetnElevnAngle_041 "Detection point elevation angle
Front Radar Moudle_X_Detection Elevation Angle
前雷达探测点俯仰角";
CM_ SG_ 1000 FRM_29_DetnRelVelRadial_041 "Detection point radial relative velocity
Front Radar Moudle_X_Detection Relative Velocity Radial 
前雷达探测点在径向上的相对速度";
CM_ SG_ 1000 FRM_29_DetnSNR_041 "Detection point signal noise ratio
Front Radar Moudle_X_Detection Signal Noise Ratio
前雷达探测点信号噪声比";
CM_ SG_ 1000 FRM_29_DetnRCS_041 "Detection point radar cross section
Front Radar Moudle_X_Detection Radar Cross Section
前雷达探测点雷达散射截面积";
CM_ SG_ 1000 FRM_29_DetnQuality_041 "Detection point quality
Front Radar Moudle_X_Detection Quality
前雷达探测点质量";
CM_ SG_ 1001 FRM_30_CRC "Profile5:E2E CRC16 (polynomial:0x1021)       
DataID:Use CANID,other bits Fill with 0";
CM_ SG_ 1001 FRM_30_RollgCntr "Profile5:E2E Rolling message counter";
CM_ SG_ 1001 FRM_30_DetnBlockCounter "Front Radar Moudle_X_Detection Block Counter
前雷达探测点块计数";
CM_ SG_ 1001 FRM_30_DetnMotionSts_042 "Detection point motion status
Front Radar Moudle_X_Detection Motion Status
前雷达探测点运动状态";
CM_ SG_ 1001 FRM_30_DetnRngRadial_042 "Detection point radial distance
Front Radar Moudle_X_Detection Range Radial
前雷达探测点径向距离";
CM_ SG_ 1001 FRM_30_DetnAziAngle_042 "Detection point azimuth angle
Front Radar Moudle_X_Detection Azimuth Angle
前雷达探测点水平方位角";
CM_ SG_ 1001 FRM_30_DetnElevnAngle_042 "Detection point elevation angle
Front Radar Moudle_X_Detection Elevation Angle
前雷达探测点俯仰角";
CM_ SG_ 1001 FRM_30_DetnRelVelRadial_042 "Detection point radial relative velocity
Front Radar Moudle_X_Detection Relative Velocity Radial 
前雷达探测点在径向上的相对速度";
CM_ SG_ 1001 FRM_30_DetnSNR_042 "Detection point signal noise ratio
Front Radar Moudle_X_Detection Signal Noise Ratio
前雷达探测点信号噪声比";
CM_ SG_ 1001 FRM_30_DetnRCS_042 "Detection point radar cross section
Front Radar Moudle_X_Detection Radar Cross Section
前雷达探测点雷达散射截面积";
CM_ SG_ 1001 FRM_30_DetnQuality_042 "Detection point quality
Front Radar Moudle_X_Detection Quality
前雷达探测点质量";
CM_ SG_ 1001 FRM_30_DetnMotionSts_043 "Detection point motion status
Front Radar Moudle_X_Detection Motion Status
前雷达探测点运动状态";
CM_ SG_ 1001 FRM_30_DetnRngRadial_043 "Detection point radial distance
Front Radar Moudle_X_Detection Range Radial
前雷达探测点径向距离";
CM_ SG_ 1001 FRM_30_DetnAziAngle_043 "Detection point azimuth angle
Front Radar Moudle_X_Detection Azimuth Angle
前雷达探测点水平方位角";
CM_ SG_ 1001 FRM_30_DetnElevnAngle_043 "Detection point elevation angle
Front Radar Moudle_X_Detection Elevation Angle
前雷达探测点俯仰角";
CM_ SG_ 1001 FRM_30_DetnRelVelRadial_043 "Detection point radial relative velocity
Front Radar Moudle_X_Detection Relative Velocity Radial 
前雷达探测点在径向上的相对速度";
CM_ SG_ 1001 FRM_30_DetnSNR_043 "Detection point signal noise ratio
Front Radar Moudle_X_Detection Signal Noise Ratio
前雷达探测点信号噪声比";
CM_ SG_ 1001 FRM_30_DetnRCS_043 "Detection point radar cross section
Front Radar Moudle_X_Detection Radar Cross Section
前雷达探测点雷达散射截面积";
CM_ SG_ 1001 FRM_30_DetnQuality_043 "Detection point quality
Front Radar Moudle_X_Detection Quality
前雷达探测点质量";
CM_ SG_ 1001 FRM_30_DetnMotionSts_044 "Detection point motion status
Front Radar Moudle_X_Detection Motion Status
前雷达探测点运动状态";
CM_ SG_ 1001 FRM_30_DetnRngRadial_044 "Detection point radial distance
Front Radar Moudle_X_Detection Range Radial
前雷达探测点径向距离";
CM_ SG_ 1001 FRM_30_DetnAziAngle_044 "Detection point azimuth angle
Front Radar Moudle_X_Detection Azimuth Angle
前雷达探测点水平方位角";
CM_ SG_ 1001 FRM_30_DetnElevnAngle_044 "Detection point elevation angle
Front Radar Moudle_X_Detection Elevation Angle
前雷达探测点俯仰角";
CM_ SG_ 1001 FRM_30_DetnRelVelRadial_044 "Detection point radial relative velocity
Front Radar Moudle_X_Detection Relative Velocity Radial 
前雷达探测点在径向上的相对速度";
CM_ SG_ 1001 FRM_30_DetnSNR_044 "Detection point signal noise ratio
Front Radar Moudle_X_Detection Signal Noise Ratio
前雷达探测点信号噪声比";
CM_ SG_ 1001 FRM_30_DetnRCS_044 "Detection point radar cross section
Front Radar Moudle_X_Detection Radar Cross Section
前雷达探测点雷达散射截面积";
CM_ SG_ 1001 FRM_30_DetnQuality_044 "Detection point quality
Front Radar Moudle_X_Detection Quality
前雷达探测点质量";
CM_ SG_ 1001 FRM_30_DetnMotionSts_045 "Detection point motion status
Front Radar Moudle_X_Detection Motion Status
前雷达探测点运动状态";
CM_ SG_ 1001 FRM_30_DetnRngRadial_045 "Detection point radial distance
Front Radar Moudle_X_Detection Range Radial
前雷达探测点径向距离";
CM_ SG_ 1001 FRM_30_DetnAziAngle_045 "Detection point azimuth angle
Front Radar Moudle_X_Detection Azimuth Angle
前雷达探测点水平方位角";
CM_ SG_ 1001 FRM_30_DetnElevnAngle_045 "Detection point elevation angle
Front Radar Moudle_X_Detection Elevation Angle
前雷达探测点俯仰角";
CM_ SG_ 1001 FRM_30_DetnRelVelRadial_045 "Detection point radial relative velocity
Front Radar Moudle_X_Detection Relative Velocity Radial 
前雷达探测点在径向上的相对速度";
CM_ SG_ 1001 FRM_30_DetnSNR_045 "Detection point signal noise ratio
Front Radar Moudle_X_Detection Signal Noise Ratio
前雷达探测点信号噪声比";
CM_ SG_ 1001 FRM_30_DetnRCS_045 "Detection point radar cross section
Front Radar Moudle_X_Detection Radar Cross Section
前雷达探测点雷达散射截面积";
CM_ SG_ 1001 FRM_30_DetnQuality_045 "Detection point quality
Front Radar Moudle_X_Detection Quality
前雷达探测点质量";
CM_ SG_ 1001 FRM_30_DetnMotionSts_046 "Detection point motion status
Front Radar Moudle_X_Detection Motion Status
前雷达探测点运动状态";
CM_ SG_ 1001 FRM_30_DetnRngRadial_046 "Detection point radial distance
Front Radar Moudle_X_Detection Range Radial
前雷达探测点径向距离";
CM_ SG_ 1001 FRM_30_DetnAziAngle_046 "Detection point azimuth angle
Front Radar Moudle_X_Detection Azimuth Angle
前雷达探测点水平方位角";
CM_ SG_ 1001 FRM_30_DetnElevnAngle_046 "Detection point elevation angle
Front Radar Moudle_X_Detection Elevation Angle
前雷达探测点俯仰角";
CM_ SG_ 1001 FRM_30_DetnRelVelRadial_046 "Detection point radial relative velocity
Front Radar Moudle_X_Detection Relative Velocity Radial 
前雷达探测点在径向上的相对速度";
CM_ SG_ 1001 FRM_30_DetnSNR_046 "Detection point signal noise ratio
Front Radar Moudle_X_Detection Signal Noise Ratio
前雷达探测点信号噪声比";
CM_ SG_ 1001 FRM_30_DetnRCS_046 "Detection point radar cross section
Front Radar Moudle_X_Detection Radar Cross Section
前雷达探测点雷达散射截面积";
CM_ SG_ 1001 FRM_30_DetnQuality_046 "Detection point quality
Front Radar Moudle_X_Detection Quality
前雷达探测点质量";
CM_ SG_ 1001 FRM_30_DetnMotionSts_047 "Detection point motion status
Front Radar Moudle_X_Detection Motion Status
前雷达探测点运动状态";
CM_ SG_ 1001 FRM_30_DetnRngRadial_047 "Detection point radial distance
Front Radar Moudle_X_Detection Range Radial
前雷达探测点径向距离";
CM_ SG_ 1001 FRM_30_DetnAziAngle_047 "Detection point azimuth angle
Front Radar Moudle_X_Detection Azimuth Angle
前雷达探测点水平方位角";
CM_ SG_ 1001 FRM_30_DetnElevnAngle_047 "Detection point elevation angle
Front Radar Moudle_X_Detection Elevation Angle
前雷达探测点俯仰角";
CM_ SG_ 1001 FRM_30_DetnRelVelRadial_047 "Detection point radial relative velocity
Front Radar Moudle_X_Detection Relative Velocity Radial 
前雷达探测点在径向上的相对速度";
CM_ SG_ 1001 FRM_30_DetnSNR_047 "Detection point signal noise ratio
Front Radar Moudle_X_Detection Signal Noise Ratio
前雷达探测点信号噪声比";
CM_ SG_ 1001 FRM_30_DetnRCS_047 "Detection point radar cross section
Front Radar Moudle_X_Detection Radar Cross Section
前雷达探测点雷达散射截面积";
CM_ SG_ 1001 FRM_30_DetnQuality_047 "Detection point quality
Front Radar Moudle_X_Detection Quality
前雷达探测点质量";

BA_DEF_ BO_  "GenMsgSendType" ENUM  "Cyclic","Event","IfActive","CE","CA","NoMsgSendType";
BA_DEF_ BO_  "GenMsgCycleTime" INT 0 0;
BA_DEF_ SG_  "GenSigSendType" ENUM  "Cyclic","OnChange","OnWrite","IfActive","OnChangeWithRepetition","OnWriteWithRepetition","IfActiveWithRepetition","NoSigSendType","OnChangeAndIfActive","OnChangeAndIfActiveWithRepetition","CA","CE","Event";
BA_DEF_ SG_  "GenSigStartValue" INT 0 0;
BA_DEF_ BO_  "GenMsgCycleTimeFast" INT 0 0;
BA_DEF_ BO_  "GenMsgNrOfRepetition" INT 0 0;
BA_DEF_ BO_  "GenMsgDelayTime" INT 0 0;
BA_DEF_ BO_  "CANFD_BRS" ENUM  "0","1";
BA_DEF_ BO_  "VFrameFormat" ENUM  "StandardCAN","ExtendedCAN","reserved","reserved","reserved","reserved","reserved","reserved","reserved","reserved","reserved","reserved","reserved","reserved","StandardCAN_FD","ExtendedCAN_FD";
BA_DEF_ BO_  "GenMsgILSupport" ENUM  "No","Yes";
BA_DEF_ SG_ "GenSigASIL" ENUM "QM","A","B","C","D","";
BA_DEF_DEF_  "GenMsgSendType" "Cyclic";
BA_DEF_DEF_  "GenMsgCycleTime" 0;
BA_DEF_DEF_  "GenSigSendType" "Cyclic";
BA_DEF_DEF_  "GenSigStartValue" 0;
BA_DEF_DEF_  "GenMsgCycleTimeFast" 0;
BA_DEF_DEF_  "GenMsgNrOfRepetition" 0;
BA_DEF_DEF_  "GenMsgDelayTime" 0;
BA_DEF_DEF_  "CANFD_BRS" "1";
BA_DEF_DEF_  "VFrameFormat" "StandardCAN_FD";
BA_DEF_DEF_  "GenMsgILSupport" "No";
BA_DEF_DEF_ "GenSigASIL" "QM";
BA_ "GenMsgILSupport" BO_ 979 1;
BA_ "GenMsgCycleTime" BO_ 979 50;
BA_ "GenSigASIL"  SG_ 979 FRM_20_CRC 5;
BA_ "GenSigASIL"  SG_ 979 FRM_20_RollgCntr 5;
BA_ "GenSigASIL"  SG_ 979 FRM_20_ObjBlockCounter 2;
BA_ "GenSigASIL"  SG_ 979 FRM_20_ObjID_34 2;
BA_ "GenSigASIL"  SG_ 979 FRM_20_ObjClosestDistX_34 2;
BA_ "GenSigStartValue" SG_ 979 FRM_20_ObjClosestDistY_34 10000;
BA_ "GenSigASIL"  SG_ 979 FRM_20_ObjClosestDistY_34 2;
BA_ "GenSigStartValue" SG_ 979 FRM_20_ObjRelVelX_34 10000;
BA_ "GenSigASIL"  SG_ 979 FRM_20_ObjRelVelX_34 2;
BA_ "GenSigStartValue" SG_ 979 FRM_20_ObjRelVelY_34 10000;
BA_ "GenSigASIL"  SG_ 979 FRM_20_ObjRelVelY_34 2;
BA_ "GenSigStartValue" SG_ 979 FRM_20_ObjAccelX_34 2500;
BA_ "GenSigASIL"  SG_ 979 FRM_20_ObjAccelX_34 2;
BA_ "GenSigStartValue" SG_ 979 FRM_20_ObjAccelY_34 2500;
BA_ "GenSigASIL"  SG_ 979 FRM_20_ObjAccelY_34 2;
BA_ "GenSigASIL"  SG_ 979 FRM_20_ObjClosestDistXStd_34 2;
BA_ "GenSigASIL"  SG_ 979 FRM_20_ObjClosestDistYStd_34 2;
BA_ "GenSigASIL"  SG_ 979 FRM_20_ObjRelVelXStd_34 2;
BA_ "GenSigASIL"  SG_ 979 FRM_20_ObjRelVelYStd_34 2;
BA_ "GenSigASIL"  SG_ 979 FRM_20_ObjRelAccelXStd_34 2;
BA_ "GenSigASIL"  SG_ 979 FRM_20_ObjRelAccelYStd_34 2;
BA_ "GenSigASIL"  SG_ 979 FRM_20_ObjExistProb_34 2;
BA_ "GenSigASIL"  SG_ 979 FRM_20_ObjType_34 2;
BA_ "GenSigASIL"  SG_ 979 FRM_20_ObjTypeConf_34 2;
BA_ "GenSigASIL"  SG_ 979 FRM_20_ObjTrackSts_34 2;
BA_ "GenSigASIL"  SG_ 979 FRM_20_ObjMotionSts_34 2;
BA_ "GenSigASIL"  SG_ 979 FRM_20_ObjMotionDirection_34 2;
BA_ "GenSigASIL"  SG_ 979 FRM_20_ObjCenterDistX_34 2;
BA_ "GenSigStartValue" SG_ 979 FRM_20_ObjCenterDistY_34 10000;
BA_ "GenSigASIL"  SG_ 979 FRM_20_ObjCenterDistY_34 2;
BA_ "GenSigASIL"  SG_ 979 FRM_20_ObjLength_34 2;
BA_ "GenSigASIL"  SG_ 979 FRM_20_ObjWidth_34 2;
BA_ "GenSigASIL"  SG_ 979 FRM_20_ObjElevnSts_34 2;
BA_ "GenSigASIL"  SG_ 979 FRM_20_ObjElevnStsConf_34 2;
BA_ "GenSigStartValue" SG_ 979 FRM_20_ObjHeading_34 1800;
BA_ "GenSigASIL"  SG_ 979 FRM_20_ObjHeading_34 2;
BA_ "GenSigASIL"  SG_ 979 FRM_20_ObjID_35 2;
BA_ "GenSigASIL"  SG_ 979 FRM_20_ObjClosestDistX_35 2;
BA_ "GenSigStartValue" SG_ 979 FRM_20_ObjClosestDistY_35 10000;
BA_ "GenSigASIL"  SG_ 979 FRM_20_ObjClosestDistY_35 2;
BA_ "GenSigStartValue" SG_ 979 FRM_20_ObjRelVelX_35 10000;
BA_ "GenSigASIL"  SG_ 979 FRM_20_ObjRelVelX_35 2;
BA_ "GenSigStartValue" SG_ 979 FRM_20_ObjRelVelY_35 10000;
BA_ "GenSigASIL"  SG_ 979 FRM_20_ObjRelVelY_35 2;
BA_ "GenSigStartValue" SG_ 979 FRM_20_ObjAccelX_35 2500;
BA_ "GenSigASIL"  SG_ 979 FRM_20_ObjAccelX_35 2;
BA_ "GenSigStartValue" SG_ 979 FRM_20_ObjAccelY_35 2500;
BA_ "GenSigASIL"  SG_ 979 FRM_20_ObjAccelY_35 2;
BA_ "GenSigASIL"  SG_ 979 FRM_20_ObjClosestDistXStd_35 2;
BA_ "GenSigASIL"  SG_ 979 FRM_20_ObjClosestDistYStd_35 2;
BA_ "GenSigASIL"  SG_ 979 FRM_20_ObjRelVelXStd_35 2;
BA_ "GenSigASIL"  SG_ 979 FRM_20_ObjRelVelYStd_35 2;
BA_ "GenSigASIL"  SG_ 979 FRM_20_ObjRelAccelXStd_35 2;
BA_ "GenSigASIL"  SG_ 979 FRM_20_ObjRelAccelYStd_35 2;
BA_ "GenSigASIL"  SG_ 979 FRM_20_ObjExistProb_35 2;
BA_ "GenSigASIL"  SG_ 979 FRM_20_ObjType_35 2;
BA_ "GenSigASIL"  SG_ 979 FRM_20_ObjTypeConf_35 2;
BA_ "GenSigASIL"  SG_ 979 FRM_20_ObjTrackSts_35 2;
BA_ "GenSigASIL"  SG_ 979 FRM_20_ObjMotionSts_35 2;
BA_ "GenSigASIL"  SG_ 979 FRM_20_ObjMotionDirection_35 2;
BA_ "GenSigASIL"  SG_ 979 FRM_20_ObjCenterDistX_35 2;
BA_ "GenSigStartValue" SG_ 979 FRM_20_ObjCenterDistY_35 10000;
BA_ "GenSigASIL"  SG_ 979 FRM_20_ObjCenterDistY_35 2;
BA_ "GenSigASIL"  SG_ 979 FRM_20_ObjLength_35 2;
BA_ "GenSigASIL"  SG_ 979 FRM_20_ObjWidth_35 2;
BA_ "GenSigASIL"  SG_ 979 FRM_20_ObjElevnSts_35 2;
BA_ "GenSigASIL"  SG_ 979 FRM_20_ObjElevnStsConf_35 2;
BA_ "GenSigStartValue" SG_ 979 FRM_20_ObjHeading_35 1800;
BA_ "GenSigASIL"  SG_ 979 FRM_20_ObjHeading_35 2;
BA_ "GenMsgILSupport" BO_ 992 1;
BA_ "GenMsgCycleTime" BO_ 992 50;
BA_ "GenSigASIL"  SG_ 992 FRM_21_CRC 5;
BA_ "GenSigASIL"  SG_ 992 FRM_21_RollgCntr 5;
BA_ "GenSigASIL"  SG_ 992 FRM_21_ObjBlockCounter 2;
BA_ "GenSigASIL"  SG_ 992 FRM_21_ObjID_36 2;
BA_ "GenSigASIL"  SG_ 992 FRM_21_ObjClosestDistX_36 2;
BA_ "GenSigStartValue" SG_ 992 FRM_21_ObjClosestDistY_36 10000;
BA_ "GenSigASIL"  SG_ 992 FRM_21_ObjClosestDistY_36 2;
BA_ "GenSigStartValue" SG_ 992 FRM_21_ObjRelVelX_36 10000;
BA_ "GenSigASIL"  SG_ 992 FRM_21_ObjRelVelX_36 2;
BA_ "GenSigStartValue" SG_ 992 FRM_21_ObjRelVelY_36 10000;
BA_ "GenSigASIL"  SG_ 992 FRM_21_ObjRelVelY_36 2;
BA_ "GenSigStartValue" SG_ 992 FRM_21_ObjAccelX_36 2500;
BA_ "GenSigASIL"  SG_ 992 FRM_21_ObjAccelX_36 2;
BA_ "GenSigStartValue" SG_ 992 FRM_21_ObjAccelY_36 2500;
BA_ "GenSigASIL"  SG_ 992 FRM_21_ObjAccelY_36 2;
BA_ "GenSigASIL"  SG_ 992 FRM_21_ObjClosestDistXStd_36 2;
BA_ "GenSigASIL"  SG_ 992 FRM_21_ObjClosestDistYStd_36 2;
BA_ "GenSigASIL"  SG_ 992 FRM_21_ObjRelVelXStd_36 2;
BA_ "GenSigASIL"  SG_ 992 FRM_21_ObjRelVelYStd_36 2;
BA_ "GenSigASIL"  SG_ 992 FRM_21_ObjRelAccelXStd_36 2;
BA_ "GenSigASIL"  SG_ 992 FRM_21_ObjRelAccelYStd_36 2;
BA_ "GenSigASIL"  SG_ 992 FRM_21_ObjExistProb_36 2;
BA_ "GenSigASIL"  SG_ 992 FRM_21_ObjType_36 2;
BA_ "GenSigASIL"  SG_ 992 FRM_21_ObjTypeConf_36 2;
BA_ "GenSigASIL"  SG_ 992 FRM_21_ObjTrackSts_36 2;
BA_ "GenSigASIL"  SG_ 992 FRM_21_ObjMotionSts_36 2;
BA_ "GenSigASIL"  SG_ 992 FRM_21_ObjMotionDirection_36 2;
BA_ "GenSigASIL"  SG_ 992 FRM_21_ObjCenterDistX_36 2;
BA_ "GenSigStartValue" SG_ 992 FRM_21_ObjCenterDistY_36 10000;
BA_ "GenSigASIL"  SG_ 992 FRM_21_ObjCenterDistY_36 2;
BA_ "GenSigASIL"  SG_ 992 FRM_21_ObjLength_36 2;
BA_ "GenSigASIL"  SG_ 992 FRM_21_ObjWidth_36 2;
BA_ "GenSigASIL"  SG_ 992 FRM_21_ObjElevnSts_36 2;
BA_ "GenSigASIL"  SG_ 992 FRM_21_ObjElevnStsConf_36 2;
BA_ "GenSigStartValue" SG_ 992 FRM_21_ObjHeading_36 1800;
BA_ "GenSigASIL"  SG_ 992 FRM_21_ObjHeading_36 2;
BA_ "GenSigASIL"  SG_ 992 FRM_21_ObjID_37 2;
BA_ "GenSigASIL"  SG_ 992 FRM_21_ObjClosestDistX_37 2;
BA_ "GenSigStartValue" SG_ 992 FRM_21_ObjClosestDistY_37 10000;
BA_ "GenSigASIL"  SG_ 992 FRM_21_ObjClosestDistY_37 2;
BA_ "GenSigStartValue" SG_ 992 FRM_21_ObjRelVelX_37 10000;
BA_ "GenSigASIL"  SG_ 992 FRM_21_ObjRelVelX_37 2;
BA_ "GenSigStartValue" SG_ 992 FRM_21_ObjRelVelY_37 10000;
BA_ "GenSigASIL"  SG_ 992 FRM_21_ObjRelVelY_37 2;
BA_ "GenSigStartValue" SG_ 992 FRM_21_ObjAccelX_37 2500;
BA_ "GenSigASIL"  SG_ 992 FRM_21_ObjAccelX_37 2;
BA_ "GenSigStartValue" SG_ 992 FRM_21_ObjAccelY_37 2500;
BA_ "GenSigASIL"  SG_ 992 FRM_21_ObjAccelY_37 2;
BA_ "GenSigASIL"  SG_ 992 FRM_21_ObjClosestDistXStd_37 2;
BA_ "GenSigASIL"  SG_ 992 FRM_21_ObjClosestDistYStd_37 2;
BA_ "GenSigASIL"  SG_ 992 FRM_21_ObjRelVelXStd_37 2;
BA_ "GenSigASIL"  SG_ 992 FRM_21_ObjRelVelYStd_37 2;
BA_ "GenSigASIL"  SG_ 992 FRM_21_ObjRelAccelXStd_37 2;
BA_ "GenSigASIL"  SG_ 992 FRM_21_ObjRelAccelYStd_37 2;
BA_ "GenSigASIL"  SG_ 992 FRM_21_ObjExistProb_37 2;
BA_ "GenSigASIL"  SG_ 992 FRM_21_ObjType_37 2;
BA_ "GenSigASIL"  SG_ 992 FRM_21_ObjTypeConf_37 2;
BA_ "GenSigASIL"  SG_ 992 FRM_21_ObjTrackSts_37 2;
BA_ "GenSigASIL"  SG_ 992 FRM_21_ObjMotionSts_37 2;
BA_ "GenSigASIL"  SG_ 992 FRM_21_ObjMotionDirection_37 2;
BA_ "GenSigASIL"  SG_ 992 FRM_21_ObjCenterDistX_37 2;
BA_ "GenSigStartValue" SG_ 992 FRM_21_ObjCenterDistY_37 10000;
BA_ "GenSigASIL"  SG_ 992 FRM_21_ObjCenterDistY_37 2;
BA_ "GenSigASIL"  SG_ 992 FRM_21_ObjLength_37 2;
BA_ "GenSigASIL"  SG_ 992 FRM_21_ObjWidth_37 2;
BA_ "GenSigASIL"  SG_ 992 FRM_21_ObjElevnSts_37 2;
BA_ "GenSigASIL"  SG_ 992 FRM_21_ObjElevnStsConf_37 2;
BA_ "GenSigStartValue" SG_ 992 FRM_21_ObjHeading_37 1800;
BA_ "GenSigASIL"  SG_ 992 FRM_21_ObjHeading_37 2;
BA_ "GenMsgILSupport" BO_ 993 1;
BA_ "GenMsgCycleTime" BO_ 993 50;
BA_ "GenSigASIL"  SG_ 993 FRM_22_CRC 5;
BA_ "GenSigASIL"  SG_ 993 FRM_22_RollgCntr 5;
BA_ "GenSigASIL"  SG_ 993 FRM_22_ObjBlockCounter 2;
BA_ "GenSigASIL"  SG_ 993 FRM_22_ObjID_38 2;
BA_ "GenSigASIL"  SG_ 993 FRM_22_ObjClosestDistX_38 2;
BA_ "GenSigStartValue" SG_ 993 FRM_22_ObjClosestDistY_38 10000;
BA_ "GenSigASIL"  SG_ 993 FRM_22_ObjClosestDistY_38 2;
BA_ "GenSigStartValue" SG_ 993 FRM_22_ObjRelVelX_38 10000;
BA_ "GenSigASIL"  SG_ 993 FRM_22_ObjRelVelX_38 2;
BA_ "GenSigStartValue" SG_ 993 FRM_22_ObjRelVelY_38 10000;
BA_ "GenSigASIL"  SG_ 993 FRM_22_ObjRelVelY_38 2;
BA_ "GenSigStartValue" SG_ 993 FRM_22_ObjAccelX_38 2500;
BA_ "GenSigASIL"  SG_ 993 FRM_22_ObjAccelX_38 2;
BA_ "GenSigStartValue" SG_ 993 FRM_22_ObjAccelY_38 2500;
BA_ "GenSigASIL"  SG_ 993 FRM_22_ObjAccelY_38 2;
BA_ "GenSigASIL"  SG_ 993 FRM_22_ObjClosestDistXStd_38 2;
BA_ "GenSigASIL"  SG_ 993 FRM_22_ObjClosestDistYStd_38 2;
BA_ "GenSigASIL"  SG_ 993 FRM_22_ObjRelVelXStd_38 2;
BA_ "GenSigASIL"  SG_ 993 FRM_22_ObjRelVelYStd_38 2;
BA_ "GenSigASIL"  SG_ 993 FRM_22_ObjRelAccelXStd_38 2;
BA_ "GenSigASIL"  SG_ 993 FRM_22_ObjRelAccelYStd_38 2;
BA_ "GenSigASIL"  SG_ 993 FRM_22_ObjExistProb_38 2;
BA_ "GenSigASIL"  SG_ 993 FRM_22_ObjType_38 2;
BA_ "GenSigASIL"  SG_ 993 FRM_22_ObjTypeConf_38 2;
BA_ "GenSigASIL"  SG_ 993 FRM_22_ObjTrackSts_38 2;
BA_ "GenSigASIL"  SG_ 993 FRM_22_ObjMotionSts_38 2;
BA_ "GenSigASIL"  SG_ 993 FRM_22_ObjMotionDirection_38 2;
BA_ "GenSigASIL"  SG_ 993 FRM_22_ObjCenterDistX_38 2;
BA_ "GenSigStartValue" SG_ 993 FRM_22_ObjCenterDistY_38 10000;
BA_ "GenSigASIL"  SG_ 993 FRM_22_ObjCenterDistY_38 2;
BA_ "GenSigASIL"  SG_ 993 FRM_22_ObjLength_38 2;
BA_ "GenSigASIL"  SG_ 993 FRM_22_ObjWidth_38 2;
BA_ "GenSigASIL"  SG_ 993 FRM_22_ObjElevnSts_38 2;
BA_ "GenSigASIL"  SG_ 993 FRM_22_ObjElevnStsConf_38 2;
BA_ "GenSigStartValue" SG_ 993 FRM_22_ObjHeading_38 1800;
BA_ "GenSigASIL"  SG_ 993 FRM_22_ObjHeading_38 2;
BA_ "GenSigASIL"  SG_ 993 FRM_22_ObjID_39 2;
BA_ "GenSigASIL"  SG_ 993 FRM_22_ObjClosestDistX_39 2;
BA_ "GenSigStartValue" SG_ 993 FRM_22_ObjClosestDistY_39 10000;
BA_ "GenSigASIL"  SG_ 993 FRM_22_ObjClosestDistY_39 2;
BA_ "GenSigStartValue" SG_ 993 FRM_22_ObjRelVelX_39 10000;
BA_ "GenSigASIL"  SG_ 993 FRM_22_ObjRelVelX_39 2;
BA_ "GenSigStartValue" SG_ 993 FRM_22_ObjRelVelY_39 10000;
BA_ "GenSigASIL"  SG_ 993 FRM_22_ObjRelVelY_39 2;
BA_ "GenSigStartValue" SG_ 993 FRM_22_ObjAccelX_39 2500;
BA_ "GenSigASIL"  SG_ 993 FRM_22_ObjAccelX_39 2;
BA_ "GenSigStartValue" SG_ 993 FRM_22_ObjAccelY_39 2500;
BA_ "GenSigASIL"  SG_ 993 FRM_22_ObjAccelY_39 2;
BA_ "GenSigASIL"  SG_ 993 FRM_22_ObjClosestDistXStd_39 2;
BA_ "GenSigASIL"  SG_ 993 FRM_22_ObjClosestDistYStd_39 2;
BA_ "GenSigASIL"  SG_ 993 FRM_22_ObjRelVelXStd_39 2;
BA_ "GenSigASIL"  SG_ 993 FRM_22_ObjRelVelYStd_39 2;
BA_ "GenSigASIL"  SG_ 993 FRM_22_ObjRelAccelXStd_39 2;
BA_ "GenSigASIL"  SG_ 993 FRM_22_ObjRelAccelYStd_39 2;
BA_ "GenSigASIL"  SG_ 993 FRM_22_ObjExistProb_39 2;
BA_ "GenSigASIL"  SG_ 993 FRM_22_ObjType_39 2;
BA_ "GenSigASIL"  SG_ 993 FRM_22_ObjTypeConf_39 2;
BA_ "GenSigASIL"  SG_ 993 FRM_22_ObjTrackSts_39 2;
BA_ "GenSigASIL"  SG_ 993 FRM_22_ObjMotionSts_39 2;
BA_ "GenSigASIL"  SG_ 993 FRM_22_ObjMotionDirection_39 2;
BA_ "GenSigASIL"  SG_ 993 FRM_22_ObjCenterDistX_39 2;
BA_ "GenSigStartValue" SG_ 993 FRM_22_ObjCenterDistY_39 10000;
BA_ "GenSigASIL"  SG_ 993 FRM_22_ObjCenterDistY_39 2;
BA_ "GenSigASIL"  SG_ 993 FRM_22_ObjLength_39 2;
BA_ "GenSigASIL"  SG_ 993 FRM_22_ObjWidth_39 2;
BA_ "GenSigASIL"  SG_ 993 FRM_22_ObjElevnSts_39 2;
BA_ "GenSigASIL"  SG_ 993 FRM_22_ObjElevnStsConf_39 2;
BA_ "GenSigStartValue" SG_ 993 FRM_22_ObjHeading_39 1800;
BA_ "GenSigASIL"  SG_ 993 FRM_22_ObjHeading_39 2;
BA_ "GenMsgILSupport" BO_ 994 1;
BA_ "GenMsgCycleTime" BO_ 994 50;
BA_ "GenSigASIL"  SG_ 994 FRM_23_CRC 5;
BA_ "GenSigASIL"  SG_ 994 FRM_23_RollgCntr 5;
BA_ "GenSigASIL"  SG_ 994 FRM_23_DetnBlockCounter 2;
BA_ "GenSigASIL"  SG_ 994 FRM_23_DetnMotionSts_000 2;
BA_ "GenSigASIL"  SG_ 994 FRM_23_DetnRngRadial_000 2;
BA_ "GenSigStartValue" SG_ 994 FRM_23_DetnAziAngle_000 900;
BA_ "GenSigASIL"  SG_ 994 FRM_23_DetnAziAngle_000 2;
BA_ "GenSigStartValue" SG_ 994 FRM_23_DetnElevnAngle_000 100;
BA_ "GenSigASIL"  SG_ 994 FRM_23_DetnElevnAngle_000 2;
BA_ "GenSigStartValue" SG_ 994 FRM_23_DetnRelVelRadial_000 10000;
BA_ "GenSigASIL"  SG_ 994 FRM_23_DetnRelVelRadial_000 2;
BA_ "GenSigASIL"  SG_ 994 FRM_23_DetnSNR_000 2;
BA_ "GenSigStartValue" SG_ 994 FRM_23_DetnRCS_000 5000;
BA_ "GenSigASIL"  SG_ 994 FRM_23_DetnRCS_000 2;
BA_ "GenSigASIL"  SG_ 994 FRM_23_DetnQuality_000 2;
BA_ "GenSigASIL"  SG_ 994 FRM_23_DetnMotionSts_001 2;
BA_ "GenSigASIL"  SG_ 994 FRM_23_DetnRngRadial_001 2;
BA_ "GenSigStartValue" SG_ 994 FRM_23_DetnAziAngle_001 900;
BA_ "GenSigASIL"  SG_ 994 FRM_23_DetnAziAngle_001 2;
BA_ "GenSigStartValue" SG_ 994 FRM_23_DetnElevnAngle_001 100;
BA_ "GenSigASIL"  SG_ 994 FRM_23_DetnElevnAngle_001 2;
BA_ "GenSigStartValue" SG_ 994 FRM_23_DetnRelVelRadial_001 10000;
BA_ "GenSigASIL"  SG_ 994 FRM_23_DetnRelVelRadial_001 2;
BA_ "GenSigASIL"  SG_ 994 FRM_23_DetnSNR_001 2;
BA_ "GenSigStartValue" SG_ 994 FRM_23_DetnRCS_001 5000;
BA_ "GenSigASIL"  SG_ 994 FRM_23_DetnRCS_001 2;
BA_ "GenSigASIL"  SG_ 994 FRM_23_DetnQuality_001 2;
BA_ "GenSigASIL"  SG_ 994 FRM_23_DetnMotionSts_002 2;
BA_ "GenSigASIL"  SG_ 994 FRM_23_DetnRngRadial_002 2;
BA_ "GenSigStartValue" SG_ 994 FRM_23_DetnAziAngle_002 900;
BA_ "GenSigASIL"  SG_ 994 FRM_23_DetnAziAngle_002 2;
BA_ "GenSigStartValue" SG_ 994 FRM_23_DetnElevnAngle_002 100;
BA_ "GenSigASIL"  SG_ 994 FRM_23_DetnElevnAngle_002 2;
BA_ "GenSigStartValue" SG_ 994 FRM_23_DetnRelVelRadial_002 10000;
BA_ "GenSigASIL"  SG_ 994 FRM_23_DetnRelVelRadial_002 2;
BA_ "GenSigASIL"  SG_ 994 FRM_23_DetnSNR_002 2;
BA_ "GenSigStartValue" SG_ 994 FRM_23_DetnRCS_002 5000;
BA_ "GenSigASIL"  SG_ 994 FRM_23_DetnRCS_002 2;
BA_ "GenSigASIL"  SG_ 994 FRM_23_DetnQuality_002 2;
BA_ "GenSigASIL"  SG_ 994 FRM_23_DetnMotionSts_003 2;
BA_ "GenSigASIL"  SG_ 994 FRM_23_DetnRngRadial_003 2;
BA_ "GenSigStartValue" SG_ 994 FRM_23_DetnAziAngle_003 900;
BA_ "GenSigASIL"  SG_ 994 FRM_23_DetnAziAngle_003 2;
BA_ "GenSigStartValue" SG_ 994 FRM_23_DetnElevnAngle_003 100;
BA_ "GenSigASIL"  SG_ 994 FRM_23_DetnElevnAngle_003 2;
BA_ "GenSigStartValue" SG_ 994 FRM_23_DetnRelVelRadial_003 10000;
BA_ "GenSigASIL"  SG_ 994 FRM_23_DetnRelVelRadial_003 2;
BA_ "GenSigASIL"  SG_ 994 FRM_23_DetnSNR_003 2;
BA_ "GenSigStartValue" SG_ 994 FRM_23_DetnRCS_003 5000;
BA_ "GenSigASIL"  SG_ 994 FRM_23_DetnRCS_003 2;
BA_ "GenSigASIL"  SG_ 994 FRM_23_DetnQuality_003 2;
BA_ "GenSigASIL"  SG_ 994 FRM_23_DetnMotionSts_004 2;
BA_ "GenSigASIL"  SG_ 994 FRM_23_DetnRngRadial_004 2;
BA_ "GenSigStartValue" SG_ 994 FRM_23_DetnAziAngle_004 900;
BA_ "GenSigASIL"  SG_ 994 FRM_23_DetnAziAngle_004 2;
BA_ "GenSigStartValue" SG_ 994 FRM_23_DetnElevnAngle_004 100;
BA_ "GenSigASIL"  SG_ 994 FRM_23_DetnElevnAngle_004 2;
BA_ "GenSigStartValue" SG_ 994 FRM_23_DetnRelVelRadial_004 10000;
BA_ "GenSigASIL"  SG_ 994 FRM_23_DetnRelVelRadial_004 2;
BA_ "GenSigASIL"  SG_ 994 FRM_23_DetnSNR_004 2;
BA_ "GenSigStartValue" SG_ 994 FRM_23_DetnRCS_004 5000;
BA_ "GenSigASIL"  SG_ 994 FRM_23_DetnRCS_004 2;
BA_ "GenSigASIL"  SG_ 994 FRM_23_DetnQuality_004 2;
BA_ "GenSigASIL"  SG_ 994 FRM_23_DetnMotionSts_005 2;
BA_ "GenSigASIL"  SG_ 994 FRM_23_DetnRngRadial_005 2;
BA_ "GenSigStartValue" SG_ 994 FRM_23_DetnAziAngle_005 900;
BA_ "GenSigASIL"  SG_ 994 FRM_23_DetnAziAngle_005 2;
BA_ "GenSigStartValue" SG_ 994 FRM_23_DetnElevnAngle_005 100;
BA_ "GenSigASIL"  SG_ 994 FRM_23_DetnElevnAngle_005 2;
BA_ "GenSigStartValue" SG_ 994 FRM_23_DetnRelVelRadial_005 10000;
BA_ "GenSigASIL"  SG_ 994 FRM_23_DetnRelVelRadial_005 2;
BA_ "GenSigASIL"  SG_ 994 FRM_23_DetnSNR_005 2;
BA_ "GenSigStartValue" SG_ 994 FRM_23_DetnRCS_005 5000;
BA_ "GenSigASIL"  SG_ 994 FRM_23_DetnRCS_005 2;
BA_ "GenSigASIL"  SG_ 994 FRM_23_DetnQuality_005 2;
BA_ "GenMsgILSupport" BO_ 995 1;
BA_ "GenMsgCycleTime" BO_ 995 50;
BA_ "GenSigASIL"  SG_ 995 FRM_24_CRC 5;
BA_ "GenSigASIL"  SG_ 995 FRM_24_RollgCntr 5;
BA_ "GenSigASIL"  SG_ 995 FRM_24_DetnBlockCounter 2;
BA_ "GenSigASIL"  SG_ 995 FRM_24_DetnMotionSts_006 2;
BA_ "GenSigASIL"  SG_ 995 FRM_24_DetnRngRadial_006 2;
BA_ "GenSigStartValue" SG_ 995 FRM_24_DetnAziAngle_006 900;
BA_ "GenSigASIL"  SG_ 995 FRM_24_DetnAziAngle_006 2;
BA_ "GenSigStartValue" SG_ 995 FRM_24_DetnElevnAngle_006 100;
BA_ "GenSigASIL"  SG_ 995 FRM_24_DetnElevnAngle_006 2;
BA_ "GenSigStartValue" SG_ 995 FRM_24_DetnRelVelRadial_006 10000;
BA_ "GenSigASIL"  SG_ 995 FRM_24_DetnRelVelRadial_006 2;
BA_ "GenSigASIL"  SG_ 995 FRM_24_DetnSNR_006 2;
BA_ "GenSigStartValue" SG_ 995 FRM_24_DetnRCS_006 5000;
BA_ "GenSigASIL"  SG_ 995 FRM_24_DetnRCS_006 2;
BA_ "GenSigASIL"  SG_ 995 FRM_24_DetnQuality_006 2;
BA_ "GenSigASIL"  SG_ 995 FRM_24_DetnMotionSts_007 2;
BA_ "GenSigASIL"  SG_ 995 FRM_24_DetnRngRadial_007 2;
BA_ "GenSigStartValue" SG_ 995 FRM_24_DetnAziAngle_007 900;
BA_ "GenSigASIL"  SG_ 995 FRM_24_DetnAziAngle_007 2;
BA_ "GenSigStartValue" SG_ 995 FRM_24_DetnElevnAngle_007 100;
BA_ "GenSigASIL"  SG_ 995 FRM_24_DetnElevnAngle_007 2;
BA_ "GenSigStartValue" SG_ 995 FRM_24_DetnRelVelRadial_007 10000;
BA_ "GenSigASIL"  SG_ 995 FRM_24_DetnRelVelRadial_007 2;
BA_ "GenSigASIL"  SG_ 995 FRM_24_DetnSNR_007 2;
BA_ "GenSigStartValue" SG_ 995 FRM_24_DetnRCS_007 5000;
BA_ "GenSigASIL"  SG_ 995 FRM_24_DetnRCS_007 2;
BA_ "GenSigASIL"  SG_ 995 FRM_24_DetnQuality_007 2;
BA_ "GenSigASIL"  SG_ 995 FRM_24_DetnMotionSts_008 2;
BA_ "GenSigASIL"  SG_ 995 FRM_24_DetnRngRadial_008 2;
BA_ "GenSigStartValue" SG_ 995 FRM_24_DetnAziAngle_008 900;
BA_ "GenSigASIL"  SG_ 995 FRM_24_DetnAziAngle_008 2;
BA_ "GenSigStartValue" SG_ 995 FRM_24_DetnElevnAngle_008 100;
BA_ "GenSigASIL"  SG_ 995 FRM_24_DetnElevnAngle_008 2;
BA_ "GenSigStartValue" SG_ 995 FRM_24_DetnRelVelRadial_008 10000;
BA_ "GenSigASIL"  SG_ 995 FRM_24_DetnRelVelRadial_008 2;
BA_ "GenSigASIL"  SG_ 995 FRM_24_DetnSNR_008 2;
BA_ "GenSigStartValue" SG_ 995 FRM_24_DetnRCS_008 5000;
BA_ "GenSigASIL"  SG_ 995 FRM_24_DetnRCS_008 2;
BA_ "GenSigASIL"  SG_ 995 FRM_24_DetnQuality_008 2;
BA_ "GenSigASIL"  SG_ 995 FRM_24_DetnMotionSts_009 2;
BA_ "GenSigASIL"  SG_ 995 FRM_24_DetnRngRadial_009 2;
BA_ "GenSigStartValue" SG_ 995 FRM_24_DetnAziAngle_009 900;
BA_ "GenSigASIL"  SG_ 995 FRM_24_DetnAziAngle_009 2;
BA_ "GenSigStartValue" SG_ 995 FRM_24_DetnElevnAngle_009 100;
BA_ "GenSigASIL"  SG_ 995 FRM_24_DetnElevnAngle_009 2;
BA_ "GenSigStartValue" SG_ 995 FRM_24_DetnRelVelRadial_009 10000;
BA_ "GenSigASIL"  SG_ 995 FRM_24_DetnRelVelRadial_009 2;
BA_ "GenSigASIL"  SG_ 995 FRM_24_DetnSNR_009 2;
BA_ "GenSigStartValue" SG_ 995 FRM_24_DetnRCS_009 5000;
BA_ "GenSigASIL"  SG_ 995 FRM_24_DetnRCS_009 2;
BA_ "GenSigASIL"  SG_ 995 FRM_24_DetnQuality_009 2;
BA_ "GenSigASIL"  SG_ 995 FRM_24_DetnMotionSts_010 2;
BA_ "GenSigASIL"  SG_ 995 FRM_24_DetnRngRadial_010 2;
BA_ "GenSigStartValue" SG_ 995 FRM_24_DetnAziAngle_010 900;
BA_ "GenSigASIL"  SG_ 995 FRM_24_DetnAziAngle_010 2;
BA_ "GenSigStartValue" SG_ 995 FRM_24_DetnElevnAngle_010 100;
BA_ "GenSigASIL"  SG_ 995 FRM_24_DetnElevnAngle_010 2;
BA_ "GenSigStartValue" SG_ 995 FRM_24_DetnRelVelRadial_010 10000;
BA_ "GenSigASIL"  SG_ 995 FRM_24_DetnRelVelRadial_010 2;
BA_ "GenSigASIL"  SG_ 995 FRM_24_DetnSNR_010 2;
BA_ "GenSigStartValue" SG_ 995 FRM_24_DetnRCS_010 5000;
BA_ "GenSigASIL"  SG_ 995 FRM_24_DetnRCS_010 2;
BA_ "GenSigASIL"  SG_ 995 FRM_24_DetnQuality_010 2;
BA_ "GenSigASIL"  SG_ 995 FRM_24_DetnMotionSts_011 2;
BA_ "GenSigASIL"  SG_ 995 FRM_24_DetnRngRadial_011 2;
BA_ "GenSigStartValue" SG_ 995 FRM_24_DetnAziAngle_011 900;
BA_ "GenSigASIL"  SG_ 995 FRM_24_DetnAziAngle_011 2;
BA_ "GenSigStartValue" SG_ 995 FRM_24_DetnElevnAngle_011 100;
BA_ "GenSigASIL"  SG_ 995 FRM_24_DetnElevnAngle_011 2;
BA_ "GenSigStartValue" SG_ 995 FRM_24_DetnRelVelRadial_011 10000;
BA_ "GenSigASIL"  SG_ 995 FRM_24_DetnRelVelRadial_011 2;
BA_ "GenSigASIL"  SG_ 995 FRM_24_DetnSNR_011 2;
BA_ "GenSigStartValue" SG_ 995 FRM_24_DetnRCS_011 5000;
BA_ "GenSigASIL"  SG_ 995 FRM_24_DetnRCS_011 2;
BA_ "GenSigASIL"  SG_ 995 FRM_24_DetnQuality_011 2;
BA_ "GenMsgILSupport" BO_ 996 1;
BA_ "GenMsgCycleTime" BO_ 996 50;
BA_ "GenSigASIL"  SG_ 996 FRM_25_CRC 5;
BA_ "GenSigASIL"  SG_ 996 FRM_25_RollgCntr 5;
BA_ "GenSigASIL"  SG_ 996 FRM_25_DetnBlockCounter 2;
BA_ "GenSigASIL"  SG_ 996 FRM_25_DetnMotionSts_012 2;
BA_ "GenSigASIL"  SG_ 996 FRM_25_DetnRngRadial_012 2;
BA_ "GenSigStartValue" SG_ 996 FRM_25_DetnAziAngle_012 900;
BA_ "GenSigASIL"  SG_ 996 FRM_25_DetnAziAngle_012 2;
BA_ "GenSigStartValue" SG_ 996 FRM_25_DetnElevnAngle_012 100;
BA_ "GenSigASIL"  SG_ 996 FRM_25_DetnElevnAngle_012 2;
BA_ "GenSigStartValue" SG_ 996 FRM_25_DetnRelVelRadial_012 10000;
BA_ "GenSigASIL"  SG_ 996 FRM_25_DetnRelVelRadial_012 2;
BA_ "GenSigASIL"  SG_ 996 FRM_25_DetnSNR_012 2;
BA_ "GenSigStartValue" SG_ 996 FRM_25_DetnRCS_012 5000;
BA_ "GenSigASIL"  SG_ 996 FRM_25_DetnRCS_012 2;
BA_ "GenSigASIL"  SG_ 996 FRM_25_DetnQuality_012 2;
BA_ "GenSigASIL"  SG_ 996 FRM_25_DetnMotionSts_013 2;
BA_ "GenSigASIL"  SG_ 996 FRM_25_DetnRngRadial_013 2;
BA_ "GenSigStartValue" SG_ 996 FRM_25_DetnAziAngle_013 900;
BA_ "GenSigASIL"  SG_ 996 FRM_25_DetnAziAngle_013 2;
BA_ "GenSigStartValue" SG_ 996 FRM_25_DetnElevnAngle_013 100;
BA_ "GenSigASIL"  SG_ 996 FRM_25_DetnElevnAngle_013 2;
BA_ "GenSigStartValue" SG_ 996 FRM_25_DetnRelVelRadial_013 10000;
BA_ "GenSigASIL"  SG_ 996 FRM_25_DetnRelVelRadial_013 2;
BA_ "GenSigASIL"  SG_ 996 FRM_25_DetnSNR_013 2;
BA_ "GenSigStartValue" SG_ 996 FRM_25_DetnRCS_013 5000;
BA_ "GenSigASIL"  SG_ 996 FRM_25_DetnRCS_013 2;
BA_ "GenSigASIL"  SG_ 996 FRM_25_DetnQuality_013 2;
BA_ "GenSigASIL"  SG_ 996 FRM_25_DetnMotionSts_014 2;
BA_ "GenSigASIL"  SG_ 996 FRM_25_DetnRngRadial_014 2;
BA_ "GenSigStartValue" SG_ 996 FRM_25_DetnAziAngle_014 900;
BA_ "GenSigASIL"  SG_ 996 FRM_25_DetnAziAngle_014 2;
BA_ "GenSigStartValue" SG_ 996 FRM_25_DetnElevnAngle_014 100;
BA_ "GenSigASIL"  SG_ 996 FRM_25_DetnElevnAngle_014 2;
BA_ "GenSigStartValue" SG_ 996 FRM_25_DetnRelVelRadial_014 10000;
BA_ "GenSigASIL"  SG_ 996 FRM_25_DetnRelVelRadial_014 2;
BA_ "GenSigASIL"  SG_ 996 FRM_25_DetnSNR_014 2;
BA_ "GenSigStartValue" SG_ 996 FRM_25_DetnRCS_014 5000;
BA_ "GenSigASIL"  SG_ 996 FRM_25_DetnRCS_014 2;
BA_ "GenSigASIL"  SG_ 996 FRM_25_DetnQuality_014 2;
BA_ "GenSigASIL"  SG_ 996 FRM_25_DetnMotionSts_015 2;
BA_ "GenSigASIL"  SG_ 996 FRM_25_DetnRngRadial_015 2;
BA_ "GenSigStartValue" SG_ 996 FRM_25_DetnAziAngle_015 900;
BA_ "GenSigASIL"  SG_ 996 FRM_25_DetnAziAngle_015 2;
BA_ "GenSigStartValue" SG_ 996 FRM_25_DetnElevnAngle_015 100;
BA_ "GenSigASIL"  SG_ 996 FRM_25_DetnElevnAngle_015 2;
BA_ "GenSigStartValue" SG_ 996 FRM_25_DetnRelVelRadial_015 10000;
BA_ "GenSigASIL"  SG_ 996 FRM_25_DetnRelVelRadial_015 2;
BA_ "GenSigASIL"  SG_ 996 FRM_25_DetnSNR_015 2;
BA_ "GenSigStartValue" SG_ 996 FRM_25_DetnRCS_015 5000;
BA_ "GenSigASIL"  SG_ 996 FRM_25_DetnRCS_015 2;
BA_ "GenSigASIL"  SG_ 996 FRM_25_DetnQuality_015 2;
BA_ "GenSigASIL"  SG_ 996 FRM_25_DetnMotionSts_016 2;
BA_ "GenSigASIL"  SG_ 996 FRM_25_DetnRngRadial_016 2;
BA_ "GenSigStartValue" SG_ 996 FRM_25_DetnAziAngle_016 900;
BA_ "GenSigASIL"  SG_ 996 FRM_25_DetnAziAngle_016 2;
BA_ "GenSigStartValue" SG_ 996 FRM_25_DetnElevnAngle_016 100;
BA_ "GenSigASIL"  SG_ 996 FRM_25_DetnElevnAngle_016 2;
BA_ "GenSigStartValue" SG_ 996 FRM_25_DetnRelVelRadial_016 10000;
BA_ "GenSigASIL"  SG_ 996 FRM_25_DetnRelVelRadial_016 2;
BA_ "GenSigASIL"  SG_ 996 FRM_25_DetnSNR_016 2;
BA_ "GenSigStartValue" SG_ 996 FRM_25_DetnRCS_016 5000;
BA_ "GenSigASIL"  SG_ 996 FRM_25_DetnRCS_016 2;
BA_ "GenSigASIL"  SG_ 996 FRM_25_DetnQuality_016 2;
BA_ "GenSigASIL"  SG_ 996 FRM_25_DetnMotionSts_017 2;
BA_ "GenSigASIL"  SG_ 996 FRM_25_DetnRngRadial_017 2;
BA_ "GenSigStartValue" SG_ 996 FRM_25_DetnAziAngle_017 900;
BA_ "GenSigASIL"  SG_ 996 FRM_25_DetnAziAngle_017 2;
BA_ "GenSigStartValue" SG_ 996 FRM_25_DetnElevnAngle_017 100;
BA_ "GenSigASIL"  SG_ 996 FRM_25_DetnElevnAngle_017 2;
BA_ "GenSigStartValue" SG_ 996 FRM_25_DetnRelVelRadial_017 10000;
BA_ "GenSigASIL"  SG_ 996 FRM_25_DetnRelVelRadial_017 2;
BA_ "GenSigASIL"  SG_ 996 FRM_25_DetnSNR_017 2;
BA_ "GenSigStartValue" SG_ 996 FRM_25_DetnRCS_017 5000;
BA_ "GenSigASIL"  SG_ 996 FRM_25_DetnRCS_017 2;
BA_ "GenSigASIL"  SG_ 996 FRM_25_DetnQuality_017 2;
BA_ "GenMsgILSupport" BO_ 997 1;
BA_ "GenMsgCycleTime" BO_ 997 50;
BA_ "GenSigASIL"  SG_ 997 FRM_26_CRC 5;
BA_ "GenSigASIL"  SG_ 997 FRM_26_RollgCntr 5;
BA_ "GenSigASIL"  SG_ 997 FRM_26_DetnBlockCounter 2;
BA_ "GenSigASIL"  SG_ 997 FRM_26_DetnMotionSts_018 2;
BA_ "GenSigASIL"  SG_ 997 FRM_26_DetnRngRadial_018 2;
BA_ "GenSigStartValue" SG_ 997 FRM_26_DetnAziAngle_018 900;
BA_ "GenSigASIL"  SG_ 997 FRM_26_DetnAziAngle_018 2;
BA_ "GenSigStartValue" SG_ 997 FRM_26_DetnElevnAngle_018 100;
BA_ "GenSigASIL"  SG_ 997 FRM_26_DetnElevnAngle_018 2;
BA_ "GenSigStartValue" SG_ 997 FRM_26_DetnRelVelRadial_018 10000;
BA_ "GenSigASIL"  SG_ 997 FRM_26_DetnRelVelRadial_018 2;
BA_ "GenSigASIL"  SG_ 997 FRM_26_DetnSNR_018 2;
BA_ "GenSigStartValue" SG_ 997 FRM_26_DetnRCS_018 5000;
BA_ "GenSigASIL"  SG_ 997 FRM_26_DetnRCS_018 2;
BA_ "GenSigASIL"  SG_ 997 FRM_26_DetnQuality_018 2;
BA_ "GenSigASIL"  SG_ 997 FRM_26_DetnMotionSts_019 2;
BA_ "GenSigASIL"  SG_ 997 FRM_26_DetnRngRadial_019 2;
BA_ "GenSigStartValue" SG_ 997 FRM_26_DetnAziAngle_019 900;
BA_ "GenSigASIL"  SG_ 997 FRM_26_DetnAziAngle_019 2;
BA_ "GenSigStartValue" SG_ 997 FRM_26_DetnElevnAngle_019 100;
BA_ "GenSigASIL"  SG_ 997 FRM_26_DetnElevnAngle_019 2;
BA_ "GenSigStartValue" SG_ 997 FRM_26_DetnRelVelRadial_019 10000;
BA_ "GenSigASIL"  SG_ 997 FRM_26_DetnRelVelRadial_019 2;
BA_ "GenSigASIL"  SG_ 997 FRM_26_DetnSNR_019 2;
BA_ "GenSigStartValue" SG_ 997 FRM_26_DetnRCS_019 5000;
BA_ "GenSigASIL"  SG_ 997 FRM_26_DetnRCS_019 2;
BA_ "GenSigASIL"  SG_ 997 FRM_26_DetnQuality_019 2;
BA_ "GenSigASIL"  SG_ 997 FRM_26_DetnMotionSts_020 2;
BA_ "GenSigASIL"  SG_ 997 FRM_26_DetnRngRadial_020 2;
BA_ "GenSigStartValue" SG_ 997 FRM_26_DetnAziAngle_020 900;
BA_ "GenSigASIL"  SG_ 997 FRM_26_DetnAziAngle_020 2;
BA_ "GenSigStartValue" SG_ 997 FRM_26_DetnElevnAngle_020 100;
BA_ "GenSigASIL"  SG_ 997 FRM_26_DetnElevnAngle_020 2;
BA_ "GenSigStartValue" SG_ 997 FRM_26_DetnRelVelRadial_020 10000;
BA_ "GenSigASIL"  SG_ 997 FRM_26_DetnRelVelRadial_020 2;
BA_ "GenSigASIL"  SG_ 997 FRM_26_DetnSNR_020 2;
BA_ "GenSigStartValue" SG_ 997 FRM_26_DetnRCS_020 5000;
BA_ "GenSigASIL"  SG_ 997 FRM_26_DetnRCS_020 2;
BA_ "GenSigASIL"  SG_ 997 FRM_26_DetnQuality_020 2;
BA_ "GenSigASIL"  SG_ 997 FRM_26_DetnMotionSts_021 2;
BA_ "GenSigASIL"  SG_ 997 FRM_26_DetnRngRadial_021 2;
BA_ "GenSigStartValue" SG_ 997 FRM_26_DetnAziAngle_021 900;
BA_ "GenSigASIL"  SG_ 997 FRM_26_DetnAziAngle_021 2;
BA_ "GenSigStartValue" SG_ 997 FRM_26_DetnElevnAngle_021 100;
BA_ "GenSigASIL"  SG_ 997 FRM_26_DetnElevnAngle_021 2;
BA_ "GenSigStartValue" SG_ 997 FRM_26_DetnRelVelRadial_021 10000;
BA_ "GenSigASIL"  SG_ 997 FRM_26_DetnRelVelRadial_021 2;
BA_ "GenSigASIL"  SG_ 997 FRM_26_DetnSNR_021 2;
BA_ "GenSigStartValue" SG_ 997 FRM_26_DetnRCS_021 5000;
BA_ "GenSigASIL"  SG_ 997 FRM_26_DetnRCS_021 2;
BA_ "GenSigASIL"  SG_ 997 FRM_26_DetnQuality_021 2;
BA_ "GenSigASIL"  SG_ 997 FRM_26_DetnMotionSts_022 2;
BA_ "GenSigASIL"  SG_ 997 FRM_26_DetnRngRadial_022 2;
BA_ "GenSigStartValue" SG_ 997 FRM_26_DetnAziAngle_022 900;
BA_ "GenSigASIL"  SG_ 997 FRM_26_DetnAziAngle_022 2;
BA_ "GenSigStartValue" SG_ 997 FRM_26_DetnElevnAngle_022 100;
BA_ "GenSigASIL"  SG_ 997 FRM_26_DetnElevnAngle_022 2;
BA_ "GenSigStartValue" SG_ 997 FRM_26_DetnRelVelRadial_022 10000;
BA_ "GenSigASIL"  SG_ 997 FRM_26_DetnRelVelRadial_022 2;
BA_ "GenSigASIL"  SG_ 997 FRM_26_DetnSNR_022 2;
BA_ "GenSigStartValue" SG_ 997 FRM_26_DetnRCS_022 5000;
BA_ "GenSigASIL"  SG_ 997 FRM_26_DetnRCS_022 2;
BA_ "GenSigASIL"  SG_ 997 FRM_26_DetnQuality_022 2;
BA_ "GenSigASIL"  SG_ 997 FRM_26_DetnMotionSts_023 2;
BA_ "GenSigASIL"  SG_ 997 FRM_26_DetnRngRadial_023 2;
BA_ "GenSigStartValue" SG_ 997 FRM_26_DetnAziAngle_023 900;
BA_ "GenSigASIL"  SG_ 997 FRM_26_DetnAziAngle_023 2;
BA_ "GenSigStartValue" SG_ 997 FRM_26_DetnElevnAngle_023 100;
BA_ "GenSigASIL"  SG_ 997 FRM_26_DetnElevnAngle_023 2;
BA_ "GenSigStartValue" SG_ 997 FRM_26_DetnRelVelRadial_023 10000;
BA_ "GenSigASIL"  SG_ 997 FRM_26_DetnRelVelRadial_023 2;
BA_ "GenSigASIL"  SG_ 997 FRM_26_DetnSNR_023 2;
BA_ "GenSigStartValue" SG_ 997 FRM_26_DetnRCS_023 5000;
BA_ "GenSigASIL"  SG_ 997 FRM_26_DetnRCS_023 2;
BA_ "GenSigASIL"  SG_ 997 FRM_26_DetnQuality_023 2;
BA_ "GenMsgILSupport" BO_ 998 1;
BA_ "GenMsgCycleTime" BO_ 998 50;
BA_ "GenSigASIL"  SG_ 998 FRM_27_CRC 5;
BA_ "GenSigASIL"  SG_ 998 FRM_27_RollgCntr 5;
BA_ "GenSigASIL"  SG_ 998 FRM_27_DetnBlockCounter 2;
BA_ "GenSigASIL"  SG_ 998 FRM_27_DetnMotionSts_024 2;
BA_ "GenSigASIL"  SG_ 998 FRM_27_DetnRngRadial_024 2;
BA_ "GenSigStartValue" SG_ 998 FRM_27_DetnAziAngle_024 900;
BA_ "GenSigASIL"  SG_ 998 FRM_27_DetnAziAngle_024 2;
BA_ "GenSigStartValue" SG_ 998 FRM_27_DetnElevnAngle_024 100;
BA_ "GenSigASIL"  SG_ 998 FRM_27_DetnElevnAngle_024 2;
BA_ "GenSigStartValue" SG_ 998 FRM_27_DetnRelVelRadial_024 10000;
BA_ "GenSigASIL"  SG_ 998 FRM_27_DetnRelVelRadial_024 2;
BA_ "GenSigASIL"  SG_ 998 FRM_27_DetnSNR_024 2;
BA_ "GenSigStartValue" SG_ 998 FRM_27_DetnRCS_024 5000;
BA_ "GenSigASIL"  SG_ 998 FRM_27_DetnRCS_024 2;
BA_ "GenSigASIL"  SG_ 998 FRM_27_DetnQuality_024 2;
BA_ "GenSigASIL"  SG_ 998 FRM_27_DetnMotionSts_025 2;
BA_ "GenSigASIL"  SG_ 998 FRM_27_DetnRngRadial_025 2;
BA_ "GenSigStartValue" SG_ 998 FRM_27_DetnAziAngle_025 900;
BA_ "GenSigASIL"  SG_ 998 FRM_27_DetnAziAngle_025 2;
BA_ "GenSigStartValue" SG_ 998 FRM_27_DetnElevnAngle_025 100;
BA_ "GenSigASIL"  SG_ 998 FRM_27_DetnElevnAngle_025 2;
BA_ "GenSigStartValue" SG_ 998 FRM_27_DetnRelVelRadial_025 10000;
BA_ "GenSigASIL"  SG_ 998 FRM_27_DetnRelVelRadial_025 2;
BA_ "GenSigASIL"  SG_ 998 FRM_27_DetnSNR_025 2;
BA_ "GenSigStartValue" SG_ 998 FRM_27_DetnRCS_025 5000;
BA_ "GenSigASIL"  SG_ 998 FRM_27_DetnRCS_025 2;
BA_ "GenSigASIL"  SG_ 998 FRM_27_DetnQuality_025 2;
BA_ "GenSigASIL"  SG_ 998 FRM_27_DetnMotionSts_026 2;
BA_ "GenSigASIL"  SG_ 998 FRM_27_DetnRngRadial_026 2;
BA_ "GenSigStartValue" SG_ 998 FRM_27_DetnAziAngle_026 900;
BA_ "GenSigASIL"  SG_ 998 FRM_27_DetnAziAngle_026 2;
BA_ "GenSigStartValue" SG_ 998 FRM_27_DetnElevnAngle_026 100;
BA_ "GenSigASIL"  SG_ 998 FRM_27_DetnElevnAngle_026 2;
BA_ "GenSigStartValue" SG_ 998 FRM_27_DetnRelVelRadial_026 10000;
BA_ "GenSigASIL"  SG_ 998 FRM_27_DetnRelVelRadial_026 2;
BA_ "GenSigASIL"  SG_ 998 FRM_27_DetnSNR_026 2;
BA_ "GenSigStartValue" SG_ 998 FRM_27_DetnRCS_026 5000;
BA_ "GenSigASIL"  SG_ 998 FRM_27_DetnRCS_026 2;
BA_ "GenSigASIL"  SG_ 998 FRM_27_DetnQuality_026 2;
BA_ "GenSigASIL"  SG_ 998 FRM_27_DetnMotionSts_027 2;
BA_ "GenSigASIL"  SG_ 998 FRM_27_DetnRngRadial_027 2;
BA_ "GenSigStartValue" SG_ 998 FRM_27_DetnAziAngle_027 900;
BA_ "GenSigASIL"  SG_ 998 FRM_27_DetnAziAngle_027 2;
BA_ "GenSigStartValue" SG_ 998 FRM_27_DetnElevnAngle_027 100;
BA_ "GenSigASIL"  SG_ 998 FRM_27_DetnElevnAngle_027 2;
BA_ "GenSigStartValue" SG_ 998 FRM_27_DetnRelVelRadial_027 10000;
BA_ "GenSigASIL"  SG_ 998 FRM_27_DetnRelVelRadial_027 2;
BA_ "GenSigASIL"  SG_ 998 FRM_27_DetnSNR_027 2;
BA_ "GenSigStartValue" SG_ 998 FRM_27_DetnRCS_027 5000;
BA_ "GenSigASIL"  SG_ 998 FRM_27_DetnRCS_027 2;
BA_ "GenSigASIL"  SG_ 998 FRM_27_DetnQuality_027 2;
BA_ "GenSigASIL"  SG_ 998 FRM_27_DetnMotionSts_028 2;
BA_ "GenSigASIL"  SG_ 998 FRM_27_DetnRngRadial_028 2;
BA_ "GenSigStartValue" SG_ 998 FRM_27_DetnAziAngle_028 900;
BA_ "GenSigASIL"  SG_ 998 FRM_27_DetnAziAngle_028 2;
BA_ "GenSigStartValue" SG_ 998 FRM_27_DetnElevnAngle_028 100;
BA_ "GenSigASIL"  SG_ 998 FRM_27_DetnElevnAngle_028 2;
BA_ "GenSigStartValue" SG_ 998 FRM_27_DetnRelVelRadial_028 10000;
BA_ "GenSigASIL"  SG_ 998 FRM_27_DetnRelVelRadial_028 2;
BA_ "GenSigASIL"  SG_ 998 FRM_27_DetnSNR_028 2;
BA_ "GenSigStartValue" SG_ 998 FRM_27_DetnRCS_028 5000;
BA_ "GenSigASIL"  SG_ 998 FRM_27_DetnRCS_028 2;
BA_ "GenSigASIL"  SG_ 998 FRM_27_DetnQuality_028 2;
BA_ "GenSigASIL"  SG_ 998 FRM_27_DetnMotionSts_029 2;
BA_ "GenSigASIL"  SG_ 998 FRM_27_DetnRngRadial_029 2;
BA_ "GenSigStartValue" SG_ 998 FRM_27_DetnAziAngle_029 900;
BA_ "GenSigASIL"  SG_ 998 FRM_27_DetnAziAngle_029 2;
BA_ "GenSigStartValue" SG_ 998 FRM_27_DetnElevnAngle_029 100;
BA_ "GenSigASIL"  SG_ 998 FRM_27_DetnElevnAngle_029 2;
BA_ "GenSigStartValue" SG_ 998 FRM_27_DetnRelVelRadial_029 10000;
BA_ "GenSigASIL"  SG_ 998 FRM_27_DetnRelVelRadial_029 2;
BA_ "GenSigASIL"  SG_ 998 FRM_27_DetnSNR_029 2;
BA_ "GenSigStartValue" SG_ 998 FRM_27_DetnRCS_029 5000;
BA_ "GenSigASIL"  SG_ 998 FRM_27_DetnRCS_029 2;
BA_ "GenSigASIL"  SG_ 998 FRM_27_DetnQuality_029 2;
BA_ "GenMsgILSupport" BO_ 999 1;
BA_ "GenMsgCycleTime" BO_ 999 50;
BA_ "GenSigASIL"  SG_ 999 FRM_28_CRC 5;
BA_ "GenSigASIL"  SG_ 999 FRM_28_RollgCntr 5;
BA_ "GenSigASIL"  SG_ 999 FRM_28_DetnBlockCounter 2;
BA_ "GenSigASIL"  SG_ 999 FRM_28_DetnMotionSts_030 2;
BA_ "GenSigASIL"  SG_ 999 FRM_28_DetnRngRadial_030 2;
BA_ "GenSigStartValue" SG_ 999 FRM_28_DetnAziAngle_030 900;
BA_ "GenSigASIL"  SG_ 999 FRM_28_DetnAziAngle_030 2;
BA_ "GenSigStartValue" SG_ 999 FRM_28_DetnElevnAngle_030 100;
BA_ "GenSigASIL"  SG_ 999 FRM_28_DetnElevnAngle_030 2;
BA_ "GenSigStartValue" SG_ 999 FRM_28_DetnRelVelRadial_030 10000;
BA_ "GenSigASIL"  SG_ 999 FRM_28_DetnRelVelRadial_030 2;
BA_ "GenSigASIL"  SG_ 999 FRM_28_DetnSNR_030 2;
BA_ "GenSigStartValue" SG_ 999 FRM_28_DetnRCS_030 5000;
BA_ "GenSigASIL"  SG_ 999 FRM_28_DetnRCS_030 2;
BA_ "GenSigASIL"  SG_ 999 FRM_28_DetnQuality_030 2;
BA_ "GenSigASIL"  SG_ 999 FRM_28_DetnMotionSts_031 2;
BA_ "GenSigASIL"  SG_ 999 FRM_28_DetnRngRadial_031 2;
BA_ "GenSigStartValue" SG_ 999 FRM_28_DetnAziAngle_031 900;
BA_ "GenSigASIL"  SG_ 999 FRM_28_DetnAziAngle_031 2;
BA_ "GenSigStartValue" SG_ 999 FRM_28_DetnElevnAngle_031 100;
BA_ "GenSigASIL"  SG_ 999 FRM_28_DetnElevnAngle_031 2;
BA_ "GenSigStartValue" SG_ 999 FRM_28_DetnRelVelRadial_031 10000;
BA_ "GenSigASIL"  SG_ 999 FRM_28_DetnRelVelRadial_031 2;
BA_ "GenSigASIL"  SG_ 999 FRM_28_DetnSNR_031 2;
BA_ "GenSigStartValue" SG_ 999 FRM_28_DetnRCS_031 5000;
BA_ "GenSigASIL"  SG_ 999 FRM_28_DetnRCS_031 2;
BA_ "GenSigASIL"  SG_ 999 FRM_28_DetnQuality_031 2;
BA_ "GenSigASIL"  SG_ 999 FRM_28_DetnMotionSts_032 2;
BA_ "GenSigASIL"  SG_ 999 FRM_28_DetnRngRadial_032 2;
BA_ "GenSigStartValue" SG_ 999 FRM_28_DetnAziAngle_032 900;
BA_ "GenSigASIL"  SG_ 999 FRM_28_DetnAziAngle_032 2;
BA_ "GenSigStartValue" SG_ 999 FRM_28_DetnElevnAngle_032 100;
BA_ "GenSigASIL"  SG_ 999 FRM_28_DetnElevnAngle_032 2;
BA_ "GenSigStartValue" SG_ 999 FRM_28_DetnRelVelRadial_032 10000;
BA_ "GenSigASIL"  SG_ 999 FRM_28_DetnRelVelRadial_032 2;
BA_ "GenSigASIL"  SG_ 999 FRM_28_DetnSNR_032 2;
BA_ "GenSigStartValue" SG_ 999 FRM_28_DetnRCS_032 5000;
BA_ "GenSigASIL"  SG_ 999 FRM_28_DetnRCS_032 2;
BA_ "GenSigASIL"  SG_ 999 FRM_28_DetnQuality_032 2;
BA_ "GenSigASIL"  SG_ 999 FRM_28_DetnMotionSts_033 2;
BA_ "GenSigASIL"  SG_ 999 FRM_28_DetnRngRadial_033 2;
BA_ "GenSigStartValue" SG_ 999 FRM_28_DetnAziAngle_033 900;
BA_ "GenSigASIL"  SG_ 999 FRM_28_DetnAziAngle_033 2;
BA_ "GenSigStartValue" SG_ 999 FRM_28_DetnElevnAngle_033 100;
BA_ "GenSigASIL"  SG_ 999 FRM_28_DetnElevnAngle_033 2;
BA_ "GenSigStartValue" SG_ 999 FRM_28_DetnRelVelRadial_033 10000;
BA_ "GenSigASIL"  SG_ 999 FRM_28_DetnRelVelRadial_033 2;
BA_ "GenSigASIL"  SG_ 999 FRM_28_DetnSNR_033 2;
BA_ "GenSigStartValue" SG_ 999 FRM_28_DetnRCS_033 5000;
BA_ "GenSigASIL"  SG_ 999 FRM_28_DetnRCS_033 2;
BA_ "GenSigASIL"  SG_ 999 FRM_28_DetnQuality_033 2;
BA_ "GenSigASIL"  SG_ 999 FRM_28_DetnMotionSts_034 2;
BA_ "GenSigASIL"  SG_ 999 FRM_28_DetnRngRadial_034 2;
BA_ "GenSigStartValue" SG_ 999 FRM_28_DetnAziAngle_034 900;
BA_ "GenSigASIL"  SG_ 999 FRM_28_DetnAziAngle_034 2;
BA_ "GenSigStartValue" SG_ 999 FRM_28_DetnElevnAngle_034 100;
BA_ "GenSigASIL"  SG_ 999 FRM_28_DetnElevnAngle_034 2;
BA_ "GenSigStartValue" SG_ 999 FRM_28_DetnRelVelRadial_034 10000;
BA_ "GenSigASIL"  SG_ 999 FRM_28_DetnRelVelRadial_034 2;
BA_ "GenSigASIL"  SG_ 999 FRM_28_DetnSNR_034 2;
BA_ "GenSigStartValue" SG_ 999 FRM_28_DetnRCS_034 5000;
BA_ "GenSigASIL"  SG_ 999 FRM_28_DetnRCS_034 2;
BA_ "GenSigASIL"  SG_ 999 FRM_28_DetnQuality_034 2;
BA_ "GenSigASIL"  SG_ 999 FRM_28_DetnMotionSts_035 2;
BA_ "GenSigASIL"  SG_ 999 FRM_28_DetnRngRadial_035 2;
BA_ "GenSigStartValue" SG_ 999 FRM_28_DetnAziAngle_035 900;
BA_ "GenSigASIL"  SG_ 999 FRM_28_DetnAziAngle_035 2;
BA_ "GenSigStartValue" SG_ 999 FRM_28_DetnElevnAngle_035 100;
BA_ "GenSigASIL"  SG_ 999 FRM_28_DetnElevnAngle_035 2;
BA_ "GenSigStartValue" SG_ 999 FRM_28_DetnRelVelRadial_035 10000;
BA_ "GenSigASIL"  SG_ 999 FRM_28_DetnRelVelRadial_035 2;
BA_ "GenSigASIL"  SG_ 999 FRM_28_DetnSNR_035 2;
BA_ "GenSigStartValue" SG_ 999 FRM_28_DetnRCS_035 5000;
BA_ "GenSigASIL"  SG_ 999 FRM_28_DetnRCS_035 2;
BA_ "GenSigASIL"  SG_ 999 FRM_28_DetnQuality_035 2;
BA_ "GenMsgILSupport" BO_ 1000 1;
BA_ "GenMsgCycleTime" BO_ 1000 50;
BA_ "GenSigASIL"  SG_ 1000 FRM_29_CRC 5;
BA_ "GenSigASIL"  SG_ 1000 FRM_29_RollgCntr 5;
BA_ "GenSigASIL"  SG_ 1000 FRM_29_DetnBlockCounter 2;
BA_ "GenSigASIL"  SG_ 1000 FRM_29_DetnMotionSts_036 2;
BA_ "GenSigASIL"  SG_ 1000 FRM_29_DetnRngRadial_036 2;
BA_ "GenSigStartValue" SG_ 1000 FRM_29_DetnAziAngle_036 900;
BA_ "GenSigASIL"  SG_ 1000 FRM_29_DetnAziAngle_036 2;
BA_ "GenSigStartValue" SG_ 1000 FRM_29_DetnElevnAngle_036 100;
BA_ "GenSigASIL"  SG_ 1000 FRM_29_DetnElevnAngle_036 2;
BA_ "GenSigStartValue" SG_ 1000 FRM_29_DetnRelVelRadial_036 10000;
BA_ "GenSigASIL"  SG_ 1000 FRM_29_DetnRelVelRadial_036 2;
BA_ "GenSigASIL"  SG_ 1000 FRM_29_DetnSNR_036 2;
BA_ "GenSigStartValue" SG_ 1000 FRM_29_DetnRCS_036 5000;
BA_ "GenSigASIL"  SG_ 1000 FRM_29_DetnRCS_036 2;
BA_ "GenSigASIL"  SG_ 1000 FRM_29_DetnQuality_036 2;
BA_ "GenSigASIL"  SG_ 1000 FRM_29_DetnMotionSts_037 2;
BA_ "GenSigASIL"  SG_ 1000 FRM_29_DetnRngRadial_037 2;
BA_ "GenSigStartValue" SG_ 1000 FRM_29_DetnAziAngle_037 900;
BA_ "GenSigASIL"  SG_ 1000 FRM_29_DetnAziAngle_037 2;
BA_ "GenSigStartValue" SG_ 1000 FRM_29_DetnElevnAngle_037 100;
BA_ "GenSigASIL"  SG_ 1000 FRM_29_DetnElevnAngle_037 2;
BA_ "GenSigStartValue" SG_ 1000 FRM_29_DetnRelVelRadial_037 10000;
BA_ "GenSigASIL"  SG_ 1000 FRM_29_DetnRelVelRadial_037 2;
BA_ "GenSigASIL"  SG_ 1000 FRM_29_DetnSNR_037 2;
BA_ "GenSigStartValue" SG_ 1000 FRM_29_DetnRCS_037 5000;
BA_ "GenSigASIL"  SG_ 1000 FRM_29_DetnRCS_037 2;
BA_ "GenSigASIL"  SG_ 1000 FRM_29_DetnQuality_037 2;
BA_ "GenSigASIL"  SG_ 1000 FRM_29_DetnMotionSts_038 2;
BA_ "GenSigASIL"  SG_ 1000 FRM_29_DetnRngRadial_038 2;
BA_ "GenSigStartValue" SG_ 1000 FRM_29_DetnAziAngle_038 900;
BA_ "GenSigASIL"  SG_ 1000 FRM_29_DetnAziAngle_038 2;
BA_ "GenSigStartValue" SG_ 1000 FRM_29_DetnElevnAngle_038 100;
BA_ "GenSigASIL"  SG_ 1000 FRM_29_DetnElevnAngle_038 2;
BA_ "GenSigStartValue" SG_ 1000 FRM_29_DetnRelVelRadial_038 10000;
BA_ "GenSigASIL"  SG_ 1000 FRM_29_DetnRelVelRadial_038 2;
BA_ "GenSigASIL"  SG_ 1000 FRM_29_DetnSNR_038 2;
BA_ "GenSigStartValue" SG_ 1000 FRM_29_DetnRCS_038 5000;
BA_ "GenSigASIL"  SG_ 1000 FRM_29_DetnRCS_038 2;
BA_ "GenSigASIL"  SG_ 1000 FRM_29_DetnQuality_038 2;
BA_ "GenSigASIL"  SG_ 1000 FRM_29_DetnMotionSts_039 2;
BA_ "GenSigASIL"  SG_ 1000 FRM_29_DetnRngRadial_039 2;
BA_ "GenSigStartValue" SG_ 1000 FRM_29_DetnAziAngle_039 900;
BA_ "GenSigASIL"  SG_ 1000 FRM_29_DetnAziAngle_039 2;
BA_ "GenSigStartValue" SG_ 1000 FRM_29_DetnElevnAngle_039 100;
BA_ "GenSigASIL"  SG_ 1000 FRM_29_DetnElevnAngle_039 2;
BA_ "GenSigStartValue" SG_ 1000 FRM_29_DetnRelVelRadial_039 10000;
BA_ "GenSigASIL"  SG_ 1000 FRM_29_DetnRelVelRadial_039 2;
BA_ "GenSigASIL"  SG_ 1000 FRM_29_DetnSNR_039 2;
BA_ "GenSigStartValue" SG_ 1000 FRM_29_DetnRCS_039 5000;
BA_ "GenSigASIL"  SG_ 1000 FRM_29_DetnRCS_039 2;
BA_ "GenSigASIL"  SG_ 1000 FRM_29_DetnQuality_039 2;
BA_ "GenSigASIL"  SG_ 1000 FRM_29_DetnMotionSts_040 2;
BA_ "GenSigASIL"  SG_ 1000 FRM_29_DetnRngRadial_040 2;
BA_ "GenSigStartValue" SG_ 1000 FRM_29_DetnAziAngle_040 900;
BA_ "GenSigASIL"  SG_ 1000 FRM_29_DetnAziAngle_040 2;
BA_ "GenSigStartValue" SG_ 1000 FRM_29_DetnElevnAngle_040 100;
BA_ "GenSigASIL"  SG_ 1000 FRM_29_DetnElevnAngle_040 2;
BA_ "GenSigStartValue" SG_ 1000 FRM_29_DetnRelVelRadial_040 10000;
BA_ "GenSigASIL"  SG_ 1000 FRM_29_DetnRelVelRadial_040 2;
BA_ "GenSigASIL"  SG_ 1000 FRM_29_DetnSNR_040 2;
BA_ "GenSigStartValue" SG_ 1000 FRM_29_DetnRCS_040 5000;
BA_ "GenSigASIL"  SG_ 1000 FRM_29_DetnRCS_040 2;
BA_ "GenSigASIL"  SG_ 1000 FRM_29_DetnQuality_040 2;
BA_ "GenSigASIL"  SG_ 1000 FRM_29_DetnMotionSts_041 2;
BA_ "GenSigASIL"  SG_ 1000 FRM_29_DetnRngRadial_041 2;
BA_ "GenSigStartValue" SG_ 1000 FRM_29_DetnAziAngle_041 900;
BA_ "GenSigASIL"  SG_ 1000 FRM_29_DetnAziAngle_041 2;
BA_ "GenSigStartValue" SG_ 1000 FRM_29_DetnElevnAngle_041 100;
BA_ "GenSigASIL"  SG_ 1000 FRM_29_DetnElevnAngle_041 2;
BA_ "GenSigStartValue" SG_ 1000 FRM_29_DetnRelVelRadial_041 10000;
BA_ "GenSigASIL"  SG_ 1000 FRM_29_DetnRelVelRadial_041 2;
BA_ "GenSigASIL"  SG_ 1000 FRM_29_DetnSNR_041 2;
BA_ "GenSigStartValue" SG_ 1000 FRM_29_DetnRCS_041 5000;
BA_ "GenSigASIL"  SG_ 1000 FRM_29_DetnRCS_041 2;
BA_ "GenSigASIL"  SG_ 1000 FRM_29_DetnQuality_041 2;
BA_ "GenMsgILSupport" BO_ 1001 1;
BA_ "GenMsgCycleTime" BO_ 1001 50;
BA_ "GenSigASIL"  SG_ 1001 FRM_30_CRC 5;
BA_ "GenSigASIL"  SG_ 1001 FRM_30_RollgCntr 5;
BA_ "GenSigASIL"  SG_ 1001 FRM_30_DetnBlockCounter 2;
BA_ "GenSigASIL"  SG_ 1001 FRM_30_DetnMotionSts_042 2;
BA_ "GenSigASIL"  SG_ 1001 FRM_30_DetnRngRadial_042 2;
BA_ "GenSigStartValue" SG_ 1001 FRM_30_DetnAziAngle_042 900;
BA_ "GenSigASIL"  SG_ 1001 FRM_30_DetnAziAngle_042 2;
BA_ "GenSigStartValue" SG_ 1001 FRM_30_DetnElevnAngle_042 100;
BA_ "GenSigASIL"  SG_ 1001 FRM_30_DetnElevnAngle_042 2;
BA_ "GenSigStartValue" SG_ 1001 FRM_30_DetnRelVelRadial_042 10000;
BA_ "GenSigASIL"  SG_ 1001 FRM_30_DetnRelVelRadial_042 2;
BA_ "GenSigASIL"  SG_ 1001 FRM_30_DetnSNR_042 2;
BA_ "GenSigStartValue" SG_ 1001 FRM_30_DetnRCS_042 5000;
BA_ "GenSigASIL"  SG_ 1001 FRM_30_DetnRCS_042 2;
BA_ "GenSigASIL"  SG_ 1001 FRM_30_DetnQuality_042 2;
BA_ "GenSigASIL"  SG_ 1001 FRM_30_DetnMotionSts_043 2;
BA_ "GenSigASIL"  SG_ 1001 FRM_30_DetnRngRadial_043 2;
BA_ "GenSigStartValue" SG_ 1001 FRM_30_DetnAziAngle_043 900;
BA_ "GenSigASIL"  SG_ 1001 FRM_30_DetnAziAngle_043 2;
BA_ "GenSigStartValue" SG_ 1001 FRM_30_DetnElevnAngle_043 100;
BA_ "GenSigASIL"  SG_ 1001 FRM_30_DetnElevnAngle_043 2;
BA_ "GenSigStartValue" SG_ 1001 FRM_30_DetnRelVelRadial_043 10000;
BA_ "GenSigASIL"  SG_ 1001 FRM_30_DetnRelVelRadial_043 2;
BA_ "GenSigASIL"  SG_ 1001 FRM_30_DetnSNR_043 2;
BA_ "GenSigStartValue" SG_ 1001 FRM_30_DetnRCS_043 5000;
BA_ "GenSigASIL"  SG_ 1001 FRM_30_DetnRCS_043 2;
BA_ "GenSigASIL"  SG_ 1001 FRM_30_DetnQuality_043 2;
BA_ "GenSigASIL"  SG_ 1001 FRM_30_DetnMotionSts_044 2;
BA_ "GenSigASIL"  SG_ 1001 FRM_30_DetnRngRadial_044 2;
BA_ "GenSigStartValue" SG_ 1001 FRM_30_DetnAziAngle_044 900;
BA_ "GenSigASIL"  SG_ 1001 FRM_30_DetnAziAngle_044 2;
BA_ "GenSigStartValue" SG_ 1001 FRM_30_DetnElevnAngle_044 100;
BA_ "GenSigASIL"  SG_ 1001 FRM_30_DetnElevnAngle_044 2;
BA_ "GenSigStartValue" SG_ 1001 FRM_30_DetnRelVelRadial_044 10000;
BA_ "GenSigASIL"  SG_ 1001 FRM_30_DetnRelVelRadial_044 2;
BA_ "GenSigASIL"  SG_ 1001 FRM_30_DetnSNR_044 2;
BA_ "GenSigStartValue" SG_ 1001 FRM_30_DetnRCS_044 5000;
BA_ "GenSigASIL"  SG_ 1001 FRM_30_DetnRCS_044 2;
BA_ "GenSigASIL"  SG_ 1001 FRM_30_DetnQuality_044 2;
BA_ "GenSigASIL"  SG_ 1001 FRM_30_DetnMotionSts_045 2;
BA_ "GenSigASIL"  SG_ 1001 FRM_30_DetnRngRadial_045 2;
BA_ "GenSigStartValue" SG_ 1001 FRM_30_DetnAziAngle_045 900;
BA_ "GenSigASIL"  SG_ 1001 FRM_30_DetnAziAngle_045 2;
BA_ "GenSigStartValue" SG_ 1001 FRM_30_DetnElevnAngle_045 100;
BA_ "GenSigASIL"  SG_ 1001 FRM_30_DetnElevnAngle_045 2;
BA_ "GenSigStartValue" SG_ 1001 FRM_30_DetnRelVelRadial_045 10000;
BA_ "GenSigASIL"  SG_ 1001 FRM_30_DetnRelVelRadial_045 2;
BA_ "GenSigASIL"  SG_ 1001 FRM_30_DetnSNR_045 2;
BA_ "GenSigStartValue" SG_ 1001 FRM_30_DetnRCS_045 5000;
BA_ "GenSigASIL"  SG_ 1001 FRM_30_DetnRCS_045 2;
BA_ "GenSigASIL"  SG_ 1001 FRM_30_DetnQuality_045 2;
BA_ "GenSigASIL"  SG_ 1001 FRM_30_DetnMotionSts_046 2;
BA_ "GenSigASIL"  SG_ 1001 FRM_30_DetnRngRadial_046 2;
BA_ "GenSigStartValue" SG_ 1001 FRM_30_DetnAziAngle_046 900;
BA_ "GenSigASIL"  SG_ 1001 FRM_30_DetnAziAngle_046 2;
BA_ "GenSigStartValue" SG_ 1001 FRM_30_DetnElevnAngle_046 100;
BA_ "GenSigASIL"  SG_ 1001 FRM_30_DetnElevnAngle_046 2;
BA_ "GenSigStartValue" SG_ 1001 FRM_30_DetnRelVelRadial_046 10000;
BA_ "GenSigASIL"  SG_ 1001 FRM_30_DetnRelVelRadial_046 2;
BA_ "GenSigASIL"  SG_ 1001 FRM_30_DetnSNR_046 2;
BA_ "GenSigStartValue" SG_ 1001 FRM_30_DetnRCS_046 5000;
BA_ "GenSigASIL"  SG_ 1001 FRM_30_DetnRCS_046 2;
BA_ "GenSigASIL"  SG_ 1001 FRM_30_DetnQuality_046 2;
BA_ "GenSigASIL"  SG_ 1001 FRM_30_DetnMotionSts_047 2;
BA_ "GenSigASIL"  SG_ 1001 FRM_30_DetnRngRadial_047 2;
BA_ "GenSigStartValue" SG_ 1001 FRM_30_DetnAziAngle_047 900;
BA_ "GenSigASIL"  SG_ 1001 FRM_30_DetnAziAngle_047 2;
BA_ "GenSigStartValue" SG_ 1001 FRM_30_DetnElevnAngle_047 100;
BA_ "GenSigASIL"  SG_ 1001 FRM_30_DetnElevnAngle_047 2;
BA_ "GenSigStartValue" SG_ 1001 FRM_30_DetnRelVelRadial_047 10000;
BA_ "GenSigASIL"  SG_ 1001 FRM_30_DetnRelVelRadial_047 2;
BA_ "GenSigASIL"  SG_ 1001 FRM_30_DetnSNR_047 2;
BA_ "GenSigStartValue" SG_ 1001 FRM_30_DetnRCS_047 5000;
BA_ "GenSigASIL"  SG_ 1001 FRM_30_DetnRCS_047 2;
BA_ "GenSigASIL"  SG_ 1001 FRM_30_DetnQuality_047 2;
VAL_ 979 FRM_20_ObjType_34 3 "Four-wheels" 2 "Two-wheels" 1 "Pedestrian" 0 "Unknown" ;
VAL_ 979 FRM_20_ObjTrackSts_34 3 "Coasted" 2 "New" 1 "Updated" 0 "Unknown" ;
VAL_ 979 FRM_20_ObjMotionSts_34 3 "Static" 2 "Stopped" 1 "Moving" 0 "Unknown" ;
VAL_ 979 FRM_20_ObjMotionDirection_34 3 "Cossing" 2 "Reverse" 1 "Homogeneous" 0 "Unknown" ;
VAL_ 979 FRM_20_ObjElevnSts_34 3 "UnderRidable" 2 "Obstacle" 1 "OverRidable" 0 "Unknown" ;
VAL_ 979 FRM_20_ObjType_35 3 "Four-wheels" 2 "Two-wheels" 1 "Pedestrian" 0 "Unknown" ;
VAL_ 979 FRM_20_ObjTrackSts_35 3 "Coasted" 2 "New" 1 "Updated" 0 "Unknown" ;
VAL_ 979 FRM_20_ObjMotionSts_35 3 "Static" 2 "Stopped" 1 "Moving" 0 "Unknown" ;
VAL_ 979 FRM_20_ObjMotionDirection_35 3 "Cossing" 2 "Reverse" 1 "Homogeneous" 0 "Unknown" ;
VAL_ 979 FRM_20_ObjElevnSts_35 3 "UnderRidable" 2 "Obstacle" 1 "OverRidable" 0 "Unknown" ;
VAL_ 992 FRM_21_ObjType_36 3 "Four-wheels" 2 "Two-wheels" 1 "Pedestrian" 0 "Unknown" ;
VAL_ 992 FRM_21_ObjTrackSts_36 3 "Coasted" 2 "New" 1 "Updated" 0 "Unknown" ;
VAL_ 992 FRM_21_ObjMotionSts_36 3 "Static" 2 "Stopped" 1 "Moving" 0 "Unknown" ;
VAL_ 992 FRM_21_ObjMotionDirection_36 3 "Cossing" 2 "Reverse" 1 "Homogeneous" 0 "Unknown" ;
VAL_ 992 FRM_21_ObjElevnSts_36 3 "UnderRidable" 2 "Obstacle" 1 "OverRidable" 0 "Unknown" ;
VAL_ 992 FRM_21_ObjType_37 3 "Four-wheels" 2 "Two-wheels" 1 "Pedestrian" 0 "Unknown" ;
VAL_ 992 FRM_21_ObjTrackSts_37 3 "Coasted" 2 "New" 1 "Updated" 0 "Unknown" ;
VAL_ 992 FRM_21_ObjMotionSts_37 3 "Static" 2 "Stopped" 1 "Moving" 0 "Unknown" ;
VAL_ 992 FRM_21_ObjMotionDirection_37 3 "Cossing" 2 "Reverse" 1 "Homogeneous" 0 "Unknown" ;
VAL_ 992 FRM_21_ObjElevnSts_37 3 "UnderRidable" 2 "Obstacle" 1 "OverRidable" 0 "Unknown" ;
VAL_ 993 FRM_22_ObjType_38 3 "Four-wheels" 2 "Two-wheels" 1 "Pedestrian" 0 "Unknown" ;
VAL_ 993 FRM_22_ObjTrackSts_38 3 "Coasted" 2 "New" 1 "Updated" 0 "Unknown" ;
VAL_ 993 FRM_22_ObjMotionSts_38 3 "Static" 2 "Stopped" 1 "Moving" 0 "Unknown" ;
VAL_ 993 FRM_22_ObjMotionDirection_38 3 "Cossing" 2 "Reverse" 1 "Homogeneous" 0 "Unknown" ;
VAL_ 993 FRM_22_ObjElevnSts_38 3 "UnderRidable" 2 "Obstacle" 1 "OverRidable" 0 "Unknown" ;
VAL_ 993 FRM_22_ObjType_39 3 "Four-wheels" 2 "Two-wheels" 1 "Pedestrian" 0 "Unknown" ;
VAL_ 993 FRM_22_ObjTrackSts_39 3 "Coasted" 2 "New" 1 "Updated" 0 "Unknown" ;
VAL_ 993 FRM_22_ObjMotionSts_39 3 "Static" 2 "Stopped" 1 "Moving" 0 "Unknown" ;
VAL_ 993 FRM_22_ObjMotionDirection_39 3 "Cossing" 2 "Reverse" 1 "Homogeneous" 0 "Unknown" ;
VAL_ 993 FRM_22_ObjElevnSts_39 3 "UnderRidable" 2 "Obstacle" 1 "OverRidable" 0 "Unknown" ;
VAL_ 994 FRM_23_DetnMotionSts_000 3 "Invalid" 2 "Static" 1 "Moving" 0 "NoTarget" ;
VAL_ 994 FRM_23_DetnMotionSts_001 3 "Invalid" 2 "Static" 1 "Moving" 0 "NoTarget" ;
VAL_ 994 FRM_23_DetnMotionSts_002 3 "Invalid" 2 "Static" 1 "Moving" 0 "NoTarget" ;
VAL_ 994 FRM_23_DetnMotionSts_003 3 "Invalid" 2 "Static" 1 "Moving" 0 "NoTarget" ;
VAL_ 994 FRM_23_DetnMotionSts_004 3 "Invalid" 2 "Static" 1 "Moving" 0 "NoTarget" ;
VAL_ 994 FRM_23_DetnMotionSts_005 3 "Invalid" 2 "Static" 1 "Moving" 0 "NoTarget" ;
VAL_ 995 FRM_24_DetnMotionSts_006 3 "Invalid" 2 "Static" 1 "Moving" 0 "NoTarget" ;
VAL_ 995 FRM_24_DetnMotionSts_007 3 "Invalid" 2 "Static" 1 "Moving" 0 "NoTarget" ;
VAL_ 995 FRM_24_DetnMotionSts_008 3 "Invalid" 2 "Static" 1 "Moving" 0 "NoTarget" ;
VAL_ 995 FRM_24_DetnMotionSts_009 3 "Invalid" 2 "Static" 1 "Moving" 0 "NoTarget" ;
VAL_ 995 FRM_24_DetnMotionSts_010 3 "Invalid" 2 "Static" 1 "Moving" 0 "NoTarget" ;
VAL_ 995 FRM_24_DetnMotionSts_011 3 "Invalid" 2 "Static" 1 "Moving" 0 "NoTarget" ;
VAL_ 996 FRM_25_DetnMotionSts_012 3 "Invalid" 2 "Static" 1 "Moving" 0 "NoTarget" ;
VAL_ 996 FRM_25_DetnMotionSts_013 3 "Invalid" 2 "Static" 1 "Moving" 0 "NoTarget" ;
VAL_ 996 FRM_25_DetnMotionSts_014 3 "Invalid" 2 "Static" 1 "Moving" 0 "NoTarget" ;
VAL_ 996 FRM_25_DetnMotionSts_015 3 "Invalid" 2 "Static" 1 "Moving" 0 "NoTarget" ;
VAL_ 996 FRM_25_DetnMotionSts_016 3 "Invalid" 2 "Static" 1 "Moving" 0 "NoTarget" ;
VAL_ 996 FRM_25_DetnMotionSts_017 3 "Invalid" 2 "Static" 1 "Moving" 0 "NoTarget" ;
VAL_ 997 FRM_26_DetnMotionSts_018 3 "Invalid" 2 "Static" 1 "Moving" 0 "NoTarget" ;
VAL_ 997 FRM_26_DetnMotionSts_019 3 "Invalid" 2 "Static" 1 "Moving" 0 "NoTarget" ;
VAL_ 997 FRM_26_DetnMotionSts_020 3 "Invalid" 2 "Static" 1 "Moving" 0 "NoTarget" ;
VAL_ 997 FRM_26_DetnMotionSts_021 3 "Invalid" 2 "Static" 1 "Moving" 0 "NoTarget" ;
VAL_ 997 FRM_26_DetnMotionSts_022 3 "Invalid" 2 "Static" 1 "Moving" 0 "NoTarget" ;
VAL_ 997 FRM_26_DetnMotionSts_023 3 "Invalid" 2 "Static" 1 "Moving" 0 "NoTarget" ;
VAL_ 998 FRM_27_DetnMotionSts_024 3 "Invalid" 2 "Static" 1 "Moving" 0 "NoTarget" ;
VAL_ 998 FRM_27_DetnMotionSts_025 3 "Invalid" 2 "Static" 1 "Moving" 0 "NoTarget" ;
VAL_ 998 FRM_27_DetnMotionSts_026 3 "Invalid" 2 "Static" 1 "Moving" 0 "NoTarget" ;
VAL_ 998 FRM_27_DetnMotionSts_027 3 "Invalid" 2 "Static" 1 "Moving" 0 "NoTarget" ;
VAL_ 998 FRM_27_DetnMotionSts_028 3 "Invalid" 2 "Static" 1 "Moving" 0 "NoTarget" ;
VAL_ 998 FRM_27_DetnMotionSts_029 3 "Invalid" 2 "Static" 1 "Moving" 0 "NoTarget" ;
VAL_ 999 FRM_28_DetnMotionSts_030 3 "Invalid" 2 "Static" 1 "Moving" 0 "NoTarget" ;
VAL_ 999 FRM_28_DetnMotionSts_031 3 "Invalid" 2 "Static" 1 "Moving" 0 "NoTarget" ;
VAL_ 999 FRM_28_DetnMotionSts_032 3 "Invalid" 2 "Static" 1 "Moving" 0 "NoTarget" ;
VAL_ 999 FRM_28_DetnMotionSts_033 3 "Invalid" 2 "Static" 1 "Moving" 0 "NoTarget" ;
VAL_ 999 FRM_28_DetnMotionSts_034 3 "Invalid" 2 "Static" 1 "Moving" 0 "NoTarget" ;
VAL_ 999 FRM_28_DetnMotionSts_035 3 "Invalid" 2 "Static" 1 "Moving" 0 "NoTarget" ;
VAL_ 1000 FRM_29_DetnMotionSts_036 3 "Invalid" 2 "Static" 1 "Moving" 0 "NoTarget" ;
VAL_ 1000 FRM_29_DetnMotionSts_037 3 "Invalid" 2 "Static" 1 "Moving" 0 "NoTarget" ;
VAL_ 1000 FRM_29_DetnMotionSts_038 3 "Invalid" 2 "Static" 1 "Moving" 0 "NoTarget" ;
VAL_ 1000 FRM_29_DetnMotionSts_039 3 "Invalid" 2 "Static" 1 "Moving" 0 "NoTarget" ;
VAL_ 1000 FRM_29_DetnMotionSts_040 3 "Invalid" 2 "Static" 1 "Moving" 0 "NoTarget" ;
VAL_ 1000 FRM_29_DetnMotionSts_041 3 "Invalid" 2 "Static" 1 "Moving" 0 "NoTarget" ;
VAL_ 1001 FRM_30_DetnMotionSts_042 3 "Invalid" 2 "Static" 1 "Moving" 0 "NoTarget" ;
VAL_ 1001 FRM_30_DetnMotionSts_043 3 "Invalid" 2 "Static" 1 "Moving" 0 "NoTarget" ;
VAL_ 1001 FRM_30_DetnMotionSts_044 3 "Invalid" 2 "Static" 1 "Moving" 0 "NoTarget" ;
VAL_ 1001 FRM_30_DetnMotionSts_045 3 "Invalid" 2 "Static" 1 "Moving" 0 "NoTarget" ;
VAL_ 1001 FRM_30_DetnMotionSts_046 3 "Invalid" 2 "Static" 1 "Moving" 0 "NoTarget" ;
VAL_ 1001 FRM_30_DetnMotionSts_047 3 "Invalid" 2 "Static" 1 "Moving" 0 "NoTarget" ;
