VERSION ""

NS_ :

BS_:

BU_: FRM_FM_4X

BO_ 970 FRM_11: 64 FRM_FM_4X
 SG_ FRM_11_CRC : 7|16@0+ (1,0) [0|65535] ""  Vector__XXX
 SG_ FRM_11_RollgCntr : 23|8@0+ (1,0) [0|255] ""  Vector__XXX
 SG_ FRM_11_ObjBlockCounter : 31|4@0+ (1,0) [0|15] ""  Vector__XXX
 SG_ FRM_11_ObjID_16 : 39|8@0+ (1,0) [0|255] ""  Vector__XXX
 SG_ FRM_11_ObjClosestDistX_16 : 47|15@0+ (0.01,0) [0|200] "m"  Vector__XXX
 SG_ FRM_11_ObjClosestDistY_16 : 63|15@0+ (0.01,-100) [-100|100] "m"  Vector__XXX
 SG_ FRM_11_ObjRelVelX_16 : 79|15@0+ (0.01,-100) [-100|80] "m/s"  Vector__XXX
 SG_ FRM_11_ObjRelVelY_16 : 95|15@0+ (0.01,-100) [-100|80] "m/s"  Vector__XXX
 SG_ FRM_11_ObjAccelX_16 : 111|13@0+ (0.01,-25) [-25|25] "m/s^2"  Vector__XXX
 SG_ FRM_11_ObjAccelY_16 : 114|13@0+ (0.01,-25) [-25|25] "m/s^2"  Vector__XXX
 SG_ FRM_11_ObjClosestDistXStd_16 : 133|6@0+ (0.1,0) [0|5] ""  Vector__XXX
 SG_ FRM_11_ObjClosestDistYStd_16 : 143|6@0+ (0.1,0) [0|5] ""  Vector__XXX
 SG_ FRM_11_ObjRelVelXStd_16 : 137|7@0+ (0.05,0) [0|4] ""  Vector__XXX
 SG_ FRM_11_ObjRelVelYStd_16 : 146|7@0+ (0.05,0) [0|4] ""  Vector__XXX
 SG_ FRM_11_ObjRelAccelXStd_16 : 155|6@0+ (0.05,0) [0|3] ""  Vector__XXX
 SG_ FRM_11_ObjRelAccelYStd_16 : 165|6@0+ (0.05,0) [0|3] ""  Vector__XXX
 SG_ FRM_11_ObjExistProb_16 : 175|7@0+ (1,0) [0|100] "%"  Vector__XXX
 SG_ FRM_11_ObjType_16 : 168|2@0+ (1,0) [0|3] ""  Vector__XXX
 SG_ FRM_11_ObjTypeConf_16 : 182|7@0+ (1,0) [0|100] "%"  Vector__XXX
 SG_ FRM_11_ObjTrackSts_16 : 191|2@0+ (1,0) [0|3] ""  Vector__XXX
 SG_ FRM_11_ObjMotionSts_16 : 189|2@0+ (1,0) [0|3] ""  Vector__XXX
 SG_ FRM_11_ObjMotionDirection_16 : 187|2@0+ (1,0) [0|3] ""  Vector__XXX
 SG_ FRM_11_ObjCenterDistX_16 : 199|15@0+ (0.01,0) [0|200] "m"  Vector__XXX
 SG_ FRM_11_ObjCenterDistY_16 : 215|15@0+ (0.01,-100) [-100|100] "m"  Vector__XXX
 SG_ FRM_11_ObjLength_16 : 216|9@0+ (0.1,0) [0|50] "m"  Vector__XXX
 SG_ FRM_11_ObjWidth_16 : 239|9@0+ (0.1,0) [0|30] "m"  Vector__XXX
 SG_ FRM_11_ObjElevnSts_16 : 246|2@0+ (1,0) [0|3] ""  Vector__XXX
 SG_ FRM_11_ObjElevnStsConf_16 : 244|7@0+ (1,0) [0|100] "%"  Vector__XXX
 SG_ FRM_11_ObjHeading_16 : 253|12@0+ (0.1,-180) [-180|180] "deg"  Vector__XXX
 SG_ FRM_11_ObjID_17 : 271|8@0+ (1,0) [0|255] ""  Vector__XXX
 SG_ FRM_11_ObjClosestDistX_17 : 279|15@0+ (0.01,0) [0|200] "m"  Vector__XXX
 SG_ FRM_11_ObjClosestDistY_17 : 295|15@0+ (0.01,-100) [-100|100] "m"  Vector__XXX
 SG_ FRM_11_ObjRelVelX_17 : 311|15@0+ (0.01,-100) [-100|80] "m/s"  Vector__XXX
 SG_ FRM_11_ObjRelVelY_17 : 327|15@0+ (0.01,-100) [-100|80] "m/s"  Vector__XXX
 SG_ FRM_11_ObjAccelX_17 : 343|13@0+ (0.01,-25) [-25|25] "m/s^2"  Vector__XXX
 SG_ FRM_11_ObjAccelY_17 : 346|13@0+ (0.01,-25) [-25|25] "m/s^2"  Vector__XXX
 SG_ FRM_11_ObjClosestDistXStd_17 : 365|6@0+ (0.1,0) [0|5] ""  Vector__XXX
 SG_ FRM_11_ObjClosestDistYStd_17 : 375|6@0+ (0.1,0) [0|5] ""  Vector__XXX
 SG_ FRM_11_ObjRelVelXStd_17 : 369|7@0+ (0.05,0) [0|4] ""  Vector__XXX
 SG_ FRM_11_ObjRelVelYStd_17 : 378|7@0+ (0.05,0) [0|4] ""  Vector__XXX
 SG_ FRM_11_ObjRelAccelXStd_17 : 387|6@0+ (0.05,0) [0|3] ""  Vector__XXX
 SG_ FRM_11_ObjRelAccelYStd_17 : 397|6@0+ (0.05,0) [0|3] ""  Vector__XXX
 SG_ FRM_11_ObjExistProb_17 : 407|7@0+ (1,0) [0|100] "%"  Vector__XXX
 SG_ FRM_11_ObjType_17 : 400|2@0+ (1,0) [0|3] ""  Vector__XXX
 SG_ FRM_11_ObjTypeConf_17 : 414|7@0+ (1,0) [0|100] "%"  Vector__XXX
 SG_ FRM_11_ObjTrackSts_17 : 423|2@0+ (1,0) [0|3] ""  Vector__XXX
 SG_ FRM_11_ObjMotionSts_17 : 421|2@0+ (1,0) [0|3] ""  Vector__XXX
 SG_ FRM_11_ObjMotionDirection_17 : 419|2@0+ (1,0) [0|3] ""  Vector__XXX
 SG_ FRM_11_ObjCenterDistX_17 : 431|15@0+ (0.01,0) [0|200] "m"  Vector__XXX
 SG_ FRM_11_ObjCenterDistY_17 : 447|15@0+ (0.01,-100) [-100|100] "m"  Vector__XXX
 SG_ FRM_11_ObjLength_17 : 448|9@0+ (0.1,0) [0|50] "m"  Vector__XXX
 SG_ FRM_11_ObjWidth_17 : 471|9@0+ (0.1,0) [0|30] "m"  Vector__XXX
 SG_ FRM_11_ObjElevnSts_17 : 478|2@0+ (1,0) [0|3] ""  Vector__XXX
 SG_ FRM_11_ObjElevnStsConf_17 : 476|7@0+ (1,0) [0|100] "%"  Vector__XXX
 SG_ FRM_11_ObjHeading_17 : 485|12@0+ (0.1,-180) [-180|180] "deg"  Vector__XXX

BO_ 971 FRM_12: 64 FRM_FM_4X
 SG_ FRM_12_CRC : 7|16@0+ (1,0) [0|65535] ""  Vector__XXX
 SG_ FRM_12_RollgCntr : 23|8@0+ (1,0) [0|255] ""  Vector__XXX
 SG_ FRM_12_ObjBlockCounter : 31|4@0+ (1,0) [0|15] ""  Vector__XXX
 SG_ FRM_12_ObjID_18 : 39|8@0+ (1,0) [0|255] ""  Vector__XXX
 SG_ FRM_12_ObjClosestDistX_18 : 47|15@0+ (0.01,0) [0|200] "m"  Vector__XXX
 SG_ FRM_12_ObjClosestDistY_18 : 63|15@0+ (0.01,-100) [-100|100] "m"  Vector__XXX
 SG_ FRM_12_ObjRelVelX_18 : 79|15@0+ (0.01,-100) [-100|80] "m/s"  Vector__XXX
 SG_ FRM_12_ObjRelVelY_18 : 95|15@0+ (0.01,-100) [-100|80] "m/s"  Vector__XXX
 SG_ FRM_12_ObjAccelX_18 : 111|13@0+ (0.01,-25) [-25|25] "m/s^2"  Vector__XXX
 SG_ FRM_12_ObjAccelY_18 : 114|13@0+ (0.01,-25) [-25|25] "m/s^2"  Vector__XXX
 SG_ FRM_12_ObjClosestDistXStd_18 : 133|6@0+ (0.1,0) [0|5] ""  Vector__XXX
 SG_ FRM_12_ObjClosestDistYStd_18 : 143|6@0+ (0.1,0) [0|5] ""  Vector__XXX
 SG_ FRM_12_ObjRelVelXStd_18 : 137|7@0+ (0.05,0) [0|4] ""  Vector__XXX
 SG_ FRM_12_ObjRelVelYStd_18 : 146|7@0+ (0.05,0) [0|4] ""  Vector__XXX
 SG_ FRM_12_ObjRelAccelXStd_18 : 155|6@0+ (0.05,0) [0|3] ""  Vector__XXX
 SG_ FRM_12_ObjRelAccelYStd_18 : 165|6@0+ (0.05,0) [0|3] ""  Vector__XXX
 SG_ FRM_12_ObjExistProb_18 : 175|7@0+ (1,0) [0|100] "%"  Vector__XXX
 SG_ FRM_12_ObjType_18 : 168|2@0+ (1,0) [0|3] ""  Vector__XXX
 SG_ FRM_12_ObjTypeConf_18 : 182|7@0+ (1,0) [0|100] "%"  Vector__XXX
 SG_ FRM_12_ObjTrackSts_18 : 191|2@0+ (1,0) [0|3] ""  Vector__XXX
 SG_ FRM_12_ObjMotionSts_18 : 189|2@0+ (1,0) [0|3] ""  Vector__XXX
 SG_ FRM_12_ObjMotionDirection_18 : 187|2@0+ (1,0) [0|3] ""  Vector__XXX
 SG_ FRM_12_ObjCenterDistX_18 : 199|15@0+ (0.01,0) [0|200] "m"  Vector__XXX
 SG_ FRM_12_ObjCenterDistY_18 : 215|15@0+ (0.01,-100) [-100|100] "m"  Vector__XXX
 SG_ FRM_12_ObjLength_18 : 216|9@0+ (0.1,0) [0|50] "m"  Vector__XXX
 SG_ FRM_12_ObjWidth_18 : 239|9@0+ (0.1,0) [0|30] "m"  Vector__XXX
 SG_ FRM_12_ObjElevnSts_18 : 246|2@0+ (1,0) [0|3] ""  Vector__XXX
 SG_ FRM_12_ObjElevnStsConf_18 : 244|7@0+ (1,0) [0|100] "%"  Vector__XXX
 SG_ FRM_12_ObjHeading_18 : 253|12@0+ (0.1,-180) [-180|180] "deg"  Vector__XXX
 SG_ FRM_12_ObjID_19 : 271|8@0+ (1,0) [0|255] ""  Vector__XXX
 SG_ FRM_12_ObjClosestDistX_19 : 279|15@0+ (0.01,0) [0|200] "m"  Vector__XXX
 SG_ FRM_12_ObjClosestDistY_19 : 295|15@0+ (0.01,-100) [-100|100] "m"  Vector__XXX
 SG_ FRM_12_ObjRelVelX_19 : 311|15@0+ (0.01,-100) [-100|80] "m/s"  Vector__XXX
 SG_ FRM_12_ObjRelVelY_19 : 327|15@0+ (0.01,-100) [-100|80] "m/s"  Vector__XXX
 SG_ FRM_12_ObjAccelX_19 : 343|13@0+ (0.01,-25) [-25|25] "m/s^2"  Vector__XXX
 SG_ FRM_12_ObjAccelY_19 : 346|13@0+ (0.01,-25) [-25|25] "m/s^2"  Vector__XXX
 SG_ FRM_12_ObjClosestDistXStd_19 : 365|6@0+ (0.1,0) [0|5] ""  Vector__XXX
 SG_ FRM_12_ObjClosestDistYStd_19 : 375|6@0+ (0.1,0) [0|5] ""  Vector__XXX
 SG_ FRM_12_ObjRelVelXStd_19 : 369|7@0+ (0.05,0) [0|4] ""  Vector__XXX
 SG_ FRM_12_ObjRelVelYStd_19 : 378|7@0+ (0.05,0) [0|4] ""  Vector__XXX
 SG_ FRM_12_ObjRelAccelXStd_19 : 387|6@0+ (0.05,0) [0|3] ""  Vector__XXX
 SG_ FRM_12_ObjRelAccelYStd_19 : 397|6@0+ (0.05,0) [0|3] ""  Vector__XXX
 SG_ FRM_12_ObjExistProb_19 : 407|7@0+ (1,0) [0|100] "%"  Vector__XXX
 SG_ FRM_12_ObjType_19 : 400|2@0+ (1,0) [0|3] ""  Vector__XXX
 SG_ FRM_12_ObjTypeConf_19 : 414|7@0+ (1,0) [0|100] "%"  Vector__XXX
 SG_ FRM_12_ObjTrackSts_19 : 423|2@0+ (1,0) [0|3] ""  Vector__XXX
 SG_ FRM_12_ObjMotionSts_19 : 421|2@0+ (1,0) [0|3] ""  Vector__XXX
 SG_ FRM_12_ObjMotionDirection_19 : 419|2@0+ (1,0) [0|3] ""  Vector__XXX
 SG_ FRM_12_ObjCenterDistX_19 : 431|15@0+ (0.01,0) [0|200] "m"  Vector__XXX
 SG_ FRM_12_ObjCenterDistY_19 : 447|15@0+ (0.01,-100) [-100|100] "m"  Vector__XXX
 SG_ FRM_12_ObjLength_19 : 448|9@0+ (0.1,0) [0|50] "m"  Vector__XXX
 SG_ FRM_12_ObjWidth_19 : 471|9@0+ (0.1,0) [0|30] "m"  Vector__XXX
 SG_ FRM_12_ObjElevnSts_19 : 478|2@0+ (1,0) [0|3] ""  Vector__XXX
 SG_ FRM_12_ObjElevnStsConf_19 : 476|7@0+ (1,0) [0|100] "%"  Vector__XXX
 SG_ FRM_12_ObjHeading_19 : 485|12@0+ (0.1,-180) [-180|180] "deg"  Vector__XXX

BO_ 972 FRM_13: 64 FRM_FM_4X
 SG_ FRM_13_CRC : 7|16@0+ (1,0) [0|65535] ""  Vector__XXX
 SG_ FRM_13_RollgCntr : 23|8@0+ (1,0) [0|255] ""  Vector__XXX
 SG_ FRM_13_ObjBlockCounter : 31|4@0+ (1,0) [0|15] ""  Vector__XXX
 SG_ FRM_13_ObjID_20 : 39|8@0+ (1,0) [0|255] ""  Vector__XXX
 SG_ FRM_13_ObjClosestDistX_20 : 47|15@0+ (0.01,0) [0|200] "m"  Vector__XXX
 SG_ FRM_13_ObjClosestDistY_20 : 63|15@0+ (0.01,-100) [-100|100] "m"  Vector__XXX
 SG_ FRM_13_ObjRelVelX_20 : 79|15@0+ (0.01,-100) [-100|80] "m/s"  Vector__XXX
 SG_ FRM_13_ObjRelVelY_20 : 95|15@0+ (0.01,-100) [-100|80] "m/s"  Vector__XXX
 SG_ FRM_13_ObjAccelX_20 : 111|13@0+ (0.01,-25) [-25|25] "m/s^2"  Vector__XXX
 SG_ FRM_13_ObjAccelY_20 : 114|13@0+ (0.01,-25) [-25|25] "m/s^2"  Vector__XXX
 SG_ FRM_13_ObjClosestDistXStd_20 : 133|6@0+ (0.1,0) [0|5] ""  Vector__XXX
 SG_ FRM_13_ObjClosestDistYStd_20 : 143|6@0+ (0.1,0) [0|5] ""  Vector__XXX
 SG_ FRM_13_ObjRelVelXStd_20 : 137|7@0+ (0.05,0) [0|4] ""  Vector__XXX
 SG_ FRM_13_ObjRelVelYStd_20 : 146|7@0+ (0.05,0) [0|4] ""  Vector__XXX
 SG_ FRM_13_ObjRelAccelXStd_20 : 155|6@0+ (0.05,0) [0|3] ""  Vector__XXX
 SG_ FRM_13_ObjRelAccelYStd_20 : 165|6@0+ (0.05,0) [0|3] ""  Vector__XXX
 SG_ FRM_13_ObjExistProb_20 : 175|7@0+ (1,0) [0|100] "%"  Vector__XXX
 SG_ FRM_13_ObjType_20 : 168|2@0+ (1,0) [0|3] ""  Vector__XXX
 SG_ FRM_13_ObjTypeConf_20 : 182|7@0+ (1,0) [0|100] "%"  Vector__XXX
 SG_ FRM_13_ObjTrackSts_20 : 191|2@0+ (1,0) [0|3] ""  Vector__XXX
 SG_ FRM_13_ObjMotionSts_20 : 189|2@0+ (1,0) [0|3] ""  Vector__XXX
 SG_ FRM_13_ObjMotionDirection_20 : 187|2@0+ (1,0) [0|3] ""  Vector__XXX
 SG_ FRM_13_ObjCenterDistX_20 : 199|15@0+ (0.01,0) [0|200] "m"  Vector__XXX
 SG_ FRM_13_ObjCenterDistY_20 : 215|15@0+ (0.01,-100) [-100|100] "m"  Vector__XXX
 SG_ FRM_13_ObjLength_20 : 216|9@0+ (0.1,0) [0|50] "m"  Vector__XXX
 SG_ FRM_13_ObjWidth_20 : 239|9@0+ (0.1,0) [0|30] "m"  Vector__XXX
 SG_ FRM_13_ObjElevnSts_20 : 246|2@0+ (1,0) [0|3] ""  Vector__XXX
 SG_ FRM_13_ObjElevnStsConf_20 : 244|7@0+ (1,0) [0|100] "%"  Vector__XXX
 SG_ FRM_13_ObjHeading_20 : 253|12@0+ (0.1,-180) [-180|180] "deg"  Vector__XXX
 SG_ FRM_13_ObjID_21 : 271|8@0+ (1,0) [0|255] ""  Vector__XXX
 SG_ FRM_13_ObjClosestDistX_21 : 279|15@0+ (0.01,0) [0|200] "m"  Vector__XXX
 SG_ FRM_13_ObjClosestDistY_21 : 295|15@0+ (0.01,-100) [-100|100] "m"  Vector__XXX
 SG_ FRM_13_ObjRelVelX_21 : 311|15@0+ (0.01,-100) [-100|80] "m/s"  Vector__XXX
 SG_ FRM_13_ObjRelVelY_21 : 327|15@0+ (0.01,-100) [-100|80] "m/s"  Vector__XXX
 SG_ FRM_13_ObjAccelX_21 : 343|13@0+ (0.01,-25) [-25|25] "m/s^2"  Vector__XXX
 SG_ FRM_13_ObjAccelY_21 : 346|13@0+ (0.01,-25) [-25|25] "m/s^2"  Vector__XXX
 SG_ FRM_13_ObjClosestDistXStd_21 : 365|6@0+ (0.1,0) [0|5] ""  Vector__XXX
 SG_ FRM_13_ObjClosestDistYStd_21 : 375|6@0+ (0.1,0) [0|5] ""  Vector__XXX
 SG_ FRM_13_ObjRelVelXStd_21 : 369|7@0+ (0.05,0) [0|4] ""  Vector__XXX
 SG_ FRM_13_ObjRelVelYStd_21 : 378|7@0+ (0.05,0) [0|4] ""  Vector__XXX
 SG_ FRM_13_ObjRelAccelXStd_21 : 387|6@0+ (0.05,0) [0|3] ""  Vector__XXX
 SG_ FRM_13_ObjRelAccelYStd_21 : 397|6@0+ (0.05,0) [0|3] ""  Vector__XXX
 SG_ FRM_13_ObjExistProb_21 : 407|7@0+ (1,0) [0|100] "%"  Vector__XXX
 SG_ FRM_13_ObjType_21 : 400|2@0+ (1,0) [0|3] ""  Vector__XXX
 SG_ FRM_13_ObjTypeConf_21 : 414|7@0+ (1,0) [0|100] "%"  Vector__XXX
 SG_ FRM_13_ObjTrackSts_21 : 423|2@0+ (1,0) [0|3] ""  Vector__XXX
 SG_ FRM_13_ObjMotionSts_21 : 421|2@0+ (1,0) [0|3] ""  Vector__XXX
 SG_ FRM_13_ObjMotionDirection_21 : 419|2@0+ (1,0) [0|3] ""  Vector__XXX
 SG_ FRM_13_ObjCenterDistX_21 : 431|15@0+ (0.01,0) [0|200] "m"  Vector__XXX
 SG_ FRM_13_ObjCenterDistY_21 : 447|15@0+ (0.01,-100) [-100|100] "m"  Vector__XXX
 SG_ FRM_13_ObjLength_21 : 448|9@0+ (0.1,0) [0|50] "m"  Vector__XXX
 SG_ FRM_13_ObjWidth_21 : 471|9@0+ (0.1,0) [0|30] "m"  Vector__XXX
 SG_ FRM_13_ObjElevnSts_21 : 478|2@0+ (1,0) [0|3] ""  Vector__XXX
 SG_ FRM_13_ObjElevnStsConf_21 : 476|7@0+ (1,0) [0|100] "%"  Vector__XXX
 SG_ FRM_13_ObjHeading_21 : 485|12@0+ (0.1,-180) [-180|180] "deg"  Vector__XXX

BO_ 973 FRM_14: 64 FRM_FM_4X
 SG_ FRM_14_CRC : 7|16@0+ (1,0) [0|65535] ""  Vector__XXX
 SG_ FRM_14_RollgCntr : 23|8@0+ (1,0) [0|255] ""  Vector__XXX
 SG_ FRM_14_ObjBlockCounter : 31|4@0+ (1,0) [0|15] ""  Vector__XXX
 SG_ FRM_14_ObjID_22 : 39|8@0+ (1,0) [0|255] ""  Vector__XXX
 SG_ FRM_14_ObjClosestDistX_22 : 47|15@0+ (0.01,0) [0|200] "m"  Vector__XXX
 SG_ FRM_14_ObjClosestDistY_22 : 63|15@0+ (0.01,-100) [-100|100] "m"  Vector__XXX
 SG_ FRM_14_ObjRelVelX_22 : 79|15@0+ (0.01,-100) [-100|80] "m/s"  Vector__XXX
 SG_ FRM_14_ObjRelVelY_22 : 95|15@0+ (0.01,-100) [-100|80] "m/s"  Vector__XXX
 SG_ FRM_14_ObjAccelX_22 : 111|13@0+ (0.01,-25) [-25|25] "m/s^2"  Vector__XXX
 SG_ FRM_14_ObjAccelY_22 : 114|13@0+ (0.01,-25) [-25|25] "m/s^2"  Vector__XXX
 SG_ FRM_14_ObjClosestDistXStd_22 : 133|6@0+ (0.1,0) [0|5] ""  Vector__XXX
 SG_ FRM_14_ObjClosestDistYStd_22 : 143|6@0+ (0.1,0) [0|5] ""  Vector__XXX
 SG_ FRM_14_ObjRelVelXStd_22 : 137|7@0+ (0.05,0) [0|4] ""  Vector__XXX
 SG_ FRM_14_ObjRelVelYStd_22 : 146|7@0+ (0.05,0) [0|4] ""  Vector__XXX
 SG_ FRM_14_ObjRelAccelXStd_22 : 155|6@0+ (0.05,0) [0|3] ""  Vector__XXX
 SG_ FRM_14_ObjRelAccelYStd_22 : 165|6@0+ (0.05,0) [0|3] ""  Vector__XXX
 SG_ FRM_14_ObjExistProb_22 : 175|7@0+ (1,0) [0|100] "%"  Vector__XXX
 SG_ FRM_14_ObjType_22 : 168|2@0+ (1,0) [0|3] ""  Vector__XXX
 SG_ FRM_14_ObjTypeConf_22 : 182|7@0+ (1,0) [0|100] "%"  Vector__XXX
 SG_ FRM_14_ObjTrackSts_22 : 191|2@0+ (1,0) [0|3] ""  Vector__XXX
 SG_ FRM_14_ObjMotionSts_22 : 189|2@0+ (1,0) [0|3] ""  Vector__XXX
 SG_ FRM_14_ObjMotionDirection_22 : 187|2@0+ (1,0) [0|3] ""  Vector__XXX
 SG_ FRM_14_ObjCenterDistX_22 : 199|15@0+ (0.01,0) [0|200] "m"  Vector__XXX
 SG_ FRM_14_ObjCenterDistY_22 : 215|15@0+ (0.01,-100) [-100|100] "m"  Vector__XXX
 SG_ FRM_14_ObjLength_22 : 216|9@0+ (0.1,0) [0|50] "m"  Vector__XXX
 SG_ FRM_14_ObjWidth_22 : 239|9@0+ (0.1,0) [0|30] "m"  Vector__XXX
 SG_ FRM_14_ObjElevnSts_22 : 246|2@0+ (1,0) [0|3] ""  Vector__XXX
 SG_ FRM_14_ObjElevnStsConf_22 : 244|7@0+ (1,0) [0|100] "%"  Vector__XXX
 SG_ FRM_14_ObjHeading_22 : 253|12@0+ (0.1,-180) [-180|180] "deg"  Vector__XXX
 SG_ FRM_14_ObjID_23 : 271|8@0+ (1,0) [0|255] ""  Vector__XXX
 SG_ FRM_14_ObjClosestDistX_23 : 279|15@0+ (0.01,0) [0|200] "m"  Vector__XXX
 SG_ FRM_14_ObjClosestDistY_23 : 295|15@0+ (0.01,-100) [-100|100] "m"  Vector__XXX
 SG_ FRM_14_ObjRelVelX_23 : 311|15@0+ (0.01,-100) [-100|80] "m/s"  Vector__XXX
 SG_ FRM_14_ObjRelVelY_23 : 327|15@0+ (0.01,-100) [-100|80] "m/s"  Vector__XXX
 SG_ FRM_14_ObjAccelX_23 : 343|13@0+ (0.01,-25) [-25|25] "m/s^2"  Vector__XXX
 SG_ FRM_14_ObjAccelY_23 : 346|13@0+ (0.01,-25) [-25|25] "m/s^2"  Vector__XXX
 SG_ FRM_14_ObjClosestDistXStd_23 : 365|6@0+ (0.1,0) [0|5] ""  Vector__XXX
 SG_ FRM_14_ObjClosestDistYStd_23 : 375|6@0+ (0.1,0) [0|5] ""  Vector__XXX
 SG_ FRM_14_ObjRelVelXStd_23 : 369|7@0+ (0.05,0) [0|4] ""  Vector__XXX
 SG_ FRM_14_ObjRelVelYStd_23 : 378|7@0+ (0.05,0) [0|4] ""  Vector__XXX
 SG_ FRM_14_ObjRelAccelXStd_23 : 387|6@0+ (0.05,0) [0|3] ""  Vector__XXX
 SG_ FRM_14_ObjRelAccelYStd_23 : 397|6@0+ (0.05,0) [0|3] ""  Vector__XXX
 SG_ FRM_14_ObjExistProb_23 : 407|7@0+ (1,0) [0|100] "%"  Vector__XXX
 SG_ FRM_14_ObjType_23 : 400|2@0+ (1,0) [0|3] ""  Vector__XXX
 SG_ FRM_14_ObjTypeConf_23 : 414|7@0+ (1,0) [0|100] "%"  Vector__XXX
 SG_ FRM_14_ObjTrackSts_23 : 423|2@0+ (1,0) [0|3] ""  Vector__XXX
 SG_ FRM_14_ObjMotionSts_23 : 421|2@0+ (1,0) [0|3] ""  Vector__XXX
 SG_ FRM_14_ObjMotionDirection_23 : 419|2@0+ (1,0) [0|3] ""  Vector__XXX
 SG_ FRM_14_ObjCenterDistX_23 : 431|15@0+ (0.01,0) [0|200] "m"  Vector__XXX
 SG_ FRM_14_ObjCenterDistY_23 : 447|15@0+ (0.01,-100) [-100|100] "m"  Vector__XXX
 SG_ FRM_14_ObjLength_23 : 448|9@0+ (0.1,0) [0|50] "m"  Vector__XXX
 SG_ FRM_14_ObjWidth_23 : 471|9@0+ (0.1,0) [0|30] "m"  Vector__XXX
 SG_ FRM_14_ObjElevnSts_23 : 478|2@0+ (1,0) [0|3] ""  Vector__XXX
 SG_ FRM_14_ObjElevnStsConf_23 : 476|7@0+ (1,0) [0|100] "%"  Vector__XXX
 SG_ FRM_14_ObjHeading_23 : 485|12@0+ (0.1,-180) [-180|180] "deg"  Vector__XXX

BO_ 974 FRM_15: 64 FRM_FM_4X
 SG_ FRM_15_CRC : 7|16@0+ (1,0) [0|65535] ""  Vector__XXX
 SG_ FRM_15_RollgCntr : 23|8@0+ (1,0) [0|255] ""  Vector__XXX
 SG_ FRM_15_ObjBlockCounter : 31|4@0+ (1,0) [0|15] ""  Vector__XXX
 SG_ FRM_15_ObjID_24 : 39|8@0+ (1,0) [0|255] ""  Vector__XXX
 SG_ FRM_15_ObjClosestDistX_24 : 47|15@0+ (0.01,0) [0|200] "m"  Vector__XXX
 SG_ FRM_15_ObjClosestDistY_24 : 63|15@0+ (0.01,-100) [-100|100] "m"  Vector__XXX
 SG_ FRM_15_ObjRelVelX_24 : 79|15@0+ (0.01,-100) [-100|80] "m/s"  Vector__XXX
 SG_ FRM_15_ObjRelVelY_24 : 95|15@0+ (0.01,-100) [-100|80] "m/s"  Vector__XXX
 SG_ FRM_15_ObjAccelX_24 : 111|13@0+ (0.01,-25) [-25|25] "m/s^2"  Vector__XXX
 SG_ FRM_15_ObjAccelY_24 : 114|13@0+ (0.01,-25) [-25|25] "m/s^2"  Vector__XXX
 SG_ FRM_15_ObjClosestDistXStd_24 : 133|6@0+ (0.1,0) [0|5] ""  Vector__XXX
 SG_ FRM_15_ObjClosestDistYStd_24 : 143|6@0+ (0.1,0) [0|5] ""  Vector__XXX
 SG_ FRM_15_ObjRelVelXStd_24 : 137|7@0+ (0.05,0) [0|4] ""  Vector__XXX
 SG_ FRM_15_ObjRelVelYStd_24 : 146|7@0+ (0.05,0) [0|4] ""  Vector__XXX
 SG_ FRM_15_ObjRelAccelXStd_24 : 155|6@0+ (0.05,0) [0|3] ""  Vector__XXX
 SG_ FRM_15_ObjRelAccelYStd_24 : 165|6@0+ (0.05,0) [0|3] ""  Vector__XXX
 SG_ FRM_15_ObjExistProb_24 : 175|7@0+ (1,0) [0|100] "%"  Vector__XXX
 SG_ FRM_15_ObjType_24 : 168|2@0+ (1,0) [0|3] ""  Vector__XXX
 SG_ FRM_15_ObjTypeConf_24 : 182|7@0+ (1,0) [0|100] "%"  Vector__XXX
 SG_ FRM_15_ObjTrackSts_24 : 191|2@0+ (1,0) [0|3] ""  Vector__XXX
 SG_ FRM_15_ObjMotionSts_24 : 189|2@0+ (1,0) [0|3] ""  Vector__XXX
 SG_ FRM_15_ObjMotionDirection_24 : 187|2@0+ (1,0) [0|3] ""  Vector__XXX
 SG_ FRM_15_ObjCenterDistX_24 : 199|15@0+ (0.01,0) [0|200] "m"  Vector__XXX
 SG_ FRM_15_ObjCenterDistY_24 : 215|15@0+ (0.01,-100) [-100|100] "m"  Vector__XXX
 SG_ FRM_15_ObjLength_24 : 216|9@0+ (0.1,0) [0|50] "m"  Vector__XXX
 SG_ FRM_15_ObjWidth_24 : 239|9@0+ (0.1,0) [0|30] "m"  Vector__XXX
 SG_ FRM_15_ObjElevnSts_24 : 246|2@0+ (1,0) [0|3] ""  Vector__XXX
 SG_ FRM_15_ObjElevnStsConf_24 : 244|7@0+ (1,0) [0|100] "%"  Vector__XXX
 SG_ FRM_15_ObjHeading_24 : 253|12@0+ (0.1,-180) [-180|180] "deg"  Vector__XXX
 SG_ FRM_15_ObjID_25 : 271|8@0+ (1,0) [0|255] ""  Vector__XXX
 SG_ FRM_15_ObjClosestDistX_25 : 279|15@0+ (0.01,0) [0|200] "m"  Vector__XXX
 SG_ FRM_15_ObjClosestDistY_25 : 295|15@0+ (0.01,-100) [-100|100] "m"  Vector__XXX
 SG_ FRM_15_ObjRelVelX_25 : 311|15@0+ (0.01,-100) [-100|80] "m/s"  Vector__XXX
 SG_ FRM_15_ObjRelVelY_25 : 327|15@0+ (0.01,-100) [-100|80] "m/s"  Vector__XXX
 SG_ FRM_15_ObjAccelX_25 : 343|13@0+ (0.01,-25) [-25|25] "m/s^2"  Vector__XXX
 SG_ FRM_15_ObjAccelY_25 : 346|13@0+ (0.01,-25) [-25|25] "m/s^2"  Vector__XXX
 SG_ FRM_15_ObjClosestDistXStd_25 : 365|6@0+ (0.1,0) [0|5] ""  Vector__XXX
 SG_ FRM_15_ObjClosestDistYStd_25 : 375|6@0+ (0.1,0) [0|5] ""  Vector__XXX
 SG_ FRM_15_ObjRelVelXStd_25 : 369|7@0+ (0.05,0) [0|4] ""  Vector__XXX
 SG_ FRM_15_ObjRelVelYStd_25 : 378|7@0+ (0.05,0) [0|4] ""  Vector__XXX
 SG_ FRM_15_ObjRelAccelXStd_25 : 387|6@0+ (0.05,0) [0|3] ""  Vector__XXX
 SG_ FRM_15_ObjRelAccelYStd_25 : 397|6@0+ (0.05,0) [0|3] ""  Vector__XXX
 SG_ FRM_15_ObjExistProb_25 : 407|7@0+ (1,0) [0|100] "%"  Vector__XXX
 SG_ FRM_15_ObjType_25 : 400|2@0+ (1,0) [0|3] ""  Vector__XXX
 SG_ FRM_15_ObjTypeConf_25 : 414|7@0+ (1,0) [0|100] "%"  Vector__XXX
 SG_ FRM_15_ObjTrackSts_25 : 423|2@0+ (1,0) [0|3] ""  Vector__XXX
 SG_ FRM_15_ObjMotionSts_25 : 421|2@0+ (1,0) [0|3] ""  Vector__XXX
 SG_ FRM_15_ObjMotionDirection_25 : 419|2@0+ (1,0) [0|3] ""  Vector__XXX
 SG_ FRM_15_ObjCenterDistX_25 : 431|15@0+ (0.01,0) [0|200] "m"  Vector__XXX
 SG_ FRM_15_ObjCenterDistY_25 : 447|15@0+ (0.01,-100) [-100|100] "m"  Vector__XXX
 SG_ FRM_15_ObjLength_25 : 448|9@0+ (0.1,0) [0|50] "m"  Vector__XXX
 SG_ FRM_15_ObjWidth_25 : 471|9@0+ (0.1,0) [0|30] "m"  Vector__XXX
 SG_ FRM_15_ObjElevnSts_25 : 478|2@0+ (1,0) [0|3] ""  Vector__XXX
 SG_ FRM_15_ObjElevnStsConf_25 : 476|7@0+ (1,0) [0|100] "%"  Vector__XXX
 SG_ FRM_15_ObjHeading_25 : 485|12@0+ (0.1,-180) [-180|180] "deg"  Vector__XXX

BO_ 975 FRM_16: 64 FRM_FM_4X
 SG_ FRM_16_CRC : 7|16@0+ (1,0) [0|65535] ""  Vector__XXX
 SG_ FRM_16_RollgCntr : 23|8@0+ (1,0) [0|255] ""  Vector__XXX
 SG_ FRM_16_ObjBlockCounter : 31|4@0+ (1,0) [0|15] ""  Vector__XXX
 SG_ FRM_16_ObjID_26 : 39|8@0+ (1,0) [0|255] ""  Vector__XXX
 SG_ FRM_16_ObjClosestDistX_26 : 47|15@0+ (0.01,0) [0|200] "m"  Vector__XXX
 SG_ FRM_16_ObjClosestDistY_26 : 63|15@0+ (0.01,-100) [-100|100] "m"  Vector__XXX
 SG_ FRM_16_ObjRelVelX_26 : 79|15@0+ (0.01,-100) [-100|80] "m/s"  Vector__XXX
 SG_ FRM_16_ObjRelVelY_26 : 95|15@0+ (0.01,-100) [-100|80] "m/s"  Vector__XXX
 SG_ FRM_16_ObjAccelX_26 : 111|13@0+ (0.01,-25) [-25|25] "m/s^2"  Vector__XXX
 SG_ FRM_16_ObjAccelY_26 : 114|13@0+ (0.01,-25) [-25|25] "m/s^2"  Vector__XXX
 SG_ FRM_16_ObjClosestDistXStd_26 : 133|6@0+ (0.1,0) [0|5] ""  Vector__XXX
 SG_ FRM_16_ObjClosestDistYStd_26 : 143|6@0+ (0.1,0) [0|5] ""  Vector__XXX
 SG_ FRM_16_ObjRelVelXStd_26 : 137|7@0+ (0.05,0) [0|4] ""  Vector__XXX
 SG_ FRM_16_ObjRelVelYStd_26 : 146|7@0+ (0.05,0) [0|4] ""  Vector__XXX
 SG_ FRM_16_ObjRelAccelXStd_26 : 155|6@0+ (0.05,0) [0|3] ""  Vector__XXX
 SG_ FRM_16_ObjRelAccelYStd_26 : 165|6@0+ (0.05,0) [0|3] ""  Vector__XXX
 SG_ FRM_16_ObjExistProb_26 : 175|7@0+ (1,0) [0|100] "%"  Vector__XXX
 SG_ FRM_16_ObjType_26 : 168|2@0+ (1,0) [0|3] ""  Vector__XXX
 SG_ FRM_16_ObjTypeConf_26 : 182|7@0+ (1,0) [0|100] "%"  Vector__XXX
 SG_ FRM_16_ObjTrackSts_26 : 191|2@0+ (1,0) [0|3] ""  Vector__XXX
 SG_ FRM_16_ObjMotionSts_26 : 189|2@0+ (1,0) [0|3] ""  Vector__XXX
 SG_ FRM_16_ObjMotionDirection_26 : 187|2@0+ (1,0) [0|3] ""  Vector__XXX
 SG_ FRM_16_ObjCenterDistX_26 : 199|15@0+ (0.01,0) [0|200] "m"  Vector__XXX
 SG_ FRM_16_ObjCenterDistY_26 : 215|15@0+ (0.01,-100) [-100|100] "m"  Vector__XXX
 SG_ FRM_16_ObjLength_26 : 216|9@0+ (0.1,0) [0|50] "m"  Vector__XXX
 SG_ FRM_16_ObjWidth_26 : 239|9@0+ (0.1,0) [0|30] "m"  Vector__XXX
 SG_ FRM_16_ObjElevnSts_26 : 246|2@0+ (1,0) [0|3] ""  Vector__XXX
 SG_ FRM_16_ObjElevnStsConf_26 : 244|7@0+ (1,0) [0|100] "%"  Vector__XXX
 SG_ FRM_16_ObjHeading_26 : 253|12@0+ (0.1,-180) [-180|180] "deg"  Vector__XXX
 SG_ FRM_16_ObjID_27 : 271|8@0+ (1,0) [0|255] ""  Vector__XXX
 SG_ FRM_16_ObjClosestDistX_27 : 279|15@0+ (0.01,0) [0|200] "m"  Vector__XXX
 SG_ FRM_16_ObjClosestDistY_27 : 295|15@0+ (0.01,-100) [-100|100] "m"  Vector__XXX
 SG_ FRM_16_ObjRelVelX_27 : 311|15@0+ (0.01,-100) [-100|80] "m/s"  Vector__XXX
 SG_ FRM_16_ObjRelVelY_27 : 327|15@0+ (0.01,-100) [-100|80] "m/s"  Vector__XXX
 SG_ FRM_16_ObjAccelX_27 : 343|13@0+ (0.01,-25) [-25|25] "m/s^2"  Vector__XXX
 SG_ FRM_16_ObjAccelY_27 : 346|13@0+ (0.01,-25) [-25|25] "m/s^2"  Vector__XXX
 SG_ FRM_16_ObjClosestDistXStd_27 : 365|6@0+ (0.1,0) [0|5] ""  Vector__XXX
 SG_ FRM_16_ObjClosestDistYStd_27 : 375|6@0+ (0.1,0) [0|5] ""  Vector__XXX
 SG_ FRM_16_ObjRelVelXStd_27 : 369|7@0+ (0.05,0) [0|4] ""  Vector__XXX
 SG_ FRM_16_ObjRelVelYStd_27 : 378|7@0+ (0.05,0) [0|4] ""  Vector__XXX
 SG_ FRM_16_ObjRelAccelXStd_27 : 387|6@0+ (0.05,0) [0|3] ""  Vector__XXX
 SG_ FRM_16_ObjRelAccelYStd_27 : 397|6@0+ (0.05,0) [0|3] ""  Vector__XXX
 SG_ FRM_16_ObjExistProb_27 : 407|7@0+ (1,0) [0|100] "%"  Vector__XXX
 SG_ FRM_16_ObjType_27 : 400|2@0+ (1,0) [0|3] ""  Vector__XXX
 SG_ FRM_16_ObjTypeConf_27 : 414|7@0+ (1,0) [0|100] "%"  Vector__XXX
 SG_ FRM_16_ObjTrackSts_27 : 423|2@0+ (1,0) [0|3] ""  Vector__XXX
 SG_ FRM_16_ObjMotionSts_27 : 421|2@0+ (1,0) [0|3] ""  Vector__XXX
 SG_ FRM_16_ObjMotionDirection_27 : 419|2@0+ (1,0) [0|3] ""  Vector__XXX
 SG_ FRM_16_ObjCenterDistX_27 : 431|15@0+ (0.01,0) [0|200] "m"  Vector__XXX
 SG_ FRM_16_ObjCenterDistY_27 : 447|15@0+ (0.01,-100) [-100|100] "m"  Vector__XXX
 SG_ FRM_16_ObjLength_27 : 448|9@0+ (0.1,0) [0|50] "m"  Vector__XXX
 SG_ FRM_16_ObjWidth_27 : 471|9@0+ (0.1,0) [0|30] "m"  Vector__XXX
 SG_ FRM_16_ObjElevnSts_27 : 478|2@0+ (1,0) [0|3] ""  Vector__XXX
 SG_ FRM_16_ObjElevnStsConf_27 : 476|7@0+ (1,0) [0|100] "%"  Vector__XXX
 SG_ FRM_16_ObjHeading_27 : 485|12@0+ (0.1,-180) [-180|180] "deg"  Vector__XXX

BO_ 976 FRM_17: 64 FRM_FM_4X
 SG_ FRM_17_CRC : 7|16@0+ (1,0) [0|65535] ""  Vector__XXX
 SG_ FRM_17_RollgCntr : 23|8@0+ (1,0) [0|255] ""  Vector__XXX
 SG_ FRM_17_ObjBlockCounter : 31|4@0+ (1,0) [0|15] ""  Vector__XXX
 SG_ FRM_17_ObjID_28 : 39|8@0+ (1,0) [0|255] ""  Vector__XXX
 SG_ FRM_17_ObjClosestDistX_28 : 47|15@0+ (0.01,0) [0|200] "m"  Vector__XXX
 SG_ FRM_17_ObjClosestDistY_28 : 63|15@0+ (0.01,-100) [-100|100] "m"  Vector__XXX
 SG_ FRM_17_ObjRelVelX_28 : 79|15@0+ (0.01,-100) [-100|80] "m/s"  Vector__XXX
 SG_ FRM_17_ObjRelVelY_28 : 95|15@0+ (0.01,-100) [-100|80] "m/s"  Vector__XXX
 SG_ FRM_17_ObjAccelX_28 : 111|13@0+ (0.01,-25) [-25|25] "m/s^2"  Vector__XXX
 SG_ FRM_17_ObjAccelY_28 : 114|13@0+ (0.01,-25) [-25|25] "m/s^2"  Vector__XXX
 SG_ FRM_17_ObjClosestDistXStd_28 : 133|6@0+ (0.1,0) [0|5] ""  Vector__XXX
 SG_ FRM_17_ObjClosestDistYStd_28 : 143|6@0+ (0.1,0) [0|5] ""  Vector__XXX
 SG_ FRM_17_ObjRelVelXStd_28 : 137|7@0+ (0.05,0) [0|4] ""  Vector__XXX
 SG_ FRM_17_ObjRelVelYStd_28 : 146|7@0+ (0.05,0) [0|4] ""  Vector__XXX
 SG_ FRM_17_ObjRelAccelXStd_28 : 155|6@0+ (0.05,0) [0|3] ""  Vector__XXX
 SG_ FRM_17_ObjRelAccelYStd_28 : 165|6@0+ (0.05,0) [0|3] ""  Vector__XXX
 SG_ FRM_17_ObjExistProb_28 : 175|7@0+ (1,0) [0|100] "%"  Vector__XXX
 SG_ FRM_17_ObjType_28 : 168|2@0+ (1,0) [0|3] ""  Vector__XXX
 SG_ FRM_17_ObjTypeConf_28 : 182|7@0+ (1,0) [0|100] "%"  Vector__XXX
 SG_ FRM_17_ObjTrackSts_28 : 191|2@0+ (1,0) [0|3] ""  Vector__XXX
 SG_ FRM_17_ObjMotionSts_28 : 189|2@0+ (1,0) [0|3] ""  Vector__XXX
 SG_ FRM_17_ObjMotionDirection_28 : 187|2@0+ (1,0) [0|3] ""  Vector__XXX
 SG_ FRM_17_ObjCenterDistX_28 : 199|15@0+ (0.01,0) [0|200] "m"  Vector__XXX
 SG_ FRM_17_ObjCenterDistY_28 : 215|15@0+ (0.01,-100) [-100|100] "m"  Vector__XXX
 SG_ FRM_17_ObjLength_28 : 216|9@0+ (0.1,0) [0|50] "m"  Vector__XXX
 SG_ FRM_17_ObjWidth_28 : 239|9@0+ (0.1,0) [0|30] "m"  Vector__XXX
 SG_ FRM_17_ObjElevnSts_28 : 246|2@0+ (1,0) [0|3] ""  Vector__XXX
 SG_ FRM_17_ObjElevnStsConf_28 : 244|7@0+ (1,0) [0|100] "%"  Vector__XXX
 SG_ FRM_17_ObjHeading_28 : 253|12@0+ (0.1,-180) [-180|180] "deg"  Vector__XXX
 SG_ FRM_17_ObjID_29 : 271|8@0+ (1,0) [0|255] ""  Vector__XXX
 SG_ FRM_17_ObjClosestDistX_29 : 279|15@0+ (0.01,0) [0|200] "m"  Vector__XXX
 SG_ FRM_17_ObjClosestDistY_29 : 295|15@0+ (0.01,-100) [-100|100] "m"  Vector__XXX
 SG_ FRM_17_ObjRelVelX_29 : 311|15@0+ (0.01,-100) [-100|80] "m/s"  Vector__XXX
 SG_ FRM_17_ObjRelVelY_29 : 327|15@0+ (0.01,-100) [-100|80] "m/s"  Vector__XXX
 SG_ FRM_17_ObjAccelX_29 : 343|13@0+ (0.01,-25) [-25|25] "m/s^2"  Vector__XXX
 SG_ FRM_17_ObjAccelY_29 : 346|13@0+ (0.01,-25) [-25|25] "m/s^2"  Vector__XXX
 SG_ FRM_17_ObjClosestDistXStd_29 : 365|6@0+ (0.1,0) [0|5] ""  Vector__XXX
 SG_ FRM_17_ObjClosestDistYStd_29 : 375|6@0+ (0.1,0) [0|5] ""  Vector__XXX
 SG_ FRM_17_ObjRelVelXStd_29 : 369|7@0+ (0.05,0) [0|4] ""  Vector__XXX
 SG_ FRM_17_ObjRelVelYStd_29 : 378|7@0+ (0.05,0) [0|4] ""  Vector__XXX
 SG_ FRM_17_ObjRelAccelXStd_29 : 387|6@0+ (0.05,0) [0|3] ""  Vector__XXX
 SG_ FRM_17_ObjRelAccelYStd_29 : 397|6@0+ (0.05,0) [0|3] ""  Vector__XXX
 SG_ FRM_17_ObjExistProb_29 : 407|7@0+ (1,0) [0|100] "%"  Vector__XXX
 SG_ FRM_17_ObjType_29 : 400|2@0+ (1,0) [0|3] ""  Vector__XXX
 SG_ FRM_17_ObjTypeConf_29 : 414|7@0+ (1,0) [0|100] "%"  Vector__XXX
 SG_ FRM_17_ObjTrackSts_29 : 423|2@0+ (1,0) [0|3] ""  Vector__XXX
 SG_ FRM_17_ObjMotionSts_29 : 421|2@0+ (1,0) [0|3] ""  Vector__XXX
 SG_ FRM_17_ObjMotionDirection_29 : 419|2@0+ (1,0) [0|3] ""  Vector__XXX
 SG_ FRM_17_ObjCenterDistX_29 : 431|15@0+ (0.01,0) [0|200] "m"  Vector__XXX
 SG_ FRM_17_ObjCenterDistY_29 : 447|15@0+ (0.01,-100) [-100|100] "m"  Vector__XXX
 SG_ FRM_17_ObjLength_29 : 448|9@0+ (0.1,0) [0|50] "m"  Vector__XXX
 SG_ FRM_17_ObjWidth_29 : 471|9@0+ (0.1,0) [0|30] "m"  Vector__XXX
 SG_ FRM_17_ObjElevnSts_29 : 478|2@0+ (1,0) [0|3] ""  Vector__XXX
 SG_ FRM_17_ObjElevnStsConf_29 : 476|7@0+ (1,0) [0|100] "%"  Vector__XXX
 SG_ FRM_17_ObjHeading_29 : 485|12@0+ (0.1,-180) [-180|180] "deg"  Vector__XXX

BO_ 977 FRM_18: 64 FRM_FM_4X
 SG_ FRM_18_CRC : 7|16@0+ (1,0) [0|65535] ""  Vector__XXX
 SG_ FRM_18_RollgCntr : 23|8@0+ (1,0) [0|255] ""  Vector__XXX
 SG_ FRM_18_ObjBlockCounter : 31|4@0+ (1,0) [0|15] ""  Vector__XXX
 SG_ FRM_18_ObjID_30 : 39|8@0+ (1,0) [0|255] ""  Vector__XXX
 SG_ FRM_18_ObjClosestDistX_30 : 47|15@0+ (0.01,0) [0|200] "m"  Vector__XXX
 SG_ FRM_18_ObjClosestDistY_30 : 63|15@0+ (0.01,-100) [-100|100] "m"  Vector__XXX
 SG_ FRM_18_ObjRelVelX_30 : 79|15@0+ (0.01,-100) [-100|80] "m/s"  Vector__XXX
 SG_ FRM_18_ObjRelVelY_30 : 95|15@0+ (0.01,-100) [-100|80] "m/s"  Vector__XXX
 SG_ FRM_18_ObjAccelX_30 : 111|13@0+ (0.01,-25) [-25|25] "m/s^2"  Vector__XXX
 SG_ FRM_18_ObjAccelY_30 : 114|13@0+ (0.01,-25) [-25|25] "m/s^2"  Vector__XXX
 SG_ FRM_18_ObjClosestDistXStd_30 : 133|6@0+ (0.1,0) [0|5] ""  Vector__XXX
 SG_ FRM_18_ObjClosestDistYStd_30 : 143|6@0+ (0.1,0) [0|5] ""  Vector__XXX
 SG_ FRM_18_ObjRelVelXStd_30 : 137|7@0+ (0.05,0) [0|4] ""  Vector__XXX
 SG_ FRM_18_ObjRelVelYStd_30 : 146|7@0+ (0.05,0) [0|4] ""  Vector__XXX
 SG_ FRM_18_ObjRelAccelXStd_30 : 155|6@0+ (0.05,0) [0|3] ""  Vector__XXX
 SG_ FRM_18_ObjRelAccelYStd_30 : 165|6@0+ (0.05,0) [0|3] ""  Vector__XXX
 SG_ FRM_18_ObjExistProb_30 : 175|7@0+ (1,0) [0|100] "%"  Vector__XXX
 SG_ FRM_18_ObjType_30 : 168|2@0+ (1,0) [0|3] ""  Vector__XXX
 SG_ FRM_18_ObjTypeConf_30 : 182|7@0+ (1,0) [0|100] "%"  Vector__XXX
 SG_ FRM_18_ObjTrackSts_30 : 191|2@0+ (1,0) [0|3] ""  Vector__XXX
 SG_ FRM_18_ObjMotionSts_30 : 189|2@0+ (1,0) [0|3] ""  Vector__XXX
 SG_ FRM_18_ObjMotionDirection_30 : 187|2@0+ (1,0) [0|3] ""  Vector__XXX
 SG_ FRM_18_ObjCenterDistX_30 : 199|15@0+ (0.01,0) [0|200] "m"  Vector__XXX
 SG_ FRM_18_ObjCenterDistY_30 : 215|15@0+ (0.01,-100) [-100|100] "m"  Vector__XXX
 SG_ FRM_18_ObjLength_30 : 216|9@0+ (0.1,0) [0|50] "m"  Vector__XXX
 SG_ FRM_18_ObjWidth_30 : 239|9@0+ (0.1,0) [0|30] "m"  Vector__XXX
 SG_ FRM_18_ObjElevnSts_30 : 246|2@0+ (1,0) [0|3] ""  Vector__XXX
 SG_ FRM_18_ObjElevnStsConf_30 : 244|7@0+ (1,0) [0|100] "%"  Vector__XXX
 SG_ FRM_18_ObjHeading_30 : 253|12@0+ (0.1,-180) [-180|180] "deg"  Vector__XXX
 SG_ FRM_18_ObjID_31 : 271|8@0+ (1,0) [0|255] ""  Vector__XXX
 SG_ FRM_18_ObjClosestDistX_31 : 279|15@0+ (0.01,0) [0|200] "m"  Vector__XXX
 SG_ FRM_18_ObjClosestDistY_31 : 295|15@0+ (0.01,-100) [-100|100] "m"  Vector__XXX
 SG_ FRM_18_ObjRelVelX_31 : 311|15@0+ (0.01,-100) [-100|80] "m/s"  Vector__XXX
 SG_ FRM_18_ObjRelVelY_31 : 327|15@0+ (0.01,-100) [-100|80] "m/s"  Vector__XXX
 SG_ FRM_18_ObjAccelX_31 : 343|13@0+ (0.01,-25) [-25|25] "m/s^2"  Vector__XXX
 SG_ FRM_18_ObjAccelY_31 : 346|13@0+ (0.01,-25) [-25|25] "m/s^2"  Vector__XXX
 SG_ FRM_18_ObjClosestDistXStd_31 : 365|6@0+ (0.1,0) [0|5] ""  Vector__XXX
 SG_ FRM_18_ObjClosestDistYStd_31 : 375|6@0+ (0.1,0) [0|5] ""  Vector__XXX
 SG_ FRM_18_ObjRelVelXStd_31 : 369|7@0+ (0.05,0) [0|4] ""  Vector__XXX
 SG_ FRM_18_ObjRelVelYStd_31 : 378|7@0+ (0.05,0) [0|4] ""  Vector__XXX
 SG_ FRM_18_ObjRelAccelXStd_31 : 387|6@0+ (0.05,0) [0|3] ""  Vector__XXX
 SG_ FRM_18_ObjRelAccelYStd_31 : 397|6@0+ (0.05,0) [0|3] ""  Vector__XXX
 SG_ FRM_18_ObjExistProb_31 : 407|7@0+ (1,0) [0|100] "%"  Vector__XXX
 SG_ FRM_18_ObjType_31 : 400|2@0+ (1,0) [0|3] ""  Vector__XXX
 SG_ FRM_18_ObjTypeConf_31 : 414|7@0+ (1,0) [0|100] "%"  Vector__XXX
 SG_ FRM_18_ObjTrackSts_31 : 423|2@0+ (1,0) [0|3] ""  Vector__XXX
 SG_ FRM_18_ObjMotionSts_31 : 421|2@0+ (1,0) [0|3] ""  Vector__XXX
 SG_ FRM_18_ObjMotionDirection_31 : 419|2@0+ (1,0) [0|3] ""  Vector__XXX
 SG_ FRM_18_ObjCenterDistX_31 : 431|15@0+ (0.01,0) [0|200] "m"  Vector__XXX
 SG_ FRM_18_ObjCenterDistY_31 : 447|15@0+ (0.01,-100) [-100|100] "m"  Vector__XXX
 SG_ FRM_18_ObjLength_31 : 448|9@0+ (0.1,0) [0|50] "m"  Vector__XXX
 SG_ FRM_18_ObjWidth_31 : 471|9@0+ (0.1,0) [0|30] "m"  Vector__XXX
 SG_ FRM_18_ObjElevnSts_31 : 478|2@0+ (1,0) [0|3] ""  Vector__XXX
 SG_ FRM_18_ObjElevnStsConf_31 : 476|7@0+ (1,0) [0|100] "%"  Vector__XXX
 SG_ FRM_18_ObjHeading_31 : 485|12@0+ (0.1,-180) [-180|180] "deg"  Vector__XXX

BO_ 978 FRM_19: 64 FRM_FM_4X
 SG_ FRM_19_CRC : 7|16@0+ (1,0) [0|65535] ""  Vector__XXX
 SG_ FRM_19_RollgCntr : 23|8@0+ (1,0) [0|255] ""  Vector__XXX
 SG_ FRM_19_ObjBlockCounter : 31|4@0+ (1,0) [0|15] ""  Vector__XXX
 SG_ FRM_19_ObjID_32 : 39|8@0+ (1,0) [0|255] ""  Vector__XXX
 SG_ FRM_19_ObjClosestDistX_32 : 47|15@0+ (0.01,0) [0|200] "m"  Vector__XXX
 SG_ FRM_19_ObjClosestDistY_32 : 63|15@0+ (0.01,-100) [-100|100] "m"  Vector__XXX
 SG_ FRM_19_ObjRelVelX_32 : 79|15@0+ (0.01,-100) [-100|80] "m/s"  Vector__XXX
 SG_ FRM_19_ObjRelVelY_32 : 95|15@0+ (0.01,-100) [-100|80] "m/s"  Vector__XXX
 SG_ FRM_19_ObjAccelX_32 : 111|13@0+ (0.01,-25) [-25|25] "m/s^2"  Vector__XXX
 SG_ FRM_19_ObjAccelY_32 : 114|13@0+ (0.01,-25) [-25|25] "m/s^2"  Vector__XXX
 SG_ FRM_19_ObjClosestDistXStd_32 : 133|6@0+ (0.1,0) [0|5] ""  Vector__XXX
 SG_ FRM_19_ObjClosestDistYStd_32 : 143|6@0+ (0.1,0) [0|5] ""  Vector__XXX
 SG_ FRM_19_ObjRelVelXStd_32 : 137|7@0+ (0.05,0) [0|4] ""  Vector__XXX
 SG_ FRM_19_ObjRelVelYStd_32 : 146|7@0+ (0.05,0) [0|4] ""  Vector__XXX
 SG_ FRM_19_ObjRelAccelXStd_32 : 155|6@0+ (0.05,0) [0|3] ""  Vector__XXX
 SG_ FRM_19_ObjRelAccelYStd_32 : 165|6@0+ (0.05,0) [0|3] ""  Vector__XXX
 SG_ FRM_19_ObjExistProb_32 : 175|7@0+ (1,0) [0|100] "%"  Vector__XXX
 SG_ FRM_19_ObjType_32 : 168|2@0+ (1,0) [0|3] ""  Vector__XXX
 SG_ FRM_19_ObjTypeConf_32 : 182|7@0+ (1,0) [0|100] "%"  Vector__XXX
 SG_ FRM_19_ObjTrackSts_32 : 191|2@0+ (1,0) [0|3] ""  Vector__XXX
 SG_ FRM_19_ObjMotionSts_32 : 189|2@0+ (1,0) [0|3] ""  Vector__XXX
 SG_ FRM_19_ObjMotionDirection_32 : 187|2@0+ (1,0) [0|3] ""  Vector__XXX
 SG_ FRM_19_ObjCenterDistX_32 : 199|15@0+ (0.01,0) [0|200] "m"  Vector__XXX
 SG_ FRM_19_ObjCenterDistY_32 : 215|15@0+ (0.01,-100) [-100|100] "m"  Vector__XXX
 SG_ FRM_19_ObjLength_32 : 216|9@0+ (0.1,0) [0|50] "m"  Vector__XXX
 SG_ FRM_19_ObjWidth_32 : 239|9@0+ (0.1,0) [0|30] "m"  Vector__XXX
 SG_ FRM_19_ObjElevnSts_32 : 246|2@0+ (1,0) [0|3] ""  Vector__XXX
 SG_ FRM_19_ObjElevnStsConf_32 : 244|7@0+ (1,0) [0|100] "%"  Vector__XXX
 SG_ FRM_19_ObjHeading_32 : 253|12@0+ (0.1,-180) [-180|180] "deg"  Vector__XXX
 SG_ FRM_19_ObjID_33 : 271|8@0+ (1,0) [0|255] ""  Vector__XXX
 SG_ FRM_19_ObjClosestDistX_33 : 279|15@0+ (0.01,0) [0|200] "m"  Vector__XXX
 SG_ FRM_19_ObjClosestDistY_33 : 295|15@0+ (0.01,-100) [-100|100] "m"  Vector__XXX
 SG_ FRM_19_ObjRelVelX_33 : 311|15@0+ (0.01,-100) [-100|80] "m/s"  Vector__XXX
 SG_ FRM_19_ObjRelVelY_33 : 327|15@0+ (0.01,-100) [-100|80] "m/s"  Vector__XXX
 SG_ FRM_19_ObjAccelX_33 : 343|13@0+ (0.01,-25) [-25|25] "m/s^2"  Vector__XXX
 SG_ FRM_19_ObjAccelY_33 : 346|13@0+ (0.01,-25) [-25|25] "m/s^2"  Vector__XXX
 SG_ FRM_19_ObjClosestDistXStd_33 : 365|6@0+ (0.1,0) [0|5] ""  Vector__XXX
 SG_ FRM_19_ObjClosestDistYStd_33 : 375|6@0+ (0.1,0) [0|5] ""  Vector__XXX
 SG_ FRM_19_ObjRelVelXStd_33 : 369|7@0+ (0.05,0) [0|4] ""  Vector__XXX
 SG_ FRM_19_ObjRelVelYStd_33 : 378|7@0+ (0.05,0) [0|4] ""  Vector__XXX
 SG_ FRM_19_ObjRelAccelXStd_33 : 387|6@0+ (0.05,0) [0|3] ""  Vector__XXX
 SG_ FRM_19_ObjRelAccelYStd_33 : 397|6@0+ (0.05,0) [0|3] ""  Vector__XXX
 SG_ FRM_19_ObjExistProb_33 : 407|7@0+ (1,0) [0|100] "%"  Vector__XXX
 SG_ FRM_19_ObjType_33 : 400|2@0+ (1,0) [0|3] ""  Vector__XXX
 SG_ FRM_19_ObjTypeConf_33 : 414|7@0+ (1,0) [0|100] "%"  Vector__XXX
 SG_ FRM_19_ObjTrackSts_33 : 423|2@0+ (1,0) [0|3] ""  Vector__XXX
 SG_ FRM_19_ObjMotionSts_33 : 421|2@0+ (1,0) [0|3] ""  Vector__XXX
 SG_ FRM_19_ObjMotionDirection_33 : 419|2@0+ (1,0) [0|3] ""  Vector__XXX
 SG_ FRM_19_ObjCenterDistX_33 : 431|15@0+ (0.01,0) [0|200] "m"  Vector__XXX
 SG_ FRM_19_ObjCenterDistY_33 : 447|15@0+ (0.01,-100) [-100|100] "m"  Vector__XXX
 SG_ FRM_19_ObjLength_33 : 448|9@0+ (0.1,0) [0|50] "m"  Vector__XXX
 SG_ FRM_19_ObjWidth_33 : 471|9@0+ (0.1,0) [0|30] "m"  Vector__XXX
 SG_ FRM_19_ObjElevnSts_33 : 478|2@0+ (1,0) [0|3] ""  Vector__XXX
 SG_ FRM_19_ObjElevnStsConf_33 : 476|7@0+ (1,0) [0|100] "%"  Vector__XXX
 SG_ FRM_19_ObjHeading_33 : 485|12@0+ (0.1,-180) [-180|180] "deg"  Vector__XXX

CM_ SG_ 970 FRM_11_CRC "Profile5:E2E CRC16 (polynomial:0x1021)       
DataID:Use CANID,other bits Fill with 0";
CM_ SG_ 970 FRM_11_RollgCntr "Profile5:E2E Rolling message counter";
CM_ SG_ 970 FRM_11_ObjBlockCounter "Front Radar Moudle_X_Object Block Counter
前雷达目标物块计数值";
CM_ SG_ 970 FRM_11_ObjID_16 "Front Radar Moudle_X_Object ID_00
前雷达目标物身份标识码_00
ID Is An Identifier Number That Allows For Tracking Of Persistent Objects Over Time
Note:A value of 0 indicates 'no object'";
CM_ SG_ 970 FRM_11_ObjClosestDistX_16 "Front Radar Moudle_X_Object Closest Distance X_00
前雷达目标物最近点在X轴上的距离_00
Closest Position Of Target Vehicle In X Direction
The rear axle center coordinate system is used";
CM_ SG_ 970 FRM_11_ObjClosestDistY_16 "Front Radar Moudle_X_Object Closest Distance Y_00
前雷达距目标物最近点在Y轴上的距离_00
Closest Position Of Target Vehicle In Y Direction
The rear axle center coordinate system is used";
CM_ SG_ 970 FRM_11_ObjRelVelX_16 "Front Radar Moudle_X_Object Relative Velocity X_00
前雷达目标物在X轴上的相对速度_00
Relative Target Object Velocity In X Direction";
CM_ SG_ 970 FRM_11_ObjRelVelY_16 "Front Radar Moudle_X_Object Relative Velocity Y_00
前雷达目标物在Y轴上的相对速度_00
Relative Target Object Velocity In Y Direction";
CM_ SG_ 970 FRM_11_ObjAccelX_16 "Front Radar Moudle_X_Object Acceleration X_00
前雷达目标物在X轴上的加速度_00
Relative Target Object Acceleration In X Direction";
CM_ SG_ 970 FRM_11_ObjAccelY_16 "Front Radar Moudle_X_Object Acceleration Y_00
前雷达目标物在Y轴上的加速度_00
Relative Target Object Acceleration In Y Direction";
CM_ SG_ 970 FRM_11_ObjClosestDistXStd_16 "Front Radar Moudle_X_Object Closest Distance X Standard_00
前雷达目标物最近点在X轴上的距离的标准差_00
Standard Deviation Of Closest Position Of Target Vehicle in X Direction";
CM_ SG_ 970 FRM_11_ObjClosestDistYStd_16 "Front Radar Moudle_X_Object Closest Distance Y Standard_00
前雷达目标物最近点在Y轴上的距离的标准差_00
Standard Deviation Of Closest Position Of Target Vehicle in Y Direction";
CM_ SG_ 970 FRM_11_ObjRelVelXStd_16 "Front Radar Moudle_X_Object Relative Velocity X Standard_00
前雷达目标物在X轴上的相对速度的标准差_00
Standard Deviation Of Relative Velocity X";
CM_ SG_ 970 FRM_11_ObjRelVelYStd_16 "Front Radar Moudle_X_Object Relative Velocity Y Standard_00
前雷达目标物在Y轴上的相对速度的标准差_00
Standard Deviation Of Relative Velocity Y";
CM_ SG_ 970 FRM_11_ObjRelAccelXStd_16 "Front Radar Moudle_X_Object Relative  Acceleration X Standard_00
前雷达目标物在X轴上的相对加速度的标准差_00
Standard Deviation Of Relative Acceleration X";
CM_ SG_ 970 FRM_11_ObjRelAccelYStd_16 "Front Radar Moudle_X_Object Relative  Acceleration Y Standard_00
前雷达目标物相对加速度在Y轴上的标准差_00
Standard Deviation Of Relative Acceleration Y";
CM_ SG_ 970 FRM_11_ObjExistProb_16 "Front Radar Moudle_X_Object Exist Probability_00
前雷达目标物存在的可能性_00
The Probability Of An Object To Exist In Reality";
CM_ SG_ 970 FRM_11_ObjType_16 "Front Radar Moudle_X_Object Type_00
前雷达目标物的分类_00
Class Of Object Type
Note: Type of static object shall always be 0x0: unknown";
CM_ SG_ 970 FRM_11_ObjTypeConf_16 "Front Radar Moudle_X_Object Type Confidence_00
前雷达目标物分类的置信度_00
The Class Confidence Of Object Type";
CM_ SG_ 970 FRM_11_ObjTrackSts_16 "Front Radar Moudle_X_Object Track Status_00
前雷达目标物的跟踪状态_00
Signal To Indicate The Object Track Status";
CM_ SG_ 970 FRM_11_ObjMotionSts_16 "Front Radar Moudle_X_Object Motion Status_00
前雷达目标物的运动状态_00
Signal To Indicate The Object Whether Moving or Stopped or Static";
CM_ SG_ 970 FRM_11_ObjMotionDirection_16 "Front Radar Moudle_X_Object Motion Direction_00
前雷达目标物的运动方向_00
Signal To Indicate The Object Moving Direction.
Note: Moving direction of static object or stopped object shall always be 0x0: Unknown";
CM_ SG_ 970 FRM_11_ObjCenterDistX_16 "Front Radar Moudle_X_Object Center Distance X_00
前雷达目标物中心点在X轴方向的距离_00
Center Position Of Target Vehicle In X Direction
The rear axle center coordinate system is used";
CM_ SG_ 970 FRM_11_ObjCenterDistY_16 "Front Radar Moudle_X_Object Center Distance Y_00
前雷达目标物中心点在Y轴方向的距离_00
Center Position Of Target Vehicle In Y Direction
The rear axle center coordinate system is used";
CM_ SG_ 970 FRM_11_ObjLength_16 "Front Radar Moudle_X_Object Length_00
前雷达目标物的长度_00
Length Of Target
Note: Length of static object shall always be 0";
CM_ SG_ 970 FRM_11_ObjWidth_16 "Front Radar Moudle_X_Object Width_00
前雷达目标物的宽度_00
Width Of Target
Note: Width of static object shall always be 0";
CM_ SG_ 970 FRM_11_ObjElevnSts_16 "Front Radar Moudle_X_Object Elevation Status_00
前雷达目标物的高度状态_00
The Elevation Status Of An Object
Note: Elevation Status of moving object or stopped object shall always be 0x2: Obstacle";
CM_ SG_ 970 FRM_11_ObjElevnStsConf_16 "Front Radar Moudle_X_Object Elevation Status Confidence_00
前雷达目标物的高度状态的置信度_00
The Confidence Of An Object Elevation Status
Note: Elevation Status Confidence of moving object or stopped object shall always be 100%";
CM_ SG_ 970 FRM_11_ObjHeading_16 "Front Radar Moudle_X_Object Heading_00
前雷达目标物朝向_00
Heading of object 
Note: A rotation vector with anticlock-rotating as positive +π shall be used instead of -π when obect vertically backward
Note: Heading of static object shall always be 0";
CM_ SG_ 970 FRM_11_ObjID_17 "Front Radar Moudle_X_Object ID_01
前雷达目标物身份标识码_01
ID Is An Identifier Number That Allows For Tracking Of Persistent Objects Over Time
Note:A value of 0 indicates 'no object'";
CM_ SG_ 970 FRM_11_ObjClosestDistX_17 "Front Radar Moudle_X_Object Closest Distance X_01
前雷达目标物最近点在X轴上的距离_01
Closest Position Of Target Vehicle In X Direction
The rear axle center coordinate system is used";
CM_ SG_ 970 FRM_11_ObjClosestDistY_17 "Front Radar Moudle_X_Object Closest Distance Y_01
前雷达距目标物最近点在Y轴上的距离_01
Closest Position Of Target Vehicle In Y Direction
The rear axle center coordinate system is used";
CM_ SG_ 970 FRM_11_ObjRelVelX_17 "Front Radar Moudle_X_Object Relative Velocity X_01
前雷达目标物在X轴上的相对速度_01
Relative Target Object Velocity In X Direction";
CM_ SG_ 970 FRM_11_ObjRelVelY_17 "Front Radar Moudle_X_Object Relative Velocity Y_01
前雷达目标物在Y轴上的相对速度_01
Relative Target Object Velocity In Y Direction";
CM_ SG_ 970 FRM_11_ObjAccelX_17 "Front Radar Moudle_X_Object Acceleration X_01
前雷达目标物在X轴上的加速度_01
Relative Target Object Acceleration In X Direction";
CM_ SG_ 970 FRM_11_ObjAccelY_17 "Front Radar Moudle_X_Object Acceleration Y_01
前雷达目标物在Y轴上的加速度_01
Relative Target Object Acceleration In Y Direction";
CM_ SG_ 970 FRM_11_ObjClosestDistXStd_17 "Front Radar Moudle_X_Object Closest Distance X Standard_01
前雷达目标物最近点在X轴上的距离的标准差_01
Standard Deviation Of Closest Position Of Target Vehicle in X Direction";
CM_ SG_ 970 FRM_11_ObjClosestDistYStd_17 "Front Radar Moudle_X_Object Closest Distance Y Standard_01
前雷达目标物最近点在Y轴上的距离的标准差_01
Standard Deviation Of Closest Position Of Target Vehicle in Y Direction";
CM_ SG_ 970 FRM_11_ObjRelVelXStd_17 "Front Radar Moudle_X_Object Relative Velocity X Standard_01
前雷达目标物在X轴上的相对速度的标准差_01
Standard Deviation Of Relative Velocity X";
CM_ SG_ 970 FRM_11_ObjRelVelYStd_17 "Front Radar Moudle_X_Object Relative Velocity Y Standard_01
前雷达目标物在Y轴上的相对速度的标准差_01
Standard Deviation Of Relative Velocity Y";
CM_ SG_ 970 FRM_11_ObjRelAccelXStd_17 "Front Radar Moudle_X_Object Relative  Acceleration X Standard_01
前雷达目标物在X轴上的相对加速度的标准差_01
Standard Deviation Of Relative Acceleration X";
CM_ SG_ 970 FRM_11_ObjRelAccelYStd_17 "Front Radar Moudle_X_Object Relative  Acceleration Y Standard_01
前雷达目标物相对加速度在Y轴上的标准差_01
Standard Deviation Of Relative Acceleration Y";
CM_ SG_ 970 FRM_11_ObjExistProb_17 "Front Radar Moudle_X_Object Exist Probability_01
前雷达目标物存在的可能性_01
The Probability Of An Object To Exist In Reality";
CM_ SG_ 970 FRM_11_ObjType_17 "Front Radar Moudle_X_Object Type_01
前雷达目标物的分类_01
Class Of Object Type
Note: Type of static object shall always be 0x0: unknown";
CM_ SG_ 970 FRM_11_ObjTypeConf_17 "Front Radar Moudle_X_Object Type Confidence_01
前雷达目标物分类的置信度_01
The Class Confidence Of Object Type";
CM_ SG_ 970 FRM_11_ObjTrackSts_17 "Front Radar Moudle_X_Object Track Status_01
前雷达目标物的跟踪状态_01
Signal To Indicate The Object Track Status";
CM_ SG_ 970 FRM_11_ObjMotionSts_17 "Front Radar Moudle_X_Object Motion Status_01
前雷达目标物的运动状态_01
Signal To Indicate The Object Whether Moving or Stopped or Static";
CM_ SG_ 970 FRM_11_ObjMotionDirection_17 "Front Radar Moudle_X_Object Motion Direction_01
前雷达目标物的运动方向_01
Signal To Indicate The Object Moving Direction.
Note: Moving direction of static object or stopped object shall always be 0x0: Unknown";
CM_ SG_ 970 FRM_11_ObjCenterDistX_17 "Front Radar Moudle_X_Object Center Distance X_01
前雷达目标物中心点在X轴方向的距离_01
Center Position Of Target Vehicle In X Direction
The rear axle center coordinate system is used";
CM_ SG_ 970 FRM_11_ObjCenterDistY_17 "Front Radar Moudle_X_Object Center Distance Y_01
前雷达目标物中心点在Y轴方向的距离_01
Center Position Of Target Vehicle In Y Direction
The rear axle center coordinate system is used";
CM_ SG_ 970 FRM_11_ObjLength_17 "Front Radar Moudle_X_Object Length_01
前雷达目标物的长度_01
Length Of Target
Note: Length of static object shall always be 0";
CM_ SG_ 970 FRM_11_ObjWidth_17 "Front Radar Moudle_X_Object Width_01
前雷达目标物的宽度_01
Width Of Target
Note: Width of static object shall always be 0";
CM_ SG_ 970 FRM_11_ObjElevnSts_17 "Front Radar Moudle_X_Object Elevation Status_01
前雷达目标物的高度状态_01
The Elevation Status Of An Object
Note: Elevation Status of moving object or stopped object shall always be 0x2: Obstacle";
CM_ SG_ 970 FRM_11_ObjElevnStsConf_17 "Front Radar Moudle_X_Object Elevation Status Confidence_01
前雷达目标物的高度状态的置信度_01
The Confidence Of An Object Elevation Status
Note: Elevation Status Confidence of moving object or stopped object shall always be 100%";
CM_ SG_ 970 FRM_11_ObjHeading_17 "Front Radar Moudle_X_Object Heading_01
前雷达目标物朝向_01
Heading of object 
Note: A rotation vector with anticlock-rotating as positive +π shall be used instead of -π when obect vertically backward
Note: Heading of static object shall always be 0";
CM_ SG_ 971 FRM_12_CRC "Profile5:E2E CRC16 (polynomial:0x1021)       
DataID:Use CANID,other bits Fill with 0";
CM_ SG_ 971 FRM_12_RollgCntr "Profile5:E2E Rolling message counter";
CM_ SG_ 971 FRM_12_ObjBlockCounter "Front Radar Moudle_X_Object Block Counter
前雷达目标物块计数值";
CM_ SG_ 971 FRM_12_ObjID_18 "Front Radar Moudle_X_Object ID_00
前雷达目标物身份标识码_00
ID Is An Identifier Number That Allows For Tracking Of Persistent Objects Over Time
Note:A value of 0 indicates 'no object'";
CM_ SG_ 971 FRM_12_ObjClosestDistX_18 "Front Radar Moudle_X_Object Closest Distance X_00
前雷达目标物最近点在X轴上的距离_00
Closest Position Of Target Vehicle In X Direction
The rear axle center coordinate system is used";
CM_ SG_ 971 FRM_12_ObjClosestDistY_18 "Front Radar Moudle_X_Object Closest Distance Y_00
前雷达距目标物最近点在Y轴上的距离_00
Closest Position Of Target Vehicle In Y Direction
The rear axle center coordinate system is used";
CM_ SG_ 971 FRM_12_ObjRelVelX_18 "Front Radar Moudle_X_Object Relative Velocity X_00
前雷达目标物在X轴上的相对速度_00
Relative Target Object Velocity In X Direction";
CM_ SG_ 971 FRM_12_ObjRelVelY_18 "Front Radar Moudle_X_Object Relative Velocity Y_00
前雷达目标物在Y轴上的相对速度_00
Relative Target Object Velocity In Y Direction";
CM_ SG_ 971 FRM_12_ObjAccelX_18 "Front Radar Moudle_X_Object Acceleration X_00
前雷达目标物在X轴上的加速度_00
Relative Target Object Acceleration In X Direction";
CM_ SG_ 971 FRM_12_ObjAccelY_18 "Front Radar Moudle_X_Object Acceleration Y_00
前雷达目标物在Y轴上的加速度_00
Relative Target Object Acceleration In Y Direction";
CM_ SG_ 971 FRM_12_ObjClosestDistXStd_18 "Front Radar Moudle_X_Object Closest Distance X Standard_00
前雷达目标物最近点在X轴上的距离的标准差_00
Standard Deviation Of Closest Position Of Target Vehicle in X Direction";
CM_ SG_ 971 FRM_12_ObjClosestDistYStd_18 "Front Radar Moudle_X_Object Closest Distance Y Standard_00
前雷达目标物最近点在Y轴上的距离的标准差_00
Standard Deviation Of Closest Position Of Target Vehicle in Y Direction";
CM_ SG_ 971 FRM_12_ObjRelVelXStd_18 "Front Radar Moudle_X_Object Relative Velocity X Standard_00
前雷达目标物在X轴上的相对速度的标准差_00
Standard Deviation Of Relative Velocity X";
CM_ SG_ 971 FRM_12_ObjRelVelYStd_18 "Front Radar Moudle_X_Object Relative Velocity Y Standard_00
前雷达目标物在Y轴上的相对速度的标准差_00
Standard Deviation Of Relative Velocity Y";
CM_ SG_ 971 FRM_12_ObjRelAccelXStd_18 "Front Radar Moudle_X_Object Relative  Acceleration X Standard_00
前雷达目标物在X轴上的相对加速度的标准差_00
Standard Deviation Of Relative Acceleration X";
CM_ SG_ 971 FRM_12_ObjRelAccelYStd_18 "Front Radar Moudle_X_Object Relative  Acceleration Y Standard_00
前雷达目标物相对加速度在Y轴上的标准差_00
Standard Deviation Of Relative Acceleration Y";
CM_ SG_ 971 FRM_12_ObjExistProb_18 "Front Radar Moudle_X_Object Exist Probability_00
前雷达目标物存在的可能性_00
The Probability Of An Object To Exist In Reality";
CM_ SG_ 971 FRM_12_ObjType_18 "Front Radar Moudle_X_Object Type_00
前雷达目标物的分类_00
Class Of Object Type
Note: Type of static object shall always be 0x0: unknown";
CM_ SG_ 971 FRM_12_ObjTypeConf_18 "Front Radar Moudle_X_Object Type Confidence_00
前雷达目标物分类的置信度_00
The Class Confidence Of Object Type";
CM_ SG_ 971 FRM_12_ObjTrackSts_18 "Front Radar Moudle_X_Object Track Status_00
前雷达目标物的跟踪状态_00
Signal To Indicate The Object Track Status";
CM_ SG_ 971 FRM_12_ObjMotionSts_18 "Front Radar Moudle_X_Object Motion Status_00
前雷达目标物的运动状态_00
Signal To Indicate The Object Whether Moving or Stopped or Static";
CM_ SG_ 971 FRM_12_ObjMotionDirection_18 "Front Radar Moudle_X_Object Motion Direction_00
前雷达目标物的运动方向_00
Signal To Indicate The Object Moving Direction.
Note: Moving direction of static object or stopped object shall always be 0x0: Unknown";
CM_ SG_ 971 FRM_12_ObjCenterDistX_18 "Front Radar Moudle_X_Object Center Distance X_00
前雷达目标物中心点在X轴方向的距离_00
Center Position Of Target Vehicle In X Direction
The rear axle center coordinate system is used";
CM_ SG_ 971 FRM_12_ObjCenterDistY_18 "Front Radar Moudle_X_Object Center Distance Y_00
前雷达目标物中心点在Y轴方向的距离_00
Center Position Of Target Vehicle In Y Direction
The rear axle center coordinate system is used";
CM_ SG_ 971 FRM_12_ObjLength_18 "Front Radar Moudle_X_Object Length_00
前雷达目标物的长度_00
Length Of Target
Note: Length of static object shall always be 0";
CM_ SG_ 971 FRM_12_ObjWidth_18 "Front Radar Moudle_X_Object Width_00
前雷达目标物的宽度_00
Width Of Target
Note: Width of static object shall always be 0";
CM_ SG_ 971 FRM_12_ObjElevnSts_18 "Front Radar Moudle_X_Object Elevation Status_00
前雷达目标物的高度状态_00
The Elevation Status Of An Object
Note: Elevation Status of moving object or stopped object shall always be 0x2: Obstacle";
CM_ SG_ 971 FRM_12_ObjElevnStsConf_18 "Front Radar Moudle_X_Object Elevation Status Confidence_00
前雷达目标物的高度状态的置信度_00
The Confidence Of An Object Elevation Status
Note: Elevation Status Confidence of moving object or stopped object shall always be 100%";
CM_ SG_ 971 FRM_12_ObjHeading_18 "Front Radar Moudle_X_Object Heading_00
前雷达目标物朝向_00
Heading of object 
Note: A rotation vector with anticlock-rotating as positive +π shall be used instead of -π when obect vertically backward
Note: Heading of static object shall always be 0";
CM_ SG_ 971 FRM_12_ObjID_19 "Front Radar Moudle_X_Object ID_01
前雷达目标物身份标识码_01
ID Is An Identifier Number That Allows For Tracking Of Persistent Objects Over Time
Note:A value of 0 indicates 'no object'";
CM_ SG_ 971 FRM_12_ObjClosestDistX_19 "Front Radar Moudle_X_Object Closest Distance X_01
前雷达目标物最近点在X轴上的距离_01
Closest Position Of Target Vehicle In X Direction
The rear axle center coordinate system is used";
CM_ SG_ 971 FRM_12_ObjClosestDistY_19 "Front Radar Moudle_X_Object Closest Distance Y_01
前雷达距目标物最近点在Y轴上的距离_01
Closest Position Of Target Vehicle In Y Direction
The rear axle center coordinate system is used";
CM_ SG_ 971 FRM_12_ObjRelVelX_19 "Front Radar Moudle_X_Object Relative Velocity X_01
前雷达目标物在X轴上的相对速度_01
Relative Target Object Velocity In X Direction";
CM_ SG_ 971 FRM_12_ObjRelVelY_19 "Front Radar Moudle_X_Object Relative Velocity Y_01
前雷达目标物在Y轴上的相对速度_01
Relative Target Object Velocity In Y Direction";
CM_ SG_ 971 FRM_12_ObjAccelX_19 "Front Radar Moudle_X_Object Acceleration X_01
前雷达目标物在X轴上的加速度_01
Relative Target Object Acceleration In X Direction";
CM_ SG_ 971 FRM_12_ObjAccelY_19 "Front Radar Moudle_X_Object Acceleration Y_01
前雷达目标物在Y轴上的加速度_01
Relative Target Object Acceleration In Y Direction";
CM_ SG_ 971 FRM_12_ObjClosestDistXStd_19 "Front Radar Moudle_X_Object Closest Distance X Standard_01
前雷达目标物最近点在X轴上的距离的标准差_01
Standard Deviation Of Closest Position Of Target Vehicle in X Direction";
CM_ SG_ 971 FRM_12_ObjClosestDistYStd_19 "Front Radar Moudle_X_Object Closest Distance Y Standard_01
前雷达目标物最近点在Y轴上的距离的标准差_01
Standard Deviation Of Closest Position Of Target Vehicle in Y Direction";
CM_ SG_ 971 FRM_12_ObjRelVelXStd_19 "Front Radar Moudle_X_Object Relative Velocity X Standard_01
前雷达目标物在X轴上的相对速度的标准差_01
Standard Deviation Of Relative Velocity X";
CM_ SG_ 971 FRM_12_ObjRelVelYStd_19 "Front Radar Moudle_X_Object Relative Velocity Y Standard_01
前雷达目标物在Y轴上的相对速度的标准差_01
Standard Deviation Of Relative Velocity Y";
CM_ SG_ 971 FRM_12_ObjRelAccelXStd_19 "Front Radar Moudle_X_Object Relative  Acceleration X Standard_01
前雷达目标物在X轴上的相对加速度的标准差_01
Standard Deviation Of Relative Acceleration X";
CM_ SG_ 971 FRM_12_ObjRelAccelYStd_19 "Front Radar Moudle_X_Object Relative  Acceleration Y Standard_01
前雷达目标物相对加速度在Y轴上的标准差_01
Standard Deviation Of Relative Acceleration Y";
CM_ SG_ 971 FRM_12_ObjExistProb_19 "Front Radar Moudle_X_Object Exist Probability_01
前雷达目标物存在的可能性_01
The Probability Of An Object To Exist In Reality";
CM_ SG_ 971 FRM_12_ObjType_19 "Front Radar Moudle_X_Object Type_01
前雷达目标物的分类_01
Class Of Object Type
Note: Type of static object shall always be 0x0: unknown";
CM_ SG_ 971 FRM_12_ObjTypeConf_19 "Front Radar Moudle_X_Object Type Confidence_01
前雷达目标物分类的置信度_01
The Class Confidence Of Object Type";
CM_ SG_ 971 FRM_12_ObjTrackSts_19 "Front Radar Moudle_X_Object Track Status_01
前雷达目标物的跟踪状态_01
Signal To Indicate The Object Track Status";
CM_ SG_ 971 FRM_12_ObjMotionSts_19 "Front Radar Moudle_X_Object Motion Status_01
前雷达目标物的运动状态_01
Signal To Indicate The Object Whether Moving or Stopped or Static";
CM_ SG_ 971 FRM_12_ObjMotionDirection_19 "Front Radar Moudle_X_Object Motion Direction_01
前雷达目标物的运动方向_01
Signal To Indicate The Object Moving Direction.
Note: Moving direction of static object or stopped object shall always be 0x0: Unknown";
CM_ SG_ 971 FRM_12_ObjCenterDistX_19 "Front Radar Moudle_X_Object Center Distance X_01
前雷达目标物中心点在X轴方向的距离_01
Center Position Of Target Vehicle In X Direction
The rear axle center coordinate system is used";
CM_ SG_ 971 FRM_12_ObjCenterDistY_19 "Front Radar Moudle_X_Object Center Distance Y_01
前雷达目标物中心点在Y轴方向的距离_01
Center Position Of Target Vehicle In Y Direction
The rear axle center coordinate system is used";
CM_ SG_ 971 FRM_12_ObjLength_19 "Front Radar Moudle_X_Object Length_01
前雷达目标物的长度_01
Length Of Target
Note: Length of static object shall always be 0";
CM_ SG_ 971 FRM_12_ObjWidth_19 "Front Radar Moudle_X_Object Width_01
前雷达目标物的宽度_01
Width Of Target
Note: Width of static object shall always be 0";
CM_ SG_ 971 FRM_12_ObjElevnSts_19 "Front Radar Moudle_X_Object Elevation Status_01
前雷达目标物的高度状态_01
The Elevation Status Of An Object
Note: Elevation Status of moving object or stopped object shall always be 0x2: Obstacle";
CM_ SG_ 971 FRM_12_ObjElevnStsConf_19 "Front Radar Moudle_X_Object Elevation Status Confidence_01
前雷达目标物的高度状态的置信度_01
The Confidence Of An Object Elevation Status
Note: Elevation Status Confidence of moving object or stopped object shall always be 100%";
CM_ SG_ 971 FRM_12_ObjHeading_19 "Front Radar Moudle_X_Object Heading_01
前雷达目标物朝向_01
Heading of object 
Note: A rotation vector with anticlock-rotating as positive +π shall be used instead of -π when obect vertically backward
Note: Heading of static object shall always be 0";
CM_ SG_ 972 FRM_13_CRC "Profile5:E2E CRC16 (polynomial:0x1021)       
DataID:Use CANID,other bits Fill with 0";
CM_ SG_ 972 FRM_13_RollgCntr "Profile5:E2E Rolling message counter";
CM_ SG_ 972 FRM_13_ObjBlockCounter "Front Radar Moudle_X_Object Block Counter
前雷达目标物块计数值";
CM_ SG_ 972 FRM_13_ObjID_20 "Front Radar Moudle_X_Object ID_00
前雷达目标物身份标识码_00
ID Is An Identifier Number That Allows For Tracking Of Persistent Objects Over Time
Note:A value of 0 indicates 'no object'";
CM_ SG_ 972 FRM_13_ObjClosestDistX_20 "Front Radar Moudle_X_Object Closest Distance X_00
前雷达目标物最近点在X轴上的距离_00
Closest Position Of Target Vehicle In X Direction
The rear axle center coordinate system is used";
CM_ SG_ 972 FRM_13_ObjClosestDistY_20 "Front Radar Moudle_X_Object Closest Distance Y_00
前雷达距目标物最近点在Y轴上的距离_00
Closest Position Of Target Vehicle In Y Direction
The rear axle center coordinate system is used";
CM_ SG_ 972 FRM_13_ObjRelVelX_20 "Front Radar Moudle_X_Object Relative Velocity X_00
前雷达目标物在X轴上的相对速度_00
Relative Target Object Velocity In X Direction";
CM_ SG_ 972 FRM_13_ObjRelVelY_20 "Front Radar Moudle_X_Object Relative Velocity Y_00
前雷达目标物在Y轴上的相对速度_00
Relative Target Object Velocity In Y Direction";
CM_ SG_ 972 FRM_13_ObjAccelX_20 "Front Radar Moudle_X_Object Acceleration X_00
前雷达目标物在X轴上的加速度_00
Relative Target Object Acceleration In X Direction";
CM_ SG_ 972 FRM_13_ObjAccelY_20 "Front Radar Moudle_X_Object Acceleration Y_00
前雷达目标物在Y轴上的加速度_00
Relative Target Object Acceleration In Y Direction";
CM_ SG_ 972 FRM_13_ObjClosestDistXStd_20 "Front Radar Moudle_X_Object Closest Distance X Standard_00
前雷达目标物最近点在X轴上的距离的标准差_00
Standard Deviation Of Closest Position Of Target Vehicle in X Direction";
CM_ SG_ 972 FRM_13_ObjClosestDistYStd_20 "Front Radar Moudle_X_Object Closest Distance Y Standard_00
前雷达目标物最近点在Y轴上的距离的标准差_00
Standard Deviation Of Closest Position Of Target Vehicle in Y Direction";
CM_ SG_ 972 FRM_13_ObjRelVelXStd_20 "Front Radar Moudle_X_Object Relative Velocity X Standard_00
前雷达目标物在X轴上的相对速度的标准差_00
Standard Deviation Of Relative Velocity X";
CM_ SG_ 972 FRM_13_ObjRelVelYStd_20 "Front Radar Moudle_X_Object Relative Velocity Y Standard_00
前雷达目标物在Y轴上的相对速度的标准差_00
Standard Deviation Of Relative Velocity Y";
CM_ SG_ 972 FRM_13_ObjRelAccelXStd_20 "Front Radar Moudle_X_Object Relative  Acceleration X Standard_00
前雷达目标物在X轴上的相对加速度的标准差_00
Standard Deviation Of Relative Acceleration X";
CM_ SG_ 972 FRM_13_ObjRelAccelYStd_20 "Front Radar Moudle_X_Object Relative  Acceleration Y Standard_00
前雷达目标物相对加速度在Y轴上的标准差_00
Standard Deviation Of Relative Acceleration Y";
CM_ SG_ 972 FRM_13_ObjExistProb_20 "Front Radar Moudle_X_Object Exist Probability_00
前雷达目标物存在的可能性_00
The Probability Of An Object To Exist In Reality";
CM_ SG_ 972 FRM_13_ObjType_20 "Front Radar Moudle_X_Object Type_00
前雷达目标物的分类_00
Class Of Object Type
Note: Type of static object shall always be 0x0: unknown";
CM_ SG_ 972 FRM_13_ObjTypeConf_20 "Front Radar Moudle_X_Object Type Confidence_00
前雷达目标物分类的置信度_00
The Class Confidence Of Object Type";
CM_ SG_ 972 FRM_13_ObjTrackSts_20 "Front Radar Moudle_X_Object Track Status_00
前雷达目标物的跟踪状态_00
Signal To Indicate The Object Track Status";
CM_ SG_ 972 FRM_13_ObjMotionSts_20 "Front Radar Moudle_X_Object Motion Status_00
前雷达目标物的运动状态_00
Signal To Indicate The Object Whether Moving or Stopped or Static";
CM_ SG_ 972 FRM_13_ObjMotionDirection_20 "Front Radar Moudle_X_Object Motion Direction_00
前雷达目标物的运动方向_00
Signal To Indicate The Object Moving Direction.
Note: Moving direction of static object or stopped object shall always be 0x0: Unknown";
CM_ SG_ 972 FRM_13_ObjCenterDistX_20 "Front Radar Moudle_X_Object Center Distance X_00
前雷达目标物中心点在X轴方向的距离_00
Center Position Of Target Vehicle In X Direction
The rear axle center coordinate system is used";
CM_ SG_ 972 FRM_13_ObjCenterDistY_20 "Front Radar Moudle_X_Object Center Distance Y_00
前雷达目标物中心点在Y轴方向的距离_00
Center Position Of Target Vehicle In Y Direction
The rear axle center coordinate system is used";
CM_ SG_ 972 FRM_13_ObjLength_20 "Front Radar Moudle_X_Object Length_00
前雷达目标物的长度_00
Length Of Target
Note: Length of static object shall always be 0";
CM_ SG_ 972 FRM_13_ObjWidth_20 "Front Radar Moudle_X_Object Width_00
前雷达目标物的宽度_00
Width Of Target
Note: Width of static object shall always be 0";
CM_ SG_ 972 FRM_13_ObjElevnSts_20 "Front Radar Moudle_X_Object Elevation Status_00
前雷达目标物的高度状态_00
The Elevation Status Of An Object
Note: Elevation Status of moving object or stopped object shall always be 0x2: Obstacle";
CM_ SG_ 972 FRM_13_ObjElevnStsConf_20 "Front Radar Moudle_X_Object Elevation Status Confidence_00
前雷达目标物的高度状态的置信度_00
The Confidence Of An Object Elevation Status
Note: Elevation Status Confidence of moving object or stopped object shall always be 100%";
CM_ SG_ 972 FRM_13_ObjHeading_20 "Front Radar Moudle_X_Object Heading_00
前雷达目标物朝向_00
Heading of object 
Note: A rotation vector with anticlock-rotating as positive +π shall be used instead of -π when obect vertically backward
Note: Heading of static object shall always be 0";
CM_ SG_ 972 FRM_13_ObjID_21 "Front Radar Moudle_X_Object ID_01
前雷达目标物身份标识码_01
ID Is An Identifier Number That Allows For Tracking Of Persistent Objects Over Time
Note:A value of 0 indicates 'no object'";
CM_ SG_ 972 FRM_13_ObjClosestDistX_21 "Front Radar Moudle_X_Object Closest Distance X_01
前雷达目标物最近点在X轴上的距离_01
Closest Position Of Target Vehicle In X Direction
The rear axle center coordinate system is used";
CM_ SG_ 972 FRM_13_ObjClosestDistY_21 "Front Radar Moudle_X_Object Closest Distance Y_01
前雷达距目标物最近点在Y轴上的距离_01
Closest Position Of Target Vehicle In Y Direction
The rear axle center coordinate system is used";
CM_ SG_ 972 FRM_13_ObjRelVelX_21 "Front Radar Moudle_X_Object Relative Velocity X_01
前雷达目标物在X轴上的相对速度_01
Relative Target Object Velocity In X Direction";
CM_ SG_ 972 FRM_13_ObjRelVelY_21 "Front Radar Moudle_X_Object Relative Velocity Y_01
前雷达目标物在Y轴上的相对速度_01
Relative Target Object Velocity In Y Direction";
CM_ SG_ 972 FRM_13_ObjAccelX_21 "Front Radar Moudle_X_Object Acceleration X_01
前雷达目标物在X轴上的加速度_01
Relative Target Object Acceleration In X Direction";
CM_ SG_ 972 FRM_13_ObjAccelY_21 "Front Radar Moudle_X_Object Acceleration Y_01
前雷达目标物在Y轴上的加速度_01
Relative Target Object Acceleration In Y Direction";
CM_ SG_ 972 FRM_13_ObjClosestDistXStd_21 "Front Radar Moudle_X_Object Closest Distance X Standard_01
前雷达目标物最近点在X轴上的距离的标准差_01
Standard Deviation Of Closest Position Of Target Vehicle in X Direction";
CM_ SG_ 972 FRM_13_ObjClosestDistYStd_21 "Front Radar Moudle_X_Object Closest Distance Y Standard_01
前雷达目标物最近点在Y轴上的距离的标准差_01
Standard Deviation Of Closest Position Of Target Vehicle in Y Direction";
CM_ SG_ 972 FRM_13_ObjRelVelXStd_21 "Front Radar Moudle_X_Object Relative Velocity X Standard_01
前雷达目标物在X轴上的相对速度的标准差_01
Standard Deviation Of Relative Velocity X";
CM_ SG_ 972 FRM_13_ObjRelVelYStd_21 "Front Radar Moudle_X_Object Relative Velocity Y Standard_01
前雷达目标物在Y轴上的相对速度的标准差_01
Standard Deviation Of Relative Velocity Y";
CM_ SG_ 972 FRM_13_ObjRelAccelXStd_21 "Front Radar Moudle_X_Object Relative  Acceleration X Standard_01
前雷达目标物在X轴上的相对加速度的标准差_01
Standard Deviation Of Relative Acceleration X";
CM_ SG_ 972 FRM_13_ObjRelAccelYStd_21 "Front Radar Moudle_X_Object Relative  Acceleration Y Standard_01
前雷达目标物相对加速度在Y轴上的标准差_01
Standard Deviation Of Relative Acceleration Y";
CM_ SG_ 972 FRM_13_ObjExistProb_21 "Front Radar Moudle_X_Object Exist Probability_01
前雷达目标物存在的可能性_01
The Probability Of An Object To Exist In Reality";
CM_ SG_ 972 FRM_13_ObjType_21 "Front Radar Moudle_X_Object Type_01
前雷达目标物的分类_01
Class Of Object Type
Note: Type of static object shall always be 0x0: unknown";
CM_ SG_ 972 FRM_13_ObjTypeConf_21 "Front Radar Moudle_X_Object Type Confidence_01
前雷达目标物分类的置信度_01
The Class Confidence Of Object Type";
CM_ SG_ 972 FRM_13_ObjTrackSts_21 "Front Radar Moudle_X_Object Track Status_01
前雷达目标物的跟踪状态_01
Signal To Indicate The Object Track Status";
CM_ SG_ 972 FRM_13_ObjMotionSts_21 "Front Radar Moudle_X_Object Motion Status_01
前雷达目标物的运动状态_01
Signal To Indicate The Object Whether Moving or Stopped or Static";
CM_ SG_ 972 FRM_13_ObjMotionDirection_21 "Front Radar Moudle_X_Object Motion Direction_01
前雷达目标物的运动方向_01
Signal To Indicate The Object Moving Direction.
Note: Moving direction of static object or stopped object shall always be 0x0: Unknown";
CM_ SG_ 972 FRM_13_ObjCenterDistX_21 "Front Radar Moudle_X_Object Center Distance X_01
前雷达目标物中心点在X轴方向的距离_01
Center Position Of Target Vehicle In X Direction
The rear axle center coordinate system is used";
CM_ SG_ 972 FRM_13_ObjCenterDistY_21 "Front Radar Moudle_X_Object Center Distance Y_01
前雷达目标物中心点在Y轴方向的距离_01
Center Position Of Target Vehicle In Y Direction
The rear axle center coordinate system is used";
CM_ SG_ 972 FRM_13_ObjLength_21 "Front Radar Moudle_X_Object Length_01
前雷达目标物的长度_01
Length Of Target
Note: Length of static object shall always be 0";
CM_ SG_ 972 FRM_13_ObjWidth_21 "Front Radar Moudle_X_Object Width_01
前雷达目标物的宽度_01
Width Of Target
Note: Width of static object shall always be 0";
CM_ SG_ 972 FRM_13_ObjElevnSts_21 "Front Radar Moudle_X_Object Elevation Status_01
前雷达目标物的高度状态_01
The Elevation Status Of An Object
Note: Elevation Status of moving object or stopped object shall always be 0x2: Obstacle";
CM_ SG_ 972 FRM_13_ObjElevnStsConf_21 "Front Radar Moudle_X_Object Elevation Status Confidence_01
前雷达目标物的高度状态的置信度_01
The Confidence Of An Object Elevation Status
Note: Elevation Status Confidence of moving object or stopped object shall always be 100%";
CM_ SG_ 972 FRM_13_ObjHeading_21 "Front Radar Moudle_X_Object Heading_01
前雷达目标物朝向_01
Heading of object 
Note: A rotation vector with anticlock-rotating as positive +π shall be used instead of -π when obect vertically backward
Note: Heading of static object shall always be 0";
CM_ SG_ 973 FRM_14_CRC "Profile5:E2E CRC16 (polynomial:0x1021)       
DataID:Use CANID,other bits Fill with 0";
CM_ SG_ 973 FRM_14_RollgCntr "Profile5:E2E Rolling message counter";
CM_ SG_ 973 FRM_14_ObjBlockCounter "Front Radar Moudle_X_Object Block Counter
前雷达目标物块计数值";
CM_ SG_ 973 FRM_14_ObjID_22 "Front Radar Moudle_X_Object ID_00
前雷达目标物身份标识码_00
ID Is An Identifier Number That Allows For Tracking Of Persistent Objects Over Time
Note:A value of 0 indicates 'no object'";
CM_ SG_ 973 FRM_14_ObjClosestDistX_22 "Front Radar Moudle_X_Object Closest Distance X_00
前雷达目标物最近点在X轴上的距离_00
Closest Position Of Target Vehicle In X Direction
The rear axle center coordinate system is used";
CM_ SG_ 973 FRM_14_ObjClosestDistY_22 "Front Radar Moudle_X_Object Closest Distance Y_00
前雷达距目标物最近点在Y轴上的距离_00
Closest Position Of Target Vehicle In Y Direction
The rear axle center coordinate system is used";
CM_ SG_ 973 FRM_14_ObjRelVelX_22 "Front Radar Moudle_X_Object Relative Velocity X_00
前雷达目标物在X轴上的相对速度_00
Relative Target Object Velocity In X Direction";
CM_ SG_ 973 FRM_14_ObjRelVelY_22 "Front Radar Moudle_X_Object Relative Velocity Y_00
前雷达目标物在Y轴上的相对速度_00
Relative Target Object Velocity In Y Direction";
CM_ SG_ 973 FRM_14_ObjAccelX_22 "Front Radar Moudle_X_Object Acceleration X_00
前雷达目标物在X轴上的加速度_00
Relative Target Object Acceleration In X Direction";
CM_ SG_ 973 FRM_14_ObjAccelY_22 "Front Radar Moudle_X_Object Acceleration Y_00
前雷达目标物在Y轴上的加速度_00
Relative Target Object Acceleration In Y Direction";
CM_ SG_ 973 FRM_14_ObjClosestDistXStd_22 "Front Radar Moudle_X_Object Closest Distance X Standard_00
前雷达目标物最近点在X轴上的距离的标准差_00
Standard Deviation Of Closest Position Of Target Vehicle in X Direction";
CM_ SG_ 973 FRM_14_ObjClosestDistYStd_22 "Front Radar Moudle_X_Object Closest Distance Y Standard_00
前雷达目标物最近点在Y轴上的距离的标准差_00
Standard Deviation Of Closest Position Of Target Vehicle in Y Direction";
CM_ SG_ 973 FRM_14_ObjRelVelXStd_22 "Front Radar Moudle_X_Object Relative Velocity X Standard_00
前雷达目标物在X轴上的相对速度的标准差_00
Standard Deviation Of Relative Velocity X";
CM_ SG_ 973 FRM_14_ObjRelVelYStd_22 "Front Radar Moudle_X_Object Relative Velocity Y Standard_00
前雷达目标物在Y轴上的相对速度的标准差_00
Standard Deviation Of Relative Velocity Y";
CM_ SG_ 973 FRM_14_ObjRelAccelXStd_22 "Front Radar Moudle_X_Object Relative  Acceleration X Standard_00
前雷达目标物在X轴上的相对加速度的标准差_00
Standard Deviation Of Relative Acceleration X";
CM_ SG_ 973 FRM_14_ObjRelAccelYStd_22 "Front Radar Moudle_X_Object Relative  Acceleration Y Standard_00
前雷达目标物相对加速度在Y轴上的标准差_00
Standard Deviation Of Relative Acceleration Y";
CM_ SG_ 973 FRM_14_ObjExistProb_22 "Front Radar Moudle_X_Object Exist Probability_00
前雷达目标物存在的可能性_00
The Probability Of An Object To Exist In Reality";
CM_ SG_ 973 FRM_14_ObjType_22 "Front Radar Moudle_X_Object Type_00
前雷达目标物的分类_00
Class Of Object Type
Note: Type of static object shall always be 0x0: unknown";
CM_ SG_ 973 FRM_14_ObjTypeConf_22 "Front Radar Moudle_X_Object Type Confidence_00
前雷达目标物分类的置信度_00
The Class Confidence Of Object Type";
CM_ SG_ 973 FRM_14_ObjTrackSts_22 "Front Radar Moudle_X_Object Track Status_00
前雷达目标物的跟踪状态_00
Signal To Indicate The Object Track Status";
CM_ SG_ 973 FRM_14_ObjMotionSts_22 "Front Radar Moudle_X_Object Motion Status_00
前雷达目标物的运动状态_00
Signal To Indicate The Object Whether Moving or Stopped or Static";
CM_ SG_ 973 FRM_14_ObjMotionDirection_22 "Front Radar Moudle_X_Object Motion Direction_00
前雷达目标物的运动方向_00
Signal To Indicate The Object Moving Direction.
Note: Moving direction of static object or stopped object shall always be 0x0: Unknown";
CM_ SG_ 973 FRM_14_ObjCenterDistX_22 "Front Radar Moudle_X_Object Center Distance X_00
前雷达目标物中心点在X轴方向的距离_00
Center Position Of Target Vehicle In X Direction
The rear axle center coordinate system is used";
CM_ SG_ 973 FRM_14_ObjCenterDistY_22 "Front Radar Moudle_X_Object Center Distance Y_00
前雷达目标物中心点在Y轴方向的距离_00
Center Position Of Target Vehicle In Y Direction
The rear axle center coordinate system is used";
CM_ SG_ 973 FRM_14_ObjLength_22 "Front Radar Moudle_X_Object Length_00
前雷达目标物的长度_00
Length Of Target
Note: Length of static object shall always be 0";
CM_ SG_ 973 FRM_14_ObjWidth_22 "Front Radar Moudle_X_Object Width_00
前雷达目标物的宽度_00
Width Of Target
Note: Width of static object shall always be 0";
CM_ SG_ 973 FRM_14_ObjElevnSts_22 "Front Radar Moudle_X_Object Elevation Status_00
前雷达目标物的高度状态_00
The Elevation Status Of An Object
Note: Elevation Status of moving object or stopped object shall always be 0x2: Obstacle";
CM_ SG_ 973 FRM_14_ObjElevnStsConf_22 "Front Radar Moudle_X_Object Elevation Status Confidence_00
前雷达目标物的高度状态的置信度_00
The Confidence Of An Object Elevation Status
Note: Elevation Status Confidence of moving object or stopped object shall always be 100%";
CM_ SG_ 973 FRM_14_ObjHeading_22 "Front Radar Moudle_X_Object Heading_00
前雷达目标物朝向_00
Heading of object 
Note: A rotation vector with anticlock-rotating as positive +π shall be used instead of -π when obect vertically backward
Note: Heading of static object shall always be 0";
CM_ SG_ 973 FRM_14_ObjID_23 "Front Radar Moudle_X_Object ID_01
前雷达目标物身份标识码_01
ID Is An Identifier Number That Allows For Tracking Of Persistent Objects Over Time
Note:A value of 0 indicates 'no object'";
CM_ SG_ 973 FRM_14_ObjClosestDistX_23 "Front Radar Moudle_X_Object Closest Distance X_01
前雷达目标物最近点在X轴上的距离_01
Closest Position Of Target Vehicle In X Direction
The rear axle center coordinate system is used";
CM_ SG_ 973 FRM_14_ObjClosestDistY_23 "Front Radar Moudle_X_Object Closest Distance Y_01
前雷达距目标物最近点在Y轴上的距离_01
Closest Position Of Target Vehicle In Y Direction
The rear axle center coordinate system is used";
CM_ SG_ 973 FRM_14_ObjRelVelX_23 "Front Radar Moudle_X_Object Relative Velocity X_01
前雷达目标物在X轴上的相对速度_01
Relative Target Object Velocity In X Direction";
CM_ SG_ 973 FRM_14_ObjRelVelY_23 "Front Radar Moudle_X_Object Relative Velocity Y_01
前雷达目标物在Y轴上的相对速度_01
Relative Target Object Velocity In Y Direction";
CM_ SG_ 973 FRM_14_ObjAccelX_23 "Front Radar Moudle_X_Object Acceleration X_01
前雷达目标物在X轴上的加速度_01
Relative Target Object Acceleration In X Direction";
CM_ SG_ 973 FRM_14_ObjAccelY_23 "Front Radar Moudle_X_Object Acceleration Y_01
前雷达目标物在Y轴上的加速度_01
Relative Target Object Acceleration In Y Direction";
CM_ SG_ 973 FRM_14_ObjClosestDistXStd_23 "Front Radar Moudle_X_Object Closest Distance X Standard_01
前雷达目标物最近点在X轴上的距离的标准差_01
Standard Deviation Of Closest Position Of Target Vehicle in X Direction";
CM_ SG_ 973 FRM_14_ObjClosestDistYStd_23 "Front Radar Moudle_X_Object Closest Distance Y Standard_01
前雷达目标物最近点在Y轴上的距离的标准差_01
Standard Deviation Of Closest Position Of Target Vehicle in Y Direction";
CM_ SG_ 973 FRM_14_ObjRelVelXStd_23 "Front Radar Moudle_X_Object Relative Velocity X Standard_01
前雷达目标物在X轴上的相对速度的标准差_01
Standard Deviation Of Relative Velocity X";
CM_ SG_ 973 FRM_14_ObjRelVelYStd_23 "Front Radar Moudle_X_Object Relative Velocity Y Standard_01
前雷达目标物在Y轴上的相对速度的标准差_01
Standard Deviation Of Relative Velocity Y";
CM_ SG_ 973 FRM_14_ObjRelAccelXStd_23 "Front Radar Moudle_X_Object Relative  Acceleration X Standard_01
前雷达目标物在X轴上的相对加速度的标准差_01
Standard Deviation Of Relative Acceleration X";
CM_ SG_ 973 FRM_14_ObjRelAccelYStd_23 "Front Radar Moudle_X_Object Relative  Acceleration Y Standard_01
前雷达目标物相对加速度在Y轴上的标准差_01
Standard Deviation Of Relative Acceleration Y";
CM_ SG_ 973 FRM_14_ObjExistProb_23 "Front Radar Moudle_X_Object Exist Probability_01
前雷达目标物存在的可能性_01
The Probability Of An Object To Exist In Reality";
CM_ SG_ 973 FRM_14_ObjType_23 "Front Radar Moudle_X_Object Type_01
前雷达目标物的分类_01
Class Of Object Type
Note: Type of static object shall always be 0x0: unknown";
CM_ SG_ 973 FRM_14_ObjTypeConf_23 "Front Radar Moudle_X_Object Type Confidence_01
前雷达目标物分类的置信度_01
The Class Confidence Of Object Type";
CM_ SG_ 973 FRM_14_ObjTrackSts_23 "Front Radar Moudle_X_Object Track Status_01
前雷达目标物的跟踪状态_01
Signal To Indicate The Object Track Status";
CM_ SG_ 973 FRM_14_ObjMotionSts_23 "Front Radar Moudle_X_Object Motion Status_01
前雷达目标物的运动状态_01
Signal To Indicate The Object Whether Moving or Stopped or Static";
CM_ SG_ 973 FRM_14_ObjMotionDirection_23 "Front Radar Moudle_X_Object Motion Direction_01
前雷达目标物的运动方向_01
Signal To Indicate The Object Moving Direction.
Note: Moving direction of static object or stopped object shall always be 0x0: Unknown";
CM_ SG_ 973 FRM_14_ObjCenterDistX_23 "Front Radar Moudle_X_Object Center Distance X_01
前雷达目标物中心点在X轴方向的距离_01
Center Position Of Target Vehicle In X Direction
The rear axle center coordinate system is used";
CM_ SG_ 973 FRM_14_ObjCenterDistY_23 "Front Radar Moudle_X_Object Center Distance Y_01
前雷达目标物中心点在Y轴方向的距离_01
Center Position Of Target Vehicle In Y Direction
The rear axle center coordinate system is used";
CM_ SG_ 973 FRM_14_ObjLength_23 "Front Radar Moudle_X_Object Length_01
前雷达目标物的长度_01
Length Of Target
Note: Length of static object shall always be 0";
CM_ SG_ 973 FRM_14_ObjWidth_23 "Front Radar Moudle_X_Object Width_01
前雷达目标物的宽度_01
Width Of Target
Note: Width of static object shall always be 0";
CM_ SG_ 973 FRM_14_ObjElevnSts_23 "Front Radar Moudle_X_Object Elevation Status_01
前雷达目标物的高度状态_01
The Elevation Status Of An Object
Note: Elevation Status of moving object or stopped object shall always be 0x2: Obstacle";
CM_ SG_ 973 FRM_14_ObjElevnStsConf_23 "Front Radar Moudle_X_Object Elevation Status Confidence_01
前雷达目标物的高度状态的置信度_01
The Confidence Of An Object Elevation Status
Note: Elevation Status Confidence of moving object or stopped object shall always be 100%";
CM_ SG_ 973 FRM_14_ObjHeading_23 "Front Radar Moudle_X_Object Heading_01
前雷达目标物朝向_01
Heading of object 
Note: A rotation vector with anticlock-rotating as positive +π shall be used instead of -π when obect vertically backward
Note: Heading of static object shall always be 0";
CM_ SG_ 974 FRM_15_CRC "Profile5:E2E CRC16 (polynomial:0x1021)       
DataID:Use CANID,other bits Fill with 0";
CM_ SG_ 974 FRM_15_RollgCntr "Profile5:E2E Rolling message counter";
CM_ SG_ 974 FRM_15_ObjBlockCounter "Front Radar Moudle_X_Object Block Counter
前雷达目标物块计数值";
CM_ SG_ 974 FRM_15_ObjID_24 "Front Radar Moudle_X_Object ID_00
前雷达目标物身份标识码_00
ID Is An Identifier Number That Allows For Tracking Of Persistent Objects Over Time
Note:A value of 0 indicates 'no object'";
CM_ SG_ 974 FRM_15_ObjClosestDistX_24 "Front Radar Moudle_X_Object Closest Distance X_00
前雷达目标物最近点在X轴上的距离_00
Closest Position Of Target Vehicle In X Direction
The rear axle center coordinate system is used";
CM_ SG_ 974 FRM_15_ObjClosestDistY_24 "Front Radar Moudle_X_Object Closest Distance Y_00
前雷达距目标物最近点在Y轴上的距离_00
Closest Position Of Target Vehicle In Y Direction
The rear axle center coordinate system is used";
CM_ SG_ 974 FRM_15_ObjRelVelX_24 "Front Radar Moudle_X_Object Relative Velocity X_00
前雷达目标物在X轴上的相对速度_00
Relative Target Object Velocity In X Direction";
CM_ SG_ 974 FRM_15_ObjRelVelY_24 "Front Radar Moudle_X_Object Relative Velocity Y_00
前雷达目标物在Y轴上的相对速度_00
Relative Target Object Velocity In Y Direction";
CM_ SG_ 974 FRM_15_ObjAccelX_24 "Front Radar Moudle_X_Object Acceleration X_00
前雷达目标物在X轴上的加速度_00
Relative Target Object Acceleration In X Direction";
CM_ SG_ 974 FRM_15_ObjAccelY_24 "Front Radar Moudle_X_Object Acceleration Y_00
前雷达目标物在Y轴上的加速度_00
Relative Target Object Acceleration In Y Direction";
CM_ SG_ 974 FRM_15_ObjClosestDistXStd_24 "Front Radar Moudle_X_Object Closest Distance X Standard_00
前雷达目标物最近点在X轴上的距离的标准差_00
Standard Deviation Of Closest Position Of Target Vehicle in X Direction";
CM_ SG_ 974 FRM_15_ObjClosestDistYStd_24 "Front Radar Moudle_X_Object Closest Distance Y Standard_00
前雷达目标物最近点在Y轴上的距离的标准差_00
Standard Deviation Of Closest Position Of Target Vehicle in Y Direction";
CM_ SG_ 974 FRM_15_ObjRelVelXStd_24 "Front Radar Moudle_X_Object Relative Velocity X Standard_00
前雷达目标物在X轴上的相对速度的标准差_00
Standard Deviation Of Relative Velocity X";
CM_ SG_ 974 FRM_15_ObjRelVelYStd_24 "Front Radar Moudle_X_Object Relative Velocity Y Standard_00
前雷达目标物在Y轴上的相对速度的标准差_00
Standard Deviation Of Relative Velocity Y";
CM_ SG_ 974 FRM_15_ObjRelAccelXStd_24 "Front Radar Moudle_X_Object Relative  Acceleration X Standard_00
前雷达目标物在X轴上的相对加速度的标准差_00
Standard Deviation Of Relative Acceleration X";
CM_ SG_ 974 FRM_15_ObjRelAccelYStd_24 "Front Radar Moudle_X_Object Relative  Acceleration Y Standard_00
前雷达目标物相对加速度在Y轴上的标准差_00
Standard Deviation Of Relative Acceleration Y";
CM_ SG_ 974 FRM_15_ObjExistProb_24 "Front Radar Moudle_X_Object Exist Probability_00
前雷达目标物存在的可能性_00
The Probability Of An Object To Exist In Reality";
CM_ SG_ 974 FRM_15_ObjType_24 "Front Radar Moudle_X_Object Type_00
前雷达目标物的分类_00
Class Of Object Type
Note: Type of static object shall always be 0x0: unknown";
CM_ SG_ 974 FRM_15_ObjTypeConf_24 "Front Radar Moudle_X_Object Type Confidence_00
前雷达目标物分类的置信度_00
The Class Confidence Of Object Type";
CM_ SG_ 974 FRM_15_ObjTrackSts_24 "Front Radar Moudle_X_Object Track Status_00
前雷达目标物的跟踪状态_00
Signal To Indicate The Object Track Status";
CM_ SG_ 974 FRM_15_ObjMotionSts_24 "Front Radar Moudle_X_Object Motion Status_00
前雷达目标物的运动状态_00
Signal To Indicate The Object Whether Moving or Stopped or Static";
CM_ SG_ 974 FRM_15_ObjMotionDirection_24 "Front Radar Moudle_X_Object Motion Direction_00
前雷达目标物的运动方向_00
Signal To Indicate The Object Moving Direction.
Note: Moving direction of static object or stopped object shall always be 0x0: Unknown";
CM_ SG_ 974 FRM_15_ObjCenterDistX_24 "Front Radar Moudle_X_Object Center Distance X_00
前雷达目标物中心点在X轴方向的距离_00
Center Position Of Target Vehicle In X Direction
The rear axle center coordinate system is used";
CM_ SG_ 974 FRM_15_ObjCenterDistY_24 "Front Radar Moudle_X_Object Center Distance Y_00
前雷达目标物中心点在Y轴方向的距离_00
Center Position Of Target Vehicle In Y Direction
The rear axle center coordinate system is used";
CM_ SG_ 974 FRM_15_ObjLength_24 "Front Radar Moudle_X_Object Length_00
前雷达目标物的长度_00
Length Of Target
Note: Length of static object shall always be 0";
CM_ SG_ 974 FRM_15_ObjWidth_24 "Front Radar Moudle_X_Object Width_00
前雷达目标物的宽度_00
Width Of Target
Note: Width of static object shall always be 0";
CM_ SG_ 974 FRM_15_ObjElevnSts_24 "Front Radar Moudle_X_Object Elevation Status_00
前雷达目标物的高度状态_00
The Elevation Status Of An Object
Note: Elevation Status of moving object or stopped object shall always be 0x2: Obstacle";
CM_ SG_ 974 FRM_15_ObjElevnStsConf_24 "Front Radar Moudle_X_Object Elevation Status Confidence_00
前雷达目标物的高度状态的置信度_00
The Confidence Of An Object Elevation Status
Note: Elevation Status Confidence of moving object or stopped object shall always be 100%";
CM_ SG_ 974 FRM_15_ObjHeading_24 "Front Radar Moudle_X_Object Heading_00
前雷达目标物朝向_00
Heading of object 
Note: A rotation vector with anticlock-rotating as positive +π shall be used instead of -π when obect vertically backward
Note: Heading of static object shall always be 0";
CM_ SG_ 974 FRM_15_ObjID_25 "Front Radar Moudle_X_Object ID_01
前雷达目标物身份标识码_01
ID Is An Identifier Number That Allows For Tracking Of Persistent Objects Over Time
Note:A value of 0 indicates 'no object'";
CM_ SG_ 974 FRM_15_ObjClosestDistX_25 "Front Radar Moudle_X_Object Closest Distance X_01
前雷达目标物最近点在X轴上的距离_01
Closest Position Of Target Vehicle In X Direction
The rear axle center coordinate system is used";
CM_ SG_ 974 FRM_15_ObjClosestDistY_25 "Front Radar Moudle_X_Object Closest Distance Y_01
前雷达距目标物最近点在Y轴上的距离_01
Closest Position Of Target Vehicle In Y Direction
The rear axle center coordinate system is used";
CM_ SG_ 974 FRM_15_ObjRelVelX_25 "Front Radar Moudle_X_Object Relative Velocity X_01
前雷达目标物在X轴上的相对速度_01
Relative Target Object Velocity In X Direction";
CM_ SG_ 974 FRM_15_ObjRelVelY_25 "Front Radar Moudle_X_Object Relative Velocity Y_01
前雷达目标物在Y轴上的相对速度_01
Relative Target Object Velocity In Y Direction";
CM_ SG_ 974 FRM_15_ObjAccelX_25 "Front Radar Moudle_X_Object Acceleration X_01
前雷达目标物在X轴上的加速度_01
Relative Target Object Acceleration In X Direction";
CM_ SG_ 974 FRM_15_ObjAccelY_25 "Front Radar Moudle_X_Object Acceleration Y_01
前雷达目标物在Y轴上的加速度_01
Relative Target Object Acceleration In Y Direction";
CM_ SG_ 974 FRM_15_ObjClosestDistXStd_25 "Front Radar Moudle_X_Object Closest Distance X Standard_01
前雷达目标物最近点在X轴上的距离的标准差_01
Standard Deviation Of Closest Position Of Target Vehicle in X Direction";
CM_ SG_ 974 FRM_15_ObjClosestDistYStd_25 "Front Radar Moudle_X_Object Closest Distance Y Standard_01
前雷达目标物最近点在Y轴上的距离的标准差_01
Standard Deviation Of Closest Position Of Target Vehicle in Y Direction";
CM_ SG_ 974 FRM_15_ObjRelVelXStd_25 "Front Radar Moudle_X_Object Relative Velocity X Standard_01
前雷达目标物在X轴上的相对速度的标准差_01
Standard Deviation Of Relative Velocity X";
CM_ SG_ 974 FRM_15_ObjRelVelYStd_25 "Front Radar Moudle_X_Object Relative Velocity Y Standard_01
前雷达目标物在Y轴上的相对速度的标准差_01
Standard Deviation Of Relative Velocity Y";
CM_ SG_ 974 FRM_15_ObjRelAccelXStd_25 "Front Radar Moudle_X_Object Relative  Acceleration X Standard_01
前雷达目标物在X轴上的相对加速度的标准差_01
Standard Deviation Of Relative Acceleration X";
CM_ SG_ 974 FRM_15_ObjRelAccelYStd_25 "Front Radar Moudle_X_Object Relative  Acceleration Y Standard_01
前雷达目标物相对加速度在Y轴上的标准差_01
Standard Deviation Of Relative Acceleration Y";
CM_ SG_ 974 FRM_15_ObjExistProb_25 "Front Radar Moudle_X_Object Exist Probability_01
前雷达目标物存在的可能性_01
The Probability Of An Object To Exist In Reality";
CM_ SG_ 974 FRM_15_ObjType_25 "Front Radar Moudle_X_Object Type_01
前雷达目标物的分类_01
Class Of Object Type
Note: Type of static object shall always be 0x0: unknown";
CM_ SG_ 974 FRM_15_ObjTypeConf_25 "Front Radar Moudle_X_Object Type Confidence_01
前雷达目标物分类的置信度_01
The Class Confidence Of Object Type";
CM_ SG_ 974 FRM_15_ObjTrackSts_25 "Front Radar Moudle_X_Object Track Status_01
前雷达目标物的跟踪状态_01
Signal To Indicate The Object Track Status";
CM_ SG_ 974 FRM_15_ObjMotionSts_25 "Front Radar Moudle_X_Object Motion Status_01
前雷达目标物的运动状态_01
Signal To Indicate The Object Whether Moving or Stopped or Static";
CM_ SG_ 974 FRM_15_ObjMotionDirection_25 "Front Radar Moudle_X_Object Motion Direction_01
前雷达目标物的运动方向_01
Signal To Indicate The Object Moving Direction.
Note: Moving direction of static object or stopped object shall always be 0x0: Unknown";
CM_ SG_ 974 FRM_15_ObjCenterDistX_25 "Front Radar Moudle_X_Object Center Distance X_01
前雷达目标物中心点在X轴方向的距离_01
Center Position Of Target Vehicle In X Direction
The rear axle center coordinate system is used";
CM_ SG_ 974 FRM_15_ObjCenterDistY_25 "Front Radar Moudle_X_Object Center Distance Y_01
前雷达目标物中心点在Y轴方向的距离_01
Center Position Of Target Vehicle In Y Direction
The rear axle center coordinate system is used";
CM_ SG_ 974 FRM_15_ObjLength_25 "Front Radar Moudle_X_Object Length_01
前雷达目标物的长度_01
Length Of Target
Note: Length of static object shall always be 0";
CM_ SG_ 974 FRM_15_ObjWidth_25 "Front Radar Moudle_X_Object Width_01
前雷达目标物的宽度_01
Width Of Target
Note: Width of static object shall always be 0";
CM_ SG_ 974 FRM_15_ObjElevnSts_25 "Front Radar Moudle_X_Object Elevation Status_01
前雷达目标物的高度状态_01
The Elevation Status Of An Object
Note: Elevation Status of moving object or stopped object shall always be 0x2: Obstacle";
CM_ SG_ 974 FRM_15_ObjElevnStsConf_25 "Front Radar Moudle_X_Object Elevation Status Confidence_01
前雷达目标物的高度状态的置信度_01
The Confidence Of An Object Elevation Status
Note: Elevation Status Confidence of moving object or stopped object shall always be 100%";
CM_ SG_ 974 FRM_15_ObjHeading_25 "Front Radar Moudle_X_Object Heading_01
前雷达目标物朝向_01
Heading of object 
Note: A rotation vector with anticlock-rotating as positive +π shall be used instead of -π when obect vertically backward
Note: Heading of static object shall always be 0";
CM_ SG_ 975 FRM_16_CRC "Profile5:E2E CRC16 (polynomial:0x1021)       
DataID:Use CANID,other bits Fill with 0";
CM_ SG_ 975 FRM_16_RollgCntr "Profile5:E2E Rolling message counter";
CM_ SG_ 975 FRM_16_ObjBlockCounter "Front Radar Moudle_X_Object Block Counter
前雷达目标物块计数值";
CM_ SG_ 975 FRM_16_ObjID_26 "Front Radar Moudle_X_Object ID_00
前雷达目标物身份标识码_00
ID Is An Identifier Number That Allows For Tracking Of Persistent Objects Over Time
Note:A value of 0 indicates 'no object'";
CM_ SG_ 975 FRM_16_ObjClosestDistX_26 "Front Radar Moudle_X_Object Closest Distance X_00
前雷达目标物最近点在X轴上的距离_00
Closest Position Of Target Vehicle In X Direction
The rear axle center coordinate system is used";
CM_ SG_ 975 FRM_16_ObjClosestDistY_26 "Front Radar Moudle_X_Object Closest Distance Y_00
前雷达距目标物最近点在Y轴上的距离_00
Closest Position Of Target Vehicle In Y Direction
The rear axle center coordinate system is used";
CM_ SG_ 975 FRM_16_ObjRelVelX_26 "Front Radar Moudle_X_Object Relative Velocity X_00
前雷达目标物在X轴上的相对速度_00
Relative Target Object Velocity In X Direction";
CM_ SG_ 975 FRM_16_ObjRelVelY_26 "Front Radar Moudle_X_Object Relative Velocity Y_00
前雷达目标物在Y轴上的相对速度_00
Relative Target Object Velocity In Y Direction";
CM_ SG_ 975 FRM_16_ObjAccelX_26 "Front Radar Moudle_X_Object Acceleration X_00
前雷达目标物在X轴上的加速度_00
Relative Target Object Acceleration In X Direction";
CM_ SG_ 975 FRM_16_ObjAccelY_26 "Front Radar Moudle_X_Object Acceleration Y_00
前雷达目标物在Y轴上的加速度_00
Relative Target Object Acceleration In Y Direction";
CM_ SG_ 975 FRM_16_ObjClosestDistXStd_26 "Front Radar Moudle_X_Object Closest Distance X Standard_00
前雷达目标物最近点在X轴上的距离的标准差_00
Standard Deviation Of Closest Position Of Target Vehicle in X Direction";
CM_ SG_ 975 FRM_16_ObjClosestDistYStd_26 "Front Radar Moudle_X_Object Closest Distance Y Standard_00
前雷达目标物最近点在Y轴上的距离的标准差_00
Standard Deviation Of Closest Position Of Target Vehicle in Y Direction";
CM_ SG_ 975 FRM_16_ObjRelVelXStd_26 "Front Radar Moudle_X_Object Relative Velocity X Standard_00
前雷达目标物在X轴上的相对速度的标准差_00
Standard Deviation Of Relative Velocity X";
CM_ SG_ 975 FRM_16_ObjRelVelYStd_26 "Front Radar Moudle_X_Object Relative Velocity Y Standard_00
前雷达目标物在Y轴上的相对速度的标准差_00
Standard Deviation Of Relative Velocity Y";
CM_ SG_ 975 FRM_16_ObjRelAccelXStd_26 "Front Radar Moudle_X_Object Relative  Acceleration X Standard_00
前雷达目标物在X轴上的相对加速度的标准差_00
Standard Deviation Of Relative Acceleration X";
CM_ SG_ 975 FRM_16_ObjRelAccelYStd_26 "Front Radar Moudle_X_Object Relative  Acceleration Y Standard_00
前雷达目标物相对加速度在Y轴上的标准差_00
Standard Deviation Of Relative Acceleration Y";
CM_ SG_ 975 FRM_16_ObjExistProb_26 "Front Radar Moudle_X_Object Exist Probability_00
前雷达目标物存在的可能性_00
The Probability Of An Object To Exist In Reality";
CM_ SG_ 975 FRM_16_ObjType_26 "Front Radar Moudle_X_Object Type_00
前雷达目标物的分类_00
Class Of Object Type
Note: Type of static object shall always be 0x0: unknown";
CM_ SG_ 975 FRM_16_ObjTypeConf_26 "Front Radar Moudle_X_Object Type Confidence_00
前雷达目标物分类的置信度_00
The Class Confidence Of Object Type";
CM_ SG_ 975 FRM_16_ObjTrackSts_26 "Front Radar Moudle_X_Object Track Status_00
前雷达目标物的跟踪状态_00
Signal To Indicate The Object Track Status";
CM_ SG_ 975 FRM_16_ObjMotionSts_26 "Front Radar Moudle_X_Object Motion Status_00
前雷达目标物的运动状态_00
Signal To Indicate The Object Whether Moving or Stopped or Static";
CM_ SG_ 975 FRM_16_ObjMotionDirection_26 "Front Radar Moudle_X_Object Motion Direction_00
前雷达目标物的运动方向_00
Signal To Indicate The Object Moving Direction.
Note: Moving direction of static object or stopped object shall always be 0x0: Unknown";
CM_ SG_ 975 FRM_16_ObjCenterDistX_26 "Front Radar Moudle_X_Object Center Distance X_00
前雷达目标物中心点在X轴方向的距离_00
Center Position Of Target Vehicle In X Direction
The rear axle center coordinate system is used";
CM_ SG_ 975 FRM_16_ObjCenterDistY_26 "Front Radar Moudle_X_Object Center Distance Y_00
前雷达目标物中心点在Y轴方向的距离_00
Center Position Of Target Vehicle In Y Direction
The rear axle center coordinate system is used";
CM_ SG_ 975 FRM_16_ObjLength_26 "Front Radar Moudle_X_Object Length_00
前雷达目标物的长度_00
Length Of Target
Note: Length of static object shall always be 0";
CM_ SG_ 975 FRM_16_ObjWidth_26 "Front Radar Moudle_X_Object Width_00
前雷达目标物的宽度_00
Width Of Target
Note: Width of static object shall always be 0";
CM_ SG_ 975 FRM_16_ObjElevnSts_26 "Front Radar Moudle_X_Object Elevation Status_00
前雷达目标物的高度状态_00
The Elevation Status Of An Object
Note: Elevation Status of moving object or stopped object shall always be 0x2: Obstacle";
CM_ SG_ 975 FRM_16_ObjElevnStsConf_26 "Front Radar Moudle_X_Object Elevation Status Confidence_00
前雷达目标物的高度状态的置信度_00
The Confidence Of An Object Elevation Status
Note: Elevation Status Confidence of moving object or stopped object shall always be 100%";
CM_ SG_ 975 FRM_16_ObjHeading_26 "Front Radar Moudle_X_Object Heading_00
前雷达目标物朝向_00
Heading of object 
Note: A rotation vector with anticlock-rotating as positive +π shall be used instead of -π when obect vertically backward
Note: Heading of static object shall always be 0";
CM_ SG_ 975 FRM_16_ObjID_27 "Front Radar Moudle_X_Object ID_01
前雷达目标物身份标识码_01
ID Is An Identifier Number That Allows For Tracking Of Persistent Objects Over Time
Note:A value of 0 indicates 'no object'";
CM_ SG_ 975 FRM_16_ObjClosestDistX_27 "Front Radar Moudle_X_Object Closest Distance X_01
前雷达目标物最近点在X轴上的距离_01
Closest Position Of Target Vehicle In X Direction
The rear axle center coordinate system is used";
CM_ SG_ 975 FRM_16_ObjClosestDistY_27 "Front Radar Moudle_X_Object Closest Distance Y_01
前雷达距目标物最近点在Y轴上的距离_01
Closest Position Of Target Vehicle In Y Direction
The rear axle center coordinate system is used";
CM_ SG_ 975 FRM_16_ObjRelVelX_27 "Front Radar Moudle_X_Object Relative Velocity X_01
前雷达目标物在X轴上的相对速度_01
Relative Target Object Velocity In X Direction";
CM_ SG_ 975 FRM_16_ObjRelVelY_27 "Front Radar Moudle_X_Object Relative Velocity Y_01
前雷达目标物在Y轴上的相对速度_01
Relative Target Object Velocity In Y Direction";
CM_ SG_ 975 FRM_16_ObjAccelX_27 "Front Radar Moudle_X_Object Acceleration X_01
前雷达目标物在X轴上的加速度_01
Relative Target Object Acceleration In X Direction";
CM_ SG_ 975 FRM_16_ObjAccelY_27 "Front Radar Moudle_X_Object Acceleration Y_01
前雷达目标物在Y轴上的加速度_01
Relative Target Object Acceleration In Y Direction";
CM_ SG_ 975 FRM_16_ObjClosestDistXStd_27 "Front Radar Moudle_X_Object Closest Distance X Standard_01
前雷达目标物最近点在X轴上的距离的标准差_01
Standard Deviation Of Closest Position Of Target Vehicle in X Direction";
CM_ SG_ 975 FRM_16_ObjClosestDistYStd_27 "Front Radar Moudle_X_Object Closest Distance Y Standard_01
前雷达目标物最近点在Y轴上的距离的标准差_01
Standard Deviation Of Closest Position Of Target Vehicle in Y Direction";
CM_ SG_ 975 FRM_16_ObjRelVelXStd_27 "Front Radar Moudle_X_Object Relative Velocity X Standard_01
前雷达目标物在X轴上的相对速度的标准差_01
Standard Deviation Of Relative Velocity X";
CM_ SG_ 975 FRM_16_ObjRelVelYStd_27 "Front Radar Moudle_X_Object Relative Velocity Y Standard_01
前雷达目标物在Y轴上的相对速度的标准差_01
Standard Deviation Of Relative Velocity Y";
CM_ SG_ 975 FRM_16_ObjRelAccelXStd_27 "Front Radar Moudle_X_Object Relative  Acceleration X Standard_01
前雷达目标物在X轴上的相对加速度的标准差_01
Standard Deviation Of Relative Acceleration X";
CM_ SG_ 975 FRM_16_ObjRelAccelYStd_27 "Front Radar Moudle_X_Object Relative  Acceleration Y Standard_01
前雷达目标物相对加速度在Y轴上的标准差_01
Standard Deviation Of Relative Acceleration Y";
CM_ SG_ 975 FRM_16_ObjExistProb_27 "Front Radar Moudle_X_Object Exist Probability_01
前雷达目标物存在的可能性_01
The Probability Of An Object To Exist In Reality";
CM_ SG_ 975 FRM_16_ObjType_27 "Front Radar Moudle_X_Object Type_01
前雷达目标物的分类_01
Class Of Object Type
Note: Type of static object shall always be 0x0: unknown";
CM_ SG_ 975 FRM_16_ObjTypeConf_27 "Front Radar Moudle_X_Object Type Confidence_01
前雷达目标物分类的置信度_01
The Class Confidence Of Object Type";
CM_ SG_ 975 FRM_16_ObjTrackSts_27 "Front Radar Moudle_X_Object Track Status_01
前雷达目标物的跟踪状态_01
Signal To Indicate The Object Track Status";
CM_ SG_ 975 FRM_16_ObjMotionSts_27 "Front Radar Moudle_X_Object Motion Status_01
前雷达目标物的运动状态_01
Signal To Indicate The Object Whether Moving or Stopped or Static";
CM_ SG_ 975 FRM_16_ObjMotionDirection_27 "Front Radar Moudle_X_Object Motion Direction_01
前雷达目标物的运动方向_01
Signal To Indicate The Object Moving Direction.
Note: Moving direction of static object or stopped object shall always be 0x0: Unknown";
CM_ SG_ 975 FRM_16_ObjCenterDistX_27 "Front Radar Moudle_X_Object Center Distance X_01
前雷达目标物中心点在X轴方向的距离_01
Center Position Of Target Vehicle In X Direction
The rear axle center coordinate system is used";
CM_ SG_ 975 FRM_16_ObjCenterDistY_27 "Front Radar Moudle_X_Object Center Distance Y_01
前雷达目标物中心点在Y轴方向的距离_01
Center Position Of Target Vehicle In Y Direction
The rear axle center coordinate system is used";
CM_ SG_ 975 FRM_16_ObjLength_27 "Front Radar Moudle_X_Object Length_01
前雷达目标物的长度_01
Length Of Target
Note: Length of static object shall always be 0";
CM_ SG_ 975 FRM_16_ObjWidth_27 "Front Radar Moudle_X_Object Width_01
前雷达目标物的宽度_01
Width Of Target
Note: Width of static object shall always be 0";
CM_ SG_ 975 FRM_16_ObjElevnSts_27 "Front Radar Moudle_X_Object Elevation Status_01
前雷达目标物的高度状态_01
The Elevation Status Of An Object
Note: Elevation Status of moving object or stopped object shall always be 0x2: Obstacle";
CM_ SG_ 975 FRM_16_ObjElevnStsConf_27 "Front Radar Moudle_X_Object Elevation Status Confidence_01
前雷达目标物的高度状态的置信度_01
The Confidence Of An Object Elevation Status
Note: Elevation Status Confidence of moving object or stopped object shall always be 100%";
CM_ SG_ 975 FRM_16_ObjHeading_27 "Front Radar Moudle_X_Object Heading_01
前雷达目标物朝向_01
Heading of object 
Note: A rotation vector with anticlock-rotating as positive +π shall be used instead of -π when obect vertically backward
Note: Heading of static object shall always be 0";
CM_ SG_ 976 FRM_17_CRC "Profile5:E2E CRC16 (polynomial:0x1021)       
DataID:Use CANID,other bits Fill with 0";
CM_ SG_ 976 FRM_17_RollgCntr "Profile5:E2E Rolling message counter";
CM_ SG_ 976 FRM_17_ObjBlockCounter "Front Radar Moudle_X_Object Block Counter
前雷达目标物块计数值";
CM_ SG_ 976 FRM_17_ObjID_28 "Front Radar Moudle_X_Object ID_00
前雷达目标物身份标识码_00
ID Is An Identifier Number That Allows For Tracking Of Persistent Objects Over Time
Note:A value of 0 indicates 'no object'";
CM_ SG_ 976 FRM_17_ObjClosestDistX_28 "Front Radar Moudle_X_Object Closest Distance X_00
前雷达目标物最近点在X轴上的距离_00
Closest Position Of Target Vehicle In X Direction
The rear axle center coordinate system is used";
CM_ SG_ 976 FRM_17_ObjClosestDistY_28 "Front Radar Moudle_X_Object Closest Distance Y_00
前雷达距目标物最近点在Y轴上的距离_00
Closest Position Of Target Vehicle In Y Direction
The rear axle center coordinate system is used";
CM_ SG_ 976 FRM_17_ObjRelVelX_28 "Front Radar Moudle_X_Object Relative Velocity X_00
前雷达目标物在X轴上的相对速度_00
Relative Target Object Velocity In X Direction";
CM_ SG_ 976 FRM_17_ObjRelVelY_28 "Front Radar Moudle_X_Object Relative Velocity Y_00
前雷达目标物在Y轴上的相对速度_00
Relative Target Object Velocity In Y Direction";
CM_ SG_ 976 FRM_17_ObjAccelX_28 "Front Radar Moudle_X_Object Acceleration X_00
前雷达目标物在X轴上的加速度_00
Relative Target Object Acceleration In X Direction";
CM_ SG_ 976 FRM_17_ObjAccelY_28 "Front Radar Moudle_X_Object Acceleration Y_00
前雷达目标物在Y轴上的加速度_00
Relative Target Object Acceleration In Y Direction";
CM_ SG_ 976 FRM_17_ObjClosestDistXStd_28 "Front Radar Moudle_X_Object Closest Distance X Standard_00
前雷达目标物最近点在X轴上的距离的标准差_00
Standard Deviation Of Closest Position Of Target Vehicle in X Direction";
CM_ SG_ 976 FRM_17_ObjClosestDistYStd_28 "Front Radar Moudle_X_Object Closest Distance Y Standard_00
前雷达目标物最近点在Y轴上的距离的标准差_00
Standard Deviation Of Closest Position Of Target Vehicle in Y Direction";
CM_ SG_ 976 FRM_17_ObjRelVelXStd_28 "Front Radar Moudle_X_Object Relative Velocity X Standard_00
前雷达目标物在X轴上的相对速度的标准差_00
Standard Deviation Of Relative Velocity X";
CM_ SG_ 976 FRM_17_ObjRelVelYStd_28 "Front Radar Moudle_X_Object Relative Velocity Y Standard_00
前雷达目标物在Y轴上的相对速度的标准差_00
Standard Deviation Of Relative Velocity Y";
CM_ SG_ 976 FRM_17_ObjRelAccelXStd_28 "Front Radar Moudle_X_Object Relative  Acceleration X Standard_00
前雷达目标物在X轴上的相对加速度的标准差_00
Standard Deviation Of Relative Acceleration X";
CM_ SG_ 976 FRM_17_ObjRelAccelYStd_28 "Front Radar Moudle_X_Object Relative  Acceleration Y Standard_00
前雷达目标物相对加速度在Y轴上的标准差_00
Standard Deviation Of Relative Acceleration Y";
CM_ SG_ 976 FRM_17_ObjExistProb_28 "Front Radar Moudle_X_Object Exist Probability_00
前雷达目标物存在的可能性_00
The Probability Of An Object To Exist In Reality";
CM_ SG_ 976 FRM_17_ObjType_28 "Front Radar Moudle_X_Object Type_00
前雷达目标物的分类_00
Class Of Object Type
Note: Type of static object shall always be 0x0: unknown";
CM_ SG_ 976 FRM_17_ObjTypeConf_28 "Front Radar Moudle_X_Object Type Confidence_00
前雷达目标物分类的置信度_00
The Class Confidence Of Object Type";
CM_ SG_ 976 FRM_17_ObjTrackSts_28 "Front Radar Moudle_X_Object Track Status_00
前雷达目标物的跟踪状态_00
Signal To Indicate The Object Track Status";
CM_ SG_ 976 FRM_17_ObjMotionSts_28 "Front Radar Moudle_X_Object Motion Status_00
前雷达目标物的运动状态_00
Signal To Indicate The Object Whether Moving or Stopped or Static";
CM_ SG_ 976 FRM_17_ObjMotionDirection_28 "Front Radar Moudle_X_Object Motion Direction_00
前雷达目标物的运动方向_00
Signal To Indicate The Object Moving Direction.
Note: Moving direction of static object or stopped object shall always be 0x0: Unknown";
CM_ SG_ 976 FRM_17_ObjCenterDistX_28 "Front Radar Moudle_X_Object Center Distance X_00
前雷达目标物中心点在X轴方向的距离_00
Center Position Of Target Vehicle In X Direction
The rear axle center coordinate system is used";
CM_ SG_ 976 FRM_17_ObjCenterDistY_28 "Front Radar Moudle_X_Object Center Distance Y_00
前雷达目标物中心点在Y轴方向的距离_00
Center Position Of Target Vehicle In Y Direction
The rear axle center coordinate system is used";
CM_ SG_ 976 FRM_17_ObjLength_28 "Front Radar Moudle_X_Object Length_00
前雷达目标物的长度_00
Length Of Target
Note: Length of static object shall always be 0";
CM_ SG_ 976 FRM_17_ObjWidth_28 "Front Radar Moudle_X_Object Width_00
前雷达目标物的宽度_00
Width Of Target
Note: Width of static object shall always be 0";
CM_ SG_ 976 FRM_17_ObjElevnSts_28 "Front Radar Moudle_X_Object Elevation Status_00
前雷达目标物的高度状态_00
The Elevation Status Of An Object
Note: Elevation Status of moving object or stopped object shall always be 0x2: Obstacle";
CM_ SG_ 976 FRM_17_ObjElevnStsConf_28 "Front Radar Moudle_X_Object Elevation Status Confidence_00
前雷达目标物的高度状态的置信度_00
The Confidence Of An Object Elevation Status
Note: Elevation Status Confidence of moving object or stopped object shall always be 100%";
CM_ SG_ 976 FRM_17_ObjHeading_28 "Front Radar Moudle_X_Object Heading_00
前雷达目标物朝向_00
Heading of object 
Note: A rotation vector with anticlock-rotating as positive +π shall be used instead of -π when obect vertically backward
Note: Heading of static object shall always be 0";
CM_ SG_ 976 FRM_17_ObjID_29 "Front Radar Moudle_X_Object ID_01
前雷达目标物身份标识码_01
ID Is An Identifier Number That Allows For Tracking Of Persistent Objects Over Time
Note:A value of 0 indicates 'no object'";
CM_ SG_ 976 FRM_17_ObjClosestDistX_29 "Front Radar Moudle_X_Object Closest Distance X_01
前雷达目标物最近点在X轴上的距离_01
Closest Position Of Target Vehicle In X Direction
The rear axle center coordinate system is used";
CM_ SG_ 976 FRM_17_ObjClosestDistY_29 "Front Radar Moudle_X_Object Closest Distance Y_01
前雷达距目标物最近点在Y轴上的距离_01
Closest Position Of Target Vehicle In Y Direction
The rear axle center coordinate system is used";
CM_ SG_ 976 FRM_17_ObjRelVelX_29 "Front Radar Moudle_X_Object Relative Velocity X_01
前雷达目标物在X轴上的相对速度_01
Relative Target Object Velocity In X Direction";
CM_ SG_ 976 FRM_17_ObjRelVelY_29 "Front Radar Moudle_X_Object Relative Velocity Y_01
前雷达目标物在Y轴上的相对速度_01
Relative Target Object Velocity In Y Direction";
CM_ SG_ 976 FRM_17_ObjAccelX_29 "Front Radar Moudle_X_Object Acceleration X_01
前雷达目标物在X轴上的加速度_01
Relative Target Object Acceleration In X Direction";
CM_ SG_ 976 FRM_17_ObjAccelY_29 "Front Radar Moudle_X_Object Acceleration Y_01
前雷达目标物在Y轴上的加速度_01
Relative Target Object Acceleration In Y Direction";
CM_ SG_ 976 FRM_17_ObjClosestDistXStd_29 "Front Radar Moudle_X_Object Closest Distance X Standard_01
前雷达目标物最近点在X轴上的距离的标准差_01
Standard Deviation Of Closest Position Of Target Vehicle in X Direction";
CM_ SG_ 976 FRM_17_ObjClosestDistYStd_29 "Front Radar Moudle_X_Object Closest Distance Y Standard_01
前雷达目标物最近点在Y轴上的距离的标准差_01
Standard Deviation Of Closest Position Of Target Vehicle in Y Direction";
CM_ SG_ 976 FRM_17_ObjRelVelXStd_29 "Front Radar Moudle_X_Object Relative Velocity X Standard_01
前雷达目标物在X轴上的相对速度的标准差_01
Standard Deviation Of Relative Velocity X";
CM_ SG_ 976 FRM_17_ObjRelVelYStd_29 "Front Radar Moudle_X_Object Relative Velocity Y Standard_01
前雷达目标物在Y轴上的相对速度的标准差_01
Standard Deviation Of Relative Velocity Y";
CM_ SG_ 976 FRM_17_ObjRelAccelXStd_29 "Front Radar Moudle_X_Object Relative  Acceleration X Standard_01
前雷达目标物在X轴上的相对加速度的标准差_01
Standard Deviation Of Relative Acceleration X";
CM_ SG_ 976 FRM_17_ObjRelAccelYStd_29 "Front Radar Moudle_X_Object Relative  Acceleration Y Standard_01
前雷达目标物相对加速度在Y轴上的标准差_01
Standard Deviation Of Relative Acceleration Y";
CM_ SG_ 976 FRM_17_ObjExistProb_29 "Front Radar Moudle_X_Object Exist Probability_01
前雷达目标物存在的可能性_01
The Probability Of An Object To Exist In Reality";
CM_ SG_ 976 FRM_17_ObjType_29 "Front Radar Moudle_X_Object Type_01
前雷达目标物的分类_01
Class Of Object Type
Note: Type of static object shall always be 0x0: unknown";
CM_ SG_ 976 FRM_17_ObjTypeConf_29 "Front Radar Moudle_X_Object Type Confidence_01
前雷达目标物分类的置信度_01
The Class Confidence Of Object Type";
CM_ SG_ 976 FRM_17_ObjTrackSts_29 "Front Radar Moudle_X_Object Track Status_01
前雷达目标物的跟踪状态_01
Signal To Indicate The Object Track Status";
CM_ SG_ 976 FRM_17_ObjMotionSts_29 "Front Radar Moudle_X_Object Motion Status_01
前雷达目标物的运动状态_01
Signal To Indicate The Object Whether Moving or Stopped or Static";
CM_ SG_ 976 FRM_17_ObjMotionDirection_29 "Front Radar Moudle_X_Object Motion Direction_01
前雷达目标物的运动方向_01
Signal To Indicate The Object Moving Direction.
Note: Moving direction of static object or stopped object shall always be 0x0: Unknown";
CM_ SG_ 976 FRM_17_ObjCenterDistX_29 "Front Radar Moudle_X_Object Center Distance X_01
前雷达目标物中心点在X轴方向的距离_01
Center Position Of Target Vehicle In X Direction
The rear axle center coordinate system is used";
CM_ SG_ 976 FRM_17_ObjCenterDistY_29 "Front Radar Moudle_X_Object Center Distance Y_01
前雷达目标物中心点在Y轴方向的距离_01
Center Position Of Target Vehicle In Y Direction
The rear axle center coordinate system is used";
CM_ SG_ 976 FRM_17_ObjLength_29 "Front Radar Moudle_X_Object Length_01
前雷达目标物的长度_01
Length Of Target
Note: Length of static object shall always be 0";
CM_ SG_ 976 FRM_17_ObjWidth_29 "Front Radar Moudle_X_Object Width_01
前雷达目标物的宽度_01
Width Of Target
Note: Width of static object shall always be 0";
CM_ SG_ 976 FRM_17_ObjElevnSts_29 "Front Radar Moudle_X_Object Elevation Status_01
前雷达目标物的高度状态_01
The Elevation Status Of An Object
Note: Elevation Status of moving object or stopped object shall always be 0x2: Obstacle";
CM_ SG_ 976 FRM_17_ObjElevnStsConf_29 "Front Radar Moudle_X_Object Elevation Status Confidence_01
前雷达目标物的高度状态的置信度_01
The Confidence Of An Object Elevation Status
Note: Elevation Status Confidence of moving object or stopped object shall always be 100%";
CM_ SG_ 976 FRM_17_ObjHeading_29 "Front Radar Moudle_X_Object Heading_01
前雷达目标物朝向_01
Heading of object 
Note: A rotation vector with anticlock-rotating as positive +π shall be used instead of -π when obect vertically backward
Note: Heading of static object shall always be 0";
CM_ SG_ 977 FRM_18_CRC "Profile5:E2E CRC16 (polynomial:0x1021)       
DataID:Use CANID,other bits Fill with 0";
CM_ SG_ 977 FRM_18_RollgCntr "Profile5:E2E Rolling message counter";
CM_ SG_ 977 FRM_18_ObjBlockCounter "Front Radar Moudle_X_Object Block Counter
前雷达目标物块计数值";
CM_ SG_ 977 FRM_18_ObjID_30 "Front Radar Moudle_X_Object ID_00
前雷达目标物身份标识码_00
ID Is An Identifier Number That Allows For Tracking Of Persistent Objects Over Time
Note:A value of 0 indicates 'no object'";
CM_ SG_ 977 FRM_18_ObjClosestDistX_30 "Front Radar Moudle_X_Object Closest Distance X_00
前雷达目标物最近点在X轴上的距离_00
Closest Position Of Target Vehicle In X Direction
The rear axle center coordinate system is used";
CM_ SG_ 977 FRM_18_ObjClosestDistY_30 "Front Radar Moudle_X_Object Closest Distance Y_00
前雷达距目标物最近点在Y轴上的距离_00
Closest Position Of Target Vehicle In Y Direction
The rear axle center coordinate system is used";
CM_ SG_ 977 FRM_18_ObjRelVelX_30 "Front Radar Moudle_X_Object Relative Velocity X_00
前雷达目标物在X轴上的相对速度_00
Relative Target Object Velocity In X Direction";
CM_ SG_ 977 FRM_18_ObjRelVelY_30 "Front Radar Moudle_X_Object Relative Velocity Y_00
前雷达目标物在Y轴上的相对速度_00
Relative Target Object Velocity In Y Direction";
CM_ SG_ 977 FRM_18_ObjAccelX_30 "Front Radar Moudle_X_Object Acceleration X_00
前雷达目标物在X轴上的加速度_00
Relative Target Object Acceleration In X Direction";
CM_ SG_ 977 FRM_18_ObjAccelY_30 "Front Radar Moudle_X_Object Acceleration Y_00
前雷达目标物在Y轴上的加速度_00
Relative Target Object Acceleration In Y Direction";
CM_ SG_ 977 FRM_18_ObjClosestDistXStd_30 "Front Radar Moudle_X_Object Closest Distance X Standard_00
前雷达目标物最近点在X轴上的距离的标准差_00
Standard Deviation Of Closest Position Of Target Vehicle in X Direction";
CM_ SG_ 977 FRM_18_ObjClosestDistYStd_30 "Front Radar Moudle_X_Object Closest Distance Y Standard_00
前雷达目标物最近点在Y轴上的距离的标准差_00
Standard Deviation Of Closest Position Of Target Vehicle in Y Direction";
CM_ SG_ 977 FRM_18_ObjRelVelXStd_30 "Front Radar Moudle_X_Object Relative Velocity X Standard_00
前雷达目标物在X轴上的相对速度的标准差_00
Standard Deviation Of Relative Velocity X";
CM_ SG_ 977 FRM_18_ObjRelVelYStd_30 "Front Radar Moudle_X_Object Relative Velocity Y Standard_00
前雷达目标物在Y轴上的相对速度的标准差_00
Standard Deviation Of Relative Velocity Y";
CM_ SG_ 977 FRM_18_ObjRelAccelXStd_30 "Front Radar Moudle_X_Object Relative  Acceleration X Standard_00
前雷达目标物在X轴上的相对加速度的标准差_00
Standard Deviation Of Relative Acceleration X";
CM_ SG_ 977 FRM_18_ObjRelAccelYStd_30 "Front Radar Moudle_X_Object Relative  Acceleration Y Standard_00
前雷达目标物相对加速度在Y轴上的标准差_00
Standard Deviation Of Relative Acceleration Y";
CM_ SG_ 977 FRM_18_ObjExistProb_30 "Front Radar Moudle_X_Object Exist Probability_00
前雷达目标物存在的可能性_00
The Probability Of An Object To Exist In Reality";
CM_ SG_ 977 FRM_18_ObjType_30 "Front Radar Moudle_X_Object Type_00
前雷达目标物的分类_00
Class Of Object Type
Note: Type of static object shall always be 0x0: unknown";
CM_ SG_ 977 FRM_18_ObjTypeConf_30 "Front Radar Moudle_X_Object Type Confidence_00
前雷达目标物分类的置信度_00
The Class Confidence Of Object Type";
CM_ SG_ 977 FRM_18_ObjTrackSts_30 "Front Radar Moudle_X_Object Track Status_00
前雷达目标物的跟踪状态_00
Signal To Indicate The Object Track Status";
CM_ SG_ 977 FRM_18_ObjMotionSts_30 "Front Radar Moudle_X_Object Motion Status_00
前雷达目标物的运动状态_00
Signal To Indicate The Object Whether Moving or Stopped or Static";
CM_ SG_ 977 FRM_18_ObjMotionDirection_30 "Front Radar Moudle_X_Object Motion Direction_00
前雷达目标物的运动方向_00
Signal To Indicate The Object Moving Direction.
Note: Moving direction of static object or stopped object shall always be 0x0: Unknown";
CM_ SG_ 977 FRM_18_ObjCenterDistX_30 "Front Radar Moudle_X_Object Center Distance X_00
前雷达目标物中心点在X轴方向的距离_00
Center Position Of Target Vehicle In X Direction
The rear axle center coordinate system is used";
CM_ SG_ 977 FRM_18_ObjCenterDistY_30 "Front Radar Moudle_X_Object Center Distance Y_00
前雷达目标物中心点在Y轴方向的距离_00
Center Position Of Target Vehicle In Y Direction
The rear axle center coordinate system is used";
CM_ SG_ 977 FRM_18_ObjLength_30 "Front Radar Moudle_X_Object Length_00
前雷达目标物的长度_00
Length Of Target
Note: Length of static object shall always be 0";
CM_ SG_ 977 FRM_18_ObjWidth_30 "Front Radar Moudle_X_Object Width_00
前雷达目标物的宽度_00
Width Of Target
Note: Width of static object shall always be 0";
CM_ SG_ 977 FRM_18_ObjElevnSts_30 "Front Radar Moudle_X_Object Elevation Status_00
前雷达目标物的高度状态_00
The Elevation Status Of An Object
Note: Elevation Status of moving object or stopped object shall always be 0x2: Obstacle";
CM_ SG_ 977 FRM_18_ObjElevnStsConf_30 "Front Radar Moudle_X_Object Elevation Status Confidence_00
前雷达目标物的高度状态的置信度_00
The Confidence Of An Object Elevation Status
Note: Elevation Status Confidence of moving object or stopped object shall always be 100%";
CM_ SG_ 977 FRM_18_ObjHeading_30 "Front Radar Moudle_X_Object Heading_00
前雷达目标物朝向_00
Heading of object 
Note: A rotation vector with anticlock-rotating as positive +π shall be used instead of -π when obect vertically backward
Note: Heading of static object shall always be 0";
CM_ SG_ 977 FRM_18_ObjID_31 "Front Radar Moudle_X_Object ID_01
前雷达目标物身份标识码_01
ID Is An Identifier Number That Allows For Tracking Of Persistent Objects Over Time
Note:A value of 0 indicates 'no object'";
CM_ SG_ 977 FRM_18_ObjClosestDistX_31 "Front Radar Moudle_X_Object Closest Distance X_01
前雷达目标物最近点在X轴上的距离_01
Closest Position Of Target Vehicle In X Direction
The rear axle center coordinate system is used";
CM_ SG_ 977 FRM_18_ObjClosestDistY_31 "Front Radar Moudle_X_Object Closest Distance Y_01
前雷达距目标物最近点在Y轴上的距离_01
Closest Position Of Target Vehicle In Y Direction
The rear axle center coordinate system is used";
CM_ SG_ 977 FRM_18_ObjRelVelX_31 "Front Radar Moudle_X_Object Relative Velocity X_01
前雷达目标物在X轴上的相对速度_01
Relative Target Object Velocity In X Direction";
CM_ SG_ 977 FRM_18_ObjRelVelY_31 "Front Radar Moudle_X_Object Relative Velocity Y_01
前雷达目标物在Y轴上的相对速度_01
Relative Target Object Velocity In Y Direction";
CM_ SG_ 977 FRM_18_ObjAccelX_31 "Front Radar Moudle_X_Object Acceleration X_01
前雷达目标物在X轴上的加速度_01
Relative Target Object Acceleration In X Direction";
CM_ SG_ 977 FRM_18_ObjAccelY_31 "Front Radar Moudle_X_Object Acceleration Y_01
前雷达目标物在Y轴上的加速度_01
Relative Target Object Acceleration In Y Direction";
CM_ SG_ 977 FRM_18_ObjClosestDistXStd_31 "Front Radar Moudle_X_Object Closest Distance X Standard_01
前雷达目标物最近点在X轴上的距离的标准差_01
Standard Deviation Of Closest Position Of Target Vehicle in X Direction";
CM_ SG_ 977 FRM_18_ObjClosestDistYStd_31 "Front Radar Moudle_X_Object Closest Distance Y Standard_01
前雷达目标物最近点在Y轴上的距离的标准差_01
Standard Deviation Of Closest Position Of Target Vehicle in Y Direction";
CM_ SG_ 977 FRM_18_ObjRelVelXStd_31 "Front Radar Moudle_X_Object Relative Velocity X Standard_01
前雷达目标物在X轴上的相对速度的标准差_01
Standard Deviation Of Relative Velocity X";
CM_ SG_ 977 FRM_18_ObjRelVelYStd_31 "Front Radar Moudle_X_Object Relative Velocity Y Standard_01
前雷达目标物在Y轴上的相对速度的标准差_01
Standard Deviation Of Relative Velocity Y";
CM_ SG_ 977 FRM_18_ObjRelAccelXStd_31 "Front Radar Moudle_X_Object Relative  Acceleration X Standard_01
前雷达目标物在X轴上的相对加速度的标准差_01
Standard Deviation Of Relative Acceleration X";
CM_ SG_ 977 FRM_18_ObjRelAccelYStd_31 "Front Radar Moudle_X_Object Relative  Acceleration Y Standard_01
前雷达目标物相对加速度在Y轴上的标准差_01
Standard Deviation Of Relative Acceleration Y";
CM_ SG_ 977 FRM_18_ObjExistProb_31 "Front Radar Moudle_X_Object Exist Probability_01
前雷达目标物存在的可能性_01
The Probability Of An Object To Exist In Reality";
CM_ SG_ 977 FRM_18_ObjType_31 "Front Radar Moudle_X_Object Type_01
前雷达目标物的分类_01
Class Of Object Type
Note: Type of static object shall always be 0x0: unknown";
CM_ SG_ 977 FRM_18_ObjTypeConf_31 "Front Radar Moudle_X_Object Type Confidence_01
前雷达目标物分类的置信度_01
The Class Confidence Of Object Type";
CM_ SG_ 977 FRM_18_ObjTrackSts_31 "Front Radar Moudle_X_Object Track Status_01
前雷达目标物的跟踪状态_01
Signal To Indicate The Object Track Status";
CM_ SG_ 977 FRM_18_ObjMotionSts_31 "Front Radar Moudle_X_Object Motion Status_01
前雷达目标物的运动状态_01
Signal To Indicate The Object Whether Moving or Stopped or Static";
CM_ SG_ 977 FRM_18_ObjMotionDirection_31 "Front Radar Moudle_X_Object Motion Direction_01
前雷达目标物的运动方向_01
Signal To Indicate The Object Moving Direction.
Note: Moving direction of static object or stopped object shall always be 0x0: Unknown";
CM_ SG_ 977 FRM_18_ObjCenterDistX_31 "Front Radar Moudle_X_Object Center Distance X_01
前雷达目标物中心点在X轴方向的距离_01
Center Position Of Target Vehicle In X Direction
The rear axle center coordinate system is used";
CM_ SG_ 977 FRM_18_ObjCenterDistY_31 "Front Radar Moudle_X_Object Center Distance Y_01
前雷达目标物中心点在Y轴方向的距离_01
Center Position Of Target Vehicle In Y Direction
The rear axle center coordinate system is used";
CM_ SG_ 977 FRM_18_ObjLength_31 "Front Radar Moudle_X_Object Length_01
前雷达目标物的长度_01
Length Of Target
Note: Length of static object shall always be 0";
CM_ SG_ 977 FRM_18_ObjWidth_31 "Front Radar Moudle_X_Object Width_01
前雷达目标物的宽度_01
Width Of Target
Note: Width of static object shall always be 0";
CM_ SG_ 977 FRM_18_ObjElevnSts_31 "Front Radar Moudle_X_Object Elevation Status_01
前雷达目标物的高度状态_01
The Elevation Status Of An Object
Note: Elevation Status of moving object or stopped object shall always be 0x2: Obstacle";
CM_ SG_ 977 FRM_18_ObjElevnStsConf_31 "Front Radar Moudle_X_Object Elevation Status Confidence_01
前雷达目标物的高度状态的置信度_01
The Confidence Of An Object Elevation Status
Note: Elevation Status Confidence of moving object or stopped object shall always be 100%";
CM_ SG_ 977 FRM_18_ObjHeading_31 "Front Radar Moudle_X_Object Heading_01
前雷达目标物朝向_01
Heading of object 
Note: A rotation vector with anticlock-rotating as positive +π shall be used instead of -π when obect vertically backward
Note: Heading of static object shall always be 0";
CM_ SG_ 978 FRM_19_CRC "Profile5:E2E CRC16 (polynomial:0x1021)       
DataID:Use CANID,other bits Fill with 0";
CM_ SG_ 978 FRM_19_RollgCntr "Profile5:E2E Rolling message counter";
CM_ SG_ 978 FRM_19_ObjBlockCounter "Front Radar Moudle_X_Object Block Counter
前雷达目标物块计数值";
CM_ SG_ 978 FRM_19_ObjID_32 "Front Radar Moudle_X_Object ID_00
前雷达目标物身份标识码_00
ID Is An Identifier Number That Allows For Tracking Of Persistent Objects Over Time
Note:A value of 0 indicates 'no object'";
CM_ SG_ 978 FRM_19_ObjClosestDistX_32 "Front Radar Moudle_X_Object Closest Distance X_00
前雷达目标物最近点在X轴上的距离_00
Closest Position Of Target Vehicle In X Direction
The rear axle center coordinate system is used";
CM_ SG_ 978 FRM_19_ObjClosestDistY_32 "Front Radar Moudle_X_Object Closest Distance Y_00
前雷达距目标物最近点在Y轴上的距离_00
Closest Position Of Target Vehicle In Y Direction
The rear axle center coordinate system is used";
CM_ SG_ 978 FRM_19_ObjRelVelX_32 "Front Radar Moudle_X_Object Relative Velocity X_00
前雷达目标物在X轴上的相对速度_00
Relative Target Object Velocity In X Direction";
CM_ SG_ 978 FRM_19_ObjRelVelY_32 "Front Radar Moudle_X_Object Relative Velocity Y_00
前雷达目标物在Y轴上的相对速度_00
Relative Target Object Velocity In Y Direction";
CM_ SG_ 978 FRM_19_ObjAccelX_32 "Front Radar Moudle_X_Object Acceleration X_00
前雷达目标物在X轴上的加速度_00
Relative Target Object Acceleration In X Direction";
CM_ SG_ 978 FRM_19_ObjAccelY_32 "Front Radar Moudle_X_Object Acceleration Y_00
前雷达目标物在Y轴上的加速度_00
Relative Target Object Acceleration In Y Direction";
CM_ SG_ 978 FRM_19_ObjClosestDistXStd_32 "Front Radar Moudle_X_Object Closest Distance X Standard_00
前雷达目标物最近点在X轴上的距离的标准差_00
Standard Deviation Of Closest Position Of Target Vehicle in X Direction";
CM_ SG_ 978 FRM_19_ObjClosestDistYStd_32 "Front Radar Moudle_X_Object Closest Distance Y Standard_00
前雷达目标物最近点在Y轴上的距离的标准差_00
Standard Deviation Of Closest Position Of Target Vehicle in Y Direction";
CM_ SG_ 978 FRM_19_ObjRelVelXStd_32 "Front Radar Moudle_X_Object Relative Velocity X Standard_00
前雷达目标物在X轴上的相对速度的标准差_00
Standard Deviation Of Relative Velocity X";
CM_ SG_ 978 FRM_19_ObjRelVelYStd_32 "Front Radar Moudle_X_Object Relative Velocity Y Standard_00
前雷达目标物在Y轴上的相对速度的标准差_00
Standard Deviation Of Relative Velocity Y";
CM_ SG_ 978 FRM_19_ObjRelAccelXStd_32 "Front Radar Moudle_X_Object Relative  Acceleration X Standard_00
前雷达目标物在X轴上的相对加速度的标准差_00
Standard Deviation Of Relative Acceleration X";
CM_ SG_ 978 FRM_19_ObjRelAccelYStd_32 "Front Radar Moudle_X_Object Relative  Acceleration Y Standard_00
前雷达目标物相对加速度在Y轴上的标准差_00
Standard Deviation Of Relative Acceleration Y";
CM_ SG_ 978 FRM_19_ObjExistProb_32 "Front Radar Moudle_X_Object Exist Probability_00
前雷达目标物存在的可能性_00
The Probability Of An Object To Exist In Reality";
CM_ SG_ 978 FRM_19_ObjType_32 "Front Radar Moudle_X_Object Type_00
前雷达目标物的分类_00
Class Of Object Type
Note: Type of static object shall always be 0x0: unknown";
CM_ SG_ 978 FRM_19_ObjTypeConf_32 "Front Radar Moudle_X_Object Type Confidence_00
前雷达目标物分类的置信度_00
The Class Confidence Of Object Type";
CM_ SG_ 978 FRM_19_ObjTrackSts_32 "Front Radar Moudle_X_Object Track Status_00
前雷达目标物的跟踪状态_00
Signal To Indicate The Object Track Status";
CM_ SG_ 978 FRM_19_ObjMotionSts_32 "Front Radar Moudle_X_Object Motion Status_00
前雷达目标物的运动状态_00
Signal To Indicate The Object Whether Moving or Stopped or Static";
CM_ SG_ 978 FRM_19_ObjMotionDirection_32 "Front Radar Moudle_X_Object Motion Direction_00
前雷达目标物的运动方向_00
Signal To Indicate The Object Moving Direction.
Note: Moving direction of static object or stopped object shall always be 0x0: Unknown";
CM_ SG_ 978 FRM_19_ObjCenterDistX_32 "Front Radar Moudle_X_Object Center Distance X_00
前雷达目标物中心点在X轴方向的距离_00
Center Position Of Target Vehicle In X Direction
The rear axle center coordinate system is used";
CM_ SG_ 978 FRM_19_ObjCenterDistY_32 "Front Radar Moudle_X_Object Center Distance Y_00
前雷达目标物中心点在Y轴方向的距离_00
Center Position Of Target Vehicle In Y Direction
The rear axle center coordinate system is used";
CM_ SG_ 978 FRM_19_ObjLength_32 "Front Radar Moudle_X_Object Length_00
前雷达目标物的长度_00
Length Of Target
Note: Length of static object shall always be 0";
CM_ SG_ 978 FRM_19_ObjWidth_32 "Front Radar Moudle_X_Object Width_00
前雷达目标物的宽度_00
Width Of Target
Note: Width of static object shall always be 0";
CM_ SG_ 978 FRM_19_ObjElevnSts_32 "Front Radar Moudle_X_Object Elevation Status_00
前雷达目标物的高度状态_00
The Elevation Status Of An Object
Note: Elevation Status of moving object or stopped object shall always be 0x2: Obstacle";
CM_ SG_ 978 FRM_19_ObjElevnStsConf_32 "Front Radar Moudle_X_Object Elevation Status Confidence_00
前雷达目标物的高度状态的置信度_00
The Confidence Of An Object Elevation Status
Note: Elevation Status Confidence of moving object or stopped object shall always be 100%";
CM_ SG_ 978 FRM_19_ObjHeading_32 "Front Radar Moudle_X_Object Heading_00
前雷达目标物朝向_00
Heading of object 
Note: A rotation vector with anticlock-rotating as positive +π shall be used instead of -π when obect vertically backward
Note: Heading of static object shall always be 0";
CM_ SG_ 978 FRM_19_ObjID_33 "Front Radar Moudle_X_Object ID_01
前雷达目标物身份标识码_01
ID Is An Identifier Number That Allows For Tracking Of Persistent Objects Over Time
Note:A value of 0 indicates 'no object'";
CM_ SG_ 978 FRM_19_ObjClosestDistX_33 "Front Radar Moudle_X_Object Closest Distance X_01
前雷达目标物最近点在X轴上的距离_01
Closest Position Of Target Vehicle In X Direction
The rear axle center coordinate system is used";
CM_ SG_ 978 FRM_19_ObjClosestDistY_33 "Front Radar Moudle_X_Object Closest Distance Y_01
前雷达距目标物最近点在Y轴上的距离_01
Closest Position Of Target Vehicle In Y Direction
The rear axle center coordinate system is used";
CM_ SG_ 978 FRM_19_ObjRelVelX_33 "Front Radar Moudle_X_Object Relative Velocity X_01
前雷达目标物在X轴上的相对速度_01
Relative Target Object Velocity In X Direction";
CM_ SG_ 978 FRM_19_ObjRelVelY_33 "Front Radar Moudle_X_Object Relative Velocity Y_01
前雷达目标物在Y轴上的相对速度_01
Relative Target Object Velocity In Y Direction";
CM_ SG_ 978 FRM_19_ObjAccelX_33 "Front Radar Moudle_X_Object Acceleration X_01
前雷达目标物在X轴上的加速度_01
Relative Target Object Acceleration In X Direction";
CM_ SG_ 978 FRM_19_ObjAccelY_33 "Front Radar Moudle_X_Object Acceleration Y_01
前雷达目标物在Y轴上的加速度_01
Relative Target Object Acceleration In Y Direction";
CM_ SG_ 978 FRM_19_ObjClosestDistXStd_33 "Front Radar Moudle_X_Object Closest Distance X Standard_01
前雷达目标物最近点在X轴上的距离的标准差_01
Standard Deviation Of Closest Position Of Target Vehicle in X Direction";
CM_ SG_ 978 FRM_19_ObjClosestDistYStd_33 "Front Radar Moudle_X_Object Closest Distance Y Standard_01
前雷达目标物最近点在Y轴上的距离的标准差_01
Standard Deviation Of Closest Position Of Target Vehicle in Y Direction";
CM_ SG_ 978 FRM_19_ObjRelVelXStd_33 "Front Radar Moudle_X_Object Relative Velocity X Standard_01
前雷达目标物在X轴上的相对速度的标准差_01
Standard Deviation Of Relative Velocity X";
CM_ SG_ 978 FRM_19_ObjRelVelYStd_33 "Front Radar Moudle_X_Object Relative Velocity Y Standard_01
前雷达目标物在Y轴上的相对速度的标准差_01
Standard Deviation Of Relative Velocity Y";
CM_ SG_ 978 FRM_19_ObjRelAccelXStd_33 "Front Radar Moudle_X_Object Relative  Acceleration X Standard_01
前雷达目标物在X轴上的相对加速度的标准差_01
Standard Deviation Of Relative Acceleration X";
CM_ SG_ 978 FRM_19_ObjRelAccelYStd_33 "Front Radar Moudle_X_Object Relative  Acceleration Y Standard_01
前雷达目标物相对加速度在Y轴上的标准差_01
Standard Deviation Of Relative Acceleration Y";
CM_ SG_ 978 FRM_19_ObjExistProb_33 "Front Radar Moudle_X_Object Exist Probability_01
前雷达目标物存在的可能性_01
The Probability Of An Object To Exist In Reality";
CM_ SG_ 978 FRM_19_ObjType_33 "Front Radar Moudle_X_Object Type_01
前雷达目标物的分类_01
Class Of Object Type
Note: Type of static object shall always be 0x0: unknown";
CM_ SG_ 978 FRM_19_ObjTypeConf_33 "Front Radar Moudle_X_Object Type Confidence_01
前雷达目标物分类的置信度_01
The Class Confidence Of Object Type";
CM_ SG_ 978 FRM_19_ObjTrackSts_33 "Front Radar Moudle_X_Object Track Status_01
前雷达目标物的跟踪状态_01
Signal To Indicate The Object Track Status";
CM_ SG_ 978 FRM_19_ObjMotionSts_33 "Front Radar Moudle_X_Object Motion Status_01
前雷达目标物的运动状态_01
Signal To Indicate The Object Whether Moving or Stopped or Static";
CM_ SG_ 978 FRM_19_ObjMotionDirection_33 "Front Radar Moudle_X_Object Motion Direction_01
前雷达目标物的运动方向_01
Signal To Indicate The Object Moving Direction.
Note: Moving direction of static object or stopped object shall always be 0x0: Unknown";
CM_ SG_ 978 FRM_19_ObjCenterDistX_33 "Front Radar Moudle_X_Object Center Distance X_01
前雷达目标物中心点在X轴方向的距离_01
Center Position Of Target Vehicle In X Direction
The rear axle center coordinate system is used";
CM_ SG_ 978 FRM_19_ObjCenterDistY_33 "Front Radar Moudle_X_Object Center Distance Y_01
前雷达目标物中心点在Y轴方向的距离_01
Center Position Of Target Vehicle In Y Direction
The rear axle center coordinate system is used";
CM_ SG_ 978 FRM_19_ObjLength_33 "Front Radar Moudle_X_Object Length_01
前雷达目标物的长度_01
Length Of Target
Note: Length of static object shall always be 0";
CM_ SG_ 978 FRM_19_ObjWidth_33 "Front Radar Moudle_X_Object Width_01
前雷达目标物的宽度_01
Width Of Target
Note: Width of static object shall always be 0";
CM_ SG_ 978 FRM_19_ObjElevnSts_33 "Front Radar Moudle_X_Object Elevation Status_01
前雷达目标物的高度状态_01
The Elevation Status Of An Object
Note: Elevation Status of moving object or stopped object shall always be 0x2: Obstacle";
CM_ SG_ 978 FRM_19_ObjElevnStsConf_33 "Front Radar Moudle_X_Object Elevation Status Confidence_01
前雷达目标物的高度状态的置信度_01
The Confidence Of An Object Elevation Status
Note: Elevation Status Confidence of moving object or stopped object shall always be 100%";
CM_ SG_ 978 FRM_19_ObjHeading_33 "Front Radar Moudle_X_Object Heading_01
前雷达目标物朝向_01
Heading of object 
Note: A rotation vector with anticlock-rotating as positive +π shall be used instead of -π when obect vertically backward
Note: Heading of static object shall always be 0";

BA_DEF_ BO_  "GenMsgSendType" ENUM  "Cyclic","Event","IfActive","CE","CA","NoMsgSendType";
BA_DEF_ BO_  "GenMsgCycleTime" INT 0 0;
BA_DEF_ SG_  "GenSigSendType" ENUM  "Cyclic","OnChange","OnWrite","IfActive","OnChangeWithRepetition","OnWriteWithRepetition","IfActiveWithRepetition","NoSigSendType","OnChangeAndIfActive","OnChangeAndIfActiveWithRepetition","CA","CE","Event";
BA_DEF_ SG_  "GenSigStartValue" INT 0 0;
BA_DEF_ BO_  "GenMsgCycleTimeFast" INT 0 0;
BA_DEF_ BO_  "GenMsgNrOfRepetition" INT 0 0;
BA_DEF_ BO_  "GenMsgDelayTime" INT 0 0;
BA_DEF_ BO_  "CANFD_BRS" ENUM  "0","1";
BA_DEF_ BO_  "VFrameFormat" ENUM  "StandardCAN","ExtendedCAN","reserved","reserved","reserved","reserved","reserved","reserved","reserved","reserved","reserved","reserved","reserved","reserved","StandardCAN_FD","ExtendedCAN_FD";
BA_DEF_ BO_  "GenMsgILSupport" ENUM  "No","Yes";
BA_DEF_ SG_ "GenSigASIL" ENUM "QM","A","B","C","D","";
BA_DEF_DEF_  "GenMsgSendType" "Cyclic";
BA_DEF_DEF_  "GenMsgCycleTime" 0;
BA_DEF_DEF_  "GenSigSendType" "Cyclic";
BA_DEF_DEF_  "GenSigStartValue" 0;
BA_DEF_DEF_  "GenMsgCycleTimeFast" 0;
BA_DEF_DEF_  "GenMsgNrOfRepetition" 0;
BA_DEF_DEF_  "GenMsgDelayTime" 0;
BA_DEF_DEF_  "CANFD_BRS" "1";
BA_DEF_DEF_  "VFrameFormat" "StandardCAN_FD";
BA_DEF_DEF_  "GenMsgILSupport" "No";
BA_DEF_DEF_ "GenSigASIL" "QM";
BA_ "GenMsgILSupport" BO_ 970 1;
BA_ "GenMsgCycleTime" BO_ 970 50;
BA_ "GenSigASIL"  SG_ 970 FRM_11_CRC 5;
BA_ "GenSigASIL"  SG_ 970 FRM_11_RollgCntr 5;
BA_ "GenSigASIL"  SG_ 970 FRM_11_ObjBlockCounter 2;
BA_ "GenSigASIL"  SG_ 970 FRM_11_ObjID_16 2;
BA_ "GenSigASIL"  SG_ 970 FRM_11_ObjClosestDistX_16 2;
BA_ "GenSigStartValue" SG_ 970 FRM_11_ObjClosestDistY_16 10000;
BA_ "GenSigASIL"  SG_ 970 FRM_11_ObjClosestDistY_16 2;
BA_ "GenSigStartValue" SG_ 970 FRM_11_ObjRelVelX_16 10000;
BA_ "GenSigASIL"  SG_ 970 FRM_11_ObjRelVelX_16 2;
BA_ "GenSigStartValue" SG_ 970 FRM_11_ObjRelVelY_16 10000;
BA_ "GenSigASIL"  SG_ 970 FRM_11_ObjRelVelY_16 2;
BA_ "GenSigStartValue" SG_ 970 FRM_11_ObjAccelX_16 2500;
BA_ "GenSigASIL"  SG_ 970 FRM_11_ObjAccelX_16 2;
BA_ "GenSigStartValue" SG_ 970 FRM_11_ObjAccelY_16 2500;
BA_ "GenSigASIL"  SG_ 970 FRM_11_ObjAccelY_16 2;
BA_ "GenSigASIL"  SG_ 970 FRM_11_ObjClosestDistXStd_16 2;
BA_ "GenSigASIL"  SG_ 970 FRM_11_ObjClosestDistYStd_16 2;
BA_ "GenSigASIL"  SG_ 970 FRM_11_ObjRelVelXStd_16 2;
BA_ "GenSigASIL"  SG_ 970 FRM_11_ObjRelVelYStd_16 2;
BA_ "GenSigASIL"  SG_ 970 FRM_11_ObjRelAccelXStd_16 2;
BA_ "GenSigASIL"  SG_ 970 FRM_11_ObjRelAccelYStd_16 2;
BA_ "GenSigASIL"  SG_ 970 FRM_11_ObjExistProb_16 2;
BA_ "GenSigASIL"  SG_ 970 FRM_11_ObjType_16 2;
BA_ "GenSigASIL"  SG_ 970 FRM_11_ObjTypeConf_16 2;
BA_ "GenSigASIL"  SG_ 970 FRM_11_ObjTrackSts_16 2;
BA_ "GenSigASIL"  SG_ 970 FRM_11_ObjMotionSts_16 2;
BA_ "GenSigASIL"  SG_ 970 FRM_11_ObjMotionDirection_16 2;
BA_ "GenSigASIL"  SG_ 970 FRM_11_ObjCenterDistX_16 2;
BA_ "GenSigStartValue" SG_ 970 FRM_11_ObjCenterDistY_16 10000;
BA_ "GenSigASIL"  SG_ 970 FRM_11_ObjCenterDistY_16 2;
BA_ "GenSigASIL"  SG_ 970 FRM_11_ObjLength_16 2;
BA_ "GenSigASIL"  SG_ 970 FRM_11_ObjWidth_16 2;
BA_ "GenSigASIL"  SG_ 970 FRM_11_ObjElevnSts_16 2;
BA_ "GenSigASIL"  SG_ 970 FRM_11_ObjElevnStsConf_16 2;
BA_ "GenSigStartValue" SG_ 970 FRM_11_ObjHeading_16 1800;
BA_ "GenSigASIL"  SG_ 970 FRM_11_ObjHeading_16 2;
BA_ "GenSigASIL"  SG_ 970 FRM_11_ObjID_17 2;
BA_ "GenSigASIL"  SG_ 970 FRM_11_ObjClosestDistX_17 2;
BA_ "GenSigStartValue" SG_ 970 FRM_11_ObjClosestDistY_17 10000;
BA_ "GenSigASIL"  SG_ 970 FRM_11_ObjClosestDistY_17 2;
BA_ "GenSigStartValue" SG_ 970 FRM_11_ObjRelVelX_17 10000;
BA_ "GenSigASIL"  SG_ 970 FRM_11_ObjRelVelX_17 2;
BA_ "GenSigStartValue" SG_ 970 FRM_11_ObjRelVelY_17 10000;
BA_ "GenSigASIL"  SG_ 970 FRM_11_ObjRelVelY_17 2;
BA_ "GenSigStartValue" SG_ 970 FRM_11_ObjAccelX_17 2500;
BA_ "GenSigASIL"  SG_ 970 FRM_11_ObjAccelX_17 2;
BA_ "GenSigStartValue" SG_ 970 FRM_11_ObjAccelY_17 2500;
BA_ "GenSigASIL"  SG_ 970 FRM_11_ObjAccelY_17 2;
BA_ "GenSigASIL"  SG_ 970 FRM_11_ObjClosestDistXStd_17 2;
BA_ "GenSigASIL"  SG_ 970 FRM_11_ObjClosestDistYStd_17 2;
BA_ "GenSigASIL"  SG_ 970 FRM_11_ObjRelVelXStd_17 2;
BA_ "GenSigASIL"  SG_ 970 FRM_11_ObjRelVelYStd_17 2;
BA_ "GenSigASIL"  SG_ 970 FRM_11_ObjRelAccelXStd_17 2;
BA_ "GenSigASIL"  SG_ 970 FRM_11_ObjRelAccelYStd_17 2;
BA_ "GenSigASIL"  SG_ 970 FRM_11_ObjExistProb_17 2;
BA_ "GenSigASIL"  SG_ 970 FRM_11_ObjType_17 2;
BA_ "GenSigASIL"  SG_ 970 FRM_11_ObjTypeConf_17 2;
BA_ "GenSigASIL"  SG_ 970 FRM_11_ObjTrackSts_17 2;
BA_ "GenSigASIL"  SG_ 970 FRM_11_ObjMotionSts_17 2;
BA_ "GenSigASIL"  SG_ 970 FRM_11_ObjMotionDirection_17 2;
BA_ "GenSigASIL"  SG_ 970 FRM_11_ObjCenterDistX_17 2;
BA_ "GenSigStartValue" SG_ 970 FRM_11_ObjCenterDistY_17 10000;
BA_ "GenSigASIL"  SG_ 970 FRM_11_ObjCenterDistY_17 2;
BA_ "GenSigASIL"  SG_ 970 FRM_11_ObjLength_17 2;
BA_ "GenSigASIL"  SG_ 970 FRM_11_ObjWidth_17 2;
BA_ "GenSigASIL"  SG_ 970 FRM_11_ObjElevnSts_17 2;
BA_ "GenSigASIL"  SG_ 970 FRM_11_ObjElevnStsConf_17 2;
BA_ "GenSigStartValue" SG_ 970 FRM_11_ObjHeading_17 1800;
BA_ "GenSigASIL"  SG_ 970 FRM_11_ObjHeading_17 2;
BA_ "GenMsgILSupport" BO_ 971 1;
BA_ "GenMsgCycleTime" BO_ 971 50;
BA_ "GenSigASIL"  SG_ 971 FRM_12_CRC 5;
BA_ "GenSigASIL"  SG_ 971 FRM_12_RollgCntr 5;
BA_ "GenSigASIL"  SG_ 971 FRM_12_ObjBlockCounter 2;
BA_ "GenSigASIL"  SG_ 971 FRM_12_ObjID_18 2;
BA_ "GenSigASIL"  SG_ 971 FRM_12_ObjClosestDistX_18 2;
BA_ "GenSigStartValue" SG_ 971 FRM_12_ObjClosestDistY_18 10000;
BA_ "GenSigASIL"  SG_ 971 FRM_12_ObjClosestDistY_18 2;
BA_ "GenSigStartValue" SG_ 971 FRM_12_ObjRelVelX_18 10000;
BA_ "GenSigASIL"  SG_ 971 FRM_12_ObjRelVelX_18 2;
BA_ "GenSigStartValue" SG_ 971 FRM_12_ObjRelVelY_18 10000;
BA_ "GenSigASIL"  SG_ 971 FRM_12_ObjRelVelY_18 2;
BA_ "GenSigStartValue" SG_ 971 FRM_12_ObjAccelX_18 2500;
BA_ "GenSigASIL"  SG_ 971 FRM_12_ObjAccelX_18 2;
BA_ "GenSigStartValue" SG_ 971 FRM_12_ObjAccelY_18 2500;
BA_ "GenSigASIL"  SG_ 971 FRM_12_ObjAccelY_18 2;
BA_ "GenSigASIL"  SG_ 971 FRM_12_ObjClosestDistXStd_18 2;
BA_ "GenSigASIL"  SG_ 971 FRM_12_ObjClosestDistYStd_18 2;
BA_ "GenSigASIL"  SG_ 971 FRM_12_ObjRelVelXStd_18 2;
BA_ "GenSigASIL"  SG_ 971 FRM_12_ObjRelVelYStd_18 2;
BA_ "GenSigASIL"  SG_ 971 FRM_12_ObjRelAccelXStd_18 2;
BA_ "GenSigASIL"  SG_ 971 FRM_12_ObjRelAccelYStd_18 2;
BA_ "GenSigASIL"  SG_ 971 FRM_12_ObjExistProb_18 2;
BA_ "GenSigASIL"  SG_ 971 FRM_12_ObjType_18 2;
BA_ "GenSigASIL"  SG_ 971 FRM_12_ObjTypeConf_18 2;
BA_ "GenSigASIL"  SG_ 971 FRM_12_ObjTrackSts_18 2;
BA_ "GenSigASIL"  SG_ 971 FRM_12_ObjMotionSts_18 2;
BA_ "GenSigASIL"  SG_ 971 FRM_12_ObjMotionDirection_18 2;
BA_ "GenSigASIL"  SG_ 971 FRM_12_ObjCenterDistX_18 2;
BA_ "GenSigStartValue" SG_ 971 FRM_12_ObjCenterDistY_18 10000;
BA_ "GenSigASIL"  SG_ 971 FRM_12_ObjCenterDistY_18 2;
BA_ "GenSigASIL"  SG_ 971 FRM_12_ObjLength_18 2;
BA_ "GenSigASIL"  SG_ 971 FRM_12_ObjWidth_18 2;
BA_ "GenSigASIL"  SG_ 971 FRM_12_ObjElevnSts_18 2;
BA_ "GenSigASIL"  SG_ 971 FRM_12_ObjElevnStsConf_18 2;
BA_ "GenSigStartValue" SG_ 971 FRM_12_ObjHeading_18 1800;
BA_ "GenSigASIL"  SG_ 971 FRM_12_ObjHeading_18 2;
BA_ "GenSigASIL"  SG_ 971 FRM_12_ObjID_19 2;
BA_ "GenSigASIL"  SG_ 971 FRM_12_ObjClosestDistX_19 2;
BA_ "GenSigStartValue" SG_ 971 FRM_12_ObjClosestDistY_19 10000;
BA_ "GenSigASIL"  SG_ 971 FRM_12_ObjClosestDistY_19 2;
BA_ "GenSigStartValue" SG_ 971 FRM_12_ObjRelVelX_19 10000;
BA_ "GenSigASIL"  SG_ 971 FRM_12_ObjRelVelX_19 2;
BA_ "GenSigStartValue" SG_ 971 FRM_12_ObjRelVelY_19 10000;
BA_ "GenSigASIL"  SG_ 971 FRM_12_ObjRelVelY_19 2;
BA_ "GenSigStartValue" SG_ 971 FRM_12_ObjAccelX_19 2500;
BA_ "GenSigASIL"  SG_ 971 FRM_12_ObjAccelX_19 2;
BA_ "GenSigStartValue" SG_ 971 FRM_12_ObjAccelY_19 2500;
BA_ "GenSigASIL"  SG_ 971 FRM_12_ObjAccelY_19 2;
BA_ "GenSigASIL"  SG_ 971 FRM_12_ObjClosestDistXStd_19 2;
BA_ "GenSigASIL"  SG_ 971 FRM_12_ObjClosestDistYStd_19 2;
BA_ "GenSigASIL"  SG_ 971 FRM_12_ObjRelVelXStd_19 2;
BA_ "GenSigASIL"  SG_ 971 FRM_12_ObjRelVelYStd_19 2;
BA_ "GenSigASIL"  SG_ 971 FRM_12_ObjRelAccelXStd_19 2;
BA_ "GenSigASIL"  SG_ 971 FRM_12_ObjRelAccelYStd_19 2;
BA_ "GenSigASIL"  SG_ 971 FRM_12_ObjExistProb_19 2;
BA_ "GenSigASIL"  SG_ 971 FRM_12_ObjType_19 2;
BA_ "GenSigASIL"  SG_ 971 FRM_12_ObjTypeConf_19 2;
BA_ "GenSigASIL"  SG_ 971 FRM_12_ObjTrackSts_19 2;
BA_ "GenSigASIL"  SG_ 971 FRM_12_ObjMotionSts_19 2;
BA_ "GenSigASIL"  SG_ 971 FRM_12_ObjMotionDirection_19 2;
BA_ "GenSigASIL"  SG_ 971 FRM_12_ObjCenterDistX_19 2;
BA_ "GenSigStartValue" SG_ 971 FRM_12_ObjCenterDistY_19 10000;
BA_ "GenSigASIL"  SG_ 971 FRM_12_ObjCenterDistY_19 2;
BA_ "GenSigASIL"  SG_ 971 FRM_12_ObjLength_19 2;
BA_ "GenSigASIL"  SG_ 971 FRM_12_ObjWidth_19 2;
BA_ "GenSigASIL"  SG_ 971 FRM_12_ObjElevnSts_19 2;
BA_ "GenSigASIL"  SG_ 971 FRM_12_ObjElevnStsConf_19 2;
BA_ "GenSigStartValue" SG_ 971 FRM_12_ObjHeading_19 1800;
BA_ "GenSigASIL"  SG_ 971 FRM_12_ObjHeading_19 2;
BA_ "GenMsgILSupport" BO_ 972 1;
BA_ "GenMsgCycleTime" BO_ 972 50;
BA_ "GenSigASIL"  SG_ 972 FRM_13_CRC 5;
BA_ "GenSigASIL"  SG_ 972 FRM_13_RollgCntr 5;
BA_ "GenSigASIL"  SG_ 972 FRM_13_ObjBlockCounter 2;
BA_ "GenSigASIL"  SG_ 972 FRM_13_ObjID_20 2;
BA_ "GenSigASIL"  SG_ 972 FRM_13_ObjClosestDistX_20 2;
BA_ "GenSigStartValue" SG_ 972 FRM_13_ObjClosestDistY_20 10000;
BA_ "GenSigASIL"  SG_ 972 FRM_13_ObjClosestDistY_20 2;
BA_ "GenSigStartValue" SG_ 972 FRM_13_ObjRelVelX_20 10000;
BA_ "GenSigASIL"  SG_ 972 FRM_13_ObjRelVelX_20 2;
BA_ "GenSigStartValue" SG_ 972 FRM_13_ObjRelVelY_20 10000;
BA_ "GenSigASIL"  SG_ 972 FRM_13_ObjRelVelY_20 2;
BA_ "GenSigStartValue" SG_ 972 FRM_13_ObjAccelX_20 2500;
BA_ "GenSigASIL"  SG_ 972 FRM_13_ObjAccelX_20 2;
BA_ "GenSigStartValue" SG_ 972 FRM_13_ObjAccelY_20 2500;
BA_ "GenSigASIL"  SG_ 972 FRM_13_ObjAccelY_20 2;
BA_ "GenSigASIL"  SG_ 972 FRM_13_ObjClosestDistXStd_20 2;
BA_ "GenSigASIL"  SG_ 972 FRM_13_ObjClosestDistYStd_20 2;
BA_ "GenSigASIL"  SG_ 972 FRM_13_ObjRelVelXStd_20 2;
BA_ "GenSigASIL"  SG_ 972 FRM_13_ObjRelVelYStd_20 2;
BA_ "GenSigASIL"  SG_ 972 FRM_13_ObjRelAccelXStd_20 2;
BA_ "GenSigASIL"  SG_ 972 FRM_13_ObjRelAccelYStd_20 2;
BA_ "GenSigASIL"  SG_ 972 FRM_13_ObjExistProb_20 2;
BA_ "GenSigASIL"  SG_ 972 FRM_13_ObjType_20 2;
BA_ "GenSigASIL"  SG_ 972 FRM_13_ObjTypeConf_20 2;
BA_ "GenSigASIL"  SG_ 972 FRM_13_ObjTrackSts_20 2;
BA_ "GenSigASIL"  SG_ 972 FRM_13_ObjMotionSts_20 2;
BA_ "GenSigASIL"  SG_ 972 FRM_13_ObjMotionDirection_20 2;
BA_ "GenSigASIL"  SG_ 972 FRM_13_ObjCenterDistX_20 2;
BA_ "GenSigStartValue" SG_ 972 FRM_13_ObjCenterDistY_20 10000;
BA_ "GenSigASIL"  SG_ 972 FRM_13_ObjCenterDistY_20 2;
BA_ "GenSigASIL"  SG_ 972 FRM_13_ObjLength_20 2;
BA_ "GenSigASIL"  SG_ 972 FRM_13_ObjWidth_20 2;
BA_ "GenSigASIL"  SG_ 972 FRM_13_ObjElevnSts_20 2;
BA_ "GenSigASIL"  SG_ 972 FRM_13_ObjElevnStsConf_20 2;
BA_ "GenSigStartValue" SG_ 972 FRM_13_ObjHeading_20 1800;
BA_ "GenSigASIL"  SG_ 972 FRM_13_ObjHeading_20 2;
BA_ "GenSigASIL"  SG_ 972 FRM_13_ObjID_21 2;
BA_ "GenSigASIL"  SG_ 972 FRM_13_ObjClosestDistX_21 2;
BA_ "GenSigStartValue" SG_ 972 FRM_13_ObjClosestDistY_21 10000;
BA_ "GenSigASIL"  SG_ 972 FRM_13_ObjClosestDistY_21 2;
BA_ "GenSigStartValue" SG_ 972 FRM_13_ObjRelVelX_21 10000;
BA_ "GenSigASIL"  SG_ 972 FRM_13_ObjRelVelX_21 2;
BA_ "GenSigStartValue" SG_ 972 FRM_13_ObjRelVelY_21 10000;
BA_ "GenSigASIL"  SG_ 972 FRM_13_ObjRelVelY_21 2;
BA_ "GenSigStartValue" SG_ 972 FRM_13_ObjAccelX_21 2500;
BA_ "GenSigASIL"  SG_ 972 FRM_13_ObjAccelX_21 2;
BA_ "GenSigStartValue" SG_ 972 FRM_13_ObjAccelY_21 2500;
BA_ "GenSigASIL"  SG_ 972 FRM_13_ObjAccelY_21 2;
BA_ "GenSigASIL"  SG_ 972 FRM_13_ObjClosestDistXStd_21 2;
BA_ "GenSigASIL"  SG_ 972 FRM_13_ObjClosestDistYStd_21 2;
BA_ "GenSigASIL"  SG_ 972 FRM_13_ObjRelVelXStd_21 2;
BA_ "GenSigASIL"  SG_ 972 FRM_13_ObjRelVelYStd_21 2;
BA_ "GenSigASIL"  SG_ 972 FRM_13_ObjRelAccelXStd_21 2;
BA_ "GenSigASIL"  SG_ 972 FRM_13_ObjRelAccelYStd_21 2;
BA_ "GenSigASIL"  SG_ 972 FRM_13_ObjExistProb_21 2;
BA_ "GenSigASIL"  SG_ 972 FRM_13_ObjType_21 2;
BA_ "GenSigASIL"  SG_ 972 FRM_13_ObjTypeConf_21 2;
BA_ "GenSigASIL"  SG_ 972 FRM_13_ObjTrackSts_21 2;
BA_ "GenSigASIL"  SG_ 972 FRM_13_ObjMotionSts_21 2;
BA_ "GenSigASIL"  SG_ 972 FRM_13_ObjMotionDirection_21 2;
BA_ "GenSigASIL"  SG_ 972 FRM_13_ObjCenterDistX_21 2;
BA_ "GenSigStartValue" SG_ 972 FRM_13_ObjCenterDistY_21 10000;
BA_ "GenSigASIL"  SG_ 972 FRM_13_ObjCenterDistY_21 2;
BA_ "GenSigASIL"  SG_ 972 FRM_13_ObjLength_21 2;
BA_ "GenSigASIL"  SG_ 972 FRM_13_ObjWidth_21 2;
BA_ "GenSigASIL"  SG_ 972 FRM_13_ObjElevnSts_21 2;
BA_ "GenSigASIL"  SG_ 972 FRM_13_ObjElevnStsConf_21 2;
BA_ "GenSigStartValue" SG_ 972 FRM_13_ObjHeading_21 1800;
BA_ "GenSigASIL"  SG_ 972 FRM_13_ObjHeading_21 2;
BA_ "GenMsgILSupport" BO_ 973 1;
BA_ "GenMsgCycleTime" BO_ 973 50;
BA_ "GenSigASIL"  SG_ 973 FRM_14_CRC 5;
BA_ "GenSigASIL"  SG_ 973 FRM_14_RollgCntr 5;
BA_ "GenSigASIL"  SG_ 973 FRM_14_ObjBlockCounter 2;
BA_ "GenSigASIL"  SG_ 973 FRM_14_ObjID_22 2;
BA_ "GenSigASIL"  SG_ 973 FRM_14_ObjClosestDistX_22 2;
BA_ "GenSigStartValue" SG_ 973 FRM_14_ObjClosestDistY_22 10000;
BA_ "GenSigASIL"  SG_ 973 FRM_14_ObjClosestDistY_22 2;
BA_ "GenSigStartValue" SG_ 973 FRM_14_ObjRelVelX_22 10000;
BA_ "GenSigASIL"  SG_ 973 FRM_14_ObjRelVelX_22 2;
BA_ "GenSigStartValue" SG_ 973 FRM_14_ObjRelVelY_22 10000;
BA_ "GenSigASIL"  SG_ 973 FRM_14_ObjRelVelY_22 2;
BA_ "GenSigStartValue" SG_ 973 FRM_14_ObjAccelX_22 2500;
BA_ "GenSigASIL"  SG_ 973 FRM_14_ObjAccelX_22 2;
BA_ "GenSigStartValue" SG_ 973 FRM_14_ObjAccelY_22 2500;
BA_ "GenSigASIL"  SG_ 973 FRM_14_ObjAccelY_22 2;
BA_ "GenSigASIL"  SG_ 973 FRM_14_ObjClosestDistXStd_22 2;
BA_ "GenSigASIL"  SG_ 973 FRM_14_ObjClosestDistYStd_22 2;
BA_ "GenSigASIL"  SG_ 973 FRM_14_ObjRelVelXStd_22 2;
BA_ "GenSigASIL"  SG_ 973 FRM_14_ObjRelVelYStd_22 2;
BA_ "GenSigASIL"  SG_ 973 FRM_14_ObjRelAccelXStd_22 2;
BA_ "GenSigASIL"  SG_ 973 FRM_14_ObjRelAccelYStd_22 2;
BA_ "GenSigASIL"  SG_ 973 FRM_14_ObjExistProb_22 2;
BA_ "GenSigASIL"  SG_ 973 FRM_14_ObjType_22 2;
BA_ "GenSigASIL"  SG_ 973 FRM_14_ObjTypeConf_22 2;
BA_ "GenSigASIL"  SG_ 973 FRM_14_ObjTrackSts_22 2;
BA_ "GenSigASIL"  SG_ 973 FRM_14_ObjMotionSts_22 2;
BA_ "GenSigASIL"  SG_ 973 FRM_14_ObjMotionDirection_22 2;
BA_ "GenSigASIL"  SG_ 973 FRM_14_ObjCenterDistX_22 2;
BA_ "GenSigStartValue" SG_ 973 FRM_14_ObjCenterDistY_22 10000;
BA_ "GenSigASIL"  SG_ 973 FRM_14_ObjCenterDistY_22 2;
BA_ "GenSigASIL"  SG_ 973 FRM_14_ObjLength_22 2;
BA_ "GenSigASIL"  SG_ 973 FRM_14_ObjWidth_22 2;
BA_ "GenSigASIL"  SG_ 973 FRM_14_ObjElevnSts_22 2;
BA_ "GenSigASIL"  SG_ 973 FRM_14_ObjElevnStsConf_22 2;
BA_ "GenSigStartValue" SG_ 973 FRM_14_ObjHeading_22 1800;
BA_ "GenSigASIL"  SG_ 973 FRM_14_ObjHeading_22 2;
BA_ "GenSigASIL"  SG_ 973 FRM_14_ObjID_23 2;
BA_ "GenSigASIL"  SG_ 973 FRM_14_ObjClosestDistX_23 2;
BA_ "GenSigStartValue" SG_ 973 FRM_14_ObjClosestDistY_23 10000;
BA_ "GenSigASIL"  SG_ 973 FRM_14_ObjClosestDistY_23 2;
BA_ "GenSigStartValue" SG_ 973 FRM_14_ObjRelVelX_23 10000;
BA_ "GenSigASIL"  SG_ 973 FRM_14_ObjRelVelX_23 2;
BA_ "GenSigStartValue" SG_ 973 FRM_14_ObjRelVelY_23 10000;
BA_ "GenSigASIL"  SG_ 973 FRM_14_ObjRelVelY_23 2;
BA_ "GenSigStartValue" SG_ 973 FRM_14_ObjAccelX_23 2500;
BA_ "GenSigASIL"  SG_ 973 FRM_14_ObjAccelX_23 2;
BA_ "GenSigStartValue" SG_ 973 FRM_14_ObjAccelY_23 2500;
BA_ "GenSigASIL"  SG_ 973 FRM_14_ObjAccelY_23 2;
BA_ "GenSigASIL"  SG_ 973 FRM_14_ObjClosestDistXStd_23 2;
BA_ "GenSigASIL"  SG_ 973 FRM_14_ObjClosestDistYStd_23 2;
BA_ "GenSigASIL"  SG_ 973 FRM_14_ObjRelVelXStd_23 2;
BA_ "GenSigASIL"  SG_ 973 FRM_14_ObjRelVelYStd_23 2;
BA_ "GenSigASIL"  SG_ 973 FRM_14_ObjRelAccelXStd_23 2;
BA_ "GenSigASIL"  SG_ 973 FRM_14_ObjRelAccelYStd_23 2;
BA_ "GenSigASIL"  SG_ 973 FRM_14_ObjExistProb_23 2;
BA_ "GenSigASIL"  SG_ 973 FRM_14_ObjType_23 2;
BA_ "GenSigASIL"  SG_ 973 FRM_14_ObjTypeConf_23 2;
BA_ "GenSigASIL"  SG_ 973 FRM_14_ObjTrackSts_23 2;
BA_ "GenSigASIL"  SG_ 973 FRM_14_ObjMotionSts_23 2;
BA_ "GenSigASIL"  SG_ 973 FRM_14_ObjMotionDirection_23 2;
BA_ "GenSigASIL"  SG_ 973 FRM_14_ObjCenterDistX_23 2;
BA_ "GenSigStartValue" SG_ 973 FRM_14_ObjCenterDistY_23 10000;
BA_ "GenSigASIL"  SG_ 973 FRM_14_ObjCenterDistY_23 2;
BA_ "GenSigASIL"  SG_ 973 FRM_14_ObjLength_23 2;
BA_ "GenSigASIL"  SG_ 973 FRM_14_ObjWidth_23 2;
BA_ "GenSigASIL"  SG_ 973 FRM_14_ObjElevnSts_23 2;
BA_ "GenSigASIL"  SG_ 973 FRM_14_ObjElevnStsConf_23 2;
BA_ "GenSigStartValue" SG_ 973 FRM_14_ObjHeading_23 1800;
BA_ "GenSigASIL"  SG_ 973 FRM_14_ObjHeading_23 2;
BA_ "GenMsgILSupport" BO_ 974 1;
BA_ "GenMsgCycleTime" BO_ 974 50;
BA_ "GenSigASIL"  SG_ 974 FRM_15_CRC 5;
BA_ "GenSigASIL"  SG_ 974 FRM_15_RollgCntr 5;
BA_ "GenSigASIL"  SG_ 974 FRM_15_ObjBlockCounter 2;
BA_ "GenSigASIL"  SG_ 974 FRM_15_ObjID_24 2;
BA_ "GenSigASIL"  SG_ 974 FRM_15_ObjClosestDistX_24 2;
BA_ "GenSigStartValue" SG_ 974 FRM_15_ObjClosestDistY_24 10000;
BA_ "GenSigASIL"  SG_ 974 FRM_15_ObjClosestDistY_24 2;
BA_ "GenSigStartValue" SG_ 974 FRM_15_ObjRelVelX_24 10000;
BA_ "GenSigASIL"  SG_ 974 FRM_15_ObjRelVelX_24 2;
BA_ "GenSigStartValue" SG_ 974 FRM_15_ObjRelVelY_24 10000;
BA_ "GenSigASIL"  SG_ 974 FRM_15_ObjRelVelY_24 2;
BA_ "GenSigStartValue" SG_ 974 FRM_15_ObjAccelX_24 2500;
BA_ "GenSigASIL"  SG_ 974 FRM_15_ObjAccelX_24 2;
BA_ "GenSigStartValue" SG_ 974 FRM_15_ObjAccelY_24 2500;
BA_ "GenSigASIL"  SG_ 974 FRM_15_ObjAccelY_24 2;
BA_ "GenSigASIL"  SG_ 974 FRM_15_ObjClosestDistXStd_24 2;
BA_ "GenSigASIL"  SG_ 974 FRM_15_ObjClosestDistYStd_24 2;
BA_ "GenSigASIL"  SG_ 974 FRM_15_ObjRelVelXStd_24 2;
BA_ "GenSigASIL"  SG_ 974 FRM_15_ObjRelVelYStd_24 2;
BA_ "GenSigASIL"  SG_ 974 FRM_15_ObjRelAccelXStd_24 2;
BA_ "GenSigASIL"  SG_ 974 FRM_15_ObjRelAccelYStd_24 2;
BA_ "GenSigASIL"  SG_ 974 FRM_15_ObjExistProb_24 2;
BA_ "GenSigASIL"  SG_ 974 FRM_15_ObjType_24 2;
BA_ "GenSigASIL"  SG_ 974 FRM_15_ObjTypeConf_24 2;
BA_ "GenSigASIL"  SG_ 974 FRM_15_ObjTrackSts_24 2;
BA_ "GenSigASIL"  SG_ 974 FRM_15_ObjMotionSts_24 2;
BA_ "GenSigASIL"  SG_ 974 FRM_15_ObjMotionDirection_24 2;
BA_ "GenSigASIL"  SG_ 974 FRM_15_ObjCenterDistX_24 2;
BA_ "GenSigStartValue" SG_ 974 FRM_15_ObjCenterDistY_24 10000;
BA_ "GenSigASIL"  SG_ 974 FRM_15_ObjCenterDistY_24 2;
BA_ "GenSigASIL"  SG_ 974 FRM_15_ObjLength_24 2;
BA_ "GenSigASIL"  SG_ 974 FRM_15_ObjWidth_24 2;
BA_ "GenSigASIL"  SG_ 974 FRM_15_ObjElevnSts_24 2;
BA_ "GenSigASIL"  SG_ 974 FRM_15_ObjElevnStsConf_24 2;
BA_ "GenSigStartValue" SG_ 974 FRM_15_ObjHeading_24 1800;
BA_ "GenSigASIL"  SG_ 974 FRM_15_ObjHeading_24 2;
BA_ "GenSigASIL"  SG_ 974 FRM_15_ObjID_25 2;
BA_ "GenSigASIL"  SG_ 974 FRM_15_ObjClosestDistX_25 2;
BA_ "GenSigStartValue" SG_ 974 FRM_15_ObjClosestDistY_25 10000;
BA_ "GenSigASIL"  SG_ 974 FRM_15_ObjClosestDistY_25 2;
BA_ "GenSigStartValue" SG_ 974 FRM_15_ObjRelVelX_25 10000;
BA_ "GenSigASIL"  SG_ 974 FRM_15_ObjRelVelX_25 2;
BA_ "GenSigStartValue" SG_ 974 FRM_15_ObjRelVelY_25 10000;
BA_ "GenSigASIL"  SG_ 974 FRM_15_ObjRelVelY_25 2;
BA_ "GenSigStartValue" SG_ 974 FRM_15_ObjAccelX_25 2500;
BA_ "GenSigASIL"  SG_ 974 FRM_15_ObjAccelX_25 2;
BA_ "GenSigStartValue" SG_ 974 FRM_15_ObjAccelY_25 2500;
BA_ "GenSigASIL"  SG_ 974 FRM_15_ObjAccelY_25 2;
BA_ "GenSigASIL"  SG_ 974 FRM_15_ObjClosestDistXStd_25 2;
BA_ "GenSigASIL"  SG_ 974 FRM_15_ObjClosestDistYStd_25 2;
BA_ "GenSigASIL"  SG_ 974 FRM_15_ObjRelVelXStd_25 2;
BA_ "GenSigASIL"  SG_ 974 FRM_15_ObjRelVelYStd_25 2;
BA_ "GenSigASIL"  SG_ 974 FRM_15_ObjRelAccelXStd_25 2;
BA_ "GenSigASIL"  SG_ 974 FRM_15_ObjRelAccelYStd_25 2;
BA_ "GenSigASIL"  SG_ 974 FRM_15_ObjExistProb_25 2;
BA_ "GenSigASIL"  SG_ 974 FRM_15_ObjType_25 2;
BA_ "GenSigASIL"  SG_ 974 FRM_15_ObjTypeConf_25 2;
BA_ "GenSigASIL"  SG_ 974 FRM_15_ObjTrackSts_25 2;
BA_ "GenSigASIL"  SG_ 974 FRM_15_ObjMotionSts_25 2;
BA_ "GenSigASIL"  SG_ 974 FRM_15_ObjMotionDirection_25 2;
BA_ "GenSigASIL"  SG_ 974 FRM_15_ObjCenterDistX_25 2;
BA_ "GenSigStartValue" SG_ 974 FRM_15_ObjCenterDistY_25 10000;
BA_ "GenSigASIL"  SG_ 974 FRM_15_ObjCenterDistY_25 2;
BA_ "GenSigASIL"  SG_ 974 FRM_15_ObjLength_25 2;
BA_ "GenSigASIL"  SG_ 974 FRM_15_ObjWidth_25 2;
BA_ "GenSigASIL"  SG_ 974 FRM_15_ObjElevnSts_25 2;
BA_ "GenSigASIL"  SG_ 974 FRM_15_ObjElevnStsConf_25 2;
BA_ "GenSigStartValue" SG_ 974 FRM_15_ObjHeading_25 1800;
BA_ "GenSigASIL"  SG_ 974 FRM_15_ObjHeading_25 2;
BA_ "GenMsgILSupport" BO_ 975 1;
BA_ "GenMsgCycleTime" BO_ 975 50;
BA_ "GenSigASIL"  SG_ 975 FRM_16_CRC 5;
BA_ "GenSigASIL"  SG_ 975 FRM_16_RollgCntr 5;
BA_ "GenSigASIL"  SG_ 975 FRM_16_ObjBlockCounter 2;
BA_ "GenSigASIL"  SG_ 975 FRM_16_ObjID_26 2;
BA_ "GenSigASIL"  SG_ 975 FRM_16_ObjClosestDistX_26 2;
BA_ "GenSigStartValue" SG_ 975 FRM_16_ObjClosestDistY_26 10000;
BA_ "GenSigASIL"  SG_ 975 FRM_16_ObjClosestDistY_26 2;
BA_ "GenSigStartValue" SG_ 975 FRM_16_ObjRelVelX_26 10000;
BA_ "GenSigASIL"  SG_ 975 FRM_16_ObjRelVelX_26 2;
BA_ "GenSigStartValue" SG_ 975 FRM_16_ObjRelVelY_26 10000;
BA_ "GenSigASIL"  SG_ 975 FRM_16_ObjRelVelY_26 2;
BA_ "GenSigStartValue" SG_ 975 FRM_16_ObjAccelX_26 2500;
BA_ "GenSigASIL"  SG_ 975 FRM_16_ObjAccelX_26 2;
BA_ "GenSigStartValue" SG_ 975 FRM_16_ObjAccelY_26 2500;
BA_ "GenSigASIL"  SG_ 975 FRM_16_ObjAccelY_26 2;
BA_ "GenSigASIL"  SG_ 975 FRM_16_ObjClosestDistXStd_26 2;
BA_ "GenSigASIL"  SG_ 975 FRM_16_ObjClosestDistYStd_26 2;
BA_ "GenSigASIL"  SG_ 975 FRM_16_ObjRelVelXStd_26 2;
BA_ "GenSigASIL"  SG_ 975 FRM_16_ObjRelVelYStd_26 2;
BA_ "GenSigASIL"  SG_ 975 FRM_16_ObjRelAccelXStd_26 2;
BA_ "GenSigASIL"  SG_ 975 FRM_16_ObjRelAccelYStd_26 2;
BA_ "GenSigASIL"  SG_ 975 FRM_16_ObjExistProb_26 2;
BA_ "GenSigASIL"  SG_ 975 FRM_16_ObjType_26 2;
BA_ "GenSigASIL"  SG_ 975 FRM_16_ObjTypeConf_26 2;
BA_ "GenSigASIL"  SG_ 975 FRM_16_ObjTrackSts_26 2;
BA_ "GenSigASIL"  SG_ 975 FRM_16_ObjMotionSts_26 2;
BA_ "GenSigASIL"  SG_ 975 FRM_16_ObjMotionDirection_26 2;
BA_ "GenSigASIL"  SG_ 975 FRM_16_ObjCenterDistX_26 2;
BA_ "GenSigStartValue" SG_ 975 FRM_16_ObjCenterDistY_26 10000;
BA_ "GenSigASIL"  SG_ 975 FRM_16_ObjCenterDistY_26 2;
BA_ "GenSigASIL"  SG_ 975 FRM_16_ObjLength_26 2;
BA_ "GenSigASIL"  SG_ 975 FRM_16_ObjWidth_26 2;
BA_ "GenSigASIL"  SG_ 975 FRM_16_ObjElevnSts_26 2;
BA_ "GenSigASIL"  SG_ 975 FRM_16_ObjElevnStsConf_26 2;
BA_ "GenSigStartValue" SG_ 975 FRM_16_ObjHeading_26 1800;
BA_ "GenSigASIL"  SG_ 975 FRM_16_ObjHeading_26 2;
BA_ "GenSigASIL"  SG_ 975 FRM_16_ObjID_27 2;
BA_ "GenSigASIL"  SG_ 975 FRM_16_ObjClosestDistX_27 2;
BA_ "GenSigStartValue" SG_ 975 FRM_16_ObjClosestDistY_27 10000;
BA_ "GenSigASIL"  SG_ 975 FRM_16_ObjClosestDistY_27 2;
BA_ "GenSigStartValue" SG_ 975 FRM_16_ObjRelVelX_27 10000;
BA_ "GenSigASIL"  SG_ 975 FRM_16_ObjRelVelX_27 2;
BA_ "GenSigStartValue" SG_ 975 FRM_16_ObjRelVelY_27 10000;
BA_ "GenSigASIL"  SG_ 975 FRM_16_ObjRelVelY_27 2;
BA_ "GenSigStartValue" SG_ 975 FRM_16_ObjAccelX_27 2500;
BA_ "GenSigASIL"  SG_ 975 FRM_16_ObjAccelX_27 2;
BA_ "GenSigStartValue" SG_ 975 FRM_16_ObjAccelY_27 2500;
BA_ "GenSigASIL"  SG_ 975 FRM_16_ObjAccelY_27 2;
BA_ "GenSigASIL"  SG_ 975 FRM_16_ObjClosestDistXStd_27 2;
BA_ "GenSigASIL"  SG_ 975 FRM_16_ObjClosestDistYStd_27 2;
BA_ "GenSigASIL"  SG_ 975 FRM_16_ObjRelVelXStd_27 2;
BA_ "GenSigASIL"  SG_ 975 FRM_16_ObjRelVelYStd_27 2;
BA_ "GenSigASIL"  SG_ 975 FRM_16_ObjRelAccelXStd_27 2;
BA_ "GenSigASIL"  SG_ 975 FRM_16_ObjRelAccelYStd_27 2;
BA_ "GenSigASIL"  SG_ 975 FRM_16_ObjExistProb_27 2;
BA_ "GenSigASIL"  SG_ 975 FRM_16_ObjType_27 2;
BA_ "GenSigASIL"  SG_ 975 FRM_16_ObjTypeConf_27 2;
BA_ "GenSigASIL"  SG_ 975 FRM_16_ObjTrackSts_27 2;
BA_ "GenSigASIL"  SG_ 975 FRM_16_ObjMotionSts_27 2;
BA_ "GenSigASIL"  SG_ 975 FRM_16_ObjMotionDirection_27 2;
BA_ "GenSigASIL"  SG_ 975 FRM_16_ObjCenterDistX_27 2;
BA_ "GenSigStartValue" SG_ 975 FRM_16_ObjCenterDistY_27 10000;
BA_ "GenSigASIL"  SG_ 975 FRM_16_ObjCenterDistY_27 2;
BA_ "GenSigASIL"  SG_ 975 FRM_16_ObjLength_27 2;
BA_ "GenSigASIL"  SG_ 975 FRM_16_ObjWidth_27 2;
BA_ "GenSigASIL"  SG_ 975 FRM_16_ObjElevnSts_27 2;
BA_ "GenSigASIL"  SG_ 975 FRM_16_ObjElevnStsConf_27 2;
BA_ "GenSigStartValue" SG_ 975 FRM_16_ObjHeading_27 1800;
BA_ "GenSigASIL"  SG_ 975 FRM_16_ObjHeading_27 2;
BA_ "GenMsgILSupport" BO_ 976 1;
BA_ "GenMsgCycleTime" BO_ 976 50;
BA_ "GenSigASIL"  SG_ 976 FRM_17_CRC 5;
BA_ "GenSigASIL"  SG_ 976 FRM_17_RollgCntr 5;
BA_ "GenSigASIL"  SG_ 976 FRM_17_ObjBlockCounter 2;
BA_ "GenSigASIL"  SG_ 976 FRM_17_ObjID_28 2;
BA_ "GenSigASIL"  SG_ 976 FRM_17_ObjClosestDistX_28 2;
BA_ "GenSigStartValue" SG_ 976 FRM_17_ObjClosestDistY_28 10000;
BA_ "GenSigASIL"  SG_ 976 FRM_17_ObjClosestDistY_28 2;
BA_ "GenSigStartValue" SG_ 976 FRM_17_ObjRelVelX_28 10000;
BA_ "GenSigASIL"  SG_ 976 FRM_17_ObjRelVelX_28 2;
BA_ "GenSigStartValue" SG_ 976 FRM_17_ObjRelVelY_28 10000;
BA_ "GenSigASIL"  SG_ 976 FRM_17_ObjRelVelY_28 2;
BA_ "GenSigStartValue" SG_ 976 FRM_17_ObjAccelX_28 2500;
BA_ "GenSigASIL"  SG_ 976 FRM_17_ObjAccelX_28 2;
BA_ "GenSigStartValue" SG_ 976 FRM_17_ObjAccelY_28 2500;
BA_ "GenSigASIL"  SG_ 976 FRM_17_ObjAccelY_28 2;
BA_ "GenSigASIL"  SG_ 976 FRM_17_ObjClosestDistXStd_28 2;
BA_ "GenSigASIL"  SG_ 976 FRM_17_ObjClosestDistYStd_28 2;
BA_ "GenSigASIL"  SG_ 976 FRM_17_ObjRelVelXStd_28 2;
BA_ "GenSigASIL"  SG_ 976 FRM_17_ObjRelVelYStd_28 2;
BA_ "GenSigASIL"  SG_ 976 FRM_17_ObjRelAccelXStd_28 2;
BA_ "GenSigASIL"  SG_ 976 FRM_17_ObjRelAccelYStd_28 2;
BA_ "GenSigASIL"  SG_ 976 FRM_17_ObjExistProb_28 2;
BA_ "GenSigASIL"  SG_ 976 FRM_17_ObjType_28 2;
BA_ "GenSigASIL"  SG_ 976 FRM_17_ObjTypeConf_28 2;
BA_ "GenSigASIL"  SG_ 976 FRM_17_ObjTrackSts_28 2;
BA_ "GenSigASIL"  SG_ 976 FRM_17_ObjMotionSts_28 2;
BA_ "GenSigASIL"  SG_ 976 FRM_17_ObjMotionDirection_28 2;
BA_ "GenSigASIL"  SG_ 976 FRM_17_ObjCenterDistX_28 2;
BA_ "GenSigStartValue" SG_ 976 FRM_17_ObjCenterDistY_28 10000;
BA_ "GenSigASIL"  SG_ 976 FRM_17_ObjCenterDistY_28 2;
BA_ "GenSigASIL"  SG_ 976 FRM_17_ObjLength_28 2;
BA_ "GenSigASIL"  SG_ 976 FRM_17_ObjWidth_28 2;
BA_ "GenSigASIL"  SG_ 976 FRM_17_ObjElevnSts_28 2;
BA_ "GenSigASIL"  SG_ 976 FRM_17_ObjElevnStsConf_28 2;
BA_ "GenSigStartValue" SG_ 976 FRM_17_ObjHeading_28 1800;
BA_ "GenSigASIL"  SG_ 976 FRM_17_ObjHeading_28 2;
BA_ "GenSigASIL"  SG_ 976 FRM_17_ObjID_29 2;
BA_ "GenSigASIL"  SG_ 976 FRM_17_ObjClosestDistX_29 2;
BA_ "GenSigStartValue" SG_ 976 FRM_17_ObjClosestDistY_29 10000;
BA_ "GenSigASIL"  SG_ 976 FRM_17_ObjClosestDistY_29 2;
BA_ "GenSigStartValue" SG_ 976 FRM_17_ObjRelVelX_29 10000;
BA_ "GenSigASIL"  SG_ 976 FRM_17_ObjRelVelX_29 2;
BA_ "GenSigStartValue" SG_ 976 FRM_17_ObjRelVelY_29 10000;
BA_ "GenSigASIL"  SG_ 976 FRM_17_ObjRelVelY_29 2;
BA_ "GenSigStartValue" SG_ 976 FRM_17_ObjAccelX_29 2500;
BA_ "GenSigASIL"  SG_ 976 FRM_17_ObjAccelX_29 2;
BA_ "GenSigStartValue" SG_ 976 FRM_17_ObjAccelY_29 2500;
BA_ "GenSigASIL"  SG_ 976 FRM_17_ObjAccelY_29 2;
BA_ "GenSigASIL"  SG_ 976 FRM_17_ObjClosestDistXStd_29 2;
BA_ "GenSigASIL"  SG_ 976 FRM_17_ObjClosestDistYStd_29 2;
BA_ "GenSigASIL"  SG_ 976 FRM_17_ObjRelVelXStd_29 2;
BA_ "GenSigASIL"  SG_ 976 FRM_17_ObjRelVelYStd_29 2;
BA_ "GenSigASIL"  SG_ 976 FRM_17_ObjRelAccelXStd_29 2;
BA_ "GenSigASIL"  SG_ 976 FRM_17_ObjRelAccelYStd_29 2;
BA_ "GenSigASIL"  SG_ 976 FRM_17_ObjExistProb_29 2;
BA_ "GenSigASIL"  SG_ 976 FRM_17_ObjType_29 2;
BA_ "GenSigASIL"  SG_ 976 FRM_17_ObjTypeConf_29 2;
BA_ "GenSigASIL"  SG_ 976 FRM_17_ObjTrackSts_29 2;
BA_ "GenSigASIL"  SG_ 976 FRM_17_ObjMotionSts_29 2;
BA_ "GenSigASIL"  SG_ 976 FRM_17_ObjMotionDirection_29 2;
BA_ "GenSigASIL"  SG_ 976 FRM_17_ObjCenterDistX_29 2;
BA_ "GenSigStartValue" SG_ 976 FRM_17_ObjCenterDistY_29 10000;
BA_ "GenSigASIL"  SG_ 976 FRM_17_ObjCenterDistY_29 2;
BA_ "GenSigASIL"  SG_ 976 FRM_17_ObjLength_29 2;
BA_ "GenSigASIL"  SG_ 976 FRM_17_ObjWidth_29 2;
BA_ "GenSigASIL"  SG_ 976 FRM_17_ObjElevnSts_29 2;
BA_ "GenSigASIL"  SG_ 976 FRM_17_ObjElevnStsConf_29 2;
BA_ "GenSigStartValue" SG_ 976 FRM_17_ObjHeading_29 1800;
BA_ "GenSigASIL"  SG_ 976 FRM_17_ObjHeading_29 2;
BA_ "GenMsgILSupport" BO_ 977 1;
BA_ "GenMsgCycleTime" BO_ 977 50;
BA_ "GenSigASIL"  SG_ 977 FRM_18_CRC 5;
BA_ "GenSigASIL"  SG_ 977 FRM_18_RollgCntr 5;
BA_ "GenSigASIL"  SG_ 977 FRM_18_ObjBlockCounter 2;
BA_ "GenSigASIL"  SG_ 977 FRM_18_ObjID_30 2;
BA_ "GenSigASIL"  SG_ 977 FRM_18_ObjClosestDistX_30 2;
BA_ "GenSigStartValue" SG_ 977 FRM_18_ObjClosestDistY_30 10000;
BA_ "GenSigASIL"  SG_ 977 FRM_18_ObjClosestDistY_30 2;
BA_ "GenSigStartValue" SG_ 977 FRM_18_ObjRelVelX_30 10000;
BA_ "GenSigASIL"  SG_ 977 FRM_18_ObjRelVelX_30 2;
BA_ "GenSigStartValue" SG_ 977 FRM_18_ObjRelVelY_30 10000;
BA_ "GenSigASIL"  SG_ 977 FRM_18_ObjRelVelY_30 2;
BA_ "GenSigStartValue" SG_ 977 FRM_18_ObjAccelX_30 2500;
BA_ "GenSigASIL"  SG_ 977 FRM_18_ObjAccelX_30 2;
BA_ "GenSigStartValue" SG_ 977 FRM_18_ObjAccelY_30 2500;
BA_ "GenSigASIL"  SG_ 977 FRM_18_ObjAccelY_30 2;
BA_ "GenSigASIL"  SG_ 977 FRM_18_ObjClosestDistXStd_30 2;
BA_ "GenSigASIL"  SG_ 977 FRM_18_ObjClosestDistYStd_30 2;
BA_ "GenSigASIL"  SG_ 977 FRM_18_ObjRelVelXStd_30 2;
BA_ "GenSigASIL"  SG_ 977 FRM_18_ObjRelVelYStd_30 2;
BA_ "GenSigASIL"  SG_ 977 FRM_18_ObjRelAccelXStd_30 2;
BA_ "GenSigASIL"  SG_ 977 FRM_18_ObjRelAccelYStd_30 2;
BA_ "GenSigASIL"  SG_ 977 FRM_18_ObjExistProb_30 2;
BA_ "GenSigASIL"  SG_ 977 FRM_18_ObjType_30 2;
BA_ "GenSigASIL"  SG_ 977 FRM_18_ObjTypeConf_30 2;
BA_ "GenSigASIL"  SG_ 977 FRM_18_ObjTrackSts_30 2;
BA_ "GenSigASIL"  SG_ 977 FRM_18_ObjMotionSts_30 2;
BA_ "GenSigASIL"  SG_ 977 FRM_18_ObjMotionDirection_30 2;
BA_ "GenSigASIL"  SG_ 977 FRM_18_ObjCenterDistX_30 2;
BA_ "GenSigStartValue" SG_ 977 FRM_18_ObjCenterDistY_30 10000;
BA_ "GenSigASIL"  SG_ 977 FRM_18_ObjCenterDistY_30 2;
BA_ "GenSigASIL"  SG_ 977 FRM_18_ObjLength_30 2;
BA_ "GenSigASIL"  SG_ 977 FRM_18_ObjWidth_30 2;
BA_ "GenSigASIL"  SG_ 977 FRM_18_ObjElevnSts_30 2;
BA_ "GenSigASIL"  SG_ 977 FRM_18_ObjElevnStsConf_30 2;
BA_ "GenSigStartValue" SG_ 977 FRM_18_ObjHeading_30 1800;
BA_ "GenSigASIL"  SG_ 977 FRM_18_ObjHeading_30 2;
BA_ "GenSigASIL"  SG_ 977 FRM_18_ObjID_31 2;
BA_ "GenSigASIL"  SG_ 977 FRM_18_ObjClosestDistX_31 2;
BA_ "GenSigStartValue" SG_ 977 FRM_18_ObjClosestDistY_31 10000;
BA_ "GenSigASIL"  SG_ 977 FRM_18_ObjClosestDistY_31 2;
BA_ "GenSigStartValue" SG_ 977 FRM_18_ObjRelVelX_31 10000;
BA_ "GenSigASIL"  SG_ 977 FRM_18_ObjRelVelX_31 2;
BA_ "GenSigStartValue" SG_ 977 FRM_18_ObjRelVelY_31 10000;
BA_ "GenSigASIL"  SG_ 977 FRM_18_ObjRelVelY_31 2;
BA_ "GenSigStartValue" SG_ 977 FRM_18_ObjAccelX_31 2500;
BA_ "GenSigASIL"  SG_ 977 FRM_18_ObjAccelX_31 2;
BA_ "GenSigStartValue" SG_ 977 FRM_18_ObjAccelY_31 2500;
BA_ "GenSigASIL"  SG_ 977 FRM_18_ObjAccelY_31 2;
BA_ "GenSigASIL"  SG_ 977 FRM_18_ObjClosestDistXStd_31 2;
BA_ "GenSigASIL"  SG_ 977 FRM_18_ObjClosestDistYStd_31 2;
BA_ "GenSigASIL"  SG_ 977 FRM_18_ObjRelVelXStd_31 2;
BA_ "GenSigASIL"  SG_ 977 FRM_18_ObjRelVelYStd_31 2;
BA_ "GenSigASIL"  SG_ 977 FRM_18_ObjRelAccelXStd_31 2;
BA_ "GenSigASIL"  SG_ 977 FRM_18_ObjRelAccelYStd_31 2;
BA_ "GenSigASIL"  SG_ 977 FRM_18_ObjExistProb_31 2;
BA_ "GenSigASIL"  SG_ 977 FRM_18_ObjType_31 2;
BA_ "GenSigASIL"  SG_ 977 FRM_18_ObjTypeConf_31 2;
BA_ "GenSigASIL"  SG_ 977 FRM_18_ObjTrackSts_31 2;
BA_ "GenSigASIL"  SG_ 977 FRM_18_ObjMotionSts_31 2;
BA_ "GenSigASIL"  SG_ 977 FRM_18_ObjMotionDirection_31 2;
BA_ "GenSigASIL"  SG_ 977 FRM_18_ObjCenterDistX_31 2;
BA_ "GenSigStartValue" SG_ 977 FRM_18_ObjCenterDistY_31 10000;
BA_ "GenSigASIL"  SG_ 977 FRM_18_ObjCenterDistY_31 2;
BA_ "GenSigASIL"  SG_ 977 FRM_18_ObjLength_31 2;
BA_ "GenSigASIL"  SG_ 977 FRM_18_ObjWidth_31 2;
BA_ "GenSigASIL"  SG_ 977 FRM_18_ObjElevnSts_31 2;
BA_ "GenSigASIL"  SG_ 977 FRM_18_ObjElevnStsConf_31 2;
BA_ "GenSigStartValue" SG_ 977 FRM_18_ObjHeading_31 1800;
BA_ "GenSigASIL"  SG_ 977 FRM_18_ObjHeading_31 2;
BA_ "GenMsgILSupport" BO_ 978 1;
BA_ "GenMsgCycleTime" BO_ 978 50;
BA_ "GenSigASIL"  SG_ 978 FRM_19_CRC 5;
BA_ "GenSigASIL"  SG_ 978 FRM_19_RollgCntr 5;
BA_ "GenSigASIL"  SG_ 978 FRM_19_ObjBlockCounter 2;
BA_ "GenSigASIL"  SG_ 978 FRM_19_ObjID_32 2;
BA_ "GenSigASIL"  SG_ 978 FRM_19_ObjClosestDistX_32 2;
BA_ "GenSigStartValue" SG_ 978 FRM_19_ObjClosestDistY_32 10000;
BA_ "GenSigASIL"  SG_ 978 FRM_19_ObjClosestDistY_32 2;
BA_ "GenSigStartValue" SG_ 978 FRM_19_ObjRelVelX_32 10000;
BA_ "GenSigASIL"  SG_ 978 FRM_19_ObjRelVelX_32 2;
BA_ "GenSigStartValue" SG_ 978 FRM_19_ObjRelVelY_32 10000;
BA_ "GenSigASIL"  SG_ 978 FRM_19_ObjRelVelY_32 2;
BA_ "GenSigStartValue" SG_ 978 FRM_19_ObjAccelX_32 2500;
BA_ "GenSigASIL"  SG_ 978 FRM_19_ObjAccelX_32 2;
BA_ "GenSigStartValue" SG_ 978 FRM_19_ObjAccelY_32 2500;
BA_ "GenSigASIL"  SG_ 978 FRM_19_ObjAccelY_32 2;
BA_ "GenSigASIL"  SG_ 978 FRM_19_ObjClosestDistXStd_32 2;
BA_ "GenSigASIL"  SG_ 978 FRM_19_ObjClosestDistYStd_32 2;
BA_ "GenSigASIL"  SG_ 978 FRM_19_ObjRelVelXStd_32 2;
BA_ "GenSigASIL"  SG_ 978 FRM_19_ObjRelVelYStd_32 2;
BA_ "GenSigASIL"  SG_ 978 FRM_19_ObjRelAccelXStd_32 2;
BA_ "GenSigASIL"  SG_ 978 FRM_19_ObjRelAccelYStd_32 2;
BA_ "GenSigASIL"  SG_ 978 FRM_19_ObjExistProb_32 2;
BA_ "GenSigASIL"  SG_ 978 FRM_19_ObjType_32 2;
BA_ "GenSigASIL"  SG_ 978 FRM_19_ObjTypeConf_32 2;
BA_ "GenSigASIL"  SG_ 978 FRM_19_ObjTrackSts_32 2;
BA_ "GenSigASIL"  SG_ 978 FRM_19_ObjMotionSts_32 2;
BA_ "GenSigASIL"  SG_ 978 FRM_19_ObjMotionDirection_32 2;
BA_ "GenSigASIL"  SG_ 978 FRM_19_ObjCenterDistX_32 2;
BA_ "GenSigStartValue" SG_ 978 FRM_19_ObjCenterDistY_32 10000;
BA_ "GenSigASIL"  SG_ 978 FRM_19_ObjCenterDistY_32 2;
BA_ "GenSigASIL"  SG_ 978 FRM_19_ObjLength_32 2;
BA_ "GenSigASIL"  SG_ 978 FRM_19_ObjWidth_32 2;
BA_ "GenSigASIL"  SG_ 978 FRM_19_ObjElevnSts_32 2;
BA_ "GenSigASIL"  SG_ 978 FRM_19_ObjElevnStsConf_32 2;
BA_ "GenSigStartValue" SG_ 978 FRM_19_ObjHeading_32 1800;
BA_ "GenSigASIL"  SG_ 978 FRM_19_ObjHeading_32 2;
BA_ "GenSigASIL"  SG_ 978 FRM_19_ObjID_33 2;
BA_ "GenSigASIL"  SG_ 978 FRM_19_ObjClosestDistX_33 2;
BA_ "GenSigStartValue" SG_ 978 FRM_19_ObjClosestDistY_33 10000;
BA_ "GenSigASIL"  SG_ 978 FRM_19_ObjClosestDistY_33 2;
BA_ "GenSigStartValue" SG_ 978 FRM_19_ObjRelVelX_33 10000;
BA_ "GenSigASIL"  SG_ 978 FRM_19_ObjRelVelX_33 2;
BA_ "GenSigStartValue" SG_ 978 FRM_19_ObjRelVelY_33 10000;
BA_ "GenSigASIL"  SG_ 978 FRM_19_ObjRelVelY_33 2;
BA_ "GenSigStartValue" SG_ 978 FRM_19_ObjAccelX_33 2500;
BA_ "GenSigASIL"  SG_ 978 FRM_19_ObjAccelX_33 2;
BA_ "GenSigStartValue" SG_ 978 FRM_19_ObjAccelY_33 2500;
BA_ "GenSigASIL"  SG_ 978 FRM_19_ObjAccelY_33 2;
BA_ "GenSigASIL"  SG_ 978 FRM_19_ObjClosestDistXStd_33 2;
BA_ "GenSigASIL"  SG_ 978 FRM_19_ObjClosestDistYStd_33 2;
BA_ "GenSigASIL"  SG_ 978 FRM_19_ObjRelVelXStd_33 2;
BA_ "GenSigASIL"  SG_ 978 FRM_19_ObjRelVelYStd_33 2;
BA_ "GenSigASIL"  SG_ 978 FRM_19_ObjRelAccelXStd_33 2;
BA_ "GenSigASIL"  SG_ 978 FRM_19_ObjRelAccelYStd_33 2;
BA_ "GenSigASIL"  SG_ 978 FRM_19_ObjExistProb_33 2;
BA_ "GenSigASIL"  SG_ 978 FRM_19_ObjType_33 2;
BA_ "GenSigASIL"  SG_ 978 FRM_19_ObjTypeConf_33 2;
BA_ "GenSigASIL"  SG_ 978 FRM_19_ObjTrackSts_33 2;
BA_ "GenSigASIL"  SG_ 978 FRM_19_ObjMotionSts_33 2;
BA_ "GenSigASIL"  SG_ 978 FRM_19_ObjMotionDirection_33 2;
BA_ "GenSigASIL"  SG_ 978 FRM_19_ObjCenterDistX_33 2;
BA_ "GenSigStartValue" SG_ 978 FRM_19_ObjCenterDistY_33 10000;
BA_ "GenSigASIL"  SG_ 978 FRM_19_ObjCenterDistY_33 2;
BA_ "GenSigASIL"  SG_ 978 FRM_19_ObjLength_33 2;
BA_ "GenSigASIL"  SG_ 978 FRM_19_ObjWidth_33 2;
BA_ "GenSigASIL"  SG_ 978 FRM_19_ObjElevnSts_33 2;
BA_ "GenSigASIL"  SG_ 978 FRM_19_ObjElevnStsConf_33 2;
BA_ "GenSigStartValue" SG_ 978 FRM_19_ObjHeading_33 1800;
BA_ "GenSigASIL"  SG_ 978 FRM_19_ObjHeading_33 2;
VAL_ 970 FRM_11_ObjType_16 3 "Four-wheels" 2 "Two-wheels" 1 "Pedestrian" 0 "Unknown" ;
VAL_ 970 FRM_11_ObjTrackSts_16 3 "Coasted" 2 "New" 1 "Updated" 0 "Unknown" ;
VAL_ 970 FRM_11_ObjMotionSts_16 3 "Static" 2 "Stopped" 1 "Moving" 0 "Unknown" ;
VAL_ 970 FRM_11_ObjMotionDirection_16 3 "Cossing" 2 "Reverse" 1 "Homogeneous" 0 "Unknown" ;
VAL_ 970 FRM_11_ObjElevnSts_16 3 "UnderRidable" 2 "Obstacle" 1 "OverRidable" 0 "Unknown" ;
VAL_ 970 FRM_11_ObjType_17 3 "Four-wheels" 2 "Two-wheels" 1 "Pedestrian" 0 "Unknown" ;
VAL_ 970 FRM_11_ObjTrackSts_17 3 "Coasted" 2 "New" 1 "Updated" 0 "Unknown" ;
VAL_ 970 FRM_11_ObjMotionSts_17 3 "Static" 2 "Stopped" 1 "Moving" 0 "Unknown" ;
VAL_ 970 FRM_11_ObjMotionDirection_17 3 "Cossing" 2 "Reverse" 1 "Homogeneous" 0 "Unknown" ;
VAL_ 970 FRM_11_ObjElevnSts_17 3 "UnderRidable" 2 "Obstacle" 1 "OverRidable" 0 "Unknown" ;
VAL_ 971 FRM_12_ObjType_18 3 "Four-wheels" 2 "Two-wheels" 1 "Pedestrian" 0 "Unknown" ;
VAL_ 971 FRM_12_ObjTrackSts_18 3 "Coasted" 2 "New" 1 "Updated" 0 "Unknown" ;
VAL_ 971 FRM_12_ObjMotionSts_18 3 "Static" 2 "Stopped" 1 "Moving" 0 "Unknown" ;
VAL_ 971 FRM_12_ObjMotionDirection_18 3 "Cossing" 2 "Reverse" 1 "Homogeneous" 0 "Unknown" ;
VAL_ 971 FRM_12_ObjElevnSts_18 3 "UnderRidable" 2 "Obstacle" 1 "OverRidable" 0 "Unknown" ;
VAL_ 971 FRM_12_ObjType_19 3 "Four-wheels" 2 "Two-wheels" 1 "Pedestrian" 0 "Unknown" ;
VAL_ 971 FRM_12_ObjTrackSts_19 3 "Coasted" 2 "New" 1 "Updated" 0 "Unknown" ;
VAL_ 971 FRM_12_ObjMotionSts_19 3 "Static" 2 "Stopped" 1 "Moving" 0 "Unknown" ;
VAL_ 971 FRM_12_ObjMotionDirection_19 3 "Cossing" 2 "Reverse" 1 "Homogeneous" 0 "Unknown" ;
VAL_ 971 FRM_12_ObjElevnSts_19 3 "UnderRidable" 2 "Obstacle" 1 "OverRidable" 0 "Unknown" ;
VAL_ 972 FRM_13_ObjType_20 3 "Four-wheels" 2 "Two-wheels" 1 "Pedestrian" 0 "Unknown" ;
VAL_ 972 FRM_13_ObjTrackSts_20 3 "Coasted" 2 "New" 1 "Updated" 0 "Unknown" ;
VAL_ 972 FRM_13_ObjMotionSts_20 3 "Static" 2 "Stopped" 1 "Moving" 0 "Unknown" ;
VAL_ 972 FRM_13_ObjMotionDirection_20 3 "Cossing" 2 "Reverse" 1 "Homogeneous" 0 "Unknown" ;
VAL_ 972 FRM_13_ObjElevnSts_20 3 "UnderRidable" 2 "Obstacle" 1 "OverRidable" 0 "Unknown" ;
VAL_ 972 FRM_13_ObjType_21 3 "Four-wheels" 2 "Two-wheels" 1 "Pedestrian" 0 "Unknown" ;
VAL_ 972 FRM_13_ObjTrackSts_21 3 "Coasted" 2 "New" 1 "Updated" 0 "Unknown" ;
VAL_ 972 FRM_13_ObjMotionSts_21 3 "Static" 2 "Stopped" 1 "Moving" 0 "Unknown" ;
VAL_ 972 FRM_13_ObjMotionDirection_21 3 "Cossing" 2 "Reverse" 1 "Homogeneous" 0 "Unknown" ;
VAL_ 972 FRM_13_ObjElevnSts_21 3 "UnderRidable" 2 "Obstacle" 1 "OverRidable" 0 "Unknown" ;
VAL_ 973 FRM_14_ObjType_22 3 "Four-wheels" 2 "Two-wheels" 1 "Pedestrian" 0 "Unknown" ;
VAL_ 973 FRM_14_ObjTrackSts_22 3 "Coasted" 2 "New" 1 "Updated" 0 "Unknown" ;
VAL_ 973 FRM_14_ObjMotionSts_22 3 "Static" 2 "Stopped" 1 "Moving" 0 "Unknown" ;
VAL_ 973 FRM_14_ObjMotionDirection_22 3 "Cossing" 2 "Reverse" 1 "Homogeneous" 0 "Unknown" ;
VAL_ 973 FRM_14_ObjElevnSts_22 3 "UnderRidable" 2 "Obstacle" 1 "OverRidable" 0 "Unknown" ;
VAL_ 973 FRM_14_ObjType_23 3 "Four-wheels" 2 "Two-wheels" 1 "Pedestrian" 0 "Unknown" ;
VAL_ 973 FRM_14_ObjTrackSts_23 3 "Coasted" 2 "New" 1 "Updated" 0 "Unknown" ;
VAL_ 973 FRM_14_ObjMotionSts_23 3 "Static" 2 "Stopped" 1 "Moving" 0 "Unknown" ;
VAL_ 973 FRM_14_ObjMotionDirection_23 3 "Cossing" 2 "Reverse" 1 "Homogeneous" 0 "Unknown" ;
VAL_ 973 FRM_14_ObjElevnSts_23 3 "UnderRidable" 2 "Obstacle" 1 "OverRidable" 0 "Unknown" ;
VAL_ 974 FRM_15_ObjType_24 3 "Four-wheels" 2 "Two-wheels" 1 "Pedestrian" 0 "Unknown" ;
VAL_ 974 FRM_15_ObjTrackSts_24 3 "Coasted" 2 "New" 1 "Updated" 0 "Unknown" ;
VAL_ 974 FRM_15_ObjMotionSts_24 3 "Static" 2 "Stopped" 1 "Moving" 0 "Unknown" ;
VAL_ 974 FRM_15_ObjMotionDirection_24 3 "Cossing" 2 "Reverse" 1 "Homogeneous" 0 "Unknown" ;
VAL_ 974 FRM_15_ObjElevnSts_24 3 "UnderRidable" 2 "Obstacle" 1 "OverRidable" 0 "Unknown" ;
VAL_ 974 FRM_15_ObjType_25 3 "Four-wheels" 2 "Two-wheels" 1 "Pedestrian" 0 "Unknown" ;
VAL_ 974 FRM_15_ObjTrackSts_25 3 "Coasted" 2 "New" 1 "Updated" 0 "Unknown" ;
VAL_ 974 FRM_15_ObjMotionSts_25 3 "Static" 2 "Stopped" 1 "Moving" 0 "Unknown" ;
VAL_ 974 FRM_15_ObjMotionDirection_25 3 "Cossing" 2 "Reverse" 1 "Homogeneous" 0 "Unknown" ;
VAL_ 974 FRM_15_ObjElevnSts_25 3 "UnderRidable" 2 "Obstacle" 1 "OverRidable" 0 "Unknown" ;
VAL_ 975 FRM_16_ObjType_26 3 "Four-wheels" 2 "Two-wheels" 1 "Pedestrian" 0 "Unknown" ;
VAL_ 975 FRM_16_ObjTrackSts_26 3 "Coasted" 2 "New" 1 "Updated" 0 "Unknown" ;
VAL_ 975 FRM_16_ObjMotionSts_26 3 "Static" 2 "Stopped" 1 "Moving" 0 "Unknown" ;
VAL_ 975 FRM_16_ObjMotionDirection_26 3 "Cossing" 2 "Reverse" 1 "Homogeneous" 0 "Unknown" ;
VAL_ 975 FRM_16_ObjElevnSts_26 3 "UnderRidable" 2 "Obstacle" 1 "OverRidable" 0 "Unknown" ;
VAL_ 975 FRM_16_ObjType_27 3 "Four-wheels" 2 "Two-wheels" 1 "Pedestrian" 0 "Unknown" ;
VAL_ 975 FRM_16_ObjTrackSts_27 3 "Coasted" 2 "New" 1 "Updated" 0 "Unknown" ;
VAL_ 975 FRM_16_ObjMotionSts_27 3 "Static" 2 "Stopped" 1 "Moving" 0 "Unknown" ;
VAL_ 975 FRM_16_ObjMotionDirection_27 3 "Cossing" 2 "Reverse" 1 "Homogeneous" 0 "Unknown" ;
VAL_ 975 FRM_16_ObjElevnSts_27 3 "UnderRidable" 2 "Obstacle" 1 "OverRidable" 0 "Unknown" ;
VAL_ 976 FRM_17_ObjType_28 3 "Four-wheels" 2 "Two-wheels" 1 "Pedestrian" 0 "Unknown" ;
VAL_ 976 FRM_17_ObjTrackSts_28 3 "Coasted" 2 "New" 1 "Updated" 0 "Unknown" ;
VAL_ 976 FRM_17_ObjMotionSts_28 3 "Static" 2 "Stopped" 1 "Moving" 0 "Unknown" ;
VAL_ 976 FRM_17_ObjMotionDirection_28 3 "Cossing" 2 "Reverse" 1 "Homogeneous" 0 "Unknown" ;
VAL_ 976 FRM_17_ObjElevnSts_28 3 "UnderRidable" 2 "Obstacle" 1 "OverRidable" 0 "Unknown" ;
VAL_ 976 FRM_17_ObjType_29 3 "Four-wheels" 2 "Two-wheels" 1 "Pedestrian" 0 "Unknown" ;
VAL_ 976 FRM_17_ObjTrackSts_29 3 "Coasted" 2 "New" 1 "Updated" 0 "Unknown" ;
VAL_ 976 FRM_17_ObjMotionSts_29 3 "Static" 2 "Stopped" 1 "Moving" 0 "Unknown" ;
VAL_ 976 FRM_17_ObjMotionDirection_29 3 "Cossing" 2 "Reverse" 1 "Homogeneous" 0 "Unknown" ;
VAL_ 976 FRM_17_ObjElevnSts_29 3 "UnderRidable" 2 "Obstacle" 1 "OverRidable" 0 "Unknown" ;
VAL_ 977 FRM_18_ObjType_30 3 "Four-wheels" 2 "Two-wheels" 1 "Pedestrian" 0 "Unknown" ;
VAL_ 977 FRM_18_ObjTrackSts_30 3 "Coasted" 2 "New" 1 "Updated" 0 "Unknown" ;
VAL_ 977 FRM_18_ObjMotionSts_30 3 "Static" 2 "Stopped" 1 "Moving" 0 "Unknown" ;
VAL_ 977 FRM_18_ObjMotionDirection_30 3 "Cossing" 2 "Reverse" 1 "Homogeneous" 0 "Unknown" ;
VAL_ 977 FRM_18_ObjElevnSts_30 3 "UnderRidable" 2 "Obstacle" 1 "OverRidable" 0 "Unknown" ;
VAL_ 977 FRM_18_ObjType_31 3 "Four-wheels" 2 "Two-wheels" 1 "Pedestrian" 0 "Unknown" ;
VAL_ 977 FRM_18_ObjTrackSts_31 3 "Coasted" 2 "New" 1 "Updated" 0 "Unknown" ;
VAL_ 977 FRM_18_ObjMotionSts_31 3 "Static" 2 "Stopped" 1 "Moving" 0 "Unknown" ;
VAL_ 977 FRM_18_ObjMotionDirection_31 3 "Cossing" 2 "Reverse" 1 "Homogeneous" 0 "Unknown" ;
VAL_ 977 FRM_18_ObjElevnSts_31 3 "UnderRidable" 2 "Obstacle" 1 "OverRidable" 0 "Unknown" ;
VAL_ 978 FRM_19_ObjType_32 3 "Four-wheels" 2 "Two-wheels" 1 "Pedestrian" 0 "Unknown" ;
VAL_ 978 FRM_19_ObjTrackSts_32 3 "Coasted" 2 "New" 1 "Updated" 0 "Unknown" ;
VAL_ 978 FRM_19_ObjMotionSts_32 3 "Static" 2 "Stopped" 1 "Moving" 0 "Unknown" ;
VAL_ 978 FRM_19_ObjMotionDirection_32 3 "Cossing" 2 "Reverse" 1 "Homogeneous" 0 "Unknown" ;
VAL_ 978 FRM_19_ObjElevnSts_32 3 "UnderRidable" 2 "Obstacle" 1 "OverRidable" 0 "Unknown" ;
VAL_ 978 FRM_19_ObjType_33 3 "Four-wheels" 2 "Two-wheels" 1 "Pedestrian" 0 "Unknown" ;
VAL_ 978 FRM_19_ObjTrackSts_33 3 "Coasted" 2 "New" 1 "Updated" 0 "Unknown" ;
VAL_ 978 FRM_19_ObjMotionSts_33 3 "Static" 2 "Stopped" 1 "Moving" 0 "Unknown" ;
VAL_ 978 FRM_19_ObjMotionDirection_33 3 "Cossing" 2 "Reverse" 1 "Homogeneous" 0 "Unknown" ;
VAL_ 978 FRM_19_ObjElevnSts_33 3 "UnderRidable" 2 "Obstacle" 1 "OverRidable" 0 "Unknown" ;
