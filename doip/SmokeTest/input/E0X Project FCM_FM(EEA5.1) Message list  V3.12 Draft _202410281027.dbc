VERSION ""

NS_ :

BS_:

BU_: FRM_FM_4X

BO_ 1002 FRM_31: 64 FRM_FM_4X
 SG_ FRM_31_CRC : 7|16@0+ (1,0) [0|65535] ""  Vector__XXX
 SG_ FRM_31_RollgCntr : 23|8@0+ (1,0) [0|255] ""  Vector__XXX
 SG_ FRM_31_DetnBlockCounter : 27|4@0+ (1,0) [0|15] ""  Vector__XXX
 SG_ FRM_31_DetnMotionSts_048 : 29|2@0+ (1,0) [0|3] ""  Vector__XXX
 SG_ FRM_31_DetnRngRadial_048 : 39|15@0+ (0.01,0) [0|200] "m"  Vector__XXX
 SG_ FRM_31_DetnAziAngle_048 : 40|11@0+ (0.1,-90) [-90|90] "deg"  Vector__XXX
 SG_ FRM_31_DetnElevnAngle_048 : 61|8@0+ (0.1,-10) [-10|10] "deg"  Vector__XXX
 SG_ FRM_31_DetnRelVelRadial_048 : 69|15@0+ (0.01,-100) [-100|80] "m/s"  Vector__XXX
 SG_ FRM_31_DetnSNR_048 : 86|7@0+ (1,0) [0|100] "dB"  Vector__XXX
 SG_ FRM_31_DetnRCS_048 : 95|15@0+ (0.01,-50) [-50|128] "dBsm"  Vector__XXX
 SG_ FRM_31_DetnQuality_048 : 96|4@0+ (10,0) [0|100] "%"  Vector__XXX
 SG_ FRM_31_DetnMotionSts_049 : 31|2@0+ (1,0) [0|3] ""  Vector__XXX
 SG_ FRM_31_DetnRngRadial_049 : 108|15@0+ (0.01,0) [0|200] "m"  Vector__XXX
 SG_ FRM_31_DetnAziAngle_049 : 125|11@0+ (0.1,-90) [-90|90] "deg"  Vector__XXX
 SG_ FRM_31_DetnElevnAngle_049 : 130|8@0+ (0.1,-10) [-10|10] "deg"  Vector__XXX
 SG_ FRM_31_DetnRelVelRadial_049 : 138|15@0+ (0.01,-100) [-100|80] "m/s"  Vector__XXX
 SG_ FRM_31_DetnSNR_049 : 155|7@0+ (1,0) [0|100] "dB"  Vector__XXX
 SG_ FRM_31_DetnRCS_049 : 164|15@0+ (0.01,-50) [-50|128] "dBsm"  Vector__XXX
 SG_ FRM_31_DetnQuality_049 : 181|4@0+ (10,0) [0|100] "%"  Vector__XXX
 SG_ FRM_31_DetnMotionSts_050 : 177|2@0+ (1,0) [0|3] ""  Vector__XXX
 SG_ FRM_31_DetnRngRadial_050 : 191|15@0+ (0.01,0) [0|200] "m"  Vector__XXX
 SG_ FRM_31_DetnAziAngle_050 : 192|11@0+ (0.1,-90) [-90|90] "deg"  Vector__XXX
 SG_ FRM_31_DetnElevnAngle_050 : 213|8@0+ (0.1,-10) [-10|10] "deg"  Vector__XXX
 SG_ FRM_31_DetnRelVelRadial_050 : 221|15@0+ (0.01,-100) [-100|80] "m/s"  Vector__XXX
 SG_ FRM_31_DetnSNR_050 : 238|7@0+ (1,0) [0|100] "dB"  Vector__XXX
 SG_ FRM_31_DetnRCS_050 : 247|15@0+ (0.01,-50) [-50|128] "dBsm"  Vector__XXX
 SG_ FRM_31_DetnQuality_050 : 248|4@0+ (10,0) [0|100] "%"  Vector__XXX
 SG_ FRM_31_DetnMotionSts_051 : 260|2@0+ (1,0) [0|3] ""  Vector__XXX
 SG_ FRM_31_DetnRngRadial_051 : 258|15@0+ (0.01,0) [0|200] "m"  Vector__XXX
 SG_ FRM_31_DetnAziAngle_051 : 275|11@0+ (0.1,-90) [-90|90] "deg"  Vector__XXX
 SG_ FRM_31_DetnElevnAngle_051 : 280|8@0+ (0.1,-10) [-10|10] "deg"  Vector__XXX
 SG_ FRM_31_DetnRelVelRadial_051 : 288|15@0+ (0.01,-100) [-100|80] "m/s"  Vector__XXX
 SG_ FRM_31_DetnSNR_051 : 305|7@0+ (1,0) [0|100] "dB"  Vector__XXX
 SG_ FRM_31_DetnRCS_051 : 314|15@0+ (0.01,-50) [-50|128] "dBsm"  Vector__XXX
 SG_ FRM_31_DetnQuality_051 : 331|4@0+ (10,0) [0|100] "%"  Vector__XXX
 SG_ FRM_31_DetnMotionSts_052 : 343|2@0+ (1,0) [0|3] ""  Vector__XXX
 SG_ FRM_31_DetnRngRadial_052 : 341|15@0+ (0.01,0) [0|200] "m"  Vector__XXX
 SG_ FRM_31_DetnAziAngle_052 : 358|11@0+ (0.1,-90) [-90|90] "deg"  Vector__XXX
 SG_ FRM_31_DetnElevnAngle_052 : 363|8@0+ (0.1,-10) [-10|10] "deg"  Vector__XXX
 SG_ FRM_31_DetnRelVelRadial_052 : 371|15@0+ (0.01,-100) [-100|80] "m/s"  Vector__XXX
 SG_ FRM_31_DetnSNR_052 : 388|7@0+ (1,0) [0|100] "dB"  Vector__XXX
 SG_ FRM_31_DetnRCS_052 : 397|15@0+ (0.01,-50) [-50|128] "dBsm"  Vector__XXX
 SG_ FRM_31_DetnQuality_052 : 414|4@0+ (10,0) [0|100] "%"  Vector__XXX
 SG_ FRM_31_DetnMotionSts_053 : 410|2@0+ (1,0) [0|3] ""  Vector__XXX
 SG_ FRM_31_DetnRngRadial_053 : 408|15@0+ (0.01,0) [0|200] "m"  Vector__XXX
 SG_ FRM_31_DetnAziAngle_053 : 425|11@0+ (0.1,-90) [-90|90] "deg"  Vector__XXX
 SG_ FRM_31_DetnElevnAngle_053 : 446|8@0+ (0.1,-10) [-10|10] "deg"  Vector__XXX
 SG_ FRM_31_DetnRelVelRadial_053 : 454|15@0+ (0.01,-100) [-100|80] "m/s"  Vector__XXX
 SG_ FRM_31_DetnSNR_053 : 471|7@0+ (1,0) [0|100] "dB"  Vector__XXX
 SG_ FRM_31_DetnRCS_053 : 464|15@0+ (0.01,-50) [-50|128] "dBsm"  Vector__XXX
 SG_ FRM_31_DetnQuality_053 : 481|4@0+ (10,0) [0|100] "%"  Vector__XXX

BO_ 1003 FRM_32: 64 FRM_FM_4X
 SG_ FRM_32_CRC : 7|16@0+ (1,0) [0|65535] ""  Vector__XXX
 SG_ FRM_32_RollgCntr : 23|8@0+ (1,0) [0|255] ""  Vector__XXX
 SG_ FRM_32_DetnBlockCounter : 27|4@0+ (1,0) [0|15] ""  Vector__XXX
 SG_ FRM_32_DetnMotionSts_054 : 29|2@0+ (1,0) [0|3] ""  Vector__XXX
 SG_ FRM_32_DetnRngRadial_054 : 39|15@0+ (0.01,0) [0|200] "m"  Vector__XXX
 SG_ FRM_32_DetnAziAngle_054 : 40|11@0+ (0.1,-90) [-90|90] "deg"  Vector__XXX
 SG_ FRM_32_DetnElevnAngle_054 : 61|8@0+ (0.1,-10) [-10|10] "deg"  Vector__XXX
 SG_ FRM_32_DetnRelVelRadial_054 : 69|15@0+ (0.01,-100) [-100|80] "m/s"  Vector__XXX
 SG_ FRM_32_DetnSNR_054 : 86|7@0+ (1,0) [0|100] "dB"  Vector__XXX
 SG_ FRM_32_DetnRCS_054 : 95|15@0+ (0.01,-50) [-50|128] "dBsm"  Vector__XXX
 SG_ FRM_32_DetnQuality_054 : 96|4@0+ (10,0) [0|100] "%"  Vector__XXX
 SG_ FRM_32_DetnMotionSts_055 : 31|2@0+ (1,0) [0|3] ""  Vector__XXX
 SG_ FRM_32_DetnRngRadial_055 : 108|15@0+ (0.01,0) [0|200] "m"  Vector__XXX
 SG_ FRM_32_DetnAziAngle_055 : 125|11@0+ (0.1,-90) [-90|90] "deg"  Vector__XXX
 SG_ FRM_32_DetnElevnAngle_055 : 130|8@0+ (0.1,-10) [-10|10] "deg"  Vector__XXX
 SG_ FRM_32_DetnRelVelRadial_055 : 138|15@0+ (0.01,-100) [-100|80] "m/s"  Vector__XXX
 SG_ FRM_32_DetnSNR_055 : 155|7@0+ (1,0) [0|100] "dB"  Vector__XXX
 SG_ FRM_32_DetnRCS_055 : 164|15@0+ (0.01,-50) [-50|128] "dBsm"  Vector__XXX
 SG_ FRM_32_DetnQuality_055 : 181|4@0+ (10,0) [0|100] "%"  Vector__XXX
 SG_ FRM_32_DetnMotionSts_056 : 177|2@0+ (1,0) [0|3] ""  Vector__XXX
 SG_ FRM_32_DetnRngRadial_056 : 191|15@0+ (0.01,0) [0|200] "m"  Vector__XXX
 SG_ FRM_32_DetnAziAngle_056 : 192|11@0+ (0.1,-90) [-90|90] "deg"  Vector__XXX
 SG_ FRM_32_DetnElevnAngle_056 : 213|8@0+ (0.1,-10) [-10|10] "deg"  Vector__XXX
 SG_ FRM_32_DetnRelVelRadial_056 : 221|15@0+ (0.01,-100) [-100|80] "m/s"  Vector__XXX
 SG_ FRM_32_DetnSNR_056 : 238|7@0+ (1,0) [0|100] "dB"  Vector__XXX
 SG_ FRM_32_DetnRCS_056 : 247|15@0+ (0.01,-50) [-50|128] "dBsm"  Vector__XXX
 SG_ FRM_32_DetnQuality_056 : 248|4@0+ (10,0) [0|100] "%"  Vector__XXX
 SG_ FRM_32_DetnMotionSts_057 : 260|2@0+ (1,0) [0|3] ""  Vector__XXX
 SG_ FRM_32_DetnRngRadial_057 : 258|15@0+ (0.01,0) [0|200] "m"  Vector__XXX
 SG_ FRM_32_DetnAziAngle_057 : 275|11@0+ (0.1,-90) [-90|90] "deg"  Vector__XXX
 SG_ FRM_32_DetnElevnAngle_057 : 280|8@0+ (0.1,-10) [-10|10] "deg"  Vector__XXX
 SG_ FRM_32_DetnRelVelRadial_057 : 288|15@0+ (0.01,-100) [-100|80] "m/s"  Vector__XXX
 SG_ FRM_32_DetnSNR_057 : 305|7@0+ (1,0) [0|100] "dB"  Vector__XXX
 SG_ FRM_32_DetnRCS_057 : 314|15@0+ (0.01,-50) [-50|128] "dBsm"  Vector__XXX
 SG_ FRM_32_DetnQuality_057 : 331|4@0+ (10,0) [0|100] "%"  Vector__XXX
 SG_ FRM_32_DetnMotionSts_058 : 343|2@0+ (1,0) [0|3] ""  Vector__XXX
 SG_ FRM_32_DetnRngRadial_058 : 341|15@0+ (0.01,0) [0|200] "m"  Vector__XXX
 SG_ FRM_32_DetnAziAngle_058 : 358|11@0+ (0.1,-90) [-90|90] "deg"  Vector__XXX
 SG_ FRM_32_DetnElevnAngle_058 : 363|8@0+ (0.1,-10) [-10|10] "deg"  Vector__XXX
 SG_ FRM_32_DetnRelVelRadial_058 : 371|15@0+ (0.01,-100) [-100|80] "m/s"  Vector__XXX
 SG_ FRM_32_DetnSNR_058 : 388|7@0+ (1,0) [0|100] "dB"  Vector__XXX
 SG_ FRM_32_DetnRCS_058 : 397|15@0+ (0.01,-50) [-50|128] "dBsm"  Vector__XXX
 SG_ FRM_32_DetnQuality_058 : 414|4@0+ (10,0) [0|100] "%"  Vector__XXX
 SG_ FRM_32_DetnMotionSts_059 : 410|2@0+ (1,0) [0|3] ""  Vector__XXX
 SG_ FRM_32_DetnRngRadial_059 : 408|15@0+ (0.01,0) [0|200] "m"  Vector__XXX
 SG_ FRM_32_DetnAziAngle_059 : 425|11@0+ (0.1,-90) [-90|90] "deg"  Vector__XXX
 SG_ FRM_32_DetnElevnAngle_059 : 446|8@0+ (0.1,-10) [-10|10] "deg"  Vector__XXX
 SG_ FRM_32_DetnRelVelRadial_059 : 454|15@0+ (0.01,-100) [-100|80] "m/s"  Vector__XXX
 SG_ FRM_32_DetnSNR_059 : 471|7@0+ (1,0) [0|100] "dB"  Vector__XXX
 SG_ FRM_32_DetnRCS_059 : 464|15@0+ (0.01,-50) [-50|128] "dBsm"  Vector__XXX
 SG_ FRM_32_DetnQuality_059 : 481|4@0+ (10,0) [0|100] "%"  Vector__XXX

BO_ 1004 FRM_33: 64 FRM_FM_4X
 SG_ FRM_33_CRC : 7|16@0+ (1,0) [0|65535] ""  Vector__XXX
 SG_ FRM_33_RollgCntr : 23|8@0+ (1,0) [0|255] ""  Vector__XXX
 SG_ FRM_33_DetnBlockCounter : 27|4@0+ (1,0) [0|15] ""  Vector__XXX
 SG_ FRM_33_DetnMotionSts_060 : 29|2@0+ (1,0) [0|3] ""  Vector__XXX
 SG_ FRM_33_DetnRngRadial_060 : 39|15@0+ (0.01,0) [0|200] "m"  Vector__XXX
 SG_ FRM_33_DetnAziAngle_060 : 40|11@0+ (0.1,-90) [-90|90] "deg"  Vector__XXX
 SG_ FRM_33_DetnElevnAngle_060 : 61|8@0+ (0.1,-10) [-10|10] "deg"  Vector__XXX
 SG_ FRM_33_DetnRelVelRadial_060 : 69|15@0+ (0.01,-100) [-100|80] "m/s"  Vector__XXX
 SG_ FRM_33_DetnSNR_060 : 86|7@0+ (1,0) [0|100] "dB"  Vector__XXX
 SG_ FRM_33_DetnRCS_060 : 95|15@0+ (0.01,-50) [-50|128] "dBsm"  Vector__XXX
 SG_ FRM_33_DetnQuality_060 : 96|4@0+ (10,0) [0|100] "%"  Vector__XXX
 SG_ FRM_33_DetnMotionSts_061 : 31|2@0+ (1,0) [0|3] ""  Vector__XXX
 SG_ FRM_33_DetnRngRadial_061 : 108|15@0+ (0.01,0) [0|200] "m"  Vector__XXX
 SG_ FRM_33_DetnAziAngle_061 : 125|11@0+ (0.1,-90) [-90|90] "deg"  Vector__XXX
 SG_ FRM_33_DetnElevnAngle_061 : 130|8@0+ (0.1,-10) [-10|10] "deg"  Vector__XXX
 SG_ FRM_33_DetnRelVelRadial_061 : 138|15@0+ (0.01,-100) [-100|80] "m/s"  Vector__XXX
 SG_ FRM_33_DetnSNR_061 : 155|7@0+ (1,0) [0|100] "dB"  Vector__XXX
 SG_ FRM_33_DetnRCS_061 : 164|15@0+ (0.01,-50) [-50|128] "dBsm"  Vector__XXX
 SG_ FRM_33_DetnQuality_061 : 181|4@0+ (10,0) [0|100] "%"  Vector__XXX
 SG_ FRM_33_DetnMotionSts_062 : 177|2@0+ (1,0) [0|3] ""  Vector__XXX
 SG_ FRM_33_DetnRngRadial_062 : 191|15@0+ (0.01,0) [0|200] "m"  Vector__XXX
 SG_ FRM_33_DetnAziAngle_062 : 192|11@0+ (0.1,-90) [-90|90] "deg"  Vector__XXX
 SG_ FRM_33_DetnElevnAngle_062 : 213|8@0+ (0.1,-10) [-10|10] "deg"  Vector__XXX
 SG_ FRM_33_DetnRelVelRadial_062 : 221|15@0+ (0.01,-100) [-100|80] "m/s"  Vector__XXX
 SG_ FRM_33_DetnSNR_062 : 238|7@0+ (1,0) [0|100] "dB"  Vector__XXX
 SG_ FRM_33_DetnRCS_062 : 247|15@0+ (0.01,-50) [-50|128] "dBsm"  Vector__XXX
 SG_ FRM_33_DetnQuality_062 : 248|4@0+ (10,0) [0|100] "%"  Vector__XXX
 SG_ FRM_33_DetnMotionSts_063 : 260|2@0+ (1,0) [0|3] ""  Vector__XXX
 SG_ FRM_33_DetnRngRadial_063 : 258|15@0+ (0.01,0) [0|200] "m"  Vector__XXX
 SG_ FRM_33_DetnAziAngle_063 : 275|11@0+ (0.1,-90) [-90|90] "deg"  Vector__XXX
 SG_ FRM_33_DetnElevnAngle_063 : 280|8@0+ (0.1,-10) [-10|10] "deg"  Vector__XXX
 SG_ FRM_33_DetnRelVelRadial_063 : 288|15@0+ (0.01,-100) [-100|80] "m/s"  Vector__XXX
 SG_ FRM_33_DetnSNR_063 : 305|7@0+ (1,0) [0|100] "dB"  Vector__XXX
 SG_ FRM_33_DetnRCS_063 : 314|15@0+ (0.01,-50) [-50|128] "dBsm"  Vector__XXX
 SG_ FRM_33_DetnQuality_063 : 331|4@0+ (10,0) [0|100] "%"  Vector__XXX
 SG_ FRM_33_DetnMotionSts_064 : 343|2@0+ (1,0) [0|3] ""  Vector__XXX
 SG_ FRM_33_DetnRngRadial_064 : 341|15@0+ (0.01,0) [0|200] "m"  Vector__XXX
 SG_ FRM_33_DetnAziAngle_064 : 358|11@0+ (0.1,-90) [-90|90] "deg"  Vector__XXX
 SG_ FRM_33_DetnElevnAngle_064 : 363|8@0+ (0.1,-10) [-10|10] "deg"  Vector__XXX
 SG_ FRM_33_DetnRelVelRadial_064 : 371|15@0+ (0.01,-100) [-100|80] "m/s"  Vector__XXX
 SG_ FRM_33_DetnSNR_064 : 388|7@0+ (1,0) [0|100] "dB"  Vector__XXX
 SG_ FRM_33_DetnRCS_064 : 397|15@0+ (0.01,-50) [-50|128] "dBsm"  Vector__XXX
 SG_ FRM_33_DetnQuality_064 : 414|4@0+ (10,0) [0|100] "%"  Vector__XXX
 SG_ FRM_33_DetnMotionSts_065 : 410|2@0+ (1,0) [0|3] ""  Vector__XXX
 SG_ FRM_33_DetnRngRadial_065 : 408|15@0+ (0.01,0) [0|200] "m"  Vector__XXX
 SG_ FRM_33_DetnAziAngle_065 : 425|11@0+ (0.1,-90) [-90|90] "deg"  Vector__XXX
 SG_ FRM_33_DetnElevnAngle_065 : 446|8@0+ (0.1,-10) [-10|10] "deg"  Vector__XXX
 SG_ FRM_33_DetnRelVelRadial_065 : 454|15@0+ (0.01,-100) [-100|80] "m/s"  Vector__XXX
 SG_ FRM_33_DetnSNR_065 : 471|7@0+ (1,0) [0|100] "dB"  Vector__XXX
 SG_ FRM_33_DetnRCS_065 : 464|15@0+ (0.01,-50) [-50|128] "dBsm"  Vector__XXX
 SG_ FRM_33_DetnQuality_065 : 481|4@0+ (10,0) [0|100] "%"  Vector__XXX

BO_ 1005 FRM_34: 64 FRM_FM_4X
 SG_ FRM_34_CRC : 7|16@0+ (1,0) [0|65535] ""  Vector__XXX
 SG_ FRM_34_RollgCntr : 23|8@0+ (1,0) [0|255] ""  Vector__XXX
 SG_ FRM_34_DetnBlockCounter : 27|4@0+ (1,0) [0|15] ""  Vector__XXX
 SG_ FRM_34_DetnMotionSts_066 : 29|2@0+ (1,0) [0|3] ""  Vector__XXX
 SG_ FRM_34_DetnRngRadial_066 : 39|15@0+ (0.01,0) [0|200] "m"  Vector__XXX
 SG_ FRM_34_DetnAziAngle_066 : 40|11@0+ (0.1,-90) [-90|90] "deg"  Vector__XXX
 SG_ FRM_34_DetnElevnAngle_066 : 61|8@0+ (0.1,-10) [-10|10] "deg"  Vector__XXX
 SG_ FRM_34_DetnRelVelRadial_066 : 69|15@0+ (0.01,-100) [-100|80] "m/s"  Vector__XXX
 SG_ FRM_34_DetnSNR_066 : 86|7@0+ (1,0) [0|100] "dB"  Vector__XXX
 SG_ FRM_34_DetnRCS_066 : 95|15@0+ (0.01,-50) [-50|128] "dBsm"  Vector__XXX
 SG_ FRM_34_DetnQuality_066 : 96|4@0+ (10,0) [0|100] "%"  Vector__XXX
 SG_ FRM_34_DetnMotionSts_067 : 31|2@0+ (1,0) [0|3] ""  Vector__XXX
 SG_ FRM_34_DetnRngRadial_067 : 108|15@0+ (0.01,0) [0|200] "m"  Vector__XXX
 SG_ FRM_34_DetnAziAngle_067 : 125|11@0+ (0.1,-90) [-90|90] "deg"  Vector__XXX
 SG_ FRM_34_DetnElevnAngle_067 : 130|8@0+ (0.1,-10) [-10|10] "deg"  Vector__XXX
 SG_ FRM_34_DetnRelVelRadial_067 : 138|15@0+ (0.01,-100) [-100|80] "m/s"  Vector__XXX
 SG_ FRM_34_DetnSNR_067 : 155|7@0+ (1,0) [0|100] "dB"  Vector__XXX
 SG_ FRM_34_DetnRCS_067 : 164|15@0+ (0.01,-50) [-50|128] "dBsm"  Vector__XXX
 SG_ FRM_34_DetnQuality_067 : 181|4@0+ (10,0) [0|100] "%"  Vector__XXX
 SG_ FRM_34_DetnMotionSts_068 : 177|2@0+ (1,0) [0|3] ""  Vector__XXX
 SG_ FRM_34_DetnRngRadial_068 : 191|15@0+ (0.01,0) [0|200] "m"  Vector__XXX
 SG_ FRM_34_DetnAziAngle_068 : 192|11@0+ (0.1,-90) [-90|90] "deg"  Vector__XXX
 SG_ FRM_34_DetnElevnAngle_068 : 213|8@0+ (0.1,-10) [-10|10] "deg"  Vector__XXX
 SG_ FRM_34_DetnRelVelRadial_068 : 221|15@0+ (0.01,-100) [-100|80] "m/s"  Vector__XXX
 SG_ FRM_34_DetnSNR_068 : 238|7@0+ (1,0) [0|100] "dB"  Vector__XXX
 SG_ FRM_34_DetnRCS_068 : 247|15@0+ (0.01,-50) [-50|128] "dBsm"  Vector__XXX
 SG_ FRM_34_DetnQuality_068 : 248|4@0+ (10,0) [0|100] "%"  Vector__XXX
 SG_ FRM_34_DetnMotionSts_069 : 260|2@0+ (1,0) [0|3] ""  Vector__XXX
 SG_ FRM_34_DetnRngRadial_069 : 258|15@0+ (0.01,0) [0|200] "m"  Vector__XXX
 SG_ FRM_34_DetnAziAngle_069 : 275|11@0+ (0.1,-90) [-90|90] "deg"  Vector__XXX
 SG_ FRM_34_DetnElevnAngle_069 : 280|8@0+ (0.1,-10) [-10|10] "deg"  Vector__XXX
 SG_ FRM_34_DetnRelVelRadial_069 : 288|15@0+ (0.01,-100) [-100|80] "m/s"  Vector__XXX
 SG_ FRM_34_DetnSNR_069 : 305|7@0+ (1,0) [0|100] "dB"  Vector__XXX
 SG_ FRM_34_DetnRCS_069 : 314|15@0+ (0.01,-50) [-50|128] "dBsm"  Vector__XXX
 SG_ FRM_34_DetnQuality_069 : 331|4@0+ (10,0) [0|100] "%"  Vector__XXX
 SG_ FRM_34_DetnMotionSts_070 : 343|2@0+ (1,0) [0|3] ""  Vector__XXX
 SG_ FRM_34_DetnRngRadial_070 : 341|15@0+ (0.01,0) [0|200] "m"  Vector__XXX
 SG_ FRM_34_DetnAziAngle_070 : 358|11@0+ (0.1,-90) [-90|90] "deg"  Vector__XXX
 SG_ FRM_34_DetnElevnAngle_070 : 363|8@0+ (0.1,-10) [-10|10] "deg"  Vector__XXX
 SG_ FRM_34_DetnRelVelRadial_070 : 371|15@0+ (0.01,-100) [-100|80] "m/s"  Vector__XXX
 SG_ FRM_34_DetnSNR_070 : 388|7@0+ (1,0) [0|100] "dB"  Vector__XXX
 SG_ FRM_34_DetnRCS_070 : 397|15@0+ (0.01,-50) [-50|128] "dBsm"  Vector__XXX
 SG_ FRM_34_DetnQuality_070 : 414|4@0+ (10,0) [0|100] "%"  Vector__XXX
 SG_ FRM_34_DetnMotionSts_071 : 410|2@0+ (1,0) [0|3] ""  Vector__XXX
 SG_ FRM_34_DetnRngRadial_071 : 408|15@0+ (0.01,0) [0|200] "m"  Vector__XXX
 SG_ FRM_34_DetnAziAngle_071 : 425|11@0+ (0.1,-90) [-90|90] "deg"  Vector__XXX
 SG_ FRM_34_DetnElevnAngle_071 : 446|8@0+ (0.1,-10) [-10|10] "deg"  Vector__XXX
 SG_ FRM_34_DetnRelVelRadial_071 : 454|15@0+ (0.01,-100) [-100|80] "m/s"  Vector__XXX
 SG_ FRM_34_DetnSNR_071 : 471|7@0+ (1,0) [0|100] "dB"  Vector__XXX
 SG_ FRM_34_DetnRCS_071 : 464|15@0+ (0.01,-50) [-50|128] "dBsm"  Vector__XXX
 SG_ FRM_34_DetnQuality_071 : 481|4@0+ (10,0) [0|100] "%"  Vector__XXX

BO_ 1006 FRM_35: 64 FRM_FM_4X
 SG_ FRM_35_CRC : 7|16@0+ (1,0) [0|65535] ""  Vector__XXX
 SG_ FRM_35_RollgCntr : 23|8@0+ (1,0) [0|255] ""  Vector__XXX
 SG_ FRM_35_DetnBlockCounter : 27|4@0+ (1,0) [0|15] ""  Vector__XXX
 SG_ FRM_35_DetnMotionSts_072 : 29|2@0+ (1,0) [0|3] ""  Vector__XXX
 SG_ FRM_35_DetnRngRadial_072 : 39|15@0+ (0.01,0) [0|200] "m"  Vector__XXX
 SG_ FRM_35_DetnAziAngle_072 : 40|11@0+ (0.1,-90) [-90|90] "deg"  Vector__XXX
 SG_ FRM_35_DetnElevnAngle_072 : 61|8@0+ (0.1,-10) [-10|10] "deg"  Vector__XXX
 SG_ FRM_35_DetnRelVelRadial_072 : 69|15@0+ (0.01,-100) [-100|80] "m/s"  Vector__XXX
 SG_ FRM_35_DetnSNR_072 : 86|7@0+ (1,0) [0|100] "dB"  Vector__XXX
 SG_ FRM_35_DetnRCS_072 : 95|15@0+ (0.01,-50) [-50|128] "dBsm"  Vector__XXX
 SG_ FRM_35_DetnQuality_072 : 96|4@0+ (10,0) [0|100] "%"  Vector__XXX
 SG_ FRM_35_DetnMotionSts_073 : 31|2@0+ (1,0) [0|3] ""  Vector__XXX
 SG_ FRM_35_DetnRngRadial_073 : 108|15@0+ (0.01,0) [0|200] "m"  Vector__XXX
 SG_ FRM_35_DetnAziAngle_073 : 125|11@0+ (0.1,-90) [-90|90] "deg"  Vector__XXX
 SG_ FRM_35_DetnElevnAngle_073 : 130|8@0+ (0.1,-10) [-10|10] "deg"  Vector__XXX
 SG_ FRM_35_DetnRelVelRadial_073 : 138|15@0+ (0.01,-100) [-100|80] "m/s"  Vector__XXX
 SG_ FRM_35_DetnSNR_073 : 155|7@0+ (1,0) [0|100] "dB"  Vector__XXX
 SG_ FRM_35_DetnRCS_073 : 164|15@0+ (0.01,-50) [-50|128] "dBsm"  Vector__XXX
 SG_ FRM_35_DetnQuality_073 : 181|4@0+ (10,0) [0|100] "%"  Vector__XXX
 SG_ FRM_35_DetnMotionSts_074 : 177|2@0+ (1,0) [0|3] ""  Vector__XXX
 SG_ FRM_35_DetnRngRadial_074 : 191|15@0+ (0.01,0) [0|200] "m"  Vector__XXX
 SG_ FRM_35_DetnAziAngle_074 : 192|11@0+ (0.1,-90) [-90|90] "deg"  Vector__XXX
 SG_ FRM_35_DetnElevnAngle_074 : 213|8@0+ (0.1,-10) [-10|10] "deg"  Vector__XXX
 SG_ FRM_35_DetnRelVelRadial_074 : 221|15@0+ (0.01,-100) [-100|80] "m/s"  Vector__XXX
 SG_ FRM_35_DetnSNR_074 : 238|7@0+ (1,0) [0|100] "dB"  Vector__XXX
 SG_ FRM_35_DetnRCS_074 : 247|15@0+ (0.01,-50) [-50|128] "dBsm"  Vector__XXX
 SG_ FRM_35_DetnQuality_074 : 248|4@0+ (10,0) [0|100] "%"  Vector__XXX
 SG_ FRM_35_DetnMotionSts_075 : 260|2@0+ (1,0) [0|3] ""  Vector__XXX
 SG_ FRM_35_DetnRngRadial_075 : 258|15@0+ (0.01,0) [0|200] "m"  Vector__XXX
 SG_ FRM_35_DetnAziAngle_075 : 275|11@0+ (0.1,-90) [-90|90] "deg"  Vector__XXX
 SG_ FRM_35_DetnElevnAngle_075 : 280|8@0+ (0.1,-10) [-10|10] "deg"  Vector__XXX
 SG_ FRM_35_DetnRelVelRadial_075 : 288|15@0+ (0.01,-100) [-100|80] "m/s"  Vector__XXX
 SG_ FRM_35_DetnSNR_075 : 305|7@0+ (1,0) [0|100] "dB"  Vector__XXX
 SG_ FRM_35_DetnRCS_075 : 314|15@0+ (0.01,-50) [-50|128] "dBsm"  Vector__XXX
 SG_ FRM_35_DetnQuality_075 : 331|4@0+ (10,0) [0|100] "%"  Vector__XXX
 SG_ FRM_35_DetnMotionSts_076 : 343|2@0+ (1,0) [0|3] ""  Vector__XXX
 SG_ FRM_35_DetnRngRadial_076 : 341|15@0+ (0.01,0) [0|200] "m"  Vector__XXX
 SG_ FRM_35_DetnAziAngle_076 : 358|11@0+ (0.1,-90) [-90|90] "deg"  Vector__XXX
 SG_ FRM_35_DetnElevnAngle_076 : 363|8@0+ (0.1,-10) [-10|10] "deg"  Vector__XXX
 SG_ FRM_35_DetnRelVelRadial_076 : 371|15@0+ (0.01,-100) [-100|80] "m/s"  Vector__XXX
 SG_ FRM_35_DetnSNR_076 : 388|7@0+ (1,0) [0|100] "dB"  Vector__XXX
 SG_ FRM_35_DetnRCS_076 : 397|15@0+ (0.01,-50) [-50|128] "dBsm"  Vector__XXX
 SG_ FRM_35_DetnQuality_076 : 414|4@0+ (10,0) [0|100] "%"  Vector__XXX
 SG_ FRM_35_DetnMotionSts_077 : 410|2@0+ (1,0) [0|3] ""  Vector__XXX
 SG_ FRM_35_DetnRngRadial_077 : 408|15@0+ (0.01,0) [0|200] "m"  Vector__XXX
 SG_ FRM_35_DetnAziAngle_077 : 425|11@0+ (0.1,-90) [-90|90] "deg"  Vector__XXX
 SG_ FRM_35_DetnElevnAngle_077 : 446|8@0+ (0.1,-10) [-10|10] "deg"  Vector__XXX
 SG_ FRM_35_DetnRelVelRadial_077 : 454|15@0+ (0.01,-100) [-100|80] "m/s"  Vector__XXX
 SG_ FRM_35_DetnSNR_077 : 471|7@0+ (1,0) [0|100] "dB"  Vector__XXX
 SG_ FRM_35_DetnRCS_077 : 464|15@0+ (0.01,-50) [-50|128] "dBsm"  Vector__XXX
 SG_ FRM_35_DetnQuality_077 : 481|4@0+ (10,0) [0|100] "%"  Vector__XXX

BO_ 1007 FRM_36: 64 FRM_FM_4X
 SG_ FRM_36_CRC : 7|16@0+ (1,0) [0|65535] ""  Vector__XXX
 SG_ FRM_36_RollgCntr : 23|8@0+ (1,0) [0|255] ""  Vector__XXX
 SG_ FRM_36_DetnBlockCounter : 27|4@0+ (1,0) [0|15] ""  Vector__XXX
 SG_ FRM_36_DetnMotionSts_078 : 29|2@0+ (1,0) [0|3] ""  Vector__XXX
 SG_ FRM_36_DetnRngRadial_078 : 39|15@0+ (0.01,0) [0|200] "m"  Vector__XXX
 SG_ FRM_36_DetnAziAngle_078 : 40|11@0+ (0.1,-90) [-90|90] "deg"  Vector__XXX
 SG_ FRM_36_DetnElevnAngle_078 : 61|8@0+ (0.1,-10) [-10|10] "deg"  Vector__XXX
 SG_ FRM_36_DetnRelVelRadial_078 : 69|15@0+ (0.01,-100) [-100|80] "m/s"  Vector__XXX
 SG_ FRM_36_DetnSNR_078 : 86|7@0+ (1,0) [0|100] "dB"  Vector__XXX
 SG_ FRM_36_DetnRCS_078 : 95|15@0+ (0.01,-50) [-50|128] "dBsm"  Vector__XXX
 SG_ FRM_36_DetnQuality_078 : 96|4@0+ (10,0) [0|100] "%"  Vector__XXX
 SG_ FRM_36_DetnMotionSts_079 : 31|2@0+ (1,0) [0|3] ""  Vector__XXX
 SG_ FRM_36_DetnRngRadial_079 : 108|15@0+ (0.01,0) [0|200] "m"  Vector__XXX
 SG_ FRM_36_DetnAziAngle_079 : 125|11@0+ (0.1,-90) [-90|90] "deg"  Vector__XXX
 SG_ FRM_36_DetnElevnAngle_079 : 130|8@0+ (0.1,-10) [-10|10] "deg"  Vector__XXX
 SG_ FRM_36_DetnRelVelRadial_079 : 138|15@0+ (0.01,-100) [-100|80] "m/s"  Vector__XXX
 SG_ FRM_36_DetnSNR_079 : 155|7@0+ (1,0) [0|100] "dB"  Vector__XXX
 SG_ FRM_36_DetnRCS_079 : 164|15@0+ (0.01,-50) [-50|128] "dBsm"  Vector__XXX
 SG_ FRM_36_DetnQuality_079 : 181|4@0+ (10,0) [0|100] "%"  Vector__XXX
 SG_ FRM_36_DetnMotionSts_080 : 177|2@0+ (1,0) [0|3] ""  Vector__XXX
 SG_ FRM_36_DetnRngRadial_080 : 191|15@0+ (0.01,0) [0|200] "m"  Vector__XXX
 SG_ FRM_36_DetnAziAngle_080 : 192|11@0+ (0.1,-90) [-90|90] "deg"  Vector__XXX
 SG_ FRM_36_DetnElevnAngle_080 : 213|8@0+ (0.1,-10) [-10|10] "deg"  Vector__XXX
 SG_ FRM_36_DetnRelVelRadial_080 : 221|15@0+ (0.01,-100) [-100|80] "m/s"  Vector__XXX
 SG_ FRM_36_DetnSNR_080 : 238|7@0+ (1,0) [0|100] "dB"  Vector__XXX
 SG_ FRM_36_DetnRCS_080 : 247|15@0+ (0.01,-50) [-50|128] "dBsm"  Vector__XXX
 SG_ FRM_36_DetnQuality_080 : 248|4@0+ (10,0) [0|100] "%"  Vector__XXX
 SG_ FRM_36_DetnMotionSts_081 : 260|2@0+ (1,0) [0|3] ""  Vector__XXX
 SG_ FRM_36_DetnRngRadial_081 : 258|15@0+ (0.01,0) [0|200] "m"  Vector__XXX
 SG_ FRM_36_DetnAziAngle_081 : 275|11@0+ (0.1,-90) [-90|90] "deg"  Vector__XXX
 SG_ FRM_36_DetnElevnAngle_081 : 280|8@0+ (0.1,-10) [-10|10] "deg"  Vector__XXX
 SG_ FRM_36_DetnRelVelRadial_081 : 288|15@0+ (0.01,-100) [-100|80] "m/s"  Vector__XXX
 SG_ FRM_36_DetnSNR_081 : 305|7@0+ (1,0) [0|100] "dB"  Vector__XXX
 SG_ FRM_36_DetnRCS_081 : 314|15@0+ (0.01,-50) [-50|128] "dBsm"  Vector__XXX
 SG_ FRM_36_DetnQuality_081 : 331|4@0+ (10,0) [0|100] "%"  Vector__XXX
 SG_ FRM_36_DetnMotionSts_082 : 343|2@0+ (1,0) [0|3] ""  Vector__XXX
 SG_ FRM_36_DetnRngRadial_082 : 341|15@0+ (0.01,0) [0|200] "m"  Vector__XXX
 SG_ FRM_36_DetnAziAngle_082 : 358|11@0+ (0.1,-90) [-90|90] "deg"  Vector__XXX
 SG_ FRM_36_DetnElevnAngle_082 : 363|8@0+ (0.1,-10) [-10|10] "deg"  Vector__XXX
 SG_ FRM_36_DetnRelVelRadial_082 : 371|15@0+ (0.01,-100) [-100|80] "m/s"  Vector__XXX
 SG_ FRM_36_DetnSNR_082 : 388|7@0+ (1,0) [0|100] "dB"  Vector__XXX
 SG_ FRM_36_DetnRCS_082 : 397|15@0+ (0.01,-50) [-50|128] "dBsm"  Vector__XXX
 SG_ FRM_36_DetnQuality_082 : 414|4@0+ (10,0) [0|100] "%"  Vector__XXX
 SG_ FRM_36_DetnMotionSts_083 : 410|2@0+ (1,0) [0|3] ""  Vector__XXX
 SG_ FRM_36_DetnRngRadial_083 : 408|15@0+ (0.01,0) [0|200] "m"  Vector__XXX
 SG_ FRM_36_DetnAziAngle_083 : 425|11@0+ (0.1,-90) [-90|90] "deg"  Vector__XXX
 SG_ FRM_36_DetnElevnAngle_083 : 446|8@0+ (0.1,-10) [-10|10] "deg"  Vector__XXX
 SG_ FRM_36_DetnRelVelRadial_083 : 454|15@0+ (0.01,-100) [-100|80] "m/s"  Vector__XXX
 SG_ FRM_36_DetnSNR_083 : 471|7@0+ (1,0) [0|100] "dB"  Vector__XXX
 SG_ FRM_36_DetnRCS_083 : 464|15@0+ (0.01,-50) [-50|128] "dBsm"  Vector__XXX
 SG_ FRM_36_DetnQuality_083 : 481|4@0+ (10,0) [0|100] "%"  Vector__XXX

BO_ 1008 FRM_37: 64 FRM_FM_4X
 SG_ FRM_37_CRC : 7|16@0+ (1,0) [0|65535] ""  Vector__XXX
 SG_ FRM_37_RollgCntr : 23|8@0+ (1,0) [0|255] ""  Vector__XXX
 SG_ FRM_37_DetnBlockCounter : 27|4@0+ (1,0) [0|15] ""  Vector__XXX
 SG_ FRM_37_DetnMotionSts_084 : 29|2@0+ (1,0) [0|3] ""  Vector__XXX
 SG_ FRM_37_DetnRngRadial_084 : 39|15@0+ (0.01,0) [0|200] "m"  Vector__XXX
 SG_ FRM_37_DetnAziAngle_084 : 40|11@0+ (0.1,-90) [-90|90] "deg"  Vector__XXX
 SG_ FRM_37_DetnElevnAngle_084 : 61|8@0+ (0.1,-10) [-10|10] "deg"  Vector__XXX
 SG_ FRM_37_DetnRelVelRadial_084 : 69|15@0+ (0.01,-100) [-100|80] "m/s"  Vector__XXX
 SG_ FRM_37_DetnSNR_084 : 86|7@0+ (1,0) [0|100] "dB"  Vector__XXX
 SG_ FRM_37_DetnRCS_084 : 95|15@0+ (0.01,-50) [-50|128] "dBsm"  Vector__XXX
 SG_ FRM_37_DetnQuality_084 : 96|4@0+ (10,0) [0|100] "%"  Vector__XXX
 SG_ FRM_37_DetnMotionSts_085 : 31|2@0+ (1,0) [0|3] ""  Vector__XXX
 SG_ FRM_37_DetnRngRadial_085 : 108|15@0+ (0.01,0) [0|200] "m"  Vector__XXX
 SG_ FRM_37_DetnAziAngle_085 : 125|11@0+ (0.1,-90) [-90|90] "deg"  Vector__XXX
 SG_ FRM_37_DetnElevnAngle_085 : 130|8@0+ (0.1,-10) [-10|10] "deg"  Vector__XXX
 SG_ FRM_37_DetnRelVelRadial_085 : 138|15@0+ (0.01,-100) [-100|80] "m/s"  Vector__XXX
 SG_ FRM_37_DetnSNR_085 : 155|7@0+ (1,0) [0|100] "dB"  Vector__XXX
 SG_ FRM_37_DetnRCS_085 : 164|15@0+ (0.01,-50) [-50|128] "dBsm"  Vector__XXX
 SG_ FRM_37_DetnQuality_085 : 181|4@0+ (10,0) [0|100] "%"  Vector__XXX
 SG_ FRM_37_DetnMotionSts_086 : 177|2@0+ (1,0) [0|3] ""  Vector__XXX
 SG_ FRM_37_DetnRngRadial_086 : 191|15@0+ (0.01,0) [0|200] "m"  Vector__XXX
 SG_ FRM_37_DetnAziAngle_086 : 192|11@0+ (0.1,-90) [-90|90] "deg"  Vector__XXX
 SG_ FRM_37_DetnElevnAngle_086 : 213|8@0+ (0.1,-10) [-10|10] "deg"  Vector__XXX
 SG_ FRM_37_DetnRelVelRadial_086 : 221|15@0+ (0.01,-100) [-100|80] "m/s"  Vector__XXX
 SG_ FRM_37_DetnSNR_086 : 238|7@0+ (1,0) [0|100] "dB"  Vector__XXX
 SG_ FRM_37_DetnRCS_086 : 247|15@0+ (0.01,-50) [-50|128] "dBsm"  Vector__XXX
 SG_ FRM_37_DetnQuality_086 : 248|4@0+ (10,0) [0|100] "%"  Vector__XXX
 SG_ FRM_37_DetnMotionSts_087 : 260|2@0+ (1,0) [0|3] ""  Vector__XXX
 SG_ FRM_37_DetnRngRadial_087 : 258|15@0+ (0.01,0) [0|200] "m"  Vector__XXX
 SG_ FRM_37_DetnAziAngle_087 : 275|11@0+ (0.1,-90) [-90|90] "deg"  Vector__XXX
 SG_ FRM_37_DetnElevnAngle_087 : 280|8@0+ (0.1,-10) [-10|10] "deg"  Vector__XXX
 SG_ FRM_37_DetnRelVelRadial_087 : 288|15@0+ (0.01,-100) [-100|80] "m/s"  Vector__XXX
 SG_ FRM_37_DetnSNR_087 : 305|7@0+ (1,0) [0|100] "dB"  Vector__XXX
 SG_ FRM_37_DetnRCS_087 : 314|15@0+ (0.01,-50) [-50|128] "dBsm"  Vector__XXX
 SG_ FRM_37_DetnQuality_087 : 331|4@0+ (10,0) [0|100] "%"  Vector__XXX
 SG_ FRM_37_DetnMotionSts_088 : 343|2@0+ (1,0) [0|3] ""  Vector__XXX
 SG_ FRM_37_DetnRngRadial_088 : 341|15@0+ (0.01,0) [0|200] "m"  Vector__XXX
 SG_ FRM_37_DetnAziAngle_088 : 358|11@0+ (0.1,-90) [-90|90] "deg"  Vector__XXX
 SG_ FRM_37_DetnElevnAngle_088 : 363|8@0+ (0.1,-10) [-10|10] "deg"  Vector__XXX
 SG_ FRM_37_DetnRelVelRadial_088 : 371|15@0+ (0.01,-100) [-100|80] "m/s"  Vector__XXX
 SG_ FRM_37_DetnSNR_088 : 388|7@0+ (1,0) [0|100] "dB"  Vector__XXX
 SG_ FRM_37_DetnRCS_088 : 397|15@0+ (0.01,-50) [-50|128] "dBsm"  Vector__XXX
 SG_ FRM_37_DetnQuality_088 : 414|4@0+ (10,0) [0|100] "%"  Vector__XXX
 SG_ FRM_37_DetnMotionSts_089 : 410|2@0+ (1,0) [0|3] ""  Vector__XXX
 SG_ FRM_37_DetnRngRadial_089 : 408|15@0+ (0.01,0) [0|200] "m"  Vector__XXX
 SG_ FRM_37_DetnAziAngle_089 : 425|11@0+ (0.1,-90) [-90|90] "deg"  Vector__XXX
 SG_ FRM_37_DetnElevnAngle_089 : 446|8@0+ (0.1,-10) [-10|10] "deg"  Vector__XXX
 SG_ FRM_37_DetnRelVelRadial_089 : 454|15@0+ (0.01,-100) [-100|80] "m/s"  Vector__XXX
 SG_ FRM_37_DetnSNR_089 : 471|7@0+ (1,0) [0|100] "dB"  Vector__XXX
 SG_ FRM_37_DetnRCS_089 : 464|15@0+ (0.01,-50) [-50|128] "dBsm"  Vector__XXX
 SG_ FRM_37_DetnQuality_089 : 481|4@0+ (10,0) [0|100] "%"  Vector__XXX

BO_ 1009 FRM_38: 64 FRM_FM_4X
 SG_ FRM_38_CRC : 7|16@0+ (1,0) [0|65535] ""  Vector__XXX
 SG_ FRM_38_RollgCntr : 23|8@0+ (1,0) [0|255] ""  Vector__XXX
 SG_ FRM_38_DetnBlockCounter : 27|4@0+ (1,0) [0|15] ""  Vector__XXX
 SG_ FRM_38_DetnMotionSts_090 : 29|2@0+ (1,0) [0|3] ""  Vector__XXX
 SG_ FRM_38_DetnRngRadial_090 : 39|15@0+ (0.01,0) [0|200] "m"  Vector__XXX
 SG_ FRM_38_DetnAziAngle_090 : 40|11@0+ (0.1,-90) [-90|90] "deg"  Vector__XXX
 SG_ FRM_38_DetnElevnAngle_090 : 61|8@0+ (0.1,-10) [-10|10] "deg"  Vector__XXX
 SG_ FRM_38_DetnRelVelRadial_090 : 69|15@0+ (0.01,-100) [-100|80] "m/s"  Vector__XXX
 SG_ FRM_38_DetnSNR_090 : 86|7@0+ (1,0) [0|100] "dB"  Vector__XXX
 SG_ FRM_38_DetnRCS_090 : 95|15@0+ (0.01,-50) [-50|128] "dBsm"  Vector__XXX
 SG_ FRM_38_DetnQuality_090 : 96|4@0+ (10,0) [0|100] "%"  Vector__XXX
 SG_ FRM_38_DetnMotionSts_091 : 31|2@0+ (1,0) [0|3] ""  Vector__XXX
 SG_ FRM_38_DetnRngRadial_091 : 108|15@0+ (0.01,0) [0|200] "m"  Vector__XXX
 SG_ FRM_38_DetnAziAngle_091 : 125|11@0+ (0.1,-90) [-90|90] "deg"  Vector__XXX
 SG_ FRM_38_DetnElevnAngle_091 : 130|8@0+ (0.1,-10) [-10|10] "deg"  Vector__XXX
 SG_ FRM_38_DetnRelVelRadial_091 : 138|15@0+ (0.01,-100) [-100|80] "m/s"  Vector__XXX
 SG_ FRM_38_DetnSNR_091 : 155|7@0+ (1,0) [0|100] "dB"  Vector__XXX
 SG_ FRM_38_DetnRCS_091 : 164|15@0+ (0.01,-50) [-50|128] "dBsm"  Vector__XXX
 SG_ FRM_38_DetnQuality_091 : 181|4@0+ (10,0) [0|100] "%"  Vector__XXX
 SG_ FRM_38_DetnMotionSts_092 : 177|2@0+ (1,0) [0|3] ""  Vector__XXX
 SG_ FRM_38_DetnRngRadial_092 : 191|15@0+ (0.01,0) [0|200] "m"  Vector__XXX
 SG_ FRM_38_DetnAziAngle_092 : 192|11@0+ (0.1,-90) [-90|90] "deg"  Vector__XXX
 SG_ FRM_38_DetnElevnAngle_092 : 213|8@0+ (0.1,-10) [-10|10] "deg"  Vector__XXX
 SG_ FRM_38_DetnRelVelRadial_092 : 221|15@0+ (0.01,-100) [-100|80] "m/s"  Vector__XXX
 SG_ FRM_38_DetnSNR_092 : 238|7@0+ (1,0) [0|100] "dB"  Vector__XXX
 SG_ FRM_38_DetnRCS_092 : 247|15@0+ (0.01,-50) [-50|128] "dBsm"  Vector__XXX
 SG_ FRM_38_DetnQuality_092 : 248|4@0+ (10,0) [0|100] "%"  Vector__XXX
 SG_ FRM_38_DetnMotionSts_093 : 260|2@0+ (1,0) [0|3] ""  Vector__XXX
 SG_ FRM_38_DetnRngRadial_093 : 258|15@0+ (0.01,0) [0|200] "m"  Vector__XXX
 SG_ FRM_38_DetnAziAngle_093 : 275|11@0+ (0.1,-90) [-90|90] "deg"  Vector__XXX
 SG_ FRM_38_DetnElevnAngle_093 : 280|8@0+ (0.1,-10) [-10|10] "deg"  Vector__XXX
 SG_ FRM_38_DetnRelVelRadial_093 : 288|15@0+ (0.01,-100) [-100|80] "m/s"  Vector__XXX
 SG_ FRM_38_DetnSNR_093 : 305|7@0+ (1,0) [0|100] "dB"  Vector__XXX
 SG_ FRM_38_DetnRCS_093 : 314|15@0+ (0.01,-50) [-50|128] "dBsm"  Vector__XXX
 SG_ FRM_38_DetnQuality_093 : 331|4@0+ (10,0) [0|100] "%"  Vector__XXX
 SG_ FRM_38_DetnMotionSts_094 : 343|2@0+ (1,0) [0|3] ""  Vector__XXX
 SG_ FRM_38_DetnRngRadial_094 : 341|15@0+ (0.01,0) [0|200] "m"  Vector__XXX
 SG_ FRM_38_DetnAziAngle_094 : 358|11@0+ (0.1,-90) [-90|90] "deg"  Vector__XXX
 SG_ FRM_38_DetnElevnAngle_094 : 363|8@0+ (0.1,-10) [-10|10] "deg"  Vector__XXX
 SG_ FRM_38_DetnRelVelRadial_094 : 371|15@0+ (0.01,-100) [-100|80] "m/s"  Vector__XXX
 SG_ FRM_38_DetnSNR_094 : 388|7@0+ (1,0) [0|100] "dB"  Vector__XXX
 SG_ FRM_38_DetnRCS_094 : 397|15@0+ (0.01,-50) [-50|128] "dBsm"  Vector__XXX
 SG_ FRM_38_DetnQuality_094 : 414|4@0+ (10,0) [0|100] "%"  Vector__XXX
 SG_ FRM_38_DetnMotionSts_095 : 410|2@0+ (1,0) [0|3] ""  Vector__XXX
 SG_ FRM_38_DetnRngRadial_095 : 408|15@0+ (0.01,0) [0|200] "m"  Vector__XXX
 SG_ FRM_38_DetnAziAngle_095 : 425|11@0+ (0.1,-90) [-90|90] "deg"  Vector__XXX
 SG_ FRM_38_DetnElevnAngle_095 : 446|8@0+ (0.1,-10) [-10|10] "deg"  Vector__XXX
 SG_ FRM_38_DetnRelVelRadial_095 : 454|15@0+ (0.01,-100) [-100|80] "m/s"  Vector__XXX
 SG_ FRM_38_DetnSNR_095 : 471|7@0+ (1,0) [0|100] "dB"  Vector__XXX
 SG_ FRM_38_DetnRCS_095 : 464|15@0+ (0.01,-50) [-50|128] "dBsm"  Vector__XXX
 SG_ FRM_38_DetnQuality_095 : 481|4@0+ (10,0) [0|100] "%"  Vector__XXX

BO_ 1010 FRM_39: 64 FRM_FM_4X
 SG_ FRM_39_CRC : 7|16@0+ (1,0) [0|65535] ""  Vector__XXX
 SG_ FRM_39_RollgCntr : 23|8@0+ (1,0) [0|255] ""  Vector__XXX
 SG_ FRM_39_DetnBlockCounter : 27|4@0+ (1,0) [0|15] ""  Vector__XXX
 SG_ FRM_39_DetnMotionSts_096 : 29|2@0+ (1,0) [0|3] ""  Vector__XXX
 SG_ FRM_39_DetnRngRadial_096 : 39|15@0+ (0.01,0) [0|200] "m"  Vector__XXX
 SG_ FRM_39_DetnAziAngle_096 : 40|11@0+ (0.1,-90) [-90|90] "deg"  Vector__XXX
 SG_ FRM_39_DetnElevnAngle_096 : 61|8@0+ (0.1,-10) [-10|10] "deg"  Vector__XXX
 SG_ FRM_39_DetnRelVelRadial_096 : 69|15@0+ (0.01,-100) [-100|80] "m/s"  Vector__XXX
 SG_ FRM_39_DetnSNR_096 : 86|7@0+ (1,0) [0|100] "dB"  Vector__XXX
 SG_ FRM_39_DetnRCS_096 : 95|15@0+ (0.01,-50) [-50|128] "dBsm"  Vector__XXX
 SG_ FRM_39_DetnQuality_096 : 96|4@0+ (10,0) [0|100] "%"  Vector__XXX
 SG_ FRM_39_DetnMotionSts_097 : 31|2@0+ (1,0) [0|3] ""  Vector__XXX
 SG_ FRM_39_DetnRngRadial_097 : 108|15@0+ (0.01,0) [0|200] "m"  Vector__XXX
 SG_ FRM_39_DetnAziAngle_097 : 125|11@0+ (0.1,-90) [-90|90] "deg"  Vector__XXX
 SG_ FRM_39_DetnElevnAngle_097 : 130|8@0+ (0.1,-10) [-10|10] "deg"  Vector__XXX
 SG_ FRM_39_DetnRelVelRadial_097 : 138|15@0+ (0.01,-100) [-100|80] "m/s"  Vector__XXX
 SG_ FRM_39_DetnSNR_097 : 155|7@0+ (1,0) [0|100] "dB"  Vector__XXX
 SG_ FRM_39_DetnRCS_097 : 164|15@0+ (0.01,-50) [-50|128] "dBsm"  Vector__XXX
 SG_ FRM_39_DetnQuality_097 : 181|4@0+ (10,0) [0|100] "%"  Vector__XXX
 SG_ FRM_39_DetnMotionSts_098 : 177|2@0+ (1,0) [0|3] ""  Vector__XXX
 SG_ FRM_39_DetnRngRadial_098 : 191|15@0+ (0.01,0) [0|200] "m"  Vector__XXX
 SG_ FRM_39_DetnAziAngle_098 : 192|11@0+ (0.1,-90) [-90|90] "deg"  Vector__XXX
 SG_ FRM_39_DetnElevnAngle_098 : 213|8@0+ (0.1,-10) [-10|10] "deg"  Vector__XXX
 SG_ FRM_39_DetnRelVelRadial_098 : 221|15@0+ (0.01,-100) [-100|80] "m/s"  Vector__XXX
 SG_ FRM_39_DetnSNR_098 : 238|7@0+ (1,0) [0|100] "dB"  Vector__XXX
 SG_ FRM_39_DetnRCS_098 : 247|15@0+ (0.01,-50) [-50|128] "dBsm"  Vector__XXX
 SG_ FRM_39_DetnQuality_098 : 248|4@0+ (10,0) [0|100] "%"  Vector__XXX
 SG_ FRM_39_DetnMotionSts_099 : 260|2@0+ (1,0) [0|3] ""  Vector__XXX
 SG_ FRM_39_DetnRngRadial_099 : 258|15@0+ (0.01,0) [0|200] "m"  Vector__XXX
 SG_ FRM_39_DetnAziAngle_099 : 275|11@0+ (0.1,-90) [-90|90] "deg"  Vector__XXX
 SG_ FRM_39_DetnElevnAngle_099 : 280|8@0+ (0.1,-10) [-10|10] "deg"  Vector__XXX
 SG_ FRM_39_DetnRelVelRadial_099 : 288|15@0+ (0.01,-100) [-100|80] "m/s"  Vector__XXX
 SG_ FRM_39_DetnSNR_099 : 305|7@0+ (1,0) [0|100] "dB"  Vector__XXX
 SG_ FRM_39_DetnRCS_099 : 314|15@0+ (0.01,-50) [-50|128] "dBsm"  Vector__XXX
 SG_ FRM_39_DetnQuality_099 : 331|4@0+ (10,0) [0|100] "%"  Vector__XXX
 SG_ FRM_39_DetnMotionSts_100 : 343|2@0+ (1,0) [0|3] ""  Vector__XXX
 SG_ FRM_39_DetnRngRadial_100 : 341|15@0+ (0.01,0) [0|200] "m"  Vector__XXX
 SG_ FRM_39_DetnAziAngle_100 : 358|11@0+ (0.1,-90) [-90|90] "deg"  Vector__XXX
 SG_ FRM_39_DetnElevnAngle_100 : 363|8@0+ (0.1,-10) [-10|10] "deg"  Vector__XXX
 SG_ FRM_39_DetnRelVelRadial_100 : 371|15@0+ (0.01,-100) [-100|80] "m/s"  Vector__XXX
 SG_ FRM_39_DetnSNR_100 : 388|7@0+ (1,0) [0|100] "dB"  Vector__XXX
 SG_ FRM_39_DetnRCS_100 : 397|15@0+ (0.01,-50) [-50|128] "dBsm"  Vector__XXX
 SG_ FRM_39_DetnQuality_100 : 414|4@0+ (10,0) [0|100] "%"  Vector__XXX
 SG_ FRM_39_DetnMotionSts_101 : 410|2@0+ (1,0) [0|3] ""  Vector__XXX
 SG_ FRM_39_DetnRngRadial_101 : 408|15@0+ (0.01,0) [0|200] "m"  Vector__XXX
 SG_ FRM_39_DetnAziAngle_101 : 425|11@0+ (0.1,-90) [-90|90] "deg"  Vector__XXX
 SG_ FRM_39_DetnElevnAngle_101 : 446|8@0+ (0.1,-10) [-10|10] "deg"  Vector__XXX
 SG_ FRM_39_DetnRelVelRadial_101 : 454|15@0+ (0.01,-100) [-100|80] "m/s"  Vector__XXX
 SG_ FRM_39_DetnSNR_101 : 471|7@0+ (1,0) [0|100] "dB"  Vector__XXX
 SG_ FRM_39_DetnRCS_101 : 464|15@0+ (0.01,-50) [-50|128] "dBsm"  Vector__XXX
 SG_ FRM_39_DetnQuality_101 : 481|4@0+ (10,0) [0|100] "%"  Vector__XXX

BO_ 1011 FRM_40: 64 FRM_FM_4X
 SG_ FRM_40_CRC : 7|16@0+ (1,0) [0|65535] ""  Vector__XXX
 SG_ FRM_40_RollgCntr : 23|8@0+ (1,0) [0|255] ""  Vector__XXX
 SG_ FRM_40_DetnBlockCounter : 27|4@0+ (1,0) [0|15] ""  Vector__XXX
 SG_ FRM_40_DetnMotionSts_102 : 29|2@0+ (1,0) [0|3] ""  Vector__XXX
 SG_ FRM_40_DetnRngRadial_102 : 39|15@0+ (0.01,0) [0|200] "m"  Vector__XXX
 SG_ FRM_40_DetnAziAngle_102 : 40|11@0+ (0.1,-90) [-90|90] "deg"  Vector__XXX
 SG_ FRM_40_DetnElevnAngle_102 : 61|8@0+ (0.1,-10) [-10|10] "deg"  Vector__XXX
 SG_ FRM_40_DetnRelVelRadial_102 : 69|15@0+ (0.01,-100) [-100|80] "m/s"  Vector__XXX
 SG_ FRM_40_DetnSNR_102 : 86|7@0+ (1,0) [0|100] "dB"  Vector__XXX
 SG_ FRM_40_DetnRCS_102 : 95|15@0+ (0.01,-50) [-50|128] "dBsm"  Vector__XXX
 SG_ FRM_40_DetnQuality_102 : 96|4@0+ (10,0) [0|100] "%"  Vector__XXX
 SG_ FRM_40_DetnMotionSts_103 : 31|2@0+ (1,0) [0|3] ""  Vector__XXX
 SG_ FRM_40_DetnRngRadial_103 : 108|15@0+ (0.01,0) [0|200] "m"  Vector__XXX
 SG_ FRM_40_DetnAziAngle_103 : 125|11@0+ (0.1,-90) [-90|90] "deg"  Vector__XXX
 SG_ FRM_40_DetnElevnAngle_103 : 130|8@0+ (0.1,-10) [-10|10] "deg"  Vector__XXX
 SG_ FRM_40_DetnRelVelRadial_103 : 138|15@0+ (0.01,-100) [-100|80] "m/s"  Vector__XXX
 SG_ FRM_40_DetnSNR_103 : 155|7@0+ (1,0) [0|100] "dB"  Vector__XXX
 SG_ FRM_40_DetnRCS_103 : 164|15@0+ (0.01,-50) [-50|128] "dBsm"  Vector__XXX
 SG_ FRM_40_DetnQuality_103 : 181|4@0+ (10,0) [0|100] "%"  Vector__XXX
 SG_ FRM_40_DetnMotionSts_104 : 177|2@0+ (1,0) [0|3] ""  Vector__XXX
 SG_ FRM_40_DetnRngRadial_104 : 191|15@0+ (0.01,0) [0|200] "m"  Vector__XXX
 SG_ FRM_40_DetnAziAngle_104 : 192|11@0+ (0.1,-90) [-90|90] "deg"  Vector__XXX
 SG_ FRM_40_DetnElevnAngle_104 : 213|8@0+ (0.1,-10) [-10|10] "deg"  Vector__XXX
 SG_ FRM_40_DetnRelVelRadial_104 : 221|15@0+ (0.01,-100) [-100|80] "m/s"  Vector__XXX
 SG_ FRM_40_DetnSNR_104 : 238|7@0+ (1,0) [0|100] "dB"  Vector__XXX
 SG_ FRM_40_DetnRCS_104 : 247|15@0+ (0.01,-50) [-50|128] "dBsm"  Vector__XXX
 SG_ FRM_40_DetnQuality_104 : 248|4@0+ (10,0) [0|100] "%"  Vector__XXX
 SG_ FRM_40_DetnMotionSts_105 : 260|2@0+ (1,0) [0|3] ""  Vector__XXX
 SG_ FRM_40_DetnRngRadial_105 : 258|15@0+ (0.01,0) [0|200] "m"  Vector__XXX
 SG_ FRM_40_DetnAziAngle_105 : 275|11@0+ (0.1,-90) [-90|90] "deg"  Vector__XXX
 SG_ FRM_40_DetnElevnAngle_105 : 280|8@0+ (0.1,-10) [-10|10] "deg"  Vector__XXX
 SG_ FRM_40_DetnRelVelRadial_105 : 288|15@0+ (0.01,-100) [-100|80] "m/s"  Vector__XXX
 SG_ FRM_40_DetnSNR_105 : 305|7@0+ (1,0) [0|100] "dB"  Vector__XXX
 SG_ FRM_40_DetnRCS_105 : 314|15@0+ (0.01,-50) [-50|128] "dBsm"  Vector__XXX
 SG_ FRM_40_DetnQuality_105 : 331|4@0+ (10,0) [0|100] "%"  Vector__XXX
 SG_ FRM_40_DetnMotionSts_106 : 343|2@0+ (1,0) [0|3] ""  Vector__XXX
 SG_ FRM_40_DetnRngRadial_106 : 341|15@0+ (0.01,0) [0|200] "m"  Vector__XXX
 SG_ FRM_40_DetnAziAngle_106 : 358|11@0+ (0.1,-90) [-90|90] "deg"  Vector__XXX
 SG_ FRM_40_DetnElevnAngle_106 : 363|8@0+ (0.1,-10) [-10|10] "deg"  Vector__XXX
 SG_ FRM_40_DetnRelVelRadial_106 : 371|15@0+ (0.01,-100) [-100|80] "m/s"  Vector__XXX
 SG_ FRM_40_DetnSNR_106 : 388|7@0+ (1,0) [0|100] "dB"  Vector__XXX
 SG_ FRM_40_DetnRCS_106 : 397|15@0+ (0.01,-50) [-50|128] "dBsm"  Vector__XXX
 SG_ FRM_40_DetnQuality_106 : 414|4@0+ (10,0) [0|100] "%"  Vector__XXX
 SG_ FRM_40_DetnMotionSts_107 : 410|2@0+ (1,0) [0|3] ""  Vector__XXX
 SG_ FRM_40_DetnRngRadial_107 : 408|15@0+ (0.01,0) [0|200] "m"  Vector__XXX
 SG_ FRM_40_DetnAziAngle_107 : 425|11@0+ (0.1,-90) [-90|90] "deg"  Vector__XXX
 SG_ FRM_40_DetnElevnAngle_107 : 446|8@0+ (0.1,-10) [-10|10] "deg"  Vector__XXX
 SG_ FRM_40_DetnRelVelRadial_107 : 454|15@0+ (0.01,-100) [-100|80] "m/s"  Vector__XXX
 SG_ FRM_40_DetnSNR_107 : 471|7@0+ (1,0) [0|100] "dB"  Vector__XXX
 SG_ FRM_40_DetnRCS_107 : 464|15@0+ (0.01,-50) [-50|128] "dBsm"  Vector__XXX
 SG_ FRM_40_DetnQuality_107 : 481|4@0+ (10,0) [0|100] "%"  Vector__XXX

BO_ 1012 FRM_41: 64 FRM_FM_4X
 SG_ FRM_41_CRC : 7|16@0+ (1,0) [0|65535] ""  Vector__XXX
 SG_ FRM_41_RollgCntr : 23|8@0+ (1,0) [0|255] ""  Vector__XXX
 SG_ FRM_41_DetnBlockCounter : 27|4@0+ (1,0) [0|15] ""  Vector__XXX
 SG_ FRM_41_DetnMotionSts_108 : 29|2@0+ (1,0) [0|3] ""  Vector__XXX
 SG_ FRM_41_DetnRngRadial_108 : 39|15@0+ (0.01,0) [0|200] "m"  Vector__XXX
 SG_ FRM_41_DetnAziAngle_108 : 40|11@0+ (0.1,-90) [-90|90] "deg"  Vector__XXX
 SG_ FRM_41_DetnElevnAngle_108 : 61|8@0+ (0.1,-10) [-10|10] "deg"  Vector__XXX
 SG_ FRM_41_DetnRelVelRadial_108 : 69|15@0+ (0.01,-100) [-100|80] "m/s"  Vector__XXX
 SG_ FRM_41_DetnSNR_108 : 86|7@0+ (1,0) [0|100] "dB"  Vector__XXX
 SG_ FRM_41_DetnRCS_108 : 95|15@0+ (0.01,-50) [-50|128] "dBsm"  Vector__XXX
 SG_ FRM_41_DetnQuality_108 : 96|4@0+ (10,0) [0|100] "%"  Vector__XXX
 SG_ FRM_41_DetnMotionSts_109 : 31|2@0+ (1,0) [0|3] ""  Vector__XXX
 SG_ FRM_41_DetnRngRadial_109 : 108|15@0+ (0.01,0) [0|200] "m"  Vector__XXX
 SG_ FRM_41_DetnAziAngle_109 : 125|11@0+ (0.1,-90) [-90|90] "deg"  Vector__XXX
 SG_ FRM_41_DetnElevnAngle_109 : 130|8@0+ (0.1,-10) [-10|10] "deg"  Vector__XXX
 SG_ FRM_41_DetnRelVelRadial_109 : 138|15@0+ (0.01,-100) [-100|80] "m/s"  Vector__XXX
 SG_ FRM_41_DetnSNR_109 : 155|7@0+ (1,0) [0|100] "dB"  Vector__XXX
 SG_ FRM_41_DetnRCS_109 : 164|15@0+ (0.01,-50) [-50|128] "dBsm"  Vector__XXX
 SG_ FRM_41_DetnQuality_109 : 181|4@0+ (10,0) [0|100] "%"  Vector__XXX
 SG_ FRM_41_DetnMotionSts_110 : 177|2@0+ (1,0) [0|3] ""  Vector__XXX
 SG_ FRM_41_DetnRngRadial_110 : 191|15@0+ (0.01,0) [0|200] "m"  Vector__XXX
 SG_ FRM_41_DetnAziAngle_110 : 192|11@0+ (0.1,-90) [-90|90] "deg"  Vector__XXX
 SG_ FRM_41_DetnElevnAngle_110 : 213|8@0+ (0.1,-10) [-10|10] "deg"  Vector__XXX
 SG_ FRM_41_DetnRelVelRadial_110 : 221|15@0+ (0.01,-100) [-100|80] "m/s"  Vector__XXX
 SG_ FRM_41_DetnSNR_110 : 238|7@0+ (1,0) [0|100] "dB"  Vector__XXX
 SG_ FRM_41_DetnRCS_110 : 247|15@0+ (0.01,-50) [-50|128] "dBsm"  Vector__XXX
 SG_ FRM_41_DetnQuality_110 : 248|4@0+ (10,0) [0|100] "%"  Vector__XXX
 SG_ FRM_41_DetnMotionSts_111 : 260|2@0+ (1,0) [0|3] ""  Vector__XXX
 SG_ FRM_41_DetnRngRadial_111 : 258|15@0+ (0.01,0) [0|200] "m"  Vector__XXX
 SG_ FRM_41_DetnAziAngle_111 : 275|11@0+ (0.1,-90) [-90|90] "deg"  Vector__XXX
 SG_ FRM_41_DetnElevnAngle_111 : 280|8@0+ (0.1,-10) [-10|10] "deg"  Vector__XXX
 SG_ FRM_41_DetnRelVelRadial_111 : 288|15@0+ (0.01,-100) [-100|80] "m/s"  Vector__XXX
 SG_ FRM_41_DetnSNR_111 : 305|7@0+ (1,0) [0|100] "dB"  Vector__XXX
 SG_ FRM_41_DetnRCS_111 : 314|15@0+ (0.01,-50) [-50|128] "dBsm"  Vector__XXX
 SG_ FRM_41_DetnQuality_111 : 331|4@0+ (10,0) [0|100] "%"  Vector__XXX
 SG_ FRM_41_DetnMotionSts_112 : 343|2@0+ (1,0) [0|3] ""  Vector__XXX
 SG_ FRM_41_DetnRngRadial_112 : 341|15@0+ (0.01,0) [0|200] "m"  Vector__XXX
 SG_ FRM_41_DetnAziAngle_112 : 358|11@0+ (0.1,-90) [-90|90] "deg"  Vector__XXX
 SG_ FRM_41_DetnElevnAngle_112 : 363|8@0+ (0.1,-10) [-10|10] "deg"  Vector__XXX
 SG_ FRM_41_DetnRelVelRadial_112 : 371|15@0+ (0.01,-100) [-100|80] "m/s"  Vector__XXX
 SG_ FRM_41_DetnSNR_112 : 388|7@0+ (1,0) [0|100] "dB"  Vector__XXX
 SG_ FRM_41_DetnRCS_112 : 397|15@0+ (0.01,-50) [-50|128] "dBsm"  Vector__XXX
 SG_ FRM_41_DetnQuality_112 : 414|4@0+ (10,0) [0|100] "%"  Vector__XXX
 SG_ FRM_41_DetnMotionSts_113 : 410|2@0+ (1,0) [0|3] ""  Vector__XXX
 SG_ FRM_41_DetnRngRadial_113 : 408|15@0+ (0.01,0) [0|200] "m"  Vector__XXX
 SG_ FRM_41_DetnAziAngle_113 : 425|11@0+ (0.1,-90) [-90|90] "deg"  Vector__XXX
 SG_ FRM_41_DetnElevnAngle_113 : 446|8@0+ (0.1,-10) [-10|10] "deg"  Vector__XXX
 SG_ FRM_41_DetnRelVelRadial_113 : 454|15@0+ (0.01,-100) [-100|80] "m/s"  Vector__XXX
 SG_ FRM_41_DetnSNR_113 : 471|7@0+ (1,0) [0|100] "dB"  Vector__XXX
 SG_ FRM_41_DetnRCS_113 : 464|15@0+ (0.01,-50) [-50|128] "dBsm"  Vector__XXX
 SG_ FRM_41_DetnQuality_113 : 481|4@0+ (10,0) [0|100] "%"  Vector__XXX

CM_ BO_ 1002 "禾多配置不发此帧报文";
CM_ BO_ 1003 "禾多配置不发此帧报文";
CM_ BO_ 1004 "禾多配置不发此帧报文";
CM_ BO_ 1005 "禾多配置不发此帧报文";
CM_ BO_ 1006 "禾多配置不发此帧报文";
CM_ BO_ 1007 "禾多配置不发此帧报文";
CM_ BO_ 1008 "禾多配置不发此帧报文";
CM_ BO_ 1009 "禾多配置不发此帧报文";
CM_ BO_ 1010 "禾多配置不发此帧报文";
CM_ BO_ 1011 "禾多配置不发此帧报文";
CM_ BO_ 1012 "禾多配置不发此帧报文";
CM_ SG_ 1002 FRM_31_CRC "Profile5:E2E CRC16 (polynomial:0x1021)       
DataID:Use CANID,other bits Fill with 0";
CM_ SG_ 1002 FRM_31_RollgCntr "Profile5:E2E Rolling message counter";
CM_ SG_ 1002 FRM_31_DetnBlockCounter "Front Radar Moudle_X_Detection Block Counter
前雷达探测点块计数";
CM_ SG_ 1002 FRM_31_DetnMotionSts_048 "Detection point motion status
Front Radar Moudle_X_Detection Motion Status
前雷达探测点运动状态";
CM_ SG_ 1002 FRM_31_DetnRngRadial_048 "Detection point radial distance
Front Radar Moudle_X_Detection Range Radial
前雷达探测点径向距离";
CM_ SG_ 1002 FRM_31_DetnAziAngle_048 "Detection point azimuth angle
Front Radar Moudle_X_Detection Azimuth Angle
前雷达探测点水平方位角";
CM_ SG_ 1002 FRM_31_DetnElevnAngle_048 "Detection point elevation angle
Front Radar Moudle_X_Detection Elevation Angle
前雷达探测点俯仰角";
CM_ SG_ 1002 FRM_31_DetnRelVelRadial_048 "Detection point radial relative velocity
Front Radar Moudle_X_Detection Relative Velocity Radial 
前雷达探测点在径向上的相对速度";
CM_ SG_ 1002 FRM_31_DetnSNR_048 "Detection point signal noise ratio
Front Radar Moudle_X_Detection Signal Noise Ratio
前雷达探测点信号噪声比";
CM_ SG_ 1002 FRM_31_DetnRCS_048 "Detection point radar cross section
Front Radar Moudle_X_Detection Radar Cross Section
前雷达探测点雷达散射截面积";
CM_ SG_ 1002 FRM_31_DetnQuality_048 "Detection point quality
Front Radar Moudle_X_Detection Quality
前雷达探测点质量";
CM_ SG_ 1002 FRM_31_DetnMotionSts_049 "Detection point motion status
Front Radar Moudle_X_Detection Motion Status
前雷达探测点运动状态";
CM_ SG_ 1002 FRM_31_DetnRngRadial_049 "Detection point radial distance
Front Radar Moudle_X_Detection Range Radial
前雷达探测点径向距离";
CM_ SG_ 1002 FRM_31_DetnAziAngle_049 "Detection point azimuth angle
Front Radar Moudle_X_Detection Azimuth Angle
前雷达探测点水平方位角";
CM_ SG_ 1002 FRM_31_DetnElevnAngle_049 "Detection point elevation angle
Front Radar Moudle_X_Detection Elevation Angle
前雷达探测点俯仰角";
CM_ SG_ 1002 FRM_31_DetnRelVelRadial_049 "Detection point radial relative velocity
Front Radar Moudle_X_Detection Relative Velocity Radial 
前雷达探测点在径向上的相对速度";
CM_ SG_ 1002 FRM_31_DetnSNR_049 "Detection point signal noise ratio
Front Radar Moudle_X_Detection Signal Noise Ratio
前雷达探测点信号噪声比";
CM_ SG_ 1002 FRM_31_DetnRCS_049 "Detection point radar cross section
Front Radar Moudle_X_Detection Radar Cross Section
前雷达探测点雷达散射截面积";
CM_ SG_ 1002 FRM_31_DetnQuality_049 "Detection point quality
Front Radar Moudle_X_Detection Quality
前雷达探测点质量";
CM_ SG_ 1002 FRM_31_DetnMotionSts_050 "Detection point motion status
Front Radar Moudle_X_Detection Motion Status
前雷达探测点运动状态";
CM_ SG_ 1002 FRM_31_DetnRngRadial_050 "Detection point radial distance
Front Radar Moudle_X_Detection Range Radial
前雷达探测点径向距离";
CM_ SG_ 1002 FRM_31_DetnAziAngle_050 "Detection point azimuth angle
Front Radar Moudle_X_Detection Azimuth Angle
前雷达探测点水平方位角";
CM_ SG_ 1002 FRM_31_DetnElevnAngle_050 "Detection point elevation angle
Front Radar Moudle_X_Detection Elevation Angle
前雷达探测点俯仰角";
CM_ SG_ 1002 FRM_31_DetnRelVelRadial_050 "Detection point radial relative velocity
Front Radar Moudle_X_Detection Relative Velocity Radial 
前雷达探测点在径向上的相对速度";
CM_ SG_ 1002 FRM_31_DetnSNR_050 "Detection point signal noise ratio
Front Radar Moudle_X_Detection Signal Noise Ratio
前雷达探测点信号噪声比";
CM_ SG_ 1002 FRM_31_DetnRCS_050 "Detection point radar cross section
Front Radar Moudle_X_Detection Radar Cross Section
前雷达探测点雷达散射截面积";
CM_ SG_ 1002 FRM_31_DetnQuality_050 "Detection point quality
Front Radar Moudle_X_Detection Quality
前雷达探测点质量";
CM_ SG_ 1002 FRM_31_DetnMotionSts_051 "Detection point motion status
Front Radar Moudle_X_Detection Motion Status
前雷达探测点运动状态";
CM_ SG_ 1002 FRM_31_DetnRngRadial_051 "Detection point radial distance
Front Radar Moudle_X_Detection Range Radial
前雷达探测点径向距离";
CM_ SG_ 1002 FRM_31_DetnAziAngle_051 "Detection point azimuth angle
Front Radar Moudle_X_Detection Azimuth Angle
前雷达探测点水平方位角";
CM_ SG_ 1002 FRM_31_DetnElevnAngle_051 "Detection point elevation angle
Front Radar Moudle_X_Detection Elevation Angle
前雷达探测点俯仰角";
CM_ SG_ 1002 FRM_31_DetnRelVelRadial_051 "Detection point radial relative velocity
Front Radar Moudle_X_Detection Relative Velocity Radial 
前雷达探测点在径向上的相对速度";
CM_ SG_ 1002 FRM_31_DetnSNR_051 "Detection point signal noise ratio
Front Radar Moudle_X_Detection Signal Noise Ratio
前雷达探测点信号噪声比";
CM_ SG_ 1002 FRM_31_DetnRCS_051 "Detection point radar cross section
Front Radar Moudle_X_Detection Radar Cross Section
前雷达探测点雷达散射截面积";
CM_ SG_ 1002 FRM_31_DetnQuality_051 "Detection point quality
Front Radar Moudle_X_Detection Quality
前雷达探测点质量";
CM_ SG_ 1002 FRM_31_DetnMotionSts_052 "Detection point motion status
Front Radar Moudle_X_Detection Motion Status
前雷达探测点运动状态";
CM_ SG_ 1002 FRM_31_DetnRngRadial_052 "Detection point radial distance
Front Radar Moudle_X_Detection Range Radial
前雷达探测点径向距离";
CM_ SG_ 1002 FRM_31_DetnAziAngle_052 "Detection point azimuth angle
Front Radar Moudle_X_Detection Azimuth Angle
前雷达探测点水平方位角";
CM_ SG_ 1002 FRM_31_DetnElevnAngle_052 "Detection point elevation angle
Front Radar Moudle_X_Detection Elevation Angle
前雷达探测点俯仰角";
CM_ SG_ 1002 FRM_31_DetnRelVelRadial_052 "Detection point radial relative velocity
Front Radar Moudle_X_Detection Relative Velocity Radial 
前雷达探测点在径向上的相对速度";
CM_ SG_ 1002 FRM_31_DetnSNR_052 "Detection point signal noise ratio
Front Radar Moudle_X_Detection Signal Noise Ratio
前雷达探测点信号噪声比";
CM_ SG_ 1002 FRM_31_DetnRCS_052 "Detection point radar cross section
Front Radar Moudle_X_Detection Radar Cross Section
前雷达探测点雷达散射截面积";
CM_ SG_ 1002 FRM_31_DetnQuality_052 "Detection point quality
Front Radar Moudle_X_Detection Quality
前雷达探测点质量";
CM_ SG_ 1002 FRM_31_DetnMotionSts_053 "Detection point motion status
Front Radar Moudle_X_Detection Motion Status
前雷达探测点运动状态";
CM_ SG_ 1002 FRM_31_DetnRngRadial_053 "Detection point radial distance
Front Radar Moudle_X_Detection Range Radial
前雷达探测点径向距离";
CM_ SG_ 1002 FRM_31_DetnAziAngle_053 "Detection point azimuth angle
Front Radar Moudle_X_Detection Azimuth Angle
前雷达探测点水平方位角";
CM_ SG_ 1002 FRM_31_DetnElevnAngle_053 "Detection point elevation angle
Front Radar Moudle_X_Detection Elevation Angle
前雷达探测点俯仰角";
CM_ SG_ 1002 FRM_31_DetnRelVelRadial_053 "Detection point radial relative velocity
Front Radar Moudle_X_Detection Relative Velocity Radial 
前雷达探测点在径向上的相对速度";
CM_ SG_ 1002 FRM_31_DetnSNR_053 "Detection point signal noise ratio
Front Radar Moudle_X_Detection Signal Noise Ratio
前雷达探测点信号噪声比";
CM_ SG_ 1002 FRM_31_DetnRCS_053 "Detection point radar cross section
Front Radar Moudle_X_Detection Radar Cross Section
前雷达探测点雷达散射截面积";
CM_ SG_ 1002 FRM_31_DetnQuality_053 "Detection point quality
Front Radar Moudle_X_Detection Quality
前雷达探测点质量";
CM_ SG_ 1003 FRM_32_CRC "Profile5:E2E CRC16 (polynomial:0x1021)       
DataID:Use CANID,other bits Fill with 0";
CM_ SG_ 1003 FRM_32_RollgCntr "Profile5:E2E Rolling message counter";
CM_ SG_ 1003 FRM_32_DetnBlockCounter "Front Radar Moudle_X_Detection Block Counter
前雷达探测点块计数";
CM_ SG_ 1003 FRM_32_DetnMotionSts_054 "Detection point motion status
Front Radar Moudle_X_Detection Motion Status
前雷达探测点运动状态";
CM_ SG_ 1003 FRM_32_DetnRngRadial_054 "Detection point radial distance
Front Radar Moudle_X_Detection Range Radial
前雷达探测点径向距离";
CM_ SG_ 1003 FRM_32_DetnAziAngle_054 "Detection point azimuth angle
Front Radar Moudle_X_Detection Azimuth Angle
前雷达探测点水平方位角";
CM_ SG_ 1003 FRM_32_DetnElevnAngle_054 "Detection point elevation angle
Front Radar Moudle_X_Detection Elevation Angle
前雷达探测点俯仰角";
CM_ SG_ 1003 FRM_32_DetnRelVelRadial_054 "Detection point radial relative velocity
Front Radar Moudle_X_Detection Relative Velocity Radial 
前雷达探测点在径向上的相对速度";
CM_ SG_ 1003 FRM_32_DetnSNR_054 "Detection point signal noise ratio
Front Radar Moudle_X_Detection Signal Noise Ratio
前雷达探测点信号噪声比";
CM_ SG_ 1003 FRM_32_DetnRCS_054 "Detection point radar cross section
Front Radar Moudle_X_Detection Radar Cross Section
前雷达探测点雷达散射截面积";
CM_ SG_ 1003 FRM_32_DetnQuality_054 "Detection point quality
Front Radar Moudle_X_Detection Quality
前雷达探测点质量";
CM_ SG_ 1003 FRM_32_DetnMotionSts_055 "Detection point motion status
Front Radar Moudle_X_Detection Motion Status
前雷达探测点运动状态";
CM_ SG_ 1003 FRM_32_DetnRngRadial_055 "Detection point radial distance
Front Radar Moudle_X_Detection Range Radial
前雷达探测点径向距离";
CM_ SG_ 1003 FRM_32_DetnAziAngle_055 "Detection point azimuth angle
Front Radar Moudle_X_Detection Azimuth Angle
前雷达探测点水平方位角";
CM_ SG_ 1003 FRM_32_DetnElevnAngle_055 "Detection point elevation angle
Front Radar Moudle_X_Detection Elevation Angle
前雷达探测点俯仰角";
CM_ SG_ 1003 FRM_32_DetnRelVelRadial_055 "Detection point radial relative velocity
Front Radar Moudle_X_Detection Relative Velocity Radial 
前雷达探测点在径向上的相对速度";
CM_ SG_ 1003 FRM_32_DetnSNR_055 "Detection point signal noise ratio
Front Radar Moudle_X_Detection Signal Noise Ratio
前雷达探测点信号噪声比";
CM_ SG_ 1003 FRM_32_DetnRCS_055 "Detection point radar cross section
Front Radar Moudle_X_Detection Radar Cross Section
前雷达探测点雷达散射截面积";
CM_ SG_ 1003 FRM_32_DetnQuality_055 "Detection point quality
Front Radar Moudle_X_Detection Quality
前雷达探测点质量";
CM_ SG_ 1003 FRM_32_DetnMotionSts_056 "Detection point motion status
Front Radar Moudle_X_Detection Motion Status
前雷达探测点运动状态";
CM_ SG_ 1003 FRM_32_DetnRngRadial_056 "Detection point radial distance
Front Radar Moudle_X_Detection Range Radial
前雷达探测点径向距离";
CM_ SG_ 1003 FRM_32_DetnAziAngle_056 "Detection point azimuth angle
Front Radar Moudle_X_Detection Azimuth Angle
前雷达探测点水平方位角";
CM_ SG_ 1003 FRM_32_DetnElevnAngle_056 "Detection point elevation angle
Front Radar Moudle_X_Detection Elevation Angle
前雷达探测点俯仰角";
CM_ SG_ 1003 FRM_32_DetnRelVelRadial_056 "Detection point radial relative velocity
Front Radar Moudle_X_Detection Relative Velocity Radial 
前雷达探测点在径向上的相对速度";
CM_ SG_ 1003 FRM_32_DetnSNR_056 "Detection point signal noise ratio
Front Radar Moudle_X_Detection Signal Noise Ratio
前雷达探测点信号噪声比";
CM_ SG_ 1003 FRM_32_DetnRCS_056 "Detection point radar cross section
Front Radar Moudle_X_Detection Radar Cross Section
前雷达探测点雷达散射截面积";
CM_ SG_ 1003 FRM_32_DetnQuality_056 "Detection point quality
Front Radar Moudle_X_Detection Quality
前雷达探测点质量";
CM_ SG_ 1003 FRM_32_DetnMotionSts_057 "Detection point motion status
Front Radar Moudle_X_Detection Motion Status
前雷达探测点运动状态";
CM_ SG_ 1003 FRM_32_DetnRngRadial_057 "Detection point radial distance
Front Radar Moudle_X_Detection Range Radial
前雷达探测点径向距离";
CM_ SG_ 1003 FRM_32_DetnAziAngle_057 "Detection point azimuth angle
Front Radar Moudle_X_Detection Azimuth Angle
前雷达探测点水平方位角";
CM_ SG_ 1003 FRM_32_DetnElevnAngle_057 "Detection point elevation angle
Front Radar Moudle_X_Detection Elevation Angle
前雷达探测点俯仰角";
CM_ SG_ 1003 FRM_32_DetnRelVelRadial_057 "Detection point radial relative velocity
Front Radar Moudle_X_Detection Relative Velocity Radial 
前雷达探测点在径向上的相对速度";
CM_ SG_ 1003 FRM_32_DetnSNR_057 "Detection point signal noise ratio
Front Radar Moudle_X_Detection Signal Noise Ratio
前雷达探测点信号噪声比";
CM_ SG_ 1003 FRM_32_DetnRCS_057 "Detection point radar cross section
Front Radar Moudle_X_Detection Radar Cross Section
前雷达探测点雷达散射截面积";
CM_ SG_ 1003 FRM_32_DetnQuality_057 "Detection point quality
Front Radar Moudle_X_Detection Quality
前雷达探测点质量";
CM_ SG_ 1003 FRM_32_DetnMotionSts_058 "Detection point motion status
Front Radar Moudle_X_Detection Motion Status
前雷达探测点运动状态";
CM_ SG_ 1003 FRM_32_DetnRngRadial_058 "Detection point radial distance
Front Radar Moudle_X_Detection Range Radial
前雷达探测点径向距离";
CM_ SG_ 1003 FRM_32_DetnAziAngle_058 "Detection point azimuth angle
Front Radar Moudle_X_Detection Azimuth Angle
前雷达探测点水平方位角";
CM_ SG_ 1003 FRM_32_DetnElevnAngle_058 "Detection point elevation angle
Front Radar Moudle_X_Detection Elevation Angle
前雷达探测点俯仰角";
CM_ SG_ 1003 FRM_32_DetnRelVelRadial_058 "Detection point radial relative velocity
Front Radar Moudle_X_Detection Relative Velocity Radial 
前雷达探测点在径向上的相对速度";
CM_ SG_ 1003 FRM_32_DetnSNR_058 "Detection point signal noise ratio
Front Radar Moudle_X_Detection Signal Noise Ratio
前雷达探测点信号噪声比";
CM_ SG_ 1003 FRM_32_DetnRCS_058 "Detection point radar cross section
Front Radar Moudle_X_Detection Radar Cross Section
前雷达探测点雷达散射截面积";
CM_ SG_ 1003 FRM_32_DetnQuality_058 "Detection point quality
Front Radar Moudle_X_Detection Quality
前雷达探测点质量";
CM_ SG_ 1003 FRM_32_DetnMotionSts_059 "Detection point motion status
Front Radar Moudle_X_Detection Motion Status
前雷达探测点运动状态";
CM_ SG_ 1003 FRM_32_DetnRngRadial_059 "Detection point radial distance
Front Radar Moudle_X_Detection Range Radial
前雷达探测点径向距离";
CM_ SG_ 1003 FRM_32_DetnAziAngle_059 "Detection point azimuth angle
Front Radar Moudle_X_Detection Azimuth Angle
前雷达探测点水平方位角";
CM_ SG_ 1003 FRM_32_DetnElevnAngle_059 "Detection point elevation angle
Front Radar Moudle_X_Detection Elevation Angle
前雷达探测点俯仰角";
CM_ SG_ 1003 FRM_32_DetnRelVelRadial_059 "Detection point radial relative velocity
Front Radar Moudle_X_Detection Relative Velocity Radial 
前雷达探测点在径向上的相对速度";
CM_ SG_ 1003 FRM_32_DetnSNR_059 "Detection point signal noise ratio
Front Radar Moudle_X_Detection Signal Noise Ratio
前雷达探测点信号噪声比";
CM_ SG_ 1003 FRM_32_DetnRCS_059 "Detection point radar cross section
Front Radar Moudle_X_Detection Radar Cross Section
前雷达探测点雷达散射截面积";
CM_ SG_ 1003 FRM_32_DetnQuality_059 "Detection point quality
Front Radar Moudle_X_Detection Quality
前雷达探测点质量";
CM_ SG_ 1004 FRM_33_CRC "Profile5:E2E CRC16 (polynomial:0x1021)       
DataID:Use CANID,other bits Fill with 0";
CM_ SG_ 1004 FRM_33_RollgCntr "Profile5:E2E Rolling message counter";
CM_ SG_ 1004 FRM_33_DetnBlockCounter "Front Radar Moudle_X_Detection Block Counter
前雷达探测点块计数";
CM_ SG_ 1004 FRM_33_DetnMotionSts_060 "Detection point motion status
Front Radar Moudle_X_Detection Motion Status
前雷达探测点运动状态";
CM_ SG_ 1004 FRM_33_DetnRngRadial_060 "Detection point radial distance
Front Radar Moudle_X_Detection Range Radial
前雷达探测点径向距离";
CM_ SG_ 1004 FRM_33_DetnAziAngle_060 "Detection point azimuth angle
Front Radar Moudle_X_Detection Azimuth Angle
前雷达探测点水平方位角";
CM_ SG_ 1004 FRM_33_DetnElevnAngle_060 "Detection point elevation angle
Front Radar Moudle_X_Detection Elevation Angle
前雷达探测点俯仰角";
CM_ SG_ 1004 FRM_33_DetnRelVelRadial_060 "Detection point radial relative velocity
Front Radar Moudle_X_Detection Relative Velocity Radial 
前雷达探测点在径向上的相对速度";
CM_ SG_ 1004 FRM_33_DetnSNR_060 "Detection point signal noise ratio
Front Radar Moudle_X_Detection Signal Noise Ratio
前雷达探测点信号噪声比";
CM_ SG_ 1004 FRM_33_DetnRCS_060 "Detection point radar cross section
Front Radar Moudle_X_Detection Radar Cross Section
前雷达探测点雷达散射截面积";
CM_ SG_ 1004 FRM_33_DetnQuality_060 "Detection point quality
Front Radar Moudle_X_Detection Quality
前雷达探测点质量";
CM_ SG_ 1004 FRM_33_DetnMotionSts_061 "Detection point motion status
Front Radar Moudle_X_Detection Motion Status
前雷达探测点运动状态";
CM_ SG_ 1004 FRM_33_DetnRngRadial_061 "Detection point radial distance
Front Radar Moudle_X_Detection Range Radial
前雷达探测点径向距离";
CM_ SG_ 1004 FRM_33_DetnAziAngle_061 "Detection point azimuth angle
Front Radar Moudle_X_Detection Azimuth Angle
前雷达探测点水平方位角";
CM_ SG_ 1004 FRM_33_DetnElevnAngle_061 "Detection point elevation angle
Front Radar Moudle_X_Detection Elevation Angle
前雷达探测点俯仰角";
CM_ SG_ 1004 FRM_33_DetnRelVelRadial_061 "Detection point radial relative velocity
Front Radar Moudle_X_Detection Relative Velocity Radial 
前雷达探测点在径向上的相对速度";
CM_ SG_ 1004 FRM_33_DetnSNR_061 "Detection point signal noise ratio
Front Radar Moudle_X_Detection Signal Noise Ratio
前雷达探测点信号噪声比";
CM_ SG_ 1004 FRM_33_DetnRCS_061 "Detection point radar cross section
Front Radar Moudle_X_Detection Radar Cross Section
前雷达探测点雷达散射截面积";
CM_ SG_ 1004 FRM_33_DetnQuality_061 "Detection point quality
Front Radar Moudle_X_Detection Quality
前雷达探测点质量";
CM_ SG_ 1004 FRM_33_DetnMotionSts_062 "Detection point motion status
Front Radar Moudle_X_Detection Motion Status
前雷达探测点运动状态";
CM_ SG_ 1004 FRM_33_DetnRngRadial_062 "Detection point radial distance
Front Radar Moudle_X_Detection Range Radial
前雷达探测点径向距离";
CM_ SG_ 1004 FRM_33_DetnAziAngle_062 "Detection point azimuth angle
Front Radar Moudle_X_Detection Azimuth Angle
前雷达探测点水平方位角";
CM_ SG_ 1004 FRM_33_DetnElevnAngle_062 "Detection point elevation angle
Front Radar Moudle_X_Detection Elevation Angle
前雷达探测点俯仰角";
CM_ SG_ 1004 FRM_33_DetnRelVelRadial_062 "Detection point radial relative velocity
Front Radar Moudle_X_Detection Relative Velocity Radial 
前雷达探测点在径向上的相对速度";
CM_ SG_ 1004 FRM_33_DetnSNR_062 "Detection point signal noise ratio
Front Radar Moudle_X_Detection Signal Noise Ratio
前雷达探测点信号噪声比";
CM_ SG_ 1004 FRM_33_DetnRCS_062 "Detection point radar cross section
Front Radar Moudle_X_Detection Radar Cross Section
前雷达探测点雷达散射截面积";
CM_ SG_ 1004 FRM_33_DetnQuality_062 "Detection point quality
Front Radar Moudle_X_Detection Quality
前雷达探测点质量";
CM_ SG_ 1004 FRM_33_DetnMotionSts_063 "Detection point motion status
Front Radar Moudle_X_Detection Motion Status
前雷达探测点运动状态";
CM_ SG_ 1004 FRM_33_DetnRngRadial_063 "Detection point radial distance
Front Radar Moudle_X_Detection Range Radial
前雷达探测点径向距离";
CM_ SG_ 1004 FRM_33_DetnAziAngle_063 "Detection point azimuth angle
Front Radar Moudle_X_Detection Azimuth Angle
前雷达探测点水平方位角";
CM_ SG_ 1004 FRM_33_DetnElevnAngle_063 "Detection point elevation angle
Front Radar Moudle_X_Detection Elevation Angle
前雷达探测点俯仰角";
CM_ SG_ 1004 FRM_33_DetnRelVelRadial_063 "Detection point radial relative velocity
Front Radar Moudle_X_Detection Relative Velocity Radial 
前雷达探测点在径向上的相对速度";
CM_ SG_ 1004 FRM_33_DetnSNR_063 "Detection point signal noise ratio
Front Radar Moudle_X_Detection Signal Noise Ratio
前雷达探测点信号噪声比";
CM_ SG_ 1004 FRM_33_DetnRCS_063 "Detection point radar cross section
Front Radar Moudle_X_Detection Radar Cross Section
前雷达探测点雷达散射截面积";
CM_ SG_ 1004 FRM_33_DetnQuality_063 "Detection point quality
Front Radar Moudle_X_Detection Quality
前雷达探测点质量";
CM_ SG_ 1004 FRM_33_DetnMotionSts_064 "Detection point motion status
Front Radar Moudle_X_Detection Motion Status
前雷达探测点运动状态";
CM_ SG_ 1004 FRM_33_DetnRngRadial_064 "Detection point radial distance
Front Radar Moudle_X_Detection Range Radial
前雷达探测点径向距离";
CM_ SG_ 1004 FRM_33_DetnAziAngle_064 "Detection point azimuth angle
Front Radar Moudle_X_Detection Azimuth Angle
前雷达探测点水平方位角";
CM_ SG_ 1004 FRM_33_DetnElevnAngle_064 "Detection point elevation angle
Front Radar Moudle_X_Detection Elevation Angle
前雷达探测点俯仰角";
CM_ SG_ 1004 FRM_33_DetnRelVelRadial_064 "Detection point radial relative velocity
Front Radar Moudle_X_Detection Relative Velocity Radial 
前雷达探测点在径向上的相对速度";
CM_ SG_ 1004 FRM_33_DetnSNR_064 "Detection point signal noise ratio
Front Radar Moudle_X_Detection Signal Noise Ratio
前雷达探测点信号噪声比";
CM_ SG_ 1004 FRM_33_DetnRCS_064 "Detection point radar cross section
Front Radar Moudle_X_Detection Radar Cross Section
前雷达探测点雷达散射截面积";
CM_ SG_ 1004 FRM_33_DetnQuality_064 "Detection point quality
Front Radar Moudle_X_Detection Quality
前雷达探测点质量";
CM_ SG_ 1004 FRM_33_DetnMotionSts_065 "Detection point motion status
Front Radar Moudle_X_Detection Motion Status
前雷达探测点运动状态";
CM_ SG_ 1004 FRM_33_DetnRngRadial_065 "Detection point radial distance
Front Radar Moudle_X_Detection Range Radial
前雷达探测点径向距离";
CM_ SG_ 1004 FRM_33_DetnAziAngle_065 "Detection point azimuth angle
Front Radar Moudle_X_Detection Azimuth Angle
前雷达探测点水平方位角";
CM_ SG_ 1004 FRM_33_DetnElevnAngle_065 "Detection point elevation angle
Front Radar Moudle_X_Detection Elevation Angle
前雷达探测点俯仰角";
CM_ SG_ 1004 FRM_33_DetnRelVelRadial_065 "Detection point radial relative velocity
Front Radar Moudle_X_Detection Relative Velocity Radial 
前雷达探测点在径向上的相对速度";
CM_ SG_ 1004 FRM_33_DetnSNR_065 "Detection point signal noise ratio
Front Radar Moudle_X_Detection Signal Noise Ratio
前雷达探测点信号噪声比";
CM_ SG_ 1004 FRM_33_DetnRCS_065 "Detection point radar cross section
Front Radar Moudle_X_Detection Radar Cross Section
前雷达探测点雷达散射截面积";
CM_ SG_ 1004 FRM_33_DetnQuality_065 "Detection point quality
Front Radar Moudle_X_Detection Quality
前雷达探测点质量";
CM_ SG_ 1005 FRM_34_CRC "Profile5:E2E CRC16 (polynomial:0x1021)       
DataID:Use CANID,other bits Fill with 0";
CM_ SG_ 1005 FRM_34_RollgCntr "Profile5:E2E Rolling message counter";
CM_ SG_ 1005 FRM_34_DetnBlockCounter "Front Radar Moudle_X_Detection Block Counter
前雷达探测点块计数";
CM_ SG_ 1005 FRM_34_DetnMotionSts_066 "Detection point motion status
Front Radar Moudle_X_Detection Motion Status
前雷达探测点运动状态";
CM_ SG_ 1005 FRM_34_DetnRngRadial_066 "Detection point radial distance
Front Radar Moudle_X_Detection Range Radial
前雷达探测点径向距离";
CM_ SG_ 1005 FRM_34_DetnAziAngle_066 "Detection point azimuth angle
Front Radar Moudle_X_Detection Azimuth Angle
前雷达探测点水平方位角";
CM_ SG_ 1005 FRM_34_DetnElevnAngle_066 "Detection point elevation angle
Front Radar Moudle_X_Detection Elevation Angle
前雷达探测点俯仰角";
CM_ SG_ 1005 FRM_34_DetnRelVelRadial_066 "Detection point radial relative velocity
Front Radar Moudle_X_Detection Relative Velocity Radial 
前雷达探测点在径向上的相对速度";
CM_ SG_ 1005 FRM_34_DetnSNR_066 "Detection point signal noise ratio
Front Radar Moudle_X_Detection Signal Noise Ratio
前雷达探测点信号噪声比";
CM_ SG_ 1005 FRM_34_DetnRCS_066 "Detection point radar cross section
Front Radar Moudle_X_Detection Radar Cross Section
前雷达探测点雷达散射截面积";
CM_ SG_ 1005 FRM_34_DetnQuality_066 "Detection point quality
Front Radar Moudle_X_Detection Quality
前雷达探测点质量";
CM_ SG_ 1005 FRM_34_DetnMotionSts_067 "Detection point motion status
Front Radar Moudle_X_Detection Motion Status
前雷达探测点运动状态";
CM_ SG_ 1005 FRM_34_DetnRngRadial_067 "Detection point radial distance
Front Radar Moudle_X_Detection Range Radial
前雷达探测点径向距离";
CM_ SG_ 1005 FRM_34_DetnAziAngle_067 "Detection point azimuth angle
Front Radar Moudle_X_Detection Azimuth Angle
前雷达探测点水平方位角";
CM_ SG_ 1005 FRM_34_DetnElevnAngle_067 "Detection point elevation angle
Front Radar Moudle_X_Detection Elevation Angle
前雷达探测点俯仰角";
CM_ SG_ 1005 FRM_34_DetnRelVelRadial_067 "Detection point radial relative velocity
Front Radar Moudle_X_Detection Relative Velocity Radial 
前雷达探测点在径向上的相对速度";
CM_ SG_ 1005 FRM_34_DetnSNR_067 "Detection point signal noise ratio
Front Radar Moudle_X_Detection Signal Noise Ratio
前雷达探测点信号噪声比";
CM_ SG_ 1005 FRM_34_DetnRCS_067 "Detection point radar cross section
Front Radar Moudle_X_Detection Radar Cross Section
前雷达探测点雷达散射截面积";
CM_ SG_ 1005 FRM_34_DetnQuality_067 "Detection point quality
Front Radar Moudle_X_Detection Quality
前雷达探测点质量";
CM_ SG_ 1005 FRM_34_DetnMotionSts_068 "Detection point motion status
Front Radar Moudle_X_Detection Motion Status
前雷达探测点运动状态";
CM_ SG_ 1005 FRM_34_DetnRngRadial_068 "Detection point radial distance
Front Radar Moudle_X_Detection Range Radial
前雷达探测点径向距离";
CM_ SG_ 1005 FRM_34_DetnAziAngle_068 "Detection point azimuth angle
Front Radar Moudle_X_Detection Azimuth Angle
前雷达探测点水平方位角";
CM_ SG_ 1005 FRM_34_DetnElevnAngle_068 "Detection point elevation angle
Front Radar Moudle_X_Detection Elevation Angle
前雷达探测点俯仰角";
CM_ SG_ 1005 FRM_34_DetnRelVelRadial_068 "Detection point radial relative velocity
Front Radar Moudle_X_Detection Relative Velocity Radial 
前雷达探测点在径向上的相对速度";
CM_ SG_ 1005 FRM_34_DetnSNR_068 "Detection point signal noise ratio
Front Radar Moudle_X_Detection Signal Noise Ratio
前雷达探测点信号噪声比";
CM_ SG_ 1005 FRM_34_DetnRCS_068 "Detection point radar cross section
Front Radar Moudle_X_Detection Radar Cross Section
前雷达探测点雷达散射截面积";
CM_ SG_ 1005 FRM_34_DetnQuality_068 "Detection point quality
Front Radar Moudle_X_Detection Quality
前雷达探测点质量";
CM_ SG_ 1005 FRM_34_DetnMotionSts_069 "Detection point motion status
Front Radar Moudle_X_Detection Motion Status
前雷达探测点运动状态";
CM_ SG_ 1005 FRM_34_DetnRngRadial_069 "Detection point radial distance
Front Radar Moudle_X_Detection Range Radial
前雷达探测点径向距离";
CM_ SG_ 1005 FRM_34_DetnAziAngle_069 "Detection point azimuth angle
Front Radar Moudle_X_Detection Azimuth Angle
前雷达探测点水平方位角";
CM_ SG_ 1005 FRM_34_DetnElevnAngle_069 "Detection point elevation angle
Front Radar Moudle_X_Detection Elevation Angle
前雷达探测点俯仰角";
CM_ SG_ 1005 FRM_34_DetnRelVelRadial_069 "Detection point radial relative velocity
Front Radar Moudle_X_Detection Relative Velocity Radial 
前雷达探测点在径向上的相对速度";
CM_ SG_ 1005 FRM_34_DetnSNR_069 "Detection point signal noise ratio
Front Radar Moudle_X_Detection Signal Noise Ratio
前雷达探测点信号噪声比";
CM_ SG_ 1005 FRM_34_DetnRCS_069 "Detection point radar cross section
Front Radar Moudle_X_Detection Radar Cross Section
前雷达探测点雷达散射截面积";
CM_ SG_ 1005 FRM_34_DetnQuality_069 "Detection point quality
Front Radar Moudle_X_Detection Quality
前雷达探测点质量";
CM_ SG_ 1005 FRM_34_DetnMotionSts_070 "Detection point motion status
Front Radar Moudle_X_Detection Motion Status
前雷达探测点运动状态";
CM_ SG_ 1005 FRM_34_DetnRngRadial_070 "Detection point radial distance
Front Radar Moudle_X_Detection Range Radial
前雷达探测点径向距离";
CM_ SG_ 1005 FRM_34_DetnAziAngle_070 "Detection point azimuth angle
Front Radar Moudle_X_Detection Azimuth Angle
前雷达探测点水平方位角";
CM_ SG_ 1005 FRM_34_DetnElevnAngle_070 "Detection point elevation angle
Front Radar Moudle_X_Detection Elevation Angle
前雷达探测点俯仰角";
CM_ SG_ 1005 FRM_34_DetnRelVelRadial_070 "Detection point radial relative velocity
Front Radar Moudle_X_Detection Relative Velocity Radial 
前雷达探测点在径向上的相对速度";
CM_ SG_ 1005 FRM_34_DetnSNR_070 "Detection point signal noise ratio
Front Radar Moudle_X_Detection Signal Noise Ratio
前雷达探测点信号噪声比";
CM_ SG_ 1005 FRM_34_DetnRCS_070 "Detection point radar cross section
Front Radar Moudle_X_Detection Radar Cross Section
前雷达探测点雷达散射截面积";
CM_ SG_ 1005 FRM_34_DetnQuality_070 "Detection point quality
Front Radar Moudle_X_Detection Quality
前雷达探测点质量";
CM_ SG_ 1005 FRM_34_DetnMotionSts_071 "Detection point motion status
Front Radar Moudle_X_Detection Motion Status
前雷达探测点运动状态";
CM_ SG_ 1005 FRM_34_DetnRngRadial_071 "Detection point radial distance
Front Radar Moudle_X_Detection Range Radial
前雷达探测点径向距离";
CM_ SG_ 1005 FRM_34_DetnAziAngle_071 "Detection point azimuth angle
Front Radar Moudle_X_Detection Azimuth Angle
前雷达探测点水平方位角";
CM_ SG_ 1005 FRM_34_DetnElevnAngle_071 "Detection point elevation angle
Front Radar Moudle_X_Detection Elevation Angle
前雷达探测点俯仰角";
CM_ SG_ 1005 FRM_34_DetnRelVelRadial_071 "Detection point radial relative velocity
Front Radar Moudle_X_Detection Relative Velocity Radial 
前雷达探测点在径向上的相对速度";
CM_ SG_ 1005 FRM_34_DetnSNR_071 "Detection point signal noise ratio
Front Radar Moudle_X_Detection Signal Noise Ratio
前雷达探测点信号噪声比";
CM_ SG_ 1005 FRM_34_DetnRCS_071 "Detection point radar cross section
Front Radar Moudle_X_Detection Radar Cross Section
前雷达探测点雷达散射截面积";
CM_ SG_ 1005 FRM_34_DetnQuality_071 "Detection point quality
Front Radar Moudle_X_Detection Quality
前雷达探测点质量";
CM_ SG_ 1006 FRM_35_CRC "Profile5:E2E CRC16 (polynomial:0x1021)       
DataID:Use CANID,other bits Fill with 0";
CM_ SG_ 1006 FRM_35_RollgCntr "Profile5:E2E Rolling message counter";
CM_ SG_ 1006 FRM_35_DetnBlockCounter "Front Radar Moudle_X_Detection Block Counter
前雷达探测点块计数";
CM_ SG_ 1006 FRM_35_DetnMotionSts_072 "Detection point motion status
Front Radar Moudle_X_Detection Motion Status
前雷达探测点运动状态";
CM_ SG_ 1006 FRM_35_DetnRngRadial_072 "Detection point radial distance
Front Radar Moudle_X_Detection Range Radial
前雷达探测点径向距离";
CM_ SG_ 1006 FRM_35_DetnAziAngle_072 "Detection point azimuth angle
Front Radar Moudle_X_Detection Azimuth Angle
前雷达探测点水平方位角";
CM_ SG_ 1006 FRM_35_DetnElevnAngle_072 "Detection point elevation angle
Front Radar Moudle_X_Detection Elevation Angle
前雷达探测点俯仰角";
CM_ SG_ 1006 FRM_35_DetnRelVelRadial_072 "Detection point radial relative velocity
Front Radar Moudle_X_Detection Relative Velocity Radial 
前雷达探测点在径向上的相对速度";
CM_ SG_ 1006 FRM_35_DetnSNR_072 "Detection point signal noise ratio
Front Radar Moudle_X_Detection Signal Noise Ratio
前雷达探测点信号噪声比";
CM_ SG_ 1006 FRM_35_DetnRCS_072 "Detection point radar cross section
Front Radar Moudle_X_Detection Radar Cross Section
前雷达探测点雷达散射截面积";
CM_ SG_ 1006 FRM_35_DetnQuality_072 "Detection point quality
Front Radar Moudle_X_Detection Quality
前雷达探测点质量";
CM_ SG_ 1006 FRM_35_DetnMotionSts_073 "Detection point motion status
Front Radar Moudle_X_Detection Motion Status
前雷达探测点运动状态";
CM_ SG_ 1006 FRM_35_DetnRngRadial_073 "Detection point radial distance
Front Radar Moudle_X_Detection Range Radial
前雷达探测点径向距离";
CM_ SG_ 1006 FRM_35_DetnAziAngle_073 "Detection point azimuth angle
Front Radar Moudle_X_Detection Azimuth Angle
前雷达探测点水平方位角";
CM_ SG_ 1006 FRM_35_DetnElevnAngle_073 "Detection point elevation angle
Front Radar Moudle_X_Detection Elevation Angle
前雷达探测点俯仰角";
CM_ SG_ 1006 FRM_35_DetnRelVelRadial_073 "Detection point radial relative velocity
Front Radar Moudle_X_Detection Relative Velocity Radial 
前雷达探测点在径向上的相对速度";
CM_ SG_ 1006 FRM_35_DetnSNR_073 "Detection point signal noise ratio
Front Radar Moudle_X_Detection Signal Noise Ratio
前雷达探测点信号噪声比";
CM_ SG_ 1006 FRM_35_DetnRCS_073 "Detection point radar cross section
Front Radar Moudle_X_Detection Radar Cross Section
前雷达探测点雷达散射截面积";
CM_ SG_ 1006 FRM_35_DetnQuality_073 "Detection point quality
Front Radar Moudle_X_Detection Quality
前雷达探测点质量";
CM_ SG_ 1006 FRM_35_DetnMotionSts_074 "Detection point motion status
Front Radar Moudle_X_Detection Motion Status
前雷达探测点运动状态";
CM_ SG_ 1006 FRM_35_DetnRngRadial_074 "Detection point radial distance
Front Radar Moudle_X_Detection Range Radial
前雷达探测点径向距离";
CM_ SG_ 1006 FRM_35_DetnAziAngle_074 "Detection point azimuth angle
Front Radar Moudle_X_Detection Azimuth Angle
前雷达探测点水平方位角";
CM_ SG_ 1006 FRM_35_DetnElevnAngle_074 "Detection point elevation angle
Front Radar Moudle_X_Detection Elevation Angle
前雷达探测点俯仰角";
CM_ SG_ 1006 FRM_35_DetnRelVelRadial_074 "Detection point radial relative velocity
Front Radar Moudle_X_Detection Relative Velocity Radial 
前雷达探测点在径向上的相对速度";
CM_ SG_ 1006 FRM_35_DetnSNR_074 "Detection point signal noise ratio
Front Radar Moudle_X_Detection Signal Noise Ratio
前雷达探测点信号噪声比";
CM_ SG_ 1006 FRM_35_DetnRCS_074 "Detection point radar cross section
Front Radar Moudle_X_Detection Radar Cross Section
前雷达探测点雷达散射截面积";
CM_ SG_ 1006 FRM_35_DetnQuality_074 "Detection point quality
Front Radar Moudle_X_Detection Quality
前雷达探测点质量";
CM_ SG_ 1006 FRM_35_DetnMotionSts_075 "Detection point motion status
Front Radar Moudle_X_Detection Motion Status
前雷达探测点运动状态";
CM_ SG_ 1006 FRM_35_DetnRngRadial_075 "Detection point radial distance
Front Radar Moudle_X_Detection Range Radial
前雷达探测点径向距离";
CM_ SG_ 1006 FRM_35_DetnAziAngle_075 "Detection point azimuth angle
Front Radar Moudle_X_Detection Azimuth Angle
前雷达探测点水平方位角";
CM_ SG_ 1006 FRM_35_DetnElevnAngle_075 "Detection point elevation angle
Front Radar Moudle_X_Detection Elevation Angle
前雷达探测点俯仰角";
CM_ SG_ 1006 FRM_35_DetnRelVelRadial_075 "Detection point radial relative velocity
Front Radar Moudle_X_Detection Relative Velocity Radial 
前雷达探测点在径向上的相对速度";
CM_ SG_ 1006 FRM_35_DetnSNR_075 "Detection point signal noise ratio
Front Radar Moudle_X_Detection Signal Noise Ratio
前雷达探测点信号噪声比";
CM_ SG_ 1006 FRM_35_DetnRCS_075 "Detection point radar cross section
Front Radar Moudle_X_Detection Radar Cross Section
前雷达探测点雷达散射截面积";
CM_ SG_ 1006 FRM_35_DetnQuality_075 "Detection point quality
Front Radar Moudle_X_Detection Quality
前雷达探测点质量";
CM_ SG_ 1006 FRM_35_DetnMotionSts_076 "Detection point motion status
Front Radar Moudle_X_Detection Motion Status
前雷达探测点运动状态";
CM_ SG_ 1006 FRM_35_DetnRngRadial_076 "Detection point radial distance
Front Radar Moudle_X_Detection Range Radial
前雷达探测点径向距离";
CM_ SG_ 1006 FRM_35_DetnAziAngle_076 "Detection point azimuth angle
Front Radar Moudle_X_Detection Azimuth Angle
前雷达探测点水平方位角";
CM_ SG_ 1006 FRM_35_DetnElevnAngle_076 "Detection point elevation angle
Front Radar Moudle_X_Detection Elevation Angle
前雷达探测点俯仰角";
CM_ SG_ 1006 FRM_35_DetnRelVelRadial_076 "Detection point radial relative velocity
Front Radar Moudle_X_Detection Relative Velocity Radial 
前雷达探测点在径向上的相对速度";
CM_ SG_ 1006 FRM_35_DetnSNR_076 "Detection point signal noise ratio
Front Radar Moudle_X_Detection Signal Noise Ratio
前雷达探测点信号噪声比";
CM_ SG_ 1006 FRM_35_DetnRCS_076 "Detection point radar cross section
Front Radar Moudle_X_Detection Radar Cross Section
前雷达探测点雷达散射截面积";
CM_ SG_ 1006 FRM_35_DetnQuality_076 "Detection point quality
Front Radar Moudle_X_Detection Quality
前雷达探测点质量";
CM_ SG_ 1006 FRM_35_DetnMotionSts_077 "Detection point motion status
Front Radar Moudle_X_Detection Motion Status
前雷达探测点运动状态";
CM_ SG_ 1006 FRM_35_DetnRngRadial_077 "Detection point radial distance
Front Radar Moudle_X_Detection Range Radial
前雷达探测点径向距离";
CM_ SG_ 1006 FRM_35_DetnAziAngle_077 "Detection point azimuth angle
Front Radar Moudle_X_Detection Azimuth Angle
前雷达探测点水平方位角";
CM_ SG_ 1006 FRM_35_DetnElevnAngle_077 "Detection point elevation angle
Front Radar Moudle_X_Detection Elevation Angle
前雷达探测点俯仰角";
CM_ SG_ 1006 FRM_35_DetnRelVelRadial_077 "Detection point radial relative velocity
Front Radar Moudle_X_Detection Relative Velocity Radial 
前雷达探测点在径向上的相对速度";
CM_ SG_ 1006 FRM_35_DetnSNR_077 "Detection point signal noise ratio
Front Radar Moudle_X_Detection Signal Noise Ratio
前雷达探测点信号噪声比";
CM_ SG_ 1006 FRM_35_DetnRCS_077 "Detection point radar cross section
Front Radar Moudle_X_Detection Radar Cross Section
前雷达探测点雷达散射截面积";
CM_ SG_ 1006 FRM_35_DetnQuality_077 "Detection point quality
Front Radar Moudle_X_Detection Quality
前雷达探测点质量";
CM_ SG_ 1007 FRM_36_CRC "Profile5:E2E CRC16 (polynomial:0x1021)       
DataID:Use CANID,other bits Fill with 0";
CM_ SG_ 1007 FRM_36_RollgCntr "Profile5:E2E Rolling message counter";
CM_ SG_ 1007 FRM_36_DetnBlockCounter "Front Radar Moudle_X_Detection Block Counter
前雷达探测点块计数";
CM_ SG_ 1007 FRM_36_DetnMotionSts_078 "Detection point motion status
Front Radar Moudle_X_Detection Motion Status
前雷达探测点运动状态";
CM_ SG_ 1007 FRM_36_DetnRngRadial_078 "Detection point radial distance
Front Radar Moudle_X_Detection Range Radial
前雷达探测点径向距离";
CM_ SG_ 1007 FRM_36_DetnAziAngle_078 "Detection point azimuth angle
Front Radar Moudle_X_Detection Azimuth Angle
前雷达探测点水平方位角";
CM_ SG_ 1007 FRM_36_DetnElevnAngle_078 "Detection point elevation angle
Front Radar Moudle_X_Detection Elevation Angle
前雷达探测点俯仰角";
CM_ SG_ 1007 FRM_36_DetnRelVelRadial_078 "Detection point radial relative velocity
Front Radar Moudle_X_Detection Relative Velocity Radial 
前雷达探测点在径向上的相对速度";
CM_ SG_ 1007 FRM_36_DetnSNR_078 "Detection point signal noise ratio
Front Radar Moudle_X_Detection Signal Noise Ratio
前雷达探测点信号噪声比";
CM_ SG_ 1007 FRM_36_DetnRCS_078 "Detection point radar cross section
Front Radar Moudle_X_Detection Radar Cross Section
前雷达探测点雷达散射截面积";
CM_ SG_ 1007 FRM_36_DetnQuality_078 "Detection point quality
Front Radar Moudle_X_Detection Quality
前雷达探测点质量";
CM_ SG_ 1007 FRM_36_DetnMotionSts_079 "Detection point motion status
Front Radar Moudle_X_Detection Motion Status
前雷达探测点运动状态";
CM_ SG_ 1007 FRM_36_DetnRngRadial_079 "Detection point radial distance
Front Radar Moudle_X_Detection Range Radial
前雷达探测点径向距离";
CM_ SG_ 1007 FRM_36_DetnAziAngle_079 "Detection point azimuth angle
Front Radar Moudle_X_Detection Azimuth Angle
前雷达探测点水平方位角";
CM_ SG_ 1007 FRM_36_DetnElevnAngle_079 "Detection point elevation angle
Front Radar Moudle_X_Detection Elevation Angle
前雷达探测点俯仰角";
CM_ SG_ 1007 FRM_36_DetnRelVelRadial_079 "Detection point radial relative velocity
Front Radar Moudle_X_Detection Relative Velocity Radial 
前雷达探测点在径向上的相对速度";
CM_ SG_ 1007 FRM_36_DetnSNR_079 "Detection point signal noise ratio
Front Radar Moudle_X_Detection Signal Noise Ratio
前雷达探测点信号噪声比";
CM_ SG_ 1007 FRM_36_DetnRCS_079 "Detection point radar cross section
Front Radar Moudle_X_Detection Radar Cross Section
前雷达探测点雷达散射截面积";
CM_ SG_ 1007 FRM_36_DetnQuality_079 "Detection point quality
Front Radar Moudle_X_Detection Quality
前雷达探测点质量";
CM_ SG_ 1007 FRM_36_DetnMotionSts_080 "Detection point motion status
Front Radar Moudle_X_Detection Motion Status
前雷达探测点运动状态";
CM_ SG_ 1007 FRM_36_DetnRngRadial_080 "Detection point radial distance
Front Radar Moudle_X_Detection Range Radial
前雷达探测点径向距离";
CM_ SG_ 1007 FRM_36_DetnAziAngle_080 "Detection point azimuth angle
Front Radar Moudle_X_Detection Azimuth Angle
前雷达探测点水平方位角";
CM_ SG_ 1007 FRM_36_DetnElevnAngle_080 "Detection point elevation angle
Front Radar Moudle_X_Detection Elevation Angle
前雷达探测点俯仰角";
CM_ SG_ 1007 FRM_36_DetnRelVelRadial_080 "Detection point radial relative velocity
Front Radar Moudle_X_Detection Relative Velocity Radial 
前雷达探测点在径向上的相对速度";
CM_ SG_ 1007 FRM_36_DetnSNR_080 "Detection point signal noise ratio
Front Radar Moudle_X_Detection Signal Noise Ratio
前雷达探测点信号噪声比";
CM_ SG_ 1007 FRM_36_DetnRCS_080 "Detection point radar cross section
Front Radar Moudle_X_Detection Radar Cross Section
前雷达探测点雷达散射截面积";
CM_ SG_ 1007 FRM_36_DetnQuality_080 "Detection point quality
Front Radar Moudle_X_Detection Quality
前雷达探测点质量";
CM_ SG_ 1007 FRM_36_DetnMotionSts_081 "Detection point motion status
Front Radar Moudle_X_Detection Motion Status
前雷达探测点运动状态";
CM_ SG_ 1007 FRM_36_DetnRngRadial_081 "Detection point radial distance
Front Radar Moudle_X_Detection Range Radial
前雷达探测点径向距离";
CM_ SG_ 1007 FRM_36_DetnAziAngle_081 "Detection point azimuth angle
Front Radar Moudle_X_Detection Azimuth Angle
前雷达探测点水平方位角";
CM_ SG_ 1007 FRM_36_DetnElevnAngle_081 "Detection point elevation angle
Front Radar Moudle_X_Detection Elevation Angle
前雷达探测点俯仰角";
CM_ SG_ 1007 FRM_36_DetnRelVelRadial_081 "Detection point radial relative velocity
Front Radar Moudle_X_Detection Relative Velocity Radial 
前雷达探测点在径向上的相对速度";
CM_ SG_ 1007 FRM_36_DetnSNR_081 "Detection point signal noise ratio
Front Radar Moudle_X_Detection Signal Noise Ratio
前雷达探测点信号噪声比";
CM_ SG_ 1007 FRM_36_DetnRCS_081 "Detection point radar cross section
Front Radar Moudle_X_Detection Radar Cross Section
前雷达探测点雷达散射截面积";
CM_ SG_ 1007 FRM_36_DetnQuality_081 "Detection point quality
Front Radar Moudle_X_Detection Quality
前雷达探测点质量";
CM_ SG_ 1007 FRM_36_DetnMotionSts_082 "Detection point motion status
Front Radar Moudle_X_Detection Motion Status
前雷达探测点运动状态";
CM_ SG_ 1007 FRM_36_DetnRngRadial_082 "Detection point radial distance
Front Radar Moudle_X_Detection Range Radial
前雷达探测点径向距离";
CM_ SG_ 1007 FRM_36_DetnAziAngle_082 "Detection point azimuth angle
Front Radar Moudle_X_Detection Azimuth Angle
前雷达探测点水平方位角";
CM_ SG_ 1007 FRM_36_DetnElevnAngle_082 "Detection point elevation angle
Front Radar Moudle_X_Detection Elevation Angle
前雷达探测点俯仰角";
CM_ SG_ 1007 FRM_36_DetnRelVelRadial_082 "Detection point radial relative velocity
Front Radar Moudle_X_Detection Relative Velocity Radial 
前雷达探测点在径向上的相对速度";
CM_ SG_ 1007 FRM_36_DetnSNR_082 "Detection point signal noise ratio
Front Radar Moudle_X_Detection Signal Noise Ratio
前雷达探测点信号噪声比";
CM_ SG_ 1007 FRM_36_DetnRCS_082 "Detection point radar cross section
Front Radar Moudle_X_Detection Radar Cross Section
前雷达探测点雷达散射截面积";
CM_ SG_ 1007 FRM_36_DetnQuality_082 "Detection point quality
Front Radar Moudle_X_Detection Quality
前雷达探测点质量";
CM_ SG_ 1007 FRM_36_DetnMotionSts_083 "Detection point motion status
Front Radar Moudle_X_Detection Motion Status
前雷达探测点运动状态";
CM_ SG_ 1007 FRM_36_DetnRngRadial_083 "Detection point radial distance
Front Radar Moudle_X_Detection Range Radial
前雷达探测点径向距离";
CM_ SG_ 1007 FRM_36_DetnAziAngle_083 "Detection point azimuth angle
Front Radar Moudle_X_Detection Azimuth Angle
前雷达探测点水平方位角";
CM_ SG_ 1007 FRM_36_DetnElevnAngle_083 "Detection point elevation angle
Front Radar Moudle_X_Detection Elevation Angle
前雷达探测点俯仰角";
CM_ SG_ 1007 FRM_36_DetnRelVelRadial_083 "Detection point radial relative velocity
Front Radar Moudle_X_Detection Relative Velocity Radial 
前雷达探测点在径向上的相对速度";
CM_ SG_ 1007 FRM_36_DetnSNR_083 "Detection point signal noise ratio
Front Radar Moudle_X_Detection Signal Noise Ratio
前雷达探测点信号噪声比";
CM_ SG_ 1007 FRM_36_DetnRCS_083 "Detection point radar cross section
Front Radar Moudle_X_Detection Radar Cross Section
前雷达探测点雷达散射截面积";
CM_ SG_ 1007 FRM_36_DetnQuality_083 "Detection point quality
Front Radar Moudle_X_Detection Quality
前雷达探测点质量";
CM_ SG_ 1008 FRM_37_CRC "Profile5:E2E CRC16 (polynomial:0x1021)       
DataID:Use CANID,other bits Fill with 0";
CM_ SG_ 1008 FRM_37_RollgCntr "Profile5:E2E Rolling message counter";
CM_ SG_ 1008 FRM_37_DetnBlockCounter "Front Radar Moudle_X_Detection Block Counter
前雷达探测点块计数";
CM_ SG_ 1008 FRM_37_DetnMotionSts_084 "Detection point motion status
Front Radar Moudle_X_Detection Motion Status
前雷达探测点运动状态";
CM_ SG_ 1008 FRM_37_DetnRngRadial_084 "Detection point radial distance
Front Radar Moudle_X_Detection Range Radial
前雷达探测点径向距离";
CM_ SG_ 1008 FRM_37_DetnAziAngle_084 "Detection point azimuth angle
Front Radar Moudle_X_Detection Azimuth Angle
前雷达探测点水平方位角";
CM_ SG_ 1008 FRM_37_DetnElevnAngle_084 "Detection point elevation angle
Front Radar Moudle_X_Detection Elevation Angle
前雷达探测点俯仰角";
CM_ SG_ 1008 FRM_37_DetnRelVelRadial_084 "Detection point radial relative velocity
Front Radar Moudle_X_Detection Relative Velocity Radial 
前雷达探测点在径向上的相对速度";
CM_ SG_ 1008 FRM_37_DetnSNR_084 "Detection point signal noise ratio
Front Radar Moudle_X_Detection Signal Noise Ratio
前雷达探测点信号噪声比";
CM_ SG_ 1008 FRM_37_DetnRCS_084 "Detection point radar cross section
Front Radar Moudle_X_Detection Radar Cross Section
前雷达探测点雷达散射截面积";
CM_ SG_ 1008 FRM_37_DetnQuality_084 "Detection point quality
Front Radar Moudle_X_Detection Quality
前雷达探测点质量";
CM_ SG_ 1008 FRM_37_DetnMotionSts_085 "Detection point motion status
Front Radar Moudle_X_Detection Motion Status
前雷达探测点运动状态";
CM_ SG_ 1008 FRM_37_DetnRngRadial_085 "Detection point radial distance
Front Radar Moudle_X_Detection Range Radial
前雷达探测点径向距离";
CM_ SG_ 1008 FRM_37_DetnAziAngle_085 "Detection point azimuth angle
Front Radar Moudle_X_Detection Azimuth Angle
前雷达探测点水平方位角";
CM_ SG_ 1008 FRM_37_DetnElevnAngle_085 "Detection point elevation angle
Front Radar Moudle_X_Detection Elevation Angle
前雷达探测点俯仰角";
CM_ SG_ 1008 FRM_37_DetnRelVelRadial_085 "Detection point radial relative velocity
Front Radar Moudle_X_Detection Relative Velocity Radial 
前雷达探测点在径向上的相对速度";
CM_ SG_ 1008 FRM_37_DetnSNR_085 "Detection point signal noise ratio
Front Radar Moudle_X_Detection Signal Noise Ratio
前雷达探测点信号噪声比";
CM_ SG_ 1008 FRM_37_DetnRCS_085 "Detection point radar cross section
Front Radar Moudle_X_Detection Radar Cross Section
前雷达探测点雷达散射截面积";
CM_ SG_ 1008 FRM_37_DetnQuality_085 "Detection point quality
Front Radar Moudle_X_Detection Quality
前雷达探测点质量";
CM_ SG_ 1008 FRM_37_DetnMotionSts_086 "Detection point motion status
Front Radar Moudle_X_Detection Motion Status
前雷达探测点运动状态";
CM_ SG_ 1008 FRM_37_DetnRngRadial_086 "Detection point radial distance
Front Radar Moudle_X_Detection Range Radial
前雷达探测点径向距离";
CM_ SG_ 1008 FRM_37_DetnAziAngle_086 "Detection point azimuth angle
Front Radar Moudle_X_Detection Azimuth Angle
前雷达探测点水平方位角";
CM_ SG_ 1008 FRM_37_DetnElevnAngle_086 "Detection point elevation angle
Front Radar Moudle_X_Detection Elevation Angle
前雷达探测点俯仰角";
CM_ SG_ 1008 FRM_37_DetnRelVelRadial_086 "Detection point radial relative velocity
Front Radar Moudle_X_Detection Relative Velocity Radial 
前雷达探测点在径向上的相对速度";
CM_ SG_ 1008 FRM_37_DetnSNR_086 "Detection point signal noise ratio
Front Radar Moudle_X_Detection Signal Noise Ratio
前雷达探测点信号噪声比";
CM_ SG_ 1008 FRM_37_DetnRCS_086 "Detection point radar cross section
Front Radar Moudle_X_Detection Radar Cross Section
前雷达探测点雷达散射截面积";
CM_ SG_ 1008 FRM_37_DetnQuality_086 "Detection point quality
Front Radar Moudle_X_Detection Quality
前雷达探测点质量";
CM_ SG_ 1008 FRM_37_DetnMotionSts_087 "Detection point motion status
Front Radar Moudle_X_Detection Motion Status
前雷达探测点运动状态";
CM_ SG_ 1008 FRM_37_DetnRngRadial_087 "Detection point radial distance
Front Radar Moudle_X_Detection Range Radial
前雷达探测点径向距离";
CM_ SG_ 1008 FRM_37_DetnAziAngle_087 "Detection point azimuth angle
Front Radar Moudle_X_Detection Azimuth Angle
前雷达探测点水平方位角";
CM_ SG_ 1008 FRM_37_DetnElevnAngle_087 "Detection point elevation angle
Front Radar Moudle_X_Detection Elevation Angle
前雷达探测点俯仰角";
CM_ SG_ 1008 FRM_37_DetnRelVelRadial_087 "Detection point radial relative velocity
Front Radar Moudle_X_Detection Relative Velocity Radial 
前雷达探测点在径向上的相对速度";
CM_ SG_ 1008 FRM_37_DetnSNR_087 "Detection point signal noise ratio
Front Radar Moudle_X_Detection Signal Noise Ratio
前雷达探测点信号噪声比";
CM_ SG_ 1008 FRM_37_DetnRCS_087 "Detection point radar cross section
Front Radar Moudle_X_Detection Radar Cross Section
前雷达探测点雷达散射截面积";
CM_ SG_ 1008 FRM_37_DetnQuality_087 "Detection point quality
Front Radar Moudle_X_Detection Quality
前雷达探测点质量";
CM_ SG_ 1008 FRM_37_DetnMotionSts_088 "Detection point motion status
Front Radar Moudle_X_Detection Motion Status
前雷达探测点运动状态";
CM_ SG_ 1008 FRM_37_DetnRngRadial_088 "Detection point radial distance
Front Radar Moudle_X_Detection Range Radial
前雷达探测点径向距离";
CM_ SG_ 1008 FRM_37_DetnAziAngle_088 "Detection point azimuth angle
Front Radar Moudle_X_Detection Azimuth Angle
前雷达探测点水平方位角";
CM_ SG_ 1008 FRM_37_DetnElevnAngle_088 "Detection point elevation angle
Front Radar Moudle_X_Detection Elevation Angle
前雷达探测点俯仰角";
CM_ SG_ 1008 FRM_37_DetnRelVelRadial_088 "Detection point radial relative velocity
Front Radar Moudle_X_Detection Relative Velocity Radial 
前雷达探测点在径向上的相对速度";
CM_ SG_ 1008 FRM_37_DetnSNR_088 "Detection point signal noise ratio
Front Radar Moudle_X_Detection Signal Noise Ratio
前雷达探测点信号噪声比";
CM_ SG_ 1008 FRM_37_DetnRCS_088 "Detection point radar cross section
Front Radar Moudle_X_Detection Radar Cross Section
前雷达探测点雷达散射截面积";
CM_ SG_ 1008 FRM_37_DetnQuality_088 "Detection point quality
Front Radar Moudle_X_Detection Quality
前雷达探测点质量";
CM_ SG_ 1008 FRM_37_DetnMotionSts_089 "Detection point motion status
Front Radar Moudle_X_Detection Motion Status
前雷达探测点运动状态";
CM_ SG_ 1008 FRM_37_DetnRngRadial_089 "Detection point radial distance
Front Radar Moudle_X_Detection Range Radial
前雷达探测点径向距离";
CM_ SG_ 1008 FRM_37_DetnAziAngle_089 "Detection point azimuth angle
Front Radar Moudle_X_Detection Azimuth Angle
前雷达探测点水平方位角";
CM_ SG_ 1008 FRM_37_DetnElevnAngle_089 "Detection point elevation angle
Front Radar Moudle_X_Detection Elevation Angle
前雷达探测点俯仰角";
CM_ SG_ 1008 FRM_37_DetnRelVelRadial_089 "Detection point radial relative velocity
Front Radar Moudle_X_Detection Relative Velocity Radial 
前雷达探测点在径向上的相对速度";
CM_ SG_ 1008 FRM_37_DetnSNR_089 "Detection point signal noise ratio
Front Radar Moudle_X_Detection Signal Noise Ratio
前雷达探测点信号噪声比";
CM_ SG_ 1008 FRM_37_DetnRCS_089 "Detection point radar cross section
Front Radar Moudle_X_Detection Radar Cross Section
前雷达探测点雷达散射截面积";
CM_ SG_ 1008 FRM_37_DetnQuality_089 "Detection point quality
Front Radar Moudle_X_Detection Quality
前雷达探测点质量";
CM_ SG_ 1009 FRM_38_CRC "Profile5:E2E CRC16 (polynomial:0x1021)       
DataID:Use CANID,other bits Fill with 0";
CM_ SG_ 1009 FRM_38_RollgCntr "Profile5:E2E Rolling message counter";
CM_ SG_ 1009 FRM_38_DetnBlockCounter "Front Radar Moudle_X_Detection Block Counter
前雷达探测点块计数";
CM_ SG_ 1009 FRM_38_DetnMotionSts_090 "Detection point motion status
Front Radar Moudle_X_Detection Motion Status
前雷达探测点运动状态";
CM_ SG_ 1009 FRM_38_DetnRngRadial_090 "Detection point radial distance
Front Radar Moudle_X_Detection Range Radial
前雷达探测点径向距离";
CM_ SG_ 1009 FRM_38_DetnAziAngle_090 "Detection point azimuth angle
Front Radar Moudle_X_Detection Azimuth Angle
前雷达探测点水平方位角";
CM_ SG_ 1009 FRM_38_DetnElevnAngle_090 "Detection point elevation angle
Front Radar Moudle_X_Detection Elevation Angle
前雷达探测点俯仰角";
CM_ SG_ 1009 FRM_38_DetnRelVelRadial_090 "Detection point radial relative velocity
Front Radar Moudle_X_Detection Relative Velocity Radial 
前雷达探测点在径向上的相对速度";
CM_ SG_ 1009 FRM_38_DetnSNR_090 "Detection point signal noise ratio
Front Radar Moudle_X_Detection Signal Noise Ratio
前雷达探测点信号噪声比";
CM_ SG_ 1009 FRM_38_DetnRCS_090 "Detection point radar cross section
Front Radar Moudle_X_Detection Radar Cross Section
前雷达探测点雷达散射截面积";
CM_ SG_ 1009 FRM_38_DetnQuality_090 "Detection point quality
Front Radar Moudle_X_Detection Quality
前雷达探测点质量";
CM_ SG_ 1009 FRM_38_DetnMotionSts_091 "Detection point motion status
Front Radar Moudle_X_Detection Motion Status
前雷达探测点运动状态";
CM_ SG_ 1009 FRM_38_DetnRngRadial_091 "Detection point radial distance
Front Radar Moudle_X_Detection Range Radial
前雷达探测点径向距离";
CM_ SG_ 1009 FRM_38_DetnAziAngle_091 "Detection point azimuth angle
Front Radar Moudle_X_Detection Azimuth Angle
前雷达探测点水平方位角";
CM_ SG_ 1009 FRM_38_DetnElevnAngle_091 "Detection point elevation angle
Front Radar Moudle_X_Detection Elevation Angle
前雷达探测点俯仰角";
CM_ SG_ 1009 FRM_38_DetnRelVelRadial_091 "Detection point radial relative velocity
Front Radar Moudle_X_Detection Relative Velocity Radial 
前雷达探测点在径向上的相对速度";
CM_ SG_ 1009 FRM_38_DetnSNR_091 "Detection point signal noise ratio
Front Radar Moudle_X_Detection Signal Noise Ratio
前雷达探测点信号噪声比";
CM_ SG_ 1009 FRM_38_DetnRCS_091 "Detection point radar cross section
Front Radar Moudle_X_Detection Radar Cross Section
前雷达探测点雷达散射截面积";
CM_ SG_ 1009 FRM_38_DetnQuality_091 "Detection point quality
Front Radar Moudle_X_Detection Quality
前雷达探测点质量";
CM_ SG_ 1009 FRM_38_DetnMotionSts_092 "Detection point motion status
Front Radar Moudle_X_Detection Motion Status
前雷达探测点运动状态";
CM_ SG_ 1009 FRM_38_DetnRngRadial_092 "Detection point radial distance
Front Radar Moudle_X_Detection Range Radial
前雷达探测点径向距离";
CM_ SG_ 1009 FRM_38_DetnAziAngle_092 "Detection point azimuth angle
Front Radar Moudle_X_Detection Azimuth Angle
前雷达探测点水平方位角";
CM_ SG_ 1009 FRM_38_DetnElevnAngle_092 "Detection point elevation angle
Front Radar Moudle_X_Detection Elevation Angle
前雷达探测点俯仰角";
CM_ SG_ 1009 FRM_38_DetnRelVelRadial_092 "Detection point radial relative velocity
Front Radar Moudle_X_Detection Relative Velocity Radial 
前雷达探测点在径向上的相对速度";
CM_ SG_ 1009 FRM_38_DetnSNR_092 "Detection point signal noise ratio
Front Radar Moudle_X_Detection Signal Noise Ratio
前雷达探测点信号噪声比";
CM_ SG_ 1009 FRM_38_DetnRCS_092 "Detection point radar cross section
Front Radar Moudle_X_Detection Radar Cross Section
前雷达探测点雷达散射截面积";
CM_ SG_ 1009 FRM_38_DetnQuality_092 "Detection point quality
Front Radar Moudle_X_Detection Quality
前雷达探测点质量";
CM_ SG_ 1009 FRM_38_DetnMotionSts_093 "Detection point motion status
Front Radar Moudle_X_Detection Motion Status
前雷达探测点运动状态";
CM_ SG_ 1009 FRM_38_DetnRngRadial_093 "Detection point radial distance
Front Radar Moudle_X_Detection Range Radial
前雷达探测点径向距离";
CM_ SG_ 1009 FRM_38_DetnAziAngle_093 "Detection point azimuth angle
Front Radar Moudle_X_Detection Azimuth Angle
前雷达探测点水平方位角";
CM_ SG_ 1009 FRM_38_DetnElevnAngle_093 "Detection point elevation angle
Front Radar Moudle_X_Detection Elevation Angle
前雷达探测点俯仰角";
CM_ SG_ 1009 FRM_38_DetnRelVelRadial_093 "Detection point radial relative velocity
Front Radar Moudle_X_Detection Relative Velocity Radial 
前雷达探测点在径向上的相对速度";
CM_ SG_ 1009 FRM_38_DetnSNR_093 "Detection point signal noise ratio
Front Radar Moudle_X_Detection Signal Noise Ratio
前雷达探测点信号噪声比";
CM_ SG_ 1009 FRM_38_DetnRCS_093 "Detection point radar cross section
Front Radar Moudle_X_Detection Radar Cross Section
前雷达探测点雷达散射截面积";
CM_ SG_ 1009 FRM_38_DetnQuality_093 "Detection point quality
Front Radar Moudle_X_Detection Quality
前雷达探测点质量";
CM_ SG_ 1009 FRM_38_DetnMotionSts_094 "Detection point motion status
Front Radar Moudle_X_Detection Motion Status
前雷达探测点运动状态";
CM_ SG_ 1009 FRM_38_DetnRngRadial_094 "Detection point radial distance
Front Radar Moudle_X_Detection Range Radial
前雷达探测点径向距离";
CM_ SG_ 1009 FRM_38_DetnAziAngle_094 "Detection point azimuth angle
Front Radar Moudle_X_Detection Azimuth Angle
前雷达探测点水平方位角";
CM_ SG_ 1009 FRM_38_DetnElevnAngle_094 "Detection point elevation angle
Front Radar Moudle_X_Detection Elevation Angle
前雷达探测点俯仰角";
CM_ SG_ 1009 FRM_38_DetnRelVelRadial_094 "Detection point radial relative velocity
Front Radar Moudle_X_Detection Relative Velocity Radial 
前雷达探测点在径向上的相对速度";
CM_ SG_ 1009 FRM_38_DetnSNR_094 "Detection point signal noise ratio
Front Radar Moudle_X_Detection Signal Noise Ratio
前雷达探测点信号噪声比";
CM_ SG_ 1009 FRM_38_DetnRCS_094 "Detection point radar cross section
Front Radar Moudle_X_Detection Radar Cross Section
前雷达探测点雷达散射截面积";
CM_ SG_ 1009 FRM_38_DetnQuality_094 "Detection point quality
Front Radar Moudle_X_Detection Quality
前雷达探测点质量";
CM_ SG_ 1009 FRM_38_DetnMotionSts_095 "Detection point motion status
Front Radar Moudle_X_Detection Motion Status
前雷达探测点运动状态";
CM_ SG_ 1009 FRM_38_DetnRngRadial_095 "Detection point radial distance
Front Radar Moudle_X_Detection Range Radial
前雷达探测点径向距离";
CM_ SG_ 1009 FRM_38_DetnAziAngle_095 "Detection point azimuth angle
Front Radar Moudle_X_Detection Azimuth Angle
前雷达探测点水平方位角";
CM_ SG_ 1009 FRM_38_DetnElevnAngle_095 "Detection point elevation angle
Front Radar Moudle_X_Detection Elevation Angle
前雷达探测点俯仰角";
CM_ SG_ 1009 FRM_38_DetnRelVelRadial_095 "Detection point radial relative velocity
Front Radar Moudle_X_Detection Relative Velocity Radial 
前雷达探测点在径向上的相对速度";
CM_ SG_ 1009 FRM_38_DetnSNR_095 "Detection point signal noise ratio
Front Radar Moudle_X_Detection Signal Noise Ratio
前雷达探测点信号噪声比";
CM_ SG_ 1009 FRM_38_DetnRCS_095 "Detection point radar cross section
Front Radar Moudle_X_Detection Radar Cross Section
前雷达探测点雷达散射截面积";
CM_ SG_ 1009 FRM_38_DetnQuality_095 "Detection point quality
Front Radar Moudle_X_Detection Quality
前雷达探测点质量";
CM_ SG_ 1010 FRM_39_CRC "Profile5:E2E CRC16 (polynomial:0x1021)       
DataID:Use CANID,other bits Fill with 0";
CM_ SG_ 1010 FRM_39_RollgCntr "Profile5:E2E Rolling message counter";
CM_ SG_ 1010 FRM_39_DetnBlockCounter "Front Radar Moudle_X_Detection Block Counter
前雷达探测点块计数";
CM_ SG_ 1010 FRM_39_DetnMotionSts_096 "Detection point motion status
Front Radar Moudle_X_Detection Motion Status
前雷达探测点运动状态";
CM_ SG_ 1010 FRM_39_DetnRngRadial_096 "Detection point radial distance
Front Radar Moudle_X_Detection Range Radial
前雷达探测点径向距离";
CM_ SG_ 1010 FRM_39_DetnAziAngle_096 "Detection point azimuth angle
Front Radar Moudle_X_Detection Azimuth Angle
前雷达探测点水平方位角";
CM_ SG_ 1010 FRM_39_DetnElevnAngle_096 "Detection point elevation angle
Front Radar Moudle_X_Detection Elevation Angle
前雷达探测点俯仰角";
CM_ SG_ 1010 FRM_39_DetnRelVelRadial_096 "Detection point radial relative velocity
Front Radar Moudle_X_Detection Relative Velocity Radial 
前雷达探测点在径向上的相对速度";
CM_ SG_ 1010 FRM_39_DetnSNR_096 "Detection point signal noise ratio
Front Radar Moudle_X_Detection Signal Noise Ratio
前雷达探测点信号噪声比";
CM_ SG_ 1010 FRM_39_DetnRCS_096 "Detection point radar cross section
Front Radar Moudle_X_Detection Radar Cross Section
前雷达探测点雷达散射截面积";
CM_ SG_ 1010 FRM_39_DetnQuality_096 "Detection point quality
Front Radar Moudle_X_Detection Quality
前雷达探测点质量";
CM_ SG_ 1010 FRM_39_DetnMotionSts_097 "Detection point motion status
Front Radar Moudle_X_Detection Motion Status
前雷达探测点运动状态";
CM_ SG_ 1010 FRM_39_DetnRngRadial_097 "Detection point radial distance
Front Radar Moudle_X_Detection Range Radial
前雷达探测点径向距离";
CM_ SG_ 1010 FRM_39_DetnAziAngle_097 "Detection point azimuth angle
Front Radar Moudle_X_Detection Azimuth Angle
前雷达探测点水平方位角";
CM_ SG_ 1010 FRM_39_DetnElevnAngle_097 "Detection point elevation angle
Front Radar Moudle_X_Detection Elevation Angle
前雷达探测点俯仰角";
CM_ SG_ 1010 FRM_39_DetnRelVelRadial_097 "Detection point radial relative velocity
Front Radar Moudle_X_Detection Relative Velocity Radial 
前雷达探测点在径向上的相对速度";
CM_ SG_ 1010 FRM_39_DetnSNR_097 "Detection point signal noise ratio
Front Radar Moudle_X_Detection Signal Noise Ratio
前雷达探测点信号噪声比";
CM_ SG_ 1010 FRM_39_DetnRCS_097 "Detection point radar cross section
Front Radar Moudle_X_Detection Radar Cross Section
前雷达探测点雷达散射截面积";
CM_ SG_ 1010 FRM_39_DetnQuality_097 "Detection point quality
Front Radar Moudle_X_Detection Quality
前雷达探测点质量";
CM_ SG_ 1010 FRM_39_DetnMotionSts_098 "Detection point motion status
Front Radar Moudle_X_Detection Motion Status
前雷达探测点运动状态";
CM_ SG_ 1010 FRM_39_DetnRngRadial_098 "Detection point radial distance
Front Radar Moudle_X_Detection Range Radial
前雷达探测点径向距离";
CM_ SG_ 1010 FRM_39_DetnAziAngle_098 "Detection point azimuth angle
Front Radar Moudle_X_Detection Azimuth Angle
前雷达探测点水平方位角";
CM_ SG_ 1010 FRM_39_DetnElevnAngle_098 "Detection point elevation angle
Front Radar Moudle_X_Detection Elevation Angle
前雷达探测点俯仰角";
CM_ SG_ 1010 FRM_39_DetnRelVelRadial_098 "Detection point radial relative velocity
Front Radar Moudle_X_Detection Relative Velocity Radial 
前雷达探测点在径向上的相对速度";
CM_ SG_ 1010 FRM_39_DetnSNR_098 "Detection point signal noise ratio
Front Radar Moudle_X_Detection Signal Noise Ratio
前雷达探测点信号噪声比";
CM_ SG_ 1010 FRM_39_DetnRCS_098 "Detection point radar cross section
Front Radar Moudle_X_Detection Radar Cross Section
前雷达探测点雷达散射截面积";
CM_ SG_ 1010 FRM_39_DetnQuality_098 "Detection point quality
Front Radar Moudle_X_Detection Quality
前雷达探测点质量";
CM_ SG_ 1010 FRM_39_DetnMotionSts_099 "Detection point motion status
Front Radar Moudle_X_Detection Motion Status
前雷达探测点运动状态";
CM_ SG_ 1010 FRM_39_DetnRngRadial_099 "Detection point radial distance
Front Radar Moudle_X_Detection Range Radial
前雷达探测点径向距离";
CM_ SG_ 1010 FRM_39_DetnAziAngle_099 "Detection point azimuth angle
Front Radar Moudle_X_Detection Azimuth Angle
前雷达探测点水平方位角";
CM_ SG_ 1010 FRM_39_DetnElevnAngle_099 "Detection point elevation angle
Front Radar Moudle_X_Detection Elevation Angle
前雷达探测点俯仰角";
CM_ SG_ 1010 FRM_39_DetnRelVelRadial_099 "Detection point radial relative velocity
Front Radar Moudle_X_Detection Relative Velocity Radial 
前雷达探测点在径向上的相对速度";
CM_ SG_ 1010 FRM_39_DetnSNR_099 "Detection point signal noise ratio
Front Radar Moudle_X_Detection Signal Noise Ratio
前雷达探测点信号噪声比";
CM_ SG_ 1010 FRM_39_DetnRCS_099 "Detection point radar cross section
Front Radar Moudle_X_Detection Radar Cross Section
前雷达探测点雷达散射截面积";
CM_ SG_ 1010 FRM_39_DetnQuality_099 "Detection point quality
Front Radar Moudle_X_Detection Quality
前雷达探测点质量";
CM_ SG_ 1010 FRM_39_DetnMotionSts_100 "Detection point motion status
Front Radar Moudle_X_Detection Motion Status
前雷达探测点运动状态";
CM_ SG_ 1010 FRM_39_DetnRngRadial_100 "Detection point radial distance
Front Radar Moudle_X_Detection Range Radial
前雷达探测点径向距离";
CM_ SG_ 1010 FRM_39_DetnAziAngle_100 "Detection point azimuth angle
Front Radar Moudle_X_Detection Azimuth Angle
前雷达探测点水平方位角";
CM_ SG_ 1010 FRM_39_DetnElevnAngle_100 "Detection point elevation angle
Front Radar Moudle_X_Detection Elevation Angle
前雷达探测点俯仰角";
CM_ SG_ 1010 FRM_39_DetnRelVelRadial_100 "Detection point radial relative velocity
Front Radar Moudle_X_Detection Relative Velocity Radial 
前雷达探测点在径向上的相对速度";
CM_ SG_ 1010 FRM_39_DetnSNR_100 "Detection point signal noise ratio
Front Radar Moudle_X_Detection Signal Noise Ratio
前雷达探测点信号噪声比";
CM_ SG_ 1010 FRM_39_DetnRCS_100 "Detection point radar cross section
Front Radar Moudle_X_Detection Radar Cross Section
前雷达探测点雷达散射截面积";
CM_ SG_ 1010 FRM_39_DetnQuality_100 "Detection point quality
Front Radar Moudle_X_Detection Quality
前雷达探测点质量";
CM_ SG_ 1010 FRM_39_DetnMotionSts_101 "Detection point motion status
Front Radar Moudle_X_Detection Motion Status
前雷达探测点运动状态";
CM_ SG_ 1010 FRM_39_DetnRngRadial_101 "Detection point radial distance
Front Radar Moudle_X_Detection Range Radial
前雷达探测点径向距离";
CM_ SG_ 1010 FRM_39_DetnAziAngle_101 "Detection point azimuth angle
Front Radar Moudle_X_Detection Azimuth Angle
前雷达探测点水平方位角";
CM_ SG_ 1010 FRM_39_DetnElevnAngle_101 "Detection point elevation angle
Front Radar Moudle_X_Detection Elevation Angle
前雷达探测点俯仰角";
CM_ SG_ 1010 FRM_39_DetnRelVelRadial_101 "Detection point radial relative velocity
Front Radar Moudle_X_Detection Relative Velocity Radial 
前雷达探测点在径向上的相对速度";
CM_ SG_ 1010 FRM_39_DetnSNR_101 "Detection point signal noise ratio
Front Radar Moudle_X_Detection Signal Noise Ratio
前雷达探测点信号噪声比";
CM_ SG_ 1010 FRM_39_DetnRCS_101 "Detection point radar cross section
Front Radar Moudle_X_Detection Radar Cross Section
前雷达探测点雷达散射截面积";
CM_ SG_ 1010 FRM_39_DetnQuality_101 "Detection point quality
Front Radar Moudle_X_Detection Quality
前雷达探测点质量";
CM_ SG_ 1011 FRM_40_CRC "Profile5:E2E CRC16 (polynomial:0x1021)       
DataID:Use CANID,other bits Fill with 0";
CM_ SG_ 1011 FRM_40_RollgCntr "Profile5:E2E Rolling message counter";
CM_ SG_ 1011 FRM_40_DetnBlockCounter "Front Radar Moudle_X_Detection Block Counter
前雷达探测点块计数";
CM_ SG_ 1011 FRM_40_DetnMotionSts_102 "Detection point motion status
Front Radar Moudle_X_Detection Motion Status
前雷达探测点运动状态";
CM_ SG_ 1011 FRM_40_DetnRngRadial_102 "Detection point radial distance
Front Radar Moudle_X_Detection Range Radial
前雷达探测点径向距离";
CM_ SG_ 1011 FRM_40_DetnAziAngle_102 "Detection point azimuth angle
Front Radar Moudle_X_Detection Azimuth Angle
前雷达探测点水平方位角";
CM_ SG_ 1011 FRM_40_DetnElevnAngle_102 "Detection point elevation angle
Front Radar Moudle_X_Detection Elevation Angle
前雷达探测点俯仰角";
CM_ SG_ 1011 FRM_40_DetnRelVelRadial_102 "Detection point radial relative velocity
Front Radar Moudle_X_Detection Relative Velocity Radial 
前雷达探测点在径向上的相对速度";
CM_ SG_ 1011 FRM_40_DetnSNR_102 "Detection point signal noise ratio
Front Radar Moudle_X_Detection Signal Noise Ratio
前雷达探测点信号噪声比";
CM_ SG_ 1011 FRM_40_DetnRCS_102 "Detection point radar cross section
Front Radar Moudle_X_Detection Radar Cross Section
前雷达探测点雷达散射截面积";
CM_ SG_ 1011 FRM_40_DetnQuality_102 "Detection point quality
Front Radar Moudle_X_Detection Quality
前雷达探测点质量";
CM_ SG_ 1011 FRM_40_DetnMotionSts_103 "Detection point motion status
Front Radar Moudle_X_Detection Motion Status
前雷达探测点运动状态";
CM_ SG_ 1011 FRM_40_DetnRngRadial_103 "Detection point radial distance
Front Radar Moudle_X_Detection Range Radial
前雷达探测点径向距离";
CM_ SG_ 1011 FRM_40_DetnAziAngle_103 "Detection point azimuth angle
Front Radar Moudle_X_Detection Azimuth Angle
前雷达探测点水平方位角";
CM_ SG_ 1011 FRM_40_DetnElevnAngle_103 "Detection point elevation angle
Front Radar Moudle_X_Detection Elevation Angle
前雷达探测点俯仰角";
CM_ SG_ 1011 FRM_40_DetnRelVelRadial_103 "Detection point radial relative velocity
Front Radar Moudle_X_Detection Relative Velocity Radial 
前雷达探测点在径向上的相对速度";
CM_ SG_ 1011 FRM_40_DetnSNR_103 "Detection point signal noise ratio
Front Radar Moudle_X_Detection Signal Noise Ratio
前雷达探测点信号噪声比";
CM_ SG_ 1011 FRM_40_DetnRCS_103 "Detection point radar cross section
Front Radar Moudle_X_Detection Radar Cross Section
前雷达探测点雷达散射截面积";
CM_ SG_ 1011 FRM_40_DetnQuality_103 "Detection point quality
Front Radar Moudle_X_Detection Quality
前雷达探测点质量";
CM_ SG_ 1011 FRM_40_DetnMotionSts_104 "Detection point motion status
Front Radar Moudle_X_Detection Motion Status
前雷达探测点运动状态";
CM_ SG_ 1011 FRM_40_DetnRngRadial_104 "Detection point radial distance
Front Radar Moudle_X_Detection Range Radial
前雷达探测点径向距离";
CM_ SG_ 1011 FRM_40_DetnAziAngle_104 "Detection point azimuth angle
Front Radar Moudle_X_Detection Azimuth Angle
前雷达探测点水平方位角";
CM_ SG_ 1011 FRM_40_DetnElevnAngle_104 "Detection point elevation angle
Front Radar Moudle_X_Detection Elevation Angle
前雷达探测点俯仰角";
CM_ SG_ 1011 FRM_40_DetnRelVelRadial_104 "Detection point radial relative velocity
Front Radar Moudle_X_Detection Relative Velocity Radial 
前雷达探测点在径向上的相对速度";
CM_ SG_ 1011 FRM_40_DetnSNR_104 "Detection point signal noise ratio
Front Radar Moudle_X_Detection Signal Noise Ratio
前雷达探测点信号噪声比";
CM_ SG_ 1011 FRM_40_DetnRCS_104 "Detection point radar cross section
Front Radar Moudle_X_Detection Radar Cross Section
前雷达探测点雷达散射截面积";
CM_ SG_ 1011 FRM_40_DetnQuality_104 "Detection point quality
Front Radar Moudle_X_Detection Quality
前雷达探测点质量";
CM_ SG_ 1011 FRM_40_DetnMotionSts_105 "Detection point motion status
Front Radar Moudle_X_Detection Motion Status
前雷达探测点运动状态";
CM_ SG_ 1011 FRM_40_DetnRngRadial_105 "Detection point radial distance
Front Radar Moudle_X_Detection Range Radial
前雷达探测点径向距离";
CM_ SG_ 1011 FRM_40_DetnAziAngle_105 "Detection point azimuth angle
Front Radar Moudle_X_Detection Azimuth Angle
前雷达探测点水平方位角";
CM_ SG_ 1011 FRM_40_DetnElevnAngle_105 "Detection point elevation angle
Front Radar Moudle_X_Detection Elevation Angle
前雷达探测点俯仰角";
CM_ SG_ 1011 FRM_40_DetnRelVelRadial_105 "Detection point radial relative velocity
Front Radar Moudle_X_Detection Relative Velocity Radial 
前雷达探测点在径向上的相对速度";
CM_ SG_ 1011 FRM_40_DetnSNR_105 "Detection point signal noise ratio
Front Radar Moudle_X_Detection Signal Noise Ratio
前雷达探测点信号噪声比";
CM_ SG_ 1011 FRM_40_DetnRCS_105 "Detection point radar cross section
Front Radar Moudle_X_Detection Radar Cross Section
前雷达探测点雷达散射截面积";
CM_ SG_ 1011 FRM_40_DetnQuality_105 "Detection point quality
Front Radar Moudle_X_Detection Quality
前雷达探测点质量";
CM_ SG_ 1011 FRM_40_DetnMotionSts_106 "Detection point motion status
Front Radar Moudle_X_Detection Motion Status
前雷达探测点运动状态";
CM_ SG_ 1011 FRM_40_DetnRngRadial_106 "Detection point radial distance
Front Radar Moudle_X_Detection Range Radial
前雷达探测点径向距离";
CM_ SG_ 1011 FRM_40_DetnAziAngle_106 "Detection point azimuth angle
Front Radar Moudle_X_Detection Azimuth Angle
前雷达探测点水平方位角";
CM_ SG_ 1011 FRM_40_DetnElevnAngle_106 "Detection point elevation angle
Front Radar Moudle_X_Detection Elevation Angle
前雷达探测点俯仰角";
CM_ SG_ 1011 FRM_40_DetnRelVelRadial_106 "Detection point radial relative velocity
Front Radar Moudle_X_Detection Relative Velocity Radial 
前雷达探测点在径向上的相对速度";
CM_ SG_ 1011 FRM_40_DetnSNR_106 "Detection point signal noise ratio
Front Radar Moudle_X_Detection Signal Noise Ratio
前雷达探测点信号噪声比";
CM_ SG_ 1011 FRM_40_DetnRCS_106 "Detection point radar cross section
Front Radar Moudle_X_Detection Radar Cross Section
前雷达探测点雷达散射截面积";
CM_ SG_ 1011 FRM_40_DetnQuality_106 "Detection point quality
Front Radar Moudle_X_Detection Quality
前雷达探测点质量";
CM_ SG_ 1011 FRM_40_DetnMotionSts_107 "Detection point motion status
Front Radar Moudle_X_Detection Motion Status
前雷达探测点运动状态";
CM_ SG_ 1011 FRM_40_DetnRngRadial_107 "Detection point radial distance
Front Radar Moudle_X_Detection Range Radial
前雷达探测点径向距离";
CM_ SG_ 1011 FRM_40_DetnAziAngle_107 "Detection point azimuth angle
Front Radar Moudle_X_Detection Azimuth Angle
前雷达探测点水平方位角";
CM_ SG_ 1011 FRM_40_DetnElevnAngle_107 "Detection point elevation angle
Front Radar Moudle_X_Detection Elevation Angle
前雷达探测点俯仰角";
CM_ SG_ 1011 FRM_40_DetnRelVelRadial_107 "Detection point radial relative velocity
Front Radar Moudle_X_Detection Relative Velocity Radial 
前雷达探测点在径向上的相对速度";
CM_ SG_ 1011 FRM_40_DetnSNR_107 "Detection point signal noise ratio
Front Radar Moudle_X_Detection Signal Noise Ratio
前雷达探测点信号噪声比";
CM_ SG_ 1011 FRM_40_DetnRCS_107 "Detection point radar cross section
Front Radar Moudle_X_Detection Radar Cross Section
前雷达探测点雷达散射截面积";
CM_ SG_ 1011 FRM_40_DetnQuality_107 "Detection point quality
Front Radar Moudle_X_Detection Quality
前雷达探测点质量";
CM_ SG_ 1012 FRM_41_CRC "Profile5:E2E CRC16 (polynomial:0x1021)       
DataID:Use CANID,other bits Fill with 0";
CM_ SG_ 1012 FRM_41_RollgCntr "Profile5:E2E Rolling message counter";
CM_ SG_ 1012 FRM_41_DetnBlockCounter "Front Radar Moudle_X_Detection Block Counter
前雷达探测点块计数";
CM_ SG_ 1012 FRM_41_DetnMotionSts_108 "Detection point motion status
Front Radar Moudle_X_Detection Motion Status
前雷达探测点运动状态";
CM_ SG_ 1012 FRM_41_DetnRngRadial_108 "Detection point radial distance
Front Radar Moudle_X_Detection Range Radial
前雷达探测点径向距离";
CM_ SG_ 1012 FRM_41_DetnAziAngle_108 "Detection point azimuth angle
Front Radar Moudle_X_Detection Azimuth Angle
前雷达探测点水平方位角";
CM_ SG_ 1012 FRM_41_DetnElevnAngle_108 "Detection point elevation angle
Front Radar Moudle_X_Detection Elevation Angle
前雷达探测点俯仰角";
CM_ SG_ 1012 FRM_41_DetnRelVelRadial_108 "Detection point radial relative velocity
Front Radar Moudle_X_Detection Relative Velocity Radial 
前雷达探测点在径向上的相对速度";
CM_ SG_ 1012 FRM_41_DetnSNR_108 "Detection point signal noise ratio
Front Radar Moudle_X_Detection Signal Noise Ratio
前雷达探测点信号噪声比";
CM_ SG_ 1012 FRM_41_DetnRCS_108 "Detection point radar cross section
Front Radar Moudle_X_Detection Radar Cross Section
前雷达探测点雷达散射截面积";
CM_ SG_ 1012 FRM_41_DetnQuality_108 "Detection point quality
Front Radar Moudle_X_Detection Quality
前雷达探测点质量";
CM_ SG_ 1012 FRM_41_DetnMotionSts_109 "Detection point motion status
Front Radar Moudle_X_Detection Motion Status
前雷达探测点运动状态";
CM_ SG_ 1012 FRM_41_DetnRngRadial_109 "Detection point radial distance
Front Radar Moudle_X_Detection Range Radial
前雷达探测点径向距离";
CM_ SG_ 1012 FRM_41_DetnAziAngle_109 "Detection point azimuth angle
Front Radar Moudle_X_Detection Azimuth Angle
前雷达探测点水平方位角";
CM_ SG_ 1012 FRM_41_DetnElevnAngle_109 "Detection point elevation angle
Front Radar Moudle_X_Detection Elevation Angle
前雷达探测点俯仰角";
CM_ SG_ 1012 FRM_41_DetnRelVelRadial_109 "Detection point radial relative velocity
Front Radar Moudle_X_Detection Relative Velocity Radial 
前雷达探测点在径向上的相对速度";
CM_ SG_ 1012 FRM_41_DetnSNR_109 "Detection point signal noise ratio
Front Radar Moudle_X_Detection Signal Noise Ratio
前雷达探测点信号噪声比";
CM_ SG_ 1012 FRM_41_DetnRCS_109 "Detection point radar cross section
Front Radar Moudle_X_Detection Radar Cross Section
前雷达探测点雷达散射截面积";
CM_ SG_ 1012 FRM_41_DetnQuality_109 "Detection point quality
Front Radar Moudle_X_Detection Quality
前雷达探测点质量";
CM_ SG_ 1012 FRM_41_DetnMotionSts_110 "Detection point motion status
Front Radar Moudle_X_Detection Motion Status
前雷达探测点运动状态";
CM_ SG_ 1012 FRM_41_DetnRngRadial_110 "Detection point radial distance
Front Radar Moudle_X_Detection Range Radial
前雷达探测点径向距离";
CM_ SG_ 1012 FRM_41_DetnAziAngle_110 "Detection point azimuth angle
Front Radar Moudle_X_Detection Azimuth Angle
前雷达探测点水平方位角";
CM_ SG_ 1012 FRM_41_DetnElevnAngle_110 "Detection point elevation angle
Front Radar Moudle_X_Detection Elevation Angle
前雷达探测点俯仰角";
CM_ SG_ 1012 FRM_41_DetnRelVelRadial_110 "Detection point radial relative velocity
Front Radar Moudle_X_Detection Relative Velocity Radial 
前雷达探测点在径向上的相对速度";
CM_ SG_ 1012 FRM_41_DetnSNR_110 "Detection point signal noise ratio
Front Radar Moudle_X_Detection Signal Noise Ratio
前雷达探测点信号噪声比";
CM_ SG_ 1012 FRM_41_DetnRCS_110 "Detection point radar cross section
Front Radar Moudle_X_Detection Radar Cross Section
前雷达探测点雷达散射截面积";
CM_ SG_ 1012 FRM_41_DetnQuality_110 "Detection point quality
Front Radar Moudle_X_Detection Quality
前雷达探测点质量";
CM_ SG_ 1012 FRM_41_DetnMotionSts_111 "Detection point motion status
Front Radar Moudle_X_Detection Motion Status
前雷达探测点运动状态";
CM_ SG_ 1012 FRM_41_DetnRngRadial_111 "Detection point radial distance
Front Radar Moudle_X_Detection Range Radial
前雷达探测点径向距离";
CM_ SG_ 1012 FRM_41_DetnAziAngle_111 "Detection point azimuth angle
Front Radar Moudle_X_Detection Azimuth Angle
前雷达探测点水平方位角";
CM_ SG_ 1012 FRM_41_DetnElevnAngle_111 "Detection point elevation angle
Front Radar Moudle_X_Detection Elevation Angle
前雷达探测点俯仰角";
CM_ SG_ 1012 FRM_41_DetnRelVelRadial_111 "Detection point radial relative velocity
Front Radar Moudle_X_Detection Relative Velocity Radial 
前雷达探测点在径向上的相对速度";
CM_ SG_ 1012 FRM_41_DetnSNR_111 "Detection point signal noise ratio
Front Radar Moudle_X_Detection Signal Noise Ratio
前雷达探测点信号噪声比";
CM_ SG_ 1012 FRM_41_DetnRCS_111 "Detection point radar cross section
Front Radar Moudle_X_Detection Radar Cross Section
前雷达探测点雷达散射截面积";
CM_ SG_ 1012 FRM_41_DetnQuality_111 "Detection point quality
Front Radar Moudle_X_Detection Quality
前雷达探测点质量";
CM_ SG_ 1012 FRM_41_DetnMotionSts_112 "Detection point motion status
Front Radar Moudle_X_Detection Motion Status
前雷达探测点运动状态";
CM_ SG_ 1012 FRM_41_DetnRngRadial_112 "Detection point radial distance
Front Radar Moudle_X_Detection Range Radial
前雷达探测点径向距离";
CM_ SG_ 1012 FRM_41_DetnAziAngle_112 "Detection point azimuth angle
Front Radar Moudle_X_Detection Azimuth Angle
前雷达探测点水平方位角";
CM_ SG_ 1012 FRM_41_DetnElevnAngle_112 "Detection point elevation angle
Front Radar Moudle_X_Detection Elevation Angle
前雷达探测点俯仰角";
CM_ SG_ 1012 FRM_41_DetnRelVelRadial_112 "Detection point radial relative velocity
Front Radar Moudle_X_Detection Relative Velocity Radial 
前雷达探测点在径向上的相对速度";
CM_ SG_ 1012 FRM_41_DetnSNR_112 "Detection point signal noise ratio
Front Radar Moudle_X_Detection Signal Noise Ratio
前雷达探测点信号噪声比";
CM_ SG_ 1012 FRM_41_DetnRCS_112 "Detection point radar cross section
Front Radar Moudle_X_Detection Radar Cross Section
前雷达探测点雷达散射截面积";
CM_ SG_ 1012 FRM_41_DetnQuality_112 "Detection point quality
Front Radar Moudle_X_Detection Quality
前雷达探测点质量";
CM_ SG_ 1012 FRM_41_DetnMotionSts_113 "Detection point motion status
Front Radar Moudle_X_Detection Motion Status
前雷达探测点运动状态";
CM_ SG_ 1012 FRM_41_DetnRngRadial_113 "Detection point radial distance
Front Radar Moudle_X_Detection Range Radial
前雷达探测点径向距离";
CM_ SG_ 1012 FRM_41_DetnAziAngle_113 "Detection point azimuth angle
Front Radar Moudle_X_Detection Azimuth Angle
前雷达探测点水平方位角";
CM_ SG_ 1012 FRM_41_DetnElevnAngle_113 "Detection point elevation angle
Front Radar Moudle_X_Detection Elevation Angle
前雷达探测点俯仰角";
CM_ SG_ 1012 FRM_41_DetnRelVelRadial_113 "Detection point radial relative velocity
Front Radar Moudle_X_Detection Relative Velocity Radial 
前雷达探测点在径向上的相对速度";
CM_ SG_ 1012 FRM_41_DetnSNR_113 "Detection point signal noise ratio
Front Radar Moudle_X_Detection Signal Noise Ratio
前雷达探测点信号噪声比";
CM_ SG_ 1012 FRM_41_DetnRCS_113 "Detection point radar cross section
Front Radar Moudle_X_Detection Radar Cross Section
前雷达探测点雷达散射截面积";
CM_ SG_ 1012 FRM_41_DetnQuality_113 "Detection point quality
Front Radar Moudle_X_Detection Quality
前雷达探测点质量";

BA_DEF_ BO_  "GenMsgSendType" ENUM  "Cyclic","Event","IfActive","CE","CA","NoMsgSendType";
BA_DEF_ BO_  "GenMsgCycleTime" INT 0 0;
BA_DEF_ SG_  "GenSigSendType" ENUM  "Cyclic","OnChange","OnWrite","IfActive","OnChangeWithRepetition","OnWriteWithRepetition","IfActiveWithRepetition","NoSigSendType","OnChangeAndIfActive","OnChangeAndIfActiveWithRepetition","CA","CE","Event";
BA_DEF_ SG_  "GenSigStartValue" INT 0 0;
BA_DEF_ BO_  "GenMsgCycleTimeFast" INT 0 0;
BA_DEF_ BO_  "GenMsgNrOfRepetition" INT 0 0;
BA_DEF_ BO_  "GenMsgDelayTime" INT 0 0;
BA_DEF_ BO_  "CANFD_BRS" ENUM  "0","1";
BA_DEF_ BO_  "VFrameFormat" ENUM  "StandardCAN","ExtendedCAN","reserved","reserved","reserved","reserved","reserved","reserved","reserved","reserved","reserved","reserved","reserved","reserved","StandardCAN_FD","ExtendedCAN_FD";
BA_DEF_ BO_  "GenMsgILSupport" ENUM  "No","Yes";
BA_DEF_ SG_ "GenSigASIL" ENUM "QM","A","B","C","D","";
BA_DEF_DEF_  "GenMsgSendType" "Cyclic";
BA_DEF_DEF_  "GenMsgCycleTime" 0;
BA_DEF_DEF_  "GenSigSendType" "Cyclic";
BA_DEF_DEF_  "GenSigStartValue" 0;
BA_DEF_DEF_  "GenMsgCycleTimeFast" 0;
BA_DEF_DEF_  "GenMsgNrOfRepetition" 0;
BA_DEF_DEF_  "GenMsgDelayTime" 0;
BA_DEF_DEF_  "CANFD_BRS" "1";
BA_DEF_DEF_  "VFrameFormat" "StandardCAN_FD";
BA_DEF_DEF_  "GenMsgILSupport" "No";
BA_DEF_DEF_ "GenSigASIL" "QM";
BA_ "GenMsgILSupport" BO_ 1002 1;
BA_ "GenMsgCycleTime" BO_ 1002 50;
BA_ "GenSigASIL"  SG_ 1002 FRM_31_CRC 5;
BA_ "GenSigASIL"  SG_ 1002 FRM_31_RollgCntr 5;
BA_ "GenSigASIL"  SG_ 1002 FRM_31_DetnBlockCounter 2;
BA_ "GenSigASIL"  SG_ 1002 FRM_31_DetnMotionSts_048 2;
BA_ "GenSigASIL"  SG_ 1002 FRM_31_DetnRngRadial_048 2;
BA_ "GenSigStartValue" SG_ 1002 FRM_31_DetnAziAngle_048 900;
BA_ "GenSigASIL"  SG_ 1002 FRM_31_DetnAziAngle_048 2;
BA_ "GenSigStartValue" SG_ 1002 FRM_31_DetnElevnAngle_048 100;
BA_ "GenSigASIL"  SG_ 1002 FRM_31_DetnElevnAngle_048 2;
BA_ "GenSigStartValue" SG_ 1002 FRM_31_DetnRelVelRadial_048 10000;
BA_ "GenSigASIL"  SG_ 1002 FRM_31_DetnRelVelRadial_048 2;
BA_ "GenSigASIL"  SG_ 1002 FRM_31_DetnSNR_048 2;
BA_ "GenSigStartValue" SG_ 1002 FRM_31_DetnRCS_048 5000;
BA_ "GenSigASIL"  SG_ 1002 FRM_31_DetnRCS_048 2;
BA_ "GenSigASIL"  SG_ 1002 FRM_31_DetnQuality_048 2;
BA_ "GenSigASIL"  SG_ 1002 FRM_31_DetnMotionSts_049 2;
BA_ "GenSigASIL"  SG_ 1002 FRM_31_DetnRngRadial_049 2;
BA_ "GenSigStartValue" SG_ 1002 FRM_31_DetnAziAngle_049 900;
BA_ "GenSigASIL"  SG_ 1002 FRM_31_DetnAziAngle_049 2;
BA_ "GenSigStartValue" SG_ 1002 FRM_31_DetnElevnAngle_049 100;
BA_ "GenSigASIL"  SG_ 1002 FRM_31_DetnElevnAngle_049 2;
BA_ "GenSigStartValue" SG_ 1002 FRM_31_DetnRelVelRadial_049 10000;
BA_ "GenSigASIL"  SG_ 1002 FRM_31_DetnRelVelRadial_049 2;
BA_ "GenSigASIL"  SG_ 1002 FRM_31_DetnSNR_049 2;
BA_ "GenSigStartValue" SG_ 1002 FRM_31_DetnRCS_049 5000;
BA_ "GenSigASIL"  SG_ 1002 FRM_31_DetnRCS_049 2;
BA_ "GenSigASIL"  SG_ 1002 FRM_31_DetnQuality_049 2;
BA_ "GenSigASIL"  SG_ 1002 FRM_31_DetnMotionSts_050 2;
BA_ "GenSigASIL"  SG_ 1002 FRM_31_DetnRngRadial_050 2;
BA_ "GenSigStartValue" SG_ 1002 FRM_31_DetnAziAngle_050 900;
BA_ "GenSigASIL"  SG_ 1002 FRM_31_DetnAziAngle_050 2;
BA_ "GenSigStartValue" SG_ 1002 FRM_31_DetnElevnAngle_050 100;
BA_ "GenSigASIL"  SG_ 1002 FRM_31_DetnElevnAngle_050 2;
BA_ "GenSigStartValue" SG_ 1002 FRM_31_DetnRelVelRadial_050 10000;
BA_ "GenSigASIL"  SG_ 1002 FRM_31_DetnRelVelRadial_050 2;
BA_ "GenSigASIL"  SG_ 1002 FRM_31_DetnSNR_050 2;
BA_ "GenSigStartValue" SG_ 1002 FRM_31_DetnRCS_050 5000;
BA_ "GenSigASIL"  SG_ 1002 FRM_31_DetnRCS_050 2;
BA_ "GenSigASIL"  SG_ 1002 FRM_31_DetnQuality_050 2;
BA_ "GenSigASIL"  SG_ 1002 FRM_31_DetnMotionSts_051 2;
BA_ "GenSigASIL"  SG_ 1002 FRM_31_DetnRngRadial_051 2;
BA_ "GenSigStartValue" SG_ 1002 FRM_31_DetnAziAngle_051 900;
BA_ "GenSigASIL"  SG_ 1002 FRM_31_DetnAziAngle_051 2;
BA_ "GenSigStartValue" SG_ 1002 FRM_31_DetnElevnAngle_051 100;
BA_ "GenSigASIL"  SG_ 1002 FRM_31_DetnElevnAngle_051 2;
BA_ "GenSigStartValue" SG_ 1002 FRM_31_DetnRelVelRadial_051 10000;
BA_ "GenSigASIL"  SG_ 1002 FRM_31_DetnRelVelRadial_051 2;
BA_ "GenSigASIL"  SG_ 1002 FRM_31_DetnSNR_051 2;
BA_ "GenSigStartValue" SG_ 1002 FRM_31_DetnRCS_051 5000;
BA_ "GenSigASIL"  SG_ 1002 FRM_31_DetnRCS_051 2;
BA_ "GenSigASIL"  SG_ 1002 FRM_31_DetnQuality_051 2;
BA_ "GenSigASIL"  SG_ 1002 FRM_31_DetnMotionSts_052 2;
BA_ "GenSigASIL"  SG_ 1002 FRM_31_DetnRngRadial_052 2;
BA_ "GenSigStartValue" SG_ 1002 FRM_31_DetnAziAngle_052 900;
BA_ "GenSigASIL"  SG_ 1002 FRM_31_DetnAziAngle_052 2;
BA_ "GenSigStartValue" SG_ 1002 FRM_31_DetnElevnAngle_052 100;
BA_ "GenSigASIL"  SG_ 1002 FRM_31_DetnElevnAngle_052 2;
BA_ "GenSigStartValue" SG_ 1002 FRM_31_DetnRelVelRadial_052 10000;
BA_ "GenSigASIL"  SG_ 1002 FRM_31_DetnRelVelRadial_052 2;
BA_ "GenSigASIL"  SG_ 1002 FRM_31_DetnSNR_052 2;
BA_ "GenSigStartValue" SG_ 1002 FRM_31_DetnRCS_052 5000;
BA_ "GenSigASIL"  SG_ 1002 FRM_31_DetnRCS_052 2;
BA_ "GenSigASIL"  SG_ 1002 FRM_31_DetnQuality_052 2;
BA_ "GenSigASIL"  SG_ 1002 FRM_31_DetnMotionSts_053 2;
BA_ "GenSigASIL"  SG_ 1002 FRM_31_DetnRngRadial_053 2;
BA_ "GenSigStartValue" SG_ 1002 FRM_31_DetnAziAngle_053 900;
BA_ "GenSigASIL"  SG_ 1002 FRM_31_DetnAziAngle_053 2;
BA_ "GenSigStartValue" SG_ 1002 FRM_31_DetnElevnAngle_053 100;
BA_ "GenSigASIL"  SG_ 1002 FRM_31_DetnElevnAngle_053 2;
BA_ "GenSigStartValue" SG_ 1002 FRM_31_DetnRelVelRadial_053 10000;
BA_ "GenSigASIL"  SG_ 1002 FRM_31_DetnRelVelRadial_053 2;
BA_ "GenSigASIL"  SG_ 1002 FRM_31_DetnSNR_053 2;
BA_ "GenSigStartValue" SG_ 1002 FRM_31_DetnRCS_053 5000;
BA_ "GenSigASIL"  SG_ 1002 FRM_31_DetnRCS_053 2;
BA_ "GenSigASIL"  SG_ 1002 FRM_31_DetnQuality_053 2;
BA_ "GenMsgILSupport" BO_ 1003 1;
BA_ "GenMsgCycleTime" BO_ 1003 50;
BA_ "GenSigASIL"  SG_ 1003 FRM_32_CRC 5;
BA_ "GenSigASIL"  SG_ 1003 FRM_32_RollgCntr 5;
BA_ "GenSigASIL"  SG_ 1003 FRM_32_DetnBlockCounter 2;
BA_ "GenSigASIL"  SG_ 1003 FRM_32_DetnMotionSts_054 2;
BA_ "GenSigASIL"  SG_ 1003 FRM_32_DetnRngRadial_054 2;
BA_ "GenSigStartValue" SG_ 1003 FRM_32_DetnAziAngle_054 900;
BA_ "GenSigASIL"  SG_ 1003 FRM_32_DetnAziAngle_054 2;
BA_ "GenSigStartValue" SG_ 1003 FRM_32_DetnElevnAngle_054 100;
BA_ "GenSigASIL"  SG_ 1003 FRM_32_DetnElevnAngle_054 2;
BA_ "GenSigStartValue" SG_ 1003 FRM_32_DetnRelVelRadial_054 10000;
BA_ "GenSigASIL"  SG_ 1003 FRM_32_DetnRelVelRadial_054 2;
BA_ "GenSigASIL"  SG_ 1003 FRM_32_DetnSNR_054 2;
BA_ "GenSigStartValue" SG_ 1003 FRM_32_DetnRCS_054 5000;
BA_ "GenSigASIL"  SG_ 1003 FRM_32_DetnRCS_054 2;
BA_ "GenSigASIL"  SG_ 1003 FRM_32_DetnQuality_054 2;
BA_ "GenSigASIL"  SG_ 1003 FRM_32_DetnMotionSts_055 2;
BA_ "GenSigASIL"  SG_ 1003 FRM_32_DetnRngRadial_055 2;
BA_ "GenSigStartValue" SG_ 1003 FRM_32_DetnAziAngle_055 900;
BA_ "GenSigASIL"  SG_ 1003 FRM_32_DetnAziAngle_055 2;
BA_ "GenSigStartValue" SG_ 1003 FRM_32_DetnElevnAngle_055 100;
BA_ "GenSigASIL"  SG_ 1003 FRM_32_DetnElevnAngle_055 2;
BA_ "GenSigStartValue" SG_ 1003 FRM_32_DetnRelVelRadial_055 10000;
BA_ "GenSigASIL"  SG_ 1003 FRM_32_DetnRelVelRadial_055 2;
BA_ "GenSigASIL"  SG_ 1003 FRM_32_DetnSNR_055 2;
BA_ "GenSigStartValue" SG_ 1003 FRM_32_DetnRCS_055 5000;
BA_ "GenSigASIL"  SG_ 1003 FRM_32_DetnRCS_055 2;
BA_ "GenSigASIL"  SG_ 1003 FRM_32_DetnQuality_055 2;
BA_ "GenSigASIL"  SG_ 1003 FRM_32_DetnMotionSts_056 2;
BA_ "GenSigASIL"  SG_ 1003 FRM_32_DetnRngRadial_056 2;
BA_ "GenSigStartValue" SG_ 1003 FRM_32_DetnAziAngle_056 900;
BA_ "GenSigASIL"  SG_ 1003 FRM_32_DetnAziAngle_056 2;
BA_ "GenSigStartValue" SG_ 1003 FRM_32_DetnElevnAngle_056 100;
BA_ "GenSigASIL"  SG_ 1003 FRM_32_DetnElevnAngle_056 2;
BA_ "GenSigStartValue" SG_ 1003 FRM_32_DetnRelVelRadial_056 10000;
BA_ "GenSigASIL"  SG_ 1003 FRM_32_DetnRelVelRadial_056 2;
BA_ "GenSigASIL"  SG_ 1003 FRM_32_DetnSNR_056 2;
BA_ "GenSigStartValue" SG_ 1003 FRM_32_DetnRCS_056 5000;
BA_ "GenSigASIL"  SG_ 1003 FRM_32_DetnRCS_056 2;
BA_ "GenSigASIL"  SG_ 1003 FRM_32_DetnQuality_056 2;
BA_ "GenSigASIL"  SG_ 1003 FRM_32_DetnMotionSts_057 2;
BA_ "GenSigASIL"  SG_ 1003 FRM_32_DetnRngRadial_057 2;
BA_ "GenSigStartValue" SG_ 1003 FRM_32_DetnAziAngle_057 900;
BA_ "GenSigASIL"  SG_ 1003 FRM_32_DetnAziAngle_057 2;
BA_ "GenSigStartValue" SG_ 1003 FRM_32_DetnElevnAngle_057 100;
BA_ "GenSigASIL"  SG_ 1003 FRM_32_DetnElevnAngle_057 2;
BA_ "GenSigStartValue" SG_ 1003 FRM_32_DetnRelVelRadial_057 10000;
BA_ "GenSigASIL"  SG_ 1003 FRM_32_DetnRelVelRadial_057 2;
BA_ "GenSigASIL"  SG_ 1003 FRM_32_DetnSNR_057 2;
BA_ "GenSigStartValue" SG_ 1003 FRM_32_DetnRCS_057 5000;
BA_ "GenSigASIL"  SG_ 1003 FRM_32_DetnRCS_057 2;
BA_ "GenSigASIL"  SG_ 1003 FRM_32_DetnQuality_057 2;
BA_ "GenSigASIL"  SG_ 1003 FRM_32_DetnMotionSts_058 2;
BA_ "GenSigASIL"  SG_ 1003 FRM_32_DetnRngRadial_058 2;
BA_ "GenSigStartValue" SG_ 1003 FRM_32_DetnAziAngle_058 900;
BA_ "GenSigASIL"  SG_ 1003 FRM_32_DetnAziAngle_058 2;
BA_ "GenSigStartValue" SG_ 1003 FRM_32_DetnElevnAngle_058 100;
BA_ "GenSigASIL"  SG_ 1003 FRM_32_DetnElevnAngle_058 2;
BA_ "GenSigStartValue" SG_ 1003 FRM_32_DetnRelVelRadial_058 10000;
BA_ "GenSigASIL"  SG_ 1003 FRM_32_DetnRelVelRadial_058 2;
BA_ "GenSigASIL"  SG_ 1003 FRM_32_DetnSNR_058 2;
BA_ "GenSigStartValue" SG_ 1003 FRM_32_DetnRCS_058 5000;
BA_ "GenSigASIL"  SG_ 1003 FRM_32_DetnRCS_058 2;
BA_ "GenSigASIL"  SG_ 1003 FRM_32_DetnQuality_058 2;
BA_ "GenSigASIL"  SG_ 1003 FRM_32_DetnMotionSts_059 2;
BA_ "GenSigASIL"  SG_ 1003 FRM_32_DetnRngRadial_059 2;
BA_ "GenSigStartValue" SG_ 1003 FRM_32_DetnAziAngle_059 900;
BA_ "GenSigASIL"  SG_ 1003 FRM_32_DetnAziAngle_059 2;
BA_ "GenSigStartValue" SG_ 1003 FRM_32_DetnElevnAngle_059 100;
BA_ "GenSigASIL"  SG_ 1003 FRM_32_DetnElevnAngle_059 2;
BA_ "GenSigStartValue" SG_ 1003 FRM_32_DetnRelVelRadial_059 10000;
BA_ "GenSigASIL"  SG_ 1003 FRM_32_DetnRelVelRadial_059 2;
BA_ "GenSigASIL"  SG_ 1003 FRM_32_DetnSNR_059 2;
BA_ "GenSigStartValue" SG_ 1003 FRM_32_DetnRCS_059 5000;
BA_ "GenSigASIL"  SG_ 1003 FRM_32_DetnRCS_059 2;
BA_ "GenSigASIL"  SG_ 1003 FRM_32_DetnQuality_059 2;
BA_ "GenMsgILSupport" BO_ 1004 1;
BA_ "GenMsgCycleTime" BO_ 1004 50;
BA_ "GenSigASIL"  SG_ 1004 FRM_33_CRC 5;
BA_ "GenSigASIL"  SG_ 1004 FRM_33_RollgCntr 5;
BA_ "GenSigASIL"  SG_ 1004 FRM_33_DetnBlockCounter 2;
BA_ "GenSigASIL"  SG_ 1004 FRM_33_DetnMotionSts_060 2;
BA_ "GenSigASIL"  SG_ 1004 FRM_33_DetnRngRadial_060 2;
BA_ "GenSigStartValue" SG_ 1004 FRM_33_DetnAziAngle_060 900;
BA_ "GenSigASIL"  SG_ 1004 FRM_33_DetnAziAngle_060 2;
BA_ "GenSigStartValue" SG_ 1004 FRM_33_DetnElevnAngle_060 100;
BA_ "GenSigASIL"  SG_ 1004 FRM_33_DetnElevnAngle_060 2;
BA_ "GenSigStartValue" SG_ 1004 FRM_33_DetnRelVelRadial_060 10000;
BA_ "GenSigASIL"  SG_ 1004 FRM_33_DetnRelVelRadial_060 2;
BA_ "GenSigASIL"  SG_ 1004 FRM_33_DetnSNR_060 2;
BA_ "GenSigStartValue" SG_ 1004 FRM_33_DetnRCS_060 5000;
BA_ "GenSigASIL"  SG_ 1004 FRM_33_DetnRCS_060 2;
BA_ "GenSigASIL"  SG_ 1004 FRM_33_DetnQuality_060 2;
BA_ "GenSigASIL"  SG_ 1004 FRM_33_DetnMotionSts_061 2;
BA_ "GenSigASIL"  SG_ 1004 FRM_33_DetnRngRadial_061 2;
BA_ "GenSigStartValue" SG_ 1004 FRM_33_DetnAziAngle_061 900;
BA_ "GenSigASIL"  SG_ 1004 FRM_33_DetnAziAngle_061 2;
BA_ "GenSigStartValue" SG_ 1004 FRM_33_DetnElevnAngle_061 100;
BA_ "GenSigASIL"  SG_ 1004 FRM_33_DetnElevnAngle_061 2;
BA_ "GenSigStartValue" SG_ 1004 FRM_33_DetnRelVelRadial_061 10000;
BA_ "GenSigASIL"  SG_ 1004 FRM_33_DetnRelVelRadial_061 2;
BA_ "GenSigASIL"  SG_ 1004 FRM_33_DetnSNR_061 2;
BA_ "GenSigStartValue" SG_ 1004 FRM_33_DetnRCS_061 5000;
BA_ "GenSigASIL"  SG_ 1004 FRM_33_DetnRCS_061 2;
BA_ "GenSigASIL"  SG_ 1004 FRM_33_DetnQuality_061 2;
BA_ "GenSigASIL"  SG_ 1004 FRM_33_DetnMotionSts_062 2;
BA_ "GenSigASIL"  SG_ 1004 FRM_33_DetnRngRadial_062 2;
BA_ "GenSigStartValue" SG_ 1004 FRM_33_DetnAziAngle_062 900;
BA_ "GenSigASIL"  SG_ 1004 FRM_33_DetnAziAngle_062 2;
BA_ "GenSigStartValue" SG_ 1004 FRM_33_DetnElevnAngle_062 100;
BA_ "GenSigASIL"  SG_ 1004 FRM_33_DetnElevnAngle_062 2;
BA_ "GenSigStartValue" SG_ 1004 FRM_33_DetnRelVelRadial_062 10000;
BA_ "GenSigASIL"  SG_ 1004 FRM_33_DetnRelVelRadial_062 2;
BA_ "GenSigASIL"  SG_ 1004 FRM_33_DetnSNR_062 2;
BA_ "GenSigStartValue" SG_ 1004 FRM_33_DetnRCS_062 5000;
BA_ "GenSigASIL"  SG_ 1004 FRM_33_DetnRCS_062 2;
BA_ "GenSigASIL"  SG_ 1004 FRM_33_DetnQuality_062 2;
BA_ "GenSigASIL"  SG_ 1004 FRM_33_DetnMotionSts_063 2;
BA_ "GenSigASIL"  SG_ 1004 FRM_33_DetnRngRadial_063 2;
BA_ "GenSigStartValue" SG_ 1004 FRM_33_DetnAziAngle_063 900;
BA_ "GenSigASIL"  SG_ 1004 FRM_33_DetnAziAngle_063 2;
BA_ "GenSigStartValue" SG_ 1004 FRM_33_DetnElevnAngle_063 100;
BA_ "GenSigASIL"  SG_ 1004 FRM_33_DetnElevnAngle_063 2;
BA_ "GenSigStartValue" SG_ 1004 FRM_33_DetnRelVelRadial_063 10000;
BA_ "GenSigASIL"  SG_ 1004 FRM_33_DetnRelVelRadial_063 2;
BA_ "GenSigASIL"  SG_ 1004 FRM_33_DetnSNR_063 2;
BA_ "GenSigStartValue" SG_ 1004 FRM_33_DetnRCS_063 5000;
BA_ "GenSigASIL"  SG_ 1004 FRM_33_DetnRCS_063 2;
BA_ "GenSigASIL"  SG_ 1004 FRM_33_DetnQuality_063 2;
BA_ "GenSigASIL"  SG_ 1004 FRM_33_DetnMotionSts_064 2;
BA_ "GenSigASIL"  SG_ 1004 FRM_33_DetnRngRadial_064 2;
BA_ "GenSigStartValue" SG_ 1004 FRM_33_DetnAziAngle_064 900;
BA_ "GenSigASIL"  SG_ 1004 FRM_33_DetnAziAngle_064 2;
BA_ "GenSigStartValue" SG_ 1004 FRM_33_DetnElevnAngle_064 100;
BA_ "GenSigASIL"  SG_ 1004 FRM_33_DetnElevnAngle_064 2;
BA_ "GenSigStartValue" SG_ 1004 FRM_33_DetnRelVelRadial_064 10000;
BA_ "GenSigASIL"  SG_ 1004 FRM_33_DetnRelVelRadial_064 2;
BA_ "GenSigASIL"  SG_ 1004 FRM_33_DetnSNR_064 2;
BA_ "GenSigStartValue" SG_ 1004 FRM_33_DetnRCS_064 5000;
BA_ "GenSigASIL"  SG_ 1004 FRM_33_DetnRCS_064 2;
BA_ "GenSigASIL"  SG_ 1004 FRM_33_DetnQuality_064 2;
BA_ "GenSigASIL"  SG_ 1004 FRM_33_DetnMotionSts_065 2;
BA_ "GenSigASIL"  SG_ 1004 FRM_33_DetnRngRadial_065 2;
BA_ "GenSigStartValue" SG_ 1004 FRM_33_DetnAziAngle_065 900;
BA_ "GenSigASIL"  SG_ 1004 FRM_33_DetnAziAngle_065 2;
BA_ "GenSigStartValue" SG_ 1004 FRM_33_DetnElevnAngle_065 100;
BA_ "GenSigASIL"  SG_ 1004 FRM_33_DetnElevnAngle_065 2;
BA_ "GenSigStartValue" SG_ 1004 FRM_33_DetnRelVelRadial_065 10000;
BA_ "GenSigASIL"  SG_ 1004 FRM_33_DetnRelVelRadial_065 2;
BA_ "GenSigASIL"  SG_ 1004 FRM_33_DetnSNR_065 2;
BA_ "GenSigStartValue" SG_ 1004 FRM_33_DetnRCS_065 5000;
BA_ "GenSigASIL"  SG_ 1004 FRM_33_DetnRCS_065 2;
BA_ "GenSigASIL"  SG_ 1004 FRM_33_DetnQuality_065 2;
BA_ "GenMsgILSupport" BO_ 1005 1;
BA_ "GenMsgCycleTime" BO_ 1005 50;
BA_ "GenSigASIL"  SG_ 1005 FRM_34_CRC 5;
BA_ "GenSigASIL"  SG_ 1005 FRM_34_RollgCntr 5;
BA_ "GenSigASIL"  SG_ 1005 FRM_34_DetnBlockCounter 2;
BA_ "GenSigASIL"  SG_ 1005 FRM_34_DetnMotionSts_066 2;
BA_ "GenSigASIL"  SG_ 1005 FRM_34_DetnRngRadial_066 2;
BA_ "GenSigStartValue" SG_ 1005 FRM_34_DetnAziAngle_066 900;
BA_ "GenSigASIL"  SG_ 1005 FRM_34_DetnAziAngle_066 2;
BA_ "GenSigStartValue" SG_ 1005 FRM_34_DetnElevnAngle_066 100;
BA_ "GenSigASIL"  SG_ 1005 FRM_34_DetnElevnAngle_066 2;
BA_ "GenSigStartValue" SG_ 1005 FRM_34_DetnRelVelRadial_066 10000;
BA_ "GenSigASIL"  SG_ 1005 FRM_34_DetnRelVelRadial_066 2;
BA_ "GenSigASIL"  SG_ 1005 FRM_34_DetnSNR_066 2;
BA_ "GenSigStartValue" SG_ 1005 FRM_34_DetnRCS_066 5000;
BA_ "GenSigASIL"  SG_ 1005 FRM_34_DetnRCS_066 2;
BA_ "GenSigASIL"  SG_ 1005 FRM_34_DetnQuality_066 2;
BA_ "GenSigASIL"  SG_ 1005 FRM_34_DetnMotionSts_067 2;
BA_ "GenSigASIL"  SG_ 1005 FRM_34_DetnRngRadial_067 2;
BA_ "GenSigStartValue" SG_ 1005 FRM_34_DetnAziAngle_067 900;
BA_ "GenSigASIL"  SG_ 1005 FRM_34_DetnAziAngle_067 2;
BA_ "GenSigStartValue" SG_ 1005 FRM_34_DetnElevnAngle_067 100;
BA_ "GenSigASIL"  SG_ 1005 FRM_34_DetnElevnAngle_067 2;
BA_ "GenSigStartValue" SG_ 1005 FRM_34_DetnRelVelRadial_067 10000;
BA_ "GenSigASIL"  SG_ 1005 FRM_34_DetnRelVelRadial_067 2;
BA_ "GenSigASIL"  SG_ 1005 FRM_34_DetnSNR_067 2;
BA_ "GenSigStartValue" SG_ 1005 FRM_34_DetnRCS_067 5000;
BA_ "GenSigASIL"  SG_ 1005 FRM_34_DetnRCS_067 2;
BA_ "GenSigASIL"  SG_ 1005 FRM_34_DetnQuality_067 2;
BA_ "GenSigASIL"  SG_ 1005 FRM_34_DetnMotionSts_068 2;
BA_ "GenSigASIL"  SG_ 1005 FRM_34_DetnRngRadial_068 2;
BA_ "GenSigStartValue" SG_ 1005 FRM_34_DetnAziAngle_068 900;
BA_ "GenSigASIL"  SG_ 1005 FRM_34_DetnAziAngle_068 2;
BA_ "GenSigStartValue" SG_ 1005 FRM_34_DetnElevnAngle_068 100;
BA_ "GenSigASIL"  SG_ 1005 FRM_34_DetnElevnAngle_068 2;
BA_ "GenSigStartValue" SG_ 1005 FRM_34_DetnRelVelRadial_068 10000;
BA_ "GenSigASIL"  SG_ 1005 FRM_34_DetnRelVelRadial_068 2;
BA_ "GenSigASIL"  SG_ 1005 FRM_34_DetnSNR_068 2;
BA_ "GenSigStartValue" SG_ 1005 FRM_34_DetnRCS_068 5000;
BA_ "GenSigASIL"  SG_ 1005 FRM_34_DetnRCS_068 2;
BA_ "GenSigASIL"  SG_ 1005 FRM_34_DetnQuality_068 2;
BA_ "GenSigASIL"  SG_ 1005 FRM_34_DetnMotionSts_069 2;
BA_ "GenSigASIL"  SG_ 1005 FRM_34_DetnRngRadial_069 2;
BA_ "GenSigStartValue" SG_ 1005 FRM_34_DetnAziAngle_069 900;
BA_ "GenSigASIL"  SG_ 1005 FRM_34_DetnAziAngle_069 2;
BA_ "GenSigStartValue" SG_ 1005 FRM_34_DetnElevnAngle_069 100;
BA_ "GenSigASIL"  SG_ 1005 FRM_34_DetnElevnAngle_069 2;
BA_ "GenSigStartValue" SG_ 1005 FRM_34_DetnRelVelRadial_069 10000;
BA_ "GenSigASIL"  SG_ 1005 FRM_34_DetnRelVelRadial_069 2;
BA_ "GenSigASIL"  SG_ 1005 FRM_34_DetnSNR_069 2;
BA_ "GenSigStartValue" SG_ 1005 FRM_34_DetnRCS_069 5000;
BA_ "GenSigASIL"  SG_ 1005 FRM_34_DetnRCS_069 2;
BA_ "GenSigASIL"  SG_ 1005 FRM_34_DetnQuality_069 2;
BA_ "GenSigASIL"  SG_ 1005 FRM_34_DetnMotionSts_070 2;
BA_ "GenSigASIL"  SG_ 1005 FRM_34_DetnRngRadial_070 2;
BA_ "GenSigStartValue" SG_ 1005 FRM_34_DetnAziAngle_070 900;
BA_ "GenSigASIL"  SG_ 1005 FRM_34_DetnAziAngle_070 2;
BA_ "GenSigStartValue" SG_ 1005 FRM_34_DetnElevnAngle_070 100;
BA_ "GenSigASIL"  SG_ 1005 FRM_34_DetnElevnAngle_070 2;
BA_ "GenSigStartValue" SG_ 1005 FRM_34_DetnRelVelRadial_070 10000;
BA_ "GenSigASIL"  SG_ 1005 FRM_34_DetnRelVelRadial_070 2;
BA_ "GenSigASIL"  SG_ 1005 FRM_34_DetnSNR_070 2;
BA_ "GenSigStartValue" SG_ 1005 FRM_34_DetnRCS_070 5000;
BA_ "GenSigASIL"  SG_ 1005 FRM_34_DetnRCS_070 2;
BA_ "GenSigASIL"  SG_ 1005 FRM_34_DetnQuality_070 2;
BA_ "GenSigASIL"  SG_ 1005 FRM_34_DetnMotionSts_071 2;
BA_ "GenSigASIL"  SG_ 1005 FRM_34_DetnRngRadial_071 2;
BA_ "GenSigStartValue" SG_ 1005 FRM_34_DetnAziAngle_071 900;
BA_ "GenSigASIL"  SG_ 1005 FRM_34_DetnAziAngle_071 2;
BA_ "GenSigStartValue" SG_ 1005 FRM_34_DetnElevnAngle_071 100;
BA_ "GenSigASIL"  SG_ 1005 FRM_34_DetnElevnAngle_071 2;
BA_ "GenSigStartValue" SG_ 1005 FRM_34_DetnRelVelRadial_071 10000;
BA_ "GenSigASIL"  SG_ 1005 FRM_34_DetnRelVelRadial_071 2;
BA_ "GenSigASIL"  SG_ 1005 FRM_34_DetnSNR_071 2;
BA_ "GenSigStartValue" SG_ 1005 FRM_34_DetnRCS_071 5000;
BA_ "GenSigASIL"  SG_ 1005 FRM_34_DetnRCS_071 2;
BA_ "GenSigASIL"  SG_ 1005 FRM_34_DetnQuality_071 2;
BA_ "GenMsgILSupport" BO_ 1006 1;
BA_ "GenMsgCycleTime" BO_ 1006 50;
BA_ "GenSigASIL"  SG_ 1006 FRM_35_CRC 5;
BA_ "GenSigASIL"  SG_ 1006 FRM_35_RollgCntr 5;
BA_ "GenSigASIL"  SG_ 1006 FRM_35_DetnBlockCounter 2;
BA_ "GenSigASIL"  SG_ 1006 FRM_35_DetnMotionSts_072 2;
BA_ "GenSigASIL"  SG_ 1006 FRM_35_DetnRngRadial_072 2;
BA_ "GenSigStartValue" SG_ 1006 FRM_35_DetnAziAngle_072 900;
BA_ "GenSigASIL"  SG_ 1006 FRM_35_DetnAziAngle_072 2;
BA_ "GenSigStartValue" SG_ 1006 FRM_35_DetnElevnAngle_072 100;
BA_ "GenSigASIL"  SG_ 1006 FRM_35_DetnElevnAngle_072 2;
BA_ "GenSigStartValue" SG_ 1006 FRM_35_DetnRelVelRadial_072 10000;
BA_ "GenSigASIL"  SG_ 1006 FRM_35_DetnRelVelRadial_072 2;
BA_ "GenSigASIL"  SG_ 1006 FRM_35_DetnSNR_072 2;
BA_ "GenSigStartValue" SG_ 1006 FRM_35_DetnRCS_072 5000;
BA_ "GenSigASIL"  SG_ 1006 FRM_35_DetnRCS_072 2;
BA_ "GenSigASIL"  SG_ 1006 FRM_35_DetnQuality_072 2;
BA_ "GenSigASIL"  SG_ 1006 FRM_35_DetnMotionSts_073 2;
BA_ "GenSigASIL"  SG_ 1006 FRM_35_DetnRngRadial_073 2;
BA_ "GenSigStartValue" SG_ 1006 FRM_35_DetnAziAngle_073 900;
BA_ "GenSigASIL"  SG_ 1006 FRM_35_DetnAziAngle_073 2;
BA_ "GenSigStartValue" SG_ 1006 FRM_35_DetnElevnAngle_073 100;
BA_ "GenSigASIL"  SG_ 1006 FRM_35_DetnElevnAngle_073 2;
BA_ "GenSigStartValue" SG_ 1006 FRM_35_DetnRelVelRadial_073 10000;
BA_ "GenSigASIL"  SG_ 1006 FRM_35_DetnRelVelRadial_073 2;
BA_ "GenSigASIL"  SG_ 1006 FRM_35_DetnSNR_073 2;
BA_ "GenSigStartValue" SG_ 1006 FRM_35_DetnRCS_073 5000;
BA_ "GenSigASIL"  SG_ 1006 FRM_35_DetnRCS_073 2;
BA_ "GenSigASIL"  SG_ 1006 FRM_35_DetnQuality_073 2;
BA_ "GenSigASIL"  SG_ 1006 FRM_35_DetnMotionSts_074 2;
BA_ "GenSigASIL"  SG_ 1006 FRM_35_DetnRngRadial_074 2;
BA_ "GenSigStartValue" SG_ 1006 FRM_35_DetnAziAngle_074 900;
BA_ "GenSigASIL"  SG_ 1006 FRM_35_DetnAziAngle_074 2;
BA_ "GenSigStartValue" SG_ 1006 FRM_35_DetnElevnAngle_074 100;
BA_ "GenSigASIL"  SG_ 1006 FRM_35_DetnElevnAngle_074 2;
BA_ "GenSigStartValue" SG_ 1006 FRM_35_DetnRelVelRadial_074 10000;
BA_ "GenSigASIL"  SG_ 1006 FRM_35_DetnRelVelRadial_074 2;
BA_ "GenSigASIL"  SG_ 1006 FRM_35_DetnSNR_074 2;
BA_ "GenSigStartValue" SG_ 1006 FRM_35_DetnRCS_074 5000;
BA_ "GenSigASIL"  SG_ 1006 FRM_35_DetnRCS_074 2;
BA_ "GenSigASIL"  SG_ 1006 FRM_35_DetnQuality_074 2;
BA_ "GenSigASIL"  SG_ 1006 FRM_35_DetnMotionSts_075 2;
BA_ "GenSigASIL"  SG_ 1006 FRM_35_DetnRngRadial_075 2;
BA_ "GenSigStartValue" SG_ 1006 FRM_35_DetnAziAngle_075 900;
BA_ "GenSigASIL"  SG_ 1006 FRM_35_DetnAziAngle_075 2;
BA_ "GenSigStartValue" SG_ 1006 FRM_35_DetnElevnAngle_075 100;
BA_ "GenSigASIL"  SG_ 1006 FRM_35_DetnElevnAngle_075 2;
BA_ "GenSigStartValue" SG_ 1006 FRM_35_DetnRelVelRadial_075 10000;
BA_ "GenSigASIL"  SG_ 1006 FRM_35_DetnRelVelRadial_075 2;
BA_ "GenSigASIL"  SG_ 1006 FRM_35_DetnSNR_075 2;
BA_ "GenSigStartValue" SG_ 1006 FRM_35_DetnRCS_075 5000;
BA_ "GenSigASIL"  SG_ 1006 FRM_35_DetnRCS_075 2;
BA_ "GenSigASIL"  SG_ 1006 FRM_35_DetnQuality_075 2;
BA_ "GenSigASIL"  SG_ 1006 FRM_35_DetnMotionSts_076 2;
BA_ "GenSigASIL"  SG_ 1006 FRM_35_DetnRngRadial_076 2;
BA_ "GenSigStartValue" SG_ 1006 FRM_35_DetnAziAngle_076 900;
BA_ "GenSigASIL"  SG_ 1006 FRM_35_DetnAziAngle_076 2;
BA_ "GenSigStartValue" SG_ 1006 FRM_35_DetnElevnAngle_076 100;
BA_ "GenSigASIL"  SG_ 1006 FRM_35_DetnElevnAngle_076 2;
BA_ "GenSigStartValue" SG_ 1006 FRM_35_DetnRelVelRadial_076 10000;
BA_ "GenSigASIL"  SG_ 1006 FRM_35_DetnRelVelRadial_076 2;
BA_ "GenSigASIL"  SG_ 1006 FRM_35_DetnSNR_076 2;
BA_ "GenSigStartValue" SG_ 1006 FRM_35_DetnRCS_076 5000;
BA_ "GenSigASIL"  SG_ 1006 FRM_35_DetnRCS_076 2;
BA_ "GenSigASIL"  SG_ 1006 FRM_35_DetnQuality_076 2;
BA_ "GenSigASIL"  SG_ 1006 FRM_35_DetnMotionSts_077 2;
BA_ "GenSigASIL"  SG_ 1006 FRM_35_DetnRngRadial_077 2;
BA_ "GenSigStartValue" SG_ 1006 FRM_35_DetnAziAngle_077 900;
BA_ "GenSigASIL"  SG_ 1006 FRM_35_DetnAziAngle_077 2;
BA_ "GenSigStartValue" SG_ 1006 FRM_35_DetnElevnAngle_077 100;
BA_ "GenSigASIL"  SG_ 1006 FRM_35_DetnElevnAngle_077 2;
BA_ "GenSigStartValue" SG_ 1006 FRM_35_DetnRelVelRadial_077 10000;
BA_ "GenSigASIL"  SG_ 1006 FRM_35_DetnRelVelRadial_077 2;
BA_ "GenSigASIL"  SG_ 1006 FRM_35_DetnSNR_077 2;
BA_ "GenSigStartValue" SG_ 1006 FRM_35_DetnRCS_077 5000;
BA_ "GenSigASIL"  SG_ 1006 FRM_35_DetnRCS_077 2;
BA_ "GenSigASIL"  SG_ 1006 FRM_35_DetnQuality_077 2;
BA_ "GenMsgILSupport" BO_ 1007 1;
BA_ "GenMsgCycleTime" BO_ 1007 50;
BA_ "GenSigASIL"  SG_ 1007 FRM_36_CRC 5;
BA_ "GenSigASIL"  SG_ 1007 FRM_36_RollgCntr 5;
BA_ "GenSigASIL"  SG_ 1007 FRM_36_DetnBlockCounter 2;
BA_ "GenSigASIL"  SG_ 1007 FRM_36_DetnMotionSts_078 2;
BA_ "GenSigASIL"  SG_ 1007 FRM_36_DetnRngRadial_078 2;
BA_ "GenSigStartValue" SG_ 1007 FRM_36_DetnAziAngle_078 900;
BA_ "GenSigASIL"  SG_ 1007 FRM_36_DetnAziAngle_078 2;
BA_ "GenSigStartValue" SG_ 1007 FRM_36_DetnElevnAngle_078 100;
BA_ "GenSigASIL"  SG_ 1007 FRM_36_DetnElevnAngle_078 2;
BA_ "GenSigStartValue" SG_ 1007 FRM_36_DetnRelVelRadial_078 10000;
BA_ "GenSigASIL"  SG_ 1007 FRM_36_DetnRelVelRadial_078 2;
BA_ "GenSigASIL"  SG_ 1007 FRM_36_DetnSNR_078 2;
BA_ "GenSigStartValue" SG_ 1007 FRM_36_DetnRCS_078 5000;
BA_ "GenSigASIL"  SG_ 1007 FRM_36_DetnRCS_078 2;
BA_ "GenSigASIL"  SG_ 1007 FRM_36_DetnQuality_078 2;
BA_ "GenSigASIL"  SG_ 1007 FRM_36_DetnMotionSts_079 2;
BA_ "GenSigASIL"  SG_ 1007 FRM_36_DetnRngRadial_079 2;
BA_ "GenSigStartValue" SG_ 1007 FRM_36_DetnAziAngle_079 900;
BA_ "GenSigASIL"  SG_ 1007 FRM_36_DetnAziAngle_079 2;
BA_ "GenSigStartValue" SG_ 1007 FRM_36_DetnElevnAngle_079 100;
BA_ "GenSigASIL"  SG_ 1007 FRM_36_DetnElevnAngle_079 2;
BA_ "GenSigStartValue" SG_ 1007 FRM_36_DetnRelVelRadial_079 10000;
BA_ "GenSigASIL"  SG_ 1007 FRM_36_DetnRelVelRadial_079 2;
BA_ "GenSigASIL"  SG_ 1007 FRM_36_DetnSNR_079 2;
BA_ "GenSigStartValue" SG_ 1007 FRM_36_DetnRCS_079 5000;
BA_ "GenSigASIL"  SG_ 1007 FRM_36_DetnRCS_079 2;
BA_ "GenSigASIL"  SG_ 1007 FRM_36_DetnQuality_079 2;
BA_ "GenSigASIL"  SG_ 1007 FRM_36_DetnMotionSts_080 2;
BA_ "GenSigASIL"  SG_ 1007 FRM_36_DetnRngRadial_080 2;
BA_ "GenSigStartValue" SG_ 1007 FRM_36_DetnAziAngle_080 900;
BA_ "GenSigASIL"  SG_ 1007 FRM_36_DetnAziAngle_080 2;
BA_ "GenSigStartValue" SG_ 1007 FRM_36_DetnElevnAngle_080 100;
BA_ "GenSigASIL"  SG_ 1007 FRM_36_DetnElevnAngle_080 2;
BA_ "GenSigStartValue" SG_ 1007 FRM_36_DetnRelVelRadial_080 10000;
BA_ "GenSigASIL"  SG_ 1007 FRM_36_DetnRelVelRadial_080 2;
BA_ "GenSigASIL"  SG_ 1007 FRM_36_DetnSNR_080 2;
BA_ "GenSigStartValue" SG_ 1007 FRM_36_DetnRCS_080 5000;
BA_ "GenSigASIL"  SG_ 1007 FRM_36_DetnRCS_080 2;
BA_ "GenSigASIL"  SG_ 1007 FRM_36_DetnQuality_080 2;
BA_ "GenSigASIL"  SG_ 1007 FRM_36_DetnMotionSts_081 2;
BA_ "GenSigASIL"  SG_ 1007 FRM_36_DetnRngRadial_081 2;
BA_ "GenSigStartValue" SG_ 1007 FRM_36_DetnAziAngle_081 900;
BA_ "GenSigASIL"  SG_ 1007 FRM_36_DetnAziAngle_081 2;
BA_ "GenSigStartValue" SG_ 1007 FRM_36_DetnElevnAngle_081 100;
BA_ "GenSigASIL"  SG_ 1007 FRM_36_DetnElevnAngle_081 2;
BA_ "GenSigStartValue" SG_ 1007 FRM_36_DetnRelVelRadial_081 10000;
BA_ "GenSigASIL"  SG_ 1007 FRM_36_DetnRelVelRadial_081 2;
BA_ "GenSigASIL"  SG_ 1007 FRM_36_DetnSNR_081 2;
BA_ "GenSigStartValue" SG_ 1007 FRM_36_DetnRCS_081 5000;
BA_ "GenSigASIL"  SG_ 1007 FRM_36_DetnRCS_081 2;
BA_ "GenSigASIL"  SG_ 1007 FRM_36_DetnQuality_081 2;
BA_ "GenSigASIL"  SG_ 1007 FRM_36_DetnMotionSts_082 2;
BA_ "GenSigASIL"  SG_ 1007 FRM_36_DetnRngRadial_082 2;
BA_ "GenSigStartValue" SG_ 1007 FRM_36_DetnAziAngle_082 900;
BA_ "GenSigASIL"  SG_ 1007 FRM_36_DetnAziAngle_082 2;
BA_ "GenSigStartValue" SG_ 1007 FRM_36_DetnElevnAngle_082 100;
BA_ "GenSigASIL"  SG_ 1007 FRM_36_DetnElevnAngle_082 2;
BA_ "GenSigStartValue" SG_ 1007 FRM_36_DetnRelVelRadial_082 10000;
BA_ "GenSigASIL"  SG_ 1007 FRM_36_DetnRelVelRadial_082 2;
BA_ "GenSigASIL"  SG_ 1007 FRM_36_DetnSNR_082 2;
BA_ "GenSigStartValue" SG_ 1007 FRM_36_DetnRCS_082 5000;
BA_ "GenSigASIL"  SG_ 1007 FRM_36_DetnRCS_082 2;
BA_ "GenSigASIL"  SG_ 1007 FRM_36_DetnQuality_082 2;
BA_ "GenSigASIL"  SG_ 1007 FRM_36_DetnMotionSts_083 2;
BA_ "GenSigASIL"  SG_ 1007 FRM_36_DetnRngRadial_083 2;
BA_ "GenSigStartValue" SG_ 1007 FRM_36_DetnAziAngle_083 900;
BA_ "GenSigASIL"  SG_ 1007 FRM_36_DetnAziAngle_083 2;
BA_ "GenSigStartValue" SG_ 1007 FRM_36_DetnElevnAngle_083 100;
BA_ "GenSigASIL"  SG_ 1007 FRM_36_DetnElevnAngle_083 2;
BA_ "GenSigStartValue" SG_ 1007 FRM_36_DetnRelVelRadial_083 10000;
BA_ "GenSigASIL"  SG_ 1007 FRM_36_DetnRelVelRadial_083 2;
BA_ "GenSigASIL"  SG_ 1007 FRM_36_DetnSNR_083 2;
BA_ "GenSigStartValue" SG_ 1007 FRM_36_DetnRCS_083 5000;
BA_ "GenSigASIL"  SG_ 1007 FRM_36_DetnRCS_083 2;
BA_ "GenSigASIL"  SG_ 1007 FRM_36_DetnQuality_083 2;
BA_ "GenMsgILSupport" BO_ 1008 1;
BA_ "GenMsgCycleTime" BO_ 1008 50;
BA_ "GenSigASIL"  SG_ 1008 FRM_37_CRC 5;
BA_ "GenSigASIL"  SG_ 1008 FRM_37_RollgCntr 5;
BA_ "GenSigASIL"  SG_ 1008 FRM_37_DetnBlockCounter 2;
BA_ "GenSigASIL"  SG_ 1008 FRM_37_DetnMotionSts_084 2;
BA_ "GenSigASIL"  SG_ 1008 FRM_37_DetnRngRadial_084 2;
BA_ "GenSigStartValue" SG_ 1008 FRM_37_DetnAziAngle_084 900;
BA_ "GenSigASIL"  SG_ 1008 FRM_37_DetnAziAngle_084 2;
BA_ "GenSigStartValue" SG_ 1008 FRM_37_DetnElevnAngle_084 100;
BA_ "GenSigASIL"  SG_ 1008 FRM_37_DetnElevnAngle_084 2;
BA_ "GenSigStartValue" SG_ 1008 FRM_37_DetnRelVelRadial_084 10000;
BA_ "GenSigASIL"  SG_ 1008 FRM_37_DetnRelVelRadial_084 2;
BA_ "GenSigASIL"  SG_ 1008 FRM_37_DetnSNR_084 2;
BA_ "GenSigStartValue" SG_ 1008 FRM_37_DetnRCS_084 5000;
BA_ "GenSigASIL"  SG_ 1008 FRM_37_DetnRCS_084 2;
BA_ "GenSigASIL"  SG_ 1008 FRM_37_DetnQuality_084 2;
BA_ "GenSigASIL"  SG_ 1008 FRM_37_DetnMotionSts_085 2;
BA_ "GenSigASIL"  SG_ 1008 FRM_37_DetnRngRadial_085 2;
BA_ "GenSigStartValue" SG_ 1008 FRM_37_DetnAziAngle_085 900;
BA_ "GenSigASIL"  SG_ 1008 FRM_37_DetnAziAngle_085 2;
BA_ "GenSigStartValue" SG_ 1008 FRM_37_DetnElevnAngle_085 100;
BA_ "GenSigASIL"  SG_ 1008 FRM_37_DetnElevnAngle_085 2;
BA_ "GenSigStartValue" SG_ 1008 FRM_37_DetnRelVelRadial_085 10000;
BA_ "GenSigASIL"  SG_ 1008 FRM_37_DetnRelVelRadial_085 2;
BA_ "GenSigASIL"  SG_ 1008 FRM_37_DetnSNR_085 2;
BA_ "GenSigStartValue" SG_ 1008 FRM_37_DetnRCS_085 5000;
BA_ "GenSigASIL"  SG_ 1008 FRM_37_DetnRCS_085 2;
BA_ "GenSigASIL"  SG_ 1008 FRM_37_DetnQuality_085 2;
BA_ "GenSigASIL"  SG_ 1008 FRM_37_DetnMotionSts_086 2;
BA_ "GenSigASIL"  SG_ 1008 FRM_37_DetnRngRadial_086 2;
BA_ "GenSigStartValue" SG_ 1008 FRM_37_DetnAziAngle_086 900;
BA_ "GenSigASIL"  SG_ 1008 FRM_37_DetnAziAngle_086 2;
BA_ "GenSigStartValue" SG_ 1008 FRM_37_DetnElevnAngle_086 100;
BA_ "GenSigASIL"  SG_ 1008 FRM_37_DetnElevnAngle_086 2;
BA_ "GenSigStartValue" SG_ 1008 FRM_37_DetnRelVelRadial_086 10000;
BA_ "GenSigASIL"  SG_ 1008 FRM_37_DetnRelVelRadial_086 2;
BA_ "GenSigASIL"  SG_ 1008 FRM_37_DetnSNR_086 2;
BA_ "GenSigStartValue" SG_ 1008 FRM_37_DetnRCS_086 5000;
BA_ "GenSigASIL"  SG_ 1008 FRM_37_DetnRCS_086 2;
BA_ "GenSigASIL"  SG_ 1008 FRM_37_DetnQuality_086 2;
BA_ "GenSigASIL"  SG_ 1008 FRM_37_DetnMotionSts_087 2;
BA_ "GenSigASIL"  SG_ 1008 FRM_37_DetnRngRadial_087 2;
BA_ "GenSigStartValue" SG_ 1008 FRM_37_DetnAziAngle_087 900;
BA_ "GenSigASIL"  SG_ 1008 FRM_37_DetnAziAngle_087 2;
BA_ "GenSigStartValue" SG_ 1008 FRM_37_DetnElevnAngle_087 100;
BA_ "GenSigASIL"  SG_ 1008 FRM_37_DetnElevnAngle_087 2;
BA_ "GenSigStartValue" SG_ 1008 FRM_37_DetnRelVelRadial_087 10000;
BA_ "GenSigASIL"  SG_ 1008 FRM_37_DetnRelVelRadial_087 2;
BA_ "GenSigASIL"  SG_ 1008 FRM_37_DetnSNR_087 2;
BA_ "GenSigStartValue" SG_ 1008 FRM_37_DetnRCS_087 5000;
BA_ "GenSigASIL"  SG_ 1008 FRM_37_DetnRCS_087 2;
BA_ "GenSigASIL"  SG_ 1008 FRM_37_DetnQuality_087 2;
BA_ "GenSigASIL"  SG_ 1008 FRM_37_DetnMotionSts_088 2;
BA_ "GenSigASIL"  SG_ 1008 FRM_37_DetnRngRadial_088 2;
BA_ "GenSigStartValue" SG_ 1008 FRM_37_DetnAziAngle_088 900;
BA_ "GenSigASIL"  SG_ 1008 FRM_37_DetnAziAngle_088 2;
BA_ "GenSigStartValue" SG_ 1008 FRM_37_DetnElevnAngle_088 100;
BA_ "GenSigASIL"  SG_ 1008 FRM_37_DetnElevnAngle_088 2;
BA_ "GenSigStartValue" SG_ 1008 FRM_37_DetnRelVelRadial_088 10000;
BA_ "GenSigASIL"  SG_ 1008 FRM_37_DetnRelVelRadial_088 2;
BA_ "GenSigASIL"  SG_ 1008 FRM_37_DetnSNR_088 2;
BA_ "GenSigStartValue" SG_ 1008 FRM_37_DetnRCS_088 5000;
BA_ "GenSigASIL"  SG_ 1008 FRM_37_DetnRCS_088 2;
BA_ "GenSigASIL"  SG_ 1008 FRM_37_DetnQuality_088 2;
BA_ "GenSigASIL"  SG_ 1008 FRM_37_DetnMotionSts_089 2;
BA_ "GenSigASIL"  SG_ 1008 FRM_37_DetnRngRadial_089 2;
BA_ "GenSigStartValue" SG_ 1008 FRM_37_DetnAziAngle_089 900;
BA_ "GenSigASIL"  SG_ 1008 FRM_37_DetnAziAngle_089 2;
BA_ "GenSigStartValue" SG_ 1008 FRM_37_DetnElevnAngle_089 100;
BA_ "GenSigASIL"  SG_ 1008 FRM_37_DetnElevnAngle_089 2;
BA_ "GenSigStartValue" SG_ 1008 FRM_37_DetnRelVelRadial_089 10000;
BA_ "GenSigASIL"  SG_ 1008 FRM_37_DetnRelVelRadial_089 2;
BA_ "GenSigASIL"  SG_ 1008 FRM_37_DetnSNR_089 2;
BA_ "GenSigStartValue" SG_ 1008 FRM_37_DetnRCS_089 5000;
BA_ "GenSigASIL"  SG_ 1008 FRM_37_DetnRCS_089 2;
BA_ "GenSigASIL"  SG_ 1008 FRM_37_DetnQuality_089 2;
BA_ "GenMsgILSupport" BO_ 1009 1;
BA_ "GenMsgCycleTime" BO_ 1009 50;
BA_ "GenSigASIL"  SG_ 1009 FRM_38_CRC 5;
BA_ "GenSigASIL"  SG_ 1009 FRM_38_RollgCntr 5;
BA_ "GenSigASIL"  SG_ 1009 FRM_38_DetnBlockCounter 2;
BA_ "GenSigASIL"  SG_ 1009 FRM_38_DetnMotionSts_090 2;
BA_ "GenSigASIL"  SG_ 1009 FRM_38_DetnRngRadial_090 2;
BA_ "GenSigStartValue" SG_ 1009 FRM_38_DetnAziAngle_090 900;
BA_ "GenSigASIL"  SG_ 1009 FRM_38_DetnAziAngle_090 2;
BA_ "GenSigStartValue" SG_ 1009 FRM_38_DetnElevnAngle_090 100;
BA_ "GenSigASIL"  SG_ 1009 FRM_38_DetnElevnAngle_090 2;
BA_ "GenSigStartValue" SG_ 1009 FRM_38_DetnRelVelRadial_090 10000;
BA_ "GenSigASIL"  SG_ 1009 FRM_38_DetnRelVelRadial_090 2;
BA_ "GenSigASIL"  SG_ 1009 FRM_38_DetnSNR_090 2;
BA_ "GenSigStartValue" SG_ 1009 FRM_38_DetnRCS_090 5000;
BA_ "GenSigASIL"  SG_ 1009 FRM_38_DetnRCS_090 2;
BA_ "GenSigASIL"  SG_ 1009 FRM_38_DetnQuality_090 2;
BA_ "GenSigASIL"  SG_ 1009 FRM_38_DetnMotionSts_091 2;
BA_ "GenSigASIL"  SG_ 1009 FRM_38_DetnRngRadial_091 2;
BA_ "GenSigStartValue" SG_ 1009 FRM_38_DetnAziAngle_091 900;
BA_ "GenSigASIL"  SG_ 1009 FRM_38_DetnAziAngle_091 2;
BA_ "GenSigStartValue" SG_ 1009 FRM_38_DetnElevnAngle_091 100;
BA_ "GenSigASIL"  SG_ 1009 FRM_38_DetnElevnAngle_091 2;
BA_ "GenSigStartValue" SG_ 1009 FRM_38_DetnRelVelRadial_091 10000;
BA_ "GenSigASIL"  SG_ 1009 FRM_38_DetnRelVelRadial_091 2;
BA_ "GenSigASIL"  SG_ 1009 FRM_38_DetnSNR_091 2;
BA_ "GenSigStartValue" SG_ 1009 FRM_38_DetnRCS_091 5000;
BA_ "GenSigASIL"  SG_ 1009 FRM_38_DetnRCS_091 2;
BA_ "GenSigASIL"  SG_ 1009 FRM_38_DetnQuality_091 2;
BA_ "GenSigASIL"  SG_ 1009 FRM_38_DetnMotionSts_092 2;
BA_ "GenSigASIL"  SG_ 1009 FRM_38_DetnRngRadial_092 2;
BA_ "GenSigStartValue" SG_ 1009 FRM_38_DetnAziAngle_092 900;
BA_ "GenSigASIL"  SG_ 1009 FRM_38_DetnAziAngle_092 2;
BA_ "GenSigStartValue" SG_ 1009 FRM_38_DetnElevnAngle_092 100;
BA_ "GenSigASIL"  SG_ 1009 FRM_38_DetnElevnAngle_092 2;
BA_ "GenSigStartValue" SG_ 1009 FRM_38_DetnRelVelRadial_092 10000;
BA_ "GenSigASIL"  SG_ 1009 FRM_38_DetnRelVelRadial_092 2;
BA_ "GenSigASIL"  SG_ 1009 FRM_38_DetnSNR_092 2;
BA_ "GenSigStartValue" SG_ 1009 FRM_38_DetnRCS_092 5000;
BA_ "GenSigASIL"  SG_ 1009 FRM_38_DetnRCS_092 2;
BA_ "GenSigASIL"  SG_ 1009 FRM_38_DetnQuality_092 2;
BA_ "GenSigASIL"  SG_ 1009 FRM_38_DetnMotionSts_093 2;
BA_ "GenSigASIL"  SG_ 1009 FRM_38_DetnRngRadial_093 2;
BA_ "GenSigStartValue" SG_ 1009 FRM_38_DetnAziAngle_093 900;
BA_ "GenSigASIL"  SG_ 1009 FRM_38_DetnAziAngle_093 2;
BA_ "GenSigStartValue" SG_ 1009 FRM_38_DetnElevnAngle_093 100;
BA_ "GenSigASIL"  SG_ 1009 FRM_38_DetnElevnAngle_093 2;
BA_ "GenSigStartValue" SG_ 1009 FRM_38_DetnRelVelRadial_093 10000;
BA_ "GenSigASIL"  SG_ 1009 FRM_38_DetnRelVelRadial_093 2;
BA_ "GenSigASIL"  SG_ 1009 FRM_38_DetnSNR_093 2;
BA_ "GenSigStartValue" SG_ 1009 FRM_38_DetnRCS_093 5000;
BA_ "GenSigASIL"  SG_ 1009 FRM_38_DetnRCS_093 2;
BA_ "GenSigASIL"  SG_ 1009 FRM_38_DetnQuality_093 2;
BA_ "GenSigASIL"  SG_ 1009 FRM_38_DetnMotionSts_094 2;
BA_ "GenSigASIL"  SG_ 1009 FRM_38_DetnRngRadial_094 2;
BA_ "GenSigStartValue" SG_ 1009 FRM_38_DetnAziAngle_094 900;
BA_ "GenSigASIL"  SG_ 1009 FRM_38_DetnAziAngle_094 2;
BA_ "GenSigStartValue" SG_ 1009 FRM_38_DetnElevnAngle_094 100;
BA_ "GenSigASIL"  SG_ 1009 FRM_38_DetnElevnAngle_094 2;
BA_ "GenSigStartValue" SG_ 1009 FRM_38_DetnRelVelRadial_094 10000;
BA_ "GenSigASIL"  SG_ 1009 FRM_38_DetnRelVelRadial_094 2;
BA_ "GenSigASIL"  SG_ 1009 FRM_38_DetnSNR_094 2;
BA_ "GenSigStartValue" SG_ 1009 FRM_38_DetnRCS_094 5000;
BA_ "GenSigASIL"  SG_ 1009 FRM_38_DetnRCS_094 2;
BA_ "GenSigASIL"  SG_ 1009 FRM_38_DetnQuality_094 2;
BA_ "GenSigASIL"  SG_ 1009 FRM_38_DetnMotionSts_095 2;
BA_ "GenSigASIL"  SG_ 1009 FRM_38_DetnRngRadial_095 2;
BA_ "GenSigStartValue" SG_ 1009 FRM_38_DetnAziAngle_095 900;
BA_ "GenSigASIL"  SG_ 1009 FRM_38_DetnAziAngle_095 2;
BA_ "GenSigStartValue" SG_ 1009 FRM_38_DetnElevnAngle_095 100;
BA_ "GenSigASIL"  SG_ 1009 FRM_38_DetnElevnAngle_095 2;
BA_ "GenSigStartValue" SG_ 1009 FRM_38_DetnRelVelRadial_095 10000;
BA_ "GenSigASIL"  SG_ 1009 FRM_38_DetnRelVelRadial_095 2;
BA_ "GenSigASIL"  SG_ 1009 FRM_38_DetnSNR_095 2;
BA_ "GenSigStartValue" SG_ 1009 FRM_38_DetnRCS_095 5000;
BA_ "GenSigASIL"  SG_ 1009 FRM_38_DetnRCS_095 2;
BA_ "GenSigASIL"  SG_ 1009 FRM_38_DetnQuality_095 2;
BA_ "GenMsgILSupport" BO_ 1010 1;
BA_ "GenMsgCycleTime" BO_ 1010 50;
BA_ "GenSigASIL"  SG_ 1010 FRM_39_CRC 5;
BA_ "GenSigASIL"  SG_ 1010 FRM_39_RollgCntr 5;
BA_ "GenSigASIL"  SG_ 1010 FRM_39_DetnBlockCounter 2;
BA_ "GenSigASIL"  SG_ 1010 FRM_39_DetnMotionSts_096 2;
BA_ "GenSigASIL"  SG_ 1010 FRM_39_DetnRngRadial_096 2;
BA_ "GenSigStartValue" SG_ 1010 FRM_39_DetnAziAngle_096 900;
BA_ "GenSigASIL"  SG_ 1010 FRM_39_DetnAziAngle_096 2;
BA_ "GenSigStartValue" SG_ 1010 FRM_39_DetnElevnAngle_096 100;
BA_ "GenSigASIL"  SG_ 1010 FRM_39_DetnElevnAngle_096 2;
BA_ "GenSigStartValue" SG_ 1010 FRM_39_DetnRelVelRadial_096 10000;
BA_ "GenSigASIL"  SG_ 1010 FRM_39_DetnRelVelRadial_096 2;
BA_ "GenSigASIL"  SG_ 1010 FRM_39_DetnSNR_096 2;
BA_ "GenSigStartValue" SG_ 1010 FRM_39_DetnRCS_096 5000;
BA_ "GenSigASIL"  SG_ 1010 FRM_39_DetnRCS_096 2;
BA_ "GenSigASIL"  SG_ 1010 FRM_39_DetnQuality_096 2;
BA_ "GenSigASIL"  SG_ 1010 FRM_39_DetnMotionSts_097 2;
BA_ "GenSigASIL"  SG_ 1010 FRM_39_DetnRngRadial_097 2;
BA_ "GenSigStartValue" SG_ 1010 FRM_39_DetnAziAngle_097 900;
BA_ "GenSigASIL"  SG_ 1010 FRM_39_DetnAziAngle_097 2;
BA_ "GenSigStartValue" SG_ 1010 FRM_39_DetnElevnAngle_097 100;
BA_ "GenSigASIL"  SG_ 1010 FRM_39_DetnElevnAngle_097 2;
BA_ "GenSigStartValue" SG_ 1010 FRM_39_DetnRelVelRadial_097 10000;
BA_ "GenSigASIL"  SG_ 1010 FRM_39_DetnRelVelRadial_097 2;
BA_ "GenSigASIL"  SG_ 1010 FRM_39_DetnSNR_097 2;
BA_ "GenSigStartValue" SG_ 1010 FRM_39_DetnRCS_097 5000;
BA_ "GenSigASIL"  SG_ 1010 FRM_39_DetnRCS_097 2;
BA_ "GenSigASIL"  SG_ 1010 FRM_39_DetnQuality_097 2;
BA_ "GenSigASIL"  SG_ 1010 FRM_39_DetnMotionSts_098 2;
BA_ "GenSigASIL"  SG_ 1010 FRM_39_DetnRngRadial_098 2;
BA_ "GenSigStartValue" SG_ 1010 FRM_39_DetnAziAngle_098 900;
BA_ "GenSigASIL"  SG_ 1010 FRM_39_DetnAziAngle_098 2;
BA_ "GenSigStartValue" SG_ 1010 FRM_39_DetnElevnAngle_098 100;
BA_ "GenSigASIL"  SG_ 1010 FRM_39_DetnElevnAngle_098 2;
BA_ "GenSigStartValue" SG_ 1010 FRM_39_DetnRelVelRadial_098 10000;
BA_ "GenSigASIL"  SG_ 1010 FRM_39_DetnRelVelRadial_098 2;
BA_ "GenSigASIL"  SG_ 1010 FRM_39_DetnSNR_098 2;
BA_ "GenSigStartValue" SG_ 1010 FRM_39_DetnRCS_098 5000;
BA_ "GenSigASIL"  SG_ 1010 FRM_39_DetnRCS_098 2;
BA_ "GenSigASIL"  SG_ 1010 FRM_39_DetnQuality_098 2;
BA_ "GenSigASIL"  SG_ 1010 FRM_39_DetnMotionSts_099 2;
BA_ "GenSigASIL"  SG_ 1010 FRM_39_DetnRngRadial_099 2;
BA_ "GenSigStartValue" SG_ 1010 FRM_39_DetnAziAngle_099 900;
BA_ "GenSigASIL"  SG_ 1010 FRM_39_DetnAziAngle_099 2;
BA_ "GenSigStartValue" SG_ 1010 FRM_39_DetnElevnAngle_099 100;
BA_ "GenSigASIL"  SG_ 1010 FRM_39_DetnElevnAngle_099 2;
BA_ "GenSigStartValue" SG_ 1010 FRM_39_DetnRelVelRadial_099 10000;
BA_ "GenSigASIL"  SG_ 1010 FRM_39_DetnRelVelRadial_099 2;
BA_ "GenSigASIL"  SG_ 1010 FRM_39_DetnSNR_099 2;
BA_ "GenSigStartValue" SG_ 1010 FRM_39_DetnRCS_099 5000;
BA_ "GenSigASIL"  SG_ 1010 FRM_39_DetnRCS_099 2;
BA_ "GenSigASIL"  SG_ 1010 FRM_39_DetnQuality_099 2;
BA_ "GenSigASIL"  SG_ 1010 FRM_39_DetnMotionSts_100 2;
BA_ "GenSigASIL"  SG_ 1010 FRM_39_DetnRngRadial_100 2;
BA_ "GenSigStartValue" SG_ 1010 FRM_39_DetnAziAngle_100 900;
BA_ "GenSigASIL"  SG_ 1010 FRM_39_DetnAziAngle_100 2;
BA_ "GenSigStartValue" SG_ 1010 FRM_39_DetnElevnAngle_100 100;
BA_ "GenSigASIL"  SG_ 1010 FRM_39_DetnElevnAngle_100 2;
BA_ "GenSigStartValue" SG_ 1010 FRM_39_DetnRelVelRadial_100 10000;
BA_ "GenSigASIL"  SG_ 1010 FRM_39_DetnRelVelRadial_100 2;
BA_ "GenSigASIL"  SG_ 1010 FRM_39_DetnSNR_100 2;
BA_ "GenSigStartValue" SG_ 1010 FRM_39_DetnRCS_100 5000;
BA_ "GenSigASIL"  SG_ 1010 FRM_39_DetnRCS_100 2;
BA_ "GenSigASIL"  SG_ 1010 FRM_39_DetnQuality_100 2;
BA_ "GenSigASIL"  SG_ 1010 FRM_39_DetnMotionSts_101 2;
BA_ "GenSigASIL"  SG_ 1010 FRM_39_DetnRngRadial_101 2;
BA_ "GenSigStartValue" SG_ 1010 FRM_39_DetnAziAngle_101 900;
BA_ "GenSigASIL"  SG_ 1010 FRM_39_DetnAziAngle_101 2;
BA_ "GenSigStartValue" SG_ 1010 FRM_39_DetnElevnAngle_101 100;
BA_ "GenSigASIL"  SG_ 1010 FRM_39_DetnElevnAngle_101 2;
BA_ "GenSigStartValue" SG_ 1010 FRM_39_DetnRelVelRadial_101 10000;
BA_ "GenSigASIL"  SG_ 1010 FRM_39_DetnRelVelRadial_101 2;
BA_ "GenSigASIL"  SG_ 1010 FRM_39_DetnSNR_101 2;
BA_ "GenSigStartValue" SG_ 1010 FRM_39_DetnRCS_101 5000;
BA_ "GenSigASIL"  SG_ 1010 FRM_39_DetnRCS_101 2;
BA_ "GenSigASIL"  SG_ 1010 FRM_39_DetnQuality_101 2;
BA_ "GenMsgILSupport" BO_ 1011 1;
BA_ "GenMsgCycleTime" BO_ 1011 50;
BA_ "GenSigASIL"  SG_ 1011 FRM_40_CRC 5;
BA_ "GenSigASIL"  SG_ 1011 FRM_40_RollgCntr 5;
BA_ "GenSigASIL"  SG_ 1011 FRM_40_DetnBlockCounter 2;
BA_ "GenSigASIL"  SG_ 1011 FRM_40_DetnMotionSts_102 2;
BA_ "GenSigASIL"  SG_ 1011 FRM_40_DetnRngRadial_102 2;
BA_ "GenSigStartValue" SG_ 1011 FRM_40_DetnAziAngle_102 900;
BA_ "GenSigASIL"  SG_ 1011 FRM_40_DetnAziAngle_102 2;
BA_ "GenSigStartValue" SG_ 1011 FRM_40_DetnElevnAngle_102 100;
BA_ "GenSigASIL"  SG_ 1011 FRM_40_DetnElevnAngle_102 2;
BA_ "GenSigStartValue" SG_ 1011 FRM_40_DetnRelVelRadial_102 10000;
BA_ "GenSigASIL"  SG_ 1011 FRM_40_DetnRelVelRadial_102 2;
BA_ "GenSigASIL"  SG_ 1011 FRM_40_DetnSNR_102 2;
BA_ "GenSigStartValue" SG_ 1011 FRM_40_DetnRCS_102 5000;
BA_ "GenSigASIL"  SG_ 1011 FRM_40_DetnRCS_102 2;
BA_ "GenSigASIL"  SG_ 1011 FRM_40_DetnQuality_102 2;
BA_ "GenSigASIL"  SG_ 1011 FRM_40_DetnMotionSts_103 2;
BA_ "GenSigASIL"  SG_ 1011 FRM_40_DetnRngRadial_103 2;
BA_ "GenSigStartValue" SG_ 1011 FRM_40_DetnAziAngle_103 900;
BA_ "GenSigASIL"  SG_ 1011 FRM_40_DetnAziAngle_103 2;
BA_ "GenSigStartValue" SG_ 1011 FRM_40_DetnElevnAngle_103 100;
BA_ "GenSigASIL"  SG_ 1011 FRM_40_DetnElevnAngle_103 2;
BA_ "GenSigStartValue" SG_ 1011 FRM_40_DetnRelVelRadial_103 10000;
BA_ "GenSigASIL"  SG_ 1011 FRM_40_DetnRelVelRadial_103 2;
BA_ "GenSigASIL"  SG_ 1011 FRM_40_DetnSNR_103 2;
BA_ "GenSigStartValue" SG_ 1011 FRM_40_DetnRCS_103 5000;
BA_ "GenSigASIL"  SG_ 1011 FRM_40_DetnRCS_103 2;
BA_ "GenSigASIL"  SG_ 1011 FRM_40_DetnQuality_103 2;
BA_ "GenSigASIL"  SG_ 1011 FRM_40_DetnMotionSts_104 2;
BA_ "GenSigASIL"  SG_ 1011 FRM_40_DetnRngRadial_104 2;
BA_ "GenSigStartValue" SG_ 1011 FRM_40_DetnAziAngle_104 900;
BA_ "GenSigASIL"  SG_ 1011 FRM_40_DetnAziAngle_104 2;
BA_ "GenSigStartValue" SG_ 1011 FRM_40_DetnElevnAngle_104 100;
BA_ "GenSigASIL"  SG_ 1011 FRM_40_DetnElevnAngle_104 2;
BA_ "GenSigStartValue" SG_ 1011 FRM_40_DetnRelVelRadial_104 10000;
BA_ "GenSigASIL"  SG_ 1011 FRM_40_DetnRelVelRadial_104 2;
BA_ "GenSigASIL"  SG_ 1011 FRM_40_DetnSNR_104 2;
BA_ "GenSigStartValue" SG_ 1011 FRM_40_DetnRCS_104 5000;
BA_ "GenSigASIL"  SG_ 1011 FRM_40_DetnRCS_104 2;
BA_ "GenSigASIL"  SG_ 1011 FRM_40_DetnQuality_104 2;
BA_ "GenSigASIL"  SG_ 1011 FRM_40_DetnMotionSts_105 2;
BA_ "GenSigASIL"  SG_ 1011 FRM_40_DetnRngRadial_105 2;
BA_ "GenSigStartValue" SG_ 1011 FRM_40_DetnAziAngle_105 900;
BA_ "GenSigASIL"  SG_ 1011 FRM_40_DetnAziAngle_105 2;
BA_ "GenSigStartValue" SG_ 1011 FRM_40_DetnElevnAngle_105 100;
BA_ "GenSigASIL"  SG_ 1011 FRM_40_DetnElevnAngle_105 2;
BA_ "GenSigStartValue" SG_ 1011 FRM_40_DetnRelVelRadial_105 10000;
BA_ "GenSigASIL"  SG_ 1011 FRM_40_DetnRelVelRadial_105 2;
BA_ "GenSigASIL"  SG_ 1011 FRM_40_DetnSNR_105 2;
BA_ "GenSigStartValue" SG_ 1011 FRM_40_DetnRCS_105 5000;
BA_ "GenSigASIL"  SG_ 1011 FRM_40_DetnRCS_105 2;
BA_ "GenSigASIL"  SG_ 1011 FRM_40_DetnQuality_105 2;
BA_ "GenSigASIL"  SG_ 1011 FRM_40_DetnMotionSts_106 2;
BA_ "GenSigASIL"  SG_ 1011 FRM_40_DetnRngRadial_106 2;
BA_ "GenSigStartValue" SG_ 1011 FRM_40_DetnAziAngle_106 900;
BA_ "GenSigASIL"  SG_ 1011 FRM_40_DetnAziAngle_106 2;
BA_ "GenSigStartValue" SG_ 1011 FRM_40_DetnElevnAngle_106 100;
BA_ "GenSigASIL"  SG_ 1011 FRM_40_DetnElevnAngle_106 2;
BA_ "GenSigStartValue" SG_ 1011 FRM_40_DetnRelVelRadial_106 10000;
BA_ "GenSigASIL"  SG_ 1011 FRM_40_DetnRelVelRadial_106 2;
BA_ "GenSigASIL"  SG_ 1011 FRM_40_DetnSNR_106 2;
BA_ "GenSigStartValue" SG_ 1011 FRM_40_DetnRCS_106 5000;
BA_ "GenSigASIL"  SG_ 1011 FRM_40_DetnRCS_106 2;
BA_ "GenSigASIL"  SG_ 1011 FRM_40_DetnQuality_106 2;
BA_ "GenSigASIL"  SG_ 1011 FRM_40_DetnMotionSts_107 2;
BA_ "GenSigASIL"  SG_ 1011 FRM_40_DetnRngRadial_107 2;
BA_ "GenSigStartValue" SG_ 1011 FRM_40_DetnAziAngle_107 900;
BA_ "GenSigASIL"  SG_ 1011 FRM_40_DetnAziAngle_107 2;
BA_ "GenSigStartValue" SG_ 1011 FRM_40_DetnElevnAngle_107 100;
BA_ "GenSigASIL"  SG_ 1011 FRM_40_DetnElevnAngle_107 2;
BA_ "GenSigStartValue" SG_ 1011 FRM_40_DetnRelVelRadial_107 10000;
BA_ "GenSigASIL"  SG_ 1011 FRM_40_DetnRelVelRadial_107 2;
BA_ "GenSigASIL"  SG_ 1011 FRM_40_DetnSNR_107 2;
BA_ "GenSigStartValue" SG_ 1011 FRM_40_DetnRCS_107 5000;
BA_ "GenSigASIL"  SG_ 1011 FRM_40_DetnRCS_107 2;
BA_ "GenSigASIL"  SG_ 1011 FRM_40_DetnQuality_107 2;
BA_ "GenMsgILSupport" BO_ 1012 1;
BA_ "GenMsgCycleTime" BO_ 1012 50;
BA_ "GenSigASIL"  SG_ 1012 FRM_41_CRC 5;
BA_ "GenSigASIL"  SG_ 1012 FRM_41_RollgCntr 5;
BA_ "GenSigASIL"  SG_ 1012 FRM_41_DetnBlockCounter 2;
BA_ "GenSigASIL"  SG_ 1012 FRM_41_DetnMotionSts_108 2;
BA_ "GenSigASIL"  SG_ 1012 FRM_41_DetnRngRadial_108 2;
BA_ "GenSigStartValue" SG_ 1012 FRM_41_DetnAziAngle_108 900;
BA_ "GenSigASIL"  SG_ 1012 FRM_41_DetnAziAngle_108 2;
BA_ "GenSigStartValue" SG_ 1012 FRM_41_DetnElevnAngle_108 100;
BA_ "GenSigASIL"  SG_ 1012 FRM_41_DetnElevnAngle_108 2;
BA_ "GenSigStartValue" SG_ 1012 FRM_41_DetnRelVelRadial_108 10000;
BA_ "GenSigASIL"  SG_ 1012 FRM_41_DetnRelVelRadial_108 2;
BA_ "GenSigASIL"  SG_ 1012 FRM_41_DetnSNR_108 2;
BA_ "GenSigStartValue" SG_ 1012 FRM_41_DetnRCS_108 5000;
BA_ "GenSigASIL"  SG_ 1012 FRM_41_DetnRCS_108 2;
BA_ "GenSigASIL"  SG_ 1012 FRM_41_DetnQuality_108 2;
BA_ "GenSigASIL"  SG_ 1012 FRM_41_DetnMotionSts_109 2;
BA_ "GenSigASIL"  SG_ 1012 FRM_41_DetnRngRadial_109 2;
BA_ "GenSigStartValue" SG_ 1012 FRM_41_DetnAziAngle_109 900;
BA_ "GenSigASIL"  SG_ 1012 FRM_41_DetnAziAngle_109 2;
BA_ "GenSigStartValue" SG_ 1012 FRM_41_DetnElevnAngle_109 100;
BA_ "GenSigASIL"  SG_ 1012 FRM_41_DetnElevnAngle_109 2;
BA_ "GenSigStartValue" SG_ 1012 FRM_41_DetnRelVelRadial_109 10000;
BA_ "GenSigASIL"  SG_ 1012 FRM_41_DetnRelVelRadial_109 2;
BA_ "GenSigASIL"  SG_ 1012 FRM_41_DetnSNR_109 2;
BA_ "GenSigStartValue" SG_ 1012 FRM_41_DetnRCS_109 5000;
BA_ "GenSigASIL"  SG_ 1012 FRM_41_DetnRCS_109 2;
BA_ "GenSigASIL"  SG_ 1012 FRM_41_DetnQuality_109 2;
BA_ "GenSigASIL"  SG_ 1012 FRM_41_DetnMotionSts_110 2;
BA_ "GenSigASIL"  SG_ 1012 FRM_41_DetnRngRadial_110 2;
BA_ "GenSigStartValue" SG_ 1012 FRM_41_DetnAziAngle_110 900;
BA_ "GenSigASIL"  SG_ 1012 FRM_41_DetnAziAngle_110 2;
BA_ "GenSigStartValue" SG_ 1012 FRM_41_DetnElevnAngle_110 100;
BA_ "GenSigASIL"  SG_ 1012 FRM_41_DetnElevnAngle_110 2;
BA_ "GenSigStartValue" SG_ 1012 FRM_41_DetnRelVelRadial_110 10000;
BA_ "GenSigASIL"  SG_ 1012 FRM_41_DetnRelVelRadial_110 2;
BA_ "GenSigASIL"  SG_ 1012 FRM_41_DetnSNR_110 2;
BA_ "GenSigStartValue" SG_ 1012 FRM_41_DetnRCS_110 5000;
BA_ "GenSigASIL"  SG_ 1012 FRM_41_DetnRCS_110 2;
BA_ "GenSigASIL"  SG_ 1012 FRM_41_DetnQuality_110 2;
BA_ "GenSigASIL"  SG_ 1012 FRM_41_DetnMotionSts_111 2;
BA_ "GenSigASIL"  SG_ 1012 FRM_41_DetnRngRadial_111 2;
BA_ "GenSigStartValue" SG_ 1012 FRM_41_DetnAziAngle_111 900;
BA_ "GenSigASIL"  SG_ 1012 FRM_41_DetnAziAngle_111 2;
BA_ "GenSigStartValue" SG_ 1012 FRM_41_DetnElevnAngle_111 100;
BA_ "GenSigASIL"  SG_ 1012 FRM_41_DetnElevnAngle_111 2;
BA_ "GenSigStartValue" SG_ 1012 FRM_41_DetnRelVelRadial_111 10000;
BA_ "GenSigASIL"  SG_ 1012 FRM_41_DetnRelVelRadial_111 2;
BA_ "GenSigASIL"  SG_ 1012 FRM_41_DetnSNR_111 2;
BA_ "GenSigStartValue" SG_ 1012 FRM_41_DetnRCS_111 5000;
BA_ "GenSigASIL"  SG_ 1012 FRM_41_DetnRCS_111 2;
BA_ "GenSigASIL"  SG_ 1012 FRM_41_DetnQuality_111 2;
BA_ "GenSigASIL"  SG_ 1012 FRM_41_DetnMotionSts_112 2;
BA_ "GenSigASIL"  SG_ 1012 FRM_41_DetnRngRadial_112 2;
BA_ "GenSigStartValue" SG_ 1012 FRM_41_DetnAziAngle_112 900;
BA_ "GenSigASIL"  SG_ 1012 FRM_41_DetnAziAngle_112 2;
BA_ "GenSigStartValue" SG_ 1012 FRM_41_DetnElevnAngle_112 100;
BA_ "GenSigASIL"  SG_ 1012 FRM_41_DetnElevnAngle_112 2;
BA_ "GenSigStartValue" SG_ 1012 FRM_41_DetnRelVelRadial_112 10000;
BA_ "GenSigASIL"  SG_ 1012 FRM_41_DetnRelVelRadial_112 2;
BA_ "GenSigASIL"  SG_ 1012 FRM_41_DetnSNR_112 2;
BA_ "GenSigStartValue" SG_ 1012 FRM_41_DetnRCS_112 5000;
BA_ "GenSigASIL"  SG_ 1012 FRM_41_DetnRCS_112 2;
BA_ "GenSigASIL"  SG_ 1012 FRM_41_DetnQuality_112 2;
BA_ "GenSigASIL"  SG_ 1012 FRM_41_DetnMotionSts_113 2;
BA_ "GenSigASIL"  SG_ 1012 FRM_41_DetnRngRadial_113 2;
BA_ "GenSigStartValue" SG_ 1012 FRM_41_DetnAziAngle_113 900;
BA_ "GenSigASIL"  SG_ 1012 FRM_41_DetnAziAngle_113 2;
BA_ "GenSigStartValue" SG_ 1012 FRM_41_DetnElevnAngle_113 100;
BA_ "GenSigASIL"  SG_ 1012 FRM_41_DetnElevnAngle_113 2;
BA_ "GenSigStartValue" SG_ 1012 FRM_41_DetnRelVelRadial_113 10000;
BA_ "GenSigASIL"  SG_ 1012 FRM_41_DetnRelVelRadial_113 2;
BA_ "GenSigASIL"  SG_ 1012 FRM_41_DetnSNR_113 2;
BA_ "GenSigStartValue" SG_ 1012 FRM_41_DetnRCS_113 5000;
BA_ "GenSigASIL"  SG_ 1012 FRM_41_DetnRCS_113 2;
BA_ "GenSigASIL"  SG_ 1012 FRM_41_DetnQuality_113 2;
VAL_ 1002 FRM_31_DetnMotionSts_048 3 "Invalid" 2 "Static" 1 "Moving" 0 "NoTarget" ;
VAL_ 1002 FRM_31_DetnMotionSts_049 3 "Invalid" 2 "Static" 1 "Moving" 0 "NoTarget" ;
VAL_ 1002 FRM_31_DetnMotionSts_050 3 "Invalid" 2 "Static" 1 "Moving" 0 "NoTarget" ;
VAL_ 1002 FRM_31_DetnMotionSts_051 3 "Invalid" 2 "Static" 1 "Moving" 0 "NoTarget" ;
VAL_ 1002 FRM_31_DetnMotionSts_052 3 "Invalid" 2 "Static" 1 "Moving" 0 "NoTarget" ;
VAL_ 1002 FRM_31_DetnMotionSts_053 3 "Invalid" 2 "Static" 1 "Moving" 0 "NoTarget" ;
VAL_ 1003 FRM_32_DetnMotionSts_054 3 "Invalid" 2 "Static" 1 "Moving" 0 "NoTarget" ;
VAL_ 1003 FRM_32_DetnMotionSts_055 3 "Invalid" 2 "Static" 1 "Moving" 0 "NoTarget" ;
VAL_ 1003 FRM_32_DetnMotionSts_056 3 "Invalid" 2 "Static" 1 "Moving" 0 "NoTarget" ;
VAL_ 1003 FRM_32_DetnMotionSts_057 3 "Invalid" 2 "Static" 1 "Moving" 0 "NoTarget" ;
VAL_ 1003 FRM_32_DetnMotionSts_058 3 "Invalid" 2 "Static" 1 "Moving" 0 "NoTarget" ;
VAL_ 1003 FRM_32_DetnMotionSts_059 3 "Invalid" 2 "Static" 1 "Moving" 0 "NoTarget" ;
VAL_ 1004 FRM_33_DetnMotionSts_060 3 "Invalid" 2 "Static" 1 "Moving" 0 "NoTarget" ;
VAL_ 1004 FRM_33_DetnMotionSts_061 3 "Invalid" 2 "Static" 1 "Moving" 0 "NoTarget" ;
VAL_ 1004 FRM_33_DetnMotionSts_062 3 "Invalid" 2 "Static" 1 "Moving" 0 "NoTarget" ;
VAL_ 1004 FRM_33_DetnMotionSts_063 3 "Invalid" 2 "Static" 1 "Moving" 0 "NoTarget" ;
VAL_ 1004 FRM_33_DetnMotionSts_064 3 "Invalid" 2 "Static" 1 "Moving" 0 "NoTarget" ;
VAL_ 1004 FRM_33_DetnMotionSts_065 3 "Invalid" 2 "Static" 1 "Moving" 0 "NoTarget" ;
VAL_ 1005 FRM_34_DetnMotionSts_066 3 "Invalid" 2 "Static" 1 "Moving" 0 "NoTarget" ;
VAL_ 1005 FRM_34_DetnMotionSts_067 3 "Invalid" 2 "Static" 1 "Moving" 0 "NoTarget" ;
VAL_ 1005 FRM_34_DetnMotionSts_068 3 "Invalid" 2 "Static" 1 "Moving" 0 "NoTarget" ;
VAL_ 1005 FRM_34_DetnMotionSts_069 3 "Invalid" 2 "Static" 1 "Moving" 0 "NoTarget" ;
VAL_ 1005 FRM_34_DetnMotionSts_070 3 "Invalid" 2 "Static" 1 "Moving" 0 "NoTarget" ;
VAL_ 1005 FRM_34_DetnMotionSts_071 3 "Invalid" 2 "Static" 1 "Moving" 0 "NoTarget" ;
VAL_ 1006 FRM_35_DetnMotionSts_072 3 "Invalid" 2 "Static" 1 "Moving" 0 "NoTarget" ;
VAL_ 1006 FRM_35_DetnMotionSts_073 3 "Invalid" 2 "Static" 1 "Moving" 0 "NoTarget" ;
VAL_ 1006 FRM_35_DetnMotionSts_074 3 "Invalid" 2 "Static" 1 "Moving" 0 "NoTarget" ;
VAL_ 1006 FRM_35_DetnMotionSts_075 3 "Invalid" 2 "Static" 1 "Moving" 0 "NoTarget" ;
VAL_ 1006 FRM_35_DetnMotionSts_076 3 "Invalid" 2 "Static" 1 "Moving" 0 "NoTarget" ;
VAL_ 1006 FRM_35_DetnMotionSts_077 3 "Invalid" 2 "Static" 1 "Moving" 0 "NoTarget" ;
VAL_ 1007 FRM_36_DetnMotionSts_078 3 "Invalid" 2 "Static" 1 "Moving" 0 "NoTarget" ;
VAL_ 1007 FRM_36_DetnMotionSts_079 3 "Invalid" 2 "Static" 1 "Moving" 0 "NoTarget" ;
VAL_ 1007 FRM_36_DetnMotionSts_080 3 "Invalid" 2 "Static" 1 "Moving" 0 "NoTarget" ;
VAL_ 1007 FRM_36_DetnMotionSts_081 3 "Invalid" 2 "Static" 1 "Moving" 0 "NoTarget" ;
VAL_ 1007 FRM_36_DetnMotionSts_082 3 "Invalid" 2 "Static" 1 "Moving" 0 "NoTarget" ;
VAL_ 1007 FRM_36_DetnMotionSts_083 3 "Invalid" 2 "Static" 1 "Moving" 0 "NoTarget" ;
VAL_ 1008 FRM_37_DetnMotionSts_084 3 "Invalid" 2 "Static" 1 "Moving" 0 "NoTarget" ;
VAL_ 1008 FRM_37_DetnMotionSts_085 3 "Invalid" 2 "Static" 1 "Moving" 0 "NoTarget" ;
VAL_ 1008 FRM_37_DetnMotionSts_086 3 "Invalid" 2 "Static" 1 "Moving" 0 "NoTarget" ;
VAL_ 1008 FRM_37_DetnMotionSts_087 3 "Invalid" 2 "Static" 1 "Moving" 0 "NoTarget" ;
VAL_ 1008 FRM_37_DetnMotionSts_088 3 "Invalid" 2 "Static" 1 "Moving" 0 "NoTarget" ;
VAL_ 1008 FRM_37_DetnMotionSts_089 3 "Invalid" 2 "Static" 1 "Moving" 0 "NoTarget" ;
VAL_ 1009 FRM_38_DetnMotionSts_090 3 "Invalid" 2 "Static" 1 "Moving" 0 "NoTarget" ;
VAL_ 1009 FRM_38_DetnMotionSts_091 3 "Invalid" 2 "Static" 1 "Moving" 0 "NoTarget" ;
VAL_ 1009 FRM_38_DetnMotionSts_092 3 "Invalid" 2 "Static" 1 "Moving" 0 "NoTarget" ;
VAL_ 1009 FRM_38_DetnMotionSts_093 3 "Invalid" 2 "Static" 1 "Moving" 0 "NoTarget" ;
VAL_ 1009 FRM_38_DetnMotionSts_094 3 "Invalid" 2 "Static" 1 "Moving" 0 "NoTarget" ;
VAL_ 1009 FRM_38_DetnMotionSts_095 3 "Invalid" 2 "Static" 1 "Moving" 0 "NoTarget" ;
VAL_ 1010 FRM_39_DetnMotionSts_096 3 "Invalid" 2 "Static" 1 "Moving" 0 "NoTarget" ;
VAL_ 1010 FRM_39_DetnMotionSts_097 3 "Invalid" 2 "Static" 1 "Moving" 0 "NoTarget" ;
VAL_ 1010 FRM_39_DetnMotionSts_098 3 "Invalid" 2 "Static" 1 "Moving" 0 "NoTarget" ;
VAL_ 1010 FRM_39_DetnMotionSts_099 3 "Invalid" 2 "Static" 1 "Moving" 0 "NoTarget" ;
VAL_ 1010 FRM_39_DetnMotionSts_100 3 "Invalid" 2 "Static" 1 "Moving" 0 "NoTarget" ;
VAL_ 1010 FRM_39_DetnMotionSts_101 3 "Invalid" 2 "Static" 1 "Moving" 0 "NoTarget" ;
VAL_ 1011 FRM_40_DetnMotionSts_102 3 "Invalid" 2 "Static" 1 "Moving" 0 "NoTarget" ;
VAL_ 1011 FRM_40_DetnMotionSts_103 3 "Invalid" 2 "Static" 1 "Moving" 0 "NoTarget" ;
VAL_ 1011 FRM_40_DetnMotionSts_104 3 "Invalid" 2 "Static" 1 "Moving" 0 "NoTarget" ;
VAL_ 1011 FRM_40_DetnMotionSts_105 3 "Invalid" 2 "Static" 1 "Moving" 0 "NoTarget" ;
VAL_ 1011 FRM_40_DetnMotionSts_106 3 "Invalid" 2 "Static" 1 "Moving" 0 "NoTarget" ;
VAL_ 1011 FRM_40_DetnMotionSts_107 3 "Invalid" 2 "Static" 1 "Moving" 0 "NoTarget" ;
VAL_ 1012 FRM_41_DetnMotionSts_108 3 "Invalid" 2 "Static" 1 "Moving" 0 "NoTarget" ;
VAL_ 1012 FRM_41_DetnMotionSts_109 3 "Invalid" 2 "Static" 1 "Moving" 0 "NoTarget" ;
VAL_ 1012 FRM_41_DetnMotionSts_110 3 "Invalid" 2 "Static" 1 "Moving" 0 "NoTarget" ;
VAL_ 1012 FRM_41_DetnMotionSts_111 3 "Invalid" 2 "Static" 1 "Moving" 0 "NoTarget" ;
VAL_ 1012 FRM_41_DetnMotionSts_112 3 "Invalid" 2 "Static" 1 "Moving" 0 "NoTarget" ;
VAL_ 1012 FRM_41_DetnMotionSts_113 3 "Invalid" 2 "Static" 1 "Moving" 0 "NoTarget" ;
