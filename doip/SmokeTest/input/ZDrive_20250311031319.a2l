ASAP2_VERSION 1 71
/begin PROJECT ProjectName ""
/begin MODULE ModuleName ""
/begin MOD_COMMON "" BYTE_ORDER MSB_LAST ALIGNMENT_BYTE 1 ALIGNMENT_WORD 1 ALIGNMENT_LONG 1 ALIGNMENT_INT64 1 ALIGNMENT_FLOAT16_IEEE 1 ALIGNMENT_FLOAT32_IEEE 1 ALIGNMENT_FLOAT64_IEEE 1 /end MOD_COMMON
/begin RECORD_LAYOUT Lookup2D_X_FLOAT64_IEEE AXIS_PTS_X 1 FLOAT64_IEEE INDEX_INCR DIRECT /end RECORD_LAYOUT
/begin RECORD_LAYOUT Record_A_UINT64 FNC_VALUES 1 A_UINT64 COLUMN_DIR DIRECT /end RECORD_LAYOUT
/begin RECORD_LAYOUT Record_FLOAT32_IEEE FNC_VALUES 1 FLOAT32_IEEE COLUMN_DIR DIRECT /end RECORD_LAYOUT
/begin RECORD_LAYOUT Record_SBYTE FNC_VALUES 1 SBYTE COLUMN_DIR DIRECT /end RECORD_LAYOUT
/begin RECORD_LAYOUT Record_SWORD FNC_VALUES 1 SWORD COLUMN_DIR DIRECT /end RECORD_LAYOUT
/begin RECORD_LAYOUT Record_UBYTE FNC_VALUES 1 UBYTE COLUMN_DIR DIRECT /end RECORD_LAYOUT
/begin RECORD_LAYOUT Record_ULONG FNC_VALUES 1 ULONG COLUMN_DIR DIRECT /end RECORD_LAYOUT
/begin RECORD_LAYOUT Record_UWORD FNC_VALUES 1 UWORD COLUMN_DIR DIRECT /end RECORD_LAYOUT
/begin RECORD_LAYOUT Record_A_UINT64 FNC_VALUES 1 A_UINT64 COLUMN_DIR DIRECT /end RECORD_LAYOUT
/begin RECORD_LAYOUT Record_FLOAT32_IEEE FNC_VALUES 1 FLOAT32_IEEE COLUMN_DIR DIRECT /end RECORD_LAYOUT
/begin RECORD_LAYOUT Record_UBYTE FNC_VALUES 1 UBYTE COLUMN_DIR DIRECT /end RECORD_LAYOUT
/begin RECORD_LAYOUT Record_ULONG FNC_VALUES 1 ULONG COLUMN_DIR DIRECT /end RECORD_LAYOUT
/begin RECORD_LAYOUT Record_UWORD FNC_VALUES 1 UWORD COLUMN_DIR DIRECT /end RECORD_LAYOUT
/begin RECORD_LAYOUT Record_A_UINT64 FNC_VALUES 1 A_UINT64 COLUMN_DIR DIRECT /end RECORD_LAYOUT
/begin RECORD_LAYOUT Record_FLOAT32_IEEE FNC_VALUES 1 FLOAT32_IEEE COLUMN_DIR DIRECT /end RECORD_LAYOUT
/begin RECORD_LAYOUT Record_SWORD FNC_VALUES 1 SWORD COLUMN_DIR DIRECT /end RECORD_LAYOUT
/begin RECORD_LAYOUT Record_UBYTE FNC_VALUES 1 UBYTE COLUMN_DIR DIRECT /end RECORD_LAYOUT
/begin RECORD_LAYOUT Record_ULONG FNC_VALUES 1 ULONG COLUMN_DIR DIRECT /end RECORD_LAYOUT
/begin RECORD_LAYOUT Record_A_UINT64 FNC_VALUES 1 A_UINT64 COLUMN_DIR DIRECT /end RECORD_LAYOUT
/begin RECORD_LAYOUT Record_FLOAT32_IEEE FNC_VALUES 1 FLOAT32_IEEE COLUMN_DIR DIRECT /end RECORD_LAYOUT
/begin RECORD_LAYOUT Record_SBYTE FNC_VALUES 1 SBYTE COLUMN_DIR DIRECT /end RECORD_LAYOUT
/begin RECORD_LAYOUT Record_UBYTE FNC_VALUES 1 UBYTE COLUMN_DIR DIRECT /end RECORD_LAYOUT
/begin RECORD_LAYOUT Record_ULONG FNC_VALUES 1 ULONG COLUMN_DIR DIRECT /end RECORD_LAYOUT
/begin RECORD_LAYOUT Record_UWORD FNC_VALUES 1 UWORD COLUMN_DIR DIRECT /end RECORD_LAYOUT
/begin RECORD_LAYOUT Record_A_UINT64 FNC_VALUES 1 A_UINT64 COLUMN_DIR DIRECT /end RECORD_LAYOUT
/begin RECORD_LAYOUT Record_FLOAT32_IEEE FNC_VALUES 1 FLOAT32_IEEE COLUMN_DIR DIRECT /end RECORD_LAYOUT
/begin RECORD_LAYOUT Record_SBYTE FNC_VALUES 1 SBYTE COLUMN_DIR DIRECT /end RECORD_LAYOUT
/begin RECORD_LAYOUT Record_SWORD FNC_VALUES 1 SWORD COLUMN_DIR DIRECT /end RECORD_LAYOUT
/begin RECORD_LAYOUT Record_UBYTE FNC_VALUES 1 UBYTE COLUMN_DIR DIRECT /end RECORD_LAYOUT
/begin RECORD_LAYOUT Record_ULONG FNC_VALUES 1 ULONG COLUMN_DIR DIRECT /end RECORD_LAYOUT
/begin RECORD_LAYOUT Record_UWORD FNC_VALUES 1 UWORD COLUMN_DIR DIRECT /end RECORD_LAYOUT
/begin RECORD_LAYOUT Record_A_UINT64 FNC_VALUES 1 A_UINT64 COLUMN_DIR DIRECT /end RECORD_LAYOUT
/begin RECORD_LAYOUT Record_FLOAT32_IEEE FNC_VALUES 1 FLOAT32_IEEE COLUMN_DIR DIRECT /end RECORD_LAYOUT
/begin RECORD_LAYOUT Record_SBYTE FNC_VALUES 1 SBYTE COLUMN_DIR DIRECT /end RECORD_LAYOUT
/begin RECORD_LAYOUT Record_SWORD FNC_VALUES 1 SWORD COLUMN_DIR DIRECT /end RECORD_LAYOUT
/begin RECORD_LAYOUT Record_UBYTE FNC_VALUES 1 UBYTE COLUMN_DIR DIRECT /end RECORD_LAYOUT
/begin RECORD_LAYOUT Record_ULONG FNC_VALUES 1 ULONG COLUMN_DIR DIRECT /end RECORD_LAYOUT
/begin RECORD_LAYOUT Record_UWORD FNC_VALUES 1 UWORD COLUMN_DIR DIRECT /end RECORD_LAYOUT
/begin RECORD_LAYOUT Record_A_UINT64 FNC_VALUES 1 A_UINT64 COLUMN_DIR DIRECT /end RECORD_LAYOUT
/begin RECORD_LAYOUT Record_FLOAT32_IEEE FNC_VALUES 1 FLOAT32_IEEE COLUMN_DIR DIRECT /end RECORD_LAYOUT
/begin RECORD_LAYOUT Record_SBYTE FNC_VALUES 1 SBYTE COLUMN_DIR DIRECT /end RECORD_LAYOUT
/begin RECORD_LAYOUT Record_SWORD FNC_VALUES 1 SWORD COLUMN_DIR DIRECT /end RECORD_LAYOUT
/begin RECORD_LAYOUT Record_UBYTE FNC_VALUES 1 UBYTE COLUMN_DIR DIRECT /end RECORD_LAYOUT
/begin RECORD_LAYOUT Record_ULONG FNC_VALUES 1 ULONG COLUMN_DIR DIRECT /end RECORD_LAYOUT
/begin RECORD_LAYOUT Record_UWORD FNC_VALUES 1 UWORD COLUMN_DIR DIRECT /end RECORD_LAYOUT
/begin RECORD_LAYOUT Record_A_UINT64 FNC_VALUES 1 A_UINT64 COLUMN_DIR DIRECT /end RECORD_LAYOUT
/begin RECORD_LAYOUT Record_FLOAT32_IEEE FNC_VALUES 1 FLOAT32_IEEE COLUMN_DIR DIRECT /end RECORD_LAYOUT
/begin RECORD_LAYOUT Record_SBYTE FNC_VALUES 1 SBYTE COLUMN_DIR DIRECT /end RECORD_LAYOUT
/begin RECORD_LAYOUT Record_SWORD FNC_VALUES 1 SWORD COLUMN_DIR DIRECT /end RECORD_LAYOUT
/begin RECORD_LAYOUT Record_UBYTE FNC_VALUES 1 UBYTE COLUMN_DIR DIRECT /end RECORD_LAYOUT
/begin RECORD_LAYOUT Record_ULONG FNC_VALUES 1 ULONG COLUMN_DIR DIRECT /end RECORD_LAYOUT
/begin RECORD_LAYOUT Record_UWORD FNC_VALUES 1 UWORD COLUMN_DIR DIRECT /end RECORD_LAYOUT
/begin RECORD_LAYOUT Record_A_UINT64 FNC_VALUES 1 A_UINT64 COLUMN_DIR DIRECT /end RECORD_LAYOUT
/begin RECORD_LAYOUT Record_FLOAT32_IEEE FNC_VALUES 1 FLOAT32_IEEE COLUMN_DIR DIRECT /end RECORD_LAYOUT
/begin RECORD_LAYOUT Record_SBYTE FNC_VALUES 1 SBYTE COLUMN_DIR DIRECT /end RECORD_LAYOUT
/begin RECORD_LAYOUT Record_SWORD FNC_VALUES 1 SWORD COLUMN_DIR DIRECT /end RECORD_LAYOUT
/begin RECORD_LAYOUT Record_UBYTE FNC_VALUES 1 UBYTE COLUMN_DIR DIRECT /end RECORD_LAYOUT
/begin RECORD_LAYOUT Record_ULONG FNC_VALUES 1 ULONG COLUMN_DIR DIRECT /end RECORD_LAYOUT
/begin RECORD_LAYOUT Record_UWORD FNC_VALUES 1 UWORD COLUMN_DIR DIRECT /end RECORD_LAYOUT
/begin MEASUREMENT autosar_swc_vmp_rtARID_DEF.velDelta_p "" FLOAT32_IEEE autosar_swc_vmp_CM_single 0 0 -3.4E+38 3.4E+38 ECU_ADDRESS 0xfe4d2d30 /* @ECU_Address@autosar_swc_vmp_rtARID_DEF.velDelta_p@ */ /end MEASUREMENT
/begin MEASUREMENT autosar_swc_vmp_rtARID_DEF.velOffRampLimit "" FLOAT32_IEEE autosar_swc_vmp_CM_single 0 0 -3.4E+38 3.4E+38 ECU_ADDRESS 0xfe4d2ce0 /* @ECU_Address@autosar_swc_vmp_rtARID_DEF.velOffRampLimit@ */ /end MEASUREMENT
/begin MEASUREMENT autosar_swc_vmp_rtARID_DEF.velOffRampLimit_a "" FLOAT32_IEEE autosar_swc_vmp_CM_single 0 0 -3.4E+38 3.4E+38 ECU_ADDRESS 0xfe4d2d28 /* @ECU_Address@autosar_swc_vmp_rtARID_DEF.velOffRampLimit_a@ */ /end MEASUREMENT
/begin MEASUREMENT autosar_swc_vmp_rtARID_DEF.velOffRampLimit_e "" FLOAT32_IEEE autosar_swc_vmp_CM_single 0 0 -3.4E+38 3.4E+38 ECU_ADDRESS 0xfe4d2d04 /* @ECU_Address@autosar_swc_vmp_rtARID_DEF.velOffRampLimit_e@ */ /end MEASUREMENT
/begin COMPU_METHOD autosar_swc_vmp_CM_single "Q = V" IDENTICAL "%8.6" "" /end COMPU_METHOD
/begin RECORD_LAYOUT Record_FLOAT32_IEEE FNC_VALUES 1 FLOAT32_IEEE COLUMN_DIR DIRECT /end RECORD_LAYOUT
/begin RECORD_LAYOUT Record_SBYTE FNC_VALUES 1 SBYTE COLUMN_DIR DIRECT /end RECORD_LAYOUT
/begin RECORD_LAYOUT Record_SWORD FNC_VALUES 1 SWORD COLUMN_DIR DIRECT /end RECORD_LAYOUT
/begin RECORD_LAYOUT Record_UBYTE FNC_VALUES 1 UBYTE COLUMN_DIR DIRECT /end RECORD_LAYOUT
/begin RECORD_LAYOUT Record_ULONG FNC_VALUES 1 ULONG COLUMN_DIR DIRECT /end RECORD_LAYOUT
/begin RECORD_LAYOUT Record_UWORD FNC_VALUES 1 UWORD COLUMN_DIR DIRECT /end RECORD_LAYOUT
/begin CHARACTERISTIC ZDrive_BSW_Cal_Cal.ZDrive_BSW_Cal_VehicleInfomationTable.ASU_Type "" VALUE 0x3d8081 Record_UBYTE 0 autosar_swc_val_CM_uint8 0 255 /end CHARACTERISTIC
/begin CHARACTERISTIC ZDrive_BSW_Cal_Cal.ZDrive_BSW_Cal_VehicleInfomationTable.AccSens_LatAccSigDirect "" VALUE 0x3d8078 Record_UBYTE 0 autosar_swc_val_CM_uint8 0 255 /end CHARACTERISTIC
/begin CHARACTERISTIC ZDrive_BSW_Cal_Cal.ZDrive_BSW_Cal_VehicleInfomationTable.AccSens_LonAccSigDirect "" VALUE 0x3d8079 Record_UBYTE 0 autosar_swc_val_CM_uint8 0 255 /end CHARACTERISTIC
/begin CHARACTERISTIC ZDrive_BSW_Cal_Cal.ZDrive_BSW_Cal_VehicleInfomationTable.ActiveType "" VALUE 0x3d806d Record_UBYTE 0 autosar_swc_val_CM_uint8 0 255 /end CHARACTERISTIC
/begin CHARACTERISTIC ZDrive_BSW_Cal_Cal.ZDrive_BSW_Cal_VehicleInfomationTable.AutoHold_Type "" VALUE 0x3d8077 Record_UBYTE 0 autosar_swc_val_CM_uint8 0 255 /end CHARACTERISTIC
/begin CHARACTERISTIC ZDrive_BSW_Cal_Cal.ZDrive_BSW_Cal_VehicleInfomationTable.CURB_kg "" VALUE 0x3d810c Record_FLOAT32_IEEE 0 autosar_swc_val_CM_single -3.4E+38 3.4E+38 /end CHARACTERISTIC
/begin CHARACTERISTIC ZDrive_BSW_Cal_Cal.ZDrive_BSW_Cal_VehicleInfomationTable.CamDistToRearAxleCenter_DZ "" VALUE 0x3d8174 Record_FLOAT32_IEEE 0 autosar_swc_val_CM_single -3.4E+38 3.4E+38 /end CHARACTERISTIC
/begin CHARACTERISTIC ZDrive_BSW_Cal_Cal.ZDrive_BSW_Cal_VehicleInfomationTable.CharSpd_mps "" VALUE 0x3d8138 Record_FLOAT32_IEEE 0 autosar_swc_val_CM_single -3.4E+38 3.4E+38 /end CHARACTERISTIC
/begin CHARACTERISTIC ZDrive_BSW_Cal_Cal.ZDrive_BSW_Cal_VehicleInfomationTable.Country_Code "" VALUE 0x3d8068 Record_UBYTE 0 autosar_swc_val_CM_uint8 0 255 /end CHARACTERISTIC
/begin CHARACTERISTIC ZDrive_BSW_Cal_Cal.ZDrive_BSW_Cal_VehicleInfomationTable.DriHandTorqueDirect "" VALUE 0x3d807b Record_UBYTE 0 autosar_swc_val_CM_uint8 0 255 /end CHARACTERISTIC
/begin CHARACTERISTIC ZDrive_BSW_Cal_Cal.ZDrive_BSW_Cal_VehicleInfomationTable.DrivingLongControlInterForm "" VALUE 0x3d8071 Record_UBYTE 0 autosar_swc_val_CM_uint8 0 255 /end CHARACTERISTIC
/begin CHARACTERISTIC ZDrive_BSW_Cal_Cal.ZDrive_BSW_Cal_VehicleInfomationTable.Driving_Type "" VALUE 0x3d8075 Record_UBYTE 0 autosar_swc_val_CM_uint8 0 255 /end CHARACTERISTIC
/begin CHARACTERISTIC ZDrive_BSW_Cal_Cal.ZDrive_BSW_Cal_VehicleInfomationTable.DxvFrontBumper_m "" VALUE 0x3d80cc Record_FLOAT32_IEEE 0 autosar_swc_val_CM_single -3.4E+38 3.4E+38 /end CHARACTERISTIC
/begin CHARACTERISTIC ZDrive_BSW_Cal_Cal.ZDrive_BSW_Cal_VehicleInfomationTable.DxvRearBumper_m "" VALUE 0x3d80c8 Record_FLOAT32_IEEE 0 autosar_swc_val_CM_single -3.4E+38 3.4E+38 /end CHARACTERISTIC
/begin CHARACTERISTIC ZDrive_BSW_Cal_Cal.ZDrive_BSW_Cal_VehicleInfomationTable.EPS_Inter "" VALUE 0x3d8070 Record_UBYTE 0 autosar_swc_val_CM_uint8 0 255 /end CHARACTERISTIC
/begin CHARACTERISTIC ZDrive_BSW_Cal_Cal.ZDrive_BSW_Cal_VehicleInfomationTable.ESP_Type "" VALUE 0x3d806b Record_UBYTE 0 autosar_swc_val_CM_uint8 0 255 /end CHARACTERISTIC
/begin CHARACTERISTIC ZDrive_BSW_Cal_Cal.ZDrive_BSW_Cal_VehicleInfomationTable.Empty_mass_kg "" VALUE 0x3d8118 Record_FLOAT32_IEEE 0 autosar_swc_val_CM_single -3.4E+38 3.4E+38 /end CHARACTERISTIC
/begin CHARACTERISTIC ZDrive_BSW_Cal_Cal.ZDrive_BSW_Cal_VehicleInfomationTable.EngineMaxiTorque_N "" VALUE 0x3d80a0 Record_FLOAT32_IEEE 0 autosar_swc_val_CM_single -3.4E+38 3.4E+38 /end CHARACTERISTIC
/begin CHARACTERISTIC ZDrive_BSW_Cal_Cal.ZDrive_BSW_Cal_VehicleInfomationTable.Engine_Type "" VALUE 0x3d806f Record_UBYTE 0 autosar_swc_val_CM_uint8 0 255 /end CHARACTERISTIC
/begin CHARACTERISTIC ZDrive_BSW_Cal_Cal.ZDrive_BSW_Cal_VehicleInfomationTable.FC2LeftWheel_m "" VALUE 0x3d8188 Record_FLOAT32_IEEE 0 autosar_swc_val_CM_single -3.4E+38 3.4E+38 /end CHARACTERISTIC
/begin CHARACTERISTIC ZDrive_BSW_Cal_Cal.ZDrive_BSW_Cal_VehicleInfomationTable.FC2RearAxisX_m "" VALUE 0x3d816c Record_FLOAT32_IEEE 0 autosar_swc_val_CM_single -3.4E+38 3.4E+38 /end CHARACTERISTIC
/begin CHARACTERISTIC ZDrive_BSW_Cal_Cal.ZDrive_BSW_Cal_VehicleInfomationTable.FC2RearAxisY_m "" VALUE 0x3d8170 Record_FLOAT32_IEEE 0 autosar_swc_val_CM_single -3.4E+38 3.4E+38 /end CHARACTERISTIC
/begin CHARACTERISTIC ZDrive_BSW_Cal_Cal.ZDrive_BSW_Cal_VehicleInfomationTable.FC2RightWheel_m "" VALUE 0x3d818c Record_FLOAT32_IEEE 0 autosar_swc_val_CM_single -3.4E+38 3.4E+38 /end CHARACTERISTIC
/begin CHARACTERISTIC ZDrive_BSW_Cal_Cal.ZDrive_BSW_Cal_VehicleInfomationTable.FCFirstViewPointDist_m "" VALUE 0x3d8178 Record_FLOAT32_IEEE 0 autosar_swc_val_CM_single -3.4E+38 3.4E+38 /end CHARACTERISTIC
/begin CHARACTERISTIC ZDrive_BSW_Cal_Cal.ZDrive_BSW_Cal_VehicleInfomationTable.FCFocus2FrAxleDist_Y_m "" VALUE 0x3d8164 Record_FLOAT32_IEEE 0 autosar_swc_val_CM_single -3.4E+38 3.4E+38 /end CHARACTERISTIC
/begin CHARACTERISTIC ZDrive_BSW_Cal_Cal.ZDrive_BSW_Cal_VehicleInfomationTable.FCFocus2FrAxleDist_Z_m "" VALUE 0x3d8168 Record_FLOAT32_IEEE 0 autosar_swc_val_CM_single -3.4E+38 3.4E+38 /end CHARACTERISTIC
/begin CHARACTERISTIC ZDrive_BSW_Cal_Cal.ZDrive_BSW_Cal_VehicleInfomationTable.FRollingRadius_m "" VALUE 0x3d8150 Record_FLOAT32_IEEE 0 autosar_swc_val_CM_single -3.4E+38 3.4E+38 /end CHARACTERISTIC
/begin CHARACTERISTIC ZDrive_BSW_Cal_Cal.ZDrive_BSW_Cal_VehicleInfomationTable.FrSCBlindSpotLength_m "" VALUE 0x3d81d0 Record_FLOAT32_IEEE 0 autosar_swc_val_CM_single -3.4E+38 3.4E+38 /end CHARACTERISTIC
/begin CHARACTERISTIC ZDrive_BSW_Cal_Cal.ZDrive_BSW_Cal_VehicleInfomationTable.FrSCDist2OuterMostSide_m "" VALUE 0x3d81d4 Record_FLOAT32_IEEE 0 autosar_swc_val_CM_single -3.4E+38 3.4E+38 /end CHARACTERISTIC
/begin CHARACTERISTIC ZDrive_BSW_Cal_Cal.ZDrive_BSW_Cal_VehicleInfomationTable.FrWhlHousingHeight_m "" VALUE 0x3d80c0 Record_FLOAT32_IEEE 0 autosar_swc_val_CM_single -3.4E+38 3.4E+38 /end CHARACTERISTIC
/begin CHARACTERISTIC ZDrive_BSW_Cal_Cal.ZDrive_BSW_Cal_VehicleInfomationTable.FrWhlTrack_m "" VALUE 0x3d80b0 Record_FLOAT32_IEEE 0 autosar_swc_val_CM_single -3.4E+38 3.4E+38 /end CHARACTERISTIC
/begin CHARACTERISTIC ZDrive_BSW_Cal_Cal.ZDrive_BSW_Cal_VehicleInfomationTable.FrntLeCrnrUss_Dx "" VALUE 0x3d8260 Record_FLOAT32_IEEE 0 autosar_swc_val_CM_single -3.4E+38 3.4E+38 /end CHARACTERISTIC
/begin CHARACTERISTIC ZDrive_BSW_Cal_Cal.ZDrive_BSW_Cal_VehicleInfomationTable.FrntLeCrnrUss_Dy "" VALUE 0x3d8264 Record_FLOAT32_IEEE 0 autosar_swc_val_CM_single -3.4E+38 3.4E+38 /end CHARACTERISTIC
/begin CHARACTERISTIC ZDrive_BSW_Cal_Cal.ZDrive_BSW_Cal_VehicleInfomationTable.FrntLeCrnrUss_Dz "" VALUE 0x3d8268 Record_FLOAT32_IEEE 0 autosar_swc_val_CM_single -3.4E+38 3.4E+38 /end CHARACTERISTIC
/begin CHARACTERISTIC ZDrive_BSW_Cal_Cal.ZDrive_BSW_Cal_VehicleInfomationTable.FrntLeCrnrUss_Pitch "" VALUE 0x3d8274 Record_FLOAT32_IEEE 0 autosar_swc_val_CM_single -3.4E+38 3.4E+38 /end CHARACTERISTIC
/begin CHARACTERISTIC ZDrive_BSW_Cal_Cal.ZDrive_BSW_Cal_VehicleInfomationTable.FrntLeCrnrUss_Roll "" VALUE 0x3d8270 Record_FLOAT32_IEEE 0 autosar_swc_val_CM_single -3.4E+38 3.4E+38 /end CHARACTERISTIC
/begin CHARACTERISTIC ZDrive_BSW_Cal_Cal.ZDrive_BSW_Cal_VehicleInfomationTable.FrntLeCrnrUss_Yaw "" VALUE 0x3d8278 Record_FLOAT32_IEEE 0 autosar_swc_val_CM_single -3.4E+38 3.4E+38 /end CHARACTERISTIC
/begin CHARACTERISTIC ZDrive_BSW_Cal_Cal.ZDrive_BSW_Cal_VehicleInfomationTable.FrntLeMidUss_Dx "" VALUE 0x3d827c Record_FLOAT32_IEEE 0 autosar_swc_val_CM_single -3.4E+38 3.4E+38 /end CHARACTERISTIC
/begin CHARACTERISTIC ZDrive_BSW_Cal_Cal.ZDrive_BSW_Cal_VehicleInfomationTable.FrntLeMidUss_Dy "" VALUE 0x3d8280 Record_FLOAT32_IEEE 0 autosar_swc_val_CM_single -3.4E+38 3.4E+38 /end CHARACTERISTIC
/begin CHARACTERISTIC ZDrive_BSW_Cal_Cal.ZDrive_BSW_Cal_VehicleInfomationTable.FrntLeMidUss_Dz "" VALUE 0x3d8284 Record_FLOAT32_IEEE 0 autosar_swc_val_CM_single -3.4E+38 3.4E+38 /end CHARACTERISTIC
/begin CHARACTERISTIC ZDrive_BSW_Cal_Cal.ZDrive_BSW_Cal_VehicleInfomationTable.FrntLeMidUss_Pitch "" VALUE 0x3d8290 Record_FLOAT32_IEEE 0 autosar_swc_val_CM_single -3.4E+38 3.4E+38 /end CHARACTERISTIC
/begin CHARACTERISTIC ZDrive_BSW_Cal_Cal.ZDrive_BSW_Cal_VehicleInfomationTable.FrntLeMidUss_Roll "" VALUE 0x3d828c Record_FLOAT32_IEEE 0 autosar_swc_val_CM_single -3.4E+38 3.4E+38 /end CHARACTERISTIC
/begin CHARACTERISTIC ZDrive_BSW_Cal_Cal.ZDrive_BSW_Cal_VehicleInfomationTable.FrntLeMidUss_Yaw "" VALUE 0x3d8294 Record_FLOAT32_IEEE 0 autosar_swc_val_CM_single -3.4E+38 3.4E+38 /end CHARACTERISTIC
/begin CHARACTERISTIC ZDrive_BSW_Cal_Cal.ZDrive_BSW_Cal_VehicleInfomationTable.FrntLeSideUss_Dx "" VALUE 0x3d8244 Record_FLOAT32_IEEE 0 autosar_swc_val_CM_single -3.4E+38 3.4E+38 /end CHARACTERISTIC
/begin CHARACTERISTIC ZDrive_BSW_Cal_Cal.ZDrive_BSW_Cal_VehicleInfomationTable.FrntLeSideUss_Dy "" VALUE 0x3d8248 Record_FLOAT32_IEEE 0 autosar_swc_val_CM_single -3.4E+38 3.4E+38 /end CHARACTERISTIC
/begin CHARACTERISTIC ZDrive_BSW_Cal_Cal.ZDrive_BSW_Cal_VehicleInfomationTable.FrntLeSideUss_Dz "" VALUE 0x3d824c Record_FLOAT32_IEEE 0 autosar_swc_val_CM_single -3.4E+38 3.4E+38 /end CHARACTERISTIC
/begin CHARACTERISTIC ZDrive_BSW_Cal_Cal.ZDrive_BSW_Cal_VehicleInfomationTable.FrntLeSideUss_Pitch "" VALUE 0x3d8258 Record_FLOAT32_IEEE 0 autosar_swc_val_CM_single -3.4E+38 3.4E+38 /end CHARACTERISTIC
/begin CHARACTERISTIC ZDrive_BSW_Cal_Cal.ZDrive_BSW_Cal_VehicleInfomationTable.FrntLeSideUss_Roll "" VALUE 0x3d8254 Record_FLOAT32_IEEE 0 autosar_swc_val_CM_single -3.4E+38 3.4E+38 /end CHARACTERISTIC
/begin CHARACTERISTIC ZDrive_BSW_Cal_Cal.ZDrive_BSW_Cal_VehicleInfomationTable.FrntLeSideUss_Yaw "" VALUE 0x3d825c Record_FLOAT32_IEEE 0 autosar_swc_val_CM_single -3.4E+38 3.4E+38 /end CHARACTERISTIC
/begin CHARACTERISTIC ZDrive_BSW_Cal_Cal.ZDrive_BSW_Cal_VehicleInfomationTable.FrntRiCrnrUss_Dx "" VALUE 0x3d82b4 Record_FLOAT32_IEEE 0 autosar_swc_val_CM_single -3.4E+38 3.4E+38 /end CHARACTERISTIC
/begin CHARACTERISTIC ZDrive_BSW_Cal_Cal.ZDrive_BSW_Cal_VehicleInfomationTable.FrntRiCrnrUss_Dy "" VALUE 0x3d82b8 Record_FLOAT32_IEEE 0 autosar_swc_val_CM_single -3.4E+38 3.4E+38 /end CHARACTERISTIC
/begin CHARACTERISTIC ZDrive_BSW_Cal_Cal.ZDrive_BSW_Cal_VehicleInfomationTable.FrntRiCrnrUss_Dz "" VALUE 0x3d82bc Record_FLOAT32_IEEE 0 autosar_swc_val_CM_single -3.4E+38 3.4E+38 /end CHARACTERISTIC
/begin CHARACTERISTIC ZDrive_BSW_Cal_Cal.ZDrive_BSW_Cal_VehicleInfomationTable.FrntRiCrnrUss_Pitch "" VALUE 0x3d82c8 Record_FLOAT32_IEEE 0 autosar_swc_val_CM_single -3.4E+38 3.4E+38 /end CHARACTERISTIC
/begin CHARACTERISTIC ZDrive_BSW_Cal_Cal.ZDrive_BSW_Cal_VehicleInfomationTable.FrntRiCrnrUss_Roll "" VALUE 0x3d82c4 Record_FLOAT32_IEEE 0 autosar_swc_val_CM_single -3.4E+38 3.4E+38 /end CHARACTERISTIC
/begin CHARACTERISTIC ZDrive_BSW_Cal_Cal.ZDrive_BSW_Cal_VehicleInfomationTable.FrntRiCrnrUss_Yaw "" VALUE 0x3d82cc Record_FLOAT32_IEEE 0 autosar_swc_val_CM_single -3.4E+38 3.4E+38 /end CHARACTERISTIC
/begin CHARACTERISTIC ZDrive_BSW_Cal_Cal.ZDrive_BSW_Cal_VehicleInfomationTable.FrntRiMidUss_Dx "" VALUE 0x3d8298 Record_FLOAT32_IEEE 0 autosar_swc_val_CM_single -3.4E+38 3.4E+38 /end CHARACTERISTIC
/begin CHARACTERISTIC ZDrive_BSW_Cal_Cal.ZDrive_BSW_Cal_VehicleInfomationTable.FrntRiMidUss_Dy "" VALUE 0x3d829c Record_FLOAT32_IEEE 0 autosar_swc_val_CM_single -3.4E+38 3.4E+38 /end CHARACTERISTIC
/begin CHARACTERISTIC ZDrive_BSW_Cal_Cal.ZDrive_BSW_Cal_VehicleInfomationTable.FrntRiMidUss_Dz "" VALUE 0x3d82a0 Record_FLOAT32_IEEE 0 autosar_swc_val_CM_single -3.4E+38 3.4E+38 /end CHARACTERISTIC
/begin CHARACTERISTIC ZDrive_BSW_Cal_Cal.ZDrive_BSW_Cal_VehicleInfomationTable.FrntRiMidUss_Pitch "" VALUE 0x3d82ac Record_FLOAT32_IEEE 0 autosar_swc_val_CM_single -3.4E+38 3.4E+38 /end CHARACTERISTIC
/begin CHARACTERISTIC ZDrive_BSW_Cal_Cal.ZDrive_BSW_Cal_VehicleInfomationTable.FrntRiMidUss_Roll "" VALUE 0x3d82a8 Record_FLOAT32_IEEE 0 autosar_swc_val_CM_single -3.4E+38 3.4E+38 /end CHARACTERISTIC
/begin CHARACTERISTIC ZDrive_BSW_Cal_Cal.ZDrive_BSW_Cal_VehicleInfomationTable.FrntRiMidUss_Yaw "" VALUE 0x3d82b0 Record_FLOAT32_IEEE 0 autosar_swc_val_CM_single -3.4E+38 3.4E+38 /end CHARACTERISTIC
/begin CHARACTERISTIC ZDrive_BSW_Cal_Cal.ZDrive_BSW_Cal_VehicleInfomationTable.FrntRiSideUss_Dx "" VALUE 0x3d82d0 Record_FLOAT32_IEEE 0 autosar_swc_val_CM_single -3.4E+38 3.4E+38 /end CHARACTERISTIC
/begin CHARACTERISTIC ZDrive_BSW_Cal_Cal.ZDrive_BSW_Cal_VehicleInfomationTable.FrntRiSideUss_Dy "" VALUE 0x3d82d4 Record_FLOAT32_IEEE 0 autosar_swc_val_CM_single -3.4E+38 3.4E+38 /end CHARACTERISTIC
/begin CHARACTERISTIC ZDrive_BSW_Cal_Cal.ZDrive_BSW_Cal_VehicleInfomationTable.FrntRiSideUss_Dz "" VALUE 0x3d82d8 Record_FLOAT32_IEEE 0 autosar_swc_val_CM_single -3.4E+38 3.4E+38 /end CHARACTERISTIC
/begin CHARACTERISTIC ZDrive_BSW_Cal_Cal.ZDrive_BSW_Cal_VehicleInfomationTable.FrntRiSideUss_Pitch "" VALUE 0x3d82e4 Record_FLOAT32_IEEE 0 autosar_swc_val_CM_single -3.4E+38 3.4E+38 /end CHARACTERISTIC
/begin CHARACTERISTIC ZDrive_BSW_Cal_Cal.ZDrive_BSW_Cal_VehicleInfomationTable.FrntRiSideUss_Roll "" VALUE 0x3d82e0 Record_FLOAT32_IEEE 0 autosar_swc_val_CM_single -3.4E+38 3.4E+38 /end CHARACTERISTIC
/begin CHARACTERISTIC ZDrive_BSW_Cal_Cal.ZDrive_BSW_Cal_VehicleInfomationTable.FrntRiSideUss_Yaw "" VALUE 0x3d82e8 Record_FLOAT32_IEEE 0 autosar_swc_val_CM_single -3.4E+38 3.4E+38 /end CHARACTERISTIC
/begin CHARACTERISTIC ZDrive_BSW_Cal_Cal.ZDrive_BSW_Cal_VehicleInfomationTable.FrontAxleToCenter_m "" VALUE 0x3d80d0 Record_FLOAT32_IEEE 0 autosar_swc_val_CM_single -3.4E+38 3.4E+38 /end CHARACTERISTIC
/begin CHARACTERISTIC ZDrive_BSW_Cal_Cal.ZDrive_BSW_Cal_VehicleInfomationTable.FrontAxleToRearAxLeCenterX_m "" VALUE 0x3d80a8 Record_FLOAT32_IEEE 0 autosar_swc_val_CM_single -3.4E+38 3.4E+38 /end CHARACTERISTIC
/begin CHARACTERISTIC ZDrive_BSW_Cal_Cal.ZDrive_BSW_Cal_VehicleInfomationTable.FrontLeftFrontPointToCenterLine_Distance_m "" VALUE 0x3d80f0 Record_FLOAT32_IEEE 0 autosar_swc_val_CM_single -3.4E+38 3.4E+38 /end CHARACTERISTIC
/begin CHARACTERISTIC ZDrive_BSW_Cal_Cal.ZDrive_BSW_Cal_VehicleInfomationTable.FrontLeftFrontPointToRearAxleCenter_Distance_m "" VALUE 0x3d80ec Record_FLOAT32_IEEE 0 autosar_swc_val_CM_single -3.4E+38 3.4E+38 /end CHARACTERISTIC
/begin CHARACTERISTIC ZDrive_BSW_Cal_Cal.ZDrive_BSW_Cal_VehicleInfomationTable.FrontLeftOutsidePointToCenterLine_Distance_m "" VALUE 0x3d80f8 Record_FLOAT32_IEEE 0 autosar_swc_val_CM_single -3.4E+38 3.4E+38 /end CHARACTERISTIC
/begin CHARACTERISTIC ZDrive_BSW_Cal_Cal.ZDrive_BSW_Cal_VehicleInfomationTable.FrontLeftOutsidePointToRearAxleCenter_Distance_m "" VALUE 0x3d80f4 Record_FLOAT32_IEEE 0 autosar_swc_val_CM_single -3.4E+38 3.4E+38 /end CHARACTERISTIC
/begin CHARACTERISTIC ZDrive_BSW_Cal_Cal.ZDrive_BSW_Cal_VehicleInfomationTable.FrontOverhang_Length_m "" VALUE 0x3d80b8 Record_FLOAT32_IEEE 0 autosar_swc_val_CM_single -3.4E+38 3.4E+38 /end CHARACTERISTIC
/begin CHARACTERISTIC ZDrive_BSW_Cal_Cal.ZDrive_BSW_Cal_VehicleInfomationTable.FrontShortCamera_Dx "" VALUE 0x3d81b4 Record_FLOAT32_IEEE 0 autosar_swc_val_CM_single -3.4E+38 3.4E+38 /end CHARACTERISTIC
/begin CHARACTERISTIC ZDrive_BSW_Cal_Cal.ZDrive_BSW_Cal_VehicleInfomationTable.FrontShortCamera_Dy "" VALUE 0x3d81b8 Record_FLOAT32_IEEE 0 autosar_swc_val_CM_single -3.4E+38 3.4E+38 /end CHARACTERISTIC
/begin CHARACTERISTIC ZDrive_BSW_Cal_Cal.ZDrive_BSW_Cal_VehicleInfomationTable.FrontShortCamera_Dz "" VALUE 0x3d81bc Record_FLOAT32_IEEE 0 autosar_swc_val_CM_single -3.4E+38 3.4E+38 /end CHARACTERISTIC
/begin CHARACTERISTIC ZDrive_BSW_Cal_Cal.ZDrive_BSW_Cal_VehicleInfomationTable.FrontShortCamera_Pitch "" VALUE 0x3d81c8 Record_FLOAT32_IEEE 0 autosar_swc_val_CM_single -3.4E+38 3.4E+38 /end CHARACTERISTIC
/begin CHARACTERISTIC ZDrive_BSW_Cal_Cal.ZDrive_BSW_Cal_VehicleInfomationTable.FrontShortCamera_Roll "" VALUE 0x3d81c4 Record_FLOAT32_IEEE 0 autosar_swc_val_CM_single -3.4E+38 3.4E+38 /end CHARACTERISTIC
/begin CHARACTERISTIC ZDrive_BSW_Cal_Cal.ZDrive_BSW_Cal_VehicleInfomationTable.FrontShortCamera_Yaw "" VALUE 0x3d81cc Record_FLOAT32_IEEE 0 autosar_swc_val_CM_single -3.4E+38 3.4E+38 /end CHARACTERISTIC
/begin CHARACTERISTIC ZDrive_BSW_Cal_Cal.ZDrive_BSW_Cal_VehicleInfomationTable.GVW_kg "" VALUE 0x3d8114 Record_FLOAT32_IEEE 0 autosar_swc_val_CM_single -3.4E+38 3.4E+38 /end CHARACTERISTIC
/begin CHARACTERISTIC ZDrive_BSW_Cal_Cal.ZDrive_BSW_Cal_VehicleInfomationTable.Gear_Box "" VALUE 0x3d806e Record_UBYTE 0 autosar_swc_val_CM_uint8 0 255 /end CHARACTERISTIC
/begin CHARACTERISTIC ZDrive_BSW_Cal_Cal.ZDrive_BSW_Cal_VehicleInfomationTable.Height_m "" VALUE 0x3d809c Record_FLOAT32_IEEE 0 autosar_swc_val_CM_single -3.4E+38 3.4E+38 /end CHARACTERISTIC
/begin CHARACTERISTIC ZDrive_BSW_Cal_Cal.ZDrive_BSW_Cal_VehicleInfomationTable.IEnviroment_Bottom_Crop "" VALUE 0x3d8184 Record_SWORD 0 autosar_swc_val_CM_int16 -32768 32767 /end CHARACTERISTIC
/begin CHARACTERISTIC ZDrive_BSW_Cal_Cal.ZDrive_BSW_Cal_VehicleInfomationTable.IEnviroment_Top_Crop "" VALUE 0x3d8182 Record_UWORD 0 autosar_swc_val_CM_uint16 0 65535 /end CHARACTERISTIC
/begin CHARACTERISTIC ZDrive_BSW_Cal_Cal.ZDrive_BSW_Cal_VehicleInfomationTable.IEnvironment_CamToFrontAxle "" VALUE 0x3d8160 Record_FLOAT32_IEEE 0 autosar_swc_val_CM_single -3.4E+38 3.4E+38 /end CHARACTERISTIC
/begin CHARACTERISTIC ZDrive_BSW_Cal_Cal.ZDrive_BSW_Cal_VehicleInfomationTable.IEnvironment_RefPX_Front_Bumper "" VALUE 0x3d817c Record_FLOAT32_IEEE 0 autosar_swc_val_CM_single -3.4E+38 3.4E+38 /end CHARACTERISTIC
/begin CHARACTERISTIC ZDrive_BSW_Cal_Cal.ZDrive_BSW_Cal_VehicleInfomationTable.IEnvironment_WheelWidth "" VALUE 0x3d8120 Record_FLOAT32_IEEE 0 autosar_swc_val_CM_single -3.4E+38 3.4E+38 /end CHARACTERISTIC
/begin CHARACTERISTIC ZDrive_BSW_Cal_Cal.ZDrive_BSW_Cal_VehicleInfomationTable.LeSCBlindSpotLength_m "" VALUE 0x3d81f4 Record_FLOAT32_IEEE 0 autosar_swc_val_CM_single -3.4E+38 3.4E+38 /end CHARACTERISTIC
/begin CHARACTERISTIC ZDrive_BSW_Cal_Cal.ZDrive_BSW_Cal_VehicleInfomationTable.LeSCVerticalDist2Body_m "" VALUE 0x3d81f8 Record_FLOAT32_IEEE 0 autosar_swc_val_CM_single -3.4E+38 3.4E+38 /end CHARACTERISTIC
/begin CHARACTERISTIC ZDrive_BSW_Cal_Cal.ZDrive_BSW_Cal_VehicleInfomationTable.LeftShortCamera_Dx "" VALUE 0x3d81d8 Record_FLOAT32_IEEE 0 autosar_swc_val_CM_single -3.4E+38 3.4E+38 /end CHARACTERISTIC
/begin CHARACTERISTIC ZDrive_BSW_Cal_Cal.ZDrive_BSW_Cal_VehicleInfomationTable.LeftShortCamera_Dy "" VALUE 0x3d81dc Record_FLOAT32_IEEE 0 autosar_swc_val_CM_single -3.4E+38 3.4E+38 /end CHARACTERISTIC
/begin CHARACTERISTIC ZDrive_BSW_Cal_Cal.ZDrive_BSW_Cal_VehicleInfomationTable.LeftShortCamera_Dz "" VALUE 0x3d81e0 Record_FLOAT32_IEEE 0 autosar_swc_val_CM_single -3.4E+38 3.4E+38 /end CHARACTERISTIC
/begin CHARACTERISTIC ZDrive_BSW_Cal_Cal.ZDrive_BSW_Cal_VehicleInfomationTable.LeftShortCamera_Pitch "" VALUE 0x3d81ec Record_FLOAT32_IEEE 0 autosar_swc_val_CM_single -3.4E+38 3.4E+38 /end CHARACTERISTIC
/begin CHARACTERISTIC ZDrive_BSW_Cal_Cal.ZDrive_BSW_Cal_VehicleInfomationTable.LeftShortCamera_Roll "" VALUE 0x3d81e8 Record_FLOAT32_IEEE 0 autosar_swc_val_CM_single -3.4E+38 3.4E+38 /end CHARACTERISTIC
/begin CHARACTERISTIC ZDrive_BSW_Cal_Cal.ZDrive_BSW_Cal_VehicleInfomationTable.LeftShortCamera_Yaw "" VALUE 0x3d81f0 Record_FLOAT32_IEEE 0 autosar_swc_val_CM_single -3.4E+38 3.4E+38 /end CHARACTERISTIC
/begin CHARACTERISTIC ZDrive_BSW_Cal_Cal.ZDrive_BSW_Cal_VehicleInfomationTable.Left_Right_handType "" VALUE 0x3d8076 Record_UBYTE 0 autosar_swc_val_CM_uint8 0 255 /end CHARACTERISTIC
/begin CHARACTERISTIC ZDrive_BSW_Cal_Cal.ZDrive_BSW_Cal_VehicleInfomationTable.MaxSteeringAngle "" VALUE 0x3d8140 Record_FLOAT32_IEEE 0 autosar_swc_val_CM_single -3.4E+38 3.4E+38 /end CHARACTERISTIC
/begin CHARACTERISTIC ZDrive_BSW_Cal_Cal.ZDrive_BSW_Cal_VehicleInfomationTable.ParkingBrakeType "" VALUE 0x3d8072 Record_UBYTE 0 autosar_swc_val_CM_uint8 0 255 /end CHARACTERISTIC
/begin CHARACTERISTIC ZDrive_BSW_Cal_Cal.ZDrive_BSW_Cal_VehicleInfomationTable.ParkingLongControlInterForm "" VALUE 0x3d8074 Record_UBYTE 0 autosar_swc_val_CM_uint8 0 255 /end CHARACTERISTIC
/begin CHARACTERISTIC ZDrive_BSW_Cal_Cal.ZDrive_BSW_Cal_VehicleInfomationTable.PitchAngOfCAD "" VALUE 0x3d81ac Record_FLOAT32_IEEE 0 autosar_swc_val_CM_single -3.4E+38 3.4E+38 /end CHARACTERISTIC
/begin CHARACTERISTIC ZDrive_BSW_Cal_Cal.ZDrive_BSW_Cal_VehicleInfomationTable.PowerTransRatio "" VALUE 0x3d8158 Record_FLOAT32_IEEE 0 autosar_swc_val_CM_single -3.4E+38 3.4E+38 /end CHARACTERISTIC
/begin CHARACTERISTIC ZDrive_BSW_Cal_Cal.ZDrive_BSW_Cal_VehicleInfomationTable.PowerType "" VALUE 0x3d806a Record_UBYTE 0 autosar_swc_val_CM_uint8 0 255 /end CHARACTERISTIC
/begin CHARACTERISTIC ZDrive_BSW_Cal_Cal.ZDrive_BSW_Cal_VehicleInfomationTable.RADAR_MOUNT_PARAM_FL_X_POSITION "" VALUE 0x3d83fc Record_FLOAT32_IEEE 0 autosar_swc_val_CM_single -3.4E+38 3.4E+38 /end CHARACTERISTIC
/begin CHARACTERISTIC ZDrive_BSW_Cal_Cal.ZDrive_BSW_Cal_VehicleInfomationTable.RADAR_MOUNT_PARAM_FL_YAW_ANGLE "" VALUE 0x3d8404 Record_FLOAT32_IEEE 0 autosar_swc_val_CM_single -3.4E+38 3.4E+38 /end CHARACTERISTIC
/begin CHARACTERISTIC ZDrive_BSW_Cal_Cal.ZDrive_BSW_Cal_VehicleInfomationTable.RADAR_MOUNT_PARAM_FL_Y_POSITION "" VALUE 0x3d8400 Record_FLOAT32_IEEE 0 autosar_swc_val_CM_single -3.4E+38 3.4E+38 /end CHARACTERISTIC
/begin CHARACTERISTIC ZDrive_BSW_Cal_Cal.ZDrive_BSW_Cal_VehicleInfomationTable.RADAR_MOUNT_PARAM_FRONT_X_POSITION "" VALUE 0x3d83f0 Record_FLOAT32_IEEE 0 autosar_swc_val_CM_single -3.4E+38 3.4E+38 /end CHARACTERISTIC
/begin CHARACTERISTIC ZDrive_BSW_Cal_Cal.ZDrive_BSW_Cal_VehicleInfomationTable.RADAR_MOUNT_PARAM_FRONT_YAW_ANGLE "" VALUE 0x3d83f8 Record_FLOAT32_IEEE 0 autosar_swc_val_CM_single -3.4E+38 3.4E+38 /end CHARACTERISTIC
/begin CHARACTERISTIC ZDrive_BSW_Cal_Cal.ZDrive_BSW_Cal_VehicleInfomationTable.RADAR_MOUNT_PARAM_FRONT_Y_POSITION "" VALUE 0x3d83f4 Record_FLOAT32_IEEE 0 autosar_swc_val_CM_single -3.4E+38 3.4E+38 /end CHARACTERISTIC
/begin CHARACTERISTIC ZDrive_BSW_Cal_Cal.ZDrive_BSW_Cal_VehicleInfomationTable.RADAR_MOUNT_PARAM_FR_X_POSITION "" VALUE 0x3d8408 Record_FLOAT32_IEEE 0 autosar_swc_val_CM_single -3.4E+38 3.4E+38 /end CHARACTERISTIC
/begin CHARACTERISTIC ZDrive_BSW_Cal_Cal.ZDrive_BSW_Cal_VehicleInfomationTable.RADAR_MOUNT_PARAM_FR_YAW_ANGLE "" VALUE 0x3d8410 Record_FLOAT32_IEEE 0 autosar_swc_val_CM_single -3.4E+38 3.4E+38 /end CHARACTERISTIC
/begin CHARACTERISTIC ZDrive_BSW_Cal_Cal.ZDrive_BSW_Cal_VehicleInfomationTable.RADAR_MOUNT_PARAM_FR_Y_POSITION "" VALUE 0x3d840c Record_FLOAT32_IEEE 0 autosar_swc_val_CM_single -3.4E+38 3.4E+38 /end CHARACTERISTIC
/begin CHARACTERISTIC ZDrive_BSW_Cal_Cal.ZDrive_BSW_Cal_VehicleInfomationTable.RADAR_MOUNT_PARAM_RL_X_POSITION "" VALUE 0x3d8414 Record_FLOAT32_IEEE 0 autosar_swc_val_CM_single -3.4E+38 3.4E+38 /end CHARACTERISTIC
/begin CHARACTERISTIC ZDrive_BSW_Cal_Cal.ZDrive_BSW_Cal_VehicleInfomationTable.RADAR_MOUNT_PARAM_RL_YAW_ANGLE "" VALUE 0x3d841c Record_FLOAT32_IEEE 0 autosar_swc_val_CM_single -3.4E+38 3.4E+38 /end CHARACTERISTIC
/begin CHARACTERISTIC ZDrive_BSW_Cal_Cal.ZDrive_BSW_Cal_VehicleInfomationTable.RADAR_MOUNT_PARAM_RL_Y_POSITION "" VALUE 0x3d8418 Record_FLOAT32_IEEE 0 autosar_swc_val_CM_single -3.4E+38 3.4E+38 /end CHARACTERISTIC
/begin CHARACTERISTIC ZDrive_BSW_Cal_Cal.ZDrive_BSW_Cal_VehicleInfomationTable.RADAR_MOUNT_PARAM_RR_X_POSITION "" VALUE 0x3d8420 Record_FLOAT32_IEEE 0 autosar_swc_val_CM_single -3.4E+38 3.4E+38 /end CHARACTERISTIC
/begin CHARACTERISTIC ZDrive_BSW_Cal_Cal.ZDrive_BSW_Cal_VehicleInfomationTable.RADAR_MOUNT_PARAM_RR_YAW_ANGLE "" VALUE 0x3d8428 Record_FLOAT32_IEEE 0 autosar_swc_val_CM_single -3.4E+38 3.4E+38 /end CHARACTERISTIC
/begin CHARACTERISTIC ZDrive_BSW_Cal_Cal.ZDrive_BSW_Cal_VehicleInfomationTable.RADAR_MOUNT_PARAM_RR_Y_POSITION "" VALUE 0x3d8424 Record_FLOAT32_IEEE 0 autosar_swc_val_CM_single -3.4E+38 3.4E+38 /end CHARACTERISTIC
/begin CHARACTERISTIC ZDrive_BSW_Cal_Cal.ZDrive_BSW_Cal_VehicleInfomationTable.RRollingRadius_m "" VALUE 0x3d8154 Record_FLOAT32_IEEE 0 autosar_swc_val_CM_single -3.4E+38 3.4E+38 /end CHARACTERISTIC
/begin CHARACTERISTIC ZDrive_BSW_Cal_Cal.ZDrive_BSW_Cal_VehicleInfomationTable.ReLeCrnrUss_Dx "" VALUE 0x3d835c Record_FLOAT32_IEEE 0 autosar_swc_val_CM_single -3.4E+38 3.4E+38 /end CHARACTERISTIC
/begin CHARACTERISTIC ZDrive_BSW_Cal_Cal.ZDrive_BSW_Cal_VehicleInfomationTable.ReLeCrnrUss_Dy "" VALUE 0x3d8360 Record_FLOAT32_IEEE 0 autosar_swc_val_CM_single -3.4E+38 3.4E+38 /end CHARACTERISTIC
/begin CHARACTERISTIC ZDrive_BSW_Cal_Cal.ZDrive_BSW_Cal_VehicleInfomationTable.ReLeCrnrUss_Dz "" VALUE 0x3d8364 Record_FLOAT32_IEEE 0 autosar_swc_val_CM_single -3.4E+38 3.4E+38 /end CHARACTERISTIC
/begin CHARACTERISTIC ZDrive_BSW_Cal_Cal.ZDrive_BSW_Cal_VehicleInfomationTable.ReLeCrnrUss_Pitch "" VALUE 0x3d8370 Record_FLOAT32_IEEE 0 autosar_swc_val_CM_single -3.4E+38 3.4E+38 /end CHARACTERISTIC
/begin CHARACTERISTIC ZDrive_BSW_Cal_Cal.ZDrive_BSW_Cal_VehicleInfomationTable.ReLeCrnrUss_Roll "" VALUE 0x3d836c Record_FLOAT32_IEEE 0 autosar_swc_val_CM_single -3.4E+38 3.4E+38 /end CHARACTERISTIC
/begin CHARACTERISTIC ZDrive_BSW_Cal_Cal.ZDrive_BSW_Cal_VehicleInfomationTable.ReLeCrnrUss_Yaw "" VALUE 0x3d8374 Record_FLOAT32_IEEE 0 autosar_swc_val_CM_single -3.4E+38 3.4E+38 /end CHARACTERISTIC
/begin CHARACTERISTIC ZDrive_BSW_Cal_Cal.ZDrive_BSW_Cal_VehicleInfomationTable.ReLeMidUss_Dx "" VALUE 0x3d8340 Record_FLOAT32_IEEE 0 autosar_swc_val_CM_single -3.4E+38 3.4E+38 /end CHARACTERISTIC
/begin CHARACTERISTIC ZDrive_BSW_Cal_Cal.ZDrive_BSW_Cal_VehicleInfomationTable.ReLeMidUss_Dy "" VALUE 0x3d8344 Record_FLOAT32_IEEE 0 autosar_swc_val_CM_single -3.4E+38 3.4E+38 /end CHARACTERISTIC
/begin CHARACTERISTIC ZDrive_BSW_Cal_Cal.ZDrive_BSW_Cal_VehicleInfomationTable.ReLeMidUss_Dz "" VALUE 0x3d8348 Record_FLOAT32_IEEE 0 autosar_swc_val_CM_single -3.4E+38 3.4E+38 /end CHARACTERISTIC
/begin CHARACTERISTIC ZDrive_BSW_Cal_Cal.ZDrive_BSW_Cal_VehicleInfomationTable.ReLeMidUss_Pitch "" VALUE 0x3d8354 Record_FLOAT32_IEEE 0 autosar_swc_val_CM_single -3.4E+38 3.4E+38 /end CHARACTERISTIC
/begin CHARACTERISTIC ZDrive_BSW_Cal_Cal.ZDrive_BSW_Cal_VehicleInfomationTable.ReLeMidUss_Roll "" VALUE 0x3d8350 Record_FLOAT32_IEEE 0 autosar_swc_val_CM_single -3.4E+38 3.4E+38 /end CHARACTERISTIC
/begin CHARACTERISTIC ZDrive_BSW_Cal_Cal.ZDrive_BSW_Cal_VehicleInfomationTable.ReLeMidUss_Yaw "" VALUE 0x3d8358 Record_FLOAT32_IEEE 0 autosar_swc_val_CM_single -3.4E+38 3.4E+38 /end CHARACTERISTIC
/begin CHARACTERISTIC ZDrive_BSW_Cal_Cal.ZDrive_BSW_Cal_VehicleInfomationTable.ReLeSideUss_Dx "" VALUE 0x3d8378 Record_FLOAT32_IEEE 0 autosar_swc_val_CM_single -3.4E+38 3.4E+38 /end CHARACTERISTIC
/begin CHARACTERISTIC ZDrive_BSW_Cal_Cal.ZDrive_BSW_Cal_VehicleInfomationTable.ReLeSideUss_Dy "" VALUE 0x3d837c Record_FLOAT32_IEEE 0 autosar_swc_val_CM_single -3.4E+38 3.4E+38 /end CHARACTERISTIC
/begin CHARACTERISTIC ZDrive_BSW_Cal_Cal.ZDrive_BSW_Cal_VehicleInfomationTable.ReLeSideUss_Dz "" VALUE 0x3d8380 Record_FLOAT32_IEEE 0 autosar_swc_val_CM_single -3.4E+38 3.4E+38 /end CHARACTERISTIC
/begin CHARACTERISTIC ZDrive_BSW_Cal_Cal.ZDrive_BSW_Cal_VehicleInfomationTable.ReLeSideUss_Pitch "" VALUE 0x3d838c Record_FLOAT32_IEEE 0 autosar_swc_val_CM_single -3.4E+38 3.4E+38 /end CHARACTERISTIC
/begin CHARACTERISTIC ZDrive_BSW_Cal_Cal.ZDrive_BSW_Cal_VehicleInfomationTable.ReLeSideUss_Roll "" VALUE 0x3d8388 Record_FLOAT32_IEEE 0 autosar_swc_val_CM_single -3.4E+38 3.4E+38 /end CHARACTERISTIC
/begin CHARACTERISTIC ZDrive_BSW_Cal_Cal.ZDrive_BSW_Cal_VehicleInfomationTable.ReLeSideUss_Yaw "" VALUE 0x3d8390 Record_FLOAT32_IEEE 0 autosar_swc_val_CM_single -3.4E+38 3.4E+38 /end CHARACTERISTIC
/begin CHARACTERISTIC ZDrive_BSW_Cal_Cal.ZDrive_BSW_Cal_VehicleInfomationTable.ReRiCrnrUss_Dx "" VALUE 0x3d8308 Record_FLOAT32_IEEE 0 autosar_swc_val_CM_single -3.4E+38 3.4E+38 /end CHARACTERISTIC
/begin CHARACTERISTIC ZDrive_BSW_Cal_Cal.ZDrive_BSW_Cal_VehicleInfomationTable.ReRiCrnrUss_Dy "" VALUE 0x3d830c Record_FLOAT32_IEEE 0 autosar_swc_val_CM_single -3.4E+38 3.4E+38 /end CHARACTERISTIC
/begin CHARACTERISTIC ZDrive_BSW_Cal_Cal.ZDrive_BSW_Cal_VehicleInfomationTable.ReRiCrnrUss_Dz "" VALUE 0x3d8310 Record_FLOAT32_IEEE 0 autosar_swc_val_CM_single -3.4E+38 3.4E+38 /end CHARACTERISTIC
/begin CHARACTERISTIC ZDrive_BSW_Cal_Cal.ZDrive_BSW_Cal_VehicleInfomationTable.ReRiCrnrUss_Pitch "" VALUE 0x3d831c Record_FLOAT32_IEEE 0 autosar_swc_val_CM_single -3.4E+38 3.4E+38 /end CHARACTERISTIC
/begin CHARACTERISTIC ZDrive_BSW_Cal_Cal.ZDrive_BSW_Cal_VehicleInfomationTable.ReRiCrnrUss_Roll "" VALUE 0x3d8318 Record_FLOAT32_IEEE 0 autosar_swc_val_CM_single -3.4E+38 3.4E+38 /end CHARACTERISTIC
/begin CHARACTERISTIC ZDrive_BSW_Cal_Cal.ZDrive_BSW_Cal_VehicleInfomationTable.ReRiCrnrUss_Yaw "" VALUE 0x3d8320 Record_FLOAT32_IEEE 0 autosar_swc_val_CM_single -3.4E+38 3.4E+38 /end CHARACTERISTIC
/begin CHARACTERISTIC ZDrive_BSW_Cal_Cal.ZDrive_BSW_Cal_VehicleInfomationTable.ReRiMidUss_Dx "" VALUE 0x3d8324 Record_FLOAT32_IEEE 0 autosar_swc_val_CM_single -3.4E+38 3.4E+38 /end CHARACTERISTIC
/begin CHARACTERISTIC ZDrive_BSW_Cal_Cal.ZDrive_BSW_Cal_VehicleInfomationTable.ReRiMidUss_Dy "" VALUE 0x3d8328 Record_FLOAT32_IEEE 0 autosar_swc_val_CM_single -3.4E+38 3.4E+38 /end CHARACTERISTIC
/begin CHARACTERISTIC ZDrive_BSW_Cal_Cal.ZDrive_BSW_Cal_VehicleInfomationTable.ReRiMidUss_Dz "" VALUE 0x3d832c Record_FLOAT32_IEEE 0 autosar_swc_val_CM_single -3.4E+38 3.4E+38 /end CHARACTERISTIC
/begin CHARACTERISTIC ZDrive_BSW_Cal_Cal.ZDrive_BSW_Cal_VehicleInfomationTable.ReRiMidUss_Pitch "" VALUE 0x3d8338 Record_FLOAT32_IEEE 0 autosar_swc_val_CM_single -3.4E+38 3.4E+38 /end CHARACTERISTIC
/begin CHARACTERISTIC ZDrive_BSW_Cal_Cal.ZDrive_BSW_Cal_VehicleInfomationTable.ReRiMidUss_Roll "" VALUE 0x3d8334 Record_FLOAT32_IEEE 0 autosar_swc_val_CM_single -3.4E+38 3.4E+38 /end CHARACTERISTIC
/begin CHARACTERISTIC ZDrive_BSW_Cal_Cal.ZDrive_BSW_Cal_VehicleInfomationTable.ReRiMidUss_Yaw "" VALUE 0x3d833c Record_FLOAT32_IEEE 0 autosar_swc_val_CM_single -3.4E+38 3.4E+38 /end CHARACTERISTIC
/begin CHARACTERISTIC ZDrive_BSW_Cal_Cal.ZDrive_BSW_Cal_VehicleInfomationTable.ReRiSideUss_Dx "" VALUE 0x3d82ec Record_FLOAT32_IEEE 0 autosar_swc_val_CM_single -3.4E+38 3.4E+38 /end CHARACTERISTIC
/begin CHARACTERISTIC ZDrive_BSW_Cal_Cal.ZDrive_BSW_Cal_VehicleInfomationTable.ReRiSideUss_Dy "" VALUE 0x3d82f0 Record_FLOAT32_IEEE 0 autosar_swc_val_CM_single -3.4E+38 3.4E+38 /end CHARACTERISTIC
/begin CHARACTERISTIC ZDrive_BSW_Cal_Cal.ZDrive_BSW_Cal_VehicleInfomationTable.ReRiSideUss_Dz "" VALUE 0x3d82f4 Record_FLOAT32_IEEE 0 autosar_swc_val_CM_single -3.4E+38 3.4E+38 /end CHARACTERISTIC
/begin CHARACTERISTIC ZDrive_BSW_Cal_Cal.ZDrive_BSW_Cal_VehicleInfomationTable.ReRiSideUss_Pitch "" VALUE 0x3d8300 Record_FLOAT32_IEEE 0 autosar_swc_val_CM_single -3.4E+38 3.4E+38 /end CHARACTERISTIC
/begin CHARACTERISTIC ZDrive_BSW_Cal_Cal.ZDrive_BSW_Cal_VehicleInfomationTable.ReRiSideUss_Roll "" VALUE 0x3d82fc Record_FLOAT32_IEEE 0 autosar_swc_val_CM_single -3.4E+38 3.4E+38 /end CHARACTERISTIC
/begin CHARACTERISTIC ZDrive_BSW_Cal_Cal.ZDrive_BSW_Cal_VehicleInfomationTable.ReRiSideUss_Yaw "" VALUE 0x3d8304 Record_FLOAT32_IEEE 0 autosar_swc_val_CM_single -3.4E+38 3.4E+38 /end CHARACTERISTIC
/begin CHARACTERISTIC ZDrive_BSW_Cal_Cal.ZDrive_BSW_Cal_VehicleInfomationTable.ReSCBlindSpotLength_m "" VALUE 0x3d8218 Record_FLOAT32_IEEE 0 autosar_swc_val_CM_single -3.4E+38 3.4E+38 /end CHARACTERISTIC
/begin CHARACTERISTIC ZDrive_BSW_Cal_Cal.ZDrive_BSW_Cal_VehicleInfomationTable.ReSCDist2OuterMostSide_m "" VALUE 0x3d821c Record_FLOAT32_IEEE 0 autosar_swc_val_CM_single -3.4E+38 3.4E+38 /end CHARACTERISTIC
/begin CHARACTERISTIC ZDrive_BSW_Cal_Cal.ZDrive_BSW_Cal_VehicleInfomationTable.ReWhlHousingHeight_m "" VALUE 0x3d80c4 Record_FLOAT32_IEEE 0 autosar_swc_val_CM_single -3.4E+38 3.4E+38 /end CHARACTERISTIC
/begin CHARACTERISTIC ZDrive_BSW_Cal_Cal.ZDrive_BSW_Cal_VehicleInfomationTable.ReWhlTrack_m "" VALUE 0x3d80b4 Record_FLOAT32_IEEE 0 autosar_swc_val_CM_single -3.4E+38 3.4E+38 /end CHARACTERISTIC
/begin CHARACTERISTIC ZDrive_BSW_Cal_Cal.ZDrive_BSW_Cal_VehicleInfomationTable.RearAxleToCenter_m "" VALUE 0x3d80d4 Record_FLOAT32_IEEE 0 autosar_swc_val_CM_single -3.4E+38 3.4E+38 /end CHARACTERISTIC
/begin CHARACTERISTIC ZDrive_BSW_Cal_Cal.ZDrive_BSW_Cal_VehicleInfomationTable.RearAxlecCenterTurningCircle "" VALUE 0x3d8148 Record_FLOAT32_IEEE 0 autosar_swc_val_CM_single -3.4E+38 3.4E+38 /end CHARACTERISTIC
/begin CHARACTERISTIC ZDrive_BSW_Cal_Cal.ZDrive_BSW_Cal_VehicleInfomationTable.RearLeftOutsidePointToCenterLine_Distance_m "" VALUE 0x3d8100 Record_FLOAT32_IEEE 0 autosar_swc_val_CM_single -3.4E+38 3.4E+38 /end CHARACTERISTIC
/begin CHARACTERISTIC ZDrive_BSW_Cal_Cal.ZDrive_BSW_Cal_VehicleInfomationTable.RearLeftOutsidePointToRearAxleCenter_Distance_m "" VALUE 0x3d80fc Record_FLOAT32_IEEE 0 autosar_swc_val_CM_single -3.4E+38 3.4E+38 /end CHARACTERISTIC
/begin CHARACTERISTIC ZDrive_BSW_Cal_Cal.ZDrive_BSW_Cal_VehicleInfomationTable.RearLeftRearPointToCenterLine_Distance_m "" VALUE 0x3d8108 Record_FLOAT32_IEEE 0 autosar_swc_val_CM_single -3.4E+38 3.4E+38 /end CHARACTERISTIC
/begin CHARACTERISTIC ZDrive_BSW_Cal_Cal.ZDrive_BSW_Cal_VehicleInfomationTable.RearLeftRearPointToRearAxleCenter_Distance_m "" VALUE 0x3d8104 Record_FLOAT32_IEEE 0 autosar_swc_val_CM_single -3.4E+38 3.4E+38 /end CHARACTERISTIC
/begin CHARACTERISTIC ZDrive_BSW_Cal_Cal.ZDrive_BSW_Cal_VehicleInfomationTable.RearOverhang_Length_m "" VALUE 0x3d80bc Record_FLOAT32_IEEE 0 autosar_swc_val_CM_single -3.4E+38 3.4E+38 /end CHARACTERISTIC
/begin CHARACTERISTIC ZDrive_BSW_Cal_Cal.ZDrive_BSW_Cal_VehicleInfomationTable.RearShortCamera_Dx "" VALUE 0x3d81fc Record_FLOAT32_IEEE 0 autosar_swc_val_CM_single -3.4E+38 3.4E+38 /end CHARACTERISTIC
/begin CHARACTERISTIC ZDrive_BSW_Cal_Cal.ZDrive_BSW_Cal_VehicleInfomationTable.RearShortCamera_Dy "" VALUE 0x3d8200 Record_FLOAT32_IEEE 0 autosar_swc_val_CM_single -3.4E+38 3.4E+38 /end CHARACTERISTIC
/begin CHARACTERISTIC ZDrive_BSW_Cal_Cal.ZDrive_BSW_Cal_VehicleInfomationTable.RearShortCamera_Dz "" VALUE 0x3d8204 Record_FLOAT32_IEEE 0 autosar_swc_val_CM_single -3.4E+38 3.4E+38 /end CHARACTERISTIC
/begin CHARACTERISTIC ZDrive_BSW_Cal_Cal.ZDrive_BSW_Cal_VehicleInfomationTable.RearShortCamera_Pitch "" VALUE 0x3d8210 Record_FLOAT32_IEEE 0 autosar_swc_val_CM_single -3.4E+38 3.4E+38 /end CHARACTERISTIC
/begin CHARACTERISTIC ZDrive_BSW_Cal_Cal.ZDrive_BSW_Cal_VehicleInfomationTable.RearShortCamera_Roll "" VALUE 0x3d820c Record_FLOAT32_IEEE 0 autosar_swc_val_CM_single -3.4E+38 3.4E+38 /end CHARACTERISTIC
/begin CHARACTERISTIC ZDrive_BSW_Cal_Cal.ZDrive_BSW_Cal_VehicleInfomationTable.RearShortCamera_Yaw "" VALUE 0x3d8214 Record_FLOAT32_IEEE 0 autosar_swc_val_CM_single -3.4E+38 3.4E+38 /end CHARACTERISTIC
/begin CHARACTERISTIC ZDrive_BSW_Cal_Cal.ZDrive_BSW_Cal_VehicleInfomationTable.RearViewMirrorBottomSide_Height "" VALUE 0x3d80e4 Record_FLOAT32_IEEE 0 autosar_swc_val_CM_single -3.4E+38 3.4E+38 /end CHARACTERISTIC
/begin CHARACTERISTIC ZDrive_BSW_Cal_Cal.ZDrive_BSW_Cal_VehicleInfomationTable.RearViewMirrorLength_On_X "" VALUE 0x3d80dc Record_FLOAT32_IEEE 0 autosar_swc_val_CM_single -3.4E+38 3.4E+38 /end CHARACTERISTIC
/begin CHARACTERISTIC ZDrive_BSW_Cal_Cal.ZDrive_BSW_Cal_VehicleInfomationTable.RearViewMirrorLength_On_Y "" VALUE 0x3d80d8 Record_FLOAT32_IEEE 0 autosar_swc_val_CM_single -3.4E+38 3.4E+38 /end CHARACTERISTIC
/begin CHARACTERISTIC ZDrive_BSW_Cal_Cal.ZDrive_BSW_Cal_VehicleInfomationTable.RearViewMirrorOutsidePointToRearAxle_Diatance_m "" VALUE 0x3d80e8 Record_FLOAT32_IEEE 0 autosar_swc_val_CM_single -3.4E+38 3.4E+38 /end CHARACTERISTIC
/begin CHARACTERISTIC ZDrive_BSW_Cal_Cal.ZDrive_BSW_Cal_VehicleInfomationTable.RearViewMirrorTopSide_Height "" VALUE 0x3d80e0 Record_FLOAT32_IEEE 0 autosar_swc_val_CM_single -3.4E+38 3.4E+38 /end CHARACTERISTIC
/begin CHARACTERISTIC ZDrive_BSW_Cal_Cal.ZDrive_BSW_Cal_VehicleInfomationTable.RiSCBlindSpotLength_m "" VALUE 0x3d823c Record_FLOAT32_IEEE 0 autosar_swc_val_CM_single -3.4E+38 3.4E+38 /end CHARACTERISTIC
/begin CHARACTERISTIC ZDrive_BSW_Cal_Cal.ZDrive_BSW_Cal_VehicleInfomationTable.RiSCVerticalDist2Body_m "" VALUE 0x3d8240 Record_FLOAT32_IEEE 0 autosar_swc_val_CM_single -3.4E+38 3.4E+38 /end CHARACTERISTIC
/begin CHARACTERISTIC ZDrive_BSW_Cal_Cal.ZDrive_BSW_Cal_VehicleInfomationTable.RightShortCamera_Dx "" VALUE 0x3d8220 Record_FLOAT32_IEEE 0 autosar_swc_val_CM_single -3.4E+38 3.4E+38 /end CHARACTERISTIC
/begin CHARACTERISTIC ZDrive_BSW_Cal_Cal.ZDrive_BSW_Cal_VehicleInfomationTable.RightShortCamera_Dy "" VALUE 0x3d8224 Record_FLOAT32_IEEE 0 autosar_swc_val_CM_single -3.4E+38 3.4E+38 /end CHARACTERISTIC
/begin CHARACTERISTIC ZDrive_BSW_Cal_Cal.ZDrive_BSW_Cal_VehicleInfomationTable.RightShortCamera_Dz "" VALUE 0x3d8228 Record_FLOAT32_IEEE 0 autosar_swc_val_CM_single -3.4E+38 3.4E+38 /end CHARACTERISTIC
/begin CHARACTERISTIC ZDrive_BSW_Cal_Cal.ZDrive_BSW_Cal_VehicleInfomationTable.RightShortCamera_Pitch "" VALUE 0x3d8234 Record_FLOAT32_IEEE 0 autosar_swc_val_CM_single -3.4E+38 3.4E+38 /end CHARACTERISTIC
/begin CHARACTERISTIC ZDrive_BSW_Cal_Cal.ZDrive_BSW_Cal_VehicleInfomationTable.RightShortCamera_Roll "" VALUE 0x3d8230 Record_FLOAT32_IEEE 0 autosar_swc_val_CM_single -3.4E+38 3.4E+38 /end CHARACTERISTIC
/begin CHARACTERISTIC ZDrive_BSW_Cal_Cal.ZDrive_BSW_Cal_VehicleInfomationTable.RightShortCamera_Yaw "" VALUE 0x3d8238 Record_FLOAT32_IEEE 0 autosar_swc_val_CM_single -3.4E+38 3.4E+38 /end CHARACTERISTIC
/begin CHARACTERISTIC ZDrive_BSW_Cal_Cal.ZDrive_BSW_Cal_VehicleInfomationTable.RollingAngOfCAD "" VALUE 0x3d81a8 Record_FLOAT32_IEEE 0 autosar_swc_val_CM_single -3.4E+38 3.4E+38 /end CHARACTERISTIC
/begin CHARACTERISTIC ZDrive_BSW_Cal_Cal.ZDrive_BSW_Cal_VehicleInfomationTable.SideSlipAnglefactor "" VALUE 0x3d813c Record_FLOAT32_IEEE 0 autosar_swc_val_CM_single -3.4E+38 3.4E+38 /end CHARACTERISTIC
/begin CHARACTERISTIC ZDrive_BSW_Cal_Cal.ZDrive_BSW_Cal_VehicleInfomationTable.SteeringAngleRatio "" VALUE 0x3d8144 Record_FLOAT32_IEEE 0 autosar_swc_val_CM_single -3.4E+38 3.4E+38 /end CHARACTERISTIC
/begin CHARACTERISTIC ZDrive_BSW_Cal_Cal.ZDrive_BSW_Cal_VehicleInfomationTable.StrWhlAngSigDirect "" VALUE 0x3d807a Record_UBYTE 0 autosar_swc_val_CM_uint8 0 255 /end CHARACTERISTIC
/begin CHARACTERISTIC ZDrive_BSW_Cal_Cal.ZDrive_BSW_Cal_VehicleInfomationTable.StrWhlConfig "" VALUE 0x3d8073 Record_UBYTE 0 autosar_swc_val_CM_uint8 0 255 /end CHARACTERISTIC
/begin CHARACTERISTIC ZDrive_BSW_Cal_Cal.ZDrive_BSW_Cal_VehicleInfomationTable.StrWhlMappingTable "" VALUE 0x3d814c Record_FLOAT32_IEEE 0 autosar_swc_val_CM_single -3.4E+38 3.4E+38 /end CHARACTERISTIC
/begin CHARACTERISTIC ZDrive_BSW_Cal_Cal.ZDrive_BSW_Cal_VehicleInfomationTable.Suspension "" VALUE 0x3d8082 Record_UBYTE 0 autosar_swc_val_CM_uint8 0 255 /end CHARACTERISTIC
/begin CHARACTERISTIC ZDrive_BSW_Cal_Cal.ZDrive_BSW_Cal_VehicleInfomationTable.TAC_Bottom "" VALUE 0x3d8180 Record_SBYTE 0 autosar_swc_val_CM_int8 -128 127 /end CHARACTERISTIC
/begin CHARACTERISTIC ZDrive_BSW_Cal_Cal.ZDrive_BSW_Cal_VehicleInfomationTable.TAC_Camera_Height "" VALUE 0x3d815c Record_FLOAT32_IEEE 0 autosar_swc_val_CM_single -3.4E+38 3.4E+38 /end CHARACTERISTIC
/begin CHARACTERISTIC ZDrive_BSW_Cal_Cal.ZDrive_BSW_Cal_VehicleInfomationTable.TAC_Targets_Num "" VALUE 0x3d8190 Record_UBYTE 0 autosar_swc_val_CM_uint8 0 255 /end CHARACTERISTIC
/begin CHARACTERISTIC ZDrive_BSW_Cal_Cal.ZDrive_BSW_Cal_VehicleInfomationTable.TireRadius_m "" VALUE 0x3d811c Record_FLOAT32_IEEE 0 autosar_swc_val_CM_single -3.4E+38 3.4E+38 /end CHARACTERISTIC
/begin CHARACTERISTIC ZDrive_BSW_Cal_Cal.ZDrive_BSW_Cal_VehicleInfomationTable.TurnLevelType "" VALUE 0x3d806c Record_UBYTE 0 autosar_swc_val_CM_uint8 0 255 /end CHARACTERISTIC
/begin CHARACTERISTIC ZDrive_BSW_Cal_Cal.ZDrive_BSW_Cal_VehicleInfomationTable.UltraInstallAng_FA "" VALUE 0x3d8398 Record_FLOAT32_IEEE 0 autosar_swc_val_CM_single -3.4E+38 3.4E+38 /end CHARACTERISTIC
/begin CHARACTERISTIC ZDrive_BSW_Cal_Cal.ZDrive_BSW_Cal_VehicleInfomationTable.UltraInstallAng_FM "" VALUE 0x3d8394 Record_FLOAT32_IEEE 0 autosar_swc_val_CM_single -3.4E+38 3.4E+38 /end CHARACTERISTIC
/begin CHARACTERISTIC ZDrive_BSW_Cal_Cal.ZDrive_BSW_Cal_VehicleInfomationTable.UltraInstallAng_FS "" VALUE 0x3d839c Record_FLOAT32_IEEE 0 autosar_swc_val_CM_single -3.4E+38 3.4E+38 /end CHARACTERISTIC
/begin CHARACTERISTIC ZDrive_BSW_Cal_Cal.ZDrive_BSW_Cal_VehicleInfomationTable.UltraInstallAng_RA "" VALUE 0x3d83b4 Record_FLOAT32_IEEE 0 autosar_swc_val_CM_single -3.4E+38 3.4E+38 /end CHARACTERISTIC
/begin CHARACTERISTIC ZDrive_BSW_Cal_Cal.ZDrive_BSW_Cal_VehicleInfomationTable.UltraInstallAng_RM "" VALUE 0x3d83b0 Record_FLOAT32_IEEE 0 autosar_swc_val_CM_single -3.4E+38 3.4E+38 /end CHARACTERISTIC
/begin CHARACTERISTIC ZDrive_BSW_Cal_Cal.ZDrive_BSW_Cal_VehicleInfomationTable.UltraInstallAng_RS "" VALUE 0x3d83b8 Record_FLOAT32_IEEE 0 autosar_swc_val_CM_single -3.4E+38 3.4E+38 /end CHARACTERISTIC
/begin CHARACTERISTIC ZDrive_BSW_Cal_Cal.ZDrive_BSW_Cal_VehicleInfomationTable.UltraInstallHeight_FA_m "" VALUE 0x3d83cc Record_FLOAT32_IEEE 0 autosar_swc_val_CM_single -3.4E+38 3.4E+38 /end CHARACTERISTIC
/begin CHARACTERISTIC ZDrive_BSW_Cal_Cal.ZDrive_BSW_Cal_VehicleInfomationTable.UltraInstallHeight_FM_m "" VALUE 0x3d83c8 Record_FLOAT32_IEEE 0 autosar_swc_val_CM_single -3.4E+38 3.4E+38 /end CHARACTERISTIC
/begin CHARACTERISTIC ZDrive_BSW_Cal_Cal.ZDrive_BSW_Cal_VehicleInfomationTable.UltraInstallHeight_FS_m "" VALUE 0x3d83d0 Record_FLOAT32_IEEE 0 autosar_swc_val_CM_single -3.4E+38 3.4E+38 /end CHARACTERISTIC
/begin CHARACTERISTIC ZDrive_BSW_Cal_Cal.ZDrive_BSW_Cal_VehicleInfomationTable.UltraInstallHeight_RA_m "" VALUE 0x3d83d8 Record_FLOAT32_IEEE 0 autosar_swc_val_CM_single -3.4E+38 3.4E+38 /end CHARACTERISTIC
/begin CHARACTERISTIC ZDrive_BSW_Cal_Cal.ZDrive_BSW_Cal_VehicleInfomationTable.UltraInstallHeight_RM_m "" VALUE 0x3d83d4 Record_FLOAT32_IEEE 0 autosar_swc_val_CM_single -3.4E+38 3.4E+38 /end CHARACTERISTIC
/begin CHARACTERISTIC ZDrive_BSW_Cal_Cal.ZDrive_BSW_Cal_VehicleInfomationTable.UltraInstallHeight_RS_m "" VALUE 0x3d83dc Record_FLOAT32_IEEE 0 autosar_swc_val_CM_single -3.4E+38 3.4E+38 /end CHARACTERISTIC
/begin CHARACTERISTIC ZDrive_BSW_Cal_Cal.ZDrive_BSW_Cal_VehicleInfomationTable.UltraInstallLatOffset_FA_m "" VALUE 0x3d83a4 Record_FLOAT32_IEEE 0 autosar_swc_val_CM_single -3.4E+38 3.4E+38 /end CHARACTERISTIC
/begin CHARACTERISTIC ZDrive_BSW_Cal_Cal.ZDrive_BSW_Cal_VehicleInfomationTable.UltraInstallLatOffset_FM_m "" VALUE 0x3d83a0 Record_FLOAT32_IEEE 0 autosar_swc_val_CM_single -3.4E+38 3.4E+38 /end CHARACTERISTIC
/begin CHARACTERISTIC ZDrive_BSW_Cal_Cal.ZDrive_BSW_Cal_VehicleInfomationTable.UltraInstallLatOffset_FS_m "" VALUE 0x3d83a8 Record_FLOAT32_IEEE 0 autosar_swc_val_CM_single -3.4E+38 3.4E+38 /end CHARACTERISTIC
/begin CHARACTERISTIC ZDrive_BSW_Cal_Cal.ZDrive_BSW_Cal_VehicleInfomationTable.UltraInstallLatOffset_RA_m "" VALUE 0x3d83c0 Record_FLOAT32_IEEE 0 autosar_swc_val_CM_single -3.4E+38 3.4E+38 /end CHARACTERISTIC
/begin CHARACTERISTIC ZDrive_BSW_Cal_Cal.ZDrive_BSW_Cal_VehicleInfomationTable.UltraInstallLatOffset_RM_m "" VALUE 0x3d83bc Record_FLOAT32_IEEE 0 autosar_swc_val_CM_single -3.4E+38 3.4E+38 /end CHARACTERISTIC
/begin CHARACTERISTIC ZDrive_BSW_Cal_Cal.ZDrive_BSW_Cal_VehicleInfomationTable.UltraInstallLatOffset_RS_m "" VALUE 0x3d83c4 Record_FLOAT32_IEEE 0 autosar_swc_val_CM_single -3.4E+38 3.4E+38 /end CHARACTERISTIC
/begin CHARACTERISTIC ZDrive_BSW_Cal_Cal.ZDrive_BSW_Cal_VehicleInfomationTable.VISION_MOUNT_PARAM_FRONT_X_POSITION "" VALUE 0x3d83e4 Record_FLOAT32_IEEE 0 autosar_swc_val_CM_single -3.4E+38 3.4E+38 /end CHARACTERISTIC
/begin CHARACTERISTIC ZDrive_BSW_Cal_Cal.ZDrive_BSW_Cal_VehicleInfomationTable.VISION_MOUNT_PARAM_FRONT_YAW_ANGLE "" VALUE 0x3d83ec Record_FLOAT32_IEEE 0 autosar_swc_val_CM_single -3.4E+38 3.4E+38 /end CHARACTERISTIC
/begin CHARACTERISTIC ZDrive_BSW_Cal_Cal.ZDrive_BSW_Cal_VehicleInfomationTable.VISION_MOUNT_PARAM_FRONT_Y_POSITION "" VALUE 0x3d83e8 Record_FLOAT32_IEEE 0 autosar_swc_val_CM_single -3.4E+38 3.4E+38 /end CHARACTERISTIC
/begin CHARACTERISTIC ZDrive_BSW_Cal_Cal.ZDrive_BSW_Cal_VehicleInfomationTable.ValFunc_Reserve1 "" VALUE 0x3d807f Record_UBYTE 0 autosar_swc_val_CM_uint8 0 255 /end CHARACTERISTIC
/begin CHARACTERISTIC ZDrive_BSW_Cal_Cal.ZDrive_BSW_Cal_VehicleInfomationTable.ValFunc_Reserve2 "" VALUE 0x3d8080 Record_UBYTE 0 autosar_swc_val_CM_uint8 0 255 /end CHARACTERISTIC
/begin CHARACTERISTIC ZDrive_BSW_Cal_Cal.ZDrive_BSW_Cal_VehicleInfomationTable.VehConfig_Code1 "" VALUE 0x3d8060 Record_ULONG 0 autosar_swc_val_CM_uint32 0 4294967295 /end CHARACTERISTIC
/begin CHARACTERISTIC ZDrive_BSW_Cal_Cal.ZDrive_BSW_Cal_VehicleInfomationTable.VehConfig_Code2 "" VALUE 0x3d8064 Record_ULONG 0 autosar_swc_val_CM_uint32 0 4294967295 /end CHARACTERISTIC
/begin CHARACTERISTIC ZDrive_BSW_Cal_Cal.ZDrive_BSW_Cal_VehicleInfomationTable.VehicleWidthMax_m "" VALUE 0x3d8094 Record_FLOAT32_IEEE 0 autosar_swc_val_CM_single -3.4E+38 3.4E+38 /end CHARACTERISTIC
/begin CHARACTERISTIC ZDrive_BSW_Cal_Cal.ZDrive_BSW_Cal_VehicleInfomationTable.VehicleWidthMin_m "" VALUE 0x3d8098 Record_FLOAT32_IEEE 0 autosar_swc_val_CM_single -3.4E+38 3.4E+38 /end CHARACTERISTIC
/begin CHARACTERISTIC ZDrive_BSW_Cal_Cal.ZDrive_BSW_Cal_VehicleInfomationTable.Vehicle_Information_End_Tag "" VALUE 0x3d855f Record_UBYTE 0 autosar_swc_val_CM_uint8 0 255 /end CHARACTERISTIC
/begin CHARACTERISTIC ZDrive_BSW_Cal_Cal.ZDrive_BSW_Cal_VehicleInfomationTable.Vehicle_Information_Reserved_Line102 "" VALUE 0x3d8181 Record_UBYTE 0 autosar_swc_val_CM_uint8 0 255 /end CHARACTERISTIC
/begin CHARACTERISTIC ZDrive_BSW_Cal_Cal.ZDrive_BSW_Cal_VehicleInfomationTable.Vehicle_Information_Reserved_Line105 "" VALUE 0x3d8186 Record_UWORD 0 autosar_swc_val_CM_uint16 0 65535 /end CHARACTERISTIC
/begin CHARACTERISTIC ZDrive_BSW_Cal_Cal.ZDrive_BSW_Cal_VehicleInfomationTable.Vehicle_Information_Reserved_Line109 "" VALUE 0x3d8191 Record_UBYTE 0 autosar_swc_val_CM_uint8 0 255 /end CHARACTERISTIC
/begin CHARACTERISTIC ZDrive_BSW_Cal_Cal.ZDrive_BSW_Cal_VehicleInfomationTable.Vehicle_Information_Reserved_Line110 "" VALUE 0x3d8192 Record_UWORD 0 autosar_swc_val_CM_uint16 0 65535 /end CHARACTERISTIC
/begin CHARACTERISTIC ZDrive_BSW_Cal_Cal.ZDrive_BSW_Cal_VehicleInfomationTable.Vehicle_Information_Reserved_Line115 "" VALUE 0x3d81a4 Record_ULONG 0 autosar_swc_val_CM_uint32 0 4294967295 /end CHARACTERISTIC
/begin CHARACTERISTIC ZDrive_BSW_Cal_Cal.ZDrive_BSW_Cal_VehicleInfomationTable.Vehicle_Information_Reserved_Line122 "" VALUE 0x3d81c0 Record_ULONG 0 autosar_swc_val_CM_uint32 0 4294967295 /end CHARACTERISTIC
/begin CHARACTERISTIC ZDrive_BSW_Cal_Cal.ZDrive_BSW_Cal_VehicleInfomationTable.Vehicle_Information_Reserved_Line131 "" VALUE 0x3d81e4 Record_ULONG 0 autosar_swc_val_CM_uint32 0 4294967295 /end CHARACTERISTIC
/begin CHARACTERISTIC ZDrive_BSW_Cal_Cal.ZDrive_BSW_Cal_VehicleInfomationTable.Vehicle_Information_Reserved_Line140 "" VALUE 0x3d8208 Record_ULONG 0 autosar_swc_val_CM_uint32 0 4294967295 /end CHARACTERISTIC
/begin CHARACTERISTIC ZDrive_BSW_Cal_Cal.ZDrive_BSW_Cal_VehicleInfomationTable.Vehicle_Information_Reserved_Line149 "" VALUE 0x3d822c Record_ULONG 0 autosar_swc_val_CM_uint32 0 4294967295 /end CHARACTERISTIC
/begin CHARACTERISTIC ZDrive_BSW_Cal_Cal.ZDrive_BSW_Cal_VehicleInfomationTable.Vehicle_Information_Reserved_Line158 "" VALUE 0x3d8250 Record_ULONG 0 autosar_swc_val_CM_uint32 0 4294967295 /end CHARACTERISTIC
/begin CHARACTERISTIC ZDrive_BSW_Cal_Cal.ZDrive_BSW_Cal_VehicleInfomationTable.Vehicle_Information_Reserved_Line165 "" VALUE 0x3d826c Record_ULONG 0 autosar_swc_val_CM_uint32 0 4294967295 /end CHARACTERISTIC
/begin CHARACTERISTIC ZDrive_BSW_Cal_Cal.ZDrive_BSW_Cal_VehicleInfomationTable.Vehicle_Information_Reserved_Line172 "" VALUE 0x3d8288 Record_ULONG 0 autosar_swc_val_CM_uint32 0 4294967295 /end CHARACTERISTIC
/begin CHARACTERISTIC ZDrive_BSW_Cal_Cal.ZDrive_BSW_Cal_VehicleInfomationTable.Vehicle_Information_Reserved_Line179 "" VALUE 0x3d82a4 Record_ULONG 0 autosar_swc_val_CM_uint32 0 4294967295 /end CHARACTERISTIC
/begin CHARACTERISTIC ZDrive_BSW_Cal_Cal.ZDrive_BSW_Cal_VehicleInfomationTable.Vehicle_Information_Reserved_Line186 "" VALUE 0x3d82c0 Record_ULONG 0 autosar_swc_val_CM_uint32 0 4294967295 /end CHARACTERISTIC
/begin CHARACTERISTIC ZDrive_BSW_Cal_Cal.ZDrive_BSW_Cal_VehicleInfomationTable.Vehicle_Information_Reserved_Line193 "" VALUE 0x3d82dc Record_ULONG 0 autosar_swc_val_CM_uint32 0 4294967295 /end CHARACTERISTIC
/begin CHARACTERISTIC ZDrive_BSW_Cal_Cal.ZDrive_BSW_Cal_VehicleInfomationTable.Vehicle_Information_Reserved_Line200 "" VALUE 0x3d82f8 Record_ULONG 0 autosar_swc_val_CM_uint32 0 4294967295 /end CHARACTERISTIC
/begin CHARACTERISTIC ZDrive_BSW_Cal_Cal.ZDrive_BSW_Cal_VehicleInfomationTable.Vehicle_Information_Reserved_Line207 "" VALUE 0x3d8314 Record_ULONG 0 autosar_swc_val_CM_uint32 0 4294967295 /end CHARACTERISTIC
/begin CHARACTERISTIC ZDrive_BSW_Cal_Cal.ZDrive_BSW_Cal_VehicleInfomationTable.Vehicle_Information_Reserved_Line214 "" VALUE 0x3d8330 Record_ULONG 0 autosar_swc_val_CM_uint32 0 4294967295 /end CHARACTERISTIC
/begin CHARACTERISTIC ZDrive_BSW_Cal_Cal.ZDrive_BSW_Cal_VehicleInfomationTable.Vehicle_Information_Reserved_Line221 "" VALUE 0x3d834c Record_ULONG 0 autosar_swc_val_CM_uint32 0 4294967295 /end CHARACTERISTIC
/begin CHARACTERISTIC ZDrive_BSW_Cal_Cal.ZDrive_BSW_Cal_VehicleInfomationTable.Vehicle_Information_Reserved_Line228 "" VALUE 0x3d8368 Record_ULONG 0 autosar_swc_val_CM_uint32 0 4294967295 /end CHARACTERISTIC
/begin CHARACTERISTIC ZDrive_BSW_Cal_Cal.ZDrive_BSW_Cal_VehicleInfomationTable.Vehicle_Information_Reserved_Line235 "" VALUE 0x3d8384 Record_ULONG 0 autosar_swc_val_CM_uint32 0 4294967295 /end CHARACTERISTIC
/begin CHARACTERISTIC ZDrive_BSW_Cal_Cal.ZDrive_BSW_Cal_VehicleInfomationTable.Vehicle_Information_Reserved_Line245 "" VALUE 0x3d83ac Record_ULONG 0 autosar_swc_val_CM_uint32 0 4294967295 /end CHARACTERISTIC
/begin CHARACTERISTIC ZDrive_BSW_Cal_Cal.ZDrive_BSW_Cal_VehicleInfomationTable.Vehicle_Information_Reserved_Line258 "" VALUE 0x3d83e0 Record_ULONG 0 autosar_swc_val_CM_uint32 0 4294967295 /end CHARACTERISTIC
/begin CHARACTERISTIC ZDrive_BSW_Cal_Cal.ZDrive_BSW_Cal_VehicleInfomationTable.Vehicle_Information_Reserved_Line26 "" VALUE 0x3d807e Record_UBYTE 0 autosar_swc_val_CM_uint8 0 255 /end CHARACTERISTIC
/begin CHARACTERISTIC ZDrive_BSW_Cal_Cal.ZDrive_BSW_Cal_VehicleInfomationTable.Vehicle_Information_Reserved_Line277 "" VALUE 0x3d842c Record_ULONG 0 autosar_swc_val_CM_uint32 0 4294967295 /end CHARACTERISTIC
/begin CHARACTERISTIC ZDrive_BSW_Cal_Cal.ZDrive_BSW_Cal_VehicleInfomationTable.Vehicle_Information_Reserved_Line278 "" VALUE 0x3d8430 Record_ULONG 0 autosar_swc_val_CM_uint32 0 4294967295 /end CHARACTERISTIC
/begin CHARACTERISTIC ZDrive_BSW_Cal_Cal.ZDrive_BSW_Cal_VehicleInfomationTable.Vehicle_Information_Reserved_Line279 "" VALUE 0x3d8434 Record_ULONG 0 autosar_swc_val_CM_uint32 0 4294967295 /end CHARACTERISTIC
/begin CHARACTERISTIC ZDrive_BSW_Cal_Cal.ZDrive_BSW_Cal_VehicleInfomationTable.Vehicle_Information_Reserved_Line280 "" VALUE 0x3d8438 Record_ULONG 0 autosar_swc_val_CM_uint32 0 4294967295 /end CHARACTERISTIC
/begin CHARACTERISTIC ZDrive_BSW_Cal_Cal.ZDrive_BSW_Cal_VehicleInfomationTable.Vehicle_Information_Reserved_Line281 "" VALUE 0x3d843c Record_ULONG 0 autosar_swc_val_CM_uint32 0 4294967295 /end CHARACTERISTIC
/begin CHARACTERISTIC ZDrive_BSW_Cal_Cal.ZDrive_BSW_Cal_VehicleInfomationTable.Vehicle_Information_Reserved_Line282 "" VALUE 0x3d8440 Record_ULONG 0 autosar_swc_val_CM_uint32 0 4294967295 /end CHARACTERISTIC
/begin CHARACTERISTIC ZDrive_BSW_Cal_Cal.ZDrive_BSW_Cal_VehicleInfomationTable.Vehicle_Information_Reserved_Line283 "" VALUE 0x3d8444 Record_ULONG 0 autosar_swc_val_CM_uint32 0 4294967295 /end CHARACTERISTIC
/begin CHARACTERISTIC ZDrive_BSW_Cal_Cal.ZDrive_BSW_Cal_VehicleInfomationTable.Vehicle_Information_Reserved_Line284 "" VALUE 0x3d8448 Record_ULONG 0 autosar_swc_val_CM_uint32 0 4294967295 /end CHARACTERISTIC
/begin CHARACTERISTIC ZDrive_BSW_Cal_Cal.ZDrive_BSW_Cal_VehicleInfomationTable.Vehicle_Information_Reserved_Line285 "" VALUE 0x3d844c Record_ULONG 0 autosar_swc_val_CM_uint32 0 4294967295 /end CHARACTERISTIC
/begin CHARACTERISTIC ZDrive_BSW_Cal_Cal.ZDrive_BSW_Cal_VehicleInfomationTable.Vehicle_Information_Reserved_Line286 "" VALUE 0x3d8450 Record_ULONG 0 autosar_swc_val_CM_uint32 0 4294967295 /end CHARACTERISTIC
/begin CHARACTERISTIC ZDrive_BSW_Cal_Cal.ZDrive_BSW_Cal_VehicleInfomationTable.Vehicle_Information_Reserved_Line287 "" VALUE 0x3d8454 Record_ULONG 0 autosar_swc_val_CM_uint32 0 4294967295 /end CHARACTERISTIC
/begin CHARACTERISTIC ZDrive_BSW_Cal_Cal.ZDrive_BSW_Cal_VehicleInfomationTable.Vehicle_Information_Reserved_Line288 "" VALUE 0x3d8458 Record_ULONG 0 autosar_swc_val_CM_uint32 0 4294967295 /end CHARACTERISTIC
/begin CHARACTERISTIC ZDrive_BSW_Cal_Cal.ZDrive_BSW_Cal_VehicleInfomationTable.Vehicle_Information_Reserved_Line289 "" VALUE 0x3d845c Record_ULONG 0 autosar_swc_val_CM_uint32 0 4294967295 /end CHARACTERISTIC
/begin CHARACTERISTIC ZDrive_BSW_Cal_Cal.ZDrive_BSW_Cal_VehicleInfomationTable.Vehicle_Information_Reserved_Line290 "" VALUE 0x3d8460 Record_ULONG 0 autosar_swc_val_CM_uint32 0 4294967295 /end CHARACTERISTIC
/begin CHARACTERISTIC ZDrive_BSW_Cal_Cal.ZDrive_BSW_Cal_VehicleInfomationTable.Vehicle_Information_Reserved_Line291 "" VALUE 0x3d8464 Record_ULONG 0 autosar_swc_val_CM_uint32 0 4294967295 /end CHARACTERISTIC
/begin CHARACTERISTIC ZDrive_BSW_Cal_Cal.ZDrive_BSW_Cal_VehicleInfomationTable.Vehicle_Information_Reserved_Line292 "" VALUE 0x3d8468 Record_ULONG 0 autosar_swc_val_CM_uint32 0 4294967295 /end CHARACTERISTIC
/begin CHARACTERISTIC ZDrive_BSW_Cal_Cal.ZDrive_BSW_Cal_VehicleInfomationTable.Vehicle_Information_Reserved_Line293 "" VALUE 0x3d846c Record_ULONG 0 autosar_swc_val_CM_uint32 0 4294967295 /end CHARACTERISTIC
/begin CHARACTERISTIC ZDrive_BSW_Cal_Cal.ZDrive_BSW_Cal_VehicleInfomationTable.Vehicle_Information_Reserved_Line294 "" VALUE 0x3d8470 Record_ULONG 0 autosar_swc_val_CM_uint32 0 4294967295 /end CHARACTERISTIC
/begin CHARACTERISTIC ZDrive_BSW_Cal_Cal.ZDrive_BSW_Cal_VehicleInfomationTable.Vehicle_Information_Reserved_Line295 "" VALUE 0x3d8474 Record_ULONG 0 autosar_swc_val_CM_uint32 0 4294967295 /end CHARACTERISTIC
/begin CHARACTERISTIC ZDrive_BSW_Cal_Cal.ZDrive_BSW_Cal_VehicleInfomationTable.Vehicle_Information_Reserved_Line296 "" VALUE 0x3d8478 Record_ULONG 0 autosar_swc_val_CM_uint32 0 4294967295 /end CHARACTERISTIC
/begin CHARACTERISTIC ZDrive_BSW_Cal_Cal.ZDrive_BSW_Cal_VehicleInfomationTable.Vehicle_Information_Reserved_Line297 "" VALUE 0x3d847c Record_ULONG 0 autosar_swc_val_CM_uint32 0 4294967295 /end CHARACTERISTIC
/begin CHARACTERISTIC ZDrive_BSW_Cal_Cal.ZDrive_BSW_Cal_VehicleInfomationTable.Vehicle_Information_Reserved_Line298 "" VALUE 0x3d8480 Record_ULONG 0 autosar_swc_val_CM_uint32 0 4294967295 /end CHARACTERISTIC
/begin CHARACTERISTIC ZDrive_BSW_Cal_Cal.ZDrive_BSW_Cal_VehicleInfomationTable.Vehicle_Information_Reserved_Line299 "" VALUE 0x3d8484 Record_ULONG 0 autosar_swc_val_CM_uint32 0 4294967295 /end CHARACTERISTIC
/begin CHARACTERISTIC ZDrive_BSW_Cal_Cal.ZDrive_BSW_Cal_VehicleInfomationTable.Vehicle_Information_Reserved_Line300 "" VALUE 0x3d8488 Record_ULONG 0 autosar_swc_val_CM_uint32 0 4294967295 /end CHARACTERISTIC
/begin CHARACTERISTIC ZDrive_BSW_Cal_Cal.ZDrive_BSW_Cal_VehicleInfomationTable.Vehicle_Information_Reserved_Line301 "" VALUE 0x3d848c Record_ULONG 0 autosar_swc_val_CM_uint32 0 4294967295 /end CHARACTERISTIC
/begin CHARACTERISTIC ZDrive_BSW_Cal_Cal.ZDrive_BSW_Cal_VehicleInfomationTable.Vehicle_Information_Reserved_Line302 "" VALUE 0x3d8490 Record_ULONG 0 autosar_swc_val_CM_uint32 0 4294967295 /end CHARACTERISTIC
/begin CHARACTERISTIC ZDrive_BSW_Cal_Cal.ZDrive_BSW_Cal_VehicleInfomationTable.Vehicle_Information_Reserved_Line303 "" VALUE 0x3d8494 Record_ULONG 0 autosar_swc_val_CM_uint32 0 4294967295 /end CHARACTERISTIC
/begin CHARACTERISTIC ZDrive_BSW_Cal_Cal.ZDrive_BSW_Cal_VehicleInfomationTable.Vehicle_Information_Reserved_Line304 "" VALUE 0x3d8498 Record_ULONG 0 autosar_swc_val_CM_uint32 0 4294967295 /end CHARACTERISTIC
/begin CHARACTERISTIC ZDrive_BSW_Cal_Cal.ZDrive_BSW_Cal_VehicleInfomationTable.Vehicle_Information_Reserved_Line305 "" VALUE 0x3d849c Record_ULONG 0 autosar_swc_val_CM_uint32 0 4294967295 /end CHARACTERISTIC
/begin CHARACTERISTIC ZDrive_BSW_Cal_Cal.ZDrive_BSW_Cal_VehicleInfomationTable.Vehicle_Information_Reserved_Line306 "" VALUE 0x3d84a0 Record_ULONG 0 autosar_swc_val_CM_uint32 0 4294967295 /end CHARACTERISTIC
/begin CHARACTERISTIC ZDrive_BSW_Cal_Cal.ZDrive_BSW_Cal_VehicleInfomationTable.Vehicle_Information_Reserved_Line307 "" VALUE 0x3d84a4 Record_ULONG 0 autosar_swc_val_CM_uint32 0 4294967295 /end CHARACTERISTIC
/begin CHARACTERISTIC ZDrive_BSW_Cal_Cal.ZDrive_BSW_Cal_VehicleInfomationTable.Vehicle_Information_Reserved_Line308 "" VALUE 0x3d84a8 Record_ULONG 0 autosar_swc_val_CM_uint32 0 4294967295 /end CHARACTERISTIC
/begin CHARACTERISTIC ZDrive_BSW_Cal_Cal.ZDrive_BSW_Cal_VehicleInfomationTable.Vehicle_Information_Reserved_Line309 "" VALUE 0x3d84ac Record_ULONG 0 autosar_swc_val_CM_uint32 0 4294967295 /end CHARACTERISTIC
/begin CHARACTERISTIC ZDrive_BSW_Cal_Cal.ZDrive_BSW_Cal_VehicleInfomationTable.Vehicle_Information_Reserved_Line31 "" VALUE 0x3d8083 Record_UBYTE 0 autosar_swc_val_CM_uint8 0 255 /end CHARACTERISTIC
/begin CHARACTERISTIC ZDrive_BSW_Cal_Cal.ZDrive_BSW_Cal_VehicleInfomationTable.Vehicle_Information_Reserved_Line310 "" VALUE 0x3d84b0 Record_ULONG 0 autosar_swc_val_CM_uint32 0 4294967295 /end CHARACTERISTIC
/begin CHARACTERISTIC ZDrive_BSW_Cal_Cal.ZDrive_BSW_Cal_VehicleInfomationTable.Vehicle_Information_Reserved_Line311 "" VALUE 0x3d84b4 Record_ULONG 0 autosar_swc_val_CM_uint32 0 4294967295 /end CHARACTERISTIC
/begin CHARACTERISTIC ZDrive_BSW_Cal_Cal.ZDrive_BSW_Cal_VehicleInfomationTable.Vehicle_Information_Reserved_Line312 "" VALUE 0x3d84b8 Record_ULONG 0 autosar_swc_val_CM_uint32 0 4294967295 /end CHARACTERISTIC
/begin CHARACTERISTIC ZDrive_BSW_Cal_Cal.ZDrive_BSW_Cal_VehicleInfomationTable.Vehicle_Information_Reserved_Line313 "" VALUE 0x3d84bc Record_ULONG 0 autosar_swc_val_CM_uint32 0 4294967295 /end CHARACTERISTIC
/begin CHARACTERISTIC ZDrive_BSW_Cal_Cal.ZDrive_BSW_Cal_VehicleInfomationTable.Vehicle_Information_Reserved_Line314 "" VALUE 0x3d84c0 Record_ULONG 0 autosar_swc_val_CM_uint32 0 4294967295 /end CHARACTERISTIC
/begin CHARACTERISTIC ZDrive_BSW_Cal_Cal.ZDrive_BSW_Cal_VehicleInfomationTable.Vehicle_Information_Reserved_Line315 "" VALUE 0x3d84c4 Record_ULONG 0 autosar_swc_val_CM_uint32 0 4294967295 /end CHARACTERISTIC
/begin CHARACTERISTIC ZDrive_BSW_Cal_Cal.ZDrive_BSW_Cal_VehicleInfomationTable.Vehicle_Information_Reserved_Line316 "" VALUE 0x3d84c8 Record_ULONG 0 autosar_swc_val_CM_uint32 0 4294967295 /end CHARACTERISTIC
/begin CHARACTERISTIC ZDrive_BSW_Cal_Cal.ZDrive_BSW_Cal_VehicleInfomationTable.Vehicle_Information_Reserved_Line317 "" VALUE 0x3d84cc Record_ULONG 0 autosar_swc_val_CM_uint32 0 4294967295 /end CHARACTERISTIC
/begin CHARACTERISTIC ZDrive_BSW_Cal_Cal.ZDrive_BSW_Cal_VehicleInfomationTable.Vehicle_Information_Reserved_Line318 "" VALUE 0x3d84d0 Record_ULONG 0 autosar_swc_val_CM_uint32 0 4294967295 /end CHARACTERISTIC
/begin CHARACTERISTIC ZDrive_BSW_Cal_Cal.ZDrive_BSW_Cal_VehicleInfomationTable.Vehicle_Information_Reserved_Line319 "" VALUE 0x3d84d4 Record_ULONG 0 autosar_swc_val_CM_uint32 0 4294967295 /end CHARACTERISTIC
/begin CHARACTERISTIC ZDrive_BSW_Cal_Cal.ZDrive_BSW_Cal_VehicleInfomationTable.Vehicle_Information_Reserved_Line32 "" VALUE 0x3d8084 Record_UWORD 0 autosar_swc_val_CM_uint16 0 65535 /end CHARACTERISTIC
/begin CHARACTERISTIC ZDrive_BSW_Cal_Cal.ZDrive_BSW_Cal_VehicleInfomationTable.Vehicle_Information_Reserved_Line320 "" VALUE 0x3d84d8 Record_ULONG 0 autosar_swc_val_CM_uint32 0 4294967295 /end CHARACTERISTIC
/begin CHARACTERISTIC ZDrive_BSW_Cal_Cal.ZDrive_BSW_Cal_VehicleInfomationTable.Vehicle_Information_Reserved_Line321 "" VALUE 0x3d84dc Record_ULONG 0 autosar_swc_val_CM_uint32 0 4294967295 /end CHARACTERISTIC
/begin CHARACTERISTIC ZDrive_BSW_Cal_Cal.ZDrive_BSW_Cal_VehicleInfomationTable.Vehicle_Information_Reserved_Line322 "" VALUE 0x3d84e0 Record_ULONG 0 autosar_swc_val_CM_uint32 0 4294967295 /end CHARACTERISTIC
/begin CHARACTERISTIC ZDrive_BSW_Cal_Cal.ZDrive_BSW_Cal_VehicleInfomationTable.Vehicle_Information_Reserved_Line323 "" VALUE 0x3d84e4 Record_ULONG 0 autosar_swc_val_CM_uint32 0 4294967295 /end CHARACTERISTIC
/begin CHARACTERISTIC ZDrive_BSW_Cal_Cal.ZDrive_BSW_Cal_VehicleInfomationTable.Vehicle_Information_Reserved_Line324 "" VALUE 0x3d84e8 Record_ULONG 0 autosar_swc_val_CM_uint32 0 4294967295 /end CHARACTERISTIC
/begin CHARACTERISTIC ZDrive_BSW_Cal_Cal.ZDrive_BSW_Cal_VehicleInfomationTable.Vehicle_Information_Reserved_Line325 "" VALUE 0x3d84ec Record_ULONG 0 autosar_swc_val_CM_uint32 0 4294967295 /end CHARACTERISTIC
/begin CHARACTERISTIC ZDrive_BSW_Cal_Cal.ZDrive_BSW_Cal_VehicleInfomationTable.Vehicle_Information_Reserved_Line326 "" VALUE 0x3d84f0 Record_ULONG 0 autosar_swc_val_CM_uint32 0 4294967295 /end CHARACTERISTIC
/begin CHARACTERISTIC ZDrive_BSW_Cal_Cal.ZDrive_BSW_Cal_VehicleInfomationTable.Vehicle_Information_Reserved_Line327 "" VALUE 0x3d84f4 Record_ULONG 0 autosar_swc_val_CM_uint32 0 4294967295 /end CHARACTERISTIC
/begin CHARACTERISTIC ZDrive_BSW_Cal_Cal.ZDrive_BSW_Cal_VehicleInfomationTable.Vehicle_Information_Reserved_Line328 "" VALUE 0x3d84f8 Record_ULONG 0 autosar_swc_val_CM_uint32 0 4294967295 /end CHARACTERISTIC
/begin CHARACTERISTIC ZDrive_BSW_Cal_Cal.ZDrive_BSW_Cal_VehicleInfomationTable.Vehicle_Information_Reserved_Line329 "" VALUE 0x3d84fc Record_ULONG 0 autosar_swc_val_CM_uint32 0 4294967295 /end CHARACTERISTIC
/begin CHARACTERISTIC ZDrive_BSW_Cal_Cal.ZDrive_BSW_Cal_VehicleInfomationTable.Vehicle_Information_Reserved_Line33 "" VALUE 0x3d8086 Record_UWORD 0 autosar_swc_val_CM_uint16 0 65535 /end CHARACTERISTIC
/begin CHARACTERISTIC ZDrive_BSW_Cal_Cal.ZDrive_BSW_Cal_VehicleInfomationTable.Vehicle_Information_Reserved_Line330 "" VALUE 0x3d8500 Record_ULONG 0 autosar_swc_val_CM_uint32 0 4294967295 /end CHARACTERISTIC
/begin CHARACTERISTIC ZDrive_BSW_Cal_Cal.ZDrive_BSW_Cal_VehicleInfomationTable.Vehicle_Information_Reserved_Line331 "" VALUE 0x3d8504 Record_ULONG 0 autosar_swc_val_CM_uint32 0 4294967295 /end CHARACTERISTIC
/begin CHARACTERISTIC ZDrive_BSW_Cal_Cal.ZDrive_BSW_Cal_VehicleInfomationTable.Vehicle_Information_Reserved_Line332 "" VALUE 0x3d8508 Record_ULONG 0 autosar_swc_val_CM_uint32 0 4294967295 /end CHARACTERISTIC
/begin CHARACTERISTIC ZDrive_BSW_Cal_Cal.ZDrive_BSW_Cal_VehicleInfomationTable.Vehicle_Information_Reserved_Line333 "" VALUE 0x3d850c Record_ULONG 0 autosar_swc_val_CM_uint32 0 4294967295 /end CHARACTERISTIC
/begin CHARACTERISTIC ZDrive_BSW_Cal_Cal.ZDrive_BSW_Cal_VehicleInfomationTable.Vehicle_Information_Reserved_Line334 "" VALUE 0x3d8510 Record_ULONG 0 autosar_swc_val_CM_uint32 0 4294967295 /end CHARACTERISTIC
/begin CHARACTERISTIC ZDrive_BSW_Cal_Cal.ZDrive_BSW_Cal_VehicleInfomationTable.Vehicle_Information_Reserved_Line335 "" VALUE 0x3d8514 Record_ULONG 0 autosar_swc_val_CM_uint32 0 4294967295 /end CHARACTERISTIC
/begin CHARACTERISTIC ZDrive_BSW_Cal_Cal.ZDrive_BSW_Cal_VehicleInfomationTable.Vehicle_Information_Reserved_Line336 "" VALUE 0x3d8518 Record_ULONG 0 autosar_swc_val_CM_uint32 0 4294967295 /end CHARACTERISTIC
/begin CHARACTERISTIC ZDrive_BSW_Cal_Cal.ZDrive_BSW_Cal_VehicleInfomationTable.Vehicle_Information_Reserved_Line337 "" VALUE 0x3d851c Record_ULONG 0 autosar_swc_val_CM_uint32 0 4294967295 /end CHARACTERISTIC
/begin CHARACTERISTIC ZDrive_BSW_Cal_Cal.ZDrive_BSW_Cal_VehicleInfomationTable.Vehicle_Information_Reserved_Line338 "" VALUE 0x3d8520 Record_ULONG 0 autosar_swc_val_CM_uint32 0 4294967295 /end CHARACTERISTIC
/begin CHARACTERISTIC ZDrive_BSW_Cal_Cal.ZDrive_BSW_Cal_VehicleInfomationTable.Vehicle_Information_Reserved_Line339 "" VALUE 0x3d8524 Record_ULONG 0 autosar_swc_val_CM_uint32 0 4294967295 /end CHARACTERISTIC
/begin CHARACTERISTIC ZDrive_BSW_Cal_Cal.ZDrive_BSW_Cal_VehicleInfomationTable.Vehicle_Information_Reserved_Line34 "" VALUE 0x3d8088 Record_UWORD 0 autosar_swc_val_CM_uint16 0 65535 /end CHARACTERISTIC
/begin CHARACTERISTIC ZDrive_BSW_Cal_Cal.ZDrive_BSW_Cal_VehicleInfomationTable.Vehicle_Information_Reserved_Line340 "" VALUE 0x3d8528 Record_ULONG 0 autosar_swc_val_CM_uint32 0 4294967295 /end CHARACTERISTIC
/begin CHARACTERISTIC ZDrive_BSW_Cal_Cal.ZDrive_BSW_Cal_VehicleInfomationTable.Vehicle_Information_Reserved_Line341 "" VALUE 0x3d852c Record_ULONG 0 autosar_swc_val_CM_uint32 0 4294967295 /end CHARACTERISTIC
/begin CHARACTERISTIC ZDrive_BSW_Cal_Cal.ZDrive_BSW_Cal_VehicleInfomationTable.Vehicle_Information_Reserved_Line342 "" VALUE 0x3d8530 Record_ULONG 0 autosar_swc_val_CM_uint32 0 4294967295 /end CHARACTERISTIC
/begin CHARACTERISTIC ZDrive_BSW_Cal_Cal.ZDrive_BSW_Cal_VehicleInfomationTable.Vehicle_Information_Reserved_Line343 "" VALUE 0x3d8534 Record_ULONG 0 autosar_swc_val_CM_uint32 0 4294967295 /end CHARACTERISTIC
/begin CHARACTERISTIC ZDrive_BSW_Cal_Cal.ZDrive_BSW_Cal_VehicleInfomationTable.Vehicle_Information_Reserved_Line344 "" VALUE 0x3d8538 Record_ULONG 0 autosar_swc_val_CM_uint32 0 4294967295 /end CHARACTERISTIC
/begin CHARACTERISTIC ZDrive_BSW_Cal_Cal.ZDrive_BSW_Cal_VehicleInfomationTable.Vehicle_Information_Reserved_Line345 "" VALUE 0x3d853c Record_ULONG 0 autosar_swc_val_CM_uint32 0 4294967295 /end CHARACTERISTIC
/begin CHARACTERISTIC ZDrive_BSW_Cal_Cal.ZDrive_BSW_Cal_VehicleInfomationTable.Vehicle_Information_Reserved_Line346 "" VALUE 0x3d8540 Record_ULONG 0 autosar_swc_val_CM_uint32 0 4294967295 /end CHARACTERISTIC
/begin CHARACTERISTIC ZDrive_BSW_Cal_Cal.ZDrive_BSW_Cal_VehicleInfomationTable.Vehicle_Information_Reserved_Line347 "" VALUE 0x3d8544 Record_ULONG 0 autosar_swc_val_CM_uint32 0 4294967295 /end CHARACTERISTIC
/begin CHARACTERISTIC ZDrive_BSW_Cal_Cal.ZDrive_BSW_Cal_VehicleInfomationTable.Vehicle_Information_Reserved_Line348 "" VALUE 0x3d8548 Record_ULONG 0 autosar_swc_val_CM_uint32 0 4294967295 /end CHARACTERISTIC
/begin CHARACTERISTIC ZDrive_BSW_Cal_Cal.ZDrive_BSW_Cal_VehicleInfomationTable.Vehicle_Information_Reserved_Line349 "" VALUE 0x3d854c Record_ULONG 0 autosar_swc_val_CM_uint32 0 4294967295 /end CHARACTERISTIC
/begin CHARACTERISTIC ZDrive_BSW_Cal_Cal.ZDrive_BSW_Cal_VehicleInfomationTable.Vehicle_Information_Reserved_Line35 "" VALUE 0x3d808a Record_UWORD 0 autosar_swc_val_CM_uint16 0 65535 /end CHARACTERISTIC
/begin CHARACTERISTIC ZDrive_BSW_Cal_Cal.ZDrive_BSW_Cal_VehicleInfomationTable.Vehicle_Information_Reserved_Line350 "" VALUE 0x3d8550 Record_ULONG 0 autosar_swc_val_CM_uint32 0 4294967295 /end CHARACTERISTIC
/begin CHARACTERISTIC ZDrive_BSW_Cal_Cal.ZDrive_BSW_Cal_VehicleInfomationTable.Vehicle_Information_Reserved_Line351 "" VALUE 0x3d8554 Record_ULONG 0 autosar_swc_val_CM_uint32 0 4294967295 /end CHARACTERISTIC
/begin CHARACTERISTIC ZDrive_BSW_Cal_Cal.ZDrive_BSW_Cal_VehicleInfomationTable.Vehicle_Information_Reserved_Line352 "" VALUE 0x3d8558 Record_ULONG 0 autosar_swc_val_CM_uint32 0 4294967295 /end CHARACTERISTIC
/begin CHARACTERISTIC ZDrive_BSW_Cal_Cal.ZDrive_BSW_Cal_VehicleInfomationTable.Vehicle_Information_Reserved_Line353 "" VALUE 0x3d855c Record_UWORD 0 autosar_swc_val_CM_uint16 0 65535 /end CHARACTERISTIC
/begin CHARACTERISTIC ZDrive_BSW_Cal_Cal.ZDrive_BSW_Cal_VehicleInfomationTable.Vehicle_Information_Reserved_Line354 "" VALUE 0x3d855e Record_UBYTE 0 autosar_swc_val_CM_uint8 0 255 /end CHARACTERISTIC
/begin CHARACTERISTIC ZDrive_BSW_Cal_Cal.ZDrive_BSW_Cal_VehicleInfomationTable.Vehicle_Information_Reserved_Line36 "" VALUE 0x3d808c Record_UWORD 0 autosar_swc_val_CM_uint16 0 65535 /end CHARACTERISTIC
/begin CHARACTERISTIC ZDrive_BSW_Cal_Cal.ZDrive_BSW_Cal_VehicleInfomationTable.Vehicle_Information_Reserved_Line37 "" VALUE 0x3d808e Record_UWORD 0 autosar_swc_val_CM_uint16 0 65535 /end CHARACTERISTIC
/begin CHARACTERISTIC ZDrive_BSW_Cal_Cal.ZDrive_BSW_Cal_VehicleInfomationTable.Vehicle_Information_Reserved_Line81 "" VALUE 0x3d8134 Record_UWORD 0 autosar_swc_val_CM_uint16 0 65535 /end CHARACTERISTIC
/begin CHARACTERISTIC ZDrive_BSW_Cal_Cal.ZDrive_BSW_Cal_VehicleInfomationTable.Vehicle_Information_Reserved_Line82 "" VALUE 0x3d8136 Record_UWORD 0 autosar_swc_val_CM_uint16 0 65535 /end CHARACTERISTIC
/begin CHARACTERISTIC ZDrive_BSW_Cal_Cal.ZDrive_BSW_Cal_VehicleInfomationTable.Vehicle_Length_m "" VALUE 0x3d8090 Record_FLOAT32_IEEE 0 autosar_swc_val_CM_single -3.4E+38 3.4E+38 /end CHARACTERISTIC
/begin CHARACTERISTIC ZDrive_BSW_Cal_Cal.ZDrive_BSW_Cal_VehicleInfomationTable.Vehicle_Model "" VALUE 0x3d8069 Record_UBYTE 0 autosar_swc_val_CM_uint8 0 255 /end CHARACTERISTIC
/begin CHARACTERISTIC ZDrive_BSW_Cal_Cal.ZDrive_BSW_Cal_VehicleInfomationTable.Weight_N "" VALUE 0x3d8110 Record_FLOAT32_IEEE 0 autosar_swc_val_CM_single -3.4E+38 3.4E+38 /end CHARACTERISTIC
/begin CHARACTERISTIC ZDrive_BSW_Cal_Cal.ZDrive_BSW_Cal_VehicleInfomationTable.WheelBase_m "" VALUE 0x3d80a4 Record_FLOAT32_IEEE 0 autosar_swc_val_CM_single -3.4E+38 3.4E+38 /end CHARACTERISTIC
/begin CHARACTERISTIC ZDrive_BSW_Cal_Cal.ZDrive_BSW_Cal_VehicleInfomationTable.WheelDiameter "" VALUE 0x3d8124 Record_FLOAT32_IEEE 0 autosar_swc_val_CM_single -3.4E+38 3.4E+38 /end CHARACTERISTIC
/begin CHARACTERISTIC ZDrive_BSW_Cal_Cal.ZDrive_BSW_Cal_VehicleInfomationTable.WheelSpeedCounterIsUnsigned "" VALUE 0x3d8130 Record_UWORD 0 autosar_swc_val_CM_uint16 0 65535 /end CHARACTERISTIC
/begin CHARACTERISTIC ZDrive_BSW_Cal_Cal.ZDrive_BSW_Cal_VehicleInfomationTable.WheelSpeedCounterMax "" VALUE 0x3d812c Record_UWORD 0 autosar_swc_val_CM_uint16 0 65535 /end CHARACTERISTIC
/begin CHARACTERISTIC ZDrive_BSW_Cal_Cal.ZDrive_BSW_Cal_VehicleInfomationTable.WheelSpeedCounterMin "" VALUE 0x3d8132 Record_UWORD 0 autosar_swc_val_CM_uint16 0 65535 /end CHARACTERISTIC
/begin CHARACTERISTIC ZDrive_BSW_Cal_Cal.ZDrive_BSW_Cal_VehicleInfomationTable.WheelSpeedCounterPulse "" VALUE 0x3d812e Record_UWORD 0 autosar_swc_val_CM_uint16 0 65535 /end CHARACTERISTIC
/begin CHARACTERISTIC ZDrive_BSW_Cal_Cal.ZDrive_BSW_Cal_VehicleInfomationTable.WheelTrack_m "" VALUE 0x3d80ac Record_FLOAT32_IEEE 0 autosar_swc_val_CM_single -3.4E+38 3.4E+38 /end CHARACTERISTIC
/begin CHARACTERISTIC ZDrive_BSW_Cal_Cal.ZDrive_BSW_Cal_VehicleInfomationTable.WhlSpdSensUnitPulseDist "" VALUE 0x3d8128 Record_FLOAT32_IEEE 0 autosar_swc_val_CM_single -3.4E+38 3.4E+38 /end CHARACTERISTIC
/begin CHARACTERISTIC ZDrive_BSW_Cal_Cal.ZDrive_BSW_Cal_VehicleInfomationTable.YawAngOfCAD "" VALUE 0x3d81b0 Record_FLOAT32_IEEE 0 autosar_swc_val_CM_single -3.4E+38 3.4E+38 /end CHARACTERISTIC
/begin CHARACTERISTIC ZDrive_BSW_Cal_Cal.ZDrive_BSW_Cal_VehicleInfomationTable.camera_x_m "" VALUE 0x3d8194 Record_FLOAT32_IEEE 0 autosar_swc_val_CM_single -3.4E+38 3.4E+38 /end CHARACTERISTIC
/begin CHARACTERISTIC ZDrive_BSW_Cal_Cal.ZDrive_BSW_Cal_VehicleInfomationTable.camera_y_m "" VALUE 0x3d8198 Record_FLOAT32_IEEE 0 autosar_swc_val_CM_single -3.4E+38 3.4E+38 /end CHARACTERISTIC
/begin CHARACTERISTIC ZDrive_BSW_Cal_Cal.ZDrive_BSW_Cal_VehicleInfomationTable.camera_z_m "" VALUE 0x3d819c Record_FLOAT32_IEEE 0 autosar_swc_val_CM_single -3.4E+38 3.4E+38 /end CHARACTERISTIC
/begin CHARACTERISTIC ZDrive_BSW_Cal_Cal.ZDrive_BSW_Cal_VehicleInfomationTable.translation_x_m "" VALUE 0x3d81a0 Record_FLOAT32_IEEE 0 autosar_swc_val_CM_single -3.4E+38 3.4E+38 /end CHARACTERISTIC
/begin MEASUREMENT SwcIn_FM_SAF_OUT.SftyErrInfoQue[10].SftyErrID "" ULONG autosar_swc_val_CM_uint32 0 0 0 4294967295 ECU_ADDRESS 0xfe4cb7d8 /* @ECU_Address@SwcIn_FM_SAF_OUT.SftyErrInfoQue[10].SftyErrID@ */ /end MEASUREMENT
/begin MEASUREMENT SwcIn_FM_SAF_OUT.SftyErrInfoQue[10].TrigTimeStamp "" ULONG autosar_swc_val_CM_uint32 0 0 0 4294967295 ECU_ADDRESS 0xfe4cb7dc /* @ECU_Address@SwcIn_FM_SAF_OUT.SftyErrInfoQue[10].TrigTimeStamp@ */ /end MEASUREMENT
/begin MEASUREMENT SwcIn_FM_SAF_OUT.SftyErrInfoQue[11].SftyErrID "" ULONG autosar_swc_val_CM_uint32 0 0 0 4294967295 ECU_ADDRESS 0xfe4cb7e0 /* @ECU_Address@SwcIn_FM_SAF_OUT.SftyErrInfoQue[11].SftyErrID@ */ /end MEASUREMENT
/begin MEASUREMENT SwcIn_FM_SAF_OUT.SftyErrInfoQue[11].TrigTimeStamp "" ULONG autosar_swc_val_CM_uint32 0 0 0 4294967295 ECU_ADDRESS 0xfe4cb7e4 /* @ECU_Address@SwcIn_FM_SAF_OUT.SftyErrInfoQue[11].TrigTimeStamp@ */ /end MEASUREMENT
/begin MEASUREMENT SwcIn_FM_SAF_OUT.SftyErrInfoQue[12].SftyErrID "" ULONG autosar_swc_val_CM_uint32 0 0 0 4294967295 ECU_ADDRESS 0xfe4cb7e8 /* @ECU_Address@SwcIn_FM_SAF_OUT.SftyErrInfoQue[12].SftyErrID@ */ /end MEASUREMENT
/begin MEASUREMENT SwcIn_FM_SAF_OUT.SftyErrInfoQue[12].TrigTimeStamp "" ULONG autosar_swc_val_CM_uint32 0 0 0 4294967295 ECU_ADDRESS 0xfe4cb7ec /* @ECU_Address@SwcIn_FM_SAF_OUT.SftyErrInfoQue[12].TrigTimeStamp@ */ /end MEASUREMENT
/begin MEASUREMENT SwcIn_FM_SAF_OUT.SftyErrInfoQue[13].SftyErrID "" ULONG autosar_swc_val_CM_uint32 0 0 0 4294967295 ECU_ADDRESS 0xfe4cb7f0 /* @ECU_Address@SwcIn_FM_SAF_OUT.SftyErrInfoQue[13].SftyErrID@ */ /end MEASUREMENT
/begin MEASUREMENT SwcIn_FM_SAF_OUT.SftyErrInfoQue[13].TrigTimeStamp "" ULONG autosar_swc_val_CM_uint32 0 0 0 4294967295 ECU_ADDRESS 0xfe4cb7f4 /* @ECU_Address@SwcIn_FM_SAF_OUT.SftyErrInfoQue[13].TrigTimeStamp@ */ /end MEASUREMENT
/begin MEASUREMENT SwcIn_FM_SAF_OUT.SftyErrInfoQue[14].SftyErrID "" ULONG autosar_swc_val_CM_uint32 0 0 0 4294967295 ECU_ADDRESS 0xfe4cb7f8 /* @ECU_Address@SwcIn_FM_SAF_OUT.SftyErrInfoQue[14].SftyErrID@ */ /end MEASUREMENT
/begin MEASUREMENT SwcIn_FM_SAF_OUT.SftyErrInfoQue[14].TrigTimeStamp "" ULONG autosar_swc_val_CM_uint32 0 0 0 4294967295 ECU_ADDRESS 0xfe4cb7fc /* @ECU_Address@SwcIn_FM_SAF_OUT.SftyErrInfoQue[14].TrigTimeStamp@ */ /end MEASUREMENT
/begin MEASUREMENT SwcIn_FM_SAF_OUT.SftyErrInfoQue[15].SftyErrID "" ULONG autosar_swc_val_CM_uint32 0 0 0 4294967295 ECU_ADDRESS 0xfe4cb800 /* @ECU_Address@SwcIn_FM_SAF_OUT.SftyErrInfoQue[15].SftyErrID@ */ /end MEASUREMENT
/begin MEASUREMENT SwcIn_FM_SAF_OUT.SftyErrInfoQue[15].TrigTimeStamp "" ULONG autosar_swc_val_CM_uint32 0 0 0 4294967295 ECU_ADDRESS 0xfe4cb804 /* @ECU_Address@SwcIn_FM_SAF_OUT.SftyErrInfoQue[15].TrigTimeStamp@ */ /end MEASUREMENT
/begin MEASUREMENT SwcIn_FM_SAF_OUT.SftyErrInfoQue[16].SftyErrID "" ULONG autosar_swc_val_CM_uint32 0 0 0 4294967295 ECU_ADDRESS 0xfe4cb808 /* @ECU_Address@SwcIn_FM_SAF_OUT.SftyErrInfoQue[16].SftyErrID@ */ /end MEASUREMENT
/begin MEASUREMENT SwcIn_FM_SAF_OUT.SftyErrInfoQue[16].TrigTimeStamp "" ULONG autosar_swc_val_CM_uint32 0 0 0 4294967295 ECU_ADDRESS 0xfe4cb80c /* @ECU_Address@SwcIn_FM_SAF_OUT.SftyErrInfoQue[16].TrigTimeStamp@ */ /end MEASUREMENT
/begin MEASUREMENT SwcIn_FM_SAF_OUT.SftyErrInfoQue[17].SftyErrID "" ULONG autosar_swc_val_CM_uint32 0 0 0 4294967295 ECU_ADDRESS 0xfe4cb810 /* @ECU_Address@SwcIn_FM_SAF_OUT.SftyErrInfoQue[17].SftyErrID@ */ /end MEASUREMENT
/begin MEASUREMENT SwcIn_FM_SAF_OUT.SftyErrInfoQue[17].TrigTimeStamp "" ULONG autosar_swc_val_CM_uint32 0 0 0 4294967295 ECU_ADDRESS 0xfe4cb814 /* @ECU_Address@SwcIn_FM_SAF_OUT.SftyErrInfoQue[17].TrigTimeStamp@ */ /end MEASUREMENT
/begin MEASUREMENT SwcIn_FM_SAF_OUT.SftyErrInfoQue[18].SftyErrID "" ULONG autosar_swc_val_CM_uint32 0 0 0 4294967295 ECU_ADDRESS 0xfe4cb818 /* @ECU_Address@SwcIn_FM_SAF_OUT.SftyErrInfoQue[18].SftyErrID@ */ /end MEASUREMENT
/begin MEASUREMENT SwcIn_FM_SAF_OUT.SftyErrInfoQue[18].TrigTimeStamp "" ULONG autosar_swc_val_CM_uint32 0 0 0 4294967295 ECU_ADDRESS 0xfe4cb81c /* @ECU_Address@SwcIn_FM_SAF_OUT.SftyErrInfoQue[18].TrigTimeStamp@ */ /end MEASUREMENT
/begin MEASUREMENT SwcIn_FM_SAF_OUT.SftyErrInfoQue[19].SftyErrID "" ULONG autosar_swc_val_CM_uint32 0 0 0 4294967295 ECU_ADDRESS 0xfe4cb820 /* @ECU_Address@SwcIn_FM_SAF_OUT.SftyErrInfoQue[19].SftyErrID@ */ /end MEASUREMENT
/begin MEASUREMENT SwcIn_FM_SAF_OUT.SftyErrInfoQue[19].TrigTimeStamp "" ULONG autosar_swc_val_CM_uint32 0 0 0 4294967295 ECU_ADDRESS 0xfe4cb824 /* @ECU_Address@SwcIn_FM_SAF_OUT.SftyErrInfoQue[19].TrigTimeStamp@ */ /end MEASUREMENT
/begin MEASUREMENT SwcIn_FM_SAF_OUT.SftyErrInfoQue[1].SftyErrID "" ULONG autosar_swc_val_CM_uint32 0 0 0 4294967295 ECU_ADDRESS 0xfe4cb790 /* @ECU_Address@SwcIn_FM_SAF_OUT.SftyErrInfoQue[1].SftyErrID@ */ /end MEASUREMENT
/begin MEASUREMENT SwcIn_FM_SAF_OUT.SftyErrInfoQue[1].TrigTimeStamp "" ULONG autosar_swc_val_CM_uint32 0 0 0 4294967295 ECU_ADDRESS 0xfe4cb794 /* @ECU_Address@SwcIn_FM_SAF_OUT.SftyErrInfoQue[1].TrigTimeStamp@ */ /end MEASUREMENT
/begin MEASUREMENT SwcIn_FM_SAF_OUT.SftyErrInfoQue[20].SftyErrID "" ULONG autosar_swc_val_CM_uint32 0 0 0 4294967295 ECU_ADDRESS 0xfe4cb828 /* @ECU_Address@SwcIn_FM_SAF_OUT.SftyErrInfoQue[20].SftyErrID@ */ /end MEASUREMENT
/begin MEASUREMENT SwcIn_FM_SAF_OUT.SftyErrInfoQue[20].TrigTimeStamp "" ULONG autosar_swc_val_CM_uint32 0 0 0 4294967295 ECU_ADDRESS 0xfe4cb82c /* @ECU_Address@SwcIn_FM_SAF_OUT.SftyErrInfoQue[20].TrigTimeStamp@ */ /end MEASUREMENT
/begin MEASUREMENT SwcIn_FM_SAF_OUT.SftyErrInfoQue[21].SftyErrID "" ULONG autosar_swc_val_CM_uint32 0 0 0 4294967295 ECU_ADDRESS 0xfe4cb830 /* @ECU_Address@SwcIn_FM_SAF_OUT.SftyErrInfoQue[21].SftyErrID@ */ /end MEASUREMENT
/begin MEASUREMENT SwcIn_FM_SAF_OUT.SftyErrInfoQue[21].TrigTimeStamp "" ULONG autosar_swc_val_CM_uint32 0 0 0 4294967295 ECU_ADDRESS 0xfe4cb834 /* @ECU_Address@SwcIn_FM_SAF_OUT.SftyErrInfoQue[21].TrigTimeStamp@ */ /end MEASUREMENT
/begin MEASUREMENT SwcIn_FM_SAF_OUT.SftyErrInfoQue[22].SftyErrID "" ULONG autosar_swc_val_CM_uint32 0 0 0 4294967295 ECU_ADDRESS 0xfe4cb838 /* @ECU_Address@SwcIn_FM_SAF_OUT.SftyErrInfoQue[22].SftyErrID@ */ /end MEASUREMENT
/begin MEASUREMENT SwcIn_FM_SAF_OUT.SftyErrInfoQue[22].TrigTimeStamp "" ULONG autosar_swc_val_CM_uint32 0 0 0 4294967295 ECU_ADDRESS 0xfe4cb83c /* @ECU_Address@SwcIn_FM_SAF_OUT.SftyErrInfoQue[22].TrigTimeStamp@ */ /end MEASUREMENT
/begin MEASUREMENT SwcIn_FM_SAF_OUT.SftyErrInfoQue[23].SftyErrID "" ULONG autosar_swc_val_CM_uint32 0 0 0 4294967295 ECU_ADDRESS 0xfe4cb840 /* @ECU_Address@SwcIn_FM_SAF_OUT.SftyErrInfoQue[23].SftyErrID@ */ /end MEASUREMENT
/begin MEASUREMENT SwcIn_FM_SAF_OUT.SftyErrInfoQue[23].TrigTimeStamp "" ULONG autosar_swc_val_CM_uint32 0 0 0 4294967295 ECU_ADDRESS 0xfe4cb844 /* @ECU_Address@SwcIn_FM_SAF_OUT.SftyErrInfoQue[23].TrigTimeStamp@ */ /end MEASUREMENT
/begin MEASUREMENT SwcIn_FM_SAF_OUT.SftyErrInfoQue[24].SftyErrID "" ULONG autosar_swc_val_CM_uint32 0 0 0 4294967295 ECU_ADDRESS 0xfe4cb848 /* @ECU_Address@SwcIn_FM_SAF_OUT.SftyErrInfoQue[24].SftyErrID@ */ /end MEASUREMENT
/begin MEASUREMENT SwcIn_FM_SAF_OUT.SftyErrInfoQue[24].TrigTimeStamp "" ULONG autosar_swc_val_CM_uint32 0 0 0 4294967295 ECU_ADDRESS 0xfe4cb84c /* @ECU_Address@SwcIn_FM_SAF_OUT.SftyErrInfoQue[24].TrigTimeStamp@ */ /end MEASUREMENT
/begin MEASUREMENT SwcIn_FM_SAF_OUT.SftyErrInfoQue[25].SftyErrID "" ULONG autosar_swc_val_CM_uint32 0 0 0 4294967295 ECU_ADDRESS 0xfe4cb850 /* @ECU_Address@SwcIn_FM_SAF_OUT.SftyErrInfoQue[25].SftyErrID@ */ /end MEASUREMENT
/begin MEASUREMENT SwcIn_FM_SAF_OUT.SftyErrInfoQue[25].TrigTimeStamp "" ULONG autosar_swc_val_CM_uint32 0 0 0 4294967295 ECU_ADDRESS 0xfe4cb854 /* @ECU_Address@SwcIn_FM_SAF_OUT.SftyErrInfoQue[25].TrigTimeStamp@ */ /end MEASUREMENT
/begin MEASUREMENT SwcIn_FM_SAF_OUT.SftyErrInfoQue[26].SftyErrID "" ULONG autosar_swc_val_CM_uint32 0 0 0 4294967295 ECU_ADDRESS 0xfe4cb858 /* @ECU_Address@SwcIn_FM_SAF_OUT.SftyErrInfoQue[26].SftyErrID@ */ /end MEASUREMENT
/begin MEASUREMENT SwcIn_FM_SAF_OUT.SftyErrInfoQue[26].TrigTimeStamp "" ULONG autosar_swc_val_CM_uint32 0 0 0 4294967295 ECU_ADDRESS 0xfe4cb85c /* @ECU_Address@SwcIn_FM_SAF_OUT.SftyErrInfoQue[26].TrigTimeStamp@ */ /end MEASUREMENT
/begin MEASUREMENT SwcIn_FM_SAF_OUT.SftyErrInfoQue[27].SftyErrID "" ULONG autosar_swc_val_CM_uint32 0 0 0 4294967295 ECU_ADDRESS 0xfe4cb860 /* @ECU_Address@SwcIn_FM_SAF_OUT.SftyErrInfoQue[27].SftyErrID@ */ /end MEASUREMENT
/begin MEASUREMENT SwcIn_FM_SAF_OUT.SftyErrInfoQue[27].TrigTimeStamp "" ULONG autosar_swc_val_CM_uint32 0 0 0 4294967295 ECU_ADDRESS 0xfe4cb864 /* @ECU_Address@SwcIn_FM_SAF_OUT.SftyErrInfoQue[27].TrigTimeStamp@ */ /end MEASUREMENT
/begin MEASUREMENT SwcIn_FM_SAF_OUT.SftyErrInfoQue[28].SftyErrID "" ULONG autosar_swc_val_CM_uint32 0 0 0 4294967295 ECU_ADDRESS 0xfe4cb868 /* @ECU_Address@SwcIn_FM_SAF_OUT.SftyErrInfoQue[28].SftyErrID@ */ /end MEASUREMENT
/begin MEASUREMENT SwcIn_FM_SAF_OUT.SftyErrInfoQue[28].TrigTimeStamp "" ULONG autosar_swc_val_CM_uint32 0 0 0 4294967295 ECU_ADDRESS 0xfe4cb86c /* @ECU_Address@SwcIn_FM_SAF_OUT.SftyErrInfoQue[28].TrigTimeStamp@ */ /end MEASUREMENT
/begin MEASUREMENT SwcIn_FM_SAF_OUT.SftyErrInfoQue[29].SftyErrID "" ULONG autosar_swc_val_CM_uint32 0 0 0 4294967295 ECU_ADDRESS 0xfe4cb870 /* @ECU_Address@SwcIn_FM_SAF_OUT.SftyErrInfoQue[29].SftyErrID@ */ /end MEASUREMENT
/begin MEASUREMENT SwcIn_FM_SAF_OUT.SftyErrInfoQue[29].TrigTimeStamp "" ULONG autosar_swc_val_CM_uint32 0 0 0 4294967295 ECU_ADDRESS 0xfe4cb874 /* @ECU_Address@SwcIn_FM_SAF_OUT.SftyErrInfoQue[29].TrigTimeStamp@ */ /end MEASUREMENT
/begin MEASUREMENT SwcIn_FM_SAF_OUT.SftyErrInfoQue[2].SftyErrID "" ULONG autosar_swc_val_CM_uint32 0 0 0 4294967295 ECU_ADDRESS 0xfe4cb798 /* @ECU_Address@SwcIn_FM_SAF_OUT.SftyErrInfoQue[2].SftyErrID@ */ /end MEASUREMENT
/begin MEASUREMENT SwcIn_FM_SAF_OUT.SftyErrInfoQue[2].TrigTimeStamp "" ULONG autosar_swc_val_CM_uint32 0 0 0 4294967295 ECU_ADDRESS 0xfe4cb79c /* @ECU_Address@SwcIn_FM_SAF_OUT.SftyErrInfoQue[2].TrigTimeStamp@ */ /end MEASUREMENT
/begin MEASUREMENT SwcIn_FM_SAF_OUT.SftyErrInfoQue[30].SftyErrID "" ULONG autosar_swc_val_CM_uint32 0 0 0 4294967295 ECU_ADDRESS 0xfe4cb878 /* @ECU_Address@SwcIn_FM_SAF_OUT.SftyErrInfoQue[30].SftyErrID@ */ /end MEASUREMENT
/begin MEASUREMENT SwcIn_FM_SAF_OUT.SftyErrInfoQue[30].TrigTimeStamp "" ULONG autosar_swc_val_CM_uint32 0 0 0 4294967295 ECU_ADDRESS 0xfe4cb87c /* @ECU_Address@SwcIn_FM_SAF_OUT.SftyErrInfoQue[30].TrigTimeStamp@ */ /end MEASUREMENT
/begin MEASUREMENT SwcIn_FM_SAF_OUT.SftyErrInfoQue[31].SftyErrID "" ULONG autosar_swc_val_CM_uint32 0 0 0 4294967295 ECU_ADDRESS 0xfe4cb880 /* @ECU_Address@SwcIn_FM_SAF_OUT.SftyErrInfoQue[31].SftyErrID@ */ /end MEASUREMENT
/begin MEASUREMENT SwcIn_FM_SAF_OUT.SftyErrInfoQue[31].TrigTimeStamp "" ULONG autosar_swc_val_CM_uint32 0 0 0 4294967295 ECU_ADDRESS 0xfe4cb884 /* @ECU_Address@SwcIn_FM_SAF_OUT.SftyErrInfoQue[31].TrigTimeStamp@ */ /end MEASUREMENT
/begin MEASUREMENT SwcIn_FM_SAF_OUT.SftyErrInfoQue[3].SftyErrID "" ULONG autosar_swc_val_CM_uint32 0 0 0 4294967295 ECU_ADDRESS 0xfe4cb7a0 /* @ECU_Address@SwcIn_FM_SAF_OUT.SftyErrInfoQue[3].SftyErrID@ */ /end MEASUREMENT
/begin MEASUREMENT SwcIn_FM_SAF_OUT.SftyErrInfoQue[3].TrigTimeStamp "" ULONG autosar_swc_val_CM_uint32 0 0 0 4294967295 ECU_ADDRESS 0xfe4cb7a4 /* @ECU_Address@SwcIn_FM_SAF_OUT.SftyErrInfoQue[3].TrigTimeStamp@ */ /end MEASUREMENT
/begin MEASUREMENT SwcIn_FM_SAF_OUT.SftyErrInfoQue[4].SftyErrID "" ULONG autosar_swc_val_CM_uint32 0 0 0 4294967295 ECU_ADDRESS 0xfe4cb7a8 /* @ECU_Address@SwcIn_FM_SAF_OUT.SftyErrInfoQue[4].SftyErrID@ */ /end MEASUREMENT
/begin MEASUREMENT SwcIn_FM_SAF_OUT.SftyErrInfoQue[4].TrigTimeStamp "" ULONG autosar_swc_val_CM_uint32 0 0 0 4294967295 ECU_ADDRESS 0xfe4cb7ac /* @ECU_Address@SwcIn_FM_SAF_OUT.SftyErrInfoQue[4].TrigTimeStamp@ */ /end MEASUREMENT
/begin MEASUREMENT SwcIn_FM_SAF_OUT.SftyErrInfoQue[5].SftyErrID "" ULONG autosar_swc_val_CM_uint32 0 0 0 4294967295 ECU_ADDRESS 0xfe4cb7b0 /* @ECU_Address@SwcIn_FM_SAF_OUT.SftyErrInfoQue[5].SftyErrID@ */ /end MEASUREMENT
/begin MEASUREMENT SwcIn_FM_SAF_OUT.SftyErrInfoQue[5].TrigTimeStamp "" ULONG autosar_swc_val_CM_uint32 0 0 0 4294967295 ECU_ADDRESS 0xfe4cb7b4 /* @ECU_Address@SwcIn_FM_SAF_OUT.SftyErrInfoQue[5].TrigTimeStamp@ */ /end MEASUREMENT
/begin MEASUREMENT SwcIn_FM_SAF_OUT.SftyErrInfoQue[6].SftyErrID "" ULONG autosar_swc_val_CM_uint32 0 0 0 4294967295 ECU_ADDRESS 0xfe4cb7b8 /* @ECU_Address@SwcIn_FM_SAF_OUT.SftyErrInfoQue[6].SftyErrID@ */ /end MEASUREMENT
/begin MEASUREMENT SwcIn_FM_SAF_OUT.SftyErrInfoQue[6].TrigTimeStamp "" ULONG autosar_swc_val_CM_uint32 0 0 0 4294967295 ECU_ADDRESS 0xfe4cb7bc /* @ECU_Address@SwcIn_FM_SAF_OUT.SftyErrInfoQue[6].TrigTimeStamp@ */ /end MEASUREMENT
/begin MEASUREMENT SwcIn_FM_SAF_OUT.SftyErrInfoQue[7].SftyErrID "" ULONG autosar_swc_val_CM_uint32 0 0 0 4294967295 ECU_ADDRESS 0xfe4cb7c0 /* @ECU_Address@SwcIn_FM_SAF_OUT.SftyErrInfoQue[7].SftyErrID@ */ /end MEASUREMENT
/begin MEASUREMENT SwcIn_FM_SAF_OUT.SftyErrInfoQue[7].TrigTimeStamp "" ULONG autosar_swc_val_CM_uint32 0 0 0 4294967295 ECU_ADDRESS 0xfe4cb7c4 /* @ECU_Address@SwcIn_FM_SAF_OUT.SftyErrInfoQue[7].TrigTimeStamp@ */ /end MEASUREMENT
/begin MEASUREMENT SwcIn_FM_SAF_OUT.SftyErrInfoQue[8].SftyErrID "" ULONG autosar_swc_val_CM_uint32 0 0 0 4294967295 ECU_ADDRESS 0xfe4cb7c8 /* @ECU_Address@SwcIn_FM_SAF_OUT.SftyErrInfoQue[8].SftyErrID@ */ /end MEASUREMENT
/begin MEASUREMENT SwcIn_FM_SAF_OUT.SftyErrInfoQue[8].TrigTimeStamp "" ULONG autosar_swc_val_CM_uint32 0 0 0 4294967295 ECU_ADDRESS 0xfe4cb7cc /* @ECU_Address@SwcIn_FM_SAF_OUT.SftyErrInfoQue[8].TrigTimeStamp@ */ /end MEASUREMENT
/begin MEASUREMENT SwcIn_FM_SAF_OUT.SftyErrInfoQue[9].SftyErrID "" ULONG autosar_swc_val_CM_uint32 0 0 0 4294967295 ECU_ADDRESS 0xfe4cb7d0 /* @ECU_Address@SwcIn_FM_SAF_OUT.SftyErrInfoQue[9].SftyErrID@ */ /end MEASUREMENT
/begin MEASUREMENT SwcIn_FM_SAF_OUT.SftyErrInfoQue[9].TrigTimeStamp "" ULONG autosar_swc_val_CM_uint32 0 0 0 4294967295 ECU_ADDRESS 0xfe4cb7d4 /* @ECU_Address@SwcIn_FM_SAF_OUT.SftyErrInfoQue[9].TrigTimeStamp@ */ /end MEASUREMENT
/begin MEASUREMENT SwcIn_J3_LANE.Crosswalk.border[1].point_x "" FLOAT64_IEEE autosar_swc_val_CM_double 0 0 -1.7E+308 1.7E+308 ECU_ADDRESS 0xfe4c9348 /* @ECU_Address@SwcIn_J3_LANE.Crosswalk.border[1].point_x@ */ /end MEASUREMENT
/begin MEASUREMENT SwcIn_J3_LANE.Crosswalk.border[1].point_y "" FLOAT64_IEEE autosar_swc_val_CM_double 0 0 -1.7E+308 1.7E+308 ECU_ADDRESS 0xfe4c9350 /* @ECU_Address@SwcIn_J3_LANE.Crosswalk.border[1].point_y@ */ /end MEASUREMENT
/begin MEASUREMENT SwcIn_J3_LANE.Crosswalk.border[2].point_x "" FLOAT64_IEEE autosar_swc_val_CM_double 0 0 -1.7E+308 1.7E+308 ECU_ADDRESS 0xfe4c9358 /* @ECU_Address@SwcIn_J3_LANE.Crosswalk.border[2].point_x@ */ /end MEASUREMENT
/begin MEASUREMENT SwcIn_J3_LANE.Crosswalk.border[2].point_y "" FLOAT64_IEEE autosar_swc_val_CM_double 0 0 -1.7E+308 1.7E+308 ECU_ADDRESS 0xfe4c9360 /* @ECU_Address@SwcIn_J3_LANE.Crosswalk.border[2].point_y@ */ /end MEASUREMENT
/begin MEASUREMENT SwcIn_J3_LANE.Crosswalk.border[3].point_x "" FLOAT64_IEEE autosar_swc_val_CM_double 0 0 -1.7E+308 1.7E+308 ECU_ADDRESS 0xfe4c9368 /* @ECU_Address@SwcIn_J3_LANE.Crosswalk.border[3].point_x@ */ /end MEASUREMENT
/begin MEASUREMENT SwcIn_J3_LANE.Crosswalk.border[3].point_y "" FLOAT64_IEEE autosar_swc_val_CM_double 0 0 -1.7E+308 1.7E+308 ECU_ADDRESS 0xfe4c9370 /* @ECU_Address@SwcIn_J3_LANE.Crosswalk.border[3].point_y@ */ /end MEASUREMENT
/begin MEASUREMENT SwcIn_J3_LANE.Lane_Extra_Type[1].change_point_valid "" UBYTE autosar_swc_val_CM_boolean 0 0 0 1 ECU_ADDRESS 0xfe4c9c70 /* @ECU_Address@SwcIn_J3_LANE.Lane_Extra_Type[1].change_point_valid@ */ /end MEASUREMENT
/begin MEASUREMENT SwcIn_J3_LANE.Lane_Extra_Type[1].point_x "" FLOAT64_IEEE autosar_swc_val_CM_double 0 0 -1.7E+308 1.7E+308 ECU_ADDRESS 0xfe4c9c78 /* @ECU_Address@SwcIn_J3_LANE.Lane_Extra_Type[1].point_x@ */ /end MEASUREMENT
/begin MEASUREMENT SwcIn_J3_LANE.Lane_Extra_Type[1].point_y "" FLOAT64_IEEE autosar_swc_val_CM_double 0 0 -1.7E+308 1.7E+308 ECU_ADDRESS 0xfe4c9c80 /* @ECU_Address@SwcIn_J3_LANE.Lane_Extra_Type[1].point_y@ */ /end MEASUREMENT
/begin MEASUREMENT SwcIn_J3_LANE.Lane_Extra_Type[1].second_line_type "" UBYTE autosar_swc_val_CM_uint8 0 0 0 255 ECU_ADDRESS 0xfe4c9c71 /* @ECU_Address@SwcIn_J3_LANE.Lane_Extra_Type[1].second_line_type@ */ /end MEASUREMENT
/begin MEASUREMENT SwcIn_J3_LANE.Lane_Extra_Type[1].type_change_position "" SLONG autosar_swc_val_CM_int32 0 0 -2147483648 2147483647 ECU_ADDRESS 0xfe4c9c74 /* @ECU_Address@SwcIn_J3_LANE.Lane_Extra_Type[1].type_change_position@ */ /end MEASUREMENT
/begin MEASUREMENT SwcIn_J3_LANE.LinePoints.linepoints[0].point[10].point_x "" FLOAT64_IEEE autosar_swc_val_CM_double 0 0 -1.7E+308 1.7E+308 ECU_ADDRESS 0xfe4c94f0 /* @ECU_Address@SwcIn_J3_LANE.LinePoints.linepoints[0].point[10].point_x@ */ /end MEASUREMENT
/begin MEASUREMENT SwcIn_J3_LANE.LinePoints.linepoints[0].point[10].point_y "" FLOAT64_IEEE autosar_swc_val_CM_double 0 0 -1.7E+308 1.7E+308 ECU_ADDRESS 0xfe4c94f8 /* @ECU_Address@SwcIn_J3_LANE.LinePoints.linepoints[0].point[10].point_y@ */ /end MEASUREMENT
/begin MEASUREMENT SwcIn_J3_LANE.LinePoints.linepoints[0].point[11].point_x "" FLOAT64_IEEE autosar_swc_val_CM_double 0 0 -1.7E+308 1.7E+308 ECU_ADDRESS 0xfe4c9500 /* @ECU_Address@SwcIn_J3_LANE.LinePoints.linepoints[0].point[11].point_x@ */ /end MEASUREMENT
/begin MEASUREMENT SwcIn_J3_LANE.LinePoints.linepoints[0].point[11].point_y "" FLOAT64_IEEE autosar_swc_val_CM_double 0 0 -1.7E+308 1.7E+308 ECU_ADDRESS 0xfe4c9508 /* @ECU_Address@SwcIn_J3_LANE.LinePoints.linepoints[0].point[11].point_y@ */ /end MEASUREMENT
/begin MEASUREMENT SwcIn_J3_LANE.LinePoints.linepoints[0].point[12].point_x "" FLOAT64_IEEE autosar_swc_val_CM_double 0 0 -1.7E+308 1.7E+308 ECU_ADDRESS 0xfe4c9510 /* @ECU_Address@SwcIn_J3_LANE.LinePoints.linepoints[0].point[12].point_x@ */ /end MEASUREMENT
/begin MEASUREMENT SwcIn_J3_LANE.LinePoints.linepoints[0].point[12].point_y "" FLOAT64_IEEE autosar_swc_val_CM_double 0 0 -1.7E+308 1.7E+308 ECU_ADDRESS 0xfe4c9518 /* @ECU_Address@SwcIn_J3_LANE.LinePoints.linepoints[0].point[12].point_y@ */ /end MEASUREMENT
/begin MEASUREMENT SwcIn_J3_LANE.LinePoints.linepoints[0].point[13].point_x "" FLOAT64_IEEE autosar_swc_val_CM_double 0 0 -1.7E+308 1.7E+308 ECU_ADDRESS 0xfe4c9520 /* @ECU_Address@SwcIn_J3_LANE.LinePoints.linepoints[0].point[13].point_x@ */ /end MEASUREMENT
/begin MEASUREMENT SwcIn_J3_LANE.LinePoints.linepoints[0].point[13].point_y "" FLOAT64_IEEE autosar_swc_val_CM_double 0 0 -1.7E+308 1.7E+308 ECU_ADDRESS 0xfe4c9528 /* @ECU_Address@SwcIn_J3_LANE.LinePoints.linepoints[0].point[13].point_y@ */ /end MEASUREMENT
/begin MEASUREMENT SwcIn_J3_LANE.LinePoints.linepoints[0].point[14].point_x "" FLOAT64_IEEE autosar_swc_val_CM_double 0 0 -1.7E+308 1.7E+308 ECU_ADDRESS 0xfe4c9530 /* @ECU_Address@SwcIn_J3_LANE.LinePoints.linepoints[0].point[14].point_x@ */ /end MEASUREMENT
/begin MEASUREMENT SwcIn_J3_LANE.LinePoints.linepoints[0].point[14].point_y "" FLOAT64_IEEE autosar_swc_val_CM_double 0 0 -1.7E+308 1.7E+308 ECU_ADDRESS 0xfe4c9538 /* @ECU_Address@SwcIn_J3_LANE.LinePoints.linepoints[0].point[14].point_y@ */ /end MEASUREMENT
/begin MEASUREMENT SwcIn_J3_LANE.LinePoints.linepoints[0].point[15].point_x "" FLOAT64_IEEE autosar_swc_val_CM_double 0 0 -1.7E+308 1.7E+308 ECU_ADDRESS 0xfe4c9540 /* @ECU_Address@SwcIn_J3_LANE.LinePoints.linepoints[0].point[15].point_x@ */ /end MEASUREMENT
/begin MEASUREMENT SwcIn_J3_LANE.LinePoints.linepoints[0].point[15].point_y "" FLOAT64_IEEE autosar_swc_val_CM_double 0 0 -1.7E+308 1.7E+308 ECU_ADDRESS 0xfe4c9548 /* @ECU_Address@SwcIn_J3_LANE.LinePoints.linepoints[0].point[15].point_y@ */ /end MEASUREMENT
/begin MEASUREMENT SwcIn_J3_LANE.LinePoints.linepoints[0].point[16].point_x "" FLOAT64_IEEE autosar_swc_val_CM_double 0 0 -1.7E+308 1.7E+308 ECU_ADDRESS 0xfe4c9550 /* @ECU_Address@SwcIn_J3_LANE.LinePoints.linepoints[0].point[16].point_x@ */ /end MEASUREMENT
/begin MEASUREMENT SwcIn_J3_LANE.LinePoints.linepoints[0].point[16].point_y "" FLOAT64_IEEE autosar_swc_val_CM_double 0 0 -1.7E+308 1.7E+308 ECU_ADDRESS 0xfe4c9558 /* @ECU_Address@SwcIn_J3_LANE.LinePoints.linepoints[0].point[16].point_y@ */ /end MEASUREMENT
/begin MEASUREMENT SwcIn_J3_LANE.LinePoints.linepoints[0].point[17].point_x "" FLOAT64_IEEE autosar_swc_val_CM_double 0 0 -1.7E+308 1.7E+308 ECU_ADDRESS 0xfe4c9560 /* @ECU_Address@SwcIn_J3_LANE.LinePoints.linepoints[0].point[17].point_x@ */ /end MEASUREMENT
/begin MEASUREMENT SwcIn_J3_LANE.LinePoints.linepoints[0].point[17].point_y "" FLOAT64_IEEE autosar_swc_val_CM_double 0 0 -1.7E+308 1.7E+308 ECU_ADDRESS 0xfe4c9568 /* @ECU_Address@SwcIn_J3_LANE.LinePoints.linepoints[0].point[17].point_y@ */ /end MEASUREMENT
/begin MEASUREMENT SwcIn_J3_LANE.LinePoints.linepoints[0].point[18].point_x "" FLOAT64_IEEE autosar_swc_val_CM_double 0 0 -1.7E+308 1.7E+308 ECU_ADDRESS 0xfe4c9570 /* @ECU_Address@SwcIn_J3_LANE.LinePoints.linepoints[0].point[18].point_x@ */ /end MEASUREMENT
/begin MEASUREMENT SwcIn_J3_LANE.LinePoints.linepoints[0].point[18].point_y "" FLOAT64_IEEE autosar_swc_val_CM_double 0 0 -1.7E+308 1.7E+308 ECU_ADDRESS 0xfe4c9578 /* @ECU_Address@SwcIn_J3_LANE.LinePoints.linepoints[0].point[18].point_y@ */ /end MEASUREMENT
/begin MEASUREMENT SwcIn_J3_LANE.LinePoints.linepoints[0].point[19].point_x "" FLOAT64_IEEE autosar_swc_val_CM_double 0 0 -1.7E+308 1.7E+308 ECU_ADDRESS 0xfe4c9580 /* @ECU_Address@SwcIn_J3_LANE.LinePoints.linepoints[0].point[19].point_x@ */ /end MEASUREMENT
/begin MEASUREMENT SwcIn_J3_LANE.LinePoints.linepoints[0].point[19].point_y "" FLOAT64_IEEE autosar_swc_val_CM_double 0 0 -1.7E+308 1.7E+308 ECU_ADDRESS 0xfe4c9588 /* @ECU_Address@SwcIn_J3_LANE.LinePoints.linepoints[0].point[19].point_y@ */ /end MEASUREMENT
/begin MEASUREMENT SwcIn_J3_LANE.LinePoints.linepoints[0].point[1].point_x "" FLOAT64_IEEE autosar_swc_val_CM_double 0 0 -1.7E+308 1.7E+308 ECU_ADDRESS 0xfe4c9460 /* @ECU_Address@SwcIn_J3_LANE.LinePoints.linepoints[0].point[1].point_x@ */ /end MEASUREMENT
/begin MEASUREMENT SwcIn_J3_LANE.LinePoints.linepoints[0].point[1].point_y "" FLOAT64_IEEE autosar_swc_val_CM_double 0 0 -1.7E+308 1.7E+308 ECU_ADDRESS 0xfe4c9468 /* @ECU_Address@SwcIn_J3_LANE.LinePoints.linepoints[0].point[1].point_y@ */ /end MEASUREMENT
/begin MEASUREMENT SwcIn_J3_LANE.LinePoints.linepoints[0].point[20].point_x "" FLOAT64_IEEE autosar_swc_val_CM_double 0 0 -1.7E+308 1.7E+308 ECU_ADDRESS 0xfe4c9590 /* @ECU_Address@SwcIn_J3_LANE.LinePoints.linepoints[0].point[20].point_x@ */ /end MEASUREMENT
/begin MEASUREMENT SwcIn_J3_LANE.LinePoints.linepoints[0].point[20].point_y "" FLOAT64_IEEE autosar_swc_val_CM_double 0 0 -1.7E+308 1.7E+308 ECU_ADDRESS 0xfe4c9598 /* @ECU_Address@SwcIn_J3_LANE.LinePoints.linepoints[0].point[20].point_y@ */ /end MEASUREMENT
/begin MEASUREMENT SwcIn_J3_LANE.LinePoints.linepoints[0].point[21].point_x "" FLOAT64_IEEE autosar_swc_val_CM_double 0 0 -1.7E+308 1.7E+308 ECU_ADDRESS 0xfe4c95a0 /* @ECU_Address@SwcIn_J3_LANE.LinePoints.linepoints[0].point[21].point_x@ */ /end MEASUREMENT
/begin MEASUREMENT SwcIn_J3_LANE.LinePoints.linepoints[0].point[21].point_y "" FLOAT64_IEEE autosar_swc_val_CM_double 0 0 -1.7E+308 1.7E+308 ECU_ADDRESS 0xfe4c95a8 /* @ECU_Address@SwcIn_J3_LANE.LinePoints.linepoints[0].point[21].point_y@ */ /end MEASUREMENT
/begin MEASUREMENT SwcIn_J3_LANE.LinePoints.linepoints[0].point[22].point_x "" FLOAT64_IEEE autosar_swc_val_CM_double 0 0 -1.7E+308 1.7E+308 ECU_ADDRESS 0xfe4c95b0 /* @ECU_Address@SwcIn_J3_LANE.LinePoints.linepoints[0].point[22].point_x@ */ /end MEASUREMENT
/begin MEASUREMENT SwcIn_J3_LANE.LinePoints.linepoints[0].point[22].point_y "" FLOAT64_IEEE autosar_swc_val_CM_double 0 0 -1.7E+308 1.7E+308 ECU_ADDRESS 0xfe4c95b8 /* @ECU_Address@SwcIn_J3_LANE.LinePoints.linepoints[0].point[22].point_y@ */ /end MEASUREMENT
/begin MEASUREMENT SwcIn_J3_LANE.LinePoints.linepoints[0].point[23].point_x "" FLOAT64_IEEE autosar_swc_val_CM_double 0 0 -1.7E+308 1.7E+308 ECU_ADDRESS 0xfe4c95c0 /* @ECU_Address@SwcIn_J3_LANE.LinePoints.linepoints[0].point[23].point_x@ */ /end MEASUREMENT
/begin MEASUREMENT SwcIn_J3_LANE.LinePoints.linepoints[0].point[23].point_y "" FLOAT64_IEEE autosar_swc_val_CM_double 0 0 -1.7E+308 1.7E+308 ECU_ADDRESS 0xfe4c95c8 /* @ECU_Address@SwcIn_J3_LANE.LinePoints.linepoints[0].point[23].point_y@ */ /end MEASUREMENT
/begin MEASUREMENT SwcIn_J3_LANE.LinePoints.linepoints[0].point[24].point_x "" FLOAT64_IEEE autosar_swc_val_CM_double 0 0 -1.7E+308 1.7E+308 ECU_ADDRESS 0xfe4c95d0 /* @ECU_Address@SwcIn_J3_LANE.LinePoints.linepoints[0].point[24].point_x@ */ /end MEASUREMENT
/begin MEASUREMENT SwcIn_J3_LANE.LinePoints.linepoints[0].point[24].point_y "" FLOAT64_IEEE autosar_swc_val_CM_double 0 0 -1.7E+308 1.7E+308 ECU_ADDRESS 0xfe4c95d8 /* @ECU_Address@SwcIn_J3_LANE.LinePoints.linepoints[0].point[24].point_y@ */ /end MEASUREMENT
/begin MEASUREMENT SwcIn_J3_LANE.LinePoints.linepoints[0].point[25].point_x "" FLOAT64_IEEE autosar_swc_val_CM_double 0 0 -1.7E+308 1.7E+308 ECU_ADDRESS 0xfe4c95e0 /* @ECU_Address@SwcIn_J3_LANE.LinePoints.linepoints[0].point[25].point_x@ */ /end MEASUREMENT
/begin MEASUREMENT SwcIn_J3_LANE.LinePoints.linepoints[0].point[25].point_y "" FLOAT64_IEEE autosar_swc_val_CM_double 0 0 -1.7E+308 1.7E+308 ECU_ADDRESS 0xfe4c95e8 /* @ECU_Address@SwcIn_J3_LANE.LinePoints.linepoints[0].point[25].point_y@ */ /end MEASUREMENT
/begin MEASUREMENT SwcIn_J3_LANE.LinePoints.linepoints[0].point[26].point_x "" FLOAT64_IEEE autosar_swc_val_CM_double 0 0 -1.7E+308 1.7E+308 ECU_ADDRESS 0xfe4c95f0 /* @ECU_Address@SwcIn_J3_LANE.LinePoints.linepoints[0].point[26].point_x@ */ /end MEASUREMENT
/begin MEASUREMENT SwcIn_J3_LANE.LinePoints.linepoints[0].point[26].point_y "" FLOAT64_IEEE autosar_swc_val_CM_double 0 0 -1.7E+308 1.7E+308 ECU_ADDRESS 0xfe4c95f8 /* @ECU_Address@SwcIn_J3_LANE.LinePoints.linepoints[0].point[26].point_y@ */ /end MEASUREMENT
/begin MEASUREMENT SwcIn_J3_LANE.LinePoints.linepoints[0].point[27].point_x "" FLOAT64_IEEE autosar_swc_val_CM_double 0 0 -1.7E+308 1.7E+308 ECU_ADDRESS 0xfe4c9600 /* @ECU_Address@SwcIn_J3_LANE.LinePoints.linepoints[0].point[27].point_x@ */ /end MEASUREMENT
/begin MEASUREMENT SwcIn_J3_LANE.LinePoints.linepoints[0].point[27].point_y "" FLOAT64_IEEE autosar_swc_val_CM_double 0 0 -1.7E+308 1.7E+308 ECU_ADDRESS 0xfe4c9608 /* @ECU_Address@SwcIn_J3_LANE.LinePoints.linepoints[0].point[27].point_y@ */ /end MEASUREMENT
/begin MEASUREMENT SwcIn_J3_LANE.LinePoints.linepoints[0].point[28].point_x "" FLOAT64_IEEE autosar_swc_val_CM_double 0 0 -1.7E+308 1.7E+308 ECU_ADDRESS 0xfe4c9610 /* @ECU_Address@SwcIn_J3_LANE.LinePoints.linepoints[0].point[28].point_x@ */ /end MEASUREMENT
/begin MEASUREMENT SwcIn_J3_LANE.LinePoints.linepoints[0].point[28].point_y "" FLOAT64_IEEE autosar_swc_val_CM_double 0 0 -1.7E+308 1.7E+308 ECU_ADDRESS 0xfe4c9618 /* @ECU_Address@SwcIn_J3_LANE.LinePoints.linepoints[0].point[28].point_y@ */ /end MEASUREMENT
/begin MEASUREMENT SwcIn_J3_LANE.LinePoints.linepoints[0].point[29].point_x "" FLOAT64_IEEE autosar_swc_val_CM_double 0 0 -1.7E+308 1.7E+308 ECU_ADDRESS 0xfe4c9620 /* @ECU_Address@SwcIn_J3_LANE.LinePoints.linepoints[0].point[29].point_x@ */ /end MEASUREMENT
/begin MEASUREMENT SwcIn_J3_LANE.LinePoints.linepoints[0].point[29].point_y "" FLOAT64_IEEE autosar_swc_val_CM_double 0 0 -1.7E+308 1.7E+308 ECU_ADDRESS 0xfe4c9628 /* @ECU_Address@SwcIn_J3_LANE.LinePoints.linepoints[0].point[29].point_y@ */ /end MEASUREMENT
/begin MEASUREMENT SwcIn_J3_LANE.LinePoints.linepoints[0].point[2].point_x "" FLOAT64_IEEE autosar_swc_val_CM_double 0 0 -1.7E+308 1.7E+308 ECU_ADDRESS 0xfe4c9470 /* @ECU_Address@SwcIn_J3_LANE.LinePoints.linepoints[0].point[2].point_x@ */ /end MEASUREMENT
/begin MEASUREMENT SwcIn_J3_LANE.LinePoints.linepoints[0].point[2].point_y "" FLOAT64_IEEE autosar_swc_val_CM_double 0 0 -1.7E+308 1.7E+308 ECU_ADDRESS 0xfe4c9478 /* @ECU_Address@SwcIn_J3_LANE.LinePoints.linepoints[0].point[2].point_y@ */ /end MEASUREMENT
/begin MEASUREMENT SwcIn_J3_LANE.LinePoints.linepoints[0].point[30].point_x "" FLOAT64_IEEE autosar_swc_val_CM_double 0 0 -1.7E+308 1.7E+308 ECU_ADDRESS 0xfe4c9630 /* @ECU_Address@SwcIn_J3_LANE.LinePoints.linepoints[0].point[30].point_x@ */ /end MEASUREMENT
/begin MEASUREMENT SwcIn_J3_LANE.LinePoints.linepoints[0].point[30].point_y "" FLOAT64_IEEE autosar_swc_val_CM_double 0 0 -1.7E+308 1.7E+308 ECU_ADDRESS 0xfe4c9638 /* @ECU_Address@SwcIn_J3_LANE.LinePoints.linepoints[0].point[30].point_y@ */ /end MEASUREMENT
/begin MEASUREMENT SwcIn_J3_LANE.LinePoints.linepoints[0].point[31].point_x "" FLOAT64_IEEE autosar_swc_val_CM_double 0 0 -1.7E+308 1.7E+308 ECU_ADDRESS 0xfe4c9640 /* @ECU_Address@SwcIn_J3_LANE.LinePoints.linepoints[0].point[31].point_x@ */ /end MEASUREMENT
/begin MEASUREMENT SwcIn_J3_LANE.LinePoints.linepoints[0].point[31].point_y "" FLOAT64_IEEE autosar_swc_val_CM_double 0 0 -1.7E+308 1.7E+308 ECU_ADDRESS 0xfe4c9648 /* @ECU_Address@SwcIn_J3_LANE.LinePoints.linepoints[0].point[31].point_y@ */ /end MEASUREMENT
/begin MEASUREMENT SwcIn_J3_LANE.LinePoints.linepoints[0].point[32].point_x "" FLOAT64_IEEE autosar_swc_val_CM_double 0 0 -1.7E+308 1.7E+308 ECU_ADDRESS 0xfe4c9650 /* @ECU_Address@SwcIn_J3_LANE.LinePoints.linepoints[0].point[32].point_x@ */ /end MEASUREMENT
/begin MEASUREMENT SwcIn_J3_LANE.LinePoints.linepoints[0].point[32].point_y "" FLOAT64_IEEE autosar_swc_val_CM_double 0 0 -1.7E+308 1.7E+308 ECU_ADDRESS 0xfe4c9658 /* @ECU_Address@SwcIn_J3_LANE.LinePoints.linepoints[0].point[32].point_y@ */ /end MEASUREMENT
/begin MEASUREMENT SwcIn_J3_LANE.LinePoints.linepoints[0].point[33].point_x "" FLOAT64_IEEE autosar_swc_val_CM_double 0 0 -1.7E+308 1.7E+308 ECU_ADDRESS 0xfe4c9660 /* @ECU_Address@SwcIn_J3_LANE.LinePoints.linepoints[0].point[33].point_x@ */ /end MEASUREMENT
/begin MEASUREMENT SwcIn_J3_LANE.LinePoints.linepoints[0].point[33].point_y "" FLOAT64_IEEE autosar_swc_val_CM_double 0 0 -1.7E+308 1.7E+308 ECU_ADDRESS 0xfe4c9668 /* @ECU_Address@SwcIn_J3_LANE.LinePoints.linepoints[0].point[33].point_y@ */ /end MEASUREMENT
/begin MEASUREMENT SwcIn_J3_LANE.LinePoints.linepoints[0].point[34].point_x "" FLOAT64_IEEE autosar_swc_val_CM_double 0 0 -1.7E+308 1.7E+308 ECU_ADDRESS 0xfe4c9670 /* @ECU_Address@SwcIn_J3_LANE.LinePoints.linepoints[0].point[34].point_x@ */ /end MEASUREMENT
/begin MEASUREMENT SwcIn_J3_LANE.LinePoints.linepoints[0].point[34].point_y "" FLOAT64_IEEE autosar_swc_val_CM_double 0 0 -1.7E+308 1.7E+308 ECU_ADDRESS 0xfe4c9678 /* @ECU_Address@SwcIn_J3_LANE.LinePoints.linepoints[0].point[34].point_y@ */ /end MEASUREMENT
/begin MEASUREMENT SwcIn_J3_LANE.LinePoints.linepoints[0].point[35].point_x "" FLOAT64_IEEE autosar_swc_val_CM_double 0 0 -1.7E+308 1.7E+308 ECU_ADDRESS 0xfe4c9680 /* @ECU_Address@SwcIn_J3_LANE.LinePoints.linepoints[0].point[35].point_x@ */ /end MEASUREMENT
/begin MEASUREMENT SwcIn_J3_LANE.LinePoints.linepoints[0].point[35].point_y "" FLOAT64_IEEE autosar_swc_val_CM_double 0 0 -1.7E+308 1.7E+308 ECU_ADDRESS 0xfe4c9688 /* @ECU_Address@SwcIn_J3_LANE.LinePoints.linepoints[0].point[35].point_y@ */ /end MEASUREMENT
/begin MEASUREMENT SwcIn_J3_LANE.LinePoints.linepoints[0].point[36].point_x "" FLOAT64_IEEE autosar_swc_val_CM_double 0 0 -1.7E+308 1.7E+308 ECU_ADDRESS 0xfe4c9690 /* @ECU_Address@SwcIn_J3_LANE.LinePoints.linepoints[0].point[36].point_x@ */ /end MEASUREMENT
/begin MEASUREMENT SwcIn_J3_LANE.LinePoints.linepoints[0].point[36].point_y "" FLOAT64_IEEE autosar_swc_val_CM_double 0 0 -1.7E+308 1.7E+308 ECU_ADDRESS 0xfe4c9698 /* @ECU_Address@SwcIn_J3_LANE.LinePoints.linepoints[0].point[36].point_y@ */ /end MEASUREMENT
/begin MEASUREMENT SwcIn_J3_LANE.LinePoints.linepoints[0].point[37].point_x "" FLOAT64_IEEE autosar_swc_val_CM_double 0 0 -1.7E+308 1.7E+308 ECU_ADDRESS 0xfe4c96a0 /* @ECU_Address@SwcIn_J3_LANE.LinePoints.linepoints[0].point[37].point_x@ */ /end MEASUREMENT
/begin MEASUREMENT SwcIn_J3_LANE.LinePoints.linepoints[0].point[37].point_y "" FLOAT64_IEEE autosar_swc_val_CM_double 0 0 -1.7E+308 1.7E+308 ECU_ADDRESS 0xfe4c96a8 /* @ECU_Address@SwcIn_J3_LANE.LinePoints.linepoints[0].point[37].point_y@ */ /end MEASUREMENT
/begin MEASUREMENT SwcIn_J3_LANE.LinePoints.linepoints[0].point[38].point_x "" FLOAT64_IEEE autosar_swc_val_CM_double 0 0 -1.7E+308 1.7E+308 ECU_ADDRESS 0xfe4c96b0 /* @ECU_Address@SwcIn_J3_LANE.LinePoints.linepoints[0].point[38].point_x@ */ /end MEASUREMENT
/begin MEASUREMENT SwcIn_J3_LANE.LinePoints.linepoints[0].point[38].point_y "" FLOAT64_IEEE autosar_swc_val_CM_double 0 0 -1.7E+308 1.7E+308 ECU_ADDRESS 0xfe4c96b8 /* @ECU_Address@SwcIn_J3_LANE.LinePoints.linepoints[0].point[38].point_y@ */ /end MEASUREMENT
/begin MEASUREMENT SwcIn_J3_LANE.LinePoints.linepoints[0].point[39].point_x "" FLOAT64_IEEE autosar_swc_val_CM_double 0 0 -1.7E+308 1.7E+308 ECU_ADDRESS 0xfe4c96c0 /* @ECU_Address@SwcIn_J3_LANE.LinePoints.linepoints[0].point[39].point_x@ */ /end MEASUREMENT
/begin MEASUREMENT SwcIn_J3_LANE.LinePoints.linepoints[0].point[39].point_y "" FLOAT64_IEEE autosar_swc_val_CM_double 0 0 -1.7E+308 1.7E+308 ECU_ADDRESS 0xfe4c96c8 /* @ECU_Address@SwcIn_J3_LANE.LinePoints.linepoints[0].point[39].point_y@ */ /end MEASUREMENT
/begin MEASUREMENT SwcIn_J3_LANE.LinePoints.linepoints[0].point[3].point_x "" FLOAT64_IEEE autosar_swc_val_CM_double 0 0 -1.7E+308 1.7E+308 ECU_ADDRESS 0xfe4c9480 /* @ECU_Address@SwcIn_J3_LANE.LinePoints.linepoints[0].point[3].point_x@ */ /end MEASUREMENT
/begin MEASUREMENT SwcIn_J3_LANE.LinePoints.linepoints[0].point[3].point_y "" FLOAT64_IEEE autosar_swc_val_CM_double 0 0 -1.7E+308 1.7E+308 ECU_ADDRESS 0xfe4c9488 /* @ECU_Address@SwcIn_J3_LANE.LinePoints.linepoints[0].point[3].point_y@ */ /end MEASUREMENT
/begin MEASUREMENT SwcIn_J3_LANE.LinePoints.linepoints[0].point[40].point_x "" FLOAT64_IEEE autosar_swc_val_CM_double 0 0 -1.7E+308 1.7E+308 ECU_ADDRESS 0xfe4c96d0 /* @ECU_Address@SwcIn_J3_LANE.LinePoints.linepoints[0].point[40].point_x@ */ /end MEASUREMENT
/begin MEASUREMENT SwcIn_J3_LANE.LinePoints.linepoints[0].point[40].point_y "" FLOAT64_IEEE autosar_swc_val_CM_double 0 0 -1.7E+308 1.7E+308 ECU_ADDRESS 0xfe4c96d8 /* @ECU_Address@SwcIn_J3_LANE.LinePoints.linepoints[0].point[40].point_y@ */ /end MEASUREMENT
/begin MEASUREMENT SwcIn_J3_LANE.LinePoints.linepoints[0].point[41].point_x "" FLOAT64_IEEE autosar_swc_val_CM_double 0 0 -1.7E+308 1.7E+308 ECU_ADDRESS 0xfe4c96e0 /* @ECU_Address@SwcIn_J3_LANE.LinePoints.linepoints[0].point[41].point_x@ */ /end MEASUREMENT
/begin MEASUREMENT SwcIn_J3_LANE.LinePoints.linepoints[0].point[41].point_y "" FLOAT64_IEEE autosar_swc_val_CM_double 0 0 -1.7E+308 1.7E+308 ECU_ADDRESS 0xfe4c96e8 /* @ECU_Address@SwcIn_J3_LANE.LinePoints.linepoints[0].point[41].point_y@ */ /end MEASUREMENT
/begin MEASUREMENT SwcIn_J3_LANE.LinePoints.linepoints[0].point[42].point_x "" FLOAT64_IEEE autosar_swc_val_CM_double 0 0 -1.7E+308 1.7E+308 ECU_ADDRESS 0xfe4c96f0 /* @ECU_Address@SwcIn_J3_LANE.LinePoints.linepoints[0].point[42].point_x@ */ /end MEASUREMENT
/begin MEASUREMENT SwcIn_J3_LANE.LinePoints.linepoints[0].point[42].point_y "" FLOAT64_IEEE autosar_swc_val_CM_double 0 0 -1.7E+308 1.7E+308 ECU_ADDRESS 0xfe4c96f8 /* @ECU_Address@SwcIn_J3_LANE.LinePoints.linepoints[0].point[42].point_y@ */ /end MEASUREMENT
/begin MEASUREMENT SwcIn_J3_LANE.LinePoints.linepoints[0].point[43].point_x "" FLOAT64_IEEE autosar_swc_val_CM_double 0 0 -1.7E+308 1.7E+308 ECU_ADDRESS 0xfe4c9700 /* @ECU_Address@SwcIn_J3_LANE.LinePoints.linepoints[0].point[43].point_x@ */ /end MEASUREMENT
/begin MEASUREMENT SwcIn_J3_LANE.LinePoints.linepoints[0].point[43].point_y "" FLOAT64_IEEE autosar_swc_val_CM_double 0 0 -1.7E+308 1.7E+308 ECU_ADDRESS 0xfe4c9708 /* @ECU_Address@SwcIn_J3_LANE.LinePoints.linepoints[0].point[43].point_y@ */ /end MEASUREMENT
/begin MEASUREMENT SwcIn_J3_LANE.LinePoints.linepoints[0].point[44].point_x "" FLOAT64_IEEE autosar_swc_val_CM_double 0 0 -1.7E+308 1.7E+308 ECU_ADDRESS 0xfe4c9710 /* @ECU_Address@SwcIn_J3_LANE.LinePoints.linepoints[0].point[44].point_x@ */ /end MEASUREMENT
/begin MEASUREMENT SwcIn_J3_LANE.LinePoints.linepoints[0].point[44].point_y "" FLOAT64_IEEE autosar_swc_val_CM_double 0 0 -1.7E+308 1.7E+308 ECU_ADDRESS 0xfe4c9718 /* @ECU_Address@SwcIn_J3_LANE.LinePoints.linepoints[0].point[44].point_y@ */ /end MEASUREMENT
/begin MEASUREMENT SwcIn_J3_LANE.LinePoints.linepoints[0].point[45].point_x "" FLOAT64_IEEE autosar_swc_val_CM_double 0 0 -1.7E+308 1.7E+308 ECU_ADDRESS 0xfe4c9720 /* @ECU_Address@SwcIn_J3_LANE.LinePoints.linepoints[0].point[45].point_x@ */ /end MEASUREMENT
/begin MEASUREMENT SwcIn_J3_LANE.LinePoints.linepoints[0].point[45].point_y "" FLOAT64_IEEE autosar_swc_val_CM_double 0 0 -1.7E+308 1.7E+308 ECU_ADDRESS 0xfe4c9728 /* @ECU_Address@SwcIn_J3_LANE.LinePoints.linepoints[0].point[45].point_y@ */ /end MEASUREMENT
/begin MEASUREMENT SwcIn_J3_LANE.LinePoints.linepoints[0].point[46].point_x "" FLOAT64_IEEE autosar_swc_val_CM_double 0 0 -1.7E+308 1.7E+308 ECU_ADDRESS 0xfe4c9730 /* @ECU_Address@SwcIn_J3_LANE.LinePoints.linepoints[0].point[46].point_x@ */ /end MEASUREMENT
/begin MEASUREMENT SwcIn_J3_LANE.LinePoints.linepoints[0].point[46].point_y "" FLOAT64_IEEE autosar_swc_val_CM_double 0 0 -1.7E+308 1.7E+308 ECU_ADDRESS 0xfe4c9738 /* @ECU_Address@SwcIn_J3_LANE.LinePoints.linepoints[0].point[46].point_y@ */ /end MEASUREMENT
/begin MEASUREMENT SwcIn_J3_LANE.LinePoints.linepoints[0].point[47].point_x "" FLOAT64_IEEE autosar_swc_val_CM_double 0 0 -1.7E+308 1.7E+308 ECU_ADDRESS 0xfe4c9740 /* @ECU_Address@SwcIn_J3_LANE.LinePoints.linepoints[0].point[47].point_x@ */ /end MEASUREMENT
/begin MEASUREMENT SwcIn_J3_LANE.LinePoints.linepoints[0].point[47].point_y "" FLOAT64_IEEE autosar_swc_val_CM_double 0 0 -1.7E+308 1.7E+308 ECU_ADDRESS 0xfe4c9748 /* @ECU_Address@SwcIn_J3_LANE.LinePoints.linepoints[0].point[47].point_y@ */ /end MEASUREMENT
/begin MEASUREMENT SwcIn_J3_LANE.LinePoints.linepoints[0].point[48].point_x "" FLOAT64_IEEE autosar_swc_val_CM_double 0 0 -1.7E+308 1.7E+308 ECU_ADDRESS 0xfe4c9750 /* @ECU_Address@SwcIn_J3_LANE.LinePoints.linepoints[0].point[48].point_x@ */ /end MEASUREMENT
/begin MEASUREMENT SwcIn_J3_LANE.LinePoints.linepoints[0].point[48].point_y "" FLOAT64_IEEE autosar_swc_val_CM_double 0 0 -1.7E+308 1.7E+308 ECU_ADDRESS 0xfe4c9758 /* @ECU_Address@SwcIn_J3_LANE.LinePoints.linepoints[0].point[48].point_y@ */ /end MEASUREMENT
/begin MEASUREMENT SwcIn_J3_LANE.LinePoints.linepoints[0].point[49].point_x "" FLOAT64_IEEE autosar_swc_val_CM_double 0 0 -1.7E+308 1.7E+308 ECU_ADDRESS 0xfe4c9760 /* @ECU_Address@SwcIn_J3_LANE.LinePoints.linepoints[0].point[49].point_x@ */ /end MEASUREMENT
/begin MEASUREMENT SwcIn_J3_LANE.LinePoints.linepoints[0].point[49].point_y "" FLOAT64_IEEE autosar_swc_val_CM_double 0 0 -1.7E+308 1.7E+308 ECU_ADDRESS 0xfe4c9768 /* @ECU_Address@SwcIn_J3_LANE.LinePoints.linepoints[0].point[49].point_y@ */ /end MEASUREMENT
/begin MEASUREMENT SwcIn_J3_LANE.LinePoints.linepoints[0].point[4].point_x "" FLOAT64_IEEE autosar_swc_val_CM_double 0 0 -1.7E+308 1.7E+308 ECU_ADDRESS 0xfe4c9490 /* @ECU_Address@SwcIn_J3_LANE.LinePoints.linepoints[0].point[4].point_x@ */ /end MEASUREMENT
/begin MEASUREMENT SwcIn_J3_LANE.LinePoints.linepoints[0].point[4].point_y "" FLOAT64_IEEE autosar_swc_val_CM_double 0 0 -1.7E+308 1.7E+308 ECU_ADDRESS 0xfe4c9498 /* @ECU_Address@SwcIn_J3_LANE.LinePoints.linepoints[0].point[4].point_y@ */ /end MEASUREMENT
/begin MEASUREMENT SwcIn_J3_LANE.LinePoints.linepoints[0].point[5].point_x "" FLOAT64_IEEE autosar_swc_val_CM_double 0 0 -1.7E+308 1.7E+308 ECU_ADDRESS 0xfe4c94a0 /* @ECU_Address@SwcIn_J3_LANE.LinePoints.linepoints[0].point[5].point_x@ */ /end MEASUREMENT
/begin MEASUREMENT SwcIn_J3_LANE.LinePoints.linepoints[0].point[5].point_y "" FLOAT64_IEEE autosar_swc_val_CM_double 0 0 -1.7E+308 1.7E+308 ECU_ADDRESS 0xfe4c94a8 /* @ECU_Address@SwcIn_J3_LANE.LinePoints.linepoints[0].point[5].point_y@ */ /end MEASUREMENT
/begin MEASUREMENT SwcIn_J3_LANE.LinePoints.linepoints[0].point[6].point_x "" FLOAT64_IEEE autosar_swc_val_CM_double 0 0 -1.7E+308 1.7E+308 ECU_ADDRESS 0xfe4c94b0 /* @ECU_Address@SwcIn_J3_LANE.LinePoints.linepoints[0].point[6].point_x@ */ /end MEASUREMENT
/begin MEASUREMENT SwcIn_J3_LANE.LinePoints.linepoints[0].point[6].point_y "" FLOAT64_IEEE autosar_swc_val_CM_double 0 0 -1.7E+308 1.7E+308 ECU_ADDRESS 0xfe4c94b8 /* @ECU_Address@SwcIn_J3_LANE.LinePoints.linepoints[0].point[6].point_y@ */ /end MEASUREMENT
/begin MEASUREMENT SwcIn_J3_LANE.LinePoints.linepoints[0].point[7].point_x "" FLOAT64_IEEE autosar_swc_val_CM_double 0 0 -1.7E+308 1.7E+308 ECU_ADDRESS 0xfe4c94c0 /* @ECU_Address@SwcIn_J3_LANE.LinePoints.linepoints[0].point[7].point_x@ */ /end MEASUREMENT
/begin MEASUREMENT SwcIn_J3_LANE.LinePoints.linepoints[0].point[7].point_y "" FLOAT64_IEEE autosar_swc_val_CM_double 0 0 -1.7E+308 1.7E+308 ECU_ADDRESS 0xfe4c94c8 /* @ECU_Address@SwcIn_J3_LANE.LinePoints.linepoints[0].point[7].point_y@ */ /end MEASUREMENT
/begin MEASUREMENT SwcIn_J3_LANE.LinePoints.linepoints[0].point[8].point_x "" FLOAT64_IEEE autosar_swc_val_CM_double 0 0 -1.7E+308 1.7E+308 ECU_ADDRESS 0xfe4c94d0 /* @ECU_Address@SwcIn_J3_LANE.LinePoints.linepoints[0].point[8].point_x@ */ /end MEASUREMENT
/begin MEASUREMENT SwcIn_J3_LANE.LinePoints.linepoints[0].point[8].point_y "" FLOAT64_IEEE autosar_swc_val_CM_double 0 0 -1.7E+308 1.7E+308 ECU_ADDRESS 0xfe4c94d8 /* @ECU_Address@SwcIn_J3_LANE.LinePoints.linepoints[0].point[8].point_y@ */ /end MEASUREMENT
/begin MEASUREMENT SwcIn_J3_LANE.LinePoints.linepoints[0].point[9].point_x "" FLOAT64_IEEE autosar_swc_val_CM_double 0 0 -1.7E+308 1.7E+308 ECU_ADDRESS 0xfe4c94e0 /* @ECU_Address@SwcIn_J3_LANE.LinePoints.linepoints[0].point[9].point_x@ */ /end MEASUREMENT
/begin MEASUREMENT SwcIn_J3_LANE.LinePoints.linepoints[0].point[9].point_y "" FLOAT64_IEEE autosar_swc_val_CM_double 0 0 -1.7E+308 1.7E+308 ECU_ADDRESS 0xfe4c94e8 /* @ECU_Address@SwcIn_J3_LANE.LinePoints.linepoints[0].point[9].point_y@ */ /end MEASUREMENT
/begin MEASUREMENT SwcIn_J3_LANE.LinePoints.linepoints[1].point[0].point_x "" FLOAT64_IEEE autosar_swc_val_CM_double 0 0 -1.7E+308 1.7E+308 ECU_ADDRESS 0xfe4c9778 /* @ECU_Address@SwcIn_J3_LANE.LinePoints.linepoints[1].point[0].point_x@ */ /end MEASUREMENT
/begin MEASUREMENT SwcIn_J3_LANE.LinePoints.linepoints[1].point[0].point_y "" FLOAT64_IEEE autosar_swc_val_CM_double 0 0 -1.7E+308 1.7E+308 ECU_ADDRESS 0xfe4c9780 /* @ECU_Address@SwcIn_J3_LANE.LinePoints.linepoints[1].point[0].point_y@ */ /end MEASUREMENT
/begin MEASUREMENT SwcOut_FCM_DrivingHmiEnv.DynamicObjectList[1].laneID "" SBYTE autosar_swc_val_CM_int8 0 0 -128 127 ECU_ADDRESS 0xfe4ca1b0 /* @ECU_Address@SwcOut_FCM_DrivingHmiEnv.DynamicObjectList[1].laneID@ */ /end MEASUREMENT
/begin MEASUREMENT SwcOut_FCM_DrivingHmiEnv.DynamicObjectList[1].lightStatus "" UBYTE autosar_swc_val_CM_uint8 0 0 0 255 ECU_ADDRESS 0xfe4ca18a /* @ECU_Address@SwcOut_FCM_DrivingHmiEnv.DynamicObjectList[1].lightStatus@ */ /end MEASUREMENT
/begin MEASUREMENT SwcOut_FCM_DrivingHmiEnv.DynamicObjectList[1].objectColor "" UBYTE autosar_swc_val_CM_uint8 0 0 0 255 ECU_ADDRESS 0xfe4ca198 /* @ECU_Address@SwcOut_FCM_DrivingHmiEnv.DynamicObjectList[1].objectColor@ */ /end MEASUREMENT
/begin MEASUREMENT SwcOut_FCM_DrivingHmiEnv.DynamicObjectList[1].objectId "" UBYTE autosar_swc_val_CM_uint8 0 0 0 255 ECU_ADDRESS 0xfe4ca188 /* @ECU_Address@SwcOut_FCM_DrivingHmiEnv.DynamicObjectList[1].objectId@ */ /end MEASUREMENT
/begin MEASUREMENT SwcOut_FCM_DrivingHmiEnv.DynamicObjectList[1].objectPoseX "" FLOAT32_IEEE autosar_swc_val_CM_single 0 0 -3.4E+38 3.4E+38 ECU_ADDRESS 0xfe4ca18c /* @ECU_Address@SwcOut_FCM_DrivingHmiEnv.DynamicObjectList[1].objectPoseX@ */ /end MEASUREMENT
/begin MEASUREMENT SwcOut_FCM_DrivingHmiEnv.DynamicObjectList[1].objectPoseY "" FLOAT32_IEEE autosar_swc_val_CM_single 0 0 -3.4E+38 3.4E+38 ECU_ADDRESS 0xfe4ca190 /* @ECU_Address@SwcOut_FCM_DrivingHmiEnv.DynamicObjectList[1].objectPoseY@ */ /end MEASUREMENT
/begin MEASUREMENT SwcOut_FCM_DrivingHmiEnv.DynamicObjectList[1].objectType "" UBYTE autosar_swc_val_CM_uint8 0 0 0 255 ECU_ADDRESS 0xfe4ca189 /* @ECU_Address@SwcOut_FCM_DrivingHmiEnv.DynamicObjectList[1].objectType@ */ /end MEASUREMENT
/begin MEASUREMENT SwcOut_FCM_DrivingHmiEnv.DynamicObjectList[1].objectVelocityX "" FLOAT32_IEEE autosar_swc_val_CM_single 0 0 -3.4E+38 3.4E+38 ECU_ADDRESS 0xfe4ca19c /* @ECU_Address@SwcOut_FCM_DrivingHmiEnv.DynamicObjectList[1].objectVelocityX@ */ /end MEASUREMENT
/begin MEASUREMENT SwcOut_FCM_DrivingHmiEnv.DynamicObjectList[1].objectVelocityY "" FLOAT32_IEEE autosar_swc_val_CM_single 0 0 -3.4E+38 3.4E+38 ECU_ADDRESS 0xfe4ca1a0 /* @ECU_Address@SwcOut_FCM_DrivingHmiEnv.DynamicObjectList[1].objectVelocityY@ */ /end MEASUREMENT
/begin MEASUREMENT SwcOut_FCM_DrivingHmiEnv.DynamicObjectList[1].objectYaw "" FLOAT32_IEEE autosar_swc_val_CM_single 0 0 -3.4E+38 3.4E+38 ECU_ADDRESS 0xfe4ca194 /* @ECU_Address@SwcOut_FCM_DrivingHmiEnv.DynamicObjectList[1].objectYaw@ */ /end MEASUREMENT
/begin MEASUREMENT SwcOut_FCM_DrivingHmiEnv.DynamicObjectList[1].timestampnSec "" A_UINT64 autosar_swc_val_CM_uint64 0 0 0.0 1.844674407370955e+19 ECU_ADDRESS 0xfe4ca1a8 /* @ECU_Address@SwcOut_FCM_DrivingHmiEnv.DynamicObjectList[1].timestampnSec@ */ /end MEASUREMENT
/begin MEASUREMENT SwcOut_FCM_DrivingHmiEnv.DynamicObjectList[2].laneID "" SBYTE autosar_swc_val_CM_int8 0 0 -128 127 ECU_ADDRESS 0xfe4ca1e0 /* @ECU_Address@SwcOut_FCM_DrivingHmiEnv.DynamicObjectList[2].laneID@ */ /end MEASUREMENT
/begin MEASUREMENT SwcOut_FCM_DrivingHmiEnv.DynamicObjectList[2].lightStatus "" UBYTE autosar_swc_val_CM_uint8 0 0 0 255 ECU_ADDRESS 0xfe4ca1ba /* @ECU_Address@SwcOut_FCM_DrivingHmiEnv.DynamicObjectList[2].lightStatus@ */ /end MEASUREMENT
/begin MEASUREMENT SwcOut_FCM_DrivingHmiEnv.DynamicObjectList[2].objectColor "" UBYTE autosar_swc_val_CM_uint8 0 0 0 255 ECU_ADDRESS 0xfe4ca1c8 /* @ECU_Address@SwcOut_FCM_DrivingHmiEnv.DynamicObjectList[2].objectColor@ */ /end MEASUREMENT
/begin MEASUREMENT SwcOut_FCM_DrivingHmiEnv.DynamicObjectList[2].objectId "" UBYTE autosar_swc_val_CM_uint8 0 0 0 255 ECU_ADDRESS 0xfe4ca1b8 /* @ECU_Address@SwcOut_FCM_DrivingHmiEnv.DynamicObjectList[2].objectId@ */ /end MEASUREMENT
/begin MEASUREMENT SwcOut_FCM_DrivingHmiEnv.DynamicObjectList[2].objectPoseX "" FLOAT32_IEEE autosar_swc_val_CM_single 0 0 -3.4E+38 3.4E+38 ECU_ADDRESS 0xfe4ca1bc /* @ECU_Address@SwcOut_FCM_DrivingHmiEnv.DynamicObjectList[2].objectPoseX@ */ /end MEASUREMENT
/begin MEASUREMENT SwcOut_FCM_DrivingHmiEnv.DynamicObjectList[2].objectPoseY "" FLOAT32_IEEE autosar_swc_val_CM_single 0 0 -3.4E+38 3.4E+38 ECU_ADDRESS 0xfe4ca1c0 /* @ECU_Address@SwcOut_FCM_DrivingHmiEnv.DynamicObjectList[2].objectPoseY@ */ /end MEASUREMENT
/begin MEASUREMENT SwcOut_FCM_DrivingHmiEnv.DynamicObjectList[2].objectType "" UBYTE autosar_swc_val_CM_uint8 0 0 0 255 ECU_ADDRESS 0xfe4ca1b9 /* @ECU_Address@SwcOut_FCM_DrivingHmiEnv.DynamicObjectList[2].objectType@ */ /end MEASUREMENT
/begin MEASUREMENT SwcOut_FCM_DrivingHmiEnv.DynamicObjectList[2].objectVelocityX "" FLOAT32_IEEE autosar_swc_val_CM_single 0 0 -3.4E+38 3.4E+38 ECU_ADDRESS 0xfe4ca1cc /* @ECU_Address@SwcOut_FCM_DrivingHmiEnv.DynamicObjectList[2].objectVelocityX@ */ /end MEASUREMENT
/begin MEASUREMENT SwcOut_FCM_DrivingHmiEnv.DynamicObjectList[2].objectVelocityY "" FLOAT32_IEEE autosar_swc_val_CM_single 0 0 -3.4E+38 3.4E+38 ECU_ADDRESS 0xfe4ca1d0 /* @ECU_Address@SwcOut_FCM_DrivingHmiEnv.DynamicObjectList[2].objectVelocityY@ */ /end MEASUREMENT
/begin MEASUREMENT SwcOut_FCM_DrivingHmiEnv.DynamicObjectList[2].objectYaw "" FLOAT32_IEEE autosar_swc_val_CM_single 0 0 -3.4E+38 3.4E+38 ECU_ADDRESS 0xfe4ca1c4 /* @ECU_Address@SwcOut_FCM_DrivingHmiEnv.DynamicObjectList[2].objectYaw@ */ /end MEASUREMENT
/begin MEASUREMENT SwcOut_FCM_DrivingHmiEnv.DynamicObjectList[2].timestampnSec "" A_UINT64 autosar_swc_val_CM_uint64 0 0 0.0 1.844674407370955e+19 ECU_ADDRESS 0xfe4ca1d8 /* @ECU_Address@SwcOut_FCM_DrivingHmiEnv.DynamicObjectList[2].timestampnSec@ */ /end MEASUREMENT
/begin MEASUREMENT SwcOut_FCM_DrivingHmiEnv.DynamicObjectList[3].laneID "" SBYTE autosar_swc_val_CM_int8 0 0 -128 127 ECU_ADDRESS 0xfe4ca210 /* @ECU_Address@SwcOut_FCM_DrivingHmiEnv.DynamicObjectList[3].laneID@ */ /end MEASUREMENT
/begin MEASUREMENT SwcOut_FCM_DrivingHmiEnv.DynamicObjectList[3].lightStatus "" UBYTE autosar_swc_val_CM_uint8 0 0 0 255 ECU_ADDRESS 0xfe4ca1ea /* @ECU_Address@SwcOut_FCM_DrivingHmiEnv.DynamicObjectList[3].lightStatus@ */ /end MEASUREMENT
/begin MEASUREMENT SwcOut_FCM_DrivingHmiEnv.DynamicObjectList[3].objectColor "" UBYTE autosar_swc_val_CM_uint8 0 0 0 255 ECU_ADDRESS 0xfe4ca1f8 /* @ECU_Address@SwcOut_FCM_DrivingHmiEnv.DynamicObjectList[3].objectColor@ */ /end MEASUREMENT
/begin MEASUREMENT SwcOut_FCM_DrivingHmiEnv.DynamicObjectList[3].objectId "" UBYTE autosar_swc_val_CM_uint8 0 0 0 255 ECU_ADDRESS 0xfe4ca1e8 /* @ECU_Address@SwcOut_FCM_DrivingHmiEnv.DynamicObjectList[3].objectId@ */ /end MEASUREMENT
/begin MEASUREMENT SwcOut_FCM_DrivingHmiEnv.DynamicObjectList[3].objectPoseX "" FLOAT32_IEEE autosar_swc_val_CM_single 0 0 -3.4E+38 3.4E+38 ECU_ADDRESS 0xfe4ca1ec /* @ECU_Address@SwcOut_FCM_DrivingHmiEnv.DynamicObjectList[3].objectPoseX@ */ /end MEASUREMENT
/begin MEASUREMENT SwcOut_FCM_DrivingHmiEnv.DynamicObjectList[3].objectPoseY "" FLOAT32_IEEE autosar_swc_val_CM_single 0 0 -3.4E+38 3.4E+38 ECU_ADDRESS 0xfe4ca1f0 /* @ECU_Address@SwcOut_FCM_DrivingHmiEnv.DynamicObjectList[3].objectPoseY@ */ /end MEASUREMENT
/begin MEASUREMENT SwcOut_FCM_DrivingHmiEnv.DynamicObjectList[3].objectType "" UBYTE autosar_swc_val_CM_uint8 0 0 0 255 ECU_ADDRESS 0xfe4ca1e9 /* @ECU_Address@SwcOut_FCM_DrivingHmiEnv.DynamicObjectList[3].objectType@ */ /end MEASUREMENT
/begin MEASUREMENT SwcOut_FCM_DrivingHmiEnv.DynamicObjectList[3].objectVelocityX "" FLOAT32_IEEE autosar_swc_val_CM_single 0 0 -3.4E+38 3.4E+38 ECU_ADDRESS 0xfe4ca1fc /* @ECU_Address@SwcOut_FCM_DrivingHmiEnv.DynamicObjectList[3].objectVelocityX@ */ /end MEASUREMENT
/begin MEASUREMENT SwcOut_FCM_DrivingHmiEnv.DynamicObjectList[3].objectVelocityY "" FLOAT32_IEEE autosar_swc_val_CM_single 0 0 -3.4E+38 3.4E+38 ECU_ADDRESS 0xfe4ca200 /* @ECU_Address@SwcOut_FCM_DrivingHmiEnv.DynamicObjectList[3].objectVelocityY@ */ /end MEASUREMENT
/begin MEASUREMENT SwcOut_FCM_DrivingHmiEnv.DynamicObjectList[3].objectYaw "" FLOAT32_IEEE autosar_swc_val_CM_single 0 0 -3.4E+38 3.4E+38 ECU_ADDRESS 0xfe4ca1f4 /* @ECU_Address@SwcOut_FCM_DrivingHmiEnv.DynamicObjectList[3].objectYaw@ */ /end MEASUREMENT
/begin MEASUREMENT SwcOut_FCM_DrivingHmiEnv.DynamicObjectList[3].timestampnSec "" A_UINT64 autosar_swc_val_CM_uint64 0 0 0.0 1.844674407370955e+19 ECU_ADDRESS 0xfe4ca208 /* @ECU_Address@SwcOut_FCM_DrivingHmiEnv.DynamicObjectList[3].timestampnSec@ */ /end MEASUREMENT
/begin MEASUREMENT SwcOut_FCM_DrivingHmiEnv.DynamicObjectList[4].laneID "" SBYTE autosar_swc_val_CM_int8 0 0 -128 127 ECU_ADDRESS 0xfe4ca240 /* @ECU_Address@SwcOut_FCM_DrivingHmiEnv.DynamicObjectList[4].laneID@ */ /end MEASUREMENT
/begin MEASUREMENT SwcOut_FCM_DrivingHmiEnv.DynamicObjectList[4].lightStatus "" UBYTE autosar_swc_val_CM_uint8 0 0 0 255 ECU_ADDRESS 0xfe4ca21a /* @ECU_Address@SwcOut_FCM_DrivingHmiEnv.DynamicObjectList[4].lightStatus@ */ /end MEASUREMENT
/begin MEASUREMENT SwcOut_FCM_DrivingHmiEnv.DynamicObjectList[4].objectColor "" UBYTE autosar_swc_val_CM_uint8 0 0 0 255 ECU_ADDRESS 0xfe4ca228 /* @ECU_Address@SwcOut_FCM_DrivingHmiEnv.DynamicObjectList[4].objectColor@ */ /end MEASUREMENT
/begin MEASUREMENT SwcOut_FCM_DrivingHmiEnv.DynamicObjectList[4].objectId "" UBYTE autosar_swc_val_CM_uint8 0 0 0 255 ECU_ADDRESS 0xfe4ca218 /* @ECU_Address@SwcOut_FCM_DrivingHmiEnv.DynamicObjectList[4].objectId@ */ /end MEASUREMENT
/begin MEASUREMENT SwcOut_FCM_DrivingHmiEnv.DynamicObjectList[4].objectPoseX "" FLOAT32_IEEE autosar_swc_val_CM_single 0 0 -3.4E+38 3.4E+38 ECU_ADDRESS 0xfe4ca21c /* @ECU_Address@SwcOut_FCM_DrivingHmiEnv.DynamicObjectList[4].objectPoseX@ */ /end MEASUREMENT
/begin MEASUREMENT SwcOut_FCM_DrivingHmiEnv.DynamicObjectList[4].objectPoseY "" FLOAT32_IEEE autosar_swc_val_CM_single 0 0 -3.4E+38 3.4E+38 ECU_ADDRESS 0xfe4ca220 /* @ECU_Address@SwcOut_FCM_DrivingHmiEnv.DynamicObjectList[4].objectPoseY@ */ /end MEASUREMENT
/begin MEASUREMENT SwcOut_FCM_DrivingHmiEnv.DynamicObjectList[4].objectType "" UBYTE autosar_swc_val_CM_uint8 0 0 0 255 ECU_ADDRESS 0xfe4ca219 /* @ECU_Address@SwcOut_FCM_DrivingHmiEnv.DynamicObjectList[4].objectType@ */ /end MEASUREMENT
/begin MEASUREMENT SwcOut_FCM_DrivingHmiEnv.DynamicObjectList[4].objectVelocityX "" FLOAT32_IEEE autosar_swc_val_CM_single 0 0 -3.4E+38 3.4E+38 ECU_ADDRESS 0xfe4ca22c /* @ECU_Address@SwcOut_FCM_DrivingHmiEnv.DynamicObjectList[4].objectVelocityX@ */ /end MEASUREMENT
/begin MEASUREMENT SwcOut_FCM_DrivingHmiEnv.DynamicObjectList[4].objectVelocityY "" FLOAT32_IEEE autosar_swc_val_CM_single 0 0 -3.4E+38 3.4E+38 ECU_ADDRESS 0xfe4ca230 /* @ECU_Address@SwcOut_FCM_DrivingHmiEnv.DynamicObjectList[4].objectVelocityY@ */ /end MEASUREMENT
/begin MEASUREMENT SwcOut_FCM_DrivingHmiEnv.DynamicObjectList[4].objectYaw "" FLOAT32_IEEE autosar_swc_val_CM_single 0 0 -3.4E+38 3.4E+38 ECU_ADDRESS 0xfe4ca224 /* @ECU_Address@SwcOut_FCM_DrivingHmiEnv.DynamicObjectList[4].objectYaw@ */ /end MEASUREMENT
/begin MEASUREMENT SwcOut_FCM_DrivingHmiEnv.DynamicObjectList[4].timestampnSec "" A_UINT64 autosar_swc_val_CM_uint64 0 0 0.0 1.844674407370955e+19 ECU_ADDRESS 0xfe4ca238 /* @ECU_Address@SwcOut_FCM_DrivingHmiEnv.DynamicObjectList[4].timestampnSec@ */ /end MEASUREMENT
/begin MEASUREMENT SwcOut_FCM_DrivingHmiEnv.DynamicObjectList[5].laneID "" SBYTE autosar_swc_val_CM_int8 0 0 -128 127 ECU_ADDRESS 0xfe4ca270 /* @ECU_Address@SwcOut_FCM_DrivingHmiEnv.DynamicObjectList[5].laneID@ */ /end MEASUREMENT
/begin MEASUREMENT SwcOut_FCM_DrivingHmiEnv.DynamicObjectList[5].lightStatus "" UBYTE autosar_swc_val_CM_uint8 0 0 0 255 ECU_ADDRESS 0xfe4ca24a /* @ECU_Address@SwcOut_FCM_DrivingHmiEnv.DynamicObjectList[5].lightStatus@ */ /end MEASUREMENT
/begin MEASUREMENT SwcOut_FCM_DrivingHmiEnv.DynamicObjectList[5].objectColor "" UBYTE autosar_swc_val_CM_uint8 0 0 0 255 ECU_ADDRESS 0xfe4ca258 /* @ECU_Address@SwcOut_FCM_DrivingHmiEnv.DynamicObjectList[5].objectColor@ */ /end MEASUREMENT
/begin MEASUREMENT SwcOut_FCM_DrivingHmiEnv.DynamicObjectList[5].objectId "" UBYTE autosar_swc_val_CM_uint8 0 0 0 255 ECU_ADDRESS 0xfe4ca248 /* @ECU_Address@SwcOut_FCM_DrivingHmiEnv.DynamicObjectList[5].objectId@ */ /end MEASUREMENT
/begin MEASUREMENT SwcOut_FCM_DrivingHmiEnv.DynamicObjectList[5].objectPoseX "" FLOAT32_IEEE autosar_swc_val_CM_single 0 0 -3.4E+38 3.4E+38 ECU_ADDRESS 0xfe4ca24c /* @ECU_Address@SwcOut_FCM_DrivingHmiEnv.DynamicObjectList[5].objectPoseX@ */ /end MEASUREMENT
/begin MEASUREMENT SwcOut_FCM_DrivingHmiEnv.DynamicObjectList[5].objectPoseY "" FLOAT32_IEEE autosar_swc_val_CM_single 0 0 -3.4E+38 3.4E+38 ECU_ADDRESS 0xfe4ca250 /* @ECU_Address@SwcOut_FCM_DrivingHmiEnv.DynamicObjectList[5].objectPoseY@ */ /end MEASUREMENT
/begin MEASUREMENT SwcOut_FCM_DrivingHmiEnv.DynamicObjectList[5].objectType "" UBYTE autosar_swc_val_CM_uint8 0 0 0 255 ECU_ADDRESS 0xfe4ca249 /* @ECU_Address@SwcOut_FCM_DrivingHmiEnv.DynamicObjectList[5].objectType@ */ /end MEASUREMENT
/begin MEASUREMENT SwcOut_FCM_DrivingHmiEnv.DynamicObjectList[5].objectVelocityX "" FLOAT32_IEEE autosar_swc_val_CM_single 0 0 -3.4E+38 3.4E+38 ECU_ADDRESS 0xfe4ca25c /* @ECU_Address@SwcOut_FCM_DrivingHmiEnv.DynamicObjectList[5].objectVelocityX@ */ /end MEASUREMENT
/begin MEASUREMENT SwcOut_FCM_DrivingHmiEnv.DynamicObjectList[5].objectVelocityY "" FLOAT32_IEEE autosar_swc_val_CM_single 0 0 -3.4E+38 3.4E+38 ECU_ADDRESS 0xfe4ca260 /* @ECU_Address@SwcOut_FCM_DrivingHmiEnv.DynamicObjectList[5].objectVelocityY@ */ /end MEASUREMENT
/begin MEASUREMENT SwcOut_FCM_DrivingHmiEnv.DynamicObjectList[5].objectYaw "" FLOAT32_IEEE autosar_swc_val_CM_single 0 0 -3.4E+38 3.4E+38 ECU_ADDRESS 0xfe4ca254 /* @ECU_Address@SwcOut_FCM_DrivingHmiEnv.DynamicObjectList[5].objectYaw@ */ /end MEASUREMENT
/begin MEASUREMENT SwcOut_FCM_DrivingHmiEnv.DynamicObjectList[5].timestampnSec "" A_UINT64 autosar_swc_val_CM_uint64 0 0 0.0 1.844674407370955e+19 ECU_ADDRESS 0xfe4ca268 /* @ECU_Address@SwcOut_FCM_DrivingHmiEnv.DynamicObjectList[5].timestampnSec@ */ /end MEASUREMENT
/begin MEASUREMENT SwcOut_FCM_DrivingHmiEnv.DynamicObjectList[6].laneID "" SBYTE autosar_swc_val_CM_int8 0 0 -128 127 ECU_ADDRESS 0xfe4ca2a0 /* @ECU_Address@SwcOut_FCM_DrivingHmiEnv.DynamicObjectList[6].laneID@ */ /end MEASUREMENT
/begin MEASUREMENT SwcOut_FCM_DrivingHmiEnv.DynamicObjectList[6].lightStatus "" UBYTE autosar_swc_val_CM_uint8 0 0 0 255 ECU_ADDRESS 0xfe4ca27a /* @ECU_Address@SwcOut_FCM_DrivingHmiEnv.DynamicObjectList[6].lightStatus@ */ /end MEASUREMENT
/begin MEASUREMENT SwcOut_FCM_DrivingHmiEnv.DynamicObjectList[6].objectColor "" UBYTE autosar_swc_val_CM_uint8 0 0 0 255 ECU_ADDRESS 0xfe4ca288 /* @ECU_Address@SwcOut_FCM_DrivingHmiEnv.DynamicObjectList[6].objectColor@ */ /end MEASUREMENT
/begin MEASUREMENT SwcOut_FCM_DrivingHmiEnv.DynamicObjectList[6].objectId "" UBYTE autosar_swc_val_CM_uint8 0 0 0 255 ECU_ADDRESS 0xfe4ca278 /* @ECU_Address@SwcOut_FCM_DrivingHmiEnv.DynamicObjectList[6].objectId@ */ /end MEASUREMENT
/begin MEASUREMENT SwcOut_FCM_DrivingHmiEnv.DynamicObjectList[6].objectPoseX "" FLOAT32_IEEE autosar_swc_val_CM_single 0 0 -3.4E+38 3.4E+38 ECU_ADDRESS 0xfe4ca27c /* @ECU_Address@SwcOut_FCM_DrivingHmiEnv.DynamicObjectList[6].objectPoseX@ */ /end MEASUREMENT
/begin MEASUREMENT SwcOut_FCM_DrivingHmiEnv.DynamicObjectList[6].objectPoseY "" FLOAT32_IEEE autosar_swc_val_CM_single 0 0 -3.4E+38 3.4E+38 ECU_ADDRESS 0xfe4ca280 /* @ECU_Address@SwcOut_FCM_DrivingHmiEnv.DynamicObjectList[6].objectPoseY@ */ /end MEASUREMENT
/begin MEASUREMENT SwcOut_FCM_DrivingHmiEnv.DynamicObjectList[6].objectType "" UBYTE autosar_swc_val_CM_uint8 0 0 0 255 ECU_ADDRESS 0xfe4ca279 /* @ECU_Address@SwcOut_FCM_DrivingHmiEnv.DynamicObjectList[6].objectType@ */ /end MEASUREMENT
/begin MEASUREMENT SwcOut_FCM_DrivingHmiEnv.DynamicObjectList[6].objectVelocityX "" FLOAT32_IEEE autosar_swc_val_CM_single 0 0 -3.4E+38 3.4E+38 ECU_ADDRESS 0xfe4ca28c /* @ECU_Address@SwcOut_FCM_DrivingHmiEnv.DynamicObjectList[6].objectVelocityX@ */ /end MEASUREMENT
/begin MEASUREMENT SwcOut_FCM_DrivingHmiEnv.DynamicObjectList[6].objectVelocityY "" FLOAT32_IEEE autosar_swc_val_CM_single 0 0 -3.4E+38 3.4E+38 ECU_ADDRESS 0xfe4ca290 /* @ECU_Address@SwcOut_FCM_DrivingHmiEnv.DynamicObjectList[6].objectVelocityY@ */ /end MEASUREMENT
/begin MEASUREMENT SwcOut_FCM_DrivingHmiEnv.DynamicObjectList[6].objectYaw "" FLOAT32_IEEE autosar_swc_val_CM_single 0 0 -3.4E+38 3.4E+38 ECU_ADDRESS 0xfe4ca284 /* @ECU_Address@SwcOut_FCM_DrivingHmiEnv.DynamicObjectList[6].objectYaw@ */ /end MEASUREMENT
/begin MEASUREMENT SwcOut_FCM_DrivingHmiEnv.DynamicObjectList[6].timestampnSec "" A_UINT64 autosar_swc_val_CM_uint64 0 0 0.0 1.844674407370955e+19 ECU_ADDRESS 0xfe4ca298 /* @ECU_Address@SwcOut_FCM_DrivingHmiEnv.DynamicObjectList[6].timestampnSec@ */ /end MEASUREMENT
/begin MEASUREMENT SwcOut_FCM_DrivingHmiEnv.DynamicObjectList[7].laneID "" SBYTE autosar_swc_val_CM_int8 0 0 -128 127 ECU_ADDRESS 0xfe4ca2d0 /* @ECU_Address@SwcOut_FCM_DrivingHmiEnv.DynamicObjectList[7].laneID@ */ /end MEASUREMENT
/begin MEASUREMENT SwcOut_FCM_DrivingHmiEnv.DynamicObjectList[7].lightStatus "" UBYTE autosar_swc_val_CM_uint8 0 0 0 255 ECU_ADDRESS 0xfe4ca2aa /* @ECU_Address@SwcOut_FCM_DrivingHmiEnv.DynamicObjectList[7].lightStatus@ */ /end MEASUREMENT
/begin MEASUREMENT SwcOut_FCM_DrivingHmiEnv.DynamicObjectList[7].objectColor "" UBYTE autosar_swc_val_CM_uint8 0 0 0 255 ECU_ADDRESS 0xfe4ca2b8 /* @ECU_Address@SwcOut_FCM_DrivingHmiEnv.DynamicObjectList[7].objectColor@ */ /end MEASUREMENT
/begin MEASUREMENT SwcOut_FCM_DrivingHmiEnv.DynamicObjectList[7].objectId "" UBYTE autosar_swc_val_CM_uint8 0 0 0 255 ECU_ADDRESS 0xfe4ca2a8 /* @ECU_Address@SwcOut_FCM_DrivingHmiEnv.DynamicObjectList[7].objectId@ */ /end MEASUREMENT
/begin MEASUREMENT SwcOut_FCM_DrivingHmiEnv.DynamicObjectList[7].objectPoseX "" FLOAT32_IEEE autosar_swc_val_CM_single 0 0 -3.4E+38 3.4E+38 ECU_ADDRESS 0xfe4ca2ac /* @ECU_Address@SwcOut_FCM_DrivingHmiEnv.DynamicObjectList[7].objectPoseX@ */ /end MEASUREMENT
/begin MEASUREMENT SwcOut_FCM_DrivingHmiEnv.DynamicObjectList[7].objectPoseY "" FLOAT32_IEEE autosar_swc_val_CM_single 0 0 -3.4E+38 3.4E+38 ECU_ADDRESS 0xfe4ca2b0 /* @ECU_Address@SwcOut_FCM_DrivingHmiEnv.DynamicObjectList[7].objectPoseY@ */ /end MEASUREMENT
/begin MEASUREMENT SwcOut_FCM_DrivingHmiEnv.DynamicObjectList[7].objectType "" UBYTE autosar_swc_val_CM_uint8 0 0 0 255 ECU_ADDRESS 0xfe4ca2a9 /* @ECU_Address@SwcOut_FCM_DrivingHmiEnv.DynamicObjectList[7].objectType@ */ /end MEASUREMENT
/begin MEASUREMENT SwcOut_FCM_DrivingHmiEnv.DynamicObjectList[7].objectVelocityX "" FLOAT32_IEEE autosar_swc_val_CM_single 0 0 -3.4E+38 3.4E+38 ECU_ADDRESS 0xfe4ca2bc /* @ECU_Address@SwcOut_FCM_DrivingHmiEnv.DynamicObjectList[7].objectVelocityX@ */ /end MEASUREMENT
/begin MEASUREMENT SwcOut_FCM_DrivingHmiEnv.DynamicObjectList[7].objectVelocityY "" FLOAT32_IEEE autosar_swc_val_CM_single 0 0 -3.4E+38 3.4E+38 ECU_ADDRESS 0xfe4ca2c0 /* @ECU_Address@SwcOut_FCM_DrivingHmiEnv.DynamicObjectList[7].objectVelocityY@ */ /end MEASUREMENT
/begin MEASUREMENT SwcOut_FCM_DrivingHmiEnv.DynamicObjectList[7].objectYaw "" FLOAT32_IEEE autosar_swc_val_CM_single 0 0 -3.4E+38 3.4E+38 ECU_ADDRESS 0xfe4ca2b4 /* @ECU_Address@SwcOut_FCM_DrivingHmiEnv.DynamicObjectList[7].objectYaw@ */ /end MEASUREMENT
/begin MEASUREMENT SwcOut_FCM_DrivingHmiEnv.DynamicObjectList[7].timestampnSec "" A_UINT64 autosar_swc_val_CM_uint64 0 0 0.0 1.844674407370955e+19 ECU_ADDRESS 0xfe4ca2c8 /* @ECU_Address@SwcOut_FCM_DrivingHmiEnv.DynamicObjectList[7].timestampnSec@ */ /end MEASUREMENT
/begin MEASUREMENT SwcOut_FCM_DrivingHmiEnv.DynamicObjectList[8].laneID "" SBYTE autosar_swc_val_CM_int8 0 0 -128 127 ECU_ADDRESS 0xfe4ca300 /* @ECU_Address@SwcOut_FCM_DrivingHmiEnv.DynamicObjectList[8].laneID@ */ /end MEASUREMENT
/begin MEASUREMENT SwcOut_FCM_DrivingHmiEnv.DynamicObjectList[8].lightStatus "" UBYTE autosar_swc_val_CM_uint8 0 0 0 255 ECU_ADDRESS 0xfe4ca2da /* @ECU_Address@SwcOut_FCM_DrivingHmiEnv.DynamicObjectList[8].lightStatus@ */ /end MEASUREMENT
/begin MEASUREMENT SwcOut_FCM_DrivingHmiEnv.DynamicObjectList[8].objectColor "" UBYTE autosar_swc_val_CM_uint8 0 0 0 255 ECU_ADDRESS 0xfe4ca2e8 /* @ECU_Address@SwcOut_FCM_DrivingHmiEnv.DynamicObjectList[8].objectColor@ */ /end MEASUREMENT
/begin MEASUREMENT SwcOut_FCM_DrivingHmiEnv.DynamicObjectList[8].objectId "" UBYTE autosar_swc_val_CM_uint8 0 0 0 255 ECU_ADDRESS 0xfe4ca2d8 /* @ECU_Address@SwcOut_FCM_DrivingHmiEnv.DynamicObjectList[8].objectId@ */ /end MEASUREMENT
/begin MEASUREMENT SwcOut_FCM_DrivingHmiEnv.DynamicObjectList[8].objectPoseX "" FLOAT32_IEEE autosar_swc_val_CM_single 0 0 -3.4E+38 3.4E+38 ECU_ADDRESS 0xfe4ca2dc /* @ECU_Address@SwcOut_FCM_DrivingHmiEnv.DynamicObjectList[8].objectPoseX@ */ /end MEASUREMENT
/begin MEASUREMENT SwcOut_FCM_DrivingHmiEnv.DynamicObjectList[8].objectPoseY "" FLOAT32_IEEE autosar_swc_val_CM_single 0 0 -3.4E+38 3.4E+38 ECU_ADDRESS 0xfe4ca2e0 /* @ECU_Address@SwcOut_FCM_DrivingHmiEnv.DynamicObjectList[8].objectPoseY@ */ /end MEASUREMENT
/begin MEASUREMENT SwcOut_FCM_DrivingHmiEnv.DynamicObjectList[8].objectType "" UBYTE autosar_swc_val_CM_uint8 0 0 0 255 ECU_ADDRESS 0xfe4ca2d9 /* @ECU_Address@SwcOut_FCM_DrivingHmiEnv.DynamicObjectList[8].objectType@ */ /end MEASUREMENT
/begin MEASUREMENT SwcOut_FCM_DrivingHmiEnv.DynamicObjectList[8].objectVelocityX "" FLOAT32_IEEE autosar_swc_val_CM_single 0 0 -3.4E+38 3.4E+38 ECU_ADDRESS 0xfe4ca2ec /* @ECU_Address@SwcOut_FCM_DrivingHmiEnv.DynamicObjectList[8].objectVelocityX@ */ /end MEASUREMENT
/begin MEASUREMENT SwcOut_FCM_DrivingHmiEnv.DynamicObjectList[8].objectVelocityY "" FLOAT32_IEEE autosar_swc_val_CM_single 0 0 -3.4E+38 3.4E+38 ECU_ADDRESS 0xfe4ca2f0 /* @ECU_Address@SwcOut_FCM_DrivingHmiEnv.DynamicObjectList[8].objectVelocityY@ */ /end MEASUREMENT
/begin MEASUREMENT SwcOut_FCM_DrivingHmiEnv.DynamicObjectList[8].objectYaw "" FLOAT32_IEEE autosar_swc_val_CM_single 0 0 -3.4E+38 3.4E+38 ECU_ADDRESS 0xfe4ca2e4 /* @ECU_Address@SwcOut_FCM_DrivingHmiEnv.DynamicObjectList[8].objectYaw@ */ /end MEASUREMENT
/begin MEASUREMENT SwcOut_FCM_DrivingHmiEnv.DynamicObjectList[8].timestampnSec "" A_UINT64 autosar_swc_val_CM_uint64 0 0 0.0 1.844674407370955e+19 ECU_ADDRESS 0xfe4ca2f8 /* @ECU_Address@SwcOut_FCM_DrivingHmiEnv.DynamicObjectList[8].timestampnSec@ */ /end MEASUREMENT
/begin MEASUREMENT SwcOut_FCM_DrivingHmiEnv.DynamicObjectList[9].laneID "" SBYTE autosar_swc_val_CM_int8 0 0 -128 127 ECU_ADDRESS 0xfe4ca330 /* @ECU_Address@SwcOut_FCM_DrivingHmiEnv.DynamicObjectList[9].laneID@ */ /end MEASUREMENT
/begin MEASUREMENT SwcOut_FCM_DrivingHmiEnv.DynamicObjectList[9].lightStatus "" UBYTE autosar_swc_val_CM_uint8 0 0 0 255 ECU_ADDRESS 0xfe4ca30a /* @ECU_Address@SwcOut_FCM_DrivingHmiEnv.DynamicObjectList[9].lightStatus@ */ /end MEASUREMENT
/begin MEASUREMENT SwcOut_FCM_DrivingHmiEnv.DynamicObjectList[9].objectColor "" UBYTE autosar_swc_val_CM_uint8 0 0 0 255 ECU_ADDRESS 0xfe4ca318 /* @ECU_Address@SwcOut_FCM_DrivingHmiEnv.DynamicObjectList[9].objectColor@ */ /end MEASUREMENT
/begin MEASUREMENT SwcOut_FCM_DrivingHmiEnv.DynamicObjectList[9].objectId "" UBYTE autosar_swc_val_CM_uint8 0 0 0 255 ECU_ADDRESS 0xfe4ca308 /* @ECU_Address@SwcOut_FCM_DrivingHmiEnv.DynamicObjectList[9].objectId@ */ /end MEASUREMENT
/begin MEASUREMENT SwcOut_FCM_DrivingHmiEnv.DynamicObjectList[9].objectPoseX "" FLOAT32_IEEE autosar_swc_val_CM_single 0 0 -3.4E+38 3.4E+38 ECU_ADDRESS 0xfe4ca30c /* @ECU_Address@SwcOut_FCM_DrivingHmiEnv.DynamicObjectList[9].objectPoseX@ */ /end MEASUREMENT
/begin MEASUREMENT SwcOut_FCM_DrivingHmiEnv.DynamicObjectList[9].objectPoseY "" FLOAT32_IEEE autosar_swc_val_CM_single 0 0 -3.4E+38 3.4E+38 ECU_ADDRESS 0xfe4ca310 /* @ECU_Address@SwcOut_FCM_DrivingHmiEnv.DynamicObjectList[9].objectPoseY@ */ /end MEASUREMENT
/begin MEASUREMENT SwcOut_FCM_DrivingHmiEnv.DynamicObjectList[9].objectType "" UBYTE autosar_swc_val_CM_uint8 0 0 0 255 ECU_ADDRESS 0xfe4ca309 /* @ECU_Address@SwcOut_FCM_DrivingHmiEnv.DynamicObjectList[9].objectType@ */ /end MEASUREMENT
/begin MEASUREMENT SwcOut_FCM_DrivingHmiEnv.DynamicObjectList[9].objectVelocityX "" FLOAT32_IEEE autosar_swc_val_CM_single 0 0 -3.4E+38 3.4E+38 ECU_ADDRESS 0xfe4ca31c /* @ECU_Address@SwcOut_FCM_DrivingHmiEnv.DynamicObjectList[9].objectVelocityX@ */ /end MEASUREMENT
/begin MEASUREMENT SwcOut_FCM_DrivingHmiEnv.DynamicObjectList[9].objectVelocityY "" FLOAT32_IEEE autosar_swc_val_CM_single 0 0 -3.4E+38 3.4E+38 ECU_ADDRESS 0xfe4ca320 /* @ECU_Address@SwcOut_FCM_DrivingHmiEnv.DynamicObjectList[9].objectVelocityY@ */ /end MEASUREMENT
/begin MEASUREMENT SwcOut_FCM_DrivingHmiEnv.DynamicObjectList[9].objectYaw "" FLOAT32_IEEE autosar_swc_val_CM_single 0 0 -3.4E+38 3.4E+38 ECU_ADDRESS 0xfe4ca314 /* @ECU_Address@SwcOut_FCM_DrivingHmiEnv.DynamicObjectList[9].objectYaw@ */ /end MEASUREMENT
/begin MEASUREMENT SwcOut_FCM_DrivingHmiEnv.DynamicObjectList[9].timestampnSec "" A_UINT64 autosar_swc_val_CM_uint64 0 0 0.0 1.844674407370955e+19 ECU_ADDRESS 0xfe4ca328 /* @ECU_Address@SwcOut_FCM_DrivingHmiEnv.DynamicObjectList[9].timestampnSec@ */ /end MEASUREMENT
/begin MEASUREMENT SwcOut_FCM_DrivingHmiEnv.LaneLineList_2[1].laneLineWidth "" FLOAT32_IEEE autosar_swc_val_CM_single 0 0 -3.4E+38 3.4E+38 ECU_ADDRESS 0xfe4ca504 /* @ECU_Address@SwcOut_FCM_DrivingHmiEnv.LaneLineList_2[1].laneLineWidth@ */ /end MEASUREMENT
/begin MEASUREMENT SwcOut_FCM_DrivingHmiEnv.LaneLineList_2[1].lineColor "" UBYTE autosar_swc_val_CM_uint8 0 0 0 255 ECU_ADDRESS 0xfe4ca4f2 /* @ECU_Address@SwcOut_FCM_DrivingHmiEnv.LaneLineList_2[1].lineColor@ */ /end MEASUREMENT
/begin MEASUREMENT SwcOut_FCM_DrivingHmiEnv.LaneLineList_2[1].lineEnd_X "" FLOAT32_IEEE autosar_swc_val_CM_single 0 0 -3.4E+38 3.4E+38 ECU_ADDRESS 0xfe4ca510 /* @ECU_Address@SwcOut_FCM_DrivingHmiEnv.LaneLineList_2[1].lineEnd_X@ */ /end MEASUREMENT
/begin MEASUREMENT SwcOut_FCM_DrivingHmiEnv.LaneLineList_2[1].lineEnd_Y "" FLOAT32_IEEE autosar_swc_val_CM_single 0 0 -3.4E+38 3.4E+38 ECU_ADDRESS 0xfe4ca514 /* @ECU_Address@SwcOut_FCM_DrivingHmiEnv.LaneLineList_2[1].lineEnd_Y@ */ /end MEASUREMENT
/begin MEASUREMENT SwcOut_FCM_DrivingHmiEnv.LaneLineList_2[1].lineEquation_C0 "" FLOAT32_IEEE autosar_swc_val_CM_single 0 0 -3.4E+38 3.4E+38 ECU_ADDRESS 0xfe4ca4f4 /* @ECU_Address@SwcOut_FCM_DrivingHmiEnv.LaneLineList_2[1].lineEquation_C0@ */ /end MEASUREMENT
/begin MEASUREMENT SwcOut_FCM_DrivingHmiEnv.LaneLineList_2[1].lineEquation_C1 "" FLOAT32_IEEE autosar_swc_val_CM_single 0 0 -3.4E+38 3.4E+38 ECU_ADDRESS 0xfe4ca4f8 /* @ECU_Address@SwcOut_FCM_DrivingHmiEnv.LaneLineList_2[1].lineEquation_C1@ */ /end MEASUREMENT
/begin MEASUREMENT SwcOut_FCM_DrivingHmiEnv.LaneLineList_2[1].lineEquation_C2 "" FLOAT32_IEEE autosar_swc_val_CM_single 0 0 -3.4E+38 3.4E+38 ECU_ADDRESS 0xfe4ca4fc /* @ECU_Address@SwcOut_FCM_DrivingHmiEnv.LaneLineList_2[1].lineEquation_C2@ */ /end MEASUREMENT
/begin MEASUREMENT SwcOut_FCM_DrivingHmiEnv.LaneLineList_2[1].lineEquation_C3 "" FLOAT32_IEEE autosar_swc_val_CM_single 0 0 -3.4E+38 3.4E+38 ECU_ADDRESS 0xfe4ca500 /* @ECU_Address@SwcOut_FCM_DrivingHmiEnv.LaneLineList_2[1].lineEquation_C3@ */ /end MEASUREMENT
/begin MEASUREMENT SwcOut_FCM_DrivingHmiEnv.LaneLineList_2[1].lineId "" UBYTE autosar_swc_val_CM_uint8 0 0 0 255 ECU_ADDRESS 0xfe4ca4f1 /* @ECU_Address@SwcOut_FCM_DrivingHmiEnv.LaneLineList_2[1].lineId@ */ /end MEASUREMENT
/begin MEASUREMENT SwcOut_FCM_DrivingHmiEnv.LaneLineList_2[1].lineIndex "" UBYTE autosar_swc_val_CM_uint8 0 0 0 255 ECU_ADDRESS 0xfe4ca4f0 /* @ECU_Address@SwcOut_FCM_DrivingHmiEnv.LaneLineList_2[1].lineIndex@ */ /end MEASUREMENT
/begin MEASUREMENT SwcOut_FCM_DrivingHmiEnv.LaneLineList_2[1].lineStart_X "" FLOAT32_IEEE autosar_swc_val_CM_single 0 0 -3.4E+38 3.4E+38 ECU_ADDRESS 0xfe4ca508 /* @ECU_Address@SwcOut_FCM_DrivingHmiEnv.LaneLineList_2[1].lineStart_X@ */ /end MEASUREMENT
/begin MEASUREMENT SwcOut_FCM_DrivingHmiEnv.LaneLineList_2[1].lineStart_Y "" FLOAT32_IEEE autosar_swc_val_CM_single 0 0 -3.4E+38 3.4E+38 ECU_ADDRESS 0xfe4ca50c /* @ECU_Address@SwcOut_FCM_DrivingHmiEnv.LaneLineList_2[1].lineStart_Y@ */ /end MEASUREMENT
/begin MEASUREMENT SwcOut_FCM_DrivingHmiEnv.LaneLineList_2[1].lineType "" UBYTE autosar_swc_val_CM_uint8 0 0 0 255 ECU_ADDRESS 0xfe4ca4f3 /* @ECU_Address@SwcOut_FCM_DrivingHmiEnv.LaneLineList_2[1].lineType@ */ /end MEASUREMENT
/begin MEASUREMENT SwcOut_FCM_DrivingHmiEnv.LaneLineList_2[2].laneLineWidth "" FLOAT32_IEEE autosar_swc_val_CM_single 0 0 -3.4E+38 3.4E+38 ECU_ADDRESS 0xfe4ca52c /* @ECU_Address@SwcOut_FCM_DrivingHmiEnv.LaneLineList_2[2].laneLineWidth@ */ /end MEASUREMENT
/begin MEASUREMENT SwcOut_FCM_DrivingHmiEnv.LaneLineList_2[2].lineColor "" UBYTE autosar_swc_val_CM_uint8 0 0 0 255 ECU_ADDRESS 0xfe4ca51a /* @ECU_Address@SwcOut_FCM_DrivingHmiEnv.LaneLineList_2[2].lineColor@ */ /end MEASUREMENT
/begin MEASUREMENT SwcOut_FCM_DrivingHmiEnv.LaneLineList_2[2].lineEnd_X "" FLOAT32_IEEE autosar_swc_val_CM_single 0 0 -3.4E+38 3.4E+38 ECU_ADDRESS 0xfe4ca538 /* @ECU_Address@SwcOut_FCM_DrivingHmiEnv.LaneLineList_2[2].lineEnd_X@ */ /end MEASUREMENT
/begin MEASUREMENT SwcOut_FCM_DrivingHmiEnv.LaneLineList_2[2].lineEnd_Y "" FLOAT32_IEEE autosar_swc_val_CM_single 0 0 -3.4E+38 3.4E+38 ECU_ADDRESS 0xfe4ca53c /* @ECU_Address@SwcOut_FCM_DrivingHmiEnv.LaneLineList_2[2].lineEnd_Y@ */ /end MEASUREMENT
/begin MEASUREMENT SwcOut_FCM_DrivingHmiEnv.LaneLineList_2[2].lineEquation_C0 "" FLOAT32_IEEE autosar_swc_val_CM_single 0 0 -3.4E+38 3.4E+38 ECU_ADDRESS 0xfe4ca51c /* @ECU_Address@SwcOut_FCM_DrivingHmiEnv.LaneLineList_2[2].lineEquation_C0@ */ /end MEASUREMENT
/begin MEASUREMENT SwcOut_FCM_DrivingHmiEnv.LaneLineList_2[2].lineEquation_C1 "" FLOAT32_IEEE autosar_swc_val_CM_single 0 0 -3.4E+38 3.4E+38 ECU_ADDRESS 0xfe4ca520 /* @ECU_Address@SwcOut_FCM_DrivingHmiEnv.LaneLineList_2[2].lineEquation_C1@ */ /end MEASUREMENT
/begin MEASUREMENT SwcOut_FCM_DrivingHmiEnv.LaneLineList_2[2].lineEquation_C2 "" FLOAT32_IEEE autosar_swc_val_CM_single 0 0 -3.4E+38 3.4E+38 ECU_ADDRESS 0xfe4ca524 /* @ECU_Address@SwcOut_FCM_DrivingHmiEnv.LaneLineList_2[2].lineEquation_C2@ */ /end MEASUREMENT
/begin MEASUREMENT SwcOut_FCM_DrivingHmiEnv.LaneLineList_2[2].lineEquation_C3 "" FLOAT32_IEEE autosar_swc_val_CM_single 0 0 -3.4E+38 3.4E+38 ECU_ADDRESS 0xfe4ca528 /* @ECU_Address@SwcOut_FCM_DrivingHmiEnv.LaneLineList_2[2].lineEquation_C3@ */ /end MEASUREMENT
/begin MEASUREMENT SwcOut_FCM_DrivingHmiEnv.LaneLineList_2[2].lineId "" UBYTE autosar_swc_val_CM_uint8 0 0 0 255 ECU_ADDRESS 0xfe4ca519 /* @ECU_Address@SwcOut_FCM_DrivingHmiEnv.LaneLineList_2[2].lineId@ */ /end MEASUREMENT
/begin MEASUREMENT SwcOut_FCM_DrivingHmiEnv.LaneLineList_2[2].lineIndex "" UBYTE autosar_swc_val_CM_uint8 0 0 0 255 ECU_ADDRESS 0xfe4ca518 /* @ECU_Address@SwcOut_FCM_DrivingHmiEnv.LaneLineList_2[2].lineIndex@ */ /end MEASUREMENT
/begin MEASUREMENT SwcOut_FCM_DrivingHmiEnv.LaneLineList_2[2].lineStart_X "" FLOAT32_IEEE autosar_swc_val_CM_single 0 0 -3.4E+38 3.4E+38 ECU_ADDRESS 0xfe4ca530 /* @ECU_Address@SwcOut_FCM_DrivingHmiEnv.LaneLineList_2[2].lineStart_X@ */ /end MEASUREMENT
/begin MEASUREMENT SwcOut_FCM_DrivingHmiEnv.LaneLineList_2[2].lineStart_Y "" FLOAT32_IEEE autosar_swc_val_CM_single 0 0 -3.4E+38 3.4E+38 ECU_ADDRESS 0xfe4ca534 /* @ECU_Address@SwcOut_FCM_DrivingHmiEnv.LaneLineList_2[2].lineStart_Y@ */ /end MEASUREMENT
/begin MEASUREMENT SwcOut_FCM_DrivingHmiEnv.LaneLineList_2[2].lineType "" UBYTE autosar_swc_val_CM_uint8 0 0 0 255 ECU_ADDRESS 0xfe4ca51b /* @ECU_Address@SwcOut_FCM_DrivingHmiEnv.LaneLineList_2[2].lineType@ */ /end MEASUREMENT
/begin MEASUREMENT SwcOut_FCM_DrivingHmiEnv.LaneLineList_2[3].laneLineWidth "" FLOAT32_IEEE autosar_swc_val_CM_single 0 0 -3.4E+38 3.4E+38 ECU_ADDRESS 0xfe4ca554 /* @ECU_Address@SwcOut_FCM_DrivingHmiEnv.LaneLineList_2[3].laneLineWidth@ */ /end MEASUREMENT
/begin MEASUREMENT SwcOut_FCM_DrivingHmiEnv.LaneLineList_2[3].lineColor "" UBYTE autosar_swc_val_CM_uint8 0 0 0 255 ECU_ADDRESS 0xfe4ca542 /* @ECU_Address@SwcOut_FCM_DrivingHmiEnv.LaneLineList_2[3].lineColor@ */ /end MEASUREMENT
/begin MEASUREMENT SwcOut_FCM_DrivingHmiEnv.LaneLineList_2[3].lineEnd_X "" FLOAT32_IEEE autosar_swc_val_CM_single 0 0 -3.4E+38 3.4E+38 ECU_ADDRESS 0xfe4ca560 /* @ECU_Address@SwcOut_FCM_DrivingHmiEnv.LaneLineList_2[3].lineEnd_X@ */ /end MEASUREMENT
/begin MEASUREMENT SwcOut_FCM_DrivingHmiEnv.LaneLineList_2[3].lineEnd_Y "" FLOAT32_IEEE autosar_swc_val_CM_single 0 0 -3.4E+38 3.4E+38 ECU_ADDRESS 0xfe4ca564 /* @ECU_Address@SwcOut_FCM_DrivingHmiEnv.LaneLineList_2[3].lineEnd_Y@ */ /end MEASUREMENT
/begin MEASUREMENT SwcOut_FCM_DrivingHmiEnv.LaneLineList_2[3].lineEquation_C0 "" FLOAT32_IEEE autosar_swc_val_CM_single 0 0 -3.4E+38 3.4E+38 ECU_ADDRESS 0xfe4ca544 /* @ECU_Address@SwcOut_FCM_DrivingHmiEnv.LaneLineList_2[3].lineEquation_C0@ */ /end MEASUREMENT
/begin MEASUREMENT SwcOut_FCM_DrivingHmiEnv.LaneLineList_2[3].lineEquation_C1 "" FLOAT32_IEEE autosar_swc_val_CM_single 0 0 -3.4E+38 3.4E+38 ECU_ADDRESS 0xfe4ca548 /* @ECU_Address@SwcOut_FCM_DrivingHmiEnv.LaneLineList_2[3].lineEquation_C1@ */ /end MEASUREMENT
/begin MEASUREMENT SwcOut_FCM_DrivingHmiEnv.LaneLineList_2[3].lineEquation_C2 "" FLOAT32_IEEE autosar_swc_val_CM_single 0 0 -3.4E+38 3.4E+38 ECU_ADDRESS 0xfe4ca54c /* @ECU_Address@SwcOut_FCM_DrivingHmiEnv.LaneLineList_2[3].lineEquation_C2@ */ /end MEASUREMENT
/begin MEASUREMENT SwcOut_FCM_DrivingHmiEnv.LaneLineList_2[3].lineEquation_C3 "" FLOAT32_IEEE autosar_swc_val_CM_single 0 0 -3.4E+38 3.4E+38 ECU_ADDRESS 0xfe4ca550 /* @ECU_Address@SwcOut_FCM_DrivingHmiEnv.LaneLineList_2[3].lineEquation_C3@ */ /end MEASUREMENT
/begin MEASUREMENT SwcOut_FCM_DrivingHmiEnv.LaneLineList_2[3].lineId "" UBYTE autosar_swc_val_CM_uint8 0 0 0 255 ECU_ADDRESS 0xfe4ca541 /* @ECU_Address@SwcOut_FCM_DrivingHmiEnv.LaneLineList_2[3].lineId@ */ /end MEASUREMENT
/begin MEASUREMENT SwcOut_FCM_DrivingHmiEnv.LaneLineList_2[3].lineIndex "" UBYTE autosar_swc_val_CM_uint8 0 0 0 255 ECU_ADDRESS 0xfe4ca540 /* @ECU_Address@SwcOut_FCM_DrivingHmiEnv.LaneLineList_2[3].lineIndex@ */ /end MEASUREMENT
/begin MEASUREMENT SwcOut_FCM_DrivingHmiEnv.LaneLineList_2[3].lineStart_X "" FLOAT32_IEEE autosar_swc_val_CM_single 0 0 -3.4E+38 3.4E+38 ECU_ADDRESS 0xfe4ca558 /* @ECU_Address@SwcOut_FCM_DrivingHmiEnv.LaneLineList_2[3].lineStart_X@ */ /end MEASUREMENT
/begin MEASUREMENT SwcOut_FCM_DrivingHmiEnv.LaneLineList_2[3].lineStart_Y "" FLOAT32_IEEE autosar_swc_val_CM_single 0 0 -3.4E+38 3.4E+38 ECU_ADDRESS 0xfe4ca55c /* @ECU_Address@SwcOut_FCM_DrivingHmiEnv.LaneLineList_2[3].lineStart_Y@ */ /end MEASUREMENT
/begin MEASUREMENT SwcOut_FCM_DrivingHmiEnv.LaneLineList_2[3].lineType "" UBYTE autosar_swc_val_CM_uint8 0 0 0 255 ECU_ADDRESS 0xfe4ca543 /* @ECU_Address@SwcOut_FCM_DrivingHmiEnv.LaneLineList_2[3].lineType@ */ /end MEASUREMENT
/begin MEASUREMENT SwcOut_FCM_DrivingHmiEnv.LaneLineList_2[4].laneLineWidth "" FLOAT32_IEEE autosar_swc_val_CM_single 0 0 -3.4E+38 3.4E+38 ECU_ADDRESS 0xfe4ca57c /* @ECU_Address@SwcOut_FCM_DrivingHmiEnv.LaneLineList_2[4].laneLineWidth@ */ /end MEASUREMENT
/begin MEASUREMENT SwcOut_FCM_DrivingHmiEnv.LaneLineList_2[4].lineColor "" UBYTE autosar_swc_val_CM_uint8 0 0 0 255 ECU_ADDRESS 0xfe4ca56a /* @ECU_Address@SwcOut_FCM_DrivingHmiEnv.LaneLineList_2[4].lineColor@ */ /end MEASUREMENT
/begin MEASUREMENT SwcOut_FCM_DrivingHmiEnv.LaneLineList_2[4].lineEnd_X "" FLOAT32_IEEE autosar_swc_val_CM_single 0 0 -3.4E+38 3.4E+38 ECU_ADDRESS 0xfe4ca588 /* @ECU_Address@SwcOut_FCM_DrivingHmiEnv.LaneLineList_2[4].lineEnd_X@ */ /end MEASUREMENT
/begin MEASUREMENT SwcOut_FCM_DrivingHmiEnv.LaneLineList_2[4].lineEnd_Y "" FLOAT32_IEEE autosar_swc_val_CM_single 0 0 -3.4E+38 3.4E+38 ECU_ADDRESS 0xfe4ca58c /* @ECU_Address@SwcOut_FCM_DrivingHmiEnv.LaneLineList_2[4].lineEnd_Y@ */ /end MEASUREMENT
/begin MEASUREMENT SwcOut_FCM_DrivingHmiEnv.LaneLineList_2[4].lineEquation_C0 "" FLOAT32_IEEE autosar_swc_val_CM_single 0 0 -3.4E+38 3.4E+38 ECU_ADDRESS 0xfe4ca56c /* @ECU_Address@SwcOut_FCM_DrivingHmiEnv.LaneLineList_2[4].lineEquation_C0@ */ /end MEASUREMENT
/begin MEASUREMENT SwcOut_FCM_DrivingHmiEnv.LaneLineList_2[4].lineEquation_C1 "" FLOAT32_IEEE autosar_swc_val_CM_single 0 0 -3.4E+38 3.4E+38 ECU_ADDRESS 0xfe4ca570 /* @ECU_Address@SwcOut_FCM_DrivingHmiEnv.LaneLineList_2[4].lineEquation_C1@ */ /end MEASUREMENT
/begin MEASUREMENT SwcOut_FCM_DrivingHmiEnv.LaneLineList_2[4].lineEquation_C2 "" FLOAT32_IEEE autosar_swc_val_CM_single 0 0 -3.4E+38 3.4E+38 ECU_ADDRESS 0xfe4ca574 /* @ECU_Address@SwcOut_FCM_DrivingHmiEnv.LaneLineList_2[4].lineEquation_C2@ */ /end MEASUREMENT
/begin MEASUREMENT SwcOut_FCM_DrivingHmiEnv.LaneLineList_2[4].lineEquation_C3 "" FLOAT32_IEEE autosar_swc_val_CM_single 0 0 -3.4E+38 3.4E+38 ECU_ADDRESS 0xfe4ca578 /* @ECU_Address@SwcOut_FCM_DrivingHmiEnv.LaneLineList_2[4].lineEquation_C3@ */ /end MEASUREMENT
/begin MEASUREMENT SwcOut_FCM_DrivingHmiEnv.LaneLineList_2[4].lineId "" UBYTE autosar_swc_val_CM_uint8 0 0 0 255 ECU_ADDRESS 0xfe4ca569 /* @ECU_Address@SwcOut_FCM_DrivingHmiEnv.LaneLineList_2[4].lineId@ */ /end MEASUREMENT
/begin MEASUREMENT SwcOut_FCM_DrivingHmiEnv.LaneLineList_2[4].lineIndex "" UBYTE autosar_swc_val_CM_uint8 0 0 0 255 ECU_ADDRESS 0xfe4ca568 /* @ECU_Address@SwcOut_FCM_DrivingHmiEnv.LaneLineList_2[4].lineIndex@ */ /end MEASUREMENT
/begin MEASUREMENT SwcOut_FCM_DrivingHmiEnv.LaneLineList_2[4].lineStart_X "" FLOAT32_IEEE autosar_swc_val_CM_single 0 0 -3.4E+38 3.4E+38 ECU_ADDRESS 0xfe4ca580 /* @ECU_Address@SwcOut_FCM_DrivingHmiEnv.LaneLineList_2[4].lineStart_X@ */ /end MEASUREMENT
/begin MEASUREMENT SwcOut_FCM_DrivingHmiEnv.LaneLineList_2[4].lineStart_Y "" FLOAT32_IEEE autosar_swc_val_CM_single 0 0 -3.4E+38 3.4E+38 ECU_ADDRESS 0xfe4ca584 /* @ECU_Address@SwcOut_FCM_DrivingHmiEnv.LaneLineList_2[4].lineStart_Y@ */ /end MEASUREMENT
/begin MEASUREMENT SwcOut_FCM_DrivingHmiEnv.LaneLineList_2[4].lineType "" UBYTE autosar_swc_val_CM_uint8 0 0 0 255 ECU_ADDRESS 0xfe4ca56b /* @ECU_Address@SwcOut_FCM_DrivingHmiEnv.LaneLineList_2[4].lineType@ */ /end MEASUREMENT
/begin MEASUREMENT SwcOut_FCM_DrivingHmiEnv.LaneLineList_2[5].laneLineWidth "" FLOAT32_IEEE autosar_swc_val_CM_single 0 0 -3.4E+38 3.4E+38 ECU_ADDRESS 0xfe4ca5a4 /* @ECU_Address@SwcOut_FCM_DrivingHmiEnv.LaneLineList_2[5].laneLineWidth@ */ /end MEASUREMENT
/begin MEASUREMENT SwcOut_FCM_DrivingHmiEnv.LaneLineList_2[5].lineColor "" UBYTE autosar_swc_val_CM_uint8 0 0 0 255 ECU_ADDRESS 0xfe4ca592 /* @ECU_Address@SwcOut_FCM_DrivingHmiEnv.LaneLineList_2[5].lineColor@ */ /end MEASUREMENT
/begin MEASUREMENT SwcOut_FCM_DrivingHmiEnv.LaneLineList_2[5].lineEnd_X "" FLOAT32_IEEE autosar_swc_val_CM_single 0 0 -3.4E+38 3.4E+38 ECU_ADDRESS 0xfe4ca5b0 /* @ECU_Address@SwcOut_FCM_DrivingHmiEnv.LaneLineList_2[5].lineEnd_X@ */ /end MEASUREMENT
/begin MEASUREMENT SwcOut_FCM_DrivingHmiEnv.LaneLineList_2[5].lineEnd_Y "" FLOAT32_IEEE autosar_swc_val_CM_single 0 0 -3.4E+38 3.4E+38 ECU_ADDRESS 0xfe4ca5b4 /* @ECU_Address@SwcOut_FCM_DrivingHmiEnv.LaneLineList_2[5].lineEnd_Y@ */ /end MEASUREMENT
/begin MEASUREMENT SwcOut_FCM_DrivingHmiEnv.LaneLineList_2[5].lineEquation_C0 "" FLOAT32_IEEE autosar_swc_val_CM_single 0 0 -3.4E+38 3.4E+38 ECU_ADDRESS 0xfe4ca594 /* @ECU_Address@SwcOut_FCM_DrivingHmiEnv.LaneLineList_2[5].lineEquation_C0@ */ /end MEASUREMENT
/begin MEASUREMENT SwcOut_FCM_DrivingHmiEnv.LaneLineList_2[5].lineEquation_C1 "" FLOAT32_IEEE autosar_swc_val_CM_single 0 0 -3.4E+38 3.4E+38 ECU_ADDRESS 0xfe4ca598 /* @ECU_Address@SwcOut_FCM_DrivingHmiEnv.LaneLineList_2[5].lineEquation_C1@ */ /end MEASUREMENT
/begin MEASUREMENT SwcOut_FCM_DrivingHmiEnv.LaneLineList_2[5].lineEquation_C2 "" FLOAT32_IEEE autosar_swc_val_CM_single 0 0 -3.4E+38 3.4E+38 ECU_ADDRESS 0xfe4ca59c /* @ECU_Address@SwcOut_FCM_DrivingHmiEnv.LaneLineList_2[5].lineEquation_C2@ */ /end MEASUREMENT
/begin MEASUREMENT SwcOut_FCM_DrivingHmiEnv.LaneLineList_2[5].lineEquation_C3 "" FLOAT32_IEEE autosar_swc_val_CM_single 0 0 -3.4E+38 3.4E+38 ECU_ADDRESS 0xfe4ca5a0 /* @ECU_Address@SwcOut_FCM_DrivingHmiEnv.LaneLineList_2[5].lineEquation_C3@ */ /end MEASUREMENT
/begin MEASUREMENT SwcOut_FCM_DrivingHmiEnv.LaneLineList_2[5].lineId "" UBYTE autosar_swc_val_CM_uint8 0 0 0 255 ECU_ADDRESS 0xfe4ca591 /* @ECU_Address@SwcOut_FCM_DrivingHmiEnv.LaneLineList_2[5].lineId@ */ /end MEASUREMENT
/begin MEASUREMENT SwcOut_FCM_DrivingHmiEnv.LaneLineList_2[5].lineIndex "" UBYTE autosar_swc_val_CM_uint8 0 0 0 255 ECU_ADDRESS 0xfe4ca590 /* @ECU_Address@SwcOut_FCM_DrivingHmiEnv.LaneLineList_2[5].lineIndex@ */ /end MEASUREMENT
/begin MEASUREMENT SwcOut_FCM_DrivingHmiEnv.LaneLineList_2[5].lineStart_X "" FLOAT32_IEEE autosar_swc_val_CM_single 0 0 -3.4E+38 3.4E+38 ECU_ADDRESS 0xfe4ca5a8 /* @ECU_Address@SwcOut_FCM_DrivingHmiEnv.LaneLineList_2[5].lineStart_X@ */ /end MEASUREMENT
/begin MEASUREMENT SwcOut_FCM_DrivingHmiEnv.LaneLineList_2[5].lineStart_Y "" FLOAT32_IEEE autosar_swc_val_CM_single 0 0 -3.4E+38 3.4E+38 ECU_ADDRESS 0xfe4ca5ac /* @ECU_Address@SwcOut_FCM_DrivingHmiEnv.LaneLineList_2[5].lineStart_Y@ */ /end MEASUREMENT
/begin MEASUREMENT SwcOut_FCM_DrivingHmiEnv.LaneLineList_2[5].lineType "" UBYTE autosar_swc_val_CM_uint8 0 0 0 255 ECU_ADDRESS 0xfe4ca593 /* @ECU_Address@SwcOut_FCM_DrivingHmiEnv.LaneLineList_2[5].lineType@ */ /end MEASUREMENT
/begin MEASUREMENT SwcOut_FCM_DrivingHmiEnv.LaneLineList_2[6].laneLineWidth "" FLOAT32_IEEE autosar_swc_val_CM_single 0 0 -3.4E+38 3.4E+38 ECU_ADDRESS 0xfe4ca5cc /* @ECU_Address@SwcOut_FCM_DrivingHmiEnv.LaneLineList_2[6].laneLineWidth@ */ /end MEASUREMENT
/begin MEASUREMENT SwcOut_FCM_DrivingHmiEnv.LaneLineList_2[6].lineColor "" UBYTE autosar_swc_val_CM_uint8 0 0 0 255 ECU_ADDRESS 0xfe4ca5ba /* @ECU_Address@SwcOut_FCM_DrivingHmiEnv.LaneLineList_2[6].lineColor@ */ /end MEASUREMENT
/begin MEASUREMENT SwcOut_FCM_DrivingHmiEnv.LaneLineList_2[6].lineEnd_X "" FLOAT32_IEEE autosar_swc_val_CM_single 0 0 -3.4E+38 3.4E+38 ECU_ADDRESS 0xfe4ca5d8 /* @ECU_Address@SwcOut_FCM_DrivingHmiEnv.LaneLineList_2[6].lineEnd_X@ */ /end MEASUREMENT
/begin MEASUREMENT SwcOut_FCM_DrivingHmiEnv.LaneLineList_2[6].lineEnd_Y "" FLOAT32_IEEE autosar_swc_val_CM_single 0 0 -3.4E+38 3.4E+38 ECU_ADDRESS 0xfe4ca5dc /* @ECU_Address@SwcOut_FCM_DrivingHmiEnv.LaneLineList_2[6].lineEnd_Y@ */ /end MEASUREMENT
/begin MEASUREMENT SwcOut_FCM_DrivingHmiEnv.LaneLineList_2[6].lineEquation_C0 "" FLOAT32_IEEE autosar_swc_val_CM_single 0 0 -3.4E+38 3.4E+38 ECU_ADDRESS 0xfe4ca5bc /* @ECU_Address@SwcOut_FCM_DrivingHmiEnv.LaneLineList_2[6].lineEquation_C0@ */ /end MEASUREMENT
/begin MEASUREMENT SwcOut_FCM_DrivingHmiEnv.LaneLineList_2[6].lineEquation_C1 "" FLOAT32_IEEE autosar_swc_val_CM_single 0 0 -3.4E+38 3.4E+38 ECU_ADDRESS 0xfe4ca5c0 /* @ECU_Address@SwcOut_FCM_DrivingHmiEnv.LaneLineList_2[6].lineEquation_C1@ */ /end MEASUREMENT
/begin MEASUREMENT SwcOut_FCM_DrivingHmiEnv.LaneLineList_2[6].lineEquation_C2 "" FLOAT32_IEEE autosar_swc_val_CM_single 0 0 -3.4E+38 3.4E+38 ECU_ADDRESS 0xfe4ca5c4 /* @ECU_Address@SwcOut_FCM_DrivingHmiEnv.LaneLineList_2[6].lineEquation_C2@ */ /end MEASUREMENT
/begin MEASUREMENT SwcOut_FCM_DrivingHmiEnv.LaneLineList_2[6].lineEquation_C3 "" FLOAT32_IEEE autosar_swc_val_CM_single 0 0 -3.4E+38 3.4E+38 ECU_ADDRESS 0xfe4ca5c8 /* @ECU_Address@SwcOut_FCM_DrivingHmiEnv.LaneLineList_2[6].lineEquation_C3@ */ /end MEASUREMENT
/begin MEASUREMENT SwcOut_FCM_DrivingHmiEnv.LaneLineList_2[6].lineId "" UBYTE autosar_swc_val_CM_uint8 0 0 0 255 ECU_ADDRESS 0xfe4ca5b9 /* @ECU_Address@SwcOut_FCM_DrivingHmiEnv.LaneLineList_2[6].lineId@ */ /end MEASUREMENT
/begin MEASUREMENT SwcOut_FCM_DrivingHmiEnv.LaneLineList_2[6].lineIndex "" UBYTE autosar_swc_val_CM_uint8 0 0 0 255 ECU_ADDRESS 0xfe4ca5b8 /* @ECU_Address@SwcOut_FCM_DrivingHmiEnv.LaneLineList_2[6].lineIndex@ */ /end MEASUREMENT
/begin MEASUREMENT SwcOut_FCM_DrivingHmiEnv.LaneLineList_2[6].lineStart_X "" FLOAT32_IEEE autosar_swc_val_CM_single 0 0 -3.4E+38 3.4E+38 ECU_ADDRESS 0xfe4ca5d0 /* @ECU_Address@SwcOut_FCM_DrivingHmiEnv.LaneLineList_2[6].lineStart_X@ */ /end MEASUREMENT
/begin MEASUREMENT SwcOut_FCM_DrivingHmiEnv.LaneLineList_2[6].lineStart_Y "" FLOAT32_IEEE autosar_swc_val_CM_single 0 0 -3.4E+38 3.4E+38 ECU_ADDRESS 0xfe4ca5d4 /* @ECU_Address@SwcOut_FCM_DrivingHmiEnv.LaneLineList_2[6].lineStart_Y@ */ /end MEASUREMENT
/begin MEASUREMENT SwcOut_FCM_DrivingHmiEnv.LaneLineList_2[6].lineType "" UBYTE autosar_swc_val_CM_uint8 0 0 0 255 ECU_ADDRESS 0xfe4ca5bb /* @ECU_Address@SwcOut_FCM_DrivingHmiEnv.LaneLineList_2[6].lineType@ */ /end MEASUREMENT
/begin MEASUREMENT SwcOut_FCM_DrivingHmiEnv.LaneLineList_2[7].laneLineWidth "" FLOAT32_IEEE autosar_swc_val_CM_single 0 0 -3.4E+38 3.4E+38 ECU_ADDRESS 0xfe4ca5f4 /* @ECU_Address@SwcOut_FCM_DrivingHmiEnv.LaneLineList_2[7].laneLineWidth@ */ /end MEASUREMENT
/begin MEASUREMENT SwcOut_FCM_DrivingHmiEnv.LaneLineList_2[7].lineColor "" UBYTE autosar_swc_val_CM_uint8 0 0 0 255 ECU_ADDRESS 0xfe4ca5e2 /* @ECU_Address@SwcOut_FCM_DrivingHmiEnv.LaneLineList_2[7].lineColor@ */ /end MEASUREMENT
/begin MEASUREMENT SwcOut_FCM_DrivingHmiEnv.LaneLineList_2[7].lineEnd_X "" FLOAT32_IEEE autosar_swc_val_CM_single 0 0 -3.4E+38 3.4E+38 ECU_ADDRESS 0xfe4ca600 /* @ECU_Address@SwcOut_FCM_DrivingHmiEnv.LaneLineList_2[7].lineEnd_X@ */ /end MEASUREMENT
/begin MEASUREMENT SwcOut_FCM_DrivingHmiEnv.LaneLineList_2[7].lineEnd_Y "" FLOAT32_IEEE autosar_swc_val_CM_single 0 0 -3.4E+38 3.4E+38 ECU_ADDRESS 0xfe4ca604 /* @ECU_Address@SwcOut_FCM_DrivingHmiEnv.LaneLineList_2[7].lineEnd_Y@ */ /end MEASUREMENT
/begin MEASUREMENT SwcOut_FCM_DrivingHmiEnv.LaneLineList_2[7].lineEquation_C0 "" FLOAT32_IEEE autosar_swc_val_CM_single 0 0 -3.4E+38 3.4E+38 ECU_ADDRESS 0xfe4ca5e4 /* @ECU_Address@SwcOut_FCM_DrivingHmiEnv.LaneLineList_2[7].lineEquation_C0@ */ /end MEASUREMENT
/begin MEASUREMENT SwcOut_FCM_DrivingHmiEnv.LaneLineList_2[7].lineEquation_C1 "" FLOAT32_IEEE autosar_swc_val_CM_single 0 0 -3.4E+38 3.4E+38 ECU_ADDRESS 0xfe4ca5e8 /* @ECU_Address@SwcOut_FCM_DrivingHmiEnv.LaneLineList_2[7].lineEquation_C1@ */ /end MEASUREMENT
/begin MEASUREMENT SwcOut_FCM_DrivingHmiEnv.LaneLineList_2[7].lineEquation_C2 "" FLOAT32_IEEE autosar_swc_val_CM_single 0 0 -3.4E+38 3.4E+38 ECU_ADDRESS 0xfe4ca5ec /* @ECU_Address@SwcOut_FCM_DrivingHmiEnv.LaneLineList_2[7].lineEquation_C2@ */ /end MEASUREMENT
/begin MEASUREMENT SwcOut_FCM_DrivingHmiEnv.LaneLineList_2[7].lineEquation_C3 "" FLOAT32_IEEE autosar_swc_val_CM_single 0 0 -3.4E+38 3.4E+38 ECU_ADDRESS 0xfe4ca5f0 /* @ECU_Address@SwcOut_FCM_DrivingHmiEnv.LaneLineList_2[7].lineEquation_C3@ */ /end MEASUREMENT
/begin MEASUREMENT SwcOut_FCM_DrivingHmiEnv.LaneLineList_2[7].lineId "" UBYTE autosar_swc_val_CM_uint8 0 0 0 255 ECU_ADDRESS 0xfe4ca5e1 /* @ECU_Address@SwcOut_FCM_DrivingHmiEnv.LaneLineList_2[7].lineId@ */ /end MEASUREMENT
/begin MEASUREMENT SwcOut_FCM_DrivingHmiEnv.LaneLineList_2[7].lineIndex "" UBYTE autosar_swc_val_CM_uint8 0 0 0 255 ECU_ADDRESS 0xfe4ca5e0 /* @ECU_Address@SwcOut_FCM_DrivingHmiEnv.LaneLineList_2[7].lineIndex@ */ /end MEASUREMENT
/begin MEASUREMENT SwcOut_FCM_DrivingHmiEnv.LaneLineList_2[7].lineStart_X "" FLOAT32_IEEE autosar_swc_val_CM_single 0 0 -3.4E+38 3.4E+38 ECU_ADDRESS 0xfe4ca5f8 /* @ECU_Address@SwcOut_FCM_DrivingHmiEnv.LaneLineList_2[7].lineStart_X@ */ /end MEASUREMENT
/begin MEASUREMENT SwcOut_FCM_DrivingHmiEnv.LaneLineList_2[7].lineStart_Y "" FLOAT32_IEEE autosar_swc_val_CM_single 0 0 -3.4E+38 3.4E+38 ECU_ADDRESS 0xfe4ca5fc /* @ECU_Address@SwcOut_FCM_DrivingHmiEnv.LaneLineList_2[7].lineStart_Y@ */ /end MEASUREMENT
/begin MEASUREMENT SwcOut_FCM_DrivingHmiEnv.LaneLineList_2[7].lineType "" UBYTE autosar_swc_val_CM_uint8 0 0 0 255 ECU_ADDRESS 0xfe4ca5e3 /* @ECU_Address@SwcOut_FCM_DrivingHmiEnv.LaneLineList_2[7].lineType@ */ /end MEASUREMENT
/begin MEASUREMENT SwcOut_FCM_DrivingHmiEnv.StaticObjectList[1].laneID "" SBYTE autosar_swc_val_CM_int8 0 0 -128 127 ECU_ADDRESS 0xfe4ca380 /* @ECU_Address@SwcOut_FCM_DrivingHmiEnv.StaticObjectList[1].laneID@ */ /end MEASUREMENT
/begin MEASUREMENT SwcOut_FCM_DrivingHmiEnv.StaticObjectList[1].objecWidth "" UWORD autosar_swc_val_CM_uint16 0 0 0 65535 ECU_ADDRESS 0xfe4ca372 /* @ECU_Address@SwcOut_FCM_DrivingHmiEnv.StaticObjectList[1].objecWidth@ */ /end MEASUREMENT
/begin MEASUREMENT SwcOut_FCM_DrivingHmiEnv.StaticObjectList[1].objectId "" UBYTE autosar_swc_val_CM_uint8 0 0 0 255 ECU_ADDRESS 0xfe4ca360 /* @ECU_Address@SwcOut_FCM_DrivingHmiEnv.StaticObjectList[1].objectId@ */ /end MEASUREMENT
/begin MEASUREMENT SwcOut_FCM_DrivingHmiEnv.StaticObjectList[1].objectLength "" UWORD autosar_swc_val_CM_uint16 0 0 0 65535 ECU_ADDRESS 0xfe4ca370 /* @ECU_Address@SwcOut_FCM_DrivingHmiEnv.StaticObjectList[1].objectLength@ */ /end MEASUREMENT
/begin MEASUREMENT SwcOut_FCM_DrivingHmiEnv.StaticObjectList[1].objectPoseX "" FLOAT32_IEEE autosar_swc_val_CM_single 0 0 -3.4E+38 3.4E+38 ECU_ADDRESS 0xfe4ca364 /* @ECU_Address@SwcOut_FCM_DrivingHmiEnv.StaticObjectList[1].objectPoseX@ */ /end MEASUREMENT
/begin MEASUREMENT SwcOut_FCM_DrivingHmiEnv.StaticObjectList[1].objectPoseY "" FLOAT32_IEEE autosar_swc_val_CM_single 0 0 -3.4E+38 3.4E+38 ECU_ADDRESS 0xfe4ca368 /* @ECU_Address@SwcOut_FCM_DrivingHmiEnv.StaticObjectList[1].objectPoseY@ */ /end MEASUREMENT
/begin MEASUREMENT SwcOut_FCM_DrivingHmiEnv.StaticObjectList[1].objectType "" UBYTE autosar_swc_val_CM_uint8 0 0 0 255 ECU_ADDRESS 0xfe4ca361 /* @ECU_Address@SwcOut_FCM_DrivingHmiEnv.StaticObjectList[1].objectType@ */ /end MEASUREMENT
/begin MEASUREMENT SwcOut_FCM_DrivingHmiEnv.StaticObjectList[1].objectYaw "" FLOAT32_IEEE autosar_swc_val_CM_single 0 0 -3.4E+38 3.4E+38 ECU_ADDRESS 0xfe4ca36c /* @ECU_Address@SwcOut_FCM_DrivingHmiEnv.StaticObjectList[1].objectYaw@ */ /end MEASUREMENT
/begin MEASUREMENT SwcOut_FCM_DrivingHmiEnv.StaticObjectList[1].timestampnSec "" A_UINT64 autosar_swc_val_CM_uint64 0 0 0.0 1.844674407370955e+19 ECU_ADDRESS 0xfe4ca378 /* @ECU_Address@SwcOut_FCM_DrivingHmiEnv.StaticObjectList[1].timestampnSec@ */ /end MEASUREMENT
/begin MEASUREMENT SwcOut_FCM_DrivingHmiEnv.StaticObjectList[2].laneID "" SBYTE autosar_swc_val_CM_int8 0 0 -128 127 ECU_ADDRESS 0xfe4ca3a8 /* @ECU_Address@SwcOut_FCM_DrivingHmiEnv.StaticObjectList[2].laneID@ */ /end MEASUREMENT
/begin MEASUREMENT SwcOut_FCM_DrivingHmiEnv.StaticObjectList[2].objecWidth "" UWORD autosar_swc_val_CM_uint16 0 0 0 65535 ECU_ADDRESS 0xfe4ca39a /* @ECU_Address@SwcOut_FCM_DrivingHmiEnv.StaticObjectList[2].objecWidth@ */ /end MEASUREMENT
/begin MEASUREMENT SwcOut_FCM_DrivingHmiEnv.StaticObjectList[2].objectId "" UBYTE autosar_swc_val_CM_uint8 0 0 0 255 ECU_ADDRESS 0xfe4ca388 /* @ECU_Address@SwcOut_FCM_DrivingHmiEnv.StaticObjectList[2].objectId@ */ /end MEASUREMENT
/begin MEASUREMENT SwcOut_FCM_DrivingHmiEnv.StaticObjectList[2].objectLength "" UWORD autosar_swc_val_CM_uint16 0 0 0 65535 ECU_ADDRESS 0xfe4ca398 /* @ECU_Address@SwcOut_FCM_DrivingHmiEnv.StaticObjectList[2].objectLength@ */ /end MEASUREMENT
/begin MEASUREMENT SwcOut_FCM_DrivingHmiEnv.StaticObjectList[2].objectPoseX "" FLOAT32_IEEE autosar_swc_val_CM_single 0 0 -3.4E+38 3.4E+38 ECU_ADDRESS 0xfe4ca38c /* @ECU_Address@SwcOut_FCM_DrivingHmiEnv.StaticObjectList[2].objectPoseX@ */ /end MEASUREMENT
/begin MEASUREMENT SwcOut_FCM_DrivingHmiEnv.StaticObjectList[2].objectPoseY "" FLOAT32_IEEE autosar_swc_val_CM_single 0 0 -3.4E+38 3.4E+38 ECU_ADDRESS 0xfe4ca390 /* @ECU_Address@SwcOut_FCM_DrivingHmiEnv.StaticObjectList[2].objectPoseY@ */ /end MEASUREMENT
/begin MEASUREMENT SwcOut_FCM_DrivingHmiEnv.StaticObjectList[2].objectType "" UBYTE autosar_swc_val_CM_uint8 0 0 0 255 ECU_ADDRESS 0xfe4ca389 /* @ECU_Address@SwcOut_FCM_DrivingHmiEnv.StaticObjectList[2].objectType@ */ /end MEASUREMENT
/begin MEASUREMENT SwcOut_FCM_DrivingHmiEnv.StaticObjectList[2].objectYaw "" FLOAT32_IEEE autosar_swc_val_CM_single 0 0 -3.4E+38 3.4E+38 ECU_ADDRESS 0xfe4ca394 /* @ECU_Address@SwcOut_FCM_DrivingHmiEnv.StaticObjectList[2].objectYaw@ */ /end MEASUREMENT
/begin MEASUREMENT SwcOut_FCM_DrivingHmiEnv.StaticObjectList[2].timestampnSec "" A_UINT64 autosar_swc_val_CM_uint64 0 0 0.0 1.844674407370955e+19 ECU_ADDRESS 0xfe4ca3a0 /* @ECU_Address@SwcOut_FCM_DrivingHmiEnv.StaticObjectList[2].timestampnSec@ */ /end MEASUREMENT
/begin MEASUREMENT SwcOut_FCM_DrivingHmiEnv.StaticObjectList[3].laneID "" SBYTE autosar_swc_val_CM_int8 0 0 -128 127 ECU_ADDRESS 0xfe4ca3d0 /* @ECU_Address@SwcOut_FCM_DrivingHmiEnv.StaticObjectList[3].laneID@ */ /end MEASUREMENT
/begin MEASUREMENT SwcOut_FCM_DrivingHmiEnv.StaticObjectList[3].objecWidth "" UWORD autosar_swc_val_CM_uint16 0 0 0 65535 ECU_ADDRESS 0xfe4ca3c2 /* @ECU_Address@SwcOut_FCM_DrivingHmiEnv.StaticObjectList[3].objecWidth@ */ /end MEASUREMENT
/begin MEASUREMENT SwcOut_FCM_DrivingHmiEnv.StaticObjectList[3].objectId "" UBYTE autosar_swc_val_CM_uint8 0 0 0 255 ECU_ADDRESS 0xfe4ca3b0 /* @ECU_Address@SwcOut_FCM_DrivingHmiEnv.StaticObjectList[3].objectId@ */ /end MEASUREMENT
/begin MEASUREMENT SwcOut_FCM_DrivingHmiEnv.StaticObjectList[3].objectLength "" UWORD autosar_swc_val_CM_uint16 0 0 0 65535 ECU_ADDRESS 0xfe4ca3c0 /* @ECU_Address@SwcOut_FCM_DrivingHmiEnv.StaticObjectList[3].objectLength@ */ /end MEASUREMENT
/begin MEASUREMENT SwcOut_FCM_DrivingHmiEnv.StaticObjectList[3].objectPoseX "" FLOAT32_IEEE autosar_swc_val_CM_single 0 0 -3.4E+38 3.4E+38 ECU_ADDRESS 0xfe4ca3b4 /* @ECU_Address@SwcOut_FCM_DrivingHmiEnv.StaticObjectList[3].objectPoseX@ */ /end MEASUREMENT
/begin MEASUREMENT SwcOut_FCM_DrivingHmiEnv.StaticObjectList[3].objectPoseY "" FLOAT32_IEEE autosar_swc_val_CM_single 0 0 -3.4E+38 3.4E+38 ECU_ADDRESS 0xfe4ca3b8 /* @ECU_Address@SwcOut_FCM_DrivingHmiEnv.StaticObjectList[3].objectPoseY@ */ /end MEASUREMENT
/begin MEASUREMENT SwcOut_FCM_DrivingHmiEnv.StaticObjectList[3].objectType "" UBYTE autosar_swc_val_CM_uint8 0 0 0 255 ECU_ADDRESS 0xfe4ca3b1 /* @ECU_Address@SwcOut_FCM_DrivingHmiEnv.StaticObjectList[3].objectType@ */ /end MEASUREMENT
/begin MEASUREMENT SwcOut_FCM_DrivingHmiEnv.StaticObjectList[3].objectYaw "" FLOAT32_IEEE autosar_swc_val_CM_single 0 0 -3.4E+38 3.4E+38 ECU_ADDRESS 0xfe4ca3bc /* @ECU_Address@SwcOut_FCM_DrivingHmiEnv.StaticObjectList[3].objectYaw@ */ /end MEASUREMENT
/begin MEASUREMENT SwcOut_FCM_DrivingHmiEnv.StaticObjectList[3].timestampnSec "" A_UINT64 autosar_swc_val_CM_uint64 0 0 0.0 1.844674407370955e+19 ECU_ADDRESS 0xfe4ca3c8 /* @ECU_Address@SwcOut_FCM_DrivingHmiEnv.StaticObjectList[3].timestampnSec@ */ /end MEASUREMENT
/begin MEASUREMENT SwcOut_FCM_DrivingHmiEnv.StaticObjectList[4].laneID "" SBYTE autosar_swc_val_CM_int8 0 0 -128 127 ECU_ADDRESS 0xfe4ca3f8 /* @ECU_Address@SwcOut_FCM_DrivingHmiEnv.StaticObjectList[4].laneID@ */ /end MEASUREMENT
/begin MEASUREMENT SwcOut_FCM_DrivingHmiEnv.StaticObjectList[4].objecWidth "" UWORD autosar_swc_val_CM_uint16 0 0 0 65535 ECU_ADDRESS 0xfe4ca3ea /* @ECU_Address@SwcOut_FCM_DrivingHmiEnv.StaticObjectList[4].objecWidth@ */ /end MEASUREMENT
/begin MEASUREMENT SwcOut_FCM_DrivingHmiEnv.StaticObjectList[4].objectId "" UBYTE autosar_swc_val_CM_uint8 0 0 0 255 ECU_ADDRESS 0xfe4ca3d8 /* @ECU_Address@SwcOut_FCM_DrivingHmiEnv.StaticObjectList[4].objectId@ */ /end MEASUREMENT
/begin MEASUREMENT SwcOut_FCM_DrivingHmiEnv.StaticObjectList[4].objectLength "" UWORD autosar_swc_val_CM_uint16 0 0 0 65535 ECU_ADDRESS 0xfe4ca3e8 /* @ECU_Address@SwcOut_FCM_DrivingHmiEnv.StaticObjectList[4].objectLength@ */ /end MEASUREMENT
/begin MEASUREMENT SwcOut_FCM_DrivingHmiEnv.StaticObjectList[4].objectPoseX "" FLOAT32_IEEE autosar_swc_val_CM_single 0 0 -3.4E+38 3.4E+38 ECU_ADDRESS 0xfe4ca3dc /* @ECU_Address@SwcOut_FCM_DrivingHmiEnv.StaticObjectList[4].objectPoseX@ */ /end MEASUREMENT
/begin MEASUREMENT SwcOut_FCM_DrivingHmiEnv.StaticObjectList[4].objectPoseY "" FLOAT32_IEEE autosar_swc_val_CM_single 0 0 -3.4E+38 3.4E+38 ECU_ADDRESS 0xfe4ca3e0 /* @ECU_Address@SwcOut_FCM_DrivingHmiEnv.StaticObjectList[4].objectPoseY@ */ /end MEASUREMENT
/begin MEASUREMENT SwcOut_FCM_DrivingHmiEnv.StaticObjectList[4].objectType "" UBYTE autosar_swc_val_CM_uint8 0 0 0 255 ECU_ADDRESS 0xfe4ca3d9 /* @ECU_Address@SwcOut_FCM_DrivingHmiEnv.StaticObjectList[4].objectType@ */ /end MEASUREMENT
/begin MEASUREMENT SwcOut_FCM_DrivingHmiEnv.StaticObjectList[4].objectYaw "" FLOAT32_IEEE autosar_swc_val_CM_single 0 0 -3.4E+38 3.4E+38 ECU_ADDRESS 0xfe4ca3e4 /* @ECU_Address@SwcOut_FCM_DrivingHmiEnv.StaticObjectList[4].objectYaw@ */ /end MEASUREMENT
/begin MEASUREMENT SwcOut_FCM_DrivingHmiEnv.StaticObjectList[4].timestampnSec "" A_UINT64 autosar_swc_val_CM_uint64 0 0 0.0 1.844674407370955e+19 ECU_ADDRESS 0xfe4ca3f0 /* @ECU_Address@SwcOut_FCM_DrivingHmiEnv.StaticObjectList[4].timestampnSec@ */ /end MEASUREMENT
/begin MEASUREMENT SwcOut_FCM_DrivingHmiEnv.StaticObjectList[5].laneID "" SBYTE autosar_swc_val_CM_int8 0 0 -128 127 ECU_ADDRESS 0xfe4ca420 /* @ECU_Address@SwcOut_FCM_DrivingHmiEnv.StaticObjectList[5].laneID@ */ /end MEASUREMENT
/begin MEASUREMENT SwcOut_FCM_DrivingHmiEnv.StaticObjectList[5].objecWidth "" UWORD autosar_swc_val_CM_uint16 0 0 0 65535 ECU_ADDRESS 0xfe4ca412 /* @ECU_Address@SwcOut_FCM_DrivingHmiEnv.StaticObjectList[5].objecWidth@ */ /end MEASUREMENT
/begin MEASUREMENT SwcOut_FCM_DrivingHmiEnv.StaticObjectList[5].objectId "" UBYTE autosar_swc_val_CM_uint8 0 0 0 255 ECU_ADDRESS 0xfe4ca400 /* @ECU_Address@SwcOut_FCM_DrivingHmiEnv.StaticObjectList[5].objectId@ */ /end MEASUREMENT
/begin MEASUREMENT SwcOut_FCM_DrivingHmiEnv.StaticObjectList[5].objectLength "" UWORD autosar_swc_val_CM_uint16 0 0 0 65535 ECU_ADDRESS 0xfe4ca410 /* @ECU_Address@SwcOut_FCM_DrivingHmiEnv.StaticObjectList[5].objectLength@ */ /end MEASUREMENT
/begin MEASUREMENT SwcOut_FCM_DrivingHmiEnv.StaticObjectList[5].objectPoseX "" FLOAT32_IEEE autosar_swc_val_CM_single 0 0 -3.4E+38 3.4E+38 ECU_ADDRESS 0xfe4ca404 /* @ECU_Address@SwcOut_FCM_DrivingHmiEnv.StaticObjectList[5].objectPoseX@ */ /end MEASUREMENT
/begin MEASUREMENT SwcOut_FCM_DrivingHmiEnv.StaticObjectList[5].objectPoseY "" FLOAT32_IEEE autosar_swc_val_CM_single 0 0 -3.4E+38 3.4E+38 ECU_ADDRESS 0xfe4ca408 /* @ECU_Address@SwcOut_FCM_DrivingHmiEnv.StaticObjectList[5].objectPoseY@ */ /end MEASUREMENT
/begin MEASUREMENT SwcOut_FCM_DrivingHmiEnv.StaticObjectList[5].objectType "" UBYTE autosar_swc_val_CM_uint8 0 0 0 255 ECU_ADDRESS 0xfe4ca401 /* @ECU_Address@SwcOut_FCM_DrivingHmiEnv.StaticObjectList[5].objectType@ */ /end MEASUREMENT
/begin MEASUREMENT SwcOut_FCM_DrivingHmiEnv.StaticObjectList[5].objectYaw "" FLOAT32_IEEE autosar_swc_val_CM_single 0 0 -3.4E+38 3.4E+38 ECU_ADDRESS 0xfe4ca40c /* @ECU_Address@SwcOut_FCM_DrivingHmiEnv.StaticObjectList[5].objectYaw@ */ /end MEASUREMENT
/begin MEASUREMENT SwcOut_FCM_DrivingHmiEnv.StaticObjectList[5].timestampnSec "" A_UINT64 autosar_swc_val_CM_uint64 0 0 0.0 1.844674407370955e+19 ECU_ADDRESS 0xfe4ca418 /* @ECU_Address@SwcOut_FCM_DrivingHmiEnv.StaticObjectList[5].timestampnSec@ */ /end MEASUREMENT
/begin MEASUREMENT SwcOut_FCM_DrivingHmiEnv.StaticObjectList[6].laneID "" SBYTE autosar_swc_val_CM_int8 0 0 -128 127 ECU_ADDRESS 0xfe4ca448 /* @ECU_Address@SwcOut_FCM_DrivingHmiEnv.StaticObjectList[6].laneID@ */ /end MEASUREMENT
/begin MEASUREMENT SwcOut_FCM_DrivingHmiEnv.StaticObjectList[6].objecWidth "" UWORD autosar_swc_val_CM_uint16 0 0 0 65535 ECU_ADDRESS 0xfe4ca43a /* @ECU_Address@SwcOut_FCM_DrivingHmiEnv.StaticObjectList[6].objecWidth@ */ /end MEASUREMENT
/begin MEASUREMENT SwcOut_FCM_DrivingHmiEnv.StaticObjectList[6].objectId "" UBYTE autosar_swc_val_CM_uint8 0 0 0 255 ECU_ADDRESS 0xfe4ca428 /* @ECU_Address@SwcOut_FCM_DrivingHmiEnv.StaticObjectList[6].objectId@ */ /end MEASUREMENT
/begin MEASUREMENT SwcOut_FCM_DrivingHmiEnv.StaticObjectList[6].objectLength "" UWORD autosar_swc_val_CM_uint16 0 0 0 65535 ECU_ADDRESS 0xfe4ca438 /* @ECU_Address@SwcOut_FCM_DrivingHmiEnv.StaticObjectList[6].objectLength@ */ /end MEASUREMENT
/begin MEASUREMENT SwcOut_FCM_DrivingHmiEnv.StaticObjectList[6].objectPoseX "" FLOAT32_IEEE autosar_swc_val_CM_single 0 0 -3.4E+38 3.4E+38 ECU_ADDRESS 0xfe4ca42c /* @ECU_Address@SwcOut_FCM_DrivingHmiEnv.StaticObjectList[6].objectPoseX@ */ /end MEASUREMENT
/begin MEASUREMENT SwcOut_FCM_DrivingHmiEnv.StaticObjectList[6].objectPoseY "" FLOAT32_IEEE autosar_swc_val_CM_single 0 0 -3.4E+38 3.4E+38 ECU_ADDRESS 0xfe4ca430 /* @ECU_Address@SwcOut_FCM_DrivingHmiEnv.StaticObjectList[6].objectPoseY@ */ /end MEASUREMENT
/begin MEASUREMENT SwcOut_FCM_DrivingHmiEnv.StaticObjectList[6].objectType "" UBYTE autosar_swc_val_CM_uint8 0 0 0 255 ECU_ADDRESS 0xfe4ca429 /* @ECU_Address@SwcOut_FCM_DrivingHmiEnv.StaticObjectList[6].objectType@ */ /end MEASUREMENT
/begin MEASUREMENT SwcOut_FCM_DrivingHmiEnv.StaticObjectList[6].objectYaw "" FLOAT32_IEEE autosar_swc_val_CM_single 0 0 -3.4E+38 3.4E+38 ECU_ADDRESS 0xfe4ca434 /* @ECU_Address@SwcOut_FCM_DrivingHmiEnv.StaticObjectList[6].objectYaw@ */ /end MEASUREMENT
/begin MEASUREMENT SwcOut_FCM_DrivingHmiEnv.StaticObjectList[6].timestampnSec "" A_UINT64 autosar_swc_val_CM_uint64 0 0 0.0 1.844674407370955e+19 ECU_ADDRESS 0xfe4ca440 /* @ECU_Address@SwcOut_FCM_DrivingHmiEnv.StaticObjectList[6].timestampnSec@ */ /end MEASUREMENT
/begin MEASUREMENT SwcOut_FCM_DrivingHmiEnv.StaticObjectList[7].laneID "" SBYTE autosar_swc_val_CM_int8 0 0 -128 127 ECU_ADDRESS 0xfe4ca470 /* @ECU_Address@SwcOut_FCM_DrivingHmiEnv.StaticObjectList[7].laneID@ */ /end MEASUREMENT
/begin MEASUREMENT SwcOut_FCM_DrivingHmiEnv.StaticObjectList[7].objecWidth "" UWORD autosar_swc_val_CM_uint16 0 0 0 65535 ECU_ADDRESS 0xfe4ca462 /* @ECU_Address@SwcOut_FCM_DrivingHmiEnv.StaticObjectList[7].objecWidth@ */ /end MEASUREMENT
/begin MEASUREMENT SwcOut_FCM_DrivingHmiEnv.StaticObjectList[7].objectId "" UBYTE autosar_swc_val_CM_uint8 0 0 0 255 ECU_ADDRESS 0xfe4ca450 /* @ECU_Address@SwcOut_FCM_DrivingHmiEnv.StaticObjectList[7].objectId@ */ /end MEASUREMENT
/begin MEASUREMENT SwcOut_FCM_DrivingHmiEnv.StaticObjectList[7].objectLength "" UWORD autosar_swc_val_CM_uint16 0 0 0 65535 ECU_ADDRESS 0xfe4ca460 /* @ECU_Address@SwcOut_FCM_DrivingHmiEnv.StaticObjectList[7].objectLength@ */ /end MEASUREMENT
/begin MEASUREMENT SwcOut_FCM_DrivingHmiEnv.StaticObjectList[7].objectPoseX "" FLOAT32_IEEE autosar_swc_val_CM_single 0 0 -3.4E+38 3.4E+38 ECU_ADDRESS 0xfe4ca454 /* @ECU_Address@SwcOut_FCM_DrivingHmiEnv.StaticObjectList[7].objectPoseX@ */ /end MEASUREMENT
/begin MEASUREMENT SwcOut_FCM_DrivingHmiEnv.StaticObjectList[7].objectPoseY "" FLOAT32_IEEE autosar_swc_val_CM_single 0 0 -3.4E+38 3.4E+38 ECU_ADDRESS 0xfe4ca458 /* @ECU_Address@SwcOut_FCM_DrivingHmiEnv.StaticObjectList[7].objectPoseY@ */ /end MEASUREMENT
/begin MEASUREMENT SwcOut_FCM_DrivingHmiEnv.StaticObjectList[7].objectType "" UBYTE autosar_swc_val_CM_uint8 0 0 0 255 ECU_ADDRESS 0xfe4ca451 /* @ECU_Address@SwcOut_FCM_DrivingHmiEnv.StaticObjectList[7].objectType@ */ /end MEASUREMENT
/begin MEASUREMENT SwcOut_FCM_DrivingHmiEnv.StaticObjectList[7].objectYaw "" FLOAT32_IEEE autosar_swc_val_CM_single 0 0 -3.4E+38 3.4E+38 ECU_ADDRESS 0xfe4ca45c /* @ECU_Address@SwcOut_FCM_DrivingHmiEnv.StaticObjectList[7].objectYaw@ */ /end MEASUREMENT
/begin MEASUREMENT SwcOut_FCM_DrivingHmiEnv.StaticObjectList[7].timestampnSec "" A_UINT64 autosar_swc_val_CM_uint64 0 0 0.0 1.844674407370955e+19 ECU_ADDRESS 0xfe4ca468 /* @ECU_Address@SwcOut_FCM_DrivingHmiEnv.StaticObjectList[7].timestampnSec@ */ /end MEASUREMENT
/begin MEASUREMENT SwcOut_FCM_DrivingHmiEnv.StaticObjectList[8].laneID "" SBYTE autosar_swc_val_CM_int8 0 0 -128 127 ECU_ADDRESS 0xfe4ca498 /* @ECU_Address@SwcOut_FCM_DrivingHmiEnv.StaticObjectList[8].laneID@ */ /end MEASUREMENT
/begin MEASUREMENT SwcOut_FCM_DrivingHmiEnv.StaticObjectList[8].objecWidth "" UWORD autosar_swc_val_CM_uint16 0 0 0 65535 ECU_ADDRESS 0xfe4ca48a /* @ECU_Address@SwcOut_FCM_DrivingHmiEnv.StaticObjectList[8].objecWidth@ */ /end MEASUREMENT
/begin MEASUREMENT SwcOut_FCM_DrivingHmiEnv.StaticObjectList[8].objectId "" UBYTE autosar_swc_val_CM_uint8 0 0 0 255 ECU_ADDRESS 0xfe4ca478 /* @ECU_Address@SwcOut_FCM_DrivingHmiEnv.StaticObjectList[8].objectId@ */ /end MEASUREMENT
/begin MEASUREMENT SwcOut_FCM_DrivingHmiEnv.StaticObjectList[8].objectLength "" UWORD autosar_swc_val_CM_uint16 0 0 0 65535 ECU_ADDRESS 0xfe4ca488 /* @ECU_Address@SwcOut_FCM_DrivingHmiEnv.StaticObjectList[8].objectLength@ */ /end MEASUREMENT
/begin MEASUREMENT SwcOut_FCM_DrivingHmiEnv.StaticObjectList[8].objectPoseX "" FLOAT32_IEEE autosar_swc_val_CM_single 0 0 -3.4E+38 3.4E+38 ECU_ADDRESS 0xfe4ca47c /* @ECU_Address@SwcOut_FCM_DrivingHmiEnv.StaticObjectList[8].objectPoseX@ */ /end MEASUREMENT
/begin MEASUREMENT SwcOut_FCM_DrivingHmiEnv.StaticObjectList[8].objectPoseY "" FLOAT32_IEEE autosar_swc_val_CM_single 0 0 -3.4E+38 3.4E+38 ECU_ADDRESS 0xfe4ca480 /* @ECU_Address@SwcOut_FCM_DrivingHmiEnv.StaticObjectList[8].objectPoseY@ */ /end MEASUREMENT
/begin MEASUREMENT SwcOut_FCM_DrivingHmiEnv.StaticObjectList[8].objectType "" UBYTE autosar_swc_val_CM_uint8 0 0 0 255 ECU_ADDRESS 0xfe4ca479 /* @ECU_Address@SwcOut_FCM_DrivingHmiEnv.StaticObjectList[8].objectType@ */ /end MEASUREMENT
/begin MEASUREMENT SwcOut_FCM_DrivingHmiEnv.StaticObjectList[8].objectYaw "" FLOAT32_IEEE autosar_swc_val_CM_single 0 0 -3.4E+38 3.4E+38 ECU_ADDRESS 0xfe4ca484 /* @ECU_Address@SwcOut_FCM_DrivingHmiEnv.StaticObjectList[8].objectYaw@ */ /end MEASUREMENT
/begin MEASUREMENT SwcOut_FCM_DrivingHmiEnv.StaticObjectList[8].timestampnSec "" A_UINT64 autosar_swc_val_CM_uint64 0 0 0.0 1.844674407370955e+19 ECU_ADDRESS 0xfe4ca490 /* @ECU_Address@SwcOut_FCM_DrivingHmiEnv.StaticObjectList[8].timestampnSec@ */ /end MEASUREMENT
/begin MEASUREMENT SwcOut_FCM_DrivingHmiEnv.StaticObjectList[9].laneID "" SBYTE autosar_swc_val_CM_int8 0 0 -128 127 ECU_ADDRESS 0xfe4ca4c0 /* @ECU_Address@SwcOut_FCM_DrivingHmiEnv.StaticObjectList[9].laneID@ */ /end MEASUREMENT
/begin MEASUREMENT SwcOut_FCM_DrivingHmiEnv.StaticObjectList[9].objecWidth "" UWORD autosar_swc_val_CM_uint16 0 0 0 65535 ECU_ADDRESS 0xfe4ca4b2 /* @ECU_Address@SwcOut_FCM_DrivingHmiEnv.StaticObjectList[9].objecWidth@ */ /end MEASUREMENT
/begin MEASUREMENT SwcOut_FCM_DrivingHmiEnv.StaticObjectList[9].objectId "" UBYTE autosar_swc_val_CM_uint8 0 0 0 255 ECU_ADDRESS 0xfe4ca4a0 /* @ECU_Address@SwcOut_FCM_DrivingHmiEnv.StaticObjectList[9].objectId@ */ /end MEASUREMENT
/begin MEASUREMENT SwcOut_FCM_DrivingHmiEnv.StaticObjectList[9].objectLength "" UWORD autosar_swc_val_CM_uint16 0 0 0 65535 ECU_ADDRESS 0xfe4ca4b0 /* @ECU_Address@SwcOut_FCM_DrivingHmiEnv.StaticObjectList[9].objectLength@ */ /end MEASUREMENT
/begin MEASUREMENT SwcOut_FCM_DrivingHmiEnv.StaticObjectList[9].objectPoseX "" FLOAT32_IEEE autosar_swc_val_CM_single 0 0 -3.4E+38 3.4E+38 ECU_ADDRESS 0xfe4ca4a4 /* @ECU_Address@SwcOut_FCM_DrivingHmiEnv.StaticObjectList[9].objectPoseX@ */ /end MEASUREMENT
/begin MEASUREMENT SwcOut_FCM_DrivingHmiEnv.StaticObjectList[9].objectPoseY "" FLOAT32_IEEE autosar_swc_val_CM_single 0 0 -3.4E+38 3.4E+38 ECU_ADDRESS 0xfe4ca4a8 /* @ECU_Address@SwcOut_FCM_DrivingHmiEnv.StaticObjectList[9].objectPoseY@ */ /end MEASUREMENT
/begin MEASUREMENT SwcOut_FCM_DrivingHmiEnv.StaticObjectList[9].objectType "" UBYTE autosar_swc_val_CM_uint8 0 0 0 255 ECU_ADDRESS 0xfe4ca4a1 /* @ECU_Address@SwcOut_FCM_DrivingHmiEnv.StaticObjectList[9].objectType@ */ /end MEASUREMENT
/begin MEASUREMENT SwcOut_FCM_DrivingHmiEnv.StaticObjectList[9].objectYaw "" FLOAT32_IEEE autosar_swc_val_CM_single 0 0 -3.4E+38 3.4E+38 ECU_ADDRESS 0xfe4ca4ac /* @ECU_Address@SwcOut_FCM_DrivingHmiEnv.StaticObjectList[9].objectYaw@ */ /end MEASUREMENT
/begin MEASUREMENT SwcOut_FCM_DrivingHmiEnv.StaticObjectList[9].timestampnSec "" A_UINT64 autosar_swc_val_CM_uint64 0 0 0.0 1.844674407370955e+19 ECU_ADDRESS 0xfe4ca4b8 /* @ECU_Address@SwcOut_FCM_DrivingHmiEnv.StaticObjectList[9].timestampnSec@ */ /end MEASUREMENT
/begin MEASUREMENT autosar_swc_val_rtARID_DEF.ARID_DEF_Chart.TimeCnt "" UBYTE autosar_swc_val_CM_uint8 0 0 0 255 ECU_ADDRESS 0xfe4ca943 /* @ECU_Address@autosar_swc_val_rtARID_DEF.ARID_DEF_Chart.TimeCnt@ */ /end MEASUREMENT
/begin MEASUREMENT autosar_swc_val_rtARID_DEF.ARID_DEF_Chart.is_active_c131_autosar_swc_val "" UBYTE autosar_swc_val_CM_uint8 0 0 0 255 ECU_ADDRESS 0xfe4ca944 /* @ECU_Address@autosar_swc_val_rtARID_DEF.ARID_DEF_Chart.is_active_c131_autosar_swc_val@ */ /end MEASUREMENT
/begin MEASUREMENT autosar_swc_val_rtARID_DEF.ARID_DEF_Chart.is_c131_autosar_swc_val "" UBYTE autosar_swc_val_CM_uint8 0 0 0 255 ECU_ADDRESS 0xfe4ca945 /* @ECU_Address@autosar_swc_val_rtARID_DEF.ARID_DEF_Chart.is_c131_autosar_swc_val@ */ /end MEASUREMENT
/begin MEASUREMENT autosar_swc_val_rtARID_DEF.ARID_DEF_Chart1.TimeCnt "" UBYTE autosar_swc_val_CM_uint8 0 0 0 255 ECU_ADDRESS 0xfe4ca940 /* @ECU_Address@autosar_swc_val_rtARID_DEF.ARID_DEF_Chart1.TimeCnt@ */ /end MEASUREMENT
/begin MEASUREMENT autosar_swc_val_rtARID_DEF.ARID_DEF_Chart1.is_active_c131_autosar_swc_val "" UBYTE autosar_swc_val_CM_uint8 0 0 0 255 ECU_ADDRESS 0xfe4ca941 /* @ECU_Address@autosar_swc_val_rtARID_DEF.ARID_DEF_Chart1.is_active_c131_autosar_swc_val@ */ /end MEASUREMENT
/begin MEASUREMENT autosar_swc_val_rtARID_DEF.ARID_DEF_Chart1.is_c131_autosar_swc_val "" UBYTE autosar_swc_val_CM_uint8 0 0 0 255 ECU_ADDRESS 0xfe4ca942 /* @ECU_Address@autosar_swc_val_rtARID_DEF.ARID_DEF_Chart1.is_c131_autosar_swc_val@ */ /end MEASUREMENT
/begin MEASUREMENT autosar_swc_val_rtARID_DEF.ARID_DEF_Chart1_k.is_active_c29_autosar_swc_val "" UBYTE autosar_swc_val_CM_uint8 0 0 0 255 ECU_ADDRESS 0xfe4ca972 /* @ECU_Address@autosar_swc_val_rtARID_DEF.ARID_DEF_Chart1_k.is_active_c29_autosar_swc_val@ */ /end MEASUREMENT
/begin MEASUREMENT autosar_swc_val_rtARID_DEF.ARID_DEF_Chart1_k.is_c29_autosar_swc_val "" UBYTE autosar_swc_val_CM_uint8 0 0 0 255 ECU_ADDRESS 0xfe4ca973 /* @ECU_Address@autosar_swc_val_rtARID_DEF.ARID_DEF_Chart1_k.is_c29_autosar_swc_val@ */ /end MEASUREMENT
/begin MEASUREMENT autosar_swc_val_rtARID_DEF.ARID_DEF_Chart1_m.Cnt "" UBYTE autosar_swc_val_CM_uint8 0 0 0 255 ECU_ADDRESS 0xfe4ca946 /* @ECU_Address@autosar_swc_val_rtARID_DEF.ARID_DEF_Chart1_m.Cnt@ */ /end MEASUREMENT
/begin MEASUREMENT autosar_swc_val_rtARID_DEF.ARID_DEF_Chart1_m.is_active_c123_autosar_swc_val "" UBYTE autosar_swc_val_CM_uint8 0 0 0 255 ECU_ADDRESS 0xfe4ca947 /* @ECU_Address@autosar_swc_val_rtARID_DEF.ARID_DEF_Chart1_m.is_active_c123_autosar_swc_val@ */ /end MEASUREMENT
/begin MEASUREMENT autosar_swc_val_rtARID_DEF.ARID_DEF_Chart1_m.is_c123_autosar_swc_val "" UBYTE autosar_swc_val_CM_uint8 0 0 0 255 ECU_ADDRESS 0xfe4ca948 /* @ECU_Address@autosar_swc_val_rtARID_DEF.ARID_DEF_Chart1_m.is_c123_autosar_swc_val@ */ /end MEASUREMENT
/begin MEASUREMENT autosar_swc_val_rtARID_DEF.ARID_DEF_Chart2.is_active_c53_autosar_swc_val "" UBYTE autosar_swc_val_CM_uint8 0 0 0 255 ECU_ADDRESS 0xfe4ca968 /* @ECU_Address@autosar_swc_val_rtARID_DEF.ARID_DEF_Chart2.is_active_c53_autosar_swc_val@ */ /end MEASUREMENT
/begin MEASUREMENT autosar_swc_val_rtARID_DEF.ARID_DEF_Chart2.is_c53_autosar_swc_val "" UBYTE autosar_swc_val_CM_uint8 0 0 0 255 ECU_ADDRESS 0xfe4ca969 /* @ECU_Address@autosar_swc_val_rtARID_DEF.ARID_DEF_Chart2.is_c53_autosar_swc_val@ */ /end MEASUREMENT
/begin MEASUREMENT autosar_swc_val_rtARID_DEF.ARID_DEF_Chart2.time "" FLOAT64_IEEE autosar_swc_val_CM_double 0 0 -1.7E+308 1.7E+308 ECU_ADDRESS 0xfe4ca960 /* @ECU_Address@autosar_swc_val_rtARID_DEF.ARID_DEF_Chart2.time@ */ /end MEASUREMENT
/begin MEASUREMENT autosar_swc_val_rtARID_DEF.ARID_DEF_Chart2_c.is_active_c74_autosar_swc_val "" UBYTE autosar_swc_val_CM_uint8 0 0 0 255 ECU_ADDRESS 0xfe4ca978 /* @ECU_Address@autosar_swc_val_rtARID_DEF.ARID_DEF_Chart2_c.is_active_c74_autosar_swc_val@ */ /end MEASUREMENT
/begin MEASUREMENT autosar_swc_val_rtARID_DEF.ARID_DEF_Chart2_c.is_c74_autosar_swc_val "" UBYTE autosar_swc_val_CM_uint8 0 0 0 255 ECU_ADDRESS 0xfe4ca979 /* @ECU_Address@autosar_swc_val_rtARID_DEF.ARID_DEF_Chart2_c.is_c74_autosar_swc_val@ */ /end MEASUREMENT
/begin MEASUREMENT autosar_swc_val_rtARID_DEF.ARID_DEF_Chart2_c.step "" UBYTE autosar_swc_val_CM_uint8 0 0 0 255 ECU_ADDRESS 0xfe4ca977 /* @ECU_Address@autosar_swc_val_rtARID_DEF.ARID_DEF_Chart2_c.step@ */ /end MEASUREMENT
/begin MEASUREMENT autosar_swc_val_rtARID_DEF.ARID_DEF_Chart3.is_active_c29_autosar_swc_val "" UBYTE autosar_swc_val_CM_uint8 0 0 0 255 ECU_ADDRESS 0xfe4ca970 /* @ECU_Address@autosar_swc_val_rtARID_DEF.ARID_DEF_Chart3.is_active_c29_autosar_swc_val@ */ /end MEASUREMENT
/begin MEASUREMENT autosar_swc_val_rtARID_DEF.ARID_DEF_Chart3.is_c29_autosar_swc_val "" UBYTE autosar_swc_val_CM_uint8 0 0 0 255 ECU_ADDRESS 0xfe4ca971 /* @ECU_Address@autosar_swc_val_rtARID_DEF.ARID_DEF_Chart3.is_c29_autosar_swc_val@ */ /end MEASUREMENT
/begin MEASUREMENT autosar_swc_val_rtARID_DEF.ARID_DEF_Chart4.is_active_c74_autosar_swc_val "" UBYTE autosar_swc_val_CM_uint8 0 0 0 255 ECU_ADDRESS 0xfe4ca975 /* @ECU_Address@autosar_swc_val_rtARID_DEF.ARID_DEF_Chart4.is_active_c74_autosar_swc_val@ */ /end MEASUREMENT
/begin MEASUREMENT autosar_swc_val_rtARID_DEF.ARID_DEF_Chart4.is_c74_autosar_swc_val "" UBYTE autosar_swc_val_CM_uint8 0 0 0 255 ECU_ADDRESS 0xfe4ca976 /* @ECU_Address@autosar_swc_val_rtARID_DEF.ARID_DEF_Chart4.is_c74_autosar_swc_val@ */ /end MEASUREMENT
/begin MEASUREMENT autosar_swc_val_rtARID_DEF.ARID_DEF_Chart4.step "" UBYTE autosar_swc_val_CM_uint8 0 0 0 255 ECU_ADDRESS 0xfe4ca974 /* @ECU_Address@autosar_swc_val_rtARID_DEF.ARID_DEF_Chart4.step@ */ /end MEASUREMENT
/begin MEASUREMENT autosar_swc_val_rtARID_DEF.ARID_DEF_Chart6.is_active_c53_autosar_swc_val "" UBYTE autosar_swc_val_CM_uint8 0 0 0 255 ECU_ADDRESS 0xfe4ca958 /* @ECU_Address@autosar_swc_val_rtARID_DEF.ARID_DEF_Chart6.is_active_c53_autosar_swc_val@ */ /end MEASUREMENT
/begin COMPU_METHOD autosar_swc_val_CM_boolean "Q = V" IDENTICAL "%1.0" "" /end COMPU_METHOD
/begin COMPU_METHOD autosar_swc_val_CM_double "Q = V" IDENTICAL "%15.10" "" /end COMPU_METHOD
/begin COMPU_METHOD autosar_swc_val_CM_int16 "Q = V" IDENTICAL "%5.0" "" /end COMPU_METHOD
/begin COMPU_METHOD autosar_swc_val_CM_int32 "Q = V" IDENTICAL "%10.0" "" /end COMPU_METHOD
/begin COMPU_METHOD autosar_swc_val_CM_int8 "Q = V" IDENTICAL "%3.0" "" /end COMPU_METHOD
/begin COMPU_METHOD autosar_swc_val_CM_single "Q = V" IDENTICAL "%8.6" "" /end COMPU_METHOD
/begin COMPU_METHOD autosar_swc_val_CM_uint16 "Q = V" IDENTICAL "%5.0" "" /end COMPU_METHOD
/begin COMPU_METHOD autosar_swc_val_CM_uint32 "Q = V" IDENTICAL "%10.0" "" /end COMPU_METHOD
/begin COMPU_METHOD autosar_swc_val_CM_uint64 "Q = V" IDENTICAL "%20.0" "" /end COMPU_METHOD
/begin COMPU_METHOD autosar_swc_val_CM_uint8 "Q = V" IDENTICAL "%3.0" "" /end COMPU_METHOD
/begin RECORD_LAYOUT Record_FLOAT32_IEEE FNC_VALUES 1 FLOAT32_IEEE COLUMN_DIR DIRECT /end RECORD_LAYOUT
/begin RECORD_LAYOUT Record_SBYTE FNC_VALUES 1 SBYTE COLUMN_DIR DIRECT /end RECORD_LAYOUT
/begin RECORD_LAYOUT Record_SWORD FNC_VALUES 1 SWORD COLUMN_DIR DIRECT /end RECORD_LAYOUT
/begin RECORD_LAYOUT Record_UBYTE FNC_VALUES 1 UBYTE COLUMN_DIR DIRECT /end RECORD_LAYOUT
/begin RECORD_LAYOUT Record_ULONG FNC_VALUES 1 ULONG COLUMN_DIR DIRECT /end RECORD_LAYOUT
/begin RECORD_LAYOUT Record_UWORD FNC_VALUES 1 UWORD COLUMN_DIR DIRECT /end RECORD_LAYOUT
/end MODULE
/end PROJECT
