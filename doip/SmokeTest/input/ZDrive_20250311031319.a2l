ASAP2_VERSION 1 71
/begin PROJECT ProjectName ""
/begin MODULE ModuleName ""
/begin MOD_COMMON "" BYTE_ORDER MSB_LAST ALIGNMENT_BYTE 1 ALIGNMENT_WORD 1 ALIGNMENT_LONG 1 ALIGNMENT_INT64 1 ALIGNMENT_FLOAT16_IEEE 1 ALIGNMENT_FLOAT32_IEEE 1 ALIGNMENT_FLOAT64_IEEE 1 /end MOD_COMMON
/begin RECORD_LAYOUT SSV__SBYTE_S AXIS_PTS_X 1 SBYTE INDEX_INCR DIRECT /end RECORD_LAYOUT
/begin RECORD_LAYOUT SSV__SWORD_S AXIS_PTS_X 1 SWORD INDEX_INCR DIRECT /end RECORD_LAYOUT
/begin RECORD_LAYOUT Record_BOOLEAN FNC_VALUES 1 UBYTE COLUMN_DIR DIRECT /end RECORD_LAYOUT
/begin RECORD_LAYOUT Record_FLOAT32_IEEE FNC_VALUES 1 FLOAT32_IEEE COLUMN_DIR DIRECT /end RECORD_LAYOUT
/begin RECORD_LAYOUT Record_FLOAT64_IEEE FNC_VALUES 1 FLOAT64_IEEE COLUMN_DIR DIRECT /end RECORD_LAYOUT
/begin RECORD_LAYOUT Record_UBYTE FNC_VALUES 1 UBYTE COLUMN_DIR DIRECT /end RECORD_LAYOUT
/begin RECORD_LAYOUT Record_UWORD FNC_VALUES 1 UWORD COLUMN_DIR DIRECT /end RECORD_LAYOUT
/begin RECORD_LAYOUT Axis_FLOAT32_IEEE AXIS_PTS_X 1 FLOAT32_IEEE INDEX_INCR DIRECT /end RECORD_LAYOUT
/begin RECORD_LAYOUT Record_BOOLEAN FNC_VALUES 1 UBYTE COLUMN_DIR DIRECT /end RECORD_LAYOUT
/begin RECORD_LAYOUT Record_FLOAT32_IEEE FNC_VALUES 1 FLOAT32_IEEE COLUMN_DIR DIRECT /end RECORD_LAYOUT
/begin RECORD_LAYOUT Record_UBYTE FNC_VALUES 1 UBYTE COLUMN_DIR DIRECT /end RECORD_LAYOUT
/begin RECORD_LAYOUT Record_UWORD FNC_VALUES 1 UWORD COLUMN_DIR DIRECT /end RECORD_LAYOUT
/begin RECORD_LAYOUT Axis_FLOAT32_IEEE AXIS_PTS_X 1 FLOAT32_IEEE INDEX_INCR DIRECT /end RECORD_LAYOUT
/begin RECORD_LAYOUT Record_BOOLEAN FNC_VALUES 1 UBYTE COLUMN_DIR DIRECT /end RECORD_LAYOUT
/begin RECORD_LAYOUT Record_FLOAT32_IEEE FNC_VALUES 1 FLOAT32_IEEE COLUMN_DIR DIRECT /end RECORD_LAYOUT
/begin RECORD_LAYOUT Record_FLOAT64_IEEE FNC_VALUES 1 FLOAT64_IEEE COLUMN_DIR DIRECT /end RECORD_LAYOUT
/begin RECORD_LAYOUT Record_UBYTE FNC_VALUES 1 UBYTE COLUMN_DIR DIRECT /end RECORD_LAYOUT
/begin RECORD_LAYOUT Record_BOOLEAN FNC_VALUES 1 UBYTE COLUMN_DIR DIRECT /end RECORD_LAYOUT
/begin RECORD_LAYOUT Record_FLOAT32_IEEE FNC_VALUES 1 FLOAT32_IEEE COLUMN_DIR DIRECT /end RECORD_LAYOUT
/begin RECORD_LAYOUT Record_UBYTE FNC_VALUES 1 UBYTE COLUMN_DIR DIRECT /end RECORD_LAYOUT
/begin RECORD_LAYOUT Record_UWORD FNC_VALUES 1 UWORD COLUMN_DIR DIRECT /end RECORD_LAYOUT
/begin RECORD_LAYOUT Axis_FLOAT32_IEEE AXIS_PTS_X 1 FLOAT32_IEEE INDEX_INCR DIRECT /end RECORD_LAYOUT
/begin CHARACTERISTIC P_LSS_ELK_NoRepaireTime "" VALUE 0xfe821134 /* @ECU_Address@P_LSS_ELK_NoRepaireTime@ */ Record_FLOAT32_IEEE 0 autosar_swc_las_CM_single -3.4E+38 3.4E+38 /end CHARACTERISTIC
/begin CHARACTERISTIC P_LSS_LDPOverRideMaxTime "" VALUE 0xfe821254 /* @ECU_Address@P_LSS_LDPOverRideMaxTime@ */ Record_FLOAT32_IEEE 0 autosar_swc_las_CM_single -3.4E+38 3.4E+38 /end CHARACTERISTIC
/begin CHARACTERISTIC P_LSS_LDP_ActiveInterval "" VALUE 0xfe82125c /* @ECU_Address@P_LSS_LDP_ActiveInterval@ */ Record_FLOAT32_IEEE 0 autosar_swc_las_CM_single -3.4E+38 3.4E+38 /end CHARACTERISTIC
/begin CHARACTERISTIC P_LSS_LDP_ActiveOverTIme "" VALUE 0xfe821260 /* @ECU_Address@P_LSS_LDP_ActiveOverTIme@ */ Record_FLOAT32_IEEE 0 autosar_swc_las_CM_single -3.4E+38 3.4E+38 /end CHARACTERISTIC
/begin CHARACTERISTIC P_LSS_LDP_PredicteSwitch "" VALUE 0xfe821468 /* @ECU_Address@P_LSS_LDP_PredicteSwitch@ */ Record_BOOLEAN 0 autosar_swc_las_CM_boolean 0 1 /end CHARACTERISTIC
/begin CHARACTERISTIC P_LSS_LDP_State_Param_CureLaneWidth_offsetfactor "" CURVE 0xfe821870 /* @ECU_Address@P_LSS_LDP_State_Param_CureLaneWidth_offsetfactor@ */ Record_FLOAT32_IEEE 0 autosar_swc_las_CM_single -3.4E+38 3.4E+38
 /begin AXIS_DESCR COM_AXIS NO_INPUT_QUANTITY autosar_swc_las_CM_single 7 -3.4E+38 3.4E+38 AXIS_PTS_REF P_LSS_LDP_State_Param_CureLaneWidth /end AXIS_DESCR
/end CHARACTERISTIC
/begin CHARACTERISTIC P_LSS_LDP_SteerSpd2IDEL_SteerSpdFactor "" VALUE 0xfe82143c /* @ECU_Address@P_LSS_LDP_SteerSpd2IDEL_SteerSpdFactor@ */ Record_UWORD 0 autosar_swc_las_CM_uint16 0 65535 /end CHARACTERISTIC
/begin CHARACTERISTIC P_LSS_LDP_SteerSpd2IEDL_VehicleSpdFactor "" VALUE 0xfe82143e /* @ECU_Address@P_LSS_LDP_SteerSpd2IEDL_VehicleSpdFactor@ */ Record_UWORD 0 autosar_swc_las_CM_uint16 0 65535 /end CHARACTERISTIC
/begin CHARACTERISTIC P_LSS_LDP_SteerSpd2Ready_SteerSpdFactor "" VALUE 0xfe821440 /* @ECU_Address@P_LSS_LDP_SteerSpd2Ready_SteerSpdFactor@ */ Record_UWORD 0 autosar_swc_las_CM_uint16 0 65535 /end CHARACTERISTIC
/begin CHARACTERISTIC P_LSS_LDP_SteerSpd2Ready_VehicleSpdFactor "" VALUE 0xfe821442 /* @ECU_Address@P_LSS_LDP_SteerSpd2Ready_VehicleSpdFactor@ */ Record_UWORD 0 autosar_swc_las_CM_uint16 0 65535 /end CHARACTERISTIC
/begin CHARACTERISTIC P_LSS_LDP_TimeCompensatePre "" VALUE 0xfe821270 /* @ECU_Address@P_LSS_LDP_TimeCompensatePre@ */ Record_FLOAT32_IEEE 0 autosar_swc_las_CM_single -3.4E+38 3.4E+38 /end CHARACTERISTIC
/begin CHARACTERISTIC P_LSS_LDW_Configure "" VALUE 0xfe821469 /* @ECU_Address@P_LSS_LDW_Configure@ */ Record_UBYTE 0 autosar_swc_las_CM_uint8 0 255 /end CHARACTERISTIC
/begin CHARACTERISTIC P_LSS_LDW_ConfigureSW "" VALUE 0xfe82146a /* @ECU_Address@P_LSS_LDW_ConfigureSW@ */ Record_BOOLEAN 0 autosar_swc_las_CM_boolean 0 1 /end CHARACTERISTIC
/begin CHARACTERISTIC P_LSS_LDW_State_Param_LaneTime "" CURVE 0xfe8216f8 /* @ECU_Address@P_LSS_LDW_State_Param_LaneTime@ */ Record_FLOAT32_IEEE 0 autosar_swc_las_CM_single -3.4E+38 3.4E+38
 /begin AXIS_DESCR COM_AXIS NO_INPUT_QUANTITY autosar_swc_las_CM_single 16 -3.4E+38 3.4E+38 AXIS_PTS_REF P_LSS_LDW_State_Param_Speed /end AXIS_DESCR
/end CHARACTERISTIC
/begin CHARACTERISTIC P_LSS_LDW_TimeCompensatePre "" VALUE 0xfe821304 /* @ECU_Address@P_LSS_LDW_TimeCompensatePre@ */ Record_FLOAT32_IEEE 0 autosar_swc_las_CM_single -3.4E+38 3.4E+38 /end CHARACTERISTIC
/begin CHARACTERISTIC P_LSS_LDW_TurnLightInTime "" VALUE 0xfe821038 /* @ECU_Address@P_LSS_LDW_TurnLightInTime@ */ Record_FLOAT64_IEEE 0 autosar_swc_las_CM_double -1.7E+308 1.7E+308 /end CHARACTERISTIC
/begin CHARACTERISTIC P_LSS_LKA_AccPedalRateOutTime "" VALUE 0xfe821048 /* @ECU_Address@P_LSS_LKA_AccPedalRateOutTime@ */ Record_FLOAT64_IEEE 0 autosar_swc_las_CM_double -1.7E+308 1.7E+308 /end CHARACTERISTIC
/begin CHARACTERISTIC P_LSS_LKA_AccRateIn "" VALUE 0xfe821314 /* @ECU_Address@P_LSS_LKA_AccRateIn@ */ Record_FLOAT32_IEEE 0 autosar_swc_las_CM_single -3.4E+38 3.4E+38 /end CHARACTERISTIC
/begin CHARACTERISTIC P_LSS_LKA_AccRateInTime "" VALUE 0xfe821050 /* @ECU_Address@P_LSS_LKA_AccRateInTime@ */ Record_FLOAT64_IEEE 0 autosar_swc_las_CM_double -1.7E+308 1.7E+308 /end CHARACTERISTIC
/begin CHARACTERISTIC P_LSS_LKA_AccRateOut "" VALUE 0xfe821318 /* @ECU_Address@P_LSS_LKA_AccRateOut@ */ Record_FLOAT32_IEEE 0 autosar_swc_las_CM_single -3.4E+38 3.4E+38 /end CHARACTERISTIC
/begin CHARACTERISTIC P_LSS_LKA_BrakePressIn "" VALUE 0xfe82131c /* @ECU_Address@P_LSS_LKA_BrakePressIn@ */ Record_FLOAT32_IEEE 0 autosar_swc_las_CM_single -3.4E+38 3.4E+38 /end CHARACTERISTIC
/begin CHARACTERISTIC P_LSS_LKA_BrakePressInTime "" VALUE 0xfe821058 /* @ECU_Address@P_LSS_LKA_BrakePressInTime@ */ Record_FLOAT64_IEEE 0 autosar_swc_las_CM_double -1.7E+308 1.7E+308 /end CHARACTERISTIC
/begin CHARACTERISTIC P_LSS_LKA_BrakePressOut "" VALUE 0xfe821320 /* @ECU_Address@P_LSS_LKA_BrakePressOut@ */ Record_FLOAT32_IEEE 0 autosar_swc_las_CM_single -3.4E+38 3.4E+38 /end CHARACTERISTIC
/begin CHARACTERISTIC P_LSS_LKA_Configure "" VALUE 0xfe82146d /* @ECU_Address@P_LSS_LKA_Configure@ */ Record_UBYTE 0 autosar_swc_las_CM_uint8 0 255 /end CHARACTERISTIC
/begin CHARACTERISTIC P_LSS_LKA_ConfigureSW "" VALUE 0xfe82146e /* @ECU_Address@P_LSS_LKA_ConfigureSW@ */ Record_BOOLEAN 0 autosar_swc_las_CM_boolean 0 1 /end CHARACTERISTIC
/begin CHARACTERISTIC P_LSS_LKA_CurveFactor "" VALUE 0xfe821324 /* @ECU_Address@P_LSS_LKA_CurveFactor@ */ Record_FLOAT32_IEEE 0 autosar_swc_las_CM_single -3.4E+38 3.4E+38 /end CHARACTERISTIC
/begin CHARACTERISTIC P_LSS_LKA_DriverInputTrqValueIn "" VALUE 0xfe821328 /* @ECU_Address@P_LSS_LKA_DriverInputTrqValueIn@ */ Record_FLOAT32_IEEE 0 autosar_swc_las_CM_single -3.4E+38 3.4E+38 /end CHARACTERISTIC
/begin CHARACTERISTIC P_LSS_LKA_DriverInputTrqValueOut "" VALUE 0xfe82132c /* @ECU_Address@P_LSS_LKA_DriverInputTrqValueOut@ */ Record_FLOAT32_IEEE 0 autosar_swc_las_CM_single -3.4E+38 3.4E+38 /end CHARACTERISTIC
/begin CHARACTERISTIC P_LSS_LKA_DriverInputTrqValueOutTime "" VALUE 0xfe821060 /* @ECU_Address@P_LSS_LKA_DriverInputTrqValueOutTime@ */ Record_FLOAT64_IEEE 0 autosar_swc_las_CM_double -1.7E+308 1.7E+308 /end CHARACTERISTIC
/begin CHARACTERISTIC P_LSS_LKA_DriverInputTrq_enable "" VALUE 0xfe821330 /* @ECU_Address@P_LSS_LKA_DriverInputTrq_enable@ */ Record_FLOAT32_IEEE 0 autosar_swc_las_CM_single -3.4E+38 3.4E+38 /end CHARACTERISTIC
/begin CHARACTERISTIC P_LSS_LKA_EndSwitch "" VALUE 0xfe82146f /* @ECU_Address@P_LSS_LKA_EndSwitch@ */ Record_BOOLEAN 0 autosar_swc_las_CM_boolean 0 1 /end CHARACTERISTIC
/begin CHARACTERISTIC P_LSS_LKA_InterSw "" VALUE 0xfe821470 /* @ECU_Address@P_LSS_LKA_InterSw@ */ Record_BOOLEAN 0 autosar_swc_las_CM_boolean 0 1 /end CHARACTERISTIC
/begin CHARACTERISTIC P_LSS_LKA_LaneCurveIn "" VALUE 0xfe821334 /* @ECU_Address@P_LSS_LKA_LaneCurveIn@ */ Record_FLOAT32_IEEE 0 autosar_swc_las_CM_single -3.4E+38 3.4E+38 /end CHARACTERISTIC
/begin CHARACTERISTIC P_LSS_LKA_LaneCurveOut "" VALUE 0xfe821338 /* @ECU_Address@P_LSS_LKA_LaneCurveOut@ */ Record_FLOAT32_IEEE 0 autosar_swc_las_CM_single -3.4E+38 3.4E+38 /end CHARACTERISTIC
/begin CHARACTERISTIC P_LSS_LKA_LaneInWidth_m "" VALUE 0xfe82133c /* @ECU_Address@P_LSS_LKA_LaneInWidth_m@ */ Record_FLOAT32_IEEE 0 autosar_swc_las_CM_single -3.4E+38 3.4E+38 /end CHARACTERISTIC
/begin CHARACTERISTIC P_LSS_LKA_LaneOutWidth_m "" VALUE 0xfe821340 /* @ECU_Address@P_LSS_LKA_LaneOutWidth_m@ */ Record_FLOAT32_IEEE 0 autosar_swc_las_CM_single -3.4E+38 3.4E+38 /end CHARACTERISTIC
/begin CHARACTERISTIC P_LSS_LKA_LeftActiveAffirmTime_s "" VALUE 0xfe821344 /* @ECU_Address@P_LSS_LKA_LeftActiveAffirmTime_s@ */ Record_FLOAT32_IEEE 0 autosar_swc_las_CM_single -3.4E+38 3.4E+38 /end CHARACTERISTIC
/begin CHARACTERISTIC P_LSS_LKA_ObsFlagTime "" VALUE 0xfe821348 /* @ECU_Address@P_LSS_LKA_ObsFlagTime@ */ Record_FLOAT32_IEEE 0 autosar_swc_las_CM_single -3.4E+38 3.4E+38 /end CHARACTERISTIC
/begin CHARACTERISTIC P_LSS_LKA_OnComingObsDefault "" VALUE 0xfe821471 /* @ECU_Address@P_LSS_LKA_OnComingObsDefault@ */ Record_BOOLEAN 0 autosar_swc_las_CM_boolean 0 1 /end CHARACTERISTIC
/begin CHARACTERISTIC P_LSS_LKA_OnComingObsDetectSw "" VALUE 0xfe821472 /* @ECU_Address@P_LSS_LKA_OnComingObsDetectSw@ */ Record_BOOLEAN 0 autosar_swc_las_CM_boolean 0 1 /end CHARACTERISTIC
/begin CHARACTERISTIC P_LSS_LKA_RightActiveAffirmTime_s "" VALUE 0xfe82134c /* @ECU_Address@P_LSS_LKA_RightActiveAffirmTime_s@ */ Record_FLOAT32_IEEE 0 autosar_swc_las_CM_single -3.4E+38 3.4E+38 /end CHARACTERISTIC
/begin CHARACTERISTIC P_LSS_LKA_Sensitive_Switch "" VALUE 0xfe821473 /* @ECU_Address@P_LSS_LKA_Sensitive_Switch@ */ Record_BOOLEAN 0 autosar_swc_las_CM_boolean 0 1 /end CHARACTERISTIC
/begin CHARACTERISTIC P_LSS_LKA_State_AEBActive_enable "" VALUE 0xfe821358 /* @ECU_Address@P_LSS_LKA_State_AEBActive_enable@ */ Record_FLOAT32_IEEE 0 autosar_swc_las_CM_single -3.4E+38 3.4E+38 /end CHARACTERISTIC
/begin CHARACTERISTIC P_LSS_LKA_State_Absesp_enable "" VALUE 0xfe82135c /* @ECU_Address@P_LSS_LKA_State_Absesp_enable@ */ Record_FLOAT32_IEEE 0 autosar_swc_las_CM_single -3.4E+38 3.4E+38 /end CHARACTERISTIC
/begin CHARACTERISTIC P_LSS_LKA_State_Accpedalrate_enable "" VALUE 0xfe821360 /* @ECU_Address@P_LSS_LKA_State_Accpedalrate_enable@ */ Record_FLOAT32_IEEE 0 autosar_swc_las_CM_single -3.4E+38 3.4E+38 /end CHARACTERISTIC
/begin CHARACTERISTIC P_LSS_LKA_State_Breakpressure_enable "" VALUE 0xfe821364 /* @ECU_Address@P_LSS_LKA_State_Breakpressure_enable@ */ Record_FLOAT32_IEEE 0 autosar_swc_las_CM_single -3.4E+38 3.4E+38 /end CHARACTERISTIC
/begin CHARACTERISTIC P_LSS_LKA_State_DriverInputTrqValue_enableTime "" VALUE 0xfe821368 /* @ECU_Address@P_LSS_LKA_State_DriverInputTrqValue_enableTime@ */ Record_FLOAT32_IEEE 0 autosar_swc_las_CM_single -3.4E+38 3.4E+38 /end CHARACTERISTIC
/begin CHARACTERISTIC P_LSS_LKA_State_EPS_enable "" VALUE 0xfe82136c /* @ECU_Address@P_LSS_LKA_State_EPS_enable@ */ Record_FLOAT32_IEEE 0 autosar_swc_las_CM_single -3.4E+38 3.4E+38 /end CHARACTERISTIC
/begin CHARACTERISTIC P_LSS_LKA_State_ESP_enable "" VALUE 0xfe821370 /* @ECU_Address@P_LSS_LKA_State_ESP_enable@ */ Record_FLOAT32_IEEE 0 autosar_swc_las_CM_single -3.4E+38 3.4E+38 /end CHARACTERISTIC
/begin CHARACTERISTIC P_LSS_LKA_State_GEAR_enable "" VALUE 0xfe821374 /* @ECU_Address@P_LSS_LKA_State_GEAR_enable@ */ Record_FLOAT32_IEEE 0 autosar_swc_las_CM_single -3.4E+38 3.4E+38 /end CHARACTERISTIC
/begin CHARACTERISTIC P_LSS_LKA_State_HazardLmpSwtSts_enable "" VALUE 0xfe821378 /* @ECU_Address@P_LSS_LKA_State_HazardLmpSwtSts_enable@ */ Record_FLOAT32_IEEE 0 autosar_swc_las_CM_single -3.4E+38 3.4E+38 /end CHARACTERISTIC
/begin CHARACTERISTIC P_LSS_LKA_State_Inhibit_enable "" VALUE 0xfe821474 /* @ECU_Address@P_LSS_LKA_State_Inhibit_enable@ */ Record_BOOLEAN 0 autosar_swc_las_CM_boolean 0 1 /end CHARACTERISTIC
/begin CHARACTERISTIC P_LSS_LKA_State_LaneChange_enable "" VALUE 0xfe82137c /* @ECU_Address@P_LSS_LKA_State_LaneChange_enable@ */ Record_FLOAT32_IEEE 0 autosar_swc_las_CM_single -3.4E+38 3.4E+38 /end CHARACTERISTIC
/begin CHARACTERISTIC P_LSS_LKA_State_Lane_enable "" VALUE 0xfe821380 /* @ECU_Address@P_LSS_LKA_State_Lane_enable@ */ Record_FLOAT32_IEEE 0 autosar_swc_las_CM_single -3.4E+38 3.4E+38 /end CHARACTERISTIC
/begin CHARACTERISTIC P_LSS_LKA_State_Lanecurve_enable "" VALUE 0xfe821384 /* @ECU_Address@P_LSS_LKA_State_Lanecurve_enable@ */ Record_FLOAT32_IEEE 0 autosar_swc_las_CM_single -3.4E+38 3.4E+38 /end CHARACTERISTIC
/begin CHARACTERISTIC P_LSS_LKA_State_MaxVehspeedInValue "" VALUE 0xfe821388 /* @ECU_Address@P_LSS_LKA_State_MaxVehspeedInValue@ */ Record_FLOAT32_IEEE 0 autosar_swc_las_CM_single -3.4E+38 3.4E+38 /end CHARACTERISTIC
/begin CHARACTERISTIC P_LSS_LKA_State_MaxVehspeedOutValue "" VALUE 0xfe82138c /* @ECU_Address@P_LSS_LKA_State_MaxVehspeedOutValue@ */ Record_FLOAT32_IEEE 0 autosar_swc_las_CM_single -3.4E+38 3.4E+38 /end CHARACTERISTIC
/begin CHARACTERISTIC P_LSS_LKA_State_MinVehspeedInValue "" VALUE 0xfe821390 /* @ECU_Address@P_LSS_LKA_State_MinVehspeedInValue@ */ Record_FLOAT32_IEEE 0 autosar_swc_las_CM_single -3.4E+38 3.4E+38 /end CHARACTERISTIC
/begin CHARACTERISTIC P_LSS_LKA_State_MinVehspeedOutValue "" VALUE 0xfe821394 /* @ECU_Address@P_LSS_LKA_State_MinVehspeedOutValue@ */ Record_FLOAT32_IEEE 0 autosar_swc_las_CM_single -3.4E+38 3.4E+38 /end CHARACTERISTIC
/begin CHARACTERISTIC P_LSS_LKA_State_Param_A0Offset "" VALUE 0xfe821398 /* @ECU_Address@P_LSS_LKA_State_Param_A0Offset@ */ Record_FLOAT32_IEEE 0 autosar_swc_las_CM_single -3.4E+38 3.4E+38 /end CHARACTERISTIC
/begin CHARACTERISTIC P_LSS_LKA_State_Param_A1leOffset "" VALUE 0xfe82139c /* @ECU_Address@P_LSS_LKA_State_Param_A1leOffset@ */ Record_FLOAT32_IEEE 0 autosar_swc_las_CM_single -3.4E+38 3.4E+38 /end CHARACTERISTIC
/begin CHARACTERISTIC P_LSS_LKA_State_Param_AngleOffset "" VALUE 0xfe8213a0 /* @ECU_Address@P_LSS_LKA_State_Param_AngleOffset@ */ Record_FLOAT32_IEEE 0 autosar_swc_las_CM_single -3.4E+38 3.4E+38 /end CHARACTERISTIC
/begin CHARACTERISTIC P_LSS_LKA_State_Param_InterventionZoneOut "" VALUE 0xfe8213a4 /* @ECU_Address@P_LSS_LKA_State_Param_InterventionZoneOut@ */ Record_FLOAT32_IEEE 0 autosar_swc_las_CM_single -3.4E+38 3.4E+38 /end CHARACTERISTIC
/begin CHARACTERISTIC P_LSS_LKA_State_Param_LaneWidth_Offset "" CURVE 0xfe82193c /* @ECU_Address@P_LSS_LKA_State_Param_LaneWidth_Offset@ */ Record_FLOAT32_IEEE 0 autosar_swc_las_CM_single -3.4E+38 3.4E+38
 /begin AXIS_DESCR COM_AXIS NO_INPUT_QUANTITY autosar_swc_las_CM_single 7 -3.4E+38 3.4E+38 AXIS_PTS_REF P_LSS_LKA_Lane_Width_Table_Calibration /end AXIS_DESCR
/end CHARACTERISTIC
/begin CHARACTERISTIC P_LSS_LKA_State_Param_LeftInterventionZoneIn "" VALUE 0xfe8213a8 /* @ECU_Address@P_LSS_LKA_State_Param_LeftInterventionZoneIn@ */ Record_FLOAT32_IEEE 0 autosar_swc_las_CM_single -3.4E+38 3.4E+38 /end CHARACTERISTIC
/begin CHARACTERISTIC P_LSS_LKA_State_Param_OutOffset "" VALUE 0xfe8213ac /* @ECU_Address@P_LSS_LKA_State_Param_OutOffset@ */ Record_FLOAT32_IEEE 0 autosar_swc_las_CM_single -3.4E+38 3.4E+38 /end CHARACTERISTIC
/begin CHARACTERISTIC P_LSS_LKA_State_Param_PreLeftInterventionZoneIn "" VALUE 0xfe8213b0 /* @ECU_Address@P_LSS_LKA_State_Param_PreLeftInterventionZoneIn@ */ Record_FLOAT32_IEEE 0 autosar_swc_las_CM_single -3.4E+38 3.4E+38 /end CHARACTERISTIC
/begin CHARACTERISTIC P_LSS_LKA_State_Param_PreRiInterventionZoneIn "" VALUE 0xfe8213b4 /* @ECU_Address@P_LSS_LKA_State_Param_PreRiInterventionZoneIn@ */ Record_FLOAT32_IEEE 0 autosar_swc_las_CM_single -3.4E+38 3.4E+38 /end CHARACTERISTIC
/begin CHARACTERISTIC P_LSS_LKA_State_Param_RiInterventionZoneIn "" VALUE 0xfe8213b8 /* @ECU_Address@P_LSS_LKA_State_Param_RiInterventionZoneIn@ */ Record_FLOAT32_IEEE 0 autosar_swc_las_CM_single -3.4E+38 3.4E+38 /end CHARACTERISTIC
/begin CHARACTERISTIC P_LSS_LKA_State_Param_Sensitive_Offset "" CURVE 0xfe821958 /* @ECU_Address@P_LSS_LKA_State_Param_Sensitive_Offset@ */ Record_FLOAT32_IEEE 0 autosar_swc_las_CM_single -3.4E+38 3.4E+38
 /begin AXIS_DESCR COM_AXIS NO_INPUT_QUANTITY autosar_swc_las_CM_single 3 -3.4E+38 3.4E+38 AXIS_PTS_REF P_LSS_LKA_Sensitive_Table_Calibration /end AXIS_DESCR
/end CHARACTERISTIC
/begin CHARACTERISTIC P_LSS_LKA_State_SteerWheelSpdOutTime "" VALUE 0xfe8213bc /* @ECU_Address@P_LSS_LKA_State_SteerWheelSpdOutTime@ */ Record_FLOAT32_IEEE 0 autosar_swc_las_CM_single -3.4E+38 3.4E+38 /end CHARACTERISTIC
/begin CHARACTERISTIC P_LSS_LKA_State_SteerWheelSpd_enable "" VALUE 0xfe8213c0 /* @ECU_Address@P_LSS_LKA_State_SteerWheelSpd_enable@ */ Record_FLOAT32_IEEE 0 autosar_swc_las_CM_single -3.4E+38 3.4E+38 /end CHARACTERISTIC
/begin CHARACTERISTIC P_LSS_LKA_State_TurnLight_enable "" VALUE 0xfe8213c4 /* @ECU_Address@P_LSS_LKA_State_TurnLight_enable@ */ Record_FLOAT32_IEEE 0 autosar_swc_las_CM_single -3.4E+38 3.4E+38 /end CHARACTERISTIC
/begin CHARACTERISTIC P_LSS_LKA_State_Vehspeed_enable "" VALUE 0xfe8213c8 /* @ECU_Address@P_LSS_LKA_State_Vehspeed_enable@ */ Record_FLOAT32_IEEE 0 autosar_swc_las_CM_single -3.4E+38 3.4E+38 /end CHARACTERISTIC
/begin CHARACTERISTIC P_LSS_LKA_State_Vehspeed_enableTime "" VALUE 0xfe8213cc /* @ECU_Address@P_LSS_LKA_State_Vehspeed_enableTime@ */ Record_FLOAT32_IEEE 0 autosar_swc_las_CM_single -3.4E+38 3.4E+38 /end CHARACTERISTIC
/begin CHARACTERISTIC P_LSS_LKA_State_Yawsup_enable "" VALUE 0xfe8213d0 /* @ECU_Address@P_LSS_LKA_State_Yawsup_enable@ */ Record_FLOAT32_IEEE 0 autosar_swc_las_CM_single -3.4E+38 3.4E+38 /end CHARACTERISTIC
/begin CHARACTERISTIC P_LSS_LKA_State_Yawsup_enableTime "" VALUE 0xfe8213d4 /* @ECU_Address@P_LSS_LKA_State_Yawsup_enableTime@ */ Record_FLOAT32_IEEE 0 autosar_swc_las_CM_single -3.4E+38 3.4E+38 /end CHARACTERISTIC
/begin CHARACTERISTIC P_LSS_LKA_SteerMinVehspeedInValue "" VALUE 0xfe8213d8 /* @ECU_Address@P_LSS_LKA_SteerMinVehspeedInValue@ */ Record_FLOAT32_IEEE 0 autosar_swc_las_CM_single -3.4E+38 3.4E+38 /end CHARACTERISTIC
/begin CHARACTERISTIC P_LSS_LKA_SteerWheelAngleIn "" VALUE 0xfe8213dc /* @ECU_Address@P_LSS_LKA_SteerWheelAngleIn@ */ Record_FLOAT32_IEEE 0 autosar_swc_las_CM_single -3.4E+38 3.4E+38 /end CHARACTERISTIC
/begin CHARACTERISTIC P_LSS_LKA_SteerWheelAngleOut "" VALUE 0xfe8213e0 /* @ECU_Address@P_LSS_LKA_SteerWheelAngleOut@ */ Record_FLOAT32_IEEE 0 autosar_swc_las_CM_single -3.4E+38 3.4E+38 /end CHARACTERISTIC
/begin CHARACTERISTIC P_LSS_LKA_SteerWheelSpdInTime "" VALUE 0xfe821068 /* @ECU_Address@P_LSS_LKA_SteerWheelSpdInTime@ */ Record_FLOAT64_IEEE 0 autosar_swc_las_CM_double -1.7E+308 1.7E+308 /end CHARACTERISTIC
/begin CHARACTERISTIC P_LSS_LKA_TurnLightInTime "" VALUE 0xfe821070 /* @ECU_Address@P_LSS_LKA_TurnLightInTime@ */ Record_FLOAT64_IEEE 0 autosar_swc_las_CM_double -1.7E+308 1.7E+308 /end CHARACTERISTIC
/begin CHARACTERISTIC P_LSS_LKA_WarnInTime "" VALUE 0xfe821078 /* @ECU_Address@P_LSS_LKA_WarnInTime@ */ Record_FLOAT64_IEEE 0 autosar_swc_las_CM_double -1.7E+308 1.7E+308 /end CHARACTERISTIC
/begin CHARACTERISTIC P_LSS_LKA_Warnarea1 "" VALUE 0xfe8213e4 /* @ECU_Address@P_LSS_LKA_Warnarea1@ */ Record_FLOAT32_IEEE 0 autosar_swc_las_CM_single -3.4E+38 3.4E+38 /end CHARACTERISTIC
/begin CHARACTERISTIC P_LSS_LKA_Warnarea2 "" VALUE 0xfe8213e8 /* @ECU_Address@P_LSS_LKA_Warnarea2@ */ Record_FLOAT32_IEEE 0 autosar_swc_las_CM_single -3.4E+38 3.4E+38 /end CHARACTERISTIC
/begin CHARACTERISTIC P_LSS_LKA_YawRateIn "" VALUE 0xfe8213ec /* @ECU_Address@P_LSS_LKA_YawRateIn@ */ Record_FLOAT32_IEEE 0 autosar_swc_las_CM_single -3.4E+38 3.4E+38 /end CHARACTERISTIC
/begin CHARACTERISTIC P_LSS_LKA_YawRateInTime "" VALUE 0xfe821080 /* @ECU_Address@P_LSS_LKA_YawRateInTime@ */ Record_FLOAT64_IEEE 0 autosar_swc_las_CM_double -1.7E+308 1.7E+308 /end CHARACTERISTIC
/begin CHARACTERISTIC P_LSS_LKA_YawRateOut "" VALUE 0xfe8213f0 /* @ECU_Address@P_LSS_LKA_YawRateOut@ */ Record_FLOAT32_IEEE 0 autosar_swc_las_CM_single -3.4E+38 3.4E+38 /end CHARACTERISTIC
/begin CHARACTERISTIC P_LSS_LSS_HandsOffWarnLevel1 "" VALUE 0xfe8213f4 /* @ECU_Address@P_LSS_LSS_HandsOffWarnLevel1@ */ Record_FLOAT32_IEEE 0 autosar_swc_las_CM_single -3.4E+38 3.4E+38 /end CHARACTERISTIC
/begin CHARACTERISTIC P_LSS_LSS_HandsOffWarnLevel2 "" VALUE 0xfe8213f8 /* @ECU_Address@P_LSS_LSS_HandsOffWarnLevel2@ */ Record_FLOAT32_IEEE 0 autosar_swc_las_CM_single -3.4E+38 3.4E+38 /end CHARACTERISTIC
/begin CHARACTERISTIC P_LSS_LaneTimeCompensateSwitch "" VALUE 0xfe8213fc /* @ECU_Address@P_LSS_LaneTimeCompensateSwitch@ */ Record_FLOAT32_IEEE 0 autosar_swc_las_CM_single -3.4E+38 3.4E+38 /end CHARACTERISTIC
/begin CHARACTERISTIC P_LSS_LaneUseRLGSLaneSwitch "" VALUE 0xfe821400 /* @ECU_Address@P_LSS_LaneUseRLGSLaneSwitch@ */ Record_FLOAT32_IEEE 0 autosar_swc_las_CM_single -3.4E+38 3.4E+38 /end CHARACTERISTIC
/begin CHARACTERISTIC P_LSS_SCM_ControlLineLatOffset "" CURVE 0xfe8219bc /* @ECU_Address@P_LSS_SCM_ControlLineLatOffset@ */ Record_FLOAT32_IEEE 0 autosar_swc_las_CM_single -3.4E+38 3.4E+38
 /begin AXIS_DESCR COM_AXIS NO_INPUT_QUANTITY autosar_swc_las_CM_single 36 -3.4E+38 3.4E+38 AXIS_PTS_REF P_LSS_SCM_LaneWidth2ControlLineLatOffset /end AXIS_DESCR
/end CHARACTERISTIC
/begin CHARACTERISTIC P_LSS_SCM_ControlLinePreDx "" CURVE 0xfe821964 /* @ECU_Address@P_LSS_SCM_ControlLinePreDx@ */ Record_FLOAT32_IEEE 0 autosar_swc_las_CM_single -3.4E+38 3.4E+38
 /begin AXIS_DESCR COM_AXIS NO_INPUT_QUANTITY autosar_swc_las_CM_single 11 -3.4E+38 3.4E+38 AXIS_PTS_REF P_LSS_SCM_VehSpd_ms /end AXIS_DESCR
/end CHARACTERISTIC
/begin CHARACTERISTIC P_LSS_SCM_EHRV2SW "" VALUE 0xfe821475 /* @ECU_Address@P_LSS_SCM_EHRV2SW@ */ Record_BOOLEAN 0 autosar_swc_las_CM_boolean 0 1 /end CHARACTERISTIC
/begin CHARACTERISTIC P_LSS_SCM_FWhelDyFilterCoef "" VALUE 0xfe82140c /* @ECU_Address@P_LSS_SCM_FWhelDyFilterCoef@ */ Record_FLOAT32_IEEE 0 autosar_swc_las_CM_single -3.4E+38 3.4E+38 /end CHARACTERISTIC
/begin CHARACTERISTIC P_LSS_SCM_HeadingAngExit_Tab "HeadingangleµÄÍË³ö½Ç¶È" CURVE 0xfe821788 /* @ECU_Address@P_LSS_SCM_HeadingAngExit_Tab@ */ Record_FLOAT32_IEEE 0 autosar_swc_las_CM_single -3.4E+38 3.4E+38
 /begin AXIS_DESCR COM_AXIS NO_INPUT_QUANTITY autosar_swc_las_CM_single 4 -3.4E+38 3.4E+38 AXIS_PTS_REF P_LSS_SCM_CenterLineA0_TabX /end AXIS_DESCR
/end CHARACTERISTIC
/begin CHARACTERISTIC P_LSS_SCM_HeadingAngleIn_deg "" VALUE 0xfe821410 /* @ECU_Address@P_LSS_SCM_HeadingAngleIn_deg@ */ Record_FLOAT32_IEEE 0 autosar_swc_las_CM_single -3.4E+38 3.4E+38 /end CHARACTERISTIC
/begin CHARACTERISTIC P_LSS_SCM_LaneWidthFilterCoe_ratio "" VALUE 0xfe821414 /* @ECU_Address@P_LSS_SCM_LaneWidthFilterCoe_ratio@ */ Record_FLOAT32_IEEE 0 autosar_swc_las_CM_single -3.4E+38 3.4E+38 /end CHARACTERISTIC
/begin CHARACTERISTIC P_LSS_SCM_LeftA1filterCoe_ratio "" VALUE 0xfe821418 /* @ECU_Address@P_LSS_SCM_LeftA1filterCoe_ratio@ */ Record_FLOAT32_IEEE 0 autosar_swc_las_CM_single -3.4E+38 3.4E+38 /end CHARACTERISTIC
/begin CHARACTERISTIC P_LSS_SCM_LeftdeFaultA1_ratio "" VALUE 0xfe82141c /* @ECU_Address@P_LSS_SCM_LeftdeFaultA1_ratio@ */ Record_FLOAT32_IEEE 0 autosar_swc_las_CM_single -3.4E+38 3.4E+38 /end CHARACTERISTIC
/begin CHARACTERISTIC P_LSS_SCM_LineJumpSW "" VALUE 0xfe821476 /* @ECU_Address@P_LSS_SCM_LineJumpSW@ */ Record_BOOLEAN 0 autosar_swc_las_CM_boolean 0 1 /end CHARACTERISTIC
/begin CHARACTERISTIC P_LSS_SCM_LinestdLowLimit "" VALUE 0xfe821420 /* @ECU_Address@P_LSS_SCM_LinestdLowLimit@ */ Record_FLOAT32_IEEE 0 autosar_swc_las_CM_single -3.4E+38 3.4E+38 /end CHARACTERISTIC
/begin CHARACTERISTIC P_LSS_SCM_LinestdpreTime "" VALUE 0xfe821424 /* @ECU_Address@P_LSS_SCM_LinestdpreTime@ */ Record_FLOAT32_IEEE 0 autosar_swc_las_CM_single -3.4E+38 3.4E+38 /end CHARACTERISTIC
/begin CHARACTERISTIC P_LSS_SCM_MinRoadWidth_m "" VALUE 0xfe821428 /* @ECU_Address@P_LSS_SCM_MinRoadWidth_m@ */ Record_FLOAT32_IEEE 0 autosar_swc_las_CM_single -3.4E+38 3.4E+38 /end CHARACTERISTIC
/begin CHARACTERISTIC P_LSS_SCM_RightA1filterCoe_ratio "" VALUE 0xfe82142c /* @ECU_Address@P_LSS_SCM_RightA1filterCoe_ratio@ */ Record_FLOAT32_IEEE 0 autosar_swc_las_CM_single -3.4E+38 3.4E+38 /end CHARACTERISTIC
/begin CHARACTERISTIC P_LSS_SCM_RightdeFaultA1_ratio "" VALUE 0xfe821430 /* @ECU_Address@P_LSS_SCM_RightdeFaultA1_ratio@ */ Record_FLOAT32_IEEE 0 autosar_swc_las_CM_single -3.4E+38 3.4E+38 /end CHARACTERISTIC
/begin CHARACTERISTIC P_LSS_SCM_RoadRepaireDefaultFlag "" VALUE 0xfe821477 /* @ECU_Address@P_LSS_SCM_RoadRepaireDefaultFlag@ */ Record_BOOLEAN 0 autosar_swc_las_CM_boolean 0 1 /end CHARACTERISTIC
/begin CHARACTERISTIC P_LSS_SCM_RoadRepaireInValidDistance "" VALUE 0xfe82144c /* @ECU_Address@P_LSS_SCM_RoadRepaireInValidDistance@ */ Record_UWORD 0 autosar_swc_las_CM_uint16 0 65535 /end CHARACTERISTIC
/begin CHARACTERISTIC P_LSS_SCM_RoadRepaireMinDistance "" VALUE 0xfe82144e /* @ECU_Address@P_LSS_SCM_RoadRepaireMinDistance@ */ Record_UWORD 0 autosar_swc_las_CM_uint16 0 65535 /end CHARACTERISTIC
/begin MEASUREMENT LAS_LDW_Count "" FLOAT32_IEEE autosar_swc_las_CM_single 0 0 -3.4E+38 3.4E+38 ECU_ADDRESS 0xfe4ae588 /* @ECU_Address@LAS_LDW_Count@ */ /end MEASUREMENT
/begin MEASUREMENT LAS_LDW_VehConfigLDW "" UBYTE autosar_swc_las_CM_uint8 0 0 0 255 ECU_ADDRESS 0xfe4ae6c0 /* @ECU_Address@LAS_LDW_VehConfigLDW@ */ /end MEASUREMENT
/begin MEASUREMENT LAS_LDW_wCount "" FLOAT32_IEEE autosar_swc_las_CM_single 0 0 -3.4E+38 3.4E+38 ECU_ADDRESS 0xfe4ae590 /* @ECU_Address@LAS_LDW_wCount@ */ /end MEASUREMENT
/begin MEASUREMENT LAS_LKAState "" UBYTE autosar_swc_las_CM_uint8 0 0 0 255 ECU_ADDRESS 0xfe4ae6c1 /* @ECU_Address@LAS_LKAState@ */ /end MEASUREMENT
/begin MEASUREMENT LAS_LKA_Error "" UBYTE autosar_swc_las_CM_boolean 0 0 0 1 MATRIX_DIM 1 1 ECU_ADDRESS 0xfe4ae6c5 /* @ECU_Address@LAS_LKA_Error@ */ /end MEASUREMENT
/begin MEASUREMENT LAS_LKA_FiLeftIntervention "" UBYTE autosar_swc_las_CM_boolean 0 0 0 1 ECU_ADDRESS 0xfe4ae6c6 /* @ECU_Address@LAS_LKA_FiLeftIntervention@ */ /end MEASUREMENT
/begin MEASUREMENT LAS_LKA_FiRightIntervention "" UBYTE autosar_swc_las_CM_boolean 0 0 0 1 ECU_ADDRESS 0xfe4ae6c7 /* @ECU_Address@LAS_LKA_FiRightIntervention@ */ /end MEASUREMENT
/begin MEASUREMENT LAS_LKA_FinalReady2Active "" FLOAT32_IEEE autosar_swc_las_CM_single 0 0 -3.4E+38 3.4E+38 ECU_ADDRESS 0xfe4ae594 /* @ECU_Address@LAS_LKA_FinalReady2Active@ */ /end MEASUREMENT
/begin MEASUREMENT LAS_LKA_LeftIntervention "" UBYTE autosar_swc_las_CM_boolean 0 0 0 1 ECU_ADDRESS 0xfe4ae6ca /* @ECU_Address@LAS_LKA_LeftIntervention@ */ /end MEASUREMENT
/begin MEASUREMENT LAS_LKA_LeftInterventionEnd "" UBYTE autosar_swc_las_CM_boolean 0 0 0 1 ECU_ADDRESS 0xfe4ae6cb /* @ECU_Address@LAS_LKA_LeftInterventionEnd@ */ /end MEASUREMENT
/begin MEASUREMENT LAS_LKA_LeftWarning "" UBYTE autosar_swc_las_CM_boolean 0 0 0 1 ECU_ADDRESS 0xfe4ae6ce /* @ECU_Address@LAS_LKA_LeftWarning@ */ /end MEASUREMENT
/begin MEASUREMENT LAS_LKA_Leftout "" UBYTE autosar_swc_las_CM_boolean 0 0 0 1 ECU_ADDRESS 0xfe4ae6cf /* @ECU_Address@LAS_LKA_Leftout@ */ /end MEASUREMENT
/begin MEASUREMENT LAS_LKA_RightIntervention "" UBYTE autosar_swc_las_CM_boolean 0 0 0 1 ECU_ADDRESS 0xfe4ae6d4 /* @ECU_Address@LAS_LKA_RightIntervention@ */ /end MEASUREMENT
/begin MEASUREMENT LAS_LKA_RightInterventionEnd "" UBYTE autosar_swc_las_CM_boolean 0 0 0 1 ECU_ADDRESS 0xfe4ae6d5 /* @ECU_Address@LAS_LKA_RightInterventionEnd@ */ /end MEASUREMENT
/begin MEASUREMENT LAS_LKA_RightWarning "" UBYTE autosar_swc_las_CM_boolean 0 0 0 1 ECU_ADDRESS 0xfe4ae6d6 /* @ECU_Address@LAS_LKA_RightWarning@ */ /end MEASUREMENT
/begin MEASUREMENT LAS_LKA_Rightout "" UBYTE autosar_swc_las_CM_boolean 0 0 0 1 ECU_ADDRESS 0xfe4ae6d7 /* @ECU_Address@LAS_LKA_Rightout@ */ /end MEASUREMENT
/begin MEASUREMENT LAS_LKA_VehConfigLKA "" UBYTE autosar_swc_las_CM_uint8 0 0 0 255 ECU_ADDRESS 0xfe4ae6d8 /* @ECU_Address@LAS_LKA_VehConfigLKA@ */ /end MEASUREMENT
/begin MEASUREMENT LAS_LKA_Warning "" UBYTE autosar_swc_las_CM_uint8 0 0 0 255 ECU_ADDRESS 0xfe4ae6d9 /* @ECU_Address@LAS_LKA_Warning@ */ /end MEASUREMENT
/begin MEASUREMENT LAS_Reserve0 "" FLOAT32_IEEE autosar_swc_las_CM_single 0 0 -3.4E+38 3.4E+38 MATRIX_DIM 1 1 ECU_ADDRESS 0xfe4ae598 /* @ECU_Address@LAS_Reserve0@ */ /end MEASUREMENT
/begin MEASUREMENT LAS_Reserve1 "" FLOAT32_IEEE autosar_swc_las_CM_single 0 0 -3.4E+38 3.4E+38 ECU_ADDRESS 0xfe4ae59c /* @ECU_Address@LAS_Reserve1@ */ /end MEASUREMENT
/begin MEASUREMENT LAS_Reserve2 "" FLOAT32_IEEE autosar_swc_las_CM_single 0 0 -3.4E+38 3.4E+38 ECU_ADDRESS 0xfe4ae5a0 /* @ECU_Address@LAS_Reserve2@ */ /end MEASUREMENT
/begin MEASUREMENT LAS_Reserve3 "" FLOAT32_IEEE autosar_swc_las_CM_single 0 0 -3.4E+38 3.4E+38 MATRIX_DIM 1 1 ECU_ADDRESS 0xfe4ae5a4 /* @ECU_Address@LAS_Reserve3@ */ /end MEASUREMENT
/begin MEASUREMENT LAS_Reserve8 "" FLOAT32_IEEE autosar_swc_las_CM_single 0 0 -3.4E+38 3.4E+38 MATRIX_DIM 1 1 ECU_ADDRESS 0xfe4ae5b8 /* @ECU_Address@LAS_Reserve8@ */ /end MEASUREMENT
/begin MEASUREMENT LAS_Reserve9 "" FLOAT32_IEEE autosar_swc_las_CM_single 0 0 -3.4E+38 3.4E+38 MATRIX_DIM 1 1 ECU_ADDRESS 0xfe4ae5bc /* @ECU_Address@LAS_Reserve9@ */ /end MEASUREMENT
/begin MEASUREMENT LAS_SCM_CenterLaneWidth "" FLOAT32_IEEE autosar_swc_las_CM_single 0 0 -3.4E+38 3.4E+38 MATRIX_DIM 1 1 ECU_ADDRESS 0xfe4ae5c0 /* @ECU_Address@LAS_SCM_CenterLaneWidth@ */ /end MEASUREMENT
/begin MEASUREMENT LAS_SCM_CenterLineA0 "" FLOAT32_IEEE autosar_swc_las_CM_single 0 0 -3.4E+38 3.4E+38 MATRIX_DIM 1 1 ECU_ADDRESS 0xfe4ae5c4 /* @ECU_Address@LAS_SCM_CenterLineA0@ */ /end MEASUREMENT
/begin MEASUREMENT LAS_SCM_CenterLineA1 "" FLOAT32_IEEE autosar_swc_las_CM_single 0 0 -3.4E+38 3.4E+38 MATRIX_DIM 1 1 ECU_ADDRESS 0xfe4ae5c8 /* @ECU_Address@LAS_SCM_CenterLineA1@ */ /end MEASUREMENT
/begin MEASUREMENT LAS_SCM_CenterLineA2 "" FLOAT32_IEEE autosar_swc_las_CM_single 0 0 -3.4E+38 3.4E+38 MATRIX_DIM 1 1 ECU_ADDRESS 0xfe4ae5cc /* @ECU_Address@LAS_SCM_CenterLineA2@ */ /end MEASUREMENT
/begin MEASUREMENT LAS_SCM_CenterLineA3 "" FLOAT32_IEEE autosar_swc_las_CM_single 0 0 -3.4E+38 3.4E+38 MATRIX_DIM 1 1 ECU_ADDRESS 0xfe4ae5d0 /* @ECU_Address@LAS_SCM_CenterLineA3@ */ /end MEASUREMENT
/begin MEASUREMENT LAS_SCM_CenterLineLength "" FLOAT32_IEEE autosar_swc_las_CM_single 0 0 -3.4E+38 3.4E+38 ECU_ADDRESS 0xfe4ae5d4 /* @ECU_Address@LAS_SCM_CenterLineLength@ */ /end MEASUREMENT
/begin MEASUREMENT LAS_SCM_CenterLineValid "" UBYTE autosar_swc_las_CM_boolean 0 0 0 1 MATRIX_DIM 1 1 ECU_ADDRESS 0xfe4ae6da /* @ECU_Address@LAS_SCM_CenterLineValid@ */ /end MEASUREMENT
/begin MEASUREMENT LAS_SCM_FLWhel2RiLineDy "" FLOAT32_IEEE autosar_swc_las_CM_single 0 0 -3.4E+38 3.4E+38 ECU_ADDRESS 0xfe4ae5d8 /* @ECU_Address@LAS_SCM_FLWhel2RiLineDy@ */ /end MEASUREMENT
/begin MEASUREMENT LAS_SCM_FRWhel2LeftLineDy "" FLOAT32_IEEE autosar_swc_las_CM_single 0 0 -3.4E+38 3.4E+38 ECU_ADDRESS 0xfe4ae5dc /* @ECU_Address@LAS_SCM_FRWhel2LeftLineDy@ */ /end MEASUREMENT
/begin MEASUREMENT LAS_SCM_FrontRoadNoRepaireFlag "" UBYTE autosar_swc_las_CM_boolean 0 0 0 1 ECU_ADDRESS 0xfe4ae6db /* @ECU_Address@LAS_SCM_FrontRoadNoRepaireFlag@ */ /end MEASUREMENT
/begin MEASUREMENT LAS_SCM_LaneWidth_m "" FLOAT32_IEEE autosar_swc_las_CM_single 0 0 -3.4E+38 3.4E+38 ECU_ADDRESS 0xfe4ae5e0 /* @ECU_Address@LAS_SCM_LaneWidth_m@ */ /end MEASUREMENT
/begin MEASUREMENT LAS_SCM_LeftEgePathChange_b "" UBYTE autosar_swc_las_CM_boolean 0 0 0 1 ECU_ADDRESS 0xfe4ae6e0 /* @ECU_Address@LAS_SCM_LeftEgePathChange_b@ */ /end MEASUREMENT
/begin MEASUREMENT LAS_SCM_LeftEgeStd_b "" FLOAT32_IEEE autosar_swc_las_CM_single 0 0 -3.4E+38 3.4E+38 ECU_ADDRESS 0xfe4ae5e4 /* @ECU_Address@LAS_SCM_LeftEgeStd_b@ */ /end MEASUREMENT
/begin MEASUREMENT LAS_SCM_LeftLinePathChange_b "" UBYTE autosar_swc_las_CM_boolean 0 0 0 1 ECU_ADDRESS 0xfe4ae6e2 /* @ECU_Address@LAS_SCM_LeftLinePathChange_b@ */ /end MEASUREMENT
/begin MEASUREMENT LAS_SCM_LeftLineStd_b "" FLOAT32_IEEE autosar_swc_las_CM_single 0 0 -3.4E+38 3.4E+38 ECU_ADDRESS 0xfe4ae5e8 /* @ECU_Address@LAS_SCM_LeftLineStd_b@ */ /end MEASUREMENT
/begin MEASUREMENT LAS_SCM_Number "" UWORD autosar_swc_las_CM_uint16 0 0 0 65535 ECU_ADDRESS 0xfe4ae654 /* @ECU_Address@LAS_SCM_Number@ */ /end MEASUREMENT
/begin MEASUREMENT LAS_SCM_RightEgePathChange_b "" UBYTE autosar_swc_las_CM_boolean 0 0 0 1 ECU_ADDRESS 0xfe4ae6e5 /* @ECU_Address@LAS_SCM_RightEgePathChange_b@ */ /end MEASUREMENT
/begin MEASUREMENT LAS_SCM_RightEgeStd_b "" FLOAT32_IEEE autosar_swc_las_CM_single 0 0 -3.4E+38 3.4E+38 ECU_ADDRESS 0xfe4ae5ec /* @ECU_Address@LAS_SCM_RightEgeStd_b@ */ /end MEASUREMENT
/begin MEASUREMENT LAS_SCM_RightLinePathChange_b "" UBYTE autosar_swc_las_CM_boolean 0 0 0 1 ECU_ADDRESS 0xfe4ae6e7 /* @ECU_Address@LAS_SCM_RightLinePathChange_b@ */ /end MEASUREMENT
/begin MEASUREMENT LAS_SCM_RightLineStd_b "" FLOAT32_IEEE autosar_swc_las_CM_single 0 0 -3.4E+38 3.4E+38 ECU_ADDRESS 0xfe4ae5f0 /* @ECU_Address@LAS_SCM_RightLineStd_b@ */ /end MEASUREMENT
/begin MEASUREMENT LAS_SCM_VERSION "" ULONG autosar_swc_las_CM_uint32 0 0 0 4294967295 ECU_ADDRESS 0xfe4ae5f4 /* @ECU_Address@LAS_SCM_VERSION@ */ /end MEASUREMENT
/begin MEASUREMENT LAS_SCM_repaireRoadDistance "" SLONG autosar_swc_las_CM_int32 0 0 -2147483648 2147483647 MATRIX_DIM 1 1 ECU_ADDRESS 0xfe4ae5f8 /* @ECU_Address@LAS_SCM_repaireRoadDistance@ */ /end MEASUREMENT
/begin MEASUREMENT LAS_UpdateCnt "" UBYTE autosar_swc_las_CM_uint8 0 0 0 255 ECU_ADDRESS 0xfe4ae6e9 /* @ECU_Address@LAS_UpdateCnt@ */ /end MEASUREMENT
/begin MEASUREMENT autosar_swc_las_rtARID_DEF.Cnt "" FLOAT32_IEEE autosar_swc_las_CM_single 0 0 -3.4E+38 3.4E+38 ECU_ADDRESS 0xfe4ae494 /* @ECU_Address@autosar_swc_las_rtARID_DEF.Cnt@ */ /end MEASUREMENT
/begin MEASUREMENT autosar_swc_las_rtARID_DEF.CntWarning "" FLOAT32_IEEE autosar_swc_las_CM_single 0 0 -3.4E+38 3.4E+38 ECU_ADDRESS 0xfe4ae484 /* @ECU_Address@autosar_swc_las_rtARID_DEF.CntWarning@ */ /end MEASUREMENT
/begin MEASUREMENT autosar_swc_las_rtARID_DEF.Cnt_HandsOffIntervene "" FLOAT32_IEEE autosar_swc_las_CM_single 0 0 -3.4E+38 3.4E+38 ECU_ADDRESS 0xfe4ae480 /* @ECU_Address@autosar_swc_las_rtARID_DEF.Cnt_HandsOffIntervene@ */ /end MEASUREMENT
/begin MEASUREMENT autosar_swc_las_rtARID_DEF.Compare_a "" UBYTE autosar_swc_las_CM_logical 0 0 0 1 ECU_ADDRESS 0xfe4ae4f1 /* @ECU_Address@autosar_swc_las_rtARID_DEF.Compare_a@ */ /end MEASUREMENT
/begin MEASUREMENT autosar_swc_las_rtARID_DEF.Compare_b "" UBYTE autosar_swc_las_CM_logical 0 0 0 1 ECU_ADDRESS 0xfe4ae4f8 /* @ECU_Address@autosar_swc_las_rtARID_DEF.Compare_b@ */ /end MEASUREMENT
/begin MEASUREMENT autosar_swc_las_rtARID_DEF.Compare_c "" UBYTE autosar_swc_las_CM_logical 0 0 0 1 ECU_ADDRESS 0xfe4ae4f2 /* @ECU_Address@autosar_swc_las_rtARID_DEF.Compare_c@ */ /end MEASUREMENT
/begin MEASUREMENT autosar_swc_las_rtARID_DEF.Compare_d "" UBYTE autosar_swc_las_CM_logical 0 0 0 1 ECU_ADDRESS 0xfe4ae4f6 /* @ECU_Address@autosar_swc_las_rtARID_DEF.Compare_d@ */ /end MEASUREMENT
/begin MEASUREMENT autosar_swc_las_rtARID_DEF.Compare_jw "" UBYTE autosar_swc_las_CM_logical 0 0 0 1 ECU_ADDRESS 0xfe4ae4ef /* @ECU_Address@autosar_swc_las_rtARID_DEF.Compare_jw@ */ /end MEASUREMENT
/begin MEASUREMENT autosar_swc_las_rtARID_DEF.Compare_l "" UBYTE autosar_swc_las_CM_logical 0 0 0 1 ECU_ADDRESS 0xfe4ae4f0 /* @ECU_Address@autosar_swc_las_rtARID_DEF.Compare_l@ */ /end MEASUREMENT
/begin MEASUREMENT autosar_swc_las_rtARID_DEF.Compare_m "" UBYTE autosar_swc_las_CM_logical 0 0 0 1 ECU_ADDRESS 0xfe4ae4f9 /* @ECU_Address@autosar_swc_las_rtARID_DEF.Compare_m@ */ /end MEASUREMENT
/begin MEASUREMENT autosar_swc_las_rtARID_DEF.Delay1_DSTATE "" FLOAT32_IEEE autosar_swc_las_CM_single 0 0 -3.4E+38 3.4E+38 ECU_ADDRESS 0xfe4ae3f4 /* @ECU_Address@autosar_swc_las_rtARID_DEF.Delay1_DSTATE@ */ /end MEASUREMENT
/begin MEASUREMENT autosar_swc_las_rtARID_DEF.Delay1_DSTATE_f "" UBYTE autosar_swc_las_CM_uint8 0 0 0 255 ECU_ADDRESS 0xfe4ae4c1 /* @ECU_Address@autosar_swc_las_rtARID_DEF.Delay1_DSTATE_f@ */ /end MEASUREMENT
/begin MEASUREMENT autosar_swc_las_rtARID_DEF.Delay1_DSTATE_g "" UBYTE autosar_swc_las_CM_uint8 0 0 0 255 ECU_ADDRESS 0xfe4ae4c3 /* @ECU_Address@autosar_swc_las_rtARID_DEF.Delay1_DSTATE_g@ */ /end MEASUREMENT
/begin MEASUREMENT autosar_swc_las_rtARID_DEF.Delay1_DSTATE_m "" UBYTE autosar_swc_las_CM_logical 0 0 0 1 ECU_ADDRESS 0xfe4ae4ff /* @ECU_Address@autosar_swc_las_rtARID_DEF.Delay1_DSTATE_m@ */ /end MEASUREMENT
/begin MEASUREMENT autosar_swc_las_rtARID_DEF.Delay1_DSTATE_o "" UBYTE autosar_swc_las_CM_uint8 0 0 0 255 ECU_ADDRESS 0xfe4ae4b2 /* @ECU_Address@autosar_swc_las_rtARID_DEF.Delay1_DSTATE_o@ */ /end MEASUREMENT
/begin MEASUREMENT autosar_swc_las_rtARID_DEF.Delay1_DSTATE_p "" UBYTE autosar_swc_las_CM_uint8 0 0 0 255 ECU_ADDRESS 0xfe4ae4b1 /* @ECU_Address@autosar_swc_las_rtARID_DEF.Delay1_DSTATE_p@ */ /end MEASUREMENT
/begin MEASUREMENT autosar_swc_las_rtARID_DEF.Delay2_DSTATE "" UBYTE autosar_swc_las_CM_uint8 0 0 0 255 ECU_ADDRESS 0xfe4ae4b3 /* @ECU_Address@autosar_swc_las_rtARID_DEF.Delay2_DSTATE@ */ /end MEASUREMENT
/begin MEASUREMENT autosar_swc_las_rtARID_DEF.Delay2_DSTATE_h "" UBYTE autosar_swc_las_CM_uint8 0 0 0 255 ECU_ADDRESS 0xfe4ae4b4 /* @ECU_Address@autosar_swc_las_rtARID_DEF.Delay2_DSTATE_h@ */ /end MEASUREMENT
/begin MEASUREMENT autosar_swc_las_rtARID_DEF.Delay2_DSTATE_m "" UBYTE autosar_swc_las_CM_uint8 0 0 0 255 ECU_ADDRESS 0xfe4ae4b5 /* @ECU_Address@autosar_swc_las_rtARID_DEF.Delay2_DSTATE_m@ */ /end MEASUREMENT
/begin MEASUREMENT autosar_swc_las_rtARID_DEF.Delay3_DSTATE "" UBYTE autosar_swc_las_CM_logical 0 0 0 1 ECU_ADDRESS 0xfe4ae506 /* @ECU_Address@autosar_swc_las_rtARID_DEF.Delay3_DSTATE@ */ /end MEASUREMENT
/begin MEASUREMENT autosar_swc_las_rtARID_DEF.Delay_DSTATE "" FLOAT32_IEEE autosar_swc_las_CM_single 0 0 -3.4E+38 3.4E+38 LAYOUT COLUMN_DIR MATRIX_DIM 5 ECU_ADDRESS 0xfe4ae320 /* @ECU_Address@autosar_swc_las_rtARID_DEF.Delay_DSTATE@ */ /end MEASUREMENT
/begin MEASUREMENT autosar_swc_las_rtARID_DEF.Delay_DSTATE_b "" UBYTE autosar_swc_las_CM_uint8 0 0 0 255 ECU_ADDRESS 0xfe4ae4c2 /* @ECU_Address@autosar_swc_las_rtARID_DEF.Delay_DSTATE_b@ */ /end MEASUREMENT
/begin MEASUREMENT autosar_swc_las_rtARID_DEF.Delay_DSTATE_d "" UBYTE autosar_swc_las_CM_logical 0 0 0 1 ECU_ADDRESS 0xfe4ae505 /* @ECU_Address@autosar_swc_las_rtARID_DEF.Delay_DSTATE_d@ */ /end MEASUREMENT
/begin MEASUREMENT autosar_swc_las_rtARID_DEF.Delay_DSTATE_f "" UBYTE autosar_swc_las_CM_uint8 0 0 0 255 ECU_ADDRESS 0xfe4ae4c0 /* @ECU_Address@autosar_swc_las_rtARID_DEF.Delay_DSTATE_f@ */ /end MEASUREMENT
/begin MEASUREMENT autosar_swc_las_rtARID_DEF.Delay_DSTATE_g "" FLOAT32_IEEE autosar_swc_las_CM_single 0 0 -3.4E+38 3.4E+38 ECU_ADDRESS 0xfe4ae3f0 /* @ECU_Address@autosar_swc_las_rtARID_DEF.Delay_DSTATE_g@ */ /end MEASUREMENT
/begin MEASUREMENT autosar_swc_las_rtARID_DEF.Delay_DSTATE_k "" UBYTE autosar_swc_las_CM_logical 0 0 0 1 ECU_ADDRESS 0xfe4ae507 /* @ECU_Address@autosar_swc_las_rtARID_DEF.Delay_DSTATE_k@ */ /end MEASUREMENT
/begin MEASUREMENT autosar_swc_las_rtARID_DEF.Gain_d "" FLOAT32_IEEE autosar_swc_las_CM_single 0 0 -3.4E+38 3.4E+38 ECU_ADDRESS 0xfe4ae37c /* @ECU_Address@autosar_swc_las_rtARID_DEF.Gain_d@ */ /end MEASUREMENT
/begin MEASUREMENT autosar_swc_las_rtARID_DEF.HandsOffWarnLevel "" UBYTE autosar_swc_las_CM_uint8 0 0 0 255 ECU_ADDRESS 0xfe4ae4ac /* @ECU_Address@autosar_swc_las_rtARID_DEF.HandsOffWarnLevel@ */ /end MEASUREMENT
/begin MEASUREMENT autosar_swc_las_rtARID_DEF.LogicalOperator12 "" UBYTE autosar_swc_las_CM_logical 0 0 0 1 ECU_ADDRESS 0xfe4ae4f4 /* @ECU_Address@autosar_swc_las_rtARID_DEF.LogicalOperator12@ */ /end MEASUREMENT
/begin MEASUREMENT autosar_swc_las_rtARID_DEF.LogicalOperator1_bj "" UBYTE autosar_swc_las_CM_logical 0 0 0 1 ECU_ADDRESS 0xfe4ae4fa /* @ECU_Address@autosar_swc_las_rtARID_DEF.LogicalOperator1_bj@ */ /end MEASUREMENT
/begin MEASUREMENT autosar_swc_las_rtARID_DEF.LogicalOperator1_p "" UBYTE autosar_swc_las_CM_logical 0 0 0 1 ECU_ADDRESS 0xfe4ae4f3 /* @ECU_Address@autosar_swc_las_rtARID_DEF.LogicalOperator1_p@ */ /end MEASUREMENT
/begin MEASUREMENT autosar_swc_las_rtARID_DEF.Out "" UBYTE autosar_swc_las_CM_logical 0 0 0 1 ECU_ADDRESS 0xfe4ae4fb /* @ECU_Address@autosar_swc_las_rtARID_DEF.Out@ */ /end MEASUREMENT
/begin MEASUREMENT autosar_swc_las_rtARID_DEF.Out_f "" UBYTE autosar_swc_las_CM_logical 0 0 0 1 ECU_ADDRESS 0xfe4ae4fd /* @ECU_Address@autosar_swc_las_rtARID_DEF.Out_f@ */ /end MEASUREMENT
/begin MEASUREMENT autosar_swc_las_rtARID_DEF.Out_f5 "" UBYTE autosar_swc_las_CM_logical 0 0 0 1 ECU_ADDRESS 0xfe4ae4fe /* @ECU_Address@autosar_swc_las_rtARID_DEF.Out_f5@ */ /end MEASUREMENT
/begin MEASUREMENT autosar_swc_las_rtARID_DEF.Output_DSTATE "" UBYTE autosar_swc_las_CM_uint8 0 0 0 255 ECU_ADDRESS 0xfe4ae4c4 /* @ECU_Address@autosar_swc_las_rtARID_DEF.Output_DSTATE@ */ /end MEASUREMENT
/begin MEASUREMENT autosar_swc_las_rtARID_DEF.OverRide "" UBYTE autosar_swc_las_CM_logical 0 0 0 1 MATRIX_DIM 1 1 ECU_ADDRESS 0xfe4ae4fc /* @ECU_Address@autosar_swc_las_rtARID_DEF.OverRide@ */ /end MEASUREMENT
/begin MEASUREMENT autosar_swc_las_rtARID_DEF.State "" UBYTE autosar_swc_las_CM_STATE 0 0 0 7 ECU_ADDRESS 0xfe4ae4b0 /* @ECU_Address@autosar_swc_las_rtARID_DEF.State@ */ /end MEASUREMENT
/begin MEASUREMENT autosar_swc_las_rtARID_DEF.Switch1 "" UBYTE autosar_swc_las_CM_logical 0 0 0 1 ECU_ADDRESS 0xfe4ae4f5 /* @ECU_Address@autosar_swc_las_rtARID_DEF.Switch1@ */ /end MEASUREMENT
/begin MEASUREMENT autosar_swc_las_rtARID_DEF.Switch2_g "" UBYTE autosar_swc_las_CM_logical 0 0 0 1 ECU_ADDRESS 0xfe4ae4f7 /* @ECU_Address@autosar_swc_las_rtARID_DEF.Switch2_g@ */ /end MEASUREMENT
/begin MEASUREMENT autosar_swc_las_rtARID_DEF.TmpSignalConversionAtVAL_DRIVER_SWITCHOutport1.AEBOnOff "" UBYTE autosar_swc_las_CM_logical 0 0 0 1 ECU_ADDRESS 0xfe4adf53 /* @ECU_Address@autosar_swc_las_rtARID_DEF.TmpSignalConversionAtVAL_DRIVER_SWITCHOutport1.AEBOnOff@ */ /end MEASUREMENT
/begin MEASUREMENT autosar_swc_las_rtARID_DEF.TmpSignalConversionAtVAL_DRIVER_SWITCHOutport1.AESOnOff "" UBYTE autosar_swc_las_CM_logical 0 0 0 1 ECU_ADDRESS 0xfe4adf4e /* @ECU_Address@autosar_swc_las_rtARID_DEF.TmpSignalConversionAtVAL_DRIVER_SWITCHOutport1.AESOnOff@ */ /end MEASUREMENT
/begin MEASUREMENT autosar_swc_las_rtARID_DEF.TmpSignalConversionAtVAL_DRIVER_SWITCHOutport1.ALCSet "" UBYTE autosar_swc_las_CM_uint8 0 0 0 255 ECU_ADDRESS 0xfe4adf60 /* @ECU_Address@autosar_swc_las_rtARID_DEF.TmpSignalConversionAtVAL_DRIVER_SWITCHOutport1.ALCSet@ */ /end MEASUREMENT
/begin MEASUREMENT autosar_swc_las_rtARID_DEF.TmpSignalConversionAtVAL_DRIVER_SWITCHOutport1.ALCSnvtySet "" UBYTE autosar_swc_las_CM_uint8 0 0 0 255 ECU_ADDRESS 0xfe4adf62 /* @ECU_Address@autosar_swc_las_rtARID_DEF.TmpSignalConversionAtVAL_DRIVER_SWITCHOutport1.ALCSnvtySet@ */ /end MEASUREMENT
/begin MEASUREMENT autosar_swc_las_rtARID_DEF.TmpSignalConversionAtVAL_DRIVER_SWITCHOutport1.DAIOnOff "" UBYTE autosar_swc_las_CM_logical 0 0 0 1 ECU_ADDRESS 0xfe4adf54 /* @ECU_Address@autosar_swc_las_rtARID_DEF.TmpSignalConversionAtVAL_DRIVER_SWITCHOutport1.DAIOnOff@ */ /end MEASUREMENT
/begin MEASUREMENT autosar_swc_las_rtARID_DEF.TmpSignalConversionAtVAL_DRIVER_SWITCHOutport1.DCLCSet "" UBYTE autosar_swc_las_CM_uint8 0 0 0 255 ECU_ADDRESS 0xfe4adf61 /* @ECU_Address@autosar_swc_las_rtARID_DEF.TmpSignalConversionAtVAL_DRIVER_SWITCHOutport1.DCLCSet@ */ /end MEASUREMENT
/begin MEASUREMENT autosar_swc_las_rtARID_DEF.TmpSignalConversionAtVAL_DRIVER_SWITCHOutport1.ELKOnOff "" UBYTE autosar_swc_las_CM_logical 0 0 0 1 ECU_ADDRESS 0xfe4adf4c /* @ECU_Address@autosar_swc_las_rtARID_DEF.TmpSignalConversionAtVAL_DRIVER_SWITCHOutport1.ELKOnOff@ */ /end MEASUREMENT
/begin MEASUREMENT autosar_swc_las_rtARID_DEF.TmpSignalConversionAtVAL_DRIVER_SWITCHOutport1.ESSOnOff "" UBYTE autosar_swc_las_CM_logical 0 0 0 1 ECU_ADDRESS 0xfe4adf4d /* @ECU_Address@autosar_swc_las_rtARID_DEF.TmpSignalConversionAtVAL_DRIVER_SWITCHOutport1.ESSOnOff@ */ /end MEASUREMENT
/begin MEASUREMENT autosar_swc_las_rtARID_DEF.TmpSignalConversionAtVAL_DRIVER_SWITCHOutport1.FCWOnOff "" UBYTE autosar_swc_las_CM_logical 0 0 0 1 ECU_ADDRESS 0xfe4adf52 /* @ECU_Address@autosar_swc_las_rtARID_DEF.TmpSignalConversionAtVAL_DRIVER_SWITCHOutport1.FCWOnOff@ */ /end MEASUREMENT
/begin MEASUREMENT autosar_swc_las_rtARID_DEF.TmpSignalConversionAtVAL_DRIVER_SWITCHOutport1.FCWSnvty "" UBYTE autosar_swc_las_CM_uint8 0 0 0 255 ECU_ADDRESS 0xfe4adf63 /* @ECU_Address@autosar_swc_las_rtARID_DEF.TmpSignalConversionAtVAL_DRIVER_SWITCHOutport1.FCWSnvty@ */ /end MEASUREMENT
/begin MEASUREMENT autosar_swc_las_rtARID_DEF.TmpSignalConversionAtVAL_DRIVER_SWITCHOutport1.ICAOnOff "" UBYTE autosar_swc_las_CM_uint8 0 0 0 255 ECU_ADDRESS 0xfe4adf59 /* @ECU_Address@autosar_swc_las_rtARID_DEF.TmpSignalConversionAtVAL_DRIVER_SWITCHOutport1.ICAOnOff@ */ /end MEASUREMENT
/begin MEASUREMENT autosar_swc_las_rtARID_DEF.TmpSignalConversionAtVAL_DRIVER_SWITCHOutport1.IHCOnOff "" UBYTE autosar_swc_las_CM_uint8 0 0 0 255 ECU_ADDRESS 0xfe4adf58 /* @ECU_Address@autosar_swc_las_rtARID_DEF.TmpSignalConversionAtVAL_DRIVER_SWITCHOutport1.IHCOnOff@ */ /end MEASUREMENT
/begin MEASUREMENT autosar_swc_las_rtARID_DEF.TmpSignalConversionAtVAL_DRIVER_SWITCHOutport1.ISLOnOff "" UBYTE autosar_swc_las_CM_logical 0 0 0 1 ECU_ADDRESS 0xfe4adf50 /* @ECU_Address@autosar_swc_las_rtARID_DEF.TmpSignalConversionAtVAL_DRIVER_SWITCHOutport1.ISLOnOff@ */ /end MEASUREMENT
/begin MEASUREMENT autosar_swc_las_rtARID_DEF.TmpSignalConversionAtVAL_DRIVER_SWITCHOutport1.IntellgntCurveOnOff "" UBYTE autosar_swc_las_CM_logical 0 0 0 1 ECU_ADDRESS 0xfe4adf51 /* @ECU_Address@autosar_swc_las_rtARID_DEF.TmpSignalConversionAtVAL_DRIVER_SWITCHOutport1.IntellgntCurveOnOff@ */ /end MEASUREMENT
/begin MEASUREMENT autosar_swc_las_rtARID_DEF.TmpSignalConversionAtVAL_DRIVER_SWITCHOutport1.LASSnvtySet "" UBYTE autosar_swc_las_CM_uint8 0 0 0 255 ECU_ADDRESS 0xfe4adf5c /* @ECU_Address@autosar_swc_las_rtARID_DEF.TmpSignalConversionAtVAL_DRIVER_SWITCHOutport1.LASSnvtySet@ */ /end MEASUREMENT
/begin MEASUREMENT autosar_swc_las_rtARID_DEF.TmpSignalConversionAtVAL_DRIVER_SWITCHOutport1.LASWarnFormSwtReq "" UBYTE autosar_swc_las_CM_uint8 0 0 0 255 ECU_ADDRESS 0xfe4adf5d /* @ECU_Address@autosar_swc_las_rtARID_DEF.TmpSignalConversionAtVAL_DRIVER_SWITCHOutport1.LASWarnFormSwtReq@ */ /end MEASUREMENT
/begin MEASUREMENT autosar_swc_las_rtARID_DEF.TmpSignalConversionAtVAL_DRIVER_SWITCHOutport1.LCKIEOnOff "" UBYTE autosar_swc_las_CM_logical 0 0 0 1 ECU_ADDRESS 0xfe4adf4f /* @ECU_Address@autosar_swc_las_rtARID_DEF.TmpSignalConversionAtVAL_DRIVER_SWITCHOutport1.LCKIEOnOff@ */ /end MEASUREMENT
/begin MEASUREMENT autosar_swc_las_rtARID_DEF.TmpSignalConversionAtVAL_DRIVER_SWITCHOutport1.LDWOnOff "" UBYTE autosar_swc_las_CM_logical 0 0 0 1 ECU_ADDRESS 0xfe4adf4a /* @ECU_Address@autosar_swc_las_rtARID_DEF.TmpSignalConversionAtVAL_DRIVER_SWITCHOutport1.LDWOnOff@ */ /end MEASUREMENT
/begin MEASUREMENT autosar_swc_las_rtARID_DEF.TmpSignalConversionAtVAL_DRIVER_SWITCHOutport1.LKAOnOff "" UBYTE autosar_swc_las_CM_logical 0 0 0 1 ECU_ADDRESS 0xfe4adf4b /* @ECU_Address@autosar_swc_las_rtARID_DEF.TmpSignalConversionAtVAL_DRIVER_SWITCHOutport1.LKAOnOff@ */ /end MEASUREMENT
/begin MEASUREMENT autosar_swc_las_rtARID_DEF.TmpSignalConversionAtVAL_DRIVER_SWITCHOutport1.NOHActReq "" UBYTE autosar_swc_las_CM_logical 0 0 0 1 ECU_ADDRESS 0xfe4adf49 /* @ECU_Address@autosar_swc_las_rtARID_DEF.TmpSignalConversionAtVAL_DRIVER_SWITCHOutport1.NOHActReq@ */ /end MEASUREMENT
/begin MEASUREMENT autosar_swc_las_rtARID_DEF.TmpSignalConversionAtVAL_DRIVER_SWITCHOutport1.NOHOnOff "" UBYTE autosar_swc_las_CM_logical 0 0 0 1 ECU_ADDRESS 0xfe4adf48 /* @ECU_Address@autosar_swc_las_rtARID_DEF.TmpSignalConversionAtVAL_DRIVER_SWITCHOutport1.NOHOnOff@ */ /end MEASUREMENT
/begin MEASUREMENT autosar_swc_las_rtARID_DEF.TmpSignalConversionAtVAL_DRIVER_SWITCHOutport1.SLAOnOff "" UBYTE autosar_swc_las_CM_uint8 0 0 0 255 ECU_ADDRESS 0xfe4adf5a /* @ECU_Address@autosar_swc_las_rtARID_DEF.TmpSignalConversionAtVAL_DRIVER_SWITCHOutport1.SLAOnOff@ */ /end MEASUREMENT
/begin MEASUREMENT autosar_swc_las_rtARID_DEF.TmpSignalConversionAtVAL_DRIVER_SWITCHOutport1.SLAWarnMod "" UBYTE autosar_swc_las_CM_uint8 0 0 0 255 ECU_ADDRESS 0xfe4adf5b /* @ECU_Address@autosar_swc_las_rtARID_DEF.TmpSignalConversionAtVAL_DRIVER_SWITCHOutport1.SLAWarnMod@ */ /end MEASUREMENT
/begin MEASUREMENT autosar_swc_las_rtARID_DEF.TmpSignalConversionAtVAL_DRIVER_SWITCHOutport1.SpeedLimitOnOff "" UBYTE autosar_swc_las_CM_uint8 0 0 0 255 ECU_ADDRESS 0xfe4adf66 /* @ECU_Address@autosar_swc_las_rtARID_DEF.TmpSignalConversionAtVAL_DRIVER_SWITCHOutport1.SpeedLimitOnOff@ */ /end MEASUREMENT
/begin MEASUREMENT autosar_swc_las_rtARID_DEF.TmpSignalConversionAtVAL_DRIVER_SWITCHOutport1.SpeedLmtNumberAbs "" SBYTE autosar_swc_las_CM_int8 0 0 -128 127 ECU_ADDRESS 0xfe4adf55 /* @ECU_Address@autosar_swc_las_rtARID_DEF.TmpSignalConversionAtVAL_DRIVER_SWITCHOutport1.SpeedLmtNumberAbs@ */ /end MEASUREMENT
/begin MEASUREMENT autosar_swc_las_rtARID_DEF.TmpSignalConversionAtVAL_DRIVER_SWITCHOutport1.SpeedLmtNumberPerct "" SBYTE autosar_swc_las_CM_int8 0 0 -128 127 ECU_ADDRESS 0xfe4adf56 /* @ECU_Address@autosar_swc_las_rtARID_DEF.TmpSignalConversionAtVAL_DRIVER_SWITCHOutport1.SpeedLmtNumberPerct@ */ /end MEASUREMENT
/begin MEASUREMENT autosar_swc_las_rtARID_DEF.TmpSignalConversionAtVAL_DRIVER_SWITCHOutport1.SpeedLmtSnvtyMod "" UBYTE autosar_swc_las_CM_uint8 0 0 0 255 ECU_ADDRESS 0xfe4adf57 /* @ECU_Address@autosar_swc_las_rtARID_DEF.TmpSignalConversionAtVAL_DRIVER_SWITCHOutport1.SpeedLmtSnvtyMod@ */ /end MEASUREMENT
/begin MEASUREMENT autosar_swc_las_rtARID_DEF.TmpSignalConversionAtVAL_DRIVER_SWITCHOutport1.TJAICAExitTextInfoONOFF "" UBYTE autosar_swc_las_CM_uint8 0 0 0 255 ECU_ADDRESS 0xfe4adf65 /* @ECU_Address@autosar_swc_las_rtARID_DEF.TmpSignalConversionAtVAL_DRIVER_SWITCHOutport1.TJAICAExitTextInfoONOFF@ */ /end MEASUREMENT
/begin MEASUREMENT autosar_swc_las_rtARID_DEF.TmpSignalConversionAtVAL_DRIVER_SWITCHOutport1.TLIOnOff "" UBYTE autosar_swc_las_CM_uint8 0 0 0 255 ECU_ADDRESS 0xfe4adf5f /* @ECU_Address@autosar_swc_las_rtARID_DEF.TmpSignalConversionAtVAL_DRIVER_SWITCHOutport1.TLIOnOff@ */ /end MEASUREMENT
/begin MEASUREMENT autosar_swc_las_rtARID_DEF.TmpSignalConversionAtVAL_DRIVER_SWITCHOutport1.TSROnOff "" UBYTE autosar_swc_las_CM_uint8 0 0 0 255 ECU_ADDRESS 0xfe4adf5e /* @ECU_Address@autosar_swc_las_rtARID_DEF.TmpSignalConversionAtVAL_DRIVER_SWITCHOutport1.TSROnOff@ */ /end MEASUREMENT
/begin MEASUREMENT autosar_swc_las_rtARID_DEF.TmpSignalConversionAtVAL_DRIVER_SWITCHOutport1.TimeStampMs "" A_UINT64 autosar_swc_las_CM_uint64 0 0 0 18446744073709551615 ECU_ADDRESS 0xfe4adf68 /* @ECU_Address@autosar_swc_las_rtARID_DEF.TmpSignalConversionAtVAL_DRIVER_SWITCHOutport1.TimeStampMs@ */ /end MEASUREMENT
/begin MEASUREMENT autosar_swc_las_rtARID_DEF.TmpSignalConversionAtVAL_DRIVER_SWITCHOutport1.VoiceRemindType "" UBYTE autosar_swc_las_CM_uint8 0 0 0 255 ECU_ADDRESS 0xfe4adf64 /* @ECU_Address@autosar_swc_las_rtARID_DEF.TmpSignalConversionAtVAL_DRIVER_SWITCHOutport1.VoiceRemindType@ */ /end MEASUREMENT
/begin MEASUREMENT autosar_swc_las_rtARID_DEF.UnitDelay10_DSTATE "" FLOAT32_IEEE autosar_swc_las_CM_single 0 0 -3.4E+38 3.4E+38 ECU_ADDRESS 0xfe4ae3c0 /* @ECU_Address@autosar_swc_las_rtARID_DEF.UnitDelay10_DSTATE@ */ /end MEASUREMENT
/begin MEASUREMENT autosar_swc_las_rtARID_DEF.UnitDelay11_DSTATE "" FLOAT32_IEEE autosar_swc_las_CM_single 0 0 -3.4E+38 3.4E+38 ECU_ADDRESS 0xfe4ae3e8 /* @ECU_Address@autosar_swc_las_rtARID_DEF.UnitDelay11_DSTATE@ */ /end MEASUREMENT
/begin MEASUREMENT autosar_swc_las_rtARID_DEF.UnitDelay12_DSTATE "" UBYTE autosar_swc_las_CM_logical 0 0 0 1 ECU_ADDRESS 0xfe4ae504 /* @ECU_Address@autosar_swc_las_rtARID_DEF.UnitDelay12_DSTATE@ */ /end MEASUREMENT
/begin MEASUREMENT autosar_swc_las_rtARID_DEF.UnitDelay13_DSTATE "" FLOAT32_IEEE autosar_swc_las_CM_single 0 0 -3.4E+38 3.4E+38 ECU_ADDRESS 0xfe4ae3dc /* @ECU_Address@autosar_swc_las_rtARID_DEF.UnitDelay13_DSTATE@ */ /end MEASUREMENT
/begin MEASUREMENT autosar_swc_las_rtARID_DEF.UnitDelay14_DSTATE "" FLOAT32_IEEE autosar_swc_las_CM_single 0 0 -3.4E+38 3.4E+38 ECU_ADDRESS 0xfe4ae3e0 /* @ECU_Address@autosar_swc_las_rtARID_DEF.UnitDelay14_DSTATE@ */ /end MEASUREMENT
/begin MEASUREMENT autosar_swc_las_rtARID_DEF.UnitDelay15_DSTATE "" FLOAT32_IEEE autosar_swc_las_CM_single 0 0 -3.4E+38 3.4E+38 ECU_ADDRESS 0xfe4ae3e4 /* @ECU_Address@autosar_swc_las_rtARID_DEF.UnitDelay15_DSTATE@ */ /end MEASUREMENT
/begin MEASUREMENT autosar_swc_las_rtARID_DEF.UnitDelay16_DSTATE "" UBYTE autosar_swc_las_CM_logical 0 0 0 1 ECU_ADDRESS 0xfe4ae501 /* @ECU_Address@autosar_swc_las_rtARID_DEF.UnitDelay16_DSTATE@ */ /end MEASUREMENT
/begin MEASUREMENT autosar_swc_las_rtARID_DEF.UnitDelay17_DSTATE "" FLOAT32_IEEE autosar_swc_las_CM_single 0 0 -3.4E+38 3.4E+38 ECU_ADDRESS 0xfe4ae3a0 /* @ECU_Address@autosar_swc_las_rtARID_DEF.UnitDelay17_DSTATE@ */ /end MEASUREMENT
/begin MEASUREMENT autosar_swc_las_rtARID_DEF.UnitDelay18_DSTATE "" FLOAT32_IEEE autosar_swc_las_CM_single 0 0 -3.4E+38 3.4E+38 ECU_ADDRESS 0xfe4ae3a4 /* @ECU_Address@autosar_swc_las_rtARID_DEF.UnitDelay18_DSTATE@ */ /end MEASUREMENT
/begin MEASUREMENT autosar_swc_las_rtARID_DEF.UnitDelay19_DSTATE "" FLOAT32_IEEE autosar_swc_las_CM_single 0 0 -3.4E+38 3.4E+38 ECU_ADDRESS 0xfe4ae3a8 /* @ECU_Address@autosar_swc_las_rtARID_DEF.UnitDelay19_DSTATE@ */ /end MEASUREMENT
/begin MEASUREMENT autosar_swc_las_rtARID_DEF.UnitDelay1_DSTATE_a "" FLOAT32_IEEE autosar_swc_las_CM_single 0 0 -3.4E+38 3.4E+38 ECU_ADDRESS 0xfe4ae394 /* @ECU_Address@autosar_swc_las_rtARID_DEF.UnitDelay1_DSTATE_a@ */ /end MEASUREMENT
/begin MEASUREMENT autosar_swc_las_rtARID_DEF.UnitDelay1_DSTATE_c "" UWORD autosar_swc_las_CM_uint16 0 0 0 65535 ECU_ADDRESS 0xfe4ae498 /* @ECU_Address@autosar_swc_las_rtARID_DEF.UnitDelay1_DSTATE_c@ */ /end MEASUREMENT
/begin MEASUREMENT autosar_swc_las_rtARID_DEF.UnitDelay1_DSTATE_co "" UBYTE autosar_swc_las_CM_logical 0 0 0 1 ECU_ADDRESS 0xfe4ae503 /* @ECU_Address@autosar_swc_las_rtARID_DEF.UnitDelay1_DSTATE_co@ */ /end MEASUREMENT
/begin MEASUREMENT autosar_swc_las_rtARID_DEF.UnitDelay1_DSTATE_e "" FLOAT32_IEEE autosar_swc_las_CM_single 0 0 -3.4E+38 3.4E+38 ECU_ADDRESS 0xfe4ae434 /* @ECU_Address@autosar_swc_las_rtARID_DEF.UnitDelay1_DSTATE_e@ */ /end MEASUREMENT
/begin MEASUREMENT autosar_swc_las_rtARID_DEF.UnitDelay1_DSTATE_f "" FLOAT32_IEEE autosar_swc_las_CM_single 0 0 -3.4E+38 3.4E+38 ECU_ADDRESS 0xfe4ae454 /* @ECU_Address@autosar_swc_las_rtARID_DEF.UnitDelay1_DSTATE_f@ */ /end MEASUREMENT
/begin MEASUREMENT autosar_swc_las_rtARID_DEF.UnitDelay1_DSTATE_g "" UWORD autosar_swc_las_CM_uint16 0 0 0 65535 ECU_ADDRESS 0xfe4ae49a /* @ECU_Address@autosar_swc_las_rtARID_DEF.UnitDelay1_DSTATE_g@ */ /end MEASUREMENT
/begin MEASUREMENT autosar_swc_las_rtARID_DEF.UnitDelay1_DSTATE_k "" FLOAT32_IEEE autosar_swc_las_CM_single 0 0 -3.4E+38 3.4E+38 ECU_ADDRESS 0xfe4ae3fc /* @ECU_Address@autosar_swc_las_rtARID_DEF.UnitDelay1_DSTATE_k@ */ /end MEASUREMENT
/begin MEASUREMENT autosar_swc_las_rtARID_DEF.UnitDelay1_DSTATE_m "" UBYTE autosar_swc_las_CM_logical 0 0 0 1 ECU_ADDRESS 0xfe4ae50a /* @ECU_Address@autosar_swc_las_rtARID_DEF.UnitDelay1_DSTATE_m@ */ /end MEASUREMENT
/begin MEASUREMENT autosar_swc_las_rtARID_DEF.UnitDelay1_DSTATE_o "" FLOAT32_IEEE autosar_swc_las_CM_single 0 0 -3.4E+38 3.4E+38 ECU_ADDRESS 0xfe4ae45c /* @ECU_Address@autosar_swc_las_rtARID_DEF.UnitDelay1_DSTATE_o@ */ /end MEASUREMENT
/begin MEASUREMENT autosar_swc_las_rtARID_DEF.UnitDelay20_DSTATE "" FLOAT32_IEEE autosar_swc_las_CM_single 0 0 -3.4E+38 3.4E+38 ECU_ADDRESS 0xfe4ae3c4 /* @ECU_Address@autosar_swc_las_rtARID_DEF.UnitDelay20_DSTATE@ */ /end MEASUREMENT
/begin MEASUREMENT autosar_swc_las_rtARID_DEF.UnitDelay21_DSTATE "" FLOAT32_IEEE autosar_swc_las_CM_single 0 0 -3.4E+38 3.4E+38 ECU_ADDRESS 0xfe4ae3b0 /* @ECU_Address@autosar_swc_las_rtARID_DEF.UnitDelay21_DSTATE@ */ /end MEASUREMENT
/begin MEASUREMENT autosar_swc_las_rtARID_DEF.UnitDelay22_DSTATE "" FLOAT32_IEEE autosar_swc_las_CM_single 0 0 -3.4E+38 3.4E+38 ECU_ADDRESS 0xfe4ae3d8 /* @ECU_Address@autosar_swc_las_rtARID_DEF.UnitDelay22_DSTATE@ */ /end MEASUREMENT
/begin MEASUREMENT autosar_swc_las_rtARID_DEF.UnitDelay27_DSTATE "" FLOAT32_IEEE autosar_swc_las_CM_single 0 0 -3.4E+38 3.4E+38 ECU_ADDRESS 0xfe4ae3ac /* @ECU_Address@autosar_swc_las_rtARID_DEF.UnitDelay27_DSTATE@ */ /end MEASUREMENT
/begin MEASUREMENT autosar_swc_las_rtARID_DEF.UnitDelay2_DSTATE "" FLOAT32_IEEE autosar_swc_las_CM_single 0 0 -3.4E+38 3.4E+38 ECU_ADDRESS 0xfe4ae388 /* @ECU_Address@autosar_swc_las_rtARID_DEF.UnitDelay2_DSTATE@ */ /end MEASUREMENT
/begin MEASUREMENT autosar_swc_las_rtARID_DEF.UnitDelay2_DSTATE_b "" FLOAT32_IEEE autosar_swc_las_CM_single 0 0 -3.4E+38 3.4E+38 ECU_ADDRESS 0xfe4ae404 /* @ECU_Address@autosar_swc_las_rtARID_DEF.UnitDelay2_DSTATE_b@ */ /end MEASUREMENT
/begin MEASUREMENT autosar_swc_las_rtARID_DEF.UnitDelay2_DSTATE_d "" UBYTE autosar_swc_las_CM_logical 0 0 0 1 ECU_ADDRESS 0xfe4ae50b /* @ECU_Address@autosar_swc_las_rtARID_DEF.UnitDelay2_DSTATE_d@ */ /end MEASUREMENT
/begin MEASUREMENT autosar_swc_las_rtARID_DEF.UnitDelay2_DSTATE_f "" FLOAT32_IEEE autosar_swc_las_CM_single 0 0 -3.4E+38 3.4E+38 ECU_ADDRESS 0xfe4ae3c8 /* @ECU_Address@autosar_swc_las_rtARID_DEF.UnitDelay2_DSTATE_f@ */ /end MEASUREMENT
/begin MEASUREMENT autosar_swc_las_rtARID_DEF.UnitDelay2_DSTATE_fp "" UBYTE autosar_swc_las_CM_logical 0 0 0 1 ECU_ADDRESS 0xfe4ae500 /* @ECU_Address@autosar_swc_las_rtARID_DEF.UnitDelay2_DSTATE_fp@ */ /end MEASUREMENT
/begin MEASUREMENT autosar_swc_las_rtARID_DEF.UnitDelay2_DSTATE_h "" UBYTE autosar_swc_las_CM_logical 0 0 0 1 ECU_ADDRESS 0xfe4ae516 /* @ECU_Address@autosar_swc_las_rtARID_DEF.UnitDelay2_DSTATE_h@ */ /end MEASUREMENT
/begin MEASUREMENT autosar_swc_las_rtARID_DEF.UnitDelay2_DSTATE_j "" FLOAT32_IEEE autosar_swc_las_CM_single 0 0 -3.4E+38 3.4E+38 ECU_ADDRESS 0xfe4ae450 /* @ECU_Address@autosar_swc_las_rtARID_DEF.UnitDelay2_DSTATE_j@ */ /end MEASUREMENT
/begin MEASUREMENT autosar_swc_las_rtARID_DEF.UnitDelay2_DSTATE_jo "" FLOAT32_IEEE autosar_swc_las_CM_single 0 0 -3.4E+38 3.4E+38 ECU_ADDRESS 0xfe4ae458 /* @ECU_Address@autosar_swc_las_rtARID_DEF.UnitDelay2_DSTATE_jo@ */ /end MEASUREMENT
/begin MEASUREMENT autosar_swc_las_rtARID_DEF.UnitDelay2_DSTATE_m "" FLOAT32_IEEE autosar_swc_las_CM_single 0 0 -3.4E+38 3.4E+38 ECU_ADDRESS 0xfe4ae400 /* @ECU_Address@autosar_swc_las_rtARID_DEF.UnitDelay2_DSTATE_m@ */ /end MEASUREMENT
/begin MEASUREMENT autosar_swc_las_rtARID_DEF.UnitDelay3_DSTATE_c "" FLOAT32_IEEE autosar_swc_las_CM_single 0 0 -3.4E+38 3.4E+38 ECU_ADDRESS 0xfe4ae3cc /* @ECU_Address@autosar_swc_las_rtARID_DEF.UnitDelay3_DSTATE_c@ */ /end MEASUREMENT
/begin MEASUREMENT autosar_swc_las_rtARID_DEF.UnitDelay4_DSTATE "" FLOAT32_IEEE autosar_swc_las_CM_single 0 0 -3.4E+38 3.4E+38 ECU_ADDRESS 0xfe4ae3d0 /* @ECU_Address@autosar_swc_las_rtARID_DEF.UnitDelay4_DSTATE@ */ /end MEASUREMENT
/begin MEASUREMENT autosar_swc_las_rtARID_DEF.UnitDelay4_DSTATE_b "" FLOAT32_IEEE autosar_swc_las_CM_single 0 0 -3.4E+38 3.4E+38 ECU_ADDRESS 0xfe4ae418 /* @ECU_Address@autosar_swc_las_rtARID_DEF.UnitDelay4_DSTATE_b@ */ /end MEASUREMENT
/begin MEASUREMENT autosar_swc_las_rtARID_DEF.UnitDelay4_DSTATE_f "" UBYTE autosar_swc_las_CM_logical 0 0 0 1 ECU_ADDRESS 0xfe4ae509 /* @ECU_Address@autosar_swc_las_rtARID_DEF.UnitDelay4_DSTATE_f@ */ /end MEASUREMENT
/begin MEASUREMENT autosar_swc_las_rtARID_DEF.UnitDelay5_DSTATE "" FLOAT32_IEEE autosar_swc_las_CM_single 0 0 -3.4E+38 3.4E+38 ECU_ADDRESS 0xfe4ae3d4 /* @ECU_Address@autosar_swc_las_rtARID_DEF.UnitDelay5_DSTATE@ */ /end MEASUREMENT
/begin MEASUREMENT autosar_swc_las_rtARID_DEF.UnitDelay5_DSTATE_j "" UBYTE autosar_swc_las_CM_logical 0 0 0 1 ECU_ADDRESS 0xfe4ae508 /* @ECU_Address@autosar_swc_las_rtARID_DEF.UnitDelay5_DSTATE_j@ */ /end MEASUREMENT
/begin MEASUREMENT autosar_swc_las_rtARID_DEF.UnitDelay5_DSTATE_n "" FLOAT32_IEEE autosar_swc_las_CM_single 0 0 -3.4E+38 3.4E+38 ECU_ADDRESS 0xfe4ae41c /* @ECU_Address@autosar_swc_las_rtARID_DEF.UnitDelay5_DSTATE_n@ */ /end MEASUREMENT
/begin MEASUREMENT autosar_swc_las_rtARID_DEF.UnitDelay6_DSTATE_k "" UBYTE autosar_swc_las_CM_logical 0 0 0 1 ECU_ADDRESS 0xfe4ae502 /* @ECU_Address@autosar_swc_las_rtARID_DEF.UnitDelay6_DSTATE_k@ */ /end MEASUREMENT
/begin MEASUREMENT autosar_swc_las_rtARID_DEF.UnitDelay7_DSTATE "" FLOAT32_IEEE autosar_swc_las_CM_single 0 0 -3.4E+38 3.4E+38 ECU_ADDRESS 0xfe4ae3b4 /* @ECU_Address@autosar_swc_las_rtARID_DEF.UnitDelay7_DSTATE@ */ /end MEASUREMENT
/begin MEASUREMENT autosar_swc_las_rtARID_DEF.UnitDelay7_DSTATE_b "" UBYTE autosar_swc_las_CM_uint8 0 0 0 255 ECU_ADDRESS 0xfe4ae4b7 /* @ECU_Address@autosar_swc_las_rtARID_DEF.UnitDelay7_DSTATE_b@ */ /end MEASUREMENT
/begin MEASUREMENT autosar_swc_las_rtARID_DEF.UnitDelay8_DSTATE "" FLOAT32_IEEE autosar_swc_las_CM_single 0 0 -3.4E+38 3.4E+38 ECU_ADDRESS 0xfe4ae3b8 /* @ECU_Address@autosar_swc_las_rtARID_DEF.UnitDelay8_DSTATE@ */ /end MEASUREMENT
/begin MEASUREMENT autosar_swc_las_rtARID_DEF.UnitDelay8_DSTATE_n "" UBYTE autosar_swc_las_CM_uint8 0 0 0 255 ECU_ADDRESS 0xfe4ae4b8 /* @ECU_Address@autosar_swc_las_rtARID_DEF.UnitDelay8_DSTATE_n@ */ /end MEASUREMENT
/begin MEASUREMENT autosar_swc_las_rtARID_DEF.UnitDelay9_DSTATE "" FLOAT32_IEEE autosar_swc_las_CM_single 0 0 -3.4E+38 3.4E+38 ECU_ADDRESS 0xfe4ae3bc /* @ECU_Address@autosar_swc_las_rtARID_DEF.UnitDelay9_DSTATE@ */ /end MEASUREMENT
/begin MEASUREMENT autosar_swc_las_rtARID_DEF.UnitDelay_DSTATE "" FLOAT64_IEEE autosar_swc_las_CM_double 0 0 -1.7E+308 1.7E+308 ECU_ADDRESS 0xfe4adfd0 /* @ECU_Address@autosar_swc_las_rtARID_DEF.UnitDelay_DSTATE@ */ /end MEASUREMENT
/begin MEASUREMENT autosar_swc_las_rtARID_DEF.UnitDelay_DSTATE_a "" FLOAT64_IEEE autosar_swc_las_CM_double 0 0 -1.7E+308 1.7E+308 ECU_ADDRESS 0xfe4ae008 /* @ECU_Address@autosar_swc_las_rtARID_DEF.UnitDelay_DSTATE_a@ */ /end MEASUREMENT
/begin MEASUREMENT autosar_swc_las_rtARID_DEF.UnitDelay_DSTATE_a1 "" FLOAT32_IEEE autosar_swc_las_CM_single 0 0 -3.4E+38 3.4E+38 ECU_ADDRESS 0xfe4ae398 /* @ECU_Address@autosar_swc_las_rtARID_DEF.UnitDelay_DSTATE_a1@ */ /end MEASUREMENT
/begin MEASUREMENT autosar_swc_las_rtARID_DEF.UnitDelay_DSTATE_ac "" FLOAT32_IEEE autosar_swc_las_CM_single 0 0 -3.4E+38 3.4E+38 ECU_ADDRESS 0xfe4ae390 /* @ECU_Address@autosar_swc_las_rtARID_DEF.UnitDelay_DSTATE_ac@ */ /end MEASUREMENT
/begin MEASUREMENT autosar_swc_las_rtARID_DEF.UnitDelay_DSTATE_b "" FLOAT64_IEEE autosar_swc_las_CM_double 0 0 -1.7E+308 1.7E+308 ECU_ADDRESS 0xfe4ae010 /* @ECU_Address@autosar_swc_las_rtARID_DEF.UnitDelay_DSTATE_b@ */ /end MEASUREMENT
/begin MEASUREMENT autosar_swc_las_rtARID_DEF.UnitDelay_DSTATE_bz "" FLOAT64_IEEE autosar_swc_las_CM_double 0 0 -1.7E+308 1.7E+308 ECU_ADDRESS 0xfe4ae050 /* @ECU_Address@autosar_swc_las_rtARID_DEF.UnitDelay_DSTATE_bz@ */ /end MEASUREMENT
/begin MEASUREMENT autosar_swc_las_rtARID_DEF.UnitDelay_DSTATE_c "" FLOAT64_IEEE autosar_swc_las_CM_double 0 0 -1.7E+308 1.7E+308 ECU_ADDRESS 0xfe4ae090 /* @ECU_Address@autosar_swc_las_rtARID_DEF.UnitDelay_DSTATE_c@ */ /end MEASUREMENT
/begin MEASUREMENT autosar_swc_las_rtARID_DEF.UnitDelay_DSTATE_c1 "" UBYTE autosar_swc_las_CM_uint8 0 0 0 255 ECU_ADDRESS 0xfe4ae4b6 /* @ECU_Address@autosar_swc_las_rtARID_DEF.UnitDelay_DSTATE_c1@ */ /end MEASUREMENT
/begin MEASUREMENT autosar_swc_las_rtARID_DEF.UnitDelay_DSTATE_c5 "" FLOAT64_IEEE autosar_swc_las_CM_double 0 0 -1.7E+308 1.7E+308 ECU_ADDRESS 0xfe4ae250 /* @ECU_Address@autosar_swc_las_rtARID_DEF.UnitDelay_DSTATE_c5@ */ /end MEASUREMENT
/begin MEASUREMENT autosar_swc_las_rtARID_DEF.UnitDelay_DSTATE_cb "" FLOAT64_IEEE autosar_swc_las_CM_double 0 0 -1.7E+308 1.7E+308 ECU_ADDRESS 0xfe4ae1f8 /* @ECU_Address@autosar_swc_las_rtARID_DEF.UnitDelay_DSTATE_cb@ */ /end MEASUREMENT
/begin MEASUREMENT autosar_swc_las_rtARID_DEF.UnitDelay_DSTATE_cl "" FLOAT32_IEEE autosar_swc_las_CM_single 0 0 -3.4E+38 3.4E+38 ECU_ADDRESS 0xfe4ae408 /* @ECU_Address@autosar_swc_las_rtARID_DEF.UnitDelay_DSTATE_cl@ */ /end MEASUREMENT
/begin MEASUREMENT autosar_swc_las_rtARID_DEF.UnitDelay_DSTATE_ctg "" FLOAT32_IEEE autosar_swc_las_CM_single 0 0 -3.4E+38 3.4E+38 ECU_ADDRESS 0xfe4ae38c /* @ECU_Address@autosar_swc_las_rtARID_DEF.UnitDelay_DSTATE_ctg@ */ /end MEASUREMENT
/begin MEASUREMENT autosar_swc_las_rtARID_DEF.UnitDelay_DSTATE_cx "" FLOAT32_IEEE autosar_swc_las_CM_single 0 0 -3.4E+38 3.4E+38 ECU_ADDRESS 0xfe4ae3ec /* @ECU_Address@autosar_swc_las_rtARID_DEF.UnitDelay_DSTATE_cx@ */ /end MEASUREMENT
/begin MEASUREMENT autosar_swc_las_rtARID_DEF.UnitDelay_DSTATE_d "" FLOAT64_IEEE autosar_swc_las_CM_double 0 0 -1.7E+308 1.7E+308 ECU_ADDRESS 0xfe4ae018 /* @ECU_Address@autosar_swc_las_rtARID_DEF.UnitDelay_DSTATE_d@ */ /end MEASUREMENT
/begin MEASUREMENT autosar_swc_las_rtARID_DEF.UnitDelay_DSTATE_d5 "" FLOAT64_IEEE autosar_swc_las_CM_double 0 0 -1.7E+308 1.7E+308 ECU_ADDRESS 0xfe4ae060 /* @ECU_Address@autosar_swc_las_rtARID_DEF.UnitDelay_DSTATE_d5@ */ /end MEASUREMENT
/begin MEASUREMENT autosar_swc_las_rtARID_DEF.UnitDelay_DSTATE_e "" FLOAT64_IEEE autosar_swc_las_CM_double 0 0 -1.7E+308 1.7E+308 ECU_ADDRESS 0xfe4ae040 /* @ECU_Address@autosar_swc_las_rtARID_DEF.UnitDelay_DSTATE_e@ */ /end MEASUREMENT
/begin MEASUREMENT autosar_swc_las_rtARID_DEF.UnitDelay_DSTATE_ed "" FLOAT64_IEEE autosar_swc_las_CM_double 0 0 -1.7E+308 1.7E+308 ECU_ADDRESS 0xfe4ae1c8 /* @ECU_Address@autosar_swc_las_rtARID_DEF.UnitDelay_DSTATE_ed@ */ /end MEASUREMENT
/begin MEASUREMENT autosar_swc_las_rtARID_DEF.UnitDelay_DSTATE_f "" FLOAT64_IEEE autosar_swc_las_CM_double 0 0 -1.7E+308 1.7E+308 ECU_ADDRESS 0xfe4ae028 /* @ECU_Address@autosar_swc_las_rtARID_DEF.UnitDelay_DSTATE_f@ */ /end MEASUREMENT
/begin MEASUREMENT autosar_swc_las_rtARID_DEF.UnitDelay_DSTATE_f2v "" FLOAT64_IEEE autosar_swc_las_CM_double 0 0 -1.7E+308 1.7E+308 ECU_ADDRESS 0xfe4ae258 /* @ECU_Address@autosar_swc_las_rtARID_DEF.UnitDelay_DSTATE_f2v@ */ /end MEASUREMENT
/begin MEASUREMENT autosar_swc_las_rtARID_DEF.UnitDelay_DSTATE_ff "" FLOAT64_IEEE autosar_swc_las_CM_double 0 0 -1.7E+308 1.7E+308 ECU_ADDRESS 0xfe4ae240 /* @ECU_Address@autosar_swc_las_rtARID_DEF.UnitDelay_DSTATE_ff@ */ /end MEASUREMENT
/begin MEASUREMENT autosar_swc_las_rtARID_DEF.UnitDelay_DSTATE_fi "" FLOAT64_IEEE autosar_swc_las_CM_double 0 0 -1.7E+308 1.7E+308 ECU_ADDRESS 0xfe4ae248 /* @ECU_Address@autosar_swc_las_rtARID_DEF.UnitDelay_DSTATE_fi@ */ /end MEASUREMENT
/begin MEASUREMENT autosar_swc_las_rtARID_DEF.UnitDelay_DSTATE_fl "" FLOAT64_IEEE autosar_swc_las_CM_double 0 0 -1.7E+308 1.7E+308 ECU_ADDRESS 0xfe4ae070 /* @ECU_Address@autosar_swc_las_rtARID_DEF.UnitDelay_DSTATE_fl@ */ /end MEASUREMENT
/begin MEASUREMENT autosar_swc_las_rtARID_DEF.UnitDelay_DSTATE_fs "" FLOAT32_IEEE autosar_swc_las_CM_single 0 0 -3.4E+38 3.4E+38 ECU_ADDRESS 0xfe4ae40c /* @ECU_Address@autosar_swc_las_rtARID_DEF.UnitDelay_DSTATE_fs@ */ /end MEASUREMENT
/begin MEASUREMENT autosar_swc_las_rtARID_DEF.UnitDelay_DSTATE_g "" FLOAT64_IEEE autosar_swc_las_CM_double 0 0 -1.7E+308 1.7E+308 ECU_ADDRESS 0xfe4ae078 /* @ECU_Address@autosar_swc_las_rtARID_DEF.UnitDelay_DSTATE_g@ */ /end MEASUREMENT
/begin MEASUREMENT autosar_swc_las_rtARID_DEF.UnitDelay_DSTATE_gb "" FLOAT64_IEEE autosar_swc_las_CM_double 0 0 -1.7E+308 1.7E+308 ECU_ADDRESS 0xfe4ae2c0 /* @ECU_Address@autosar_swc_las_rtARID_DEF.UnitDelay_DSTATE_gb@ */ /end MEASUREMENT
/begin MEASUREMENT autosar_swc_las_rtARID_DEF.UnitDelay_DSTATE_gw "" FLOAT64_IEEE autosar_swc_las_CM_double 0 0 -1.7E+308 1.7E+308 ECU_ADDRESS 0xfe4ae2c8 /* @ECU_Address@autosar_swc_las_rtARID_DEF.UnitDelay_DSTATE_gw@ */ /end MEASUREMENT
/begin MEASUREMENT autosar_swc_las_rtARID_DEF.UnitDelay_DSTATE_h "" FLOAT64_IEEE autosar_swc_las_CM_double 0 0 -1.7E+308 1.7E+308 ECU_ADDRESS 0xfe4ae030 /* @ECU_Address@autosar_swc_las_rtARID_DEF.UnitDelay_DSTATE_h@ */ /end MEASUREMENT
/begin MEASUREMENT autosar_swc_las_rtARID_DEF.UnitDelay_DSTATE_hk "" FLOAT64_IEEE autosar_swc_las_CM_double 0 0 -1.7E+308 1.7E+308 ECU_ADDRESS 0xfe4ae058 /* @ECU_Address@autosar_swc_las_rtARID_DEF.UnitDelay_DSTATE_hk@ */ /end MEASUREMENT
/begin MEASUREMENT autosar_swc_las_rtARID_DEF.UnitDelay_DSTATE_i "" FLOAT64_IEEE autosar_swc_las_CM_double 0 0 -1.7E+308 1.7E+308 ECU_ADDRESS 0xfe4ae038 /* @ECU_Address@autosar_swc_las_rtARID_DEF.UnitDelay_DSTATE_i@ */ /end MEASUREMENT
/begin MEASUREMENT autosar_swc_las_rtARID_DEF.UnitDelay_DSTATE_i5 "" FLOAT32_IEEE autosar_swc_las_CM_single 0 0 -3.4E+38 3.4E+38 ECU_ADDRESS 0xfe4ae39c /* @ECU_Address@autosar_swc_las_rtARID_DEF.UnitDelay_DSTATE_i5@ */ /end MEASUREMENT
/begin MEASUREMENT autosar_swc_las_rtARID_DEF.UnitDelay_DSTATE_in "" FLOAT32_IEEE autosar_swc_las_CM_single 0 0 -3.4E+38 3.4E+38 ECU_ADDRESS 0xfe4ae3f8 /* @ECU_Address@autosar_swc_las_rtARID_DEF.UnitDelay_DSTATE_in@ */ /end MEASUREMENT
/begin MEASUREMENT autosar_swc_las_rtARID_DEF.UnitDelay_DSTATE_io "" FLOAT64_IEEE autosar_swc_las_CM_double 0 0 -1.7E+308 1.7E+308 ECU_ADDRESS 0xfe4ae098 /* @ECU_Address@autosar_swc_las_rtARID_DEF.UnitDelay_DSTATE_io@ */ /end MEASUREMENT
/begin MEASUREMENT autosar_swc_las_rtARID_DEF.UnitDelay_DSTATE_iq "" FLOAT64_IEEE autosar_swc_las_CM_double 0 0 -1.7E+308 1.7E+308 ECU_ADDRESS 0xfe4ae088 /* @ECU_Address@autosar_swc_las_rtARID_DEF.UnitDelay_DSTATE_iq@ */ /end MEASUREMENT
/begin MEASUREMENT autosar_swc_las_rtARID_DEF.UnitDelay_DSTATE_ix "" FLOAT64_IEEE autosar_swc_las_CM_double 0 0 -1.7E+308 1.7E+308 ECU_ADDRESS 0xfe4ae048 /* @ECU_Address@autosar_swc_las_rtARID_DEF.UnitDelay_DSTATE_ix@ */ /end MEASUREMENT
/begin MEASUREMENT autosar_swc_las_rtARID_DEF.UnitDelay_DSTATE_j "" FLOAT64_IEEE autosar_swc_las_CM_double 0 0 -1.7E+308 1.7E+308 ECU_ADDRESS 0xfe4ae020 /* @ECU_Address@autosar_swc_las_rtARID_DEF.UnitDelay_DSTATE_j@ */ /end MEASUREMENT
/begin MEASUREMENT autosar_swc_las_rtARID_DEF.UnitDelay_DSTATE_jb "" FLOAT32_IEEE autosar_swc_las_CM_single 0 0 -3.4E+38 3.4E+38 ECU_ADDRESS 0xfe4ae460 /* @ECU_Address@autosar_swc_las_rtARID_DEF.UnitDelay_DSTATE_jb@ */ /end MEASUREMENT
/begin MEASUREMENT autosar_swc_las_rtARID_DEF.UnitDelay_DSTATE_jp "" FLOAT64_IEEE autosar_swc_las_CM_double 0 0 -1.7E+308 1.7E+308 ECU_ADDRESS 0xfe4ae220 /* @ECU_Address@autosar_swc_las_rtARID_DEF.UnitDelay_DSTATE_jp@ */ /end MEASUREMENT
/begin MEASUREMENT autosar_swc_las_rtARID_DEF.UnitDelay_DSTATE_ju "" FLOAT32_IEEE autosar_swc_las_CM_single 0 0 -3.4E+38 3.4E+38 ECU_ADDRESS 0xfe4ae384 /* @ECU_Address@autosar_swc_las_rtARID_DEF.UnitDelay_DSTATE_ju@ */ /end MEASUREMENT
/begin MEASUREMENT autosar_swc_las_rtARID_DEF.UnitDelay_DSTATE_k2 "" FLOAT32_IEEE autosar_swc_las_CM_single 0 0 -3.4E+38 3.4E+38 ECU_ADDRESS 0xfe4ae464 /* @ECU_Address@autosar_swc_las_rtARID_DEF.UnitDelay_DSTATE_k2@ */ /end MEASUREMENT
/begin MEASUREMENT autosar_swc_las_rtARID_DEF.UnitDelay_DSTATE_kn "" FLOAT64_IEEE autosar_swc_las_CM_double 0 0 -1.7E+308 1.7E+308 ECU_ADDRESS 0xfe4ae1c0 /* @ECU_Address@autosar_swc_las_rtARID_DEF.UnitDelay_DSTATE_kn@ */ /end MEASUREMENT
/begin MEASUREMENT autosar_swc_las_rtARID_DEF.UnitDelay_DSTATE_kus "" FLOAT64_IEEE autosar_swc_las_CM_double 0 0 -1.7E+308 1.7E+308 ECU_ADDRESS 0xfe4ae1f0 /* @ECU_Address@autosar_swc_las_rtARID_DEF.UnitDelay_DSTATE_kus@ */ /end MEASUREMENT
/begin MEASUREMENT autosar_swc_las_rtARID_DEF.UnitDelay_DSTATE_l "" FLOAT64_IEEE autosar_swc_las_CM_double 0 0 -1.7E+308 1.7E+308 ECU_ADDRESS 0xfe4adfe0 /* @ECU_Address@autosar_swc_las_rtARID_DEF.UnitDelay_DSTATE_l@ */ /end MEASUREMENT
/begin MEASUREMENT autosar_swc_las_rtARID_DEF.UnitDelay_DSTATE_lq "" FLOAT64_IEEE autosar_swc_las_CM_double 0 0 -1.7E+308 1.7E+308 ECU_ADDRESS 0xfe4ae068 /* @ECU_Address@autosar_swc_las_rtARID_DEF.UnitDelay_DSTATE_lq@ */ /end MEASUREMENT
/begin MEASUREMENT autosar_swc_las_rtARID_DEF.UnitDelay_DSTATE_lt "" FLOAT64_IEEE autosar_swc_las_CM_double 0 0 -1.7E+308 1.7E+308 ECU_ADDRESS 0xfe4ae1e8 /* @ECU_Address@autosar_swc_las_rtARID_DEF.UnitDelay_DSTATE_lt@ */ /end MEASUREMENT
/begin MEASUREMENT autosar_swc_las_rtARID_DEF.UnitDelay_DSTATE_lv "" FLOAT64_IEEE autosar_swc_las_CM_double 0 0 -1.7E+308 1.7E+308 ECU_ADDRESS 0xfe4ae000 /* @ECU_Address@autosar_swc_las_rtARID_DEF.UnitDelay_DSTATE_lv@ */ /end MEASUREMENT
/begin MEASUREMENT autosar_swc_las_rtARID_DEF.UnitDelay_DSTATE_lvq "" FLOAT64_IEEE autosar_swc_las_CM_double 0 0 -1.7E+308 1.7E+308 ECU_ADDRESS 0xfe4ae1e0 /* @ECU_Address@autosar_swc_las_rtARID_DEF.UnitDelay_DSTATE_lvq@ */ /end MEASUREMENT
/begin MEASUREMENT autosar_swc_las_rtARID_DEF.UnitDelay_DSTATE_m "" FLOAT64_IEEE autosar_swc_las_CM_double 0 0 -1.7E+308 1.7E+308 ECU_ADDRESS 0xfe4adff8 /* @ECU_Address@autosar_swc_las_rtARID_DEF.UnitDelay_DSTATE_m@ */ /end MEASUREMENT
/begin MEASUREMENT autosar_swc_las_rtARID_DEF.UnitDelay_DSTATE_n "" FLOAT64_IEEE autosar_swc_las_CM_double 0 0 -1.7E+308 1.7E+308 ECU_ADDRESS 0xfe4ae080 /* @ECU_Address@autosar_swc_las_rtARID_DEF.UnitDelay_DSTATE_n@ */ /end MEASUREMENT
/begin MEASUREMENT autosar_swc_las_rtARID_DEF.UnitDelay_DSTATE_n0 "" FLOAT64_IEEE autosar_swc_las_CM_double 0 0 -1.7E+308 1.7E+308 ECU_ADDRESS 0xfe4ae208 /* @ECU_Address@autosar_swc_las_rtARID_DEF.UnitDelay_DSTATE_n0@ */ /end MEASUREMENT
/begin MEASUREMENT autosar_swc_las_rtARID_DEF.UnitDelay_DSTATE_n4 "" FLOAT32_IEEE autosar_swc_las_CM_single 0 0 -3.4E+38 3.4E+38 ECU_ADDRESS 0xfe4ae430 /* @ECU_Address@autosar_swc_las_rtARID_DEF.UnitDelay_DSTATE_n4@ */ /end MEASUREMENT
/begin MEASUREMENT autosar_swc_las_rtARID_DEF.UnitDelay_DSTATE_ni "" FLOAT64_IEEE autosar_swc_las_CM_double 0 0 -1.7E+308 1.7E+308 ECU_ADDRESS 0xfe4ae200 /* @ECU_Address@autosar_swc_las_rtARID_DEF.UnitDelay_DSTATE_ni@ */ /end MEASUREMENT
/begin MEASUREMENT autosar_swc_las_rtARID_DEF.UnitDelay_DSTATE_o "" FLOAT64_IEEE autosar_swc_las_CM_double 0 0 -1.7E+308 1.7E+308 ECU_ADDRESS 0xfe4adff0 /* @ECU_Address@autosar_swc_las_rtARID_DEF.UnitDelay_DSTATE_o@ */ /end MEASUREMENT
/begin MEASUREMENT autosar_swc_las_rtARID_DEF.UnitDelay_DSTATE_oc "" FLOAT64_IEEE autosar_swc_las_CM_double 0 0 -1.7E+308 1.7E+308 ECU_ADDRESS 0xfe4ae230 /* @ECU_Address@autosar_swc_las_rtARID_DEF.UnitDelay_DSTATE_oc@ */ /end MEASUREMENT
/begin MEASUREMENT autosar_swc_las_rtARID_DEF.UnitDelay_DSTATE_om "" FLOAT64_IEEE autosar_swc_las_CM_double 0 0 -1.7E+308 1.7E+308 ECU_ADDRESS 0xfe4ae228 /* @ECU_Address@autosar_swc_las_rtARID_DEF.UnitDelay_DSTATE_om@ */ /end MEASUREMENT
/begin MEASUREMENT autosar_swc_las_rtARID_DEF.UnitDelay_DSTATE_p "" FLOAT64_IEEE autosar_swc_las_CM_double 0 0 -1.7E+308 1.7E+308 ECU_ADDRESS 0xfe4adfd8 /* @ECU_Address@autosar_swc_las_rtARID_DEF.UnitDelay_DSTATE_p@ */ /end MEASUREMENT
/begin MEASUREMENT autosar_swc_las_rtARID_DEF.UnitDelay_DSTATE_p5 "" FLOAT64_IEEE autosar_swc_las_CM_double 0 0 -1.7E+308 1.7E+308 ECU_ADDRESS 0xfe4adfe8 /* @ECU_Address@autosar_swc_las_rtARID_DEF.UnitDelay_DSTATE_p5@ */ /end MEASUREMENT
/begin MEASUREMENT autosar_swc_las_rtARID_DEF.Warn "" FLOAT64_IEEE autosar_swc_las_CM_double 0 0 -1.7E+308 1.7E+308 ECU_ADDRESS 0xfe4adf98 /* @ECU_Address@autosar_swc_las_rtARID_DEF.Warn@ */ /end MEASUREMENT
/begin MEASUREMENT autosar_swc_las_rtARID_DEF.actcount "" FLOAT64_IEEE autosar_swc_las_CM_double 0 0 -1.7E+308 1.7E+308 ECU_ADDRESS 0xfe4adfa8 /* @ECU_Address@autosar_swc_las_rtARID_DEF.actcount@ */ /end MEASUREMENT
/begin MEASUREMENT autosar_swc_las_rtARID_DEF.cnt_WarningLevel1 "" FLOAT32_IEEE autosar_swc_las_CM_single 0 0 -3.4E+38 3.4E+38 ECU_ADDRESS 0xfe4ae488 /* @ECU_Address@autosar_swc_las_rtARID_DEF.cnt_WarningLevel1@ */ /end MEASUREMENT
/begin MEASUREMENT autosar_swc_las_rtARID_DEF.cnt_WarningLevel2 "" FLOAT32_IEEE autosar_swc_las_CM_single 0 0 -3.4E+38 3.4E+38 ECU_ADDRESS 0xfe4ae48c /* @ECU_Address@autosar_swc_las_rtARID_DEF.cnt_WarningLevel2@ */ /end MEASUREMENT
/begin MEASUREMENT autosar_swc_las_rtARID_DEF.cntleft "" UBYTE autosar_swc_las_CM_uint8 0 0 0 255 ECU_ADDRESS 0xfe4ae4ca /* @ECU_Address@autosar_swc_las_rtARID_DEF.cntleft@ */ /end MEASUREMENT
/begin MEASUREMENT autosar_swc_las_rtARID_DEF.incount "" FLOAT64_IEEE autosar_swc_las_CM_double 0 0 -1.7E+308 1.7E+308 ECU_ADDRESS 0xfe4adfb8 /* @ECU_Address@autosar_swc_las_rtARID_DEF.incount@ */ /end MEASUREMENT
/begin MEASUREMENT autosar_swc_las_rtARID_DEF.is_HandsOff "" UBYTE autosar_swc_las_CM_uint8 0 0 0 255 ECU_ADDRESS 0xfe4ae4c7 /* @ECU_Address@autosar_swc_las_rtARID_DEF.is_HandsOff@ */ /end MEASUREMENT
/begin MEASUREMENT autosar_swc_las_rtARID_DEF.is_Interveneing "" UBYTE autosar_swc_las_CM_uint8 0 0 0 255 ECU_ADDRESS 0xfe4ae4c8 /* @ECU_Address@autosar_swc_las_rtARID_DEF.is_Interveneing@ */ /end MEASUREMENT
/begin MEASUREMENT autosar_swc_las_rtARID_DEF.is_Left "" UBYTE autosar_swc_las_CM_uint8 0 0 0 255 ECU_ADDRESS 0xfe4ae4da /* @ECU_Address@autosar_swc_las_rtARID_DEF.is_Left@ */ /end MEASUREMENT
/begin MEASUREMENT autosar_swc_las_rtARID_DEF.is_MAINST_ON "" UBYTE autosar_swc_las_CM_uint8 0 0 0 255 ECU_ADDRESS 0xfe4ae4cf /* @ECU_Address@autosar_swc_las_rtARID_DEF.is_MAINST_ON@ */ /end MEASUREMENT
/begin MEASUREMENT autosar_swc_las_rtARID_DEF.is_MAINST_ON_h "" UBYTE autosar_swc_las_CM_uint8 0 0 0 255 ECU_ADDRESS 0xfe4ae4d7 /* @ECU_Address@autosar_swc_las_rtARID_DEF.is_MAINST_ON_h@ */ /end MEASUREMENT
/begin MEASUREMENT autosar_swc_las_rtARID_DEF.is_Right "" UBYTE autosar_swc_las_CM_uint8 0 0 0 255 ECU_ADDRESS 0xfe4ae4db /* @ECU_Address@autosar_swc_las_rtARID_DEF.is_Right@ */ /end MEASUREMENT
/begin MEASUREMENT autosar_swc_las_rtARID_DEF.is_SUBST_ACTIVE "" UBYTE autosar_swc_las_CM_uint8 0 0 0 255 ECU_ADDRESS 0xfe4ae4d0 /* @ECU_Address@autosar_swc_las_rtARID_DEF.is_SUBST_ACTIVE@ */ /end MEASUREMENT
/begin MEASUREMENT autosar_swc_las_rtARID_DEF.is_SUBST_ACTIVE_LEFT "" UBYTE autosar_swc_las_CM_uint8 0 0 0 255 ECU_ADDRESS 0xfe4ae4d1 /* @ECU_Address@autosar_swc_las_rtARID_DEF.is_SUBST_ACTIVE_LEFT@ */ /end MEASUREMENT
/begin MEASUREMENT autosar_swc_las_rtARID_DEF.is_SUBST_ACTIVE_RIGHT "" UBYTE autosar_swc_las_CM_uint8 0 0 0 255 ECU_ADDRESS 0xfe4ae4d2 /* @ECU_Address@autosar_swc_las_rtARID_DEF.is_SUBST_ACTIVE_RIGHT@ */ /end MEASUREMENT
/begin MEASUREMENT autosar_swc_las_rtARID_DEF.is_SUBST_ACTIVE_a "" UBYTE autosar_swc_las_CM_uint8 0 0 0 255 ECU_ADDRESS 0xfe4ae4d9 /* @ECU_Address@autosar_swc_las_rtARID_DEF.is_SUBST_ACTIVE_a@ */ /end MEASUREMENT
/begin MEASUREMENT autosar_swc_las_rtARID_DEF.is_Time "" UBYTE autosar_swc_las_CM_uint8 0 0 0 255 ECU_ADDRESS 0xfe4ae4c6 /* @ECU_Address@autosar_swc_las_rtARID_DEF.is_Time@ */ /end MEASUREMENT
/begin MEASUREMENT autosar_swc_las_rtARID_DEF.is_WarningLevel2 "" UBYTE autosar_swc_las_CM_uint8 0 0 0 255 ECU_ADDRESS 0xfe4ae4c9 /* @ECU_Address@autosar_swc_las_rtARID_DEF.is_WarningLevel2@ */ /end MEASUREMENT
/begin MEASUREMENT autosar_swc_las_rtARID_DEF.is_active_c125_autosar_swc_las "" UBYTE autosar_swc_las_CM_uint8 0 0 0 255 ECU_ADDRESS 0xfe4ae4cb /* @ECU_Address@autosar_swc_las_rtARID_DEF.is_active_c125_autosar_swc_las@ */ /end MEASUREMENT
/begin MEASUREMENT autosar_swc_las_rtARID_DEF.is_active_c129_autosar_swc_las "" UBYTE autosar_swc_las_CM_uint8 0 0 0 255 ECU_ADDRESS 0xfe4ae4cd /* @ECU_Address@autosar_swc_las_rtARID_DEF.is_active_c129_autosar_swc_las@ */ /end MEASUREMENT
/begin MEASUREMENT autosar_swc_las_rtARID_DEF.is_active_c82_autosar_swc_las "" UBYTE autosar_swc_las_CM_uint8 0 0 0 255 ECU_ADDRESS 0xfe4ae4d5 /* @ECU_Address@autosar_swc_las_rtARID_DEF.is_active_c82_autosar_swc_las@ */ /end MEASUREMENT
/begin MEASUREMENT autosar_swc_las_rtARID_DEF.is_active_c89_autosar_swc_las "" UBYTE autosar_swc_las_CM_uint8 0 0 0 255 ECU_ADDRESS 0xfe4ae4d3 /* @ECU_Address@autosar_swc_las_rtARID_DEF.is_active_c89_autosar_swc_las@ */ /end MEASUREMENT
/begin MEASUREMENT autosar_swc_las_rtARID_DEF.is_c125_autosar_swc_las "" UBYTE autosar_swc_las_CM_uint8 0 0 0 255 ECU_ADDRESS 0xfe4ae4cc /* @ECU_Address@autosar_swc_las_rtARID_DEF.is_c125_autosar_swc_las@ */ /end MEASUREMENT
/begin MEASUREMENT autosar_swc_las_rtARID_DEF.is_c129_autosar_swc_las "" UBYTE autosar_swc_las_CM_uint8 0 0 0 255 ECU_ADDRESS 0xfe4ae4ce /* @ECU_Address@autosar_swc_las_rtARID_DEF.is_c129_autosar_swc_las@ */ /end MEASUREMENT
/begin MEASUREMENT autosar_swc_las_rtARID_DEF.is_c82_autosar_swc_las "" UBYTE autosar_swc_las_CM_uint8 0 0 0 255 ECU_ADDRESS 0xfe4ae4d6 /* @ECU_Address@autosar_swc_las_rtARID_DEF.is_c82_autosar_swc_las@ */ /end MEASUREMENT
/begin MEASUREMENT autosar_swc_las_rtARID_DEF.is_c89_autosar_swc_las "" UBYTE autosar_swc_las_CM_uint8 0 0 0 255 ECU_ADDRESS 0xfe4ae4d4 /* @ECU_Address@autosar_swc_las_rtARID_DEF.is_c89_autosar_swc_las@ */ /end MEASUREMENT
/begin MEASUREMENT autosar_swc_las_rtARID_DEF.is_inactive "" UBYTE autosar_swc_las_CM_uint8 0 0 0 255 ECU_ADDRESS 0xfe4ae4d8 /* @ECU_Address@autosar_swc_las_rtARID_DEF.is_inactive@ */ /end MEASUREMENT
/begin MEASUREMENT autosar_swc_las_rtARID_DEF.mPrePointX "" FLOAT32_IEEE autosar_swc_las_CM_single 0 0 -3.4E+38 3.4E+38 ECU_ADDRESS 0xfe4ae35c /* @ECU_Address@autosar_swc_las_rtARID_DEF.mPrePointX@ */ /end MEASUREMENT
/begin MEASUREMENT autosar_swc_las_rtARID_DEF.mPrePointX_c "" FLOAT32_IEEE autosar_swc_las_CM_single 0 0 -3.4E+38 3.4E+38 ECU_ADDRESS 0xfe4ae36c /* @ECU_Address@autosar_swc_las_rtARID_DEF.mPrePointX_c@ */ /end MEASUREMENT
/begin MEASUREMENT autosar_swc_las_rtARID_DEF.mPrePointX_m "" FLOAT32_IEEE autosar_swc_las_CM_single 0 0 -3.4E+38 3.4E+38 ECU_ADDRESS 0xfe4ae368 /* @ECU_Address@autosar_swc_las_rtARID_DEF.mPrePointX_m@ */ /end MEASUREMENT
/begin MEASUREMENT autosar_swc_las_rtARID_DEF.mPrePointX_o "" FLOAT32_IEEE autosar_swc_las_CM_single 0 0 -3.4E+38 3.4E+38 ECU_ADDRESS 0xfe4ae374 /* @ECU_Address@autosar_swc_las_rtARID_DEF.mPrePointX_o@ */ /end MEASUREMENT
/begin MEASUREMENT autosar_swc_las_rtARID_DEF.mPrePointY "" FLOAT32_IEEE autosar_swc_las_CM_single 0 0 -3.4E+38 3.4E+38 ECU_ADDRESS 0xfe4ae360 /* @ECU_Address@autosar_swc_las_rtARID_DEF.mPrePointY@ */ /end MEASUREMENT
/begin MEASUREMENT autosar_swc_las_rtARID_DEF.mPrePointY_e "" FLOAT32_IEEE autosar_swc_las_CM_single 0 0 -3.4E+38 3.4E+38 ECU_ADDRESS 0xfe4ae378 /* @ECU_Address@autosar_swc_las_rtARID_DEF.mPrePointY_e@ */ /end MEASUREMENT
/begin MEASUREMENT autosar_swc_las_rtARID_DEF.mPrePointY_j "" FLOAT32_IEEE autosar_swc_las_CM_single 0 0 -3.4E+38 3.4E+38 ECU_ADDRESS 0xfe4ae364 /* @ECU_Address@autosar_swc_las_rtARID_DEF.mPrePointY_j@ */ /end MEASUREMENT
/begin MEASUREMENT autosar_swc_las_rtARID_DEF.mPrePointY_l "" FLOAT32_IEEE autosar_swc_las_CM_single 0 0 -3.4E+38 3.4E+38 ECU_ADDRESS 0xfe4ae370 /* @ECU_Address@autosar_swc_las_rtARID_DEF.mPrePointY_l@ */ /end MEASUREMENT
/begin MEASUREMENT autosar_swc_las_rtARID_DEF.out_count "" FLOAT64_IEEE autosar_swc_las_CM_double 0 0 -1.7E+308 1.7E+308 ECU_ADDRESS 0xfe4adfa0 /* @ECU_Address@autosar_swc_las_rtARID_DEF.out_count@ */ /end MEASUREMENT
/begin MEASUREMENT autosar_swc_las_rtARID_DEF.temp "" FLOAT32_IEEE autosar_swc_las_CM_single 0 0 -3.4E+38 3.4E+38 ECU_ADDRESS 0xfe4ae490 /* @ECU_Address@autosar_swc_las_rtARID_DEF.temp@ */ /end MEASUREMENT
/begin MEASUREMENT autosar_swc_las_rtARID_DEF.wcount "" FLOAT64_IEEE autosar_swc_las_CM_double 0 0 -1.7E+308 1.7E+308 ECU_ADDRESS 0xfe4adfb0 /* @ECU_Address@autosar_swc_las_rtARID_DEF.wcount@ */ /end MEASUREMENT
/begin AXIS_PTS P_LSS_LDP_State_Param_CureLaneWidth "" 0xfe821854 /* @ECU_Address@P_LSS_LDP_State_Param_CureLaneWidth@ */ NO_INPUT_QUANTITY Axis_FLOAT32_IEEE 0 autosar_swc_las_CM_single 7 -3.4E+38 3.4E+38 /end AXIS_PTS
/begin AXIS_PTS P_LSS_LDW_State_Param_Speed "" 0xfe821738 /* @ECU_Address@P_LSS_LDW_State_Param_Speed@ */ NO_INPUT_QUANTITY Axis_FLOAT32_IEEE 0 autosar_swc_las_CM_single 16 -3.4E+38 3.4E+38 /end AXIS_PTS
/begin AXIS_PTS P_LSS_LKA_Lane_Width_Table_Calibration "" 0xfe821914 /* @ECU_Address@P_LSS_LKA_Lane_Width_Table_Calibration@ */ NO_INPUT_QUANTITY Axis_FLOAT32_IEEE 0 autosar_swc_las_CM_single 7 -3.4E+38 3.4E+38 /end AXIS_PTS
/begin AXIS_PTS P_LSS_LKA_Sensitive_Table_Calibration "" 0xfe821930 /* @ECU_Address@P_LSS_LKA_Sensitive_Table_Calibration@ */ NO_INPUT_QUANTITY Axis_FLOAT32_IEEE 0 autosar_swc_las_CM_single 3 -3.4E+38 3.4E+38 /end AXIS_PTS
/begin AXIS_PTS P_LSS_SCM_CenterLineA0_TabX "" 0xfe821778 /* @ECU_Address@P_LSS_SCM_CenterLineA0_TabX@ */ NO_INPUT_QUANTITY Axis_FLOAT32_IEEE 0 autosar_swc_las_CM_single 4 -3.4E+38 3.4E+38 /end AXIS_PTS
/begin AXIS_PTS P_LSS_SCM_LaneWidth2ControlLineLatOffset "" 0xfe821a4c /* @ECU_Address@P_LSS_SCM_LaneWidth2ControlLineLatOffset@ */ NO_INPUT_QUANTITY Axis_FLOAT32_IEEE 0 autosar_swc_las_CM_single 36 -3.4E+38 3.4E+38 /end AXIS_PTS
/begin AXIS_PTS P_LSS_SCM_VehSpd_ms "" 0xfe821990 /* @ECU_Address@P_LSS_SCM_VehSpd_ms@ */ NO_INPUT_QUANTITY Axis_FLOAT32_IEEE 0 autosar_swc_las_CM_single 11 -3.4E+38 3.4E+38 /end AXIS_PTS
/begin COMPU_METHOD autosar_swc_las_CM_STATE "Enumerated data type: STATE" TAB_VERB "%0.6" "" COMPU_TAB_REF VTAB_FOR_autosar_swc_las_CM_STATE /end COMPU_METHOD
/begin COMPU_VTAB VTAB_FOR_autosar_swc_las_CM_STATE "Enumerated data type: STATE" TAB_VERB 8 0 "STATE_OFF" 1 "STATE_IDLE" 2 "STATE_READY" 3 "STATE_ACTIVE" 4 "STATE_ACTIVE_LEFT" 5 "STATE_ACTIVE_RIGHT" 6 "STATE_ERROR" 7 "STATE_DEFAULT" /end COMPU_VTAB
/begin COMPU_METHOD autosar_swc_las_CM_boolean "Q = V" IDENTICAL "%1.0" "" /end COMPU_METHOD
/begin COMPU_METHOD autosar_swc_las_CM_double "Q = V" IDENTICAL "%15.10" "" /end COMPU_METHOD
/begin COMPU_METHOD autosar_swc_las_CM_int32 "Q = V" IDENTICAL "%10.0" "" /end COMPU_METHOD
/begin COMPU_METHOD autosar_swc_las_CM_int8 "Q = V" IDENTICAL "%3.0" "" /end COMPU_METHOD
/begin COMPU_METHOD autosar_swc_las_CM_logical "Q = V" IDENTICAL "%1.0" "" /end COMPU_METHOD
/begin COMPU_METHOD autosar_swc_las_CM_single "Q = V" IDENTICAL "%8.6" "" /end COMPU_METHOD
/begin COMPU_METHOD autosar_swc_las_CM_uint16 "Q = V" IDENTICAL "%5.0" "" /end COMPU_METHOD
/begin COMPU_METHOD autosar_swc_las_CM_uint32 "Q = V" IDENTICAL "%10.0" "" /end COMPU_METHOD
/begin COMPU_METHOD autosar_swc_las_CM_uint64 "Q = V" IDENTICAL "%20.0" "" /end COMPU_METHOD
/begin COMPU_METHOD autosar_swc_las_CM_uint8 "Q = V" IDENTICAL "%3.0" "" /end COMPU_METHOD
/begin RECORD_LAYOUT Record_BOOLEAN FNC_VALUES 1 UBYTE COLUMN_DIR DIRECT /end RECORD_LAYOUT
/begin RECORD_LAYOUT Record_FLOAT32_IEEE FNC_VALUES 1 FLOAT32_IEEE COLUMN_DIR DIRECT /end RECORD_LAYOUT
/begin RECORD_LAYOUT Record_FLOAT64_IEEE FNC_VALUES 1 FLOAT64_IEEE COLUMN_DIR DIRECT /end RECORD_LAYOUT
/begin RECORD_LAYOUT Record_UBYTE FNC_VALUES 1 UBYTE COLUMN_DIR DIRECT /end RECORD_LAYOUT
/begin RECORD_LAYOUT Record_UWORD FNC_VALUES 1 UWORD COLUMN_DIR DIRECT /end RECORD_LAYOUT
/begin RECORD_LAYOUT Axis_FLOAT32_IEEE AXIS_PTS_X 1 FLOAT32_IEEE INDEX_INCR DIRECT /end RECORD_LAYOUT
/begin GROUP autosar_swc_las_autosar_swc_las_Step_sys_las_LDW_LDW_Condition_SASDegOverride1_TrueDurationTime3 "autosar_swc_las/autosar_swc_las_Step_sys/las/LDW/LDW_Condition/SASDegOverride1/TrueDurationTime3"
 /begin REF_MEASUREMENT autosar_swc_las_rtARID_DEF.UnitDelay1_DSTATE_g autosar_swc_las_rtARID_DEF.UnitDelay2_DSTATE_h /end REF_MEASUREMENT
/end GROUP
/begin GROUP autosar_swc_las_autosar_swc_las_Step_sys_las_LDW_LDW_Condition_Subsystem "autosar_swc_las/autosar_swc_las_Step_sys/las/LDW/LDW_Condition/Subsystem" /begin REF_MEASUREMENT autosar_swc_las_rtARID_DEF.UnitDelay_DSTATE_kn /end REF_MEASUREMENT /end GROUP
/begin GROUP autosar_swc_las_autosar_swc_las_Step_sys_las_LDW_LDW_Condition_Subsystem10 "autosar_swc_las/autosar_swc_las_Step_sys/las/LDW/LDW_Condition/Subsystem10" /begin REF_MEASUREMENT autosar_swc_las_rtARID_DEF.UnitDelay_DSTATE_lt /end REF_MEASUREMENT /end GROUP
/begin GROUP autosar_swc_las_autosar_swc_las_Step_sys_las_LDW_LDW_Condition_Subsystem11 "autosar_swc_las/autosar_swc_las_Step_sys/las/LDW/LDW_Condition/Subsystem11" /begin REF_MEASUREMENT autosar_swc_las_rtARID_DEF.UnitDelay_DSTATE_ni /end REF_MEASUREMENT /end GROUP
/begin GROUP autosar_swc_las_autosar_swc_las_Step_sys_las_LDW_LDW_Condition_Subsystem12 "autosar_swc_las/autosar_swc_las_Step_sys/las/LDW/LDW_Condition/Subsystem12" /begin REF_MEASUREMENT autosar_swc_las_rtARID_DEF.UnitDelay_DSTATE_jp /end REF_MEASUREMENT /end GROUP
/begin GROUP autosar_swc_las_autosar_swc_las_Step_sys_las_LDW_LDW_Condition_Subsystem14 "autosar_swc_las/autosar_swc_las_Step_sys/las/LDW/LDW_Condition/Subsystem14" /begin REF_MEASUREMENT autosar_swc_las_rtARID_DEF.UnitDelay_DSTATE_lvq /end REF_MEASUREMENT /end GROUP
/begin GROUP autosar_swc_las_autosar_swc_las_Step_sys_las_LDW_LDW_Condition_Subsystem2 "autosar_swc_las/autosar_swc_las_Step_sys/las/LDW/LDW_Condition/Subsystem2" /begin REF_MEASUREMENT autosar_swc_las_rtARID_DEF.UnitDelay_DSTATE_ed /end REF_MEASUREMENT /end GROUP
/begin GROUP autosar_swc_las_autosar_swc_las_Step_sys_las_LDW_LDW_Condition_Subsystem3 "autosar_swc_las/autosar_swc_las_Step_sys/las/LDW/LDW_Condition/Subsystem3" /begin REF_MEASUREMENT autosar_swc_las_rtARID_DEF.UnitDelay_DSTATE_cb /end REF_MEASUREMENT /end GROUP
/begin GROUP autosar_swc_las_autosar_swc_las_Step_sys_las_LDW_LDW_Condition_Subsystem4 "autosar_swc_las/autosar_swc_las_Step_sys/las/LDW/LDW_Condition/Subsystem4" /begin REF_MEASUREMENT autosar_swc_las_rtARID_DEF.UnitDelay_DSTATE_kus /end REF_MEASUREMENT /end GROUP
/begin GROUP autosar_swc_las_autosar_swc_las_Step_sys_las_LDW_LDW_Condition_Subsystem5 "autosar_swc_las/autosar_swc_las_Step_sys/las/LDW/LDW_Condition/Subsystem5" /begin REF_MEASUREMENT autosar_swc_las_rtARID_DEF.UnitDelay_DSTATE_om /end REF_MEASUREMENT /end GROUP
/begin GROUP autosar_swc_las_autosar_swc_las_Step_sys_las_LDW_LDW_Condition_Subsystem6 "autosar_swc_las/autosar_swc_las_Step_sys/las/LDW/LDW_Condition/Subsystem6" /begin REF_MEASUREMENT autosar_swc_las_rtARID_DEF.UnitDelay_DSTATE_oc /end REF_MEASUREMENT /end GROUP
/begin GROUP autosar_swc_las_autosar_swc_las_Step_sys_las_LDW_LDW_Condition_Subsystem9 "autosar_swc_las/autosar_swc_las_Step_sys/las/LDW/LDW_Condition/Subsystem9" /begin REF_MEASUREMENT autosar_swc_las_rtARID_DEF.UnitDelay_DSTATE_n0 /end REF_MEASUREMENT /end GROUP
/begin GROUP autosar_swc_las_autosar_swc_las_Step_sys_las_LDW_LDW_StateMachine "autosar_swc_las/autosar_swc_las_Step_sys/las/LDW/LDW_StateMachine"
 /begin SUB_GROUP autosar_swc_las_autosar_swc_las_Step_sys_las_LDW_LDW_StateMachine_Subsystem autosar_swc_las_autosar_swc_las_Step_sys_las_LDW_LDW_StateMachine_Subsystem1 autosar_swc_las_autosar_swc_las_Step_sys_las_LDW_LDW_StateMachine_Subsystem2 autosar_swc_las_autosar_swc_las_Step_sys_las_LDW_LDW_StateMachine_TurnLightAffirm autosar_swc_las_autosar_swc_las_Step_sys_las_LDW_LDW_StateMachine_TurnLightAffirm1 /end SUB_GROUP
 /begin REF_MEASUREMENT LAS_LDW_Count LAS_LDW_VehConfigLDW LAS_LDW_wCount autosar_swc_las_rtARID_DEF.Out_f autosar_swc_las_rtARID_DEF.Out_f5 autosar_swc_las_rtARID_DEF.is_Left autosar_swc_las_rtARID_DEF.is_MAINST_ON_h autosar_swc_las_rtARID_DEF.is_Right autosar_swc_las_rtARID_DEF.is_SUBST_ACTIVE_a autosar_swc_las_rtARID_DEF.is_active_c82_autosar_swc_las autosar_swc_las_rtARID_DEF.is_c82_autosar_swc_las autosar_swc_las_rtARID_DEF.is_inactive /end REF_MEASUREMENT
/end GROUP
/begin GROUP autosar_swc_las_autosar_swc_las_Step_sys_las_LDW_LDW_StateMachine_Subsystem "autosar_swc_las/autosar_swc_las_Step_sys/las/LDW/LDW_StateMachine/Subsystem"
 /begin SUB_GROUP autosar_swc_las_autosar_swc_las_Step_sys_las_LDW_LDW_StateMachine_Subsystem_Subsystem2 /end SUB_GROUP
 /begin REF_MEASUREMENT autosar_swc_las_rtARID_DEF.UnitDelay_DSTATE_jb /end REF_MEASUREMENT
/end GROUP
/begin GROUP autosar_swc_las_autosar_swc_las_Step_sys_las_LDW_LDW_StateMachine_Subsystem1 "autosar_swc_las/autosar_swc_las_Step_sys/las/LDW/LDW_StateMachine/Subsystem1"
 /begin SUB_GROUP autosar_swc_las_autosar_swc_las_Step_sys_las_LDW_LDW_StateMachine_Subsystem1_Subsystem2 /end SUB_GROUP
 /begin REF_MEASUREMENT autosar_swc_las_rtARID_DEF.UnitDelay_DSTATE_k2 /end REF_MEASUREMENT
/end GROUP
/begin GROUP autosar_swc_las_autosar_swc_las_Step_sys_las_LDW_LDW_StateMachine_Subsystem1_Subsystem2 "autosar_swc_las/autosar_swc_las_Step_sys/las/LDW/LDW_StateMachine/Subsystem1/Subsystem2" /begin REF_MEASUREMENT autosar_swc_las_rtARID_DEF.UnitDelay_DSTATE_f2v /end REF_MEASUREMENT /end GROUP
/begin GROUP autosar_swc_las_autosar_swc_las_Step_sys_las_LDW_LDW_StateMachine_Subsystem2 "autosar_swc_las/autosar_swc_las_Step_sys/las/LDW/LDW_StateMachine/Subsystem2"
 /begin REF_MEASUREMENT autosar_swc_las_rtARID_DEF.Delay1_DSTATE_g autosar_swc_las_rtARID_DEF.Delay_DSTATE_b autosar_swc_las_rtARID_DEF.Out_f autosar_swc_las_rtARID_DEF.Out_f5 /end REF_MEASUREMENT
/end GROUP
/begin GROUP autosar_swc_las_autosar_swc_las_Step_sys_las_LDW_LDW_StateMachine_Subsystem_Subsystem2 "autosar_swc_las/autosar_swc_las_Step_sys/las/LDW/LDW_StateMachine/Subsystem/Subsystem2" /begin REF_MEASUREMENT autosar_swc_las_rtARID_DEF.UnitDelay_DSTATE_c5 /end REF_MEASUREMENT /end GROUP
/begin GROUP autosar_swc_las_autosar_swc_las_Step_sys_las_LDW_LDW_StateMachine_TurnLightAffirm "autosar_swc_las/autosar_swc_las_Step_sys/las/LDW/LDW_StateMachine/TurnLightAffirm"
 /begin SUB_GROUP autosar_swc_las_autosar_swc_las_Step_sys_las_LDW_LDW_StateMachine_TurnLightAffirm_Compare_To_Constant15 autosar_swc_las_autosar_swc_las_Step_sys_las_LDW_LDW_StateMachine_TurnLightAffirm_Subsystem9 /end SUB_GROUP
/end GROUP
/begin GROUP autosar_swc_las_autosar_swc_las_Step_sys_las_LDW_LDW_StateMachine_TurnLightAffirm1 "autosar_swc_las/autosar_swc_las_Step_sys/las/LDW/LDW_StateMachine/TurnLightAffirm1"
 /begin SUB_GROUP autosar_swc_las_autosar_swc_las_Step_sys_las_LDW_LDW_StateMachine_TurnLightAffirm1_Compare_To_Constant15 autosar_swc_las_autosar_swc_las_Step_sys_las_LDW_LDW_StateMachine_TurnLightAffirm1_Subsystem9 /end SUB_GROUP
/end GROUP
/begin GROUP autosar_swc_las_autosar_swc_las_Step_sys_las_LDW_LDW_StateMachine_TurnLightAffirm1_Compare_To_Constant15 "autosar_swc_las/autosar_swc_las_Step_sys/las/LDW/LDW_StateMachine/TurnLightAffirm1/Compare\nTo Constant15" /begin REF_CHARACTERISTIC P_LSS_LDW_TurnLightInTime /end REF_CHARACTERISTIC /end GROUP
/begin GROUP autosar_swc_las_autosar_swc_las_Step_sys_las_LDW_LDW_StateMachine_TurnLightAffirm1_Subsystem9 "autosar_swc_las/autosar_swc_las_Step_sys/las/LDW/LDW_StateMachine/TurnLightAffirm1/Subsystem9" /begin REF_MEASUREMENT autosar_swc_las_rtARID_DEF.UnitDelay_DSTATE_fi /end REF_MEASUREMENT /end GROUP
/begin GROUP autosar_swc_las_autosar_swc_las_Step_sys_las_LDW_LDW_StateMachine_TurnLightAffirm_Compare_To_Constant15 "autosar_swc_las/autosar_swc_las_Step_sys/las/LDW/LDW_StateMachine/TurnLightAffirm/Compare\nTo Constant15" /begin REF_CHARACTERISTIC P_LSS_LDW_TurnLightInTime /end REF_CHARACTERISTIC /end GROUP
/begin GROUP autosar_swc_las_autosar_swc_las_Step_sys_las_LDW_LDW_StateMachine_TurnLightAffirm_Subsystem9 "autosar_swc_las/autosar_swc_las_Step_sys/las/LDW/LDW_StateMachine/TurnLightAffirm/Subsystem9" /begin REF_MEASUREMENT autosar_swc_las_rtARID_DEF.UnitDelay_DSTATE_ff /end REF_MEASUREMENT /end GROUP
/begin GROUP autosar_swc_las_autosar_swc_las_Step_sys_las_LDW_Subsystem3 "autosar_swc_las/autosar_swc_las_Step_sys/las/LDW/Subsystem3" /begin REF_CHARACTERISTIC P_LSS_LDW_Configure P_LSS_LDW_ConfigureSW /end REF_CHARACTERISTIC /begin REF_MEASUREMENT LAS_LDW_VehConfigLDW /end REF_MEASUREMENT /end GROUP
/begin GROUP autosar_swc_las_autosar_swc_las_Step_sys_las_LKA "autosar_swc_las/autosar_swc_las_Step_sys/las/LKA"
 /begin SUB_GROUP autosar_swc_las_autosar_swc_las_Step_sys_las_LKA_LKA2 autosar_swc_las_autosar_swc_las_Step_sys_las_LKA_LKA_Condition autosar_swc_las_autosar_swc_las_Step_sys_las_LKA_LKA_StateMachine autosar_swc_las_autosar_swc_las_Step_sys_las_LKA_Subsystem3 /end SUB_GROUP
 /begin REF_MEASUREMENT LAS_LKAState LAS_Reserve9 autosar_swc_las_rtARID_DEF.LogicalOperator1_bj autosar_swc_las_rtARID_DEF.Out autosar_swc_las_rtARID_DEF.UnitDelay_DSTATE_c1 /end REF_MEASUREMENT
/end GROUP
/begin GROUP autosar_swc_las_autosar_swc_las_Step_sys_las_LKA_LKA2 "autosar_swc_las/autosar_swc_las_Step_sys/las/LKA/LKA2"
 /begin SUB_GROUP autosar_swc_las_autosar_swc_las_Step_sys_las_LKA_LKA2_Compare_To_Constant1 autosar_swc_las_autosar_swc_las_Step_sys_las_LKA_LKA2_Compare_To_Constant2 autosar_swc_las_autosar_swc_las_Step_sys_las_LKA_LKA2_Compare_To_Constant45 autosar_swc_las_autosar_swc_las_Step_sys_las_LKA_LKA2_Compare_To_Constant48 autosar_swc_las_autosar_swc_las_Step_sys_las_LKA_LKA2_Compare_To_Constant49 autosar_swc_las_autosar_swc_las_Step_sys_las_LKA_LKA2_Compare_To_Constant5 autosar_swc_las_autosar_swc_las_Step_sys_las_LKA_LKA2_Compare_To_Constant50 autosar_swc_las_autosar_swc_las_Step_sys_las_LKA_LKA2_Compare_To_Constant51 autosar_swc_las_autosar_swc_las_Step_sys_las_LKA_LKA2_Compare_To_Constant8 autosar_swc_las_autosar_swc_las_Step_sys_las_LKA_LKA2_Subsystem1 autosar_swc_las_autosar_swc_las_Step_sys_las_LKA_LKA2_Subsystem2 autosar_swc_las_autosar_swc_las_Step_sys_las_LKA_LKA2_Subsystem3 autosar_swc_las_autosar_swc_las_Step_sys_las_LKA_LKA2_Subsystem4 autosar_swc_las_autosar_swc_las_Step_sys_las_LKA_LKA2_Subsystem5 autosar_swc_las_autosar_swc_las_Step_sys_las_LKA_LKA2_Subsystem6 /end SUB_GROUP
 /begin REF_CHARACTERISTIC P_LSS_LDP_PredicteSwitch P_LSS_LDP_State_Param_CureLaneWidth P_LSS_LDP_State_Param_CureLaneWidth_offsetfactor P_LSS_LKA_CurveFactor P_LSS_LKA_EndSwitch P_LSS_LKA_InterSw P_LSS_LKA_Lane_Width_Table_Calibration P_LSS_LKA_Sensitive_Switch P_LSS_LKA_Sensitive_Table_Calibration P_LSS_LKA_State_Param_A0Offset P_LSS_LKA_State_Param_A1leOffset P_LSS_LKA_State_Param_AngleOffset P_LSS_LKA_State_Param_InterventionZoneOut P_LSS_LKA_State_Param_LaneWidth_Offset P_LSS_LKA_State_Param_LeftInterventionZoneIn P_LSS_LKA_State_Param_OutOffset P_LSS_LKA_State_Param_PreLeftInterventionZoneIn P_LSS_LKA_State_Param_PreRiInterventionZoneIn P_LSS_LKA_State_Param_RiInterventionZoneIn P_LSS_LKA_State_Param_Sensitive_Offset P_LSS_LKA_Warnarea1 P_LSS_LKA_Warnarea2 /end REF_CHARACTERISTIC
 /begin REF_MEASUREMENT LAS_LKAState LAS_LKA_FiLeftIntervention LAS_LKA_FiRightIntervention LAS_LKA_LeftIntervention LAS_LKA_LeftInterventionEnd LAS_LKA_LeftWarning LAS_LKA_Leftout LAS_LKA_RightIntervention LAS_LKA_RightInterventionEnd LAS_LKA_RightWarning LAS_LKA_Rightout autosar_swc_las_rtARID_DEF.LogicalOperator12 autosar_swc_las_rtARID_DEF.LogicalOperator1_p autosar_swc_las_rtARID_DEF.UnitDelay1_DSTATE_m autosar_swc_las_rtARID_DEF.UnitDelay2_DSTATE_d autosar_swc_las_rtARID_DEF.UnitDelay4_DSTATE_f autosar_swc_las_rtARID_DEF.UnitDelay5_DSTATE_j autosar_swc_las_rtARID_DEF.UnitDelay7_DSTATE_b autosar_swc_las_rtARID_DEF.UnitDelay8_DSTATE_n /end REF_MEASUREMENT
/end GROUP
/begin GROUP autosar_swc_las_autosar_swc_las_Step_sys_las_LKA_LKA2_Compare_To_Constant1 "autosar_swc_las/autosar_swc_las_Step_sys/las/LKA/LKA2/Compare\nTo Constant1" /begin REF_CHARACTERISTIC P_LSS_LKA_LaneOutWidth_m /end REF_CHARACTERISTIC /end GROUP
/begin GROUP autosar_swc_las_autosar_swc_las_Step_sys_las_LKA_LKA2_Compare_To_Constant2 "autosar_swc_las/autosar_swc_las_Step_sys/las/LKA/LKA2/Compare\nTo Constant2" /begin REF_CHARACTERISTIC P_LSS_LKA_LaneInWidth_m /end REF_CHARACTERISTIC /end GROUP
/begin GROUP autosar_swc_las_autosar_swc_las_Step_sys_las_LKA_LKA2_Compare_To_Constant45 "autosar_swc_las/autosar_swc_las_Step_sys/las/LKA/LKA2/Compare\nTo Constant45" /begin REF_CHARACTERISTIC P_LSS_LKA_WarnInTime /end REF_CHARACTERISTIC /end GROUP
/begin GROUP autosar_swc_las_autosar_swc_las_Step_sys_las_LKA_LKA2_Compare_To_Constant48 "autosar_swc_las/autosar_swc_las_Step_sys/las/LKA/LKA2/Compare\nTo Constant48" /begin REF_CHARACTERISTIC P_LSS_LKA_Warnarea2 /end REF_CHARACTERISTIC /end GROUP
/begin GROUP autosar_swc_las_autosar_swc_las_Step_sys_las_LKA_LKA2_Compare_To_Constant49 "autosar_swc_las/autosar_swc_las_Step_sys/las/LKA/LKA2/Compare\nTo Constant49" /begin REF_CHARACTERISTIC P_LSS_LKA_WarnInTime /end REF_CHARACTERISTIC /end GROUP
/begin GROUP autosar_swc_las_autosar_swc_las_Step_sys_las_LKA_LKA2_Compare_To_Constant5 "autosar_swc_las/autosar_swc_las_Step_sys/las/LKA/LKA2/Compare\nTo Constant5" /begin REF_MEASUREMENT LAS_LKAState /end REF_MEASUREMENT /end GROUP
/begin GROUP autosar_swc_las_autosar_swc_las_Step_sys_las_LKA_LKA2_Compare_To_Constant50 "autosar_swc_las/autosar_swc_las_Step_sys/las/LKA/LKA2/Compare\nTo Constant50" /begin REF_CHARACTERISTIC P_LSS_LKA_Warnarea1 /end REF_CHARACTERISTIC /end GROUP
/begin GROUP autosar_swc_las_autosar_swc_las_Step_sys_las_LKA_LKA2_Compare_To_Constant51 "autosar_swc_las/autosar_swc_las_Step_sys/las/LKA/LKA2/Compare\nTo Constant51" /begin REF_CHARACTERISTIC P_LSS_LKA_Warnarea1 /end REF_CHARACTERISTIC /end GROUP
/begin GROUP autosar_swc_las_autosar_swc_las_Step_sys_las_LKA_LKA2_Compare_To_Constant8 "autosar_swc_las/autosar_swc_las_Step_sys/las/LKA/LKA2/Compare\nTo Constant8" /begin REF_MEASUREMENT LAS_LKAState /end REF_MEASUREMENT /end GROUP
/begin GROUP autosar_swc_las_autosar_swc_las_Step_sys_las_LKA_LKA2_Subsystem1 "autosar_swc_las/autosar_swc_las_Step_sys/las/LKA/LKA2/Subsystem1" /begin REF_MEASUREMENT autosar_swc_las_rtARID_DEF.UnitDelay_DSTATE_i /end REF_MEASUREMENT /end GROUP
/begin GROUP autosar_swc_las_autosar_swc_las_Step_sys_las_LKA_LKA2_Subsystem2 "autosar_swc_las/autosar_swc_las_Step_sys/las/LKA/LKA2/Subsystem2" /begin REF_MEASUREMENT autosar_swc_las_rtARID_DEF.UnitDelay_DSTATE_hk /end REF_MEASUREMENT /end GROUP
/begin GROUP autosar_swc_las_autosar_swc_las_Step_sys_las_LKA_LKA2_Subsystem3 "autosar_swc_las/autosar_swc_las_Step_sys/las/LKA/LKA2/Subsystem3" /begin REF_MEASUREMENT autosar_swc_las_rtARID_DEF.UnitDelay_DSTATE_d5 /end REF_MEASUREMENT /end GROUP
/begin GROUP autosar_swc_las_autosar_swc_las_Step_sys_las_LKA_LKA2_Subsystem4 "autosar_swc_las/autosar_swc_las_Step_sys/las/LKA/LKA2/Subsystem4" /begin REF_MEASUREMENT autosar_swc_las_rtARID_DEF.UnitDelay_DSTATE_h /end REF_MEASUREMENT /end GROUP
/begin GROUP autosar_swc_las_autosar_swc_las_Step_sys_las_LKA_LKA2_Subsystem5 "autosar_swc_las/autosar_swc_las_Step_sys/las/LKA/LKA2/Subsystem5" /begin REF_MEASUREMENT autosar_swc_las_rtARID_DEF.UnitDelay_DSTATE_p /end REF_MEASUREMENT /end GROUP
/begin GROUP autosar_swc_las_autosar_swc_las_Step_sys_las_LKA_LKA2_Subsystem6 "autosar_swc_las/autosar_swc_las_Step_sys/las/LKA/LKA2/Subsystem6" /begin REF_MEASUREMENT autosar_swc_las_rtARID_DEF.UnitDelay_DSTATE_l /end REF_MEASUREMENT /end GROUP
/begin GROUP autosar_swc_las_autosar_swc_las_Step_sys_las_LKA_LKA_Condition "autosar_swc_las/autosar_swc_las_Step_sys/las/LKA/LKA_Condition"
 /begin SUB_GROUP autosar_swc_las_autosar_swc_las_Step_sys_las_LKA_LKA_Condition_Compare_To_Constant1 autosar_swc_las_autosar_swc_las_Step_sys_las_LKA_LKA_Condition_Compare_To_Constant10 autosar_swc_las_autosar_swc_las_Step_sys_las_LKA_LKA_Condition_Compare_To_Constant11 autosar_swc_las_autosar_swc_las_Step_sys_las_LKA_LKA_Condition_Compare_To_Constant12 autosar_swc_las_autosar_swc_las_Step_sys_las_LKA_LKA_Condition_Compare_To_Constant123 autosar_swc_las_autosar_swc_las_Step_sys_las_LKA_LKA_Condition_Compare_To_Constant126 autosar_swc_las_autosar_swc_las_Step_sys_las_LKA_LKA_Condition_Compare_To_Constant150 autosar_swc_las_autosar_swc_las_Step_sys_las_LKA_LKA_Condition_Compare_To_Constant153 autosar_swc_las_autosar_swc_las_Step_sys_las_LKA_LKA_Condition_Compare_To_Constant158 autosar_swc_las_autosar_swc_las_Step_sys_las_LKA_LKA_Condition_Compare_To_Constant17 autosar_swc_las_autosar_swc_las_Step_sys_las_LKA_LKA_Condition_Compare_To_Constant170 autosar_swc_las_autosar_swc_las_Step_sys_las_LKA_LKA_Condition_Compare_To_Constant171 autosar_swc_las_autosar_swc_las_Step_sys_las_LKA_LKA_Condition_Compare_To_Constant173 autosar_swc_las_autosar_swc_las_Step_sys_las_LKA_LKA_Condition_Compare_To_Constant188 autosar_swc_las_autosar_swc_las_Step_sys_las_LKA_LKA_Condition_Compare_To_Constant19 autosar_swc_las_autosar_swc_las_Step_sys_las_LKA_LKA_Condition_Compare_To_Constant197 autosar_swc_las_autosar_swc_las_Step_sys_las_LKA_LKA_Condition_Compare_To_Constant209 autosar_swc_las_autosar_swc_las_Step_sys_las_LKA_LKA_Condition_Compare_To_Constant211 autosar_swc_las_autosar_swc_las_Step_sys_las_LKA_LKA_Condition_Compare_To_Constant225 autosar_swc_las_autosar_swc_las_Step_sys_las_LKA_LKA_Condition_Compare_To_Constant233 autosar_swc_las_autosar_swc_las_Step_sys_las_LKA_LKA_Condition_Compare_To_Constant234 autosar_swc_las_autosar_swc_las_Step_sys_las_LKA_LKA_Condition_Compare_To_Constant236 autosar_swc_las_autosar_swc_las_Step_sys_las_LKA_LKA_Condition_Compare_To_Constant26 autosar_swc_las_autosar_swc_las_Step_sys_las_LKA_LKA_Condition_Compare_To_Constant27 autosar_swc_las_autosar_swc_las_Step_sys_las_LKA_LKA_Condition_Compare_To_Constant33 autosar_swc_las_autosar_swc_las_Step_sys_las_LKA_LKA_Condition_Compare_To_Constant39 autosar_swc_las_autosar_swc_las_Step_sys_las_LKA_LKA_Condition_Compare_To_Constant41 autosar_swc_las_autosar_swc_las_Step_sys_las_LKA_LKA_Condition_Compare_To_Constant43 autosar_swc_las_autosar_swc_las_Step_sys_las_LKA_LKA_Condition_Compare_To_Constant44 autosar_swc_las_autosar_swc_las_Step_sys_las_LKA_LKA_Condition_Compare_To_Constant46 autosar_swc_las_autosar_swc_las_Step_sys_las_LKA_LKA_Condition_Compare_To_Constant54 autosar_swc_las_autosar_swc_las_Step_sys_las_LKA_LKA_Condition_Compare_To_Constant6 autosar_swc_las_autosar_swc_las_Step_sys_las_LKA_LKA_Condition_Compare_To_Constant8 autosar_swc_las_autosar_swc_las_Step_sys_las_LKA_LKA_Condition_Compare_To_Constant9 autosar_swc_las_autosar_swc_las_Step_sys_las_LKA_LKA_Condition_SASDegOverride1 autosar_swc_las_autosar_swc_las_Step_sys_las_LKA_LKA_Condition_Subsystem1 autosar_swc_las_autosar_swc_las_Step_sys_las_LKA_LKA_Condition_Subsystem10 autosar_swc_las_autosar_swc_las_Step_sys_las_LKA_LKA_Condition_Subsystem11 autosar_swc_las_autosar_swc_las_Step_sys_las_LKA_LKA_Condition_Subsystem12 autosar_swc_las_autosar_swc_las_Step_sys_las_LKA_LKA_Condition_Subsystem13 autosar_swc_las_autosar_swc_las_Step_sys_las_LKA_LKA_Condition_Subsystem14 autosar_swc_las_autosar_swc_las_Step_sys_las_LKA_LKA_Condition_Subsystem16 autosar_swc_las_autosar_swc_las_Step_sys_las_LKA_LKA_Condition_Subsystem17 autosar_swc_las_autosar_swc_las_Step_sys_las_LKA_LKA_Condition_Subsystem18 autosar_swc_las_autosar_swc_las_Step_sys_las_LKA_LKA_Condition_Subsystem19 autosar_swc_las_autosar_swc_las_Step_sys_las_LKA_LKA_Condition_Subsystem2 autosar_swc_las_autosar_swc_las_Step_sys_las_LKA_LKA_Condition_Subsystem3 autosar_swc_las_autosar_swc_las_Step_sys_las_LKA_LKA_Condition_Subsystem4 autosar_swc_las_autosar_swc_las_Step_sys_las_LKA_LKA_Condition_Subsystem5 autosar_swc_las_autosar_swc_las_Step_sys_las_LKA_LKA_Condition_Subsystem6 autosar_swc_las_autosar_swc_las_Step_sys_las_LKA_LKA_Condition_Subsystem7 autosar_swc_las_autosar_swc_las_Step_sys_las_LKA_LKA_Condition_Subsystem9 /end SUB_GROUP
 /begin REF_CHARACTERISTIC P_LSS_LDPOverRideMaxTime P_LSS_LDP_SteerSpd2IDEL_SteerSpdFactor P_LSS_LDP_SteerSpd2IEDL_VehicleSpdFactor P_LSS_LDP_SteerSpd2Ready_SteerSpdFactor P_LSS_LDP_SteerSpd2Ready_VehicleSpdFactor P_LSS_LKA_DriverInputTrq_enable P_LSS_LKA_State_AEBActive_enable P_LSS_LKA_State_Absesp_enable P_LSS_LKA_State_Accpedalrate_enable P_LSS_LKA_State_Breakpressure_enable P_LSS_LKA_State_EPS_enable P_LSS_LKA_State_ESP_enable P_LSS_LKA_State_GEAR_enable P_LSS_LKA_State_HazardLmpSwtSts_enable P_LSS_LKA_State_Inhibit_enable P_LSS_LKA_State_LaneChange_enable P_LSS_LKA_State_Lane_enable P_LSS_LKA_State_Lanecurve_enable P_LSS_LKA_State_SteerWheelSpd_enable P_LSS_LKA_State_TurnLight_enable P_LSS_LKA_State_Vehspeed_enable P_LSS_LKA_State_Yawsup_enable /end REF_CHARACTERISTIC
 /begin REF_MEASUREMENT LAS_Reserve0 LAS_Reserve1 LAS_Reserve2 LAS_Reserve3 autosar_swc_las_rtARID_DEF.Cnt autosar_swc_las_rtARID_DEF.Delay1_DSTATE_m autosar_swc_las_rtARID_DEF.Delay_DSTATE autosar_swc_las_rtARID_DEF.OverRide autosar_swc_las_rtARID_DEF.is_active_c89_autosar_swc_las autosar_swc_las_rtARID_DEF.is_c89_autosar_swc_las autosar_swc_las_rtARID_DEF.temp /end REF_MEASUREMENT
/end GROUP
/begin GROUP autosar_swc_las_autosar_swc_las_Step_sys_las_LKA_LKA_Condition_Compare_To_Constant1 "autosar_swc_las/autosar_swc_las_Step_sys/las/LKA/LKA_Condition/Compare\nTo Constant1" /begin REF_CHARACTERISTIC P_LSS_LKA_State_SteerWheelSpdOutTime /end REF_CHARACTERISTIC /end GROUP
/begin GROUP autosar_swc_las_autosar_swc_las_Step_sys_las_LKA_LKA_Condition_Compare_To_Constant10 "autosar_swc_las/autosar_swc_las_Step_sys/las/LKA/LKA_Condition/Compare\nTo Constant10" /begin REF_CHARACTERISTIC P_LSS_LKA_State_DriverInputTrqValue_enableTime /end REF_CHARACTERISTIC /end GROUP
/begin GROUP autosar_swc_las_autosar_swc_las_Step_sys_las_LKA_LKA_Condition_Compare_To_Constant11 "autosar_swc_las/autosar_swc_las_Step_sys/las/LKA/LKA_Condition/Compare\nTo Constant11" /begin REF_CHARACTERISTIC P_LSS_LKA_SteerMinVehspeedInValue /end REF_CHARACTERISTIC /end GROUP
/begin GROUP autosar_swc_las_autosar_swc_las_Step_sys_las_LKA_LKA_Condition_Compare_To_Constant12 "autosar_swc_las/autosar_swc_las_Step_sys/las/LKA/LKA_Condition/Compare\nTo Constant12" /begin REF_CHARACTERISTIC P_LSS_LKA_SteerWheelAngleOut /end REF_CHARACTERISTIC /end GROUP
/begin GROUP autosar_swc_las_autosar_swc_las_Step_sys_las_LKA_LKA_Condition_Compare_To_Constant123 "autosar_swc_las/autosar_swc_las_Step_sys/las/LKA/LKA_Condition/Compare\nTo Constant123" /begin REF_CHARACTERISTIC P_LSS_LKA_State_MinVehspeedOutValue /end REF_CHARACTERISTIC /end GROUP
/begin GROUP autosar_swc_las_autosar_swc_las_Step_sys_las_LKA_LKA_Condition_Compare_To_Constant126 "autosar_swc_las/autosar_swc_las_Step_sys/las/LKA/LKA_Condition/Compare\nTo Constant126" /begin REF_CHARACTERISTIC P_LSS_LKA_State_MaxVehspeedOutValue /end REF_CHARACTERISTIC /end GROUP
/begin GROUP autosar_swc_las_autosar_swc_las_Step_sys_las_LKA_LKA_Condition_Compare_To_Constant150 "autosar_swc_las/autosar_swc_las_Step_sys/las/LKA/LKA_Condition/Compare\nTo Constant150" /begin REF_CHARACTERISTIC P_LSS_LKA_YawRateIn /end REF_CHARACTERISTIC /end GROUP
/begin GROUP autosar_swc_las_autosar_swc_las_Step_sys_las_LKA_LKA_Condition_Compare_To_Constant153 "autosar_swc_las/autosar_swc_las_Step_sys/las/LKA/LKA_Condition/Compare\nTo Constant153" /begin REF_CHARACTERISTIC P_LSS_LKA_YawRateInTime /end REF_CHARACTERISTIC /end GROUP
/begin GROUP autosar_swc_las_autosar_swc_las_Step_sys_las_LKA_LKA_Condition_Compare_To_Constant158 "autosar_swc_las/autosar_swc_las_Step_sys/las/LKA/LKA_Condition/Compare\nTo Constant158" /begin REF_CHARACTERISTIC P_LSS_LKA_LaneCurveIn /end REF_CHARACTERISTIC /end GROUP
/begin GROUP autosar_swc_las_autosar_swc_las_Step_sys_las_LKA_LKA_Condition_Compare_To_Constant170 "autosar_swc_las/autosar_swc_las_Step_sys/las/LKA/LKA_Condition/Compare\nTo Constant170" /begin REF_CHARACTERISTIC P_LSS_LKA_State_MinVehspeedInValue /end REF_CHARACTERISTIC /end GROUP
/begin GROUP autosar_swc_las_autosar_swc_las_Step_sys_las_LKA_LKA_Condition_Compare_To_Constant171 "autosar_swc_las/autosar_swc_las_Step_sys/las/LKA/LKA_Condition/Compare\nTo Constant171" /begin REF_CHARACTERISTIC P_LSS_LKA_State_MaxVehspeedInValue /end REF_CHARACTERISTIC /end GROUP
/begin GROUP autosar_swc_las_autosar_swc_las_Step_sys_las_LKA_LKA_Condition_Compare_To_Constant173 "autosar_swc_las/autosar_swc_las_Step_sys/las/LKA/LKA_Condition/Compare\nTo Constant173" /begin REF_CHARACTERISTIC P_LSS_LKA_YawRateOut /end REF_CHARACTERISTIC /end GROUP
/begin GROUP autosar_swc_las_autosar_swc_las_Step_sys_las_LKA_LKA_Condition_Compare_To_Constant188 "autosar_swc_las/autosar_swc_las_Step_sys/las/LKA/LKA_Condition/Compare\nTo Constant188" /begin REF_CHARACTERISTIC P_LSS_LKA_LaneCurveOut /end REF_CHARACTERISTIC /end GROUP
/begin GROUP autosar_swc_las_autosar_swc_las_Step_sys_las_LKA_LKA_Condition_Compare_To_Constant197 "autosar_swc_las/autosar_swc_las_Step_sys/las/LKA/LKA_Condition/Compare\nTo Constant197" /begin REF_CHARACTERISTIC P_LSS_LKA_BrakePressIn /end REF_CHARACTERISTIC /end GROUP
/begin GROUP autosar_swc_las_autosar_swc_las_Step_sys_las_LKA_LKA_Condition_Compare_To_Constant209 "autosar_swc_las/autosar_swc_las_Step_sys/las/LKA/LKA_Condition/Compare\nTo Constant209" /begin REF_CHARACTERISTIC P_LSS_LKA_AccRateIn /end REF_CHARACTERISTIC /end GROUP
/begin GROUP autosar_swc_las_autosar_swc_las_Step_sys_las_LKA_LKA_Condition_Compare_To_Constant211 "autosar_swc_las/autosar_swc_las_Step_sys/las/LKA/LKA_Condition/Compare\nTo Constant211" /begin REF_CHARACTERISTIC P_LSS_LKA_AccRateInTime /end REF_CHARACTERISTIC /end GROUP
/begin GROUP autosar_swc_las_autosar_swc_las_Step_sys_las_LKA_LKA_Condition_Compare_To_Constant225 "autosar_swc_las/autosar_swc_las_Step_sys/las/LKA/LKA_Condition/Compare\nTo Constant225" /begin REF_CHARACTERISTIC P_LSS_LKA_DriverInputTrqValueOut /end REF_CHARACTERISTIC /end GROUP
/begin GROUP autosar_swc_las_autosar_swc_las_Step_sys_las_LKA_LKA_Condition_Compare_To_Constant233 "autosar_swc_las/autosar_swc_las_Step_sys/las/LKA/LKA_Condition/Compare\nTo Constant233" /begin REF_CHARACTERISTIC P_LSS_LKA_BrakePressOut /end REF_CHARACTERISTIC /end GROUP
/begin GROUP autosar_swc_las_autosar_swc_las_Step_sys_las_LKA_LKA_Condition_Compare_To_Constant234 "autosar_swc_las/autosar_swc_las_Step_sys/las/LKA/LKA_Condition/Compare\nTo Constant234" /begin REF_CHARACTERISTIC P_LSS_LKA_AccRateOut /end REF_CHARACTERISTIC /end GROUP
/begin GROUP autosar_swc_las_autosar_swc_las_Step_sys_las_LKA_LKA_Condition_Compare_To_Constant236 "autosar_swc_las/autosar_swc_las_Step_sys/las/LKA/LKA_Condition/Compare\nTo Constant236" /begin REF_CHARACTERISTIC P_LSS_LKA_BrakePressInTime /end REF_CHARACTERISTIC /end GROUP
/begin GROUP autosar_swc_las_autosar_swc_las_Step_sys_las_LKA_LKA_Condition_Compare_To_Constant27 "autosar_swc_las/autosar_swc_las_Step_sys/las/LKA/LKA_Condition/Compare\nTo Constant27" /begin REF_CHARACTERISTIC P_LSS_LKA_DriverInputTrqValueOutTime /end REF_CHARACTERISTIC /end GROUP
/begin GROUP autosar_swc_las_autosar_swc_las_Step_sys_las_LKA_LKA_Condition_Compare_To_Constant33 "autosar_swc_las/autosar_swc_las_Step_sys/las/LKA/LKA_Condition/Compare\nTo Constant33" /begin REF_CHARACTERISTIC P_LSS_LKA_AccPedalRateOutTime /end REF_CHARACTERISTIC /end GROUP
/begin GROUP autosar_swc_las_autosar_swc_las_Step_sys_las_LKA_LKA_Condition_Compare_To_Constant39 "autosar_swc_las/autosar_swc_las_Step_sys/las/LKA/LKA_Condition/Compare\nTo Constant39" /begin REF_CHARACTERISTIC P_LSS_LKA_DriverInputTrqValueIn /end REF_CHARACTERISTIC /end GROUP
/begin GROUP autosar_swc_las_autosar_swc_las_Step_sys_las_LKA_LKA_Condition_Compare_To_Constant41 "autosar_swc_las/autosar_swc_las_Step_sys/las/LKA/LKA_Condition/Compare\nTo Constant41" /begin REF_MEASUREMENT autosar_swc_las_rtARID_DEF.OverRide /end REF_MEASUREMENT /end GROUP
/begin GROUP autosar_swc_las_autosar_swc_las_Step_sys_las_LKA_LKA_Condition_Compare_To_Constant43 "autosar_swc_las/autosar_swc_las_Step_sys/las/LKA/LKA_Condition/Compare\nTo Constant43" /begin REF_CHARACTERISTIC P_LSS_LKA_SteerMinVehspeedInValue /end REF_CHARACTERISTIC /end GROUP
/begin GROUP autosar_swc_las_autosar_swc_las_Step_sys_las_LKA_LKA_Condition_Compare_To_Constant44 "autosar_swc_las/autosar_swc_las_Step_sys/las/LKA/LKA_Condition/Compare\nTo Constant44" /begin REF_CHARACTERISTIC P_LSS_LKA_SteerWheelAngleIn /end REF_CHARACTERISTIC /end GROUP
/begin GROUP autosar_swc_las_autosar_swc_las_Step_sys_las_LKA_LKA_Condition_Compare_To_Constant46 "autosar_swc_las/autosar_swc_las_Step_sys/las/LKA/LKA_Condition/Compare\nTo Constant46" /begin REF_CHARACTERISTIC P_LSS_LKA_SteerWheelSpdInTime /end REF_CHARACTERISTIC /end GROUP
/begin GROUP autosar_swc_las_autosar_swc_las_Step_sys_las_LKA_LKA_Condition_Compare_To_Constant54 "autosar_swc_las/autosar_swc_las_Step_sys/las/LKA/LKA_Condition/Compare\nTo Constant54" /begin REF_MEASUREMENT autosar_swc_las_rtARID_DEF.OverRide /end REF_MEASUREMENT /end GROUP
/begin GROUP autosar_swc_las_autosar_swc_las_Step_sys_las_LKA_LKA_Condition_Compare_To_Constant8 "autosar_swc_las/autosar_swc_las_Step_sys/las/LKA/LKA_Condition/Compare\nTo Constant8" /begin REF_CHARACTERISTIC P_LSS_LKA_State_Vehspeed_enableTime /end REF_CHARACTERISTIC /end GROUP
/begin GROUP autosar_swc_las_autosar_swc_las_Step_sys_las_LKA_LKA_Condition_Compare_To_Constant9 "autosar_swc_las/autosar_swc_las_Step_sys/las/LKA/LKA_Condition/Compare\nTo Constant9" /begin REF_CHARACTERISTIC P_LSS_LKA_State_Yawsup_enableTime /end REF_CHARACTERISTIC /end GROUP
/begin GROUP autosar_swc_las_autosar_swc_las_Step_sys_las_LKA_LKA_Condition_SASDegOverride1 "autosar_swc_las/autosar_swc_las_Step_sys/las/LKA/LKA_Condition/SASDegOverride1"
 /begin SUB_GROUP autosar_swc_las_autosar_swc_las_Step_sys_las_LKA_LKA_Condition_SASDegOverride1_Compare_To_Constant3 autosar_swc_las_autosar_swc_las_Step_sys_las_LKA_LKA_Condition_SASDegOverride1_Subsystem1 autosar_swc_las_autosar_swc_las_Step_sys_las_LKA_LKA_Condition_SASDegOverride1_Subsystem2 autosar_swc_las_autosar_swc_las_Step_sys_las_LKA_LKA_Condition_SASDegOverride1_Subsystem3 autosar_swc_las_autosar_swc_las_Step_sys_las_LKA_LKA_Condition_SASDegOverride1_Subsystem4 autosar_swc_las_autosar_swc_las_Step_sys_las_LKA_LKA_Condition_SASDegOverride1_TrueDurationTime3 /end SUB_GROUP
 /begin REF_MEASUREMENT autosar_swc_las_rtARID_DEF.UnitDelay1_DSTATE_a autosar_swc_las_rtARID_DEF.UnitDelay2_DSTATE /end REF_MEASUREMENT
/end GROUP
/begin GROUP autosar_swc_las_autosar_swc_las_Step_sys_las_LKA_LKA_Condition_SASDegOverride1_Subsystem1 "autosar_swc_las/autosar_swc_las_Step_sys/las/LKA/LKA_Condition/SASDegOverride1/Subsystem1" /begin REF_MEASUREMENT autosar_swc_las_rtARID_DEF.UnitDelay_DSTATE_ju /end REF_MEASUREMENT /end GROUP
/begin GROUP autosar_swc_las_autosar_swc_las_Step_sys_las_LKA_LKA_Condition_SASDegOverride1_Subsystem2 "autosar_swc_las/autosar_swc_las_Step_sys/las/LKA/LKA_Condition/SASDegOverride1/Subsystem2" /begin REF_MEASUREMENT autosar_swc_las_rtARID_DEF.UnitDelay_DSTATE_ac /end REF_MEASUREMENT /end GROUP
/begin GROUP autosar_swc_las_autosar_swc_las_Step_sys_las_LKA_LKA_Condition_SASDegOverride1_Subsystem3 "autosar_swc_las/autosar_swc_las_Step_sys/las/LKA/LKA_Condition/SASDegOverride1/Subsystem3" /begin REF_MEASUREMENT autosar_swc_las_rtARID_DEF.UnitDelay_DSTATE_a1 /end REF_MEASUREMENT /end GROUP
/begin GROUP autosar_swc_las_autosar_swc_las_Step_sys_las_LKA_LKA_Condition_SASDegOverride1_Subsystem4 "autosar_swc_las/autosar_swc_las_Step_sys/las/LKA/LKA_Condition/SASDegOverride1/Subsystem4" /begin REF_MEASUREMENT autosar_swc_las_rtARID_DEF.UnitDelay_DSTATE_ctg /end REF_MEASUREMENT /end GROUP
/begin GROUP autosar_swc_las_autosar_swc_las_Step_sys_las_LKA_LKA_Condition_SASDegOverride1_TrueDurationTime3 "autosar_swc_las/autosar_swc_las_Step_sys/las/LKA/LKA_Condition/SASDegOverride1/TrueDurationTime3"
 /begin REF_MEASUREMENT autosar_swc_las_rtARID_DEF.UnitDelay1_DSTATE_c autosar_swc_las_rtARID_DEF.UnitDelay2_DSTATE_fp /end REF_MEASUREMENT
/end GROUP
/begin GROUP autosar_swc_las_autosar_swc_las_Step_sys_las_LKA_LKA_Condition_Subsystem1 "autosar_swc_las/autosar_swc_las_Step_sys/las/LKA/LKA_Condition/Subsystem1" /begin REF_MEASUREMENT autosar_swc_las_rtARID_DEF.UnitDelay_DSTATE_b /end REF_MEASUREMENT /end GROUP
/begin GROUP autosar_swc_las_autosar_swc_las_Step_sys_las_LKA_LKA_Condition_Subsystem10 "autosar_swc_las/autosar_swc_las_Step_sys/las/LKA/LKA_Condition/Subsystem10" /begin REF_MEASUREMENT autosar_swc_las_rtARID_DEF.UnitDelay_DSTATE_j /end REF_MEASUREMENT /end GROUP
/begin GROUP autosar_swc_las_autosar_swc_las_Step_sys_las_LKA_LKA_Condition_Subsystem11 "autosar_swc_las/autosar_swc_las_Step_sys/las/LKA/LKA_Condition/Subsystem11" /begin REF_MEASUREMENT autosar_swc_las_rtARID_DEF.UnitDelay_DSTATE_f /end REF_MEASUREMENT /end GROUP
/begin GROUP autosar_swc_las_autosar_swc_las_Step_sys_las_LKA_LKA_Condition_Subsystem12 "autosar_swc_las/autosar_swc_las_Step_sys/las/LKA/LKA_Condition/Subsystem12" /begin REF_MEASUREMENT autosar_swc_las_rtARID_DEF.Delay2_DSTATE_h /end REF_MEASUREMENT /end GROUP
/begin GROUP autosar_swc_las_autosar_swc_las_Step_sys_las_LKA_LKA_Condition_Subsystem13 "autosar_swc_las/autosar_swc_las_Step_sys/las/LKA/LKA_Condition/Subsystem13" /begin REF_MEASUREMENT autosar_swc_las_rtARID_DEF.UnitDelay_DSTATE_ix /end REF_MEASUREMENT /end GROUP
/begin GROUP autosar_swc_las_autosar_swc_las_Step_sys_las_LKA_LKA_Condition_Subsystem14 "autosar_swc_las/autosar_swc_las_Step_sys/las/LKA/LKA_Condition/Subsystem14" /begin REF_MEASUREMENT autosar_swc_las_rtARID_DEF.UnitDelay_DSTATE_gb /end REF_MEASUREMENT /end GROUP
/begin GROUP autosar_swc_las_autosar_swc_las_Step_sys_las_LKA_LKA_Condition_Subsystem16 "autosar_swc_las/autosar_swc_las_Step_sys/las/LKA/LKA_Condition/Subsystem16" /begin REF_MEASUREMENT autosar_swc_las_rtARID_DEF.UnitDelay_DSTATE_gw /end REF_MEASUREMENT /end GROUP
/begin GROUP autosar_swc_las_autosar_swc_las_Step_sys_las_LKA_LKA_Condition_Subsystem17 "autosar_swc_las/autosar_swc_las_Step_sys/las/LKA/LKA_Condition/Subsystem17" /begin REF_MEASUREMENT autosar_swc_las_rtARID_DEF.UnitDelay_DSTATE_m /end REF_MEASUREMENT /end GROUP
/begin GROUP autosar_swc_las_autosar_swc_las_Step_sys_las_LKA_LKA_Condition_Subsystem18 "autosar_swc_las/autosar_swc_las_Step_sys/las/LKA/LKA_Condition/Subsystem18" /begin REF_MEASUREMENT autosar_swc_las_rtARID_DEF.Delay2_DSTATE_m /end REF_MEASUREMENT /end GROUP
/begin GROUP autosar_swc_las_autosar_swc_las_Step_sys_las_LKA_LKA_Condition_Subsystem19 "autosar_swc_las/autosar_swc_las_Step_sys/las/LKA/LKA_Condition/Subsystem19" /begin REF_MEASUREMENT autosar_swc_las_rtARID_DEF.UnitDelay_DSTATE_lv /end REF_MEASUREMENT /end GROUP
/begin GROUP autosar_swc_las_autosar_swc_las_Step_sys_las_LKA_LKA_Condition_Subsystem2 "autosar_swc_las/autosar_swc_las_Step_sys/las/LKA/LKA_Condition/Subsystem2" /begin REF_MEASUREMENT autosar_swc_las_rtARID_DEF.UnitDelay_DSTATE_a /end REF_MEASUREMENT /end GROUP
/begin GROUP autosar_swc_las_autosar_swc_las_Step_sys_las_LKA_LKA_Condition_Subsystem3 "autosar_swc_las/autosar_swc_las_Step_sys/las/LKA/LKA_Condition/Subsystem3" /begin REF_MEASUREMENT autosar_swc_las_rtARID_DEF.UnitDelay_DSTATE_e /end REF_MEASUREMENT /end GROUP
/begin GROUP autosar_swc_las_autosar_swc_las_Step_sys_las_LKA_LKA_Condition_Subsystem4 "autosar_swc_las/autosar_swc_las_Step_sys/las/LKA/LKA_Condition/Subsystem4" /begin REF_MEASUREMENT autosar_swc_las_rtARID_DEF.UnitDelay_DSTATE_bz /end REF_MEASUREMENT /end GROUP
/begin GROUP autosar_swc_las_autosar_swc_las_Step_sys_las_LKA_LKA_Condition_Subsystem5 "autosar_swc_las/autosar_swc_las_Step_sys/las/LKA/LKA_Condition/Subsystem5" /begin REF_MEASUREMENT autosar_swc_las_rtARID_DEF.UnitDelay_DSTATE_p5 /end REF_MEASUREMENT /end GROUP
/begin GROUP autosar_swc_las_autosar_swc_las_Step_sys_las_LKA_LKA_Condition_Subsystem6 "autosar_swc_las/autosar_swc_las_Step_sys/las/LKA/LKA_Condition/Subsystem6" /begin REF_MEASUREMENT autosar_swc_las_rtARID_DEF.UnitDelay_DSTATE /end REF_MEASUREMENT /end GROUP
/begin GROUP autosar_swc_las_autosar_swc_las_Step_sys_las_LKA_LKA_Condition_Subsystem7 "autosar_swc_las/autosar_swc_las_Step_sys/las/LKA/LKA_Condition/Subsystem7" /begin REF_MEASUREMENT autosar_swc_las_rtARID_DEF.UnitDelay_DSTATE_o /end REF_MEASUREMENT /end GROUP
/begin GROUP autosar_swc_las_autosar_swc_las_Step_sys_las_LKA_LKA_Condition_Subsystem9 "autosar_swc_las/autosar_swc_las_Step_sys/las/LKA/LKA_Condition/Subsystem9" /begin REF_MEASUREMENT autosar_swc_las_rtARID_DEF.Delay1_DSTATE_p /end REF_MEASUREMENT /end GROUP
/begin GROUP autosar_swc_las_autosar_swc_las_Step_sys_las_LKA_LKA_StateMachine "autosar_swc_las/autosar_swc_las_Step_sys/las/LKA/LKA_StateMachine"
 /begin SUB_GROUP autosar_swc_las_autosar_swc_las_Step_sys_las_LKA_LKA_StateMachine_Compare_To_Constant1 autosar_swc_las_autosar_swc_las_Step_sys_las_LKA_LKA_StateMachine_Compare_To_Constant10 autosar_swc_las_autosar_swc_las_Step_sys_las_LKA_LKA_StateMachine_Compare_To_Constant11 autosar_swc_las_autosar_swc_las_Step_sys_las_LKA_LKA_StateMachine_Compare_To_Constant2 autosar_swc_las_autosar_swc_las_Step_sys_las_LKA_LKA_StateMachine_Compare_To_Constant3 autosar_swc_las_autosar_swc_las_Step_sys_las_LKA_LKA_StateMachine_Compare_To_Constant4 autosar_swc_las_autosar_swc_las_Step_sys_las_LKA_LKA_StateMachine_Compare_To_Constant5 autosar_swc_las_autosar_swc_las_Step_sys_las_LKA_LKA_StateMachine_Compare_To_Constant8 autosar_swc_las_autosar_swc_las_Step_sys_las_LKA_LKA_StateMachine_Compare_To_Constant9 autosar_swc_las_autosar_swc_las_Step_sys_las_LKA_LKA_StateMachine_ObsAffirm autosar_swc_las_autosar_swc_las_Step_sys_las_LKA_LKA_StateMachine_ObsAffirm1 autosar_swc_las_autosar_swc_las_Step_sys_las_LKA_LKA_StateMachine_Subsystem autosar_swc_las_autosar_swc_las_Step_sys_las_LKA_LKA_StateMachine_Subsystem1 autosar_swc_las_autosar_swc_las_Step_sys_las_LKA_LKA_StateMachine_Subsystem2 autosar_swc_las_autosar_swc_las_Step_sys_las_LKA_LKA_StateMachine_Subsystem9 autosar_swc_las_autosar_swc_las_Step_sys_las_LKA_LKA_StateMachine_TurnLightAffirm autosar_swc_las_autosar_swc_las_Step_sys_las_LKA_LKA_StateMachine_TurnLightAffirm1 /end SUB_GROUP
 /begin REF_CHARACTERISTIC P_LSS_LDP_ActiveOverTIme P_LSS_LKA_OnComingObsDefault P_LSS_LKA_OnComingObsDetectSw /end REF_CHARACTERISTIC
 /begin REF_MEASUREMENT LAS_LKA_Error LAS_LKA_FinalReady2Active LAS_LKA_LeftInterventionEnd LAS_LKA_LeftWarning LAS_LKA_Leftout LAS_LKA_RightInterventionEnd LAS_LKA_RightWarning LAS_LKA_Rightout LAS_LKA_VehConfigLKA LAS_LKA_Warning autosar_swc_las_rtARID_DEF.Compare_a autosar_swc_las_rtARID_DEF.Compare_b autosar_swc_las_rtARID_DEF.Compare_c autosar_swc_las_rtARID_DEF.Compare_d autosar_swc_las_rtARID_DEF.Compare_jw autosar_swc_las_rtARID_DEF.Compare_l autosar_swc_las_rtARID_DEF.Compare_m autosar_swc_las_rtARID_DEF.Gain_d autosar_swc_las_rtARID_DEF.LogicalOperator12 autosar_swc_las_rtARID_DEF.LogicalOperator1_bj autosar_swc_las_rtARID_DEF.LogicalOperator1_p autosar_swc_las_rtARID_DEF.Out autosar_swc_las_rtARID_DEF.State autosar_swc_las_rtARID_DEF.Switch1 autosar_swc_las_rtARID_DEF.Switch2_g autosar_swc_las_rtARID_DEF.Warn autosar_swc_las_rtARID_DEF.actcount autosar_swc_las_rtARID_DEF.incount autosar_swc_las_rtARID_DEF.is_MAINST_ON autosar_swc_las_rtARID_DEF.is_SUBST_ACTIVE autosar_swc_las_rtARID_DEF.is_SUBST_ACTIVE_LEFT autosar_swc_las_rtARID_DEF.is_SUBST_ACTIVE_RIGHT autosar_swc_las_rtARID_DEF.is_active_c129_autosar_swc_las autosar_swc_las_rtARID_DEF.is_c129_autosar_swc_las autosar_swc_las_rtARID_DEF.out_count autosar_swc_las_rtARID_DEF.wcount /end REF_MEASUREMENT
/end GROUP
/begin GROUP autosar_swc_las_autosar_swc_las_Step_sys_las_LKA_LKA_StateMachine_Compare_To_Constant1 "autosar_swc_las/autosar_swc_las_Step_sys/las/LKA/LKA_StateMachine/Compare\nTo Constant1" /begin REF_MEASUREMENT autosar_swc_las_rtARID_DEF.Compare_m /end REF_MEASUREMENT /end GROUP
/begin GROUP autosar_swc_las_autosar_swc_las_Step_sys_las_LKA_LKA_StateMachine_ObsAffirm "autosar_swc_las/autosar_swc_las_Step_sys/las/LKA/LKA_StateMachine/ObsAffirm"
 /begin SUB_GROUP autosar_swc_las_autosar_swc_las_Step_sys_las_LKA_LKA_StateMachine_ObsAffirm_Compare_To_Constant autosar_swc_las_autosar_swc_las_Step_sys_las_LKA_LKA_StateMachine_ObsAffirm_Compare_To_Constant212 autosar_swc_las_autosar_swc_las_Step_sys_las_LKA_LKA_StateMachine_ObsAffirm_Subsystem9 /end SUB_GROUP
/end GROUP
/begin GROUP autosar_swc_las_autosar_swc_las_Step_sys_las_LKA_LKA_StateMachine_ObsAffirm1 "autosar_swc_las/autosar_swc_las_Step_sys/las/LKA/LKA_StateMachine/ObsAffirm1"
 /begin SUB_GROUP autosar_swc_las_autosar_swc_las_Step_sys_las_LKA_LKA_StateMachine_ObsAffirm1_Compare_To_Constant autosar_swc_las_autosar_swc_las_Step_sys_las_LKA_LKA_StateMachine_ObsAffirm1_Compare_To_Constant212 autosar_swc_las_autosar_swc_las_Step_sys_las_LKA_LKA_StateMachine_ObsAffirm1_Subsystem9 /end SUB_GROUP
/end GROUP
/begin GROUP autosar_swc_las_autosar_swc_las_Step_sys_las_LKA_LKA_StateMachine_ObsAffirm1_Compare_To_Constant "autosar_swc_las/autosar_swc_las_Step_sys/las/LKA/LKA_StateMachine/ObsAffirm1/Compare\nTo Constant" /begin REF_MEASUREMENT autosar_swc_las_rtARID_DEF.Switch2_g /end REF_MEASUREMENT /end GROUP
/begin GROUP autosar_swc_las_autosar_swc_las_Step_sys_las_LKA_LKA_StateMachine_ObsAffirm1_Compare_To_Constant212 "autosar_swc_las/autosar_swc_las_Step_sys/las/LKA/LKA_StateMachine/ObsAffirm1/Compare\nTo Constant212" /begin REF_CHARACTERISTIC P_LSS_LKA_ObsFlagTime /end REF_CHARACTERISTIC /begin REF_MEASUREMENT autosar_swc_las_rtARID_DEF.Compare_b /end REF_MEASUREMENT /end GROUP
/begin GROUP autosar_swc_las_autosar_swc_las_Step_sys_las_LKA_LKA_StateMachine_ObsAffirm1_Subsystem9 "autosar_swc_las/autosar_swc_las_Step_sys/las/LKA/LKA_StateMachine/ObsAffirm1/Subsystem9" /begin REF_MEASUREMENT autosar_swc_las_rtARID_DEF.UnitDelay_DSTATE_c /end REF_MEASUREMENT /end GROUP
/begin GROUP autosar_swc_las_autosar_swc_las_Step_sys_las_LKA_LKA_StateMachine_ObsAffirm_Compare_To_Constant "autosar_swc_las/autosar_swc_las_Step_sys/las/LKA/LKA_StateMachine/ObsAffirm/Compare\nTo Constant" /begin REF_MEASUREMENT autosar_swc_las_rtARID_DEF.Switch1 /end REF_MEASUREMENT /end GROUP
/begin GROUP autosar_swc_las_autosar_swc_las_Step_sys_las_LKA_LKA_StateMachine_ObsAffirm_Compare_To_Constant212 "autosar_swc_las/autosar_swc_las_Step_sys/las/LKA/LKA_StateMachine/ObsAffirm/Compare\nTo Constant212" /begin REF_CHARACTERISTIC P_LSS_LKA_ObsFlagTime /end REF_CHARACTERISTIC /begin REF_MEASUREMENT autosar_swc_las_rtARID_DEF.Compare_d /end REF_MEASUREMENT /end GROUP
/begin GROUP autosar_swc_las_autosar_swc_las_Step_sys_las_LKA_LKA_StateMachine_ObsAffirm_Subsystem9 "autosar_swc_las/autosar_swc_las_Step_sys/las/LKA/LKA_StateMachine/ObsAffirm/Subsystem9" /begin REF_MEASUREMENT autosar_swc_las_rtARID_DEF.UnitDelay_DSTATE_iq /end REF_MEASUREMENT /end GROUP
/begin GROUP autosar_swc_las_autosar_swc_las_Step_sys_las_LKA_LKA_StateMachine_Subsystem "autosar_swc_las/autosar_swc_las_Step_sys/las/LKA/LKA_StateMachine/Subsystem"
 /begin SUB_GROUP autosar_swc_las_autosar_swc_las_Step_sys_las_LKA_LKA_StateMachine_Subsystem_Compare_To_Constant1 autosar_swc_las_autosar_swc_las_Step_sys_las_LKA_LKA_StateMachine_Subsystem_Subsystem2 /end SUB_GROUP
 /begin REF_MEASUREMENT autosar_swc_las_rtARID_DEF.UnitDelay_DSTATE_cl /end REF_MEASUREMENT
/end GROUP
/begin GROUP autosar_swc_las_autosar_swc_las_Step_sys_las_LKA_LKA_StateMachine_Subsystem1 "autosar_swc_las/autosar_swc_las_Step_sys/las/LKA/LKA_StateMachine/Subsystem1"
 /begin SUB_GROUP autosar_swc_las_autosar_swc_las_Step_sys_las_LKA_LKA_StateMachine_Subsystem1_Compare_To_Constant2 autosar_swc_las_autosar_swc_las_Step_sys_las_LKA_LKA_StateMachine_Subsystem1_Subsystem2 /end SUB_GROUP
 /begin REF_MEASUREMENT autosar_swc_las_rtARID_DEF.UnitDelay_DSTATE_fs /end REF_MEASUREMENT
/end GROUP
/begin GROUP autosar_swc_las_autosar_swc_las_Step_sys_las_LKA_LKA_StateMachine_Subsystem1_Compare_To_Constant2 "autosar_swc_las/autosar_swc_las_Step_sys/las/LKA/LKA_StateMachine/Subsystem1/Compare\nTo Constant2" /begin REF_CHARACTERISTIC P_LSS_LKA_RightActiveAffirmTime_s /end REF_CHARACTERISTIC /begin REF_MEASUREMENT autosar_swc_las_rtARID_DEF.Compare_c /end REF_MEASUREMENT /end GROUP
/begin GROUP autosar_swc_las_autosar_swc_las_Step_sys_las_LKA_LKA_StateMachine_Subsystem1_Subsystem2 "autosar_swc_las/autosar_swc_las_Step_sys/las/LKA/LKA_StateMachine/Subsystem1/Subsystem2" /begin REF_MEASUREMENT autosar_swc_las_rtARID_DEF.UnitDelay_DSTATE_n /end REF_MEASUREMENT /end GROUP
/begin GROUP autosar_swc_las_autosar_swc_las_Step_sys_las_LKA_LKA_StateMachine_Subsystem2 "autosar_swc_las/autosar_swc_las_Step_sys/las/LKA/LKA_StateMachine/Subsystem2" /begin REF_CHARACTERISTIC P_LSS_LDP_ActiveInterval /end REF_CHARACTERISTIC
 /begin REF_MEASUREMENT autosar_swc_las_rtARID_DEF.Delay1_DSTATE_f autosar_swc_las_rtARID_DEF.Delay_DSTATE_f autosar_swc_las_rtARID_DEF.Out autosar_swc_las_rtARID_DEF.cntleft autosar_swc_las_rtARID_DEF.is_active_c125_autosar_swc_las autosar_swc_las_rtARID_DEF.is_c125_autosar_swc_las /end REF_MEASUREMENT
/end GROUP
/begin GROUP autosar_swc_las_autosar_swc_las_Step_sys_las_LKA_LKA_StateMachine_Subsystem9 "autosar_swc_las/autosar_swc_las_Step_sys/las/LKA/LKA_StateMachine/Subsystem9" /begin REF_MEASUREMENT autosar_swc_las_rtARID_DEF.UnitDelay_DSTATE_io /end REF_MEASUREMENT /end GROUP
/begin GROUP autosar_swc_las_autosar_swc_las_Step_sys_las_LKA_LKA_StateMachine_Subsystem_Compare_To_Constant1 "autosar_swc_las/autosar_swc_las_Step_sys/las/LKA/LKA_StateMachine/Subsystem/Compare\nTo Constant1" /begin REF_CHARACTERISTIC P_LSS_LKA_LeftActiveAffirmTime_s /end REF_CHARACTERISTIC /begin REF_MEASUREMENT autosar_swc_las_rtARID_DEF.Compare_a /end REF_MEASUREMENT /end GROUP
/begin GROUP autosar_swc_las_autosar_swc_las_Step_sys_las_LKA_LKA_StateMachine_Subsystem_Subsystem2 "autosar_swc_las/autosar_swc_las_Step_sys/las/LKA/LKA_StateMachine/Subsystem/Subsystem2" /begin REF_MEASUREMENT autosar_swc_las_rtARID_DEF.UnitDelay_DSTATE_g /end REF_MEASUREMENT /end GROUP
/begin GROUP autosar_swc_las_autosar_swc_las_Step_sys_las_LKA_LKA_StateMachine_TurnLightAffirm "autosar_swc_las/autosar_swc_las_Step_sys/las/LKA/LKA_StateMachine/TurnLightAffirm"
 /begin SUB_GROUP autosar_swc_las_autosar_swc_las_Step_sys_las_LKA_LKA_StateMachine_TurnLightAffirm_Compare_To_Constant212 autosar_swc_las_autosar_swc_las_Step_sys_las_LKA_LKA_StateMachine_TurnLightAffirm_Subsystem9 /end SUB_GROUP
/end GROUP
/begin GROUP autosar_swc_las_autosar_swc_las_Step_sys_las_LKA_LKA_StateMachine_TurnLightAffirm1 "autosar_swc_las/autosar_swc_las_Step_sys/las/LKA/LKA_StateMachine/TurnLightAffirm1"
 /begin SUB_GROUP autosar_swc_las_autosar_swc_las_Step_sys_las_LKA_LKA_StateMachine_TurnLightAffirm1_Compare_To_Constant212 autosar_swc_las_autosar_swc_las_Step_sys_las_LKA_LKA_StateMachine_TurnLightAffirm1_Subsystem9 /end SUB_GROUP
/end GROUP
/begin GROUP autosar_swc_las_autosar_swc_las_Step_sys_las_LKA_LKA_StateMachine_TurnLightAffirm1_Compare_To_Constant212 "autosar_swc_las/autosar_swc_las_Step_sys/las/LKA/LKA_StateMachine/TurnLightAffirm1/Compare\nTo Constant212" /begin REF_CHARACTERISTIC P_LSS_LKA_TurnLightInTime /end REF_CHARACTERISTIC /begin REF_MEASUREMENT autosar_swc_las_rtARID_DEF.Compare_l /end REF_MEASUREMENT /end GROUP
/begin GROUP autosar_swc_las_autosar_swc_las_Step_sys_las_LKA_LKA_StateMachine_TurnLightAffirm1_Subsystem9 "autosar_swc_las/autosar_swc_las_Step_sys/las/LKA/LKA_StateMachine/TurnLightAffirm1/Subsystem9" /begin REF_MEASUREMENT autosar_swc_las_rtARID_DEF.UnitDelay_DSTATE_fl /end REF_MEASUREMENT /end GROUP
/begin GROUP autosar_swc_las_autosar_swc_las_Step_sys_las_LKA_LKA_StateMachine_TurnLightAffirm_Compare_To_Constant212 "autosar_swc_las/autosar_swc_las_Step_sys/las/LKA/LKA_StateMachine/TurnLightAffirm/Compare\nTo Constant212" /begin REF_CHARACTERISTIC P_LSS_LKA_TurnLightInTime /end REF_CHARACTERISTIC /begin REF_MEASUREMENT autosar_swc_las_rtARID_DEF.Compare_jw /end REF_MEASUREMENT /end GROUP
/begin GROUP autosar_swc_las_autosar_swc_las_Step_sys_las_LKA_LKA_StateMachine_TurnLightAffirm_Subsystem9 "autosar_swc_las/autosar_swc_las_Step_sys/las/LKA/LKA_StateMachine/TurnLightAffirm/Subsystem9" /begin REF_MEASUREMENT autosar_swc_las_rtARID_DEF.UnitDelay_DSTATE_lq /end REF_MEASUREMENT /end GROUP
/begin GROUP autosar_swc_las_autosar_swc_las_Step_sys_las_LKA_Subsystem3 "autosar_swc_las/autosar_swc_las_Step_sys/las/LKA/Subsystem3" /begin REF_CHARACTERISTIC P_LSS_LKA_Configure P_LSS_LKA_ConfigureSW /end REF_CHARACTERISTIC /begin REF_MEASUREMENT LAS_LKA_VehConfigLKA /end REF_MEASUREMENT /end GROUP
/begin GROUP autosar_swc_las_autosar_swc_las_Step_sys_las_OutPort "autosar_swc_las/autosar_swc_las_Step_sys/las/OutPort"
 /begin SUB_GROUP autosar_swc_las_autosar_swc_las_Step_sys_las_OutPort_Counter_Limited autosar_swc_las_autosar_swc_las_Step_sys_las_OutPort_HandsOffWarningCal /end SUB_GROUP
 /begin REF_MEASUREMENT LAS_LKA_Warning LAS_UpdateCnt /end REF_MEASUREMENT
/end GROUP
/begin GROUP autosar_swc_las_autosar_swc_las_Step_sys_las_OutPort_Counter_Limited "autosar_swc_las/autosar_swc_las_Step_sys/las/OutPort/Counter\nLimited"
 /begin SUB_GROUP autosar_swc_las_autosar_swc_las_Step_sys_las_OutPort_Counter_Limited_Increment_Real_World /end SUB_GROUP
 /begin REF_MEASUREMENT LAS_UpdateCnt autosar_swc_las_rtARID_DEF.Output_DSTATE /end REF_MEASUREMENT
/end GROUP
/begin GROUP autosar_swc_las_autosar_swc_las_Step_sys_las_OutPort_Counter_Limited_Increment_Real_World "autosar_swc_las/autosar_swc_las_Step_sys/las/OutPort/Counter\nLimited/Increment\nReal World" /begin REF_MEASUREMENT LAS_UpdateCnt /end REF_MEASUREMENT /end GROUP
/begin GROUP autosar_swc_las_autosar_swc_las_Step_sys_las_OutPort_HandsOffWarningCal "autosar_swc_las/autosar_swc_las_Step_sys/las/OutPort/HandsOffWarningCal"
 /begin SUB_GROUP autosar_swc_las_autosar_swc_las_Step_sys_las_OutPort_HandsOffWarningCal_Subsystem /end SUB_GROUP
 /begin REF_CHARACTERISTIC P_LSS_LSS_HandsOffWarnLevel1 P_LSS_LSS_HandsOffWarnLevel2 /end REF_CHARACTERISTIC
 /begin REF_MEASUREMENT autosar_swc_las_rtARID_DEF.CntWarning autosar_swc_las_rtARID_DEF.Cnt_HandsOffIntervene autosar_swc_las_rtARID_DEF.HandsOffWarnLevel autosar_swc_las_rtARID_DEF.cnt_WarningLevel1 autosar_swc_las_rtARID_DEF.cnt_WarningLevel2 autosar_swc_las_rtARID_DEF.is_HandsOff autosar_swc_las_rtARID_DEF.is_Interveneing autosar_swc_las_rtARID_DEF.is_Time autosar_swc_las_rtARID_DEF.is_WarningLevel2 /end REF_MEASUREMENT
/end GROUP
/begin GROUP autosar_swc_las_autosar_swc_las_Step_sys_las_OutPort_HandsOffWarningCal_Subsystem "autosar_swc_las/autosar_swc_las_Step_sys/las/OutPort/HandsOffWarningCal/Subsystem"
 /begin REF_MEASUREMENT autosar_swc_las_rtARID_DEF.Delay1_DSTATE_o autosar_swc_las_rtARID_DEF.Delay2_DSTATE autosar_swc_las_rtARID_DEF.Delay3_DSTATE autosar_swc_las_rtARID_DEF.Delay_DSTATE_d /end REF_MEASUREMENT
/end GROUP
/begin GROUP autosar_swc_las_autosar_swc_las_Step_sys_las_SCM1 "autosar_swc_las/autosar_swc_las_Step_sys/las/SCM1"
 /begin SUB_GROUP autosar_swc_las_autosar_swc_las_Step_sys_las_SCM1_LaneAndRe_SignalProcess /end SUB_GROUP
 /begin REF_MEASUREMENT LAS_SCM_Number LAS_SCM_VERSION /end REF_MEASUREMENT
/end GROUP
/begin GROUP autosar_swc_las_autosar_swc_las_Step_sys_las_SCM1_LaneAndRe_SignalProcess "autosar_swc_las/autosar_swc_las_Step_sys/las/SCM1/LaneAndRe_SignalProcess"
 /begin SUB_GROUP autosar_swc_las_autosar_swc_las_Step_sys_las_SCM1_LaneAndRe_SignalProcess_CalNearestLine autosar_swc_las_autosar_swc_las_Step_sys_las_SCM1_LaneAndRe_SignalProcess_Cal_LaneHeadingAng autosar_swc_las_autosar_swc_las_Step_sys_las_SCM1_LaneAndRe_SignalProcess_CenterLineFitting autosar_swc_las_autosar_swc_las_Step_sys_las_SCM1_LaneAndRe_SignalProcess_JudgeFinalLaneOfLR autosar_swc_las_autosar_swc_las_Step_sys_las_SCM1_LaneAndRe_SignalProcess_LKA_LDW_SignalProcess autosar_swc_las_autosar_swc_las_Step_sys_las_SCM1_LaneAndRe_SignalProcess_LaneChangeValidJud autosar_swc_las_autosar_swc_las_Step_sys_las_SCM1_LaneAndRe_SignalProcess_LineCheck autosar_swc_las_autosar_swc_las_Step_sys_las_SCM1_LaneAndRe_SignalProcess_RepaireRoadJudge autosar_swc_las_autosar_swc_las_Step_sys_las_SCM1_LaneAndRe_SignalProcess_Subsystem1 autosar_swc_las_autosar_swc_las_Step_sys_las_SCM1_LaneAndRe_SignalProcess_Subsystem3 /end SUB_GROUP
 /begin REF_MEASUREMENT LAS_SCM_LaneWidth_m /end REF_MEASUREMENT
/end GROUP
/begin GROUP autosar_swc_las_autosar_swc_las_Step_sys_las_SCM1_LaneAndRe_SignalProcess_Cal_LaneHeadingAng "autosar_swc_las/autosar_swc_las_Step_sys/las/SCM1/LaneAndRe_SignalProcess/Cal_LaneHeadingAng"
 /begin SUB_GROUP autosar_swc_las_autosar_swc_las_Step_sys_las_SCM1_LaneAndRe_SignalProcess_Cal_LaneHeadingAng_Compare_To_Constant /end SUB_GROUP
 /begin REF_CHARACTERISTIC P_LSS_SCM_CenterLineA0_TabX P_LSS_SCM_HeadingAngExit_Tab P_LSS_SCM_LeftA1filterCoe_ratio P_LSS_SCM_LeftdeFaultA1_ratio P_LSS_SCM_RightA1filterCoe_ratio P_LSS_SCM_RightdeFaultA1_ratio /end REF_CHARACTERISTIC
 /begin REF_MEASUREMENT autosar_swc_las_rtARID_DEF.UnitDelay1_DSTATE_e autosar_swc_las_rtARID_DEF.UnitDelay_DSTATE_n4 /end REF_MEASUREMENT
/end GROUP
/begin GROUP autosar_swc_las_autosar_swc_las_Step_sys_las_SCM1_LaneAndRe_SignalProcess_Cal_LaneHeadingAng_Compare_To_Constant "autosar_swc_las/autosar_swc_las_Step_sys/las/SCM1/LaneAndRe_SignalProcess/Cal_LaneHeadingAng/Compare\nTo Constant" /begin REF_CHARACTERISTIC P_LSS_SCM_HeadingAngleIn_deg /end REF_CHARACTERISTIC /end GROUP
/begin GROUP autosar_swc_las_autosar_swc_las_Step_sys_las_SCM1_LaneAndRe_SignalProcess_CenterLineFitting "autosar_swc_las/autosar_swc_las_Step_sys/las/SCM1/LaneAndRe_SignalProcess/CenterLineFitting"
 /begin SUB_GROUP autosar_swc_las_autosar_swc_las_Step_sys_las_SCM1_LaneAndRe_SignalProcess_CenterLineFitting_Subsystem /end SUB_GROUP
 /begin REF_CHARACTERISTIC P_LSS_SCM_ControlLineLatOffset P_LSS_SCM_ControlLinePreDx P_LSS_SCM_LaneWidth2ControlLineLatOffset P_LSS_SCM_LaneWidthFilterCoe_ratio P_LSS_SCM_MinRoadWidth_m P_LSS_SCM_VehSpd_ms /end REF_CHARACTERISTIC
 /begin REF_MEASUREMENT autosar_swc_las_rtARID_DEF.UnitDelay_DSTATE_cx /end REF_MEASUREMENT
/end GROUP
/begin GROUP autosar_swc_las_autosar_swc_las_Step_sys_las_SCM1_LaneAndRe_SignalProcess_CenterLineFitting_Subsystem "autosar_swc_las/autosar_swc_las_Step_sys/las/SCM1/LaneAndRe_SignalProcess/CenterLineFitting/Subsystem"
 /begin REF_MEASUREMENT LAS_SCM_CenterLaneWidth LAS_SCM_CenterLineA0 LAS_SCM_CenterLineA1 LAS_SCM_CenterLineA2 LAS_SCM_CenterLineA3 LAS_SCM_CenterLineLength LAS_SCM_CenterLineValid /end REF_MEASUREMENT
/end GROUP
/begin GROUP autosar_swc_las_autosar_swc_las_Step_sys_las_SCM1_LaneAndRe_SignalProcess_LKA_LDW_SignalProcess "autosar_swc_las/autosar_swc_las_Step_sys/las/SCM1/LaneAndRe_SignalProcess/LKA_LDW_SignalProcess"
 /begin SUB_GROUP autosar_swc_las_autosar_swc_las_Step_sys_las_SCM1_LaneAndRe_SignalProcess_LKA_LDW_SignalProcess_Subsystem autosar_swc_las_autosar_swc_las_Step_sys_las_SCM1_LaneAndRe_SignalProcess_LKA_LDW_SignalProcess_Subsystem1 autosar_swc_las_autosar_swc_las_Step_sys_las_SCM1_LaneAndRe_SignalProcess_LKA_LDW_SignalProcess_Subsystem10 autosar_swc_las_autosar_swc_las_Step_sys_las_SCM1_LaneAndRe_SignalProcess_LKA_LDW_SignalProcess_Subsystem11 autosar_swc_las_autosar_swc_las_Step_sys_las_SCM1_LaneAndRe_SignalProcess_LKA_LDW_SignalProcess_Subsystem12 autosar_swc_las_autosar_swc_las_Step_sys_las_SCM1_LaneAndRe_SignalProcess_LKA_LDW_SignalProcess_Subsystem13 autosar_swc_las_autosar_swc_las_Step_sys_las_SCM1_LaneAndRe_SignalProcess_LKA_LDW_SignalProcess_Subsystem2 autosar_swc_las_autosar_swc_las_Step_sys_las_SCM1_LaneAndRe_SignalProcess_LKA_LDW_SignalProcess_Subsystem3 autosar_swc_las_autosar_swc_las_Step_sys_las_SCM1_LaneAndRe_SignalProcess_LKA_LDW_SignalProcess_Subsystem6 autosar_swc_las_autosar_swc_las_Step_sys_las_SCM1_LaneAndRe_SignalProcess_LKA_LDW_SignalProcess_Subsystem7 autosar_swc_las_autosar_swc_las_Step_sys_las_SCM1_LaneAndRe_SignalProcess_LKA_LDW_SignalProcess_Subsystem8 autosar_swc_las_autosar_swc_las_Step_sys_las_SCM1_LaneAndRe_SignalProcess_LKA_LDW_SignalProcess_Subsystem9 /end SUB_GROUP
 /begin REF_CHARACTERISTIC P_LSS_LDP_TimeCompensatePre P_LSS_LDW_State_Param_LaneTime P_LSS_LDW_State_Param_Speed P_LSS_LDW_TimeCompensatePre /end REF_CHARACTERISTIC
 /begin REF_MEASUREMENT LAS_SCM_FLWhel2RiLineDy LAS_SCM_FRWhel2LeftLineDy autosar_swc_las_rtARID_DEF.Delay_DSTATE_k autosar_swc_las_rtARID_DEF.mPrePointX autosar_swc_las_rtARID_DEF.mPrePointX_c autosar_swc_las_rtARID_DEF.mPrePointX_m autosar_swc_las_rtARID_DEF.mPrePointX_o autosar_swc_las_rtARID_DEF.mPrePointY autosar_swc_las_rtARID_DEF.mPrePointY_e autosar_swc_las_rtARID_DEF.mPrePointY_j autosar_swc_las_rtARID_DEF.mPrePointY_l /end REF_MEASUREMENT
/end GROUP
/begin GROUP autosar_swc_las_autosar_swc_las_Step_sys_las_SCM1_LaneAndRe_SignalProcess_LKA_LDW_SignalProcess_Subsystem "autosar_swc_las/autosar_swc_las_Step_sys/las/SCM1/LaneAndRe_SignalProcess/LKA_LDW_SignalProcess/Subsystem" /begin REF_CHARACTERISTIC P_LSS_SCM_FWhelDyFilterCoef /end REF_CHARACTERISTIC /begin REF_MEASUREMENT autosar_swc_las_rtARID_DEF.UnitDelay4_DSTATE_b /end REF_MEASUREMENT /end GROUP
/begin GROUP autosar_swc_las_autosar_swc_las_Step_sys_las_SCM1_LaneAndRe_SignalProcess_LKA_LDW_SignalProcess_Subsystem1 "autosar_swc_las/autosar_swc_las_Step_sys/las/SCM1/LaneAndRe_SignalProcess/LKA_LDW_SignalProcess/Subsystem1" /begin REF_CHARACTERISTIC P_LSS_SCM_FWhelDyFilterCoef /end REF_CHARACTERISTIC /begin REF_MEASUREMENT autosar_swc_las_rtARID_DEF.UnitDelay5_DSTATE_n /end REF_MEASUREMENT /end GROUP
/begin GROUP autosar_swc_las_autosar_swc_las_Step_sys_las_SCM1_LaneAndRe_SignalProcess_LKA_LDW_SignalProcess_Subsystem10 "autosar_swc_las/autosar_swc_las_Step_sys/las/SCM1/LaneAndRe_SignalProcess/LKA_LDW_SignalProcess/Subsystem10"
 /begin SUB_GROUP autosar_swc_las_autosar_swc_las_Step_sys_las_SCM1_LaneAndRe_SignalProcess_LKA_LDW_SignalProcess_Subsystem10_Subsystem autosar_swc_las_autosar_swc_las_Step_sys_las_SCM1_LaneAndRe_SignalProcess_LKA_LDW_SignalProcess_Subsystem10_Subsystem1 /end SUB_GROUP
/end GROUP
/begin GROUP autosar_swc_las_autosar_swc_las_Step_sys_las_SCM1_LaneAndRe_SignalProcess_LKA_LDW_SignalProcess_Subsystem10_Subsystem "autosar_swc_las/autosar_swc_las_Step_sys/las/SCM1/LaneAndRe_SignalProcess/LKA_LDW_SignalProcess/Subsystem10/Subsystem"
 /begin REF_MEASUREMENT autosar_swc_las_rtARID_DEF.mPrePointX_c autosar_swc_las_rtARID_DEF.mPrePointY_l /end REF_MEASUREMENT
/end GROUP
/begin GROUP autosar_swc_las_autosar_swc_las_Step_sys_las_SCM1_LaneAndRe_SignalProcess_LKA_LDW_SignalProcess_Subsystem10_Subsystem1 "autosar_swc_las/autosar_swc_las_Step_sys/las/SCM1/LaneAndRe_SignalProcess/LKA_LDW_SignalProcess/Subsystem10/Subsystem1" /begin REF_MEASUREMENT autosar_swc_las_rtARID_DEF.mPrePointX_c /end REF_MEASUREMENT /end GROUP
/begin GROUP autosar_swc_las_autosar_swc_las_Step_sys_las_SCM1_LaneAndRe_SignalProcess_LKA_LDW_SignalProcess_Subsystem11 "autosar_swc_las/autosar_swc_las_Step_sys/las/SCM1/LaneAndRe_SignalProcess/LKA_LDW_SignalProcess/Subsystem11"
 /begin SUB_GROUP autosar_swc_las_autosar_swc_las_Step_sys_las_SCM1_LaneAndRe_SignalProcess_LKA_LDW_SignalProcess_Subsystem11_Subsystem autosar_swc_las_autosar_swc_las_Step_sys_las_SCM1_LaneAndRe_SignalProcess_LKA_LDW_SignalProcess_Subsystem11_Subsystem1 /end SUB_GROUP
/end GROUP
/begin GROUP autosar_swc_las_autosar_swc_las_Step_sys_las_SCM1_LaneAndRe_SignalProcess_LKA_LDW_SignalProcess_Subsystem11_Subsystem "autosar_swc_las/autosar_swc_las_Step_sys/las/SCM1/LaneAndRe_SignalProcess/LKA_LDW_SignalProcess/Subsystem11/Subsystem"
 /begin REF_MEASUREMENT autosar_swc_las_rtARID_DEF.mPrePointX_o autosar_swc_las_rtARID_DEF.mPrePointY_e /end REF_MEASUREMENT
/end GROUP
/begin GROUP autosar_swc_las_autosar_swc_las_Step_sys_las_SCM1_LaneAndRe_SignalProcess_LKA_LDW_SignalProcess_Subsystem11_Subsystem1 "autosar_swc_las/autosar_swc_las_Step_sys/las/SCM1/LaneAndRe_SignalProcess/LKA_LDW_SignalProcess/Subsystem11/Subsystem1" /begin REF_MEASUREMENT autosar_swc_las_rtARID_DEF.mPrePointX_o /end REF_MEASUREMENT /end GROUP
/begin GROUP autosar_swc_las_autosar_swc_las_Step_sys_las_SCM1_LaneAndRe_SignalProcess_LKA_LDW_SignalProcess_Subsystem12 "autosar_swc_las/autosar_swc_las_Step_sys/las/SCM1/LaneAndRe_SignalProcess/LKA_LDW_SignalProcess/Subsystem12" /begin REF_CHARACTERISTIC P_LSS_SCM_FWhelDyFilterCoef /end REF_CHARACTERISTIC /begin REF_MEASUREMENT autosar_swc_las_rtARID_DEF.UnitDelay2_DSTATE_m /end REF_MEASUREMENT /end GROUP
/begin GROUP autosar_swc_las_autosar_swc_las_Step_sys_las_SCM1_LaneAndRe_SignalProcess_LKA_LDW_SignalProcess_Subsystem13 "autosar_swc_las/autosar_swc_las_Step_sys/las/SCM1/LaneAndRe_SignalProcess/LKA_LDW_SignalProcess/Subsystem13" /begin REF_CHARACTERISTIC P_LSS_SCM_FWhelDyFilterCoef /end REF_CHARACTERISTIC /begin REF_MEASUREMENT autosar_swc_las_rtARID_DEF.UnitDelay2_DSTATE_b /end REF_MEASUREMENT /end GROUP
/begin GROUP autosar_swc_las_autosar_swc_las_Step_sys_las_SCM1_LaneAndRe_SignalProcess_LKA_LDW_SignalProcess_Subsystem2 "autosar_swc_las/autosar_swc_las_Step_sys/las/SCM1/LaneAndRe_SignalProcess/LKA_LDW_SignalProcess/Subsystem2" /begin REF_CHARACTERISTIC P_LSS_SCM_FWhelDyFilterCoef /end REF_CHARACTERISTIC /begin REF_MEASUREMENT autosar_swc_las_rtARID_DEF.UnitDelay_DSTATE_in /end REF_MEASUREMENT /end GROUP
/begin GROUP autosar_swc_las_autosar_swc_las_Step_sys_las_SCM1_LaneAndRe_SignalProcess_LKA_LDW_SignalProcess_Subsystem3 "autosar_swc_las/autosar_swc_las_Step_sys/las/SCM1/LaneAndRe_SignalProcess/LKA_LDW_SignalProcess/Subsystem3" /begin REF_CHARACTERISTIC P_LSS_SCM_FWhelDyFilterCoef /end REF_CHARACTERISTIC /begin REF_MEASUREMENT autosar_swc_las_rtARID_DEF.UnitDelay1_DSTATE_k /end REF_MEASUREMENT /end GROUP
/begin GROUP autosar_swc_las_autosar_swc_las_Step_sys_las_SCM1_LaneAndRe_SignalProcess_LKA_LDW_SignalProcess_Subsystem6 "autosar_swc_las/autosar_swc_las_Step_sys/las/SCM1/LaneAndRe_SignalProcess/LKA_LDW_SignalProcess/Subsystem6"
 /begin SUB_GROUP autosar_swc_las_autosar_swc_las_Step_sys_las_SCM1_LaneAndRe_SignalProcess_LKA_LDW_SignalProcess_Subsystem6_Subsystem autosar_swc_las_autosar_swc_las_Step_sys_las_SCM1_LaneAndRe_SignalProcess_LKA_LDW_SignalProcess_Subsystem6_Subsystem1 /end SUB_GROUP
/end GROUP
/begin GROUP autosar_swc_las_autosar_swc_las_Step_sys_las_SCM1_LaneAndRe_SignalProcess_LKA_LDW_SignalProcess_Subsystem6_Subsystem "autosar_swc_las/autosar_swc_las_Step_sys/las/SCM1/LaneAndRe_SignalProcess/LKA_LDW_SignalProcess/Subsystem6/Subsystem"
 /begin REF_MEASUREMENT autosar_swc_las_rtARID_DEF.mPrePointX autosar_swc_las_rtARID_DEF.mPrePointY /end REF_MEASUREMENT
/end GROUP
/begin GROUP autosar_swc_las_autosar_swc_las_Step_sys_las_SCM1_LaneAndRe_SignalProcess_LKA_LDW_SignalProcess_Subsystem6_Subsystem1 "autosar_swc_las/autosar_swc_las_Step_sys/las/SCM1/LaneAndRe_SignalProcess/LKA_LDW_SignalProcess/Subsystem6/Subsystem1" /begin REF_MEASUREMENT autosar_swc_las_rtARID_DEF.mPrePointX /end REF_MEASUREMENT /end GROUP
/begin GROUP autosar_swc_las_autosar_swc_las_Step_sys_las_SCM1_LaneAndRe_SignalProcess_LKA_LDW_SignalProcess_Subsystem7 "autosar_swc_las/autosar_swc_las_Step_sys/las/SCM1/LaneAndRe_SignalProcess/LKA_LDW_SignalProcess/Subsystem7" /begin REF_CHARACTERISTIC P_LSS_SCM_FWhelDyFilterCoef /end REF_CHARACTERISTIC /begin REF_MEASUREMENT autosar_swc_las_rtARID_DEF.UnitDelay2_DSTATE_j /end REF_MEASUREMENT /end GROUP
/begin GROUP autosar_swc_las_autosar_swc_las_Step_sys_las_SCM1_LaneAndRe_SignalProcess_LKA_LDW_SignalProcess_Subsystem8 "autosar_swc_las/autosar_swc_las_Step_sys/las/SCM1/LaneAndRe_SignalProcess/LKA_LDW_SignalProcess/Subsystem8" /begin REF_CHARACTERISTIC P_LSS_SCM_FWhelDyFilterCoef /end REF_CHARACTERISTIC /begin REF_MEASUREMENT autosar_swc_las_rtARID_DEF.UnitDelay2_DSTATE_jo /end REF_MEASUREMENT /end GROUP
/begin GROUP autosar_swc_las_autosar_swc_las_Step_sys_las_SCM1_LaneAndRe_SignalProcess_LKA_LDW_SignalProcess_Subsystem9 "autosar_swc_las/autosar_swc_las_Step_sys/las/SCM1/LaneAndRe_SignalProcess/LKA_LDW_SignalProcess/Subsystem9"
 /begin SUB_GROUP autosar_swc_las_autosar_swc_las_Step_sys_las_SCM1_LaneAndRe_SignalProcess_LKA_LDW_SignalProcess_Subsystem9_Subsystem autosar_swc_las_autosar_swc_las_Step_sys_las_SCM1_LaneAndRe_SignalProcess_LKA_LDW_SignalProcess_Subsystem9_Subsystem1 /end SUB_GROUP
/end GROUP
/begin GROUP autosar_swc_las_autosar_swc_las_Step_sys_las_SCM1_LaneAndRe_SignalProcess_LKA_LDW_SignalProcess_Subsystem9_Subsystem "autosar_swc_las/autosar_swc_las_Step_sys/las/SCM1/LaneAndRe_SignalProcess/LKA_LDW_SignalProcess/Subsystem9/Subsystem"
 /begin REF_MEASUREMENT autosar_swc_las_rtARID_DEF.mPrePointX_m autosar_swc_las_rtARID_DEF.mPrePointY_j /end REF_MEASUREMENT
/end GROUP
/begin GROUP autosar_swc_las_autosar_swc_las_Step_sys_las_SCM1_LaneAndRe_SignalProcess_LKA_LDW_SignalProcess_Subsystem9_Subsystem1 "autosar_swc_las/autosar_swc_las_Step_sys/las/SCM1/LaneAndRe_SignalProcess/LKA_LDW_SignalProcess/Subsystem9/Subsystem1" /begin REF_MEASUREMENT autosar_swc_las_rtARID_DEF.mPrePointX_m /end REF_MEASUREMENT /end GROUP
/begin GROUP autosar_swc_las_autosar_swc_las_Step_sys_las_SCM1_LaneAndRe_SignalProcess_LaneChangeValidJud "autosar_swc_las/autosar_swc_las_Step_sys/las/SCM1/LaneAndRe_SignalProcess/LaneChangeValidJud"
 /begin REF_MEASUREMENT autosar_swc_las_rtARID_DEF.Delay1_DSTATE autosar_swc_las_rtARID_DEF.Delay_DSTATE_g /end REF_MEASUREMENT
/end GROUP
/begin GROUP autosar_swc_las_autosar_swc_las_Step_sys_las_SCM1_LaneAndRe_SignalProcess_LineCheck "autosar_swc_las/autosar_swc_las_Step_sys/las/SCM1/LaneAndRe_SignalProcess/LineCheck"
 /begin REF_CHARACTERISTIC P_LSS_SCM_LineJumpSW P_LSS_SCM_LinestdLowLimit P_LSS_SCM_LinestdpreTime /end REF_CHARACTERISTIC
 /begin REF_MEASUREMENT LAS_SCM_LeftEgePathChange_b LAS_SCM_LeftEgeStd_b LAS_SCM_LeftLinePathChange_b LAS_SCM_LeftLineStd_b LAS_SCM_RightEgePathChange_b LAS_SCM_RightEgeStd_b LAS_SCM_RightLinePathChange_b LAS_SCM_RightLineStd_b autosar_swc_las_rtARID_DEF.UnitDelay10_DSTATE autosar_swc_las_rtARID_DEF.UnitDelay11_DSTATE autosar_swc_las_rtARID_DEF.UnitDelay12_DSTATE autosar_swc_las_rtARID_DEF.UnitDelay13_DSTATE autosar_swc_las_rtARID_DEF.UnitDelay14_DSTATE autosar_swc_las_rtARID_DEF.UnitDelay15_DSTATE autosar_swc_las_rtARID_DEF.UnitDelay16_DSTATE autosar_swc_las_rtARID_DEF.UnitDelay17_DSTATE autosar_swc_las_rtARID_DEF.UnitDelay18_DSTATE autosar_swc_las_rtARID_DEF.UnitDelay19_DSTATE autosar_swc_las_rtARID_DEF.UnitDelay1_DSTATE_co autosar_swc_las_rtARID_DEF.UnitDelay20_DSTATE autosar_swc_las_rtARID_DEF.UnitDelay21_DSTATE autosar_swc_las_rtARID_DEF.UnitDelay22_DSTATE autosar_swc_las_rtARID_DEF.UnitDelay27_DSTATE autosar_swc_las_rtARID_DEF.UnitDelay2_DSTATE_f autosar_swc_las_rtARID_DEF.UnitDelay3_DSTATE_c autosar_swc_las_rtARID_DEF.UnitDelay4_DSTATE autosar_swc_las_rtARID_DEF.UnitDelay5_DSTATE autosar_swc_las_rtARID_DEF.UnitDelay6_DSTATE_k autosar_swc_las_rtARID_DEF.UnitDelay7_DSTATE autosar_swc_las_rtARID_DEF.UnitDelay8_DSTATE autosar_swc_las_rtARID_DEF.UnitDelay9_DSTATE autosar_swc_las_rtARID_DEF.UnitDelay_DSTATE_i5 /end REF_MEASUREMENT
/end GROUP
/begin GROUP autosar_swc_las_autosar_swc_las_Step_sys_las_SCM1_LaneAndRe_SignalProcess_RepaireRoadJudge "autosar_swc_las/autosar_swc_las_Step_sys/las/SCM1/LaneAndRe_SignalProcess/RepaireRoadJudge"
 /begin SUB_GROUP autosar_swc_las_autosar_swc_las_Step_sys_las_SCM1_LaneAndRe_SignalProcess_RepaireRoadJudge_Compare_To_Constant autosar_swc_las_autosar_swc_las_Step_sys_las_SCM1_LaneAndRe_SignalProcess_RepaireRoadJudge_Compare_To_Constant1 autosar_swc_las_autosar_swc_las_Step_sys_las_SCM1_LaneAndRe_SignalProcess_RepaireRoadJudge_Compare_To_Constant212 autosar_swc_las_autosar_swc_las_Step_sys_las_SCM1_LaneAndRe_SignalProcess_RepaireRoadJudge_Subsystem2 /end SUB_GROUP
 /begin REF_CHARACTERISTIC P_LSS_SCM_EHRV2SW P_LSS_SCM_RoadRepaireDefaultFlag /end REF_CHARACTERISTIC
 /begin REF_MEASUREMENT LAS_SCM_FrontRoadNoRepaireFlag LAS_SCM_repaireRoadDistance /end REF_MEASUREMENT
/end GROUP
/begin GROUP autosar_swc_las_autosar_swc_las_Step_sys_las_SCM1_LaneAndRe_SignalProcess_RepaireRoadJudge_Compare_To_Constant "autosar_swc_las/autosar_swc_las_Step_sys/las/SCM1/LaneAndRe_SignalProcess/RepaireRoadJudge/Compare\nTo Constant" /begin REF_CHARACTERISTIC P_LSS_SCM_RoadRepaireInValidDistance /end REF_CHARACTERISTIC /end GROUP
/begin GROUP autosar_swc_las_autosar_swc_las_Step_sys_las_SCM1_LaneAndRe_SignalProcess_RepaireRoadJudge_Compare_To_Constant1 "autosar_swc_las/autosar_swc_las_Step_sys/las/SCM1/LaneAndRe_SignalProcess/RepaireRoadJudge/Compare\nTo Constant1" /begin REF_CHARACTERISTIC P_LSS_SCM_RoadRepaireMinDistance /end REF_CHARACTERISTIC /end GROUP
/begin GROUP autosar_swc_las_autosar_swc_las_Step_sys_las_SCM1_LaneAndRe_SignalProcess_RepaireRoadJudge_Compare_To_Constant212 "autosar_swc_las/autosar_swc_las_Step_sys/las/SCM1/LaneAndRe_SignalProcess/RepaireRoadJudge/Compare\nTo Constant212" /begin REF_CHARACTERISTIC P_LSS_ELK_NoRepaireTime /end REF_CHARACTERISTIC /end GROUP
/begin GROUP autosar_swc_las_autosar_swc_las_Step_sys_las_SCM1_LaneAndRe_SignalProcess_RepaireRoadJudge_Subsystem2 "autosar_swc_las/autosar_swc_las_Step_sys/las/SCM1/LaneAndRe_SignalProcess/RepaireRoadJudge/Subsystem2" /begin REF_MEASUREMENT autosar_swc_las_rtARID_DEF.UnitDelay_DSTATE_d /end REF_MEASUREMENT /end GROUP
/begin GROUP autosar_swc_las_autosar_swc_las_Step_sys_las_SCM1_LaneAndRe_SignalProcess_Subsystem1 "autosar_swc_las/autosar_swc_las_Step_sys/las/SCM1/LaneAndRe_SignalProcess/Subsystem1" /begin REF_CHARACTERISTIC P_LSS_SCM_FWhelDyFilterCoef /end REF_CHARACTERISTIC /begin REF_MEASUREMENT autosar_swc_las_rtARID_DEF.UnitDelay1_DSTATE_o /end REF_MEASUREMENT /end GROUP
/begin GROUP autosar_swc_las_autosar_swc_las_Step_sys_las_SCM1_LaneAndRe_SignalProcess_Subsystem3 "autosar_swc_las/autosar_swc_las_Step_sys/las/SCM1/LaneAndRe_SignalProcess/Subsystem3" /begin REF_CHARACTERISTIC P_LSS_SCM_FWhelDyFilterCoef /end REF_CHARACTERISTIC /begin REF_MEASUREMENT autosar_swc_las_rtARID_DEF.UnitDelay1_DSTATE_f /end REF_MEASUREMENT /end GROUP
/begin GROUP autosar_swc_las_autosar_swc_las_Step_sys_las_Subsystem1 "autosar_swc_las/autosar_swc_las_Step_sys/las/Subsystem1" /begin REF_CHARACTERISTIC P_LSS_LaneTimeCompensateSwitch P_LSS_LaneUseRLGSLaneSwitch /end REF_CHARACTERISTIC /begin REF_MEASUREMENT LAS_Reserve8 /end REF_MEASUREMENT /end GROUP
/begin GROUP autosar_swc_las_rtARID_DEF.TmpSignalConversionAtVAL_DRIVER_SWITCHOutport1 ""
 /begin REF_MEASUREMENT autosar_swc_las_rtARID_DEF.TmpSignalConversionAtVAL_DRIVER_SWITCHOutport1.NOHOnOff autosar_swc_las_rtARID_DEF.TmpSignalConversionAtVAL_DRIVER_SWITCHOutport1.NOHActReq autosar_swc_las_rtARID_DEF.TmpSignalConversionAtVAL_DRIVER_SWITCHOutport1.LDWOnOff autosar_swc_las_rtARID_DEF.TmpSignalConversionAtVAL_DRIVER_SWITCHOutport1.LKAOnOff autosar_swc_las_rtARID_DEF.TmpSignalConversionAtVAL_DRIVER_SWITCHOutport1.ELKOnOff autosar_swc_las_rtARID_DEF.TmpSignalConversionAtVAL_DRIVER_SWITCHOutport1.ESSOnOff autosar_swc_las_rtARID_DEF.TmpSignalConversionAtVAL_DRIVER_SWITCHOutport1.AESOnOff autosar_swc_las_rtARID_DEF.TmpSignalConversionAtVAL_DRIVER_SWITCHOutport1.LCKIEOnOff autosar_swc_las_rtARID_DEF.TmpSignalConversionAtVAL_DRIVER_SWITCHOutport1.ISLOnOff autosar_swc_las_rtARID_DEF.TmpSignalConversionAtVAL_DRIVER_SWITCHOutport1.IntellgntCurveOnOff autosar_swc_las_rtARID_DEF.TmpSignalConversionAtVAL_DRIVER_SWITCHOutport1.FCWOnOff autosar_swc_las_rtARID_DEF.TmpSignalConversionAtVAL_DRIVER_SWITCHOutport1.AEBOnOff autosar_swc_las_rtARID_DEF.TmpSignalConversionAtVAL_DRIVER_SWITCHOutport1.DAIOnOff autosar_swc_las_rtARID_DEF.TmpSignalConversionAtVAL_DRIVER_SWITCHOutport1.SpeedLmtNumberAbs autosar_swc_las_rtARID_DEF.TmpSignalConversionAtVAL_DRIVER_SWITCHOutport1.SpeedLmtNumberPerct autosar_swc_las_rtARID_DEF.TmpSignalConversionAtVAL_DRIVER_SWITCHOutport1.SpeedLmtSnvtyMod autosar_swc_las_rtARID_DEF.TmpSignalConversionAtVAL_DRIVER_SWITCHOutport1.IHCOnOff autosar_swc_las_rtARID_DEF.TmpSignalConversionAtVAL_DRIVER_SWITCHOutport1.ICAOnOff autosar_swc_las_rtARID_DEF.TmpSignalConversionAtVAL_DRIVER_SWITCHOutport1.SLAOnOff autosar_swc_las_rtARID_DEF.TmpSignalConversionAtVAL_DRIVER_SWITCHOutport1.SLAWarnMod autosar_swc_las_rtARID_DEF.TmpSignalConversionAtVAL_DRIVER_SWITCHOutport1.LASSnvtySet autosar_swc_las_rtARID_DEF.TmpSignalConversionAtVAL_DRIVER_SWITCHOutport1.LASWarnFormSwtReq autosar_swc_las_rtARID_DEF.TmpSignalConversionAtVAL_DRIVER_SWITCHOutport1.TSROnOff autosar_swc_las_rtARID_DEF.TmpSignalConversionAtVAL_DRIVER_SWITCHOutport1.TLIOnOff autosar_swc_las_rtARID_DEF.TmpSignalConversionAtVAL_DRIVER_SWITCHOutport1.ALCSet autosar_swc_las_rtARID_DEF.TmpSignalConversionAtVAL_DRIVER_SWITCHOutport1.DCLCSet autosar_swc_las_rtARID_DEF.TmpSignalConversionAtVAL_DRIVER_SWITCHOutport1.ALCSnvtySet autosar_swc_las_rtARID_DEF.TmpSignalConversionAtVAL_DRIVER_SWITCHOutport1.FCWSnvty autosar_swc_las_rtARID_DEF.TmpSignalConversionAtVAL_DRIVER_SWITCHOutport1.VoiceRemindType autosar_swc_las_rtARID_DEF.TmpSignalConversionAtVAL_DRIVER_SWITCHOutport1.TJAICAExitTextInfoONOFF autosar_swc_las_rtARID_DEF.TmpSignalConversionAtVAL_DRIVER_SWITCHOutport1.SpeedLimitOnOff autosar_swc_las_rtARID_DEF.TmpSignalConversionAtVAL_DRIVER_SWITCHOutport1.TimeStampMs /end REF_MEASUREMENT
/end GROUP
/begin MEASUREMENT RLGS_ExecTimestamp.nanoseconds "" ULONG autosar_swc_rlgs_CM_uint32 0 0 0 4294967295 ECU_ADDRESS 0xfe4ae6f4 /* @ECU_Address@RLGS_ExecTimestamp.nanoseconds@ */ /end MEASUREMENT
/begin MEASUREMENT RLGS_ExecTimestamp.seconds "" A_UINT64 autosar_swc_rlgs_CM_uint64 0 0 0 18446744073709551615 ECU_ADDRESS 0xfe4ae6f8 /* @ECU_Address@RLGS_ExecTimestamp.seconds@ */ /end MEASUREMENT
/begin MEASUREMENT RLGS_ExecTimestamp.timeBaseStatus "" UBYTE autosar_swc_rlgs_CM_uint8 0 0 0 255 ECU_ADDRESS 0xfe4ae6f0 /* @ECU_Address@RLGS_ExecTimestamp.timeBaseStatus@ */ /end MEASUREMENT
/begin MEASUREMENT SwcOut_RLGS_EVM_DECS.host_lane_idx "" UBYTE autosar_swc_rlgs_CM_uint8 0 0 0 255 ECU_ADDRESS 0xfe4ae700 /* @ECU_Address@SwcOut_RLGS_EVM_DECS.host_lane_idx@ */ /end MEASUREMENT
/begin MEASUREMENT SwcOut_RLGS_EVM_DECS.lc_level "" UBYTE autosar_swc_rlgs_CM_uint8 0 0 0 255 ECU_ADDRESS 0xfe4ae704 /* @ECU_Address@SwcOut_RLGS_EVM_DECS.lc_level@ */ /end MEASUREMENT
/begin MEASUREMENT SwcOut_RLGS_EVM_DECS.lc_lntention_conds "" ULONG autosar_swc_rlgs_CM_uint32 0 0 0 4294967295 LAYOUT COLUMN_DIR MATRIX_DIM 10 ECU_ADDRESS 0xfe4ae708 /* @ECU_Address@SwcOut_RLGS_EVM_DECS.lc_lntention_conds@ */ /end MEASUREMENT
/begin MEASUREMENT SwcOut_RLGS_EVM_DECS.lc_req "" UBYTE autosar_swc_rlgs_CM_uint8 0 0 0 255 ECU_ADDRESS 0xfe4ae702 /* @ECU_Address@SwcOut_RLGS_EVM_DECS.lc_req@ */ /end MEASUREMENT
/begin MEASUREMENT SwcOut_RLGS_EVM_DECS.lc_req_reason "" UBYTE autosar_swc_rlgs_CM_uint8 0 0 0 255 ECU_ADDRESS 0xfe4ae705 /* @ECU_Address@SwcOut_RLGS_EVM_DECS.lc_req_reason@ */ /end MEASUREMENT
/begin MEASUREMENT SwcOut_RLGS_EVM_DECS.lc_req_sync_id "" UBYTE autosar_swc_rlgs_CM_uint8 0 0 0 255 ECU_ADDRESS 0xfe4ae703 /* @ECU_Address@SwcOut_RLGS_EVM_DECS.lc_req_sync_id@ */ /end MEASUREMENT
/begin MEASUREMENT SwcOut_RLGS_EVM_DECS.target_lane_idx "" UBYTE autosar_swc_rlgs_CM_uint8 0 0 0 255 ECU_ADDRESS 0xfe4ae701 /* @ECU_Address@SwcOut_RLGS_EVM_DECS.target_lane_idx@ */ /end MEASUREMENT
/begin MEASUREMENT SwcOut_RLGS_EVM_LANE[0].arrow_dir "" UBYTE autosar_swc_rlgs_CM_uint8 0 0 0 255 ECU_ADDRESS 0xfe4ae733 /* @ECU_Address@SwcOut_RLGS_EVM_LANE[0].arrow_dir@ */ /end MEASUREMENT
/begin MEASUREMENT SwcOut_RLGS_EVM_LANE[0].center_refline.calc_state "" UBYTE autosar_swc_rlgs_CM_uint8 0 0 0 255 ECU_ADDRESS 0xfe4ae7a1 /* @ECU_Address@SwcOut_RLGS_EVM_LANE[0].center_refline.calc_state@ */ /end MEASUREMENT
/begin MEASUREMENT SwcOut_RLGS_EVM_LANE[0].center_refline.curve.end "" FLOAT32_IEEE autosar_swc_rlgs_CM_single 0 0 -3.4E+38 3.4E+38 ECU_ADDRESS 0xfe4ae7ac /* @ECU_Address@SwcOut_RLGS_EVM_LANE[0].center_refline.curve.end@ */ /end MEASUREMENT
/begin MEASUREMENT SwcOut_RLGS_EVM_LANE[0].center_refline.curve.poly_vec "" FLOAT32_IEEE autosar_swc_rlgs_CM_single 0 0 -3.4E+38 3.4E+38 LAYOUT COLUMN_DIR MATRIX_DIM 6 ECU_ADDRESS 0xfe4ae7b0 /* @ECU_Address@SwcOut_RLGS_EVM_LANE[0].center_refline.curve.poly_vec@ */ /end MEASUREMENT
/begin MEASUREMENT SwcOut_RLGS_EVM_LANE[0].center_refline.curve.start "" FLOAT32_IEEE autosar_swc_rlgs_CM_single 0 0 -3.4E+38 3.4E+38 ECU_ADDRESS 0xfe4ae7a8 /* @ECU_Address@SwcOut_RLGS_EVM_LANE[0].center_refline.curve.start@ */ /end MEASUREMENT
/begin MEASUREMENT SwcOut_RLGS_EVM_LANE[0].center_refline.id "" ULONG autosar_swc_rlgs_CM_uint32 0 0 0 4294967295 ECU_ADDRESS 0xfe4ae7a4 /* @ECU_Address@SwcOut_RLGS_EVM_LANE[0].center_refline.id@ */ /end MEASUREMENT
/begin MEASUREMENT SwcOut_RLGS_EVM_LANE[0].center_refline.ref_source "" UBYTE autosar_swc_rlgs_CM_uint8 0 0 0 255 ECU_ADDRESS 0xfe4ae7a0 /* @ECU_Address@SwcOut_RLGS_EVM_LANE[0].center_refline.ref_source@ */ /end MEASUREMENT
/begin MEASUREMENT SwcOut_RLGS_EVM_LANE[0].current_width "" FLOAT32_IEEE autosar_swc_rlgs_CM_single 0 0 -3.4E+38 3.4E+38 ECU_ADDRESS 0xfe4ae734 /* @ECU_Address@SwcOut_RLGS_EVM_LANE[0].current_width@ */ /end MEASUREMENT
/begin MEASUREMENT SwcOut_RLGS_EVM_LANE[0].end_dist "" FLOAT32_IEEE autosar_swc_rlgs_CM_single 0 0 -3.4E+38 3.4E+38 ECU_ADDRESS 0xfe4ae738 /* @ECU_Address@SwcOut_RLGS_EVM_LANE[0].end_dist@ */ /end MEASUREMENT
/begin MEASUREMENT SwcOut_RLGS_EVM_LANE[0].id "" ULONG autosar_swc_rlgs_CM_uint32 0 0 0 4294967295 ECU_ADDRESS 0xfe4ae73c /* @ECU_Address@SwcOut_RLGS_EVM_LANE[0].id@ */ /end MEASUREMENT
/begin MEASUREMENT SwcOut_RLGS_EVM_LANE[0].lane_extension_type "" UBYTE autosar_swc_rlgs_CM_uint8 0 0 0 255 ECU_ADDRESS 0xfe4ae732 /* @ECU_Address@SwcOut_RLGS_EVM_LANE[0].lane_extension_type@ */ /end MEASUREMENT
/begin MEASUREMENT SwcOut_RLGS_EVM_LANE[0].lane_source "" UBYTE autosar_swc_rlgs_CM_uint8 0 0 0 255 ECU_ADDRESS 0xfe4ae731 /* @ECU_Address@SwcOut_RLGS_EVM_LANE[0].lane_source@ */ /end MEASUREMENT
/begin MEASUREMENT SwcOut_RLGS_EVM_LANE[0].left_constraint.constraint_type "" UBYTE autosar_swc_rlgs_CM_uint8 0 0 0 255 ECU_ADDRESS 0xfe4ae740 /* @ECU_Address@SwcOut_RLGS_EVM_LANE[0].left_constraint.constraint_type@ */ /end MEASUREMENT
/begin MEASUREMENT SwcOut_RLGS_EVM_LANE[0].left_constraint.constraint_type_ahead "" UBYTE autosar_swc_rlgs_CM_uint8 0 0 0 255 ECU_ADDRESS 0xfe4ae741 /* @ECU_Address@SwcOut_RLGS_EVM_LANE[0].left_constraint.constraint_type_ahead@ */ /end MEASUREMENT
/begin MEASUREMENT SwcOut_RLGS_EVM_LANE[0].left_constraint.constraint_type_change_point_dx "" FLOAT32_IEEE autosar_swc_rlgs_CM_single 0 0 -3.4E+38 3.4E+38 ECU_ADDRESS 0xfe4ae744 /* @ECU_Address@SwcOut_RLGS_EVM_LANE[0].left_constraint.constraint_type_change_point_dx@ */ /end MEASUREMENT
/begin MEASUREMENT SwcOut_RLGS_EVM_LANE[0].left_constraint.curve.end "" FLOAT32_IEEE autosar_swc_rlgs_CM_single 0 0 -3.4E+38 3.4E+38 ECU_ADDRESS 0xfe4ae754 /* @ECU_Address@SwcOut_RLGS_EVM_LANE[0].left_constraint.curve.end@ */ /end MEASUREMENT
/begin MEASUREMENT SwcOut_RLGS_EVM_LANE[0].left_constraint.curve.poly_vec "" FLOAT32_IEEE autosar_swc_rlgs_CM_single 0 0 -3.4E+38 3.4E+38 LAYOUT COLUMN_DIR MATRIX_DIM 6 ECU_ADDRESS 0xfe4ae758 /* @ECU_Address@SwcOut_RLGS_EVM_LANE[0].left_constraint.curve.poly_vec@ */ /end MEASUREMENT
/begin MEASUREMENT SwcOut_RLGS_EVM_LANE[0].left_constraint.curve.start "" FLOAT32_IEEE autosar_swc_rlgs_CM_single 0 0 -3.4E+38 3.4E+38 ECU_ADDRESS 0xfe4ae750 /* @ECU_Address@SwcOut_RLGS_EVM_LANE[0].left_constraint.curve.start@ */ /end MEASUREMENT
/begin MEASUREMENT SwcOut_RLGS_EVM_LANE[0].left_constraint.id "" ULONG autosar_swc_rlgs_CM_uint32 0 0 0 4294967295 ECU_ADDRESS 0xfe4ae74c /* @ECU_Address@SwcOut_RLGS_EVM_LANE[0].left_constraint.id@ */ /end MEASUREMENT
/begin MEASUREMENT SwcOut_RLGS_EVM_LANE[0].left_constraint.meas_state "" UBYTE autosar_swc_rlgs_CM_uint8 0 0 0 255 ECU_ADDRESS 0xfe4ae743 /* @ECU_Address@SwcOut_RLGS_EVM_LANE[0].left_constraint.meas_state@ */ /end MEASUREMENT
/begin MEASUREMENT SwcOut_RLGS_EVM_LANE[0].left_constraint.source_type "" UBYTE autosar_swc_rlgs_CM_uint8 0 0 0 255 ECU_ADDRESS 0xfe4ae742 /* @ECU_Address@SwcOut_RLGS_EVM_LANE[0].left_constraint.source_type@ */ /end MEASUREMENT
/begin MEASUREMENT SwcOut_RLGS_EVM_LANE[0].left_constraint.visible_end "" FLOAT32_IEEE autosar_swc_rlgs_CM_single 0 0 -3.4E+38 3.4E+38 ECU_ADDRESS 0xfe4ae748 /* @ECU_Address@SwcOut_RLGS_EVM_LANE[0].left_constraint.visible_end@ */ /end MEASUREMENT
/begin MEASUREMENT SwcOut_RLGS_EVM_LANE[0].right_constraint.constraint_type "" UBYTE autosar_swc_rlgs_CM_uint8 0 0 0 255 ECU_ADDRESS 0xfe4ae770 /* @ECU_Address@SwcOut_RLGS_EVM_LANE[0].right_constraint.constraint_type@ */ /end MEASUREMENT
/begin MEASUREMENT SwcOut_RLGS_EVM_LANE[0].right_constraint.constraint_type_ahead "" UBYTE autosar_swc_rlgs_CM_uint8 0 0 0 255 ECU_ADDRESS 0xfe4ae771 /* @ECU_Address@SwcOut_RLGS_EVM_LANE[0].right_constraint.constraint_type_ahead@ */ /end MEASUREMENT
/begin MEASUREMENT SwcOut_RLGS_EVM_LANE[0].right_constraint.constraint_type_change_point_dx "" FLOAT32_IEEE autosar_swc_rlgs_CM_single 0 0 -3.4E+38 3.4E+38 ECU_ADDRESS 0xfe4ae774 /* @ECU_Address@SwcOut_RLGS_EVM_LANE[0].right_constraint.constraint_type_change_point_dx@ */ /end MEASUREMENT
/begin MEASUREMENT SwcOut_RLGS_EVM_LANE[0].right_constraint.curve.end "" FLOAT32_IEEE autosar_swc_rlgs_CM_single 0 0 -3.4E+38 3.4E+38 ECU_ADDRESS 0xfe4ae784 /* @ECU_Address@SwcOut_RLGS_EVM_LANE[0].right_constraint.curve.end@ */ /end MEASUREMENT
/begin MEASUREMENT SwcOut_RLGS_EVM_LANE[0].right_constraint.curve.poly_vec "" FLOAT32_IEEE autosar_swc_rlgs_CM_single 0 0 -3.4E+38 3.4E+38 LAYOUT COLUMN_DIR MATRIX_DIM 6 ECU_ADDRESS 0xfe4ae788 /* @ECU_Address@SwcOut_RLGS_EVM_LANE[0].right_constraint.curve.poly_vec@ */ /end MEASUREMENT
/begin MEASUREMENT SwcOut_RLGS_EVM_LANE[0].right_constraint.curve.start "" FLOAT32_IEEE autosar_swc_rlgs_CM_single 0 0 -3.4E+38 3.4E+38 ECU_ADDRESS 0xfe4ae780 /* @ECU_Address@SwcOut_RLGS_EVM_LANE[0].right_constraint.curve.start@ */ /end MEASUREMENT
/begin MEASUREMENT SwcOut_RLGS_EVM_LANE[0].right_constraint.id "" ULONG autosar_swc_rlgs_CM_uint32 0 0 0 4294967295 ECU_ADDRESS 0xfe4ae77c /* @ECU_Address@SwcOut_RLGS_EVM_LANE[0].right_constraint.id@ */ /end MEASUREMENT
/begin MEASUREMENT SwcOut_RLGS_EVM_LANE[0].right_constraint.meas_state "" UBYTE autosar_swc_rlgs_CM_uint8 0 0 0 255 ECU_ADDRESS 0xfe4ae773 /* @ECU_Address@SwcOut_RLGS_EVM_LANE[0].right_constraint.meas_state@ */ /end MEASUREMENT
/begin MEASUREMENT SwcOut_RLGS_EVM_LANE[0].right_constraint.source_type "" UBYTE autosar_swc_rlgs_CM_uint8 0 0 0 255 ECU_ADDRESS 0xfe4ae772 /* @ECU_Address@SwcOut_RLGS_EVM_LANE[0].right_constraint.source_type@ */ /end MEASUREMENT
/begin MEASUREMENT SwcOut_RLGS_EVM_LANE[0].right_constraint.visible_end "" FLOAT32_IEEE autosar_swc_rlgs_CM_single 0 0 -3.4E+38 3.4E+38 ECU_ADDRESS 0xfe4ae778 /* @ECU_Address@SwcOut_RLGS_EVM_LANE[0].right_constraint.visible_end@ */ /end MEASUREMENT
/begin MEASUREMENT SwcOut_RLGS_EVM_LANE[0].type "" UBYTE autosar_swc_rlgs_CM_uint8 0 0 0 255 ECU_ADDRESS 0xfe4ae730 /* @ECU_Address@SwcOut_RLGS_EVM_LANE[0].type@ */ /end MEASUREMENT
/begin MEASUREMENT SwcOut_RLGS_EVM_LANE[1].arrow_dir "" UBYTE autosar_swc_rlgs_CM_uint8 0 0 0 255 ECU_ADDRESS 0xfe4ae7cb /* @ECU_Address@SwcOut_RLGS_EVM_LANE[1].arrow_dir@ */ /end MEASUREMENT
/begin MEASUREMENT SwcOut_RLGS_EVM_LANE[1].center_refline.calc_state "" UBYTE autosar_swc_rlgs_CM_uint8 0 0 0 255 ECU_ADDRESS 0xfe4ae839 /* @ECU_Address@SwcOut_RLGS_EVM_LANE[1].center_refline.calc_state@ */ /end MEASUREMENT
/begin MEASUREMENT SwcOut_RLGS_EVM_LANE[1].center_refline.curve.end "" FLOAT32_IEEE autosar_swc_rlgs_CM_single 0 0 -3.4E+38 3.4E+38 ECU_ADDRESS 0xfe4ae844 /* @ECU_Address@SwcOut_RLGS_EVM_LANE[1].center_refline.curve.end@ */ /end MEASUREMENT
/begin MEASUREMENT SwcOut_RLGS_EVM_LANE[1].center_refline.curve.poly_vec "" FLOAT32_IEEE autosar_swc_rlgs_CM_single 0 0 -3.4E+38 3.4E+38 LAYOUT COLUMN_DIR MATRIX_DIM 6 ECU_ADDRESS 0xfe4ae848 /* @ECU_Address@SwcOut_RLGS_EVM_LANE[1].center_refline.curve.poly_vec@ */ /end MEASUREMENT
/begin MEASUREMENT SwcOut_RLGS_EVM_LANE[1].center_refline.curve.start "" FLOAT32_IEEE autosar_swc_rlgs_CM_single 0 0 -3.4E+38 3.4E+38 ECU_ADDRESS 0xfe4ae840 /* @ECU_Address@SwcOut_RLGS_EVM_LANE[1].center_refline.curve.start@ */ /end MEASUREMENT
/begin MEASUREMENT SwcOut_RLGS_EVM_LANE[1].center_refline.id "" ULONG autosar_swc_rlgs_CM_uint32 0 0 0 4294967295 ECU_ADDRESS 0xfe4ae83c /* @ECU_Address@SwcOut_RLGS_EVM_LANE[1].center_refline.id@ */ /end MEASUREMENT
/begin MEASUREMENT SwcOut_RLGS_EVM_LANE[1].center_refline.ref_source "" UBYTE autosar_swc_rlgs_CM_uint8 0 0 0 255 ECU_ADDRESS 0xfe4ae838 /* @ECU_Address@SwcOut_RLGS_EVM_LANE[1].center_refline.ref_source@ */ /end MEASUREMENT
/begin MEASUREMENT SwcOut_RLGS_EVM_LANE[1].current_width "" FLOAT32_IEEE autosar_swc_rlgs_CM_single 0 0 -3.4E+38 3.4E+38 ECU_ADDRESS 0xfe4ae7cc /* @ECU_Address@SwcOut_RLGS_EVM_LANE[1].current_width@ */ /end MEASUREMENT
/begin MEASUREMENT SwcOut_RLGS_EVM_LANE[1].end_dist "" FLOAT32_IEEE autosar_swc_rlgs_CM_single 0 0 -3.4E+38 3.4E+38 ECU_ADDRESS 0xfe4ae7d0 /* @ECU_Address@SwcOut_RLGS_EVM_LANE[1].end_dist@ */ /end MEASUREMENT
/begin MEASUREMENT SwcOut_RLGS_EVM_LANE[1].id "" ULONG autosar_swc_rlgs_CM_uint32 0 0 0 4294967295 ECU_ADDRESS 0xfe4ae7d4 /* @ECU_Address@SwcOut_RLGS_EVM_LANE[1].id@ */ /end MEASUREMENT
/begin MEASUREMENT SwcOut_RLGS_EVM_LANE[1].lane_extension_type "" UBYTE autosar_swc_rlgs_CM_uint8 0 0 0 255 ECU_ADDRESS 0xfe4ae7ca /* @ECU_Address@SwcOut_RLGS_EVM_LANE[1].lane_extension_type@ */ /end MEASUREMENT
/begin MEASUREMENT SwcOut_RLGS_EVM_LANE[1].lane_source "" UBYTE autosar_swc_rlgs_CM_uint8 0 0 0 255 ECU_ADDRESS 0xfe4ae7c9 /* @ECU_Address@SwcOut_RLGS_EVM_LANE[1].lane_source@ */ /end MEASUREMENT
/begin MEASUREMENT SwcOut_RLGS_EVM_LANE[1].left_constraint.constraint_type "" UBYTE autosar_swc_rlgs_CM_uint8 0 0 0 255 ECU_ADDRESS 0xfe4ae7d8 /* @ECU_Address@SwcOut_RLGS_EVM_LANE[1].left_constraint.constraint_type@ */ /end MEASUREMENT
/begin MEASUREMENT SwcOut_RLGS_EVM_LANE[1].left_constraint.constraint_type_ahead "" UBYTE autosar_swc_rlgs_CM_uint8 0 0 0 255 ECU_ADDRESS 0xfe4ae7d9 /* @ECU_Address@SwcOut_RLGS_EVM_LANE[1].left_constraint.constraint_type_ahead@ */ /end MEASUREMENT
/begin MEASUREMENT SwcOut_RLGS_EVM_LANE[1].left_constraint.constraint_type_change_point_dx "" FLOAT32_IEEE autosar_swc_rlgs_CM_single 0 0 -3.4E+38 3.4E+38 ECU_ADDRESS 0xfe4ae7dc /* @ECU_Address@SwcOut_RLGS_EVM_LANE[1].left_constraint.constraint_type_change_point_dx@ */ /end MEASUREMENT
/begin MEASUREMENT SwcOut_RLGS_EVM_LANE[1].left_constraint.curve.end "" FLOAT32_IEEE autosar_swc_rlgs_CM_single 0 0 -3.4E+38 3.4E+38 ECU_ADDRESS 0xfe4ae7ec /* @ECU_Address@SwcOut_RLGS_EVM_LANE[1].left_constraint.curve.end@ */ /end MEASUREMENT
/begin MEASUREMENT SwcOut_RLGS_EVM_LANE[1].left_constraint.curve.poly_vec "" FLOAT32_IEEE autosar_swc_rlgs_CM_single 0 0 -3.4E+38 3.4E+38 LAYOUT COLUMN_DIR MATRIX_DIM 6 ECU_ADDRESS 0xfe4ae7f0 /* @ECU_Address@SwcOut_RLGS_EVM_LANE[1].left_constraint.curve.poly_vec@ */ /end MEASUREMENT
/begin MEASUREMENT SwcOut_RLGS_EVM_LANE[1].left_constraint.curve.start "" FLOAT32_IEEE autosar_swc_rlgs_CM_single 0 0 -3.4E+38 3.4E+38 ECU_ADDRESS 0xfe4ae7e8 /* @ECU_Address@SwcOut_RLGS_EVM_LANE[1].left_constraint.curve.start@ */ /end MEASUREMENT
/begin MEASUREMENT SwcOut_RLGS_EVM_LANE[1].left_constraint.id "" ULONG autosar_swc_rlgs_CM_uint32 0 0 0 4294967295 ECU_ADDRESS 0xfe4ae7e4 /* @ECU_Address@SwcOut_RLGS_EVM_LANE[1].left_constraint.id@ */ /end MEASUREMENT
/begin MEASUREMENT SwcOut_RLGS_EVM_LANE[1].left_constraint.meas_state "" UBYTE autosar_swc_rlgs_CM_uint8 0 0 0 255 ECU_ADDRESS 0xfe4ae7db /* @ECU_Address@SwcOut_RLGS_EVM_LANE[1].left_constraint.meas_state@ */ /end MEASUREMENT
/begin MEASUREMENT SwcOut_RLGS_EVM_LANE[1].left_constraint.source_type "" UBYTE autosar_swc_rlgs_CM_uint8 0 0 0 255 ECU_ADDRESS 0xfe4ae7da /* @ECU_Address@SwcOut_RLGS_EVM_LANE[1].left_constraint.source_type@ */ /end MEASUREMENT
/begin MEASUREMENT SwcOut_RLGS_EVM_LANE[1].left_constraint.visible_end "" FLOAT32_IEEE autosar_swc_rlgs_CM_single 0 0 -3.4E+38 3.4E+38 ECU_ADDRESS 0xfe4ae7e0 /* @ECU_Address@SwcOut_RLGS_EVM_LANE[1].left_constraint.visible_end@ */ /end MEASUREMENT
/begin MEASUREMENT SwcOut_RLGS_EVM_LANE[1].type "" UBYTE autosar_swc_rlgs_CM_uint8 0 0 0 255 ECU_ADDRESS 0xfe4ae7c8 /* @ECU_Address@SwcOut_RLGS_EVM_LANE[1].type@ */ /end MEASUREMENT
/begin COMPU_METHOD autosar_swc_rlgs_CM_single "Q = V" IDENTICAL "%8.6" "" /end COMPU_METHOD
/begin COMPU_METHOD autosar_swc_rlgs_CM_uint32 "Q = V" IDENTICAL "%10.0" "" /end COMPU_METHOD
/begin COMPU_METHOD autosar_swc_rlgs_CM_uint64 "Q = V" IDENTICAL "%20.0" "" /end COMPU_METHOD
/begin COMPU_METHOD autosar_swc_rlgs_CM_uint8 "Q = V" IDENTICAL "%3.0" "" /end COMPU_METHOD
/begin RECORD_LAYOUT Record_BOOLEAN FNC_VALUES 1 UBYTE COLUMN_DIR DIRECT /end RECORD_LAYOUT
/begin RECORD_LAYOUT Record_FLOAT32_IEEE FNC_VALUES 1 FLOAT32_IEEE COLUMN_DIR DIRECT /end RECORD_LAYOUT
/begin RECORD_LAYOUT Record_FLOAT64_IEEE FNC_VALUES 1 FLOAT64_IEEE COLUMN_DIR DIRECT /end RECORD_LAYOUT
/begin RECORD_LAYOUT Record_UBYTE FNC_VALUES 1 UBYTE COLUMN_DIR DIRECT /end RECORD_LAYOUT
/begin RECORD_LAYOUT Record_UWORD FNC_VALUES 1 UWORD COLUMN_DIR DIRECT /end RECORD_LAYOUT
/begin RECORD_LAYOUT Axis_FLOAT32_IEEE AXIS_PTS_X 1 FLOAT32_IEEE INDEX_INCR DIRECT /end RECORD_LAYOUT
/begin GROUP RLGS_ExecTimestamp ""
 /begin REF_MEASUREMENT RLGS_ExecTimestamp.timeBaseStatus RLGS_ExecTimestamp.nanoseconds RLGS_ExecTimestamp.seconds /end REF_MEASUREMENT
/end GROUP
/begin GROUP SwcOut_RLGS_EVM_DECS ""
 /begin REF_MEASUREMENT SwcOut_RLGS_EVM_DECS.host_lane_idx SwcOut_RLGS_EVM_DECS.target_lane_idx SwcOut_RLGS_EVM_DECS.lc_req SwcOut_RLGS_EVM_DECS.lc_req_sync_id SwcOut_RLGS_EVM_DECS.lc_level SwcOut_RLGS_EVM_DECS.lc_req_reason SwcOut_RLGS_EVM_DECS.lc_lntention_conds /end REF_MEASUREMENT
/end GROUP
/begin GROUP SwcOut_RLGS_EVM_LANE[0] ""
 /begin SUB_GROUP SwcOut_RLGS_EVM_LANE[0].left_constraint SwcOut_RLGS_EVM_LANE[0].right_constraint SwcOut_RLGS_EVM_LANE[0].center_refline /end SUB_GROUP
 /begin REF_MEASUREMENT SwcOut_RLGS_EVM_LANE[0].type SwcOut_RLGS_EVM_LANE[0].lane_source SwcOut_RLGS_EVM_LANE[0].lane_extension_type SwcOut_RLGS_EVM_LANE[0].arrow_dir SwcOut_RLGS_EVM_LANE[0].current_width SwcOut_RLGS_EVM_LANE[0].end_dist SwcOut_RLGS_EVM_LANE[0].id /end REF_MEASUREMENT
/end GROUP
/begin GROUP SwcOut_RLGS_EVM_LANE[0].center_refline "" /begin SUB_GROUP SwcOut_RLGS_EVM_LANE[0].center_refline.curve /end SUB_GROUP
 /begin REF_MEASUREMENT SwcOut_RLGS_EVM_LANE[0].center_refline.ref_source SwcOut_RLGS_EVM_LANE[0].center_refline.calc_state SwcOut_RLGS_EVM_LANE[0].center_refline.id /end REF_MEASUREMENT
/end GROUP
/begin GROUP SwcOut_RLGS_EVM_LANE[0].center_refline.curve ""
 /begin REF_MEASUREMENT SwcOut_RLGS_EVM_LANE[0].center_refline.curve.start SwcOut_RLGS_EVM_LANE[0].center_refline.curve.end SwcOut_RLGS_EVM_LANE[0].center_refline.curve.poly_vec /end REF_MEASUREMENT
/end GROUP
/begin GROUP SwcOut_RLGS_EVM_LANE[0].left_constraint "" /begin SUB_GROUP SwcOut_RLGS_EVM_LANE[0].left_constraint.curve /end SUB_GROUP
 /begin REF_MEASUREMENT SwcOut_RLGS_EVM_LANE[0].left_constraint.constraint_type SwcOut_RLGS_EVM_LANE[0].left_constraint.constraint_type_ahead SwcOut_RLGS_EVM_LANE[0].left_constraint.source_type SwcOut_RLGS_EVM_LANE[0].left_constraint.meas_state SwcOut_RLGS_EVM_LANE[0].left_constraint.constraint_type_change_point_dx SwcOut_RLGS_EVM_LANE[0].left_constraint.visible_end SwcOut_RLGS_EVM_LANE[0].left_constraint.id /end REF_MEASUREMENT
/end GROUP
/begin GROUP SwcOut_RLGS_EVM_LANE[0].left_constraint.curve ""
 /begin REF_MEASUREMENT SwcOut_RLGS_EVM_LANE[0].left_constraint.curve.start SwcOut_RLGS_EVM_LANE[0].left_constraint.curve.end SwcOut_RLGS_EVM_LANE[0].left_constraint.curve.poly_vec /end REF_MEASUREMENT
/end GROUP
/begin GROUP SwcOut_RLGS_EVM_LANE[0].right_constraint "" /begin SUB_GROUP SwcOut_RLGS_EVM_LANE[0].right_constraint.curve /end SUB_GROUP
 /begin REF_MEASUREMENT SwcOut_RLGS_EVM_LANE[0].right_constraint.constraint_type SwcOut_RLGS_EVM_LANE[0].right_constraint.constraint_type_ahead SwcOut_RLGS_EVM_LANE[0].right_constraint.source_type SwcOut_RLGS_EVM_LANE[0].right_constraint.meas_state SwcOut_RLGS_EVM_LANE[0].right_constraint.constraint_type_change_point_dx SwcOut_RLGS_EVM_LANE[0].right_constraint.visible_end SwcOut_RLGS_EVM_LANE[0].right_constraint.id /end REF_MEASUREMENT
/end GROUP
/begin GROUP SwcOut_RLGS_EVM_LANE[0].right_constraint.curve ""
 /begin REF_MEASUREMENT SwcOut_RLGS_EVM_LANE[0].right_constraint.curve.start SwcOut_RLGS_EVM_LANE[0].right_constraint.curve.end SwcOut_RLGS_EVM_LANE[0].right_constraint.curve.poly_vec /end REF_MEASUREMENT
/end GROUP
/begin GROUP SwcOut_RLGS_EVM_LANE[1] ""
 /begin SUB_GROUP SwcOut_RLGS_EVM_LANE[1].left_constraint SwcOut_RLGS_EVM_LANE[1].right_constraint SwcOut_RLGS_EVM_LANE[1].center_refline /end SUB_GROUP
 /begin REF_MEASUREMENT SwcOut_RLGS_EVM_LANE[1].type SwcOut_RLGS_EVM_LANE[1].lane_source SwcOut_RLGS_EVM_LANE[1].lane_extension_type SwcOut_RLGS_EVM_LANE[1].arrow_dir SwcOut_RLGS_EVM_LANE[1].current_width SwcOut_RLGS_EVM_LANE[1].end_dist SwcOut_RLGS_EVM_LANE[1].id /end REF_MEASUREMENT
/end GROUP
/begin GROUP SwcOut_RLGS_EVM_LANE[1].center_refline "" /begin SUB_GROUP SwcOut_RLGS_EVM_LANE[1].center_refline.curve /end SUB_GROUP
 /begin REF_MEASUREMENT SwcOut_RLGS_EVM_LANE[1].center_refline.ref_source SwcOut_RLGS_EVM_LANE[1].center_refline.calc_state SwcOut_RLGS_EVM_LANE[1].center_refline.id /end REF_MEASUREMENT
/end GROUP
/begin GROUP SwcOut_RLGS_EVM_LANE[1].center_refline.curve ""
 /begin REF_MEASUREMENT SwcOut_RLGS_EVM_LANE[1].center_refline.curve.start SwcOut_RLGS_EVM_LANE[1].center_refline.curve.end SwcOut_RLGS_EVM_LANE[1].center_refline.curve.poly_vec /end REF_MEASUREMENT
/end GROUP
/begin GROUP SwcOut_RLGS_EVM_LANE[1].left_constraint "" /begin SUB_GROUP SwcOut_RLGS_EVM_LANE[1].left_constraint.curve /end SUB_GROUP
 /begin REF_MEASUREMENT SwcOut_RLGS_EVM_LANE[1].left_constraint.constraint_type SwcOut_RLGS_EVM_LANE[1].left_constraint.constraint_type_ahead SwcOut_RLGS_EVM_LANE[1].left_constraint.source_type SwcOut_RLGS_EVM_LANE[1].left_constraint.meas_state SwcOut_RLGS_EVM_LANE[1].left_constraint.constraint_type_change_point_dx SwcOut_RLGS_EVM_LANE[1].left_constraint.visible_end SwcOut_RLGS_EVM_LANE[1].left_constraint.id /end REF_MEASUREMENT
/end GROUP
/begin GROUP SwcOut_RLGS_EVM_LANE[1].left_constraint.curve ""
 /begin REF_MEASUREMENT SwcOut_RLGS_EVM_LANE[1].left_constraint.curve.start SwcOut_RLGS_EVM_LANE[1].left_constraint.curve.end SwcOut_RLGS_EVM_LANE[1].left_constraint.curve.poly_vec /end REF_MEASUREMENT
/end GROUP
/begin RECORD_LAYOUT Record_BOOLEAN FNC_VALUES 1 UBYTE COLUMN_DIR DIRECT /end RECORD_LAYOUT
/begin RECORD_LAYOUT Record_FLOAT32_IEEE FNC_VALUES 1 FLOAT32_IEEE COLUMN_DIR DIRECT /end RECORD_LAYOUT
/begin RECORD_LAYOUT Record_FLOAT64_IEEE FNC_VALUES 1 FLOAT64_IEEE COLUMN_DIR DIRECT /end RECORD_LAYOUT
/begin RECORD_LAYOUT Record_UBYTE FNC_VALUES 1 UBYTE COLUMN_DIR DIRECT /end RECORD_LAYOUT
/begin RECORD_LAYOUT Record_UWORD FNC_VALUES 1 UWORD COLUMN_DIR DIRECT /end RECORD_LAYOUT
/begin RECORD_LAYOUT Record_BOOLEAN FNC_VALUES 1 UBYTE COLUMN_DIR DIRECT /end RECORD_LAYOUT
/begin RECORD_LAYOUT Record_FLOAT32_IEEE FNC_VALUES 1 FLOAT32_IEEE COLUMN_DIR DIRECT /end RECORD_LAYOUT
/begin RECORD_LAYOUT Record_FLOAT64_IEEE FNC_VALUES 1 FLOAT64_IEEE COLUMN_DIR DIRECT /end RECORD_LAYOUT
/begin RECORD_LAYOUT Record_UBYTE FNC_VALUES 1 UBYTE COLUMN_DIR DIRECT /end RECORD_LAYOUT
/begin RECORD_LAYOUT Record_UWORD FNC_VALUES 1 UWORD COLUMN_DIR DIRECT /end RECORD_LAYOUT
/begin RECORD_LAYOUT Axis_FLOAT32_IEEE AXIS_PTS_X 1 FLOAT32_IEEE INDEX_INCR DIRECT /end RECORD_LAYOUT
/begin RECORD_LAYOUT Record_BOOLEAN FNC_VALUES 1 UBYTE COLUMN_DIR DIRECT /end RECORD_LAYOUT
/begin RECORD_LAYOUT Record_FLOAT32_IEEE FNC_VALUES 1 FLOAT32_IEEE COLUMN_DIR DIRECT /end RECORD_LAYOUT
/begin RECORD_LAYOUT Record_FLOAT64_IEEE FNC_VALUES 1 FLOAT64_IEEE COLUMN_DIR DIRECT /end RECORD_LAYOUT
/begin RECORD_LAYOUT Record_UBYTE FNC_VALUES 1 UBYTE COLUMN_DIR DIRECT /end RECORD_LAYOUT
/begin RECORD_LAYOUT Record_UWORD FNC_VALUES 1 UWORD COLUMN_DIR DIRECT /end RECORD_LAYOUT
/begin RECORD_LAYOUT Axis_FLOAT32_IEEE AXIS_PTS_X 1 FLOAT32_IEEE INDEX_INCR DIRECT /end RECORD_LAYOUT
/begin RECORD_LAYOUT Record_BOOLEAN FNC_VALUES 1 UBYTE COLUMN_DIR DIRECT /end RECORD_LAYOUT
/begin RECORD_LAYOUT Record_FLOAT32_IEEE FNC_VALUES 1 FLOAT32_IEEE COLUMN_DIR DIRECT /end RECORD_LAYOUT
/begin RECORD_LAYOUT Record_FLOAT64_IEEE FNC_VALUES 1 FLOAT64_IEEE COLUMN_DIR DIRECT /end RECORD_LAYOUT
/begin RECORD_LAYOUT Record_UBYTE FNC_VALUES 1 UBYTE COLUMN_DIR DIRECT /end RECORD_LAYOUT
/begin RECORD_LAYOUT Record_UWORD FNC_VALUES 1 UWORD COLUMN_DIR DIRECT /end RECORD_LAYOUT
/begin RECORD_LAYOUT Axis_FLOAT32_IEEE AXIS_PTS_X 1 FLOAT32_IEEE INDEX_INCR DIRECT /end RECORD_LAYOUT
/begin RECORD_LAYOUT Record_BOOLEAN FNC_VALUES 1 UBYTE COLUMN_DIR DIRECT /end RECORD_LAYOUT
/begin RECORD_LAYOUT Record_FLOAT32_IEEE FNC_VALUES 1 FLOAT32_IEEE COLUMN_DIR DIRECT /end RECORD_LAYOUT
/begin RECORD_LAYOUT Record_FLOAT64_IEEE FNC_VALUES 1 FLOAT64_IEEE COLUMN_DIR DIRECT /end RECORD_LAYOUT
/begin RECORD_LAYOUT Record_UBYTE FNC_VALUES 1 UBYTE COLUMN_DIR DIRECT /end RECORD_LAYOUT
/begin RECORD_LAYOUT Record_UWORD FNC_VALUES 1 UWORD COLUMN_DIR DIRECT /end RECORD_LAYOUT
/begin RECORD_LAYOUT Axis_FLOAT32_IEEE AXIS_PTS_X 1 FLOAT32_IEEE INDEX_INCR DIRECT /end RECORD_LAYOUT
/end MODULE
/end PROJECT
