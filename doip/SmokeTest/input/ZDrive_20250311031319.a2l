ASAP2_VERSION 1 71
/begin PROJECT ProjectName ""
/begin MODULE ModuleName ""
/begin MOD_COMMON "" BYTE_ORDER MSB_LAST ALIGNMENT_BYTE 1 ALIGNMENT_WORD 1 ALIGNMENT_LONG 1 ALIGNMENT_INT64 1 ALIGNMENT_FLOAT16_IEEE 1 ALIGNMENT_FLOAT32_IEEE 1 ALIGNMENT_FLOAT64_IEEE 1 /end MOD_COMMON
/begin RECORD_LAYOUT __A_INT64_S FNC_VALUES 1 A_INT64 COLUMN_DIR DIRECT /end RECORD_LAYOUT
/begin RECORD_LAYOUT SSV__A_UINT64_S AXIS_PTS_X 1 A_UINT64 INDEX_INCR DIRECT /end RECORD_LAYOUT
/begin RECORD_LAYOUT Record_BOOLEAN FNC_VALUES 1 UBYTE COLUMN_DIR DIRECT /end RECORD_LAYOUT
/begin RECORD_LAYOUT Record_FLOAT32_IEEE FNC_VALUES 1 FLOAT32_IEEE COLUMN_DIR DIRECT /end RECORD_LAYOUT
/begin RECORD_LAYOUT Record_FLOAT64_IEEE FNC_VALUES 1 FLOAT64_IEEE COLUMN_DIR DIRECT /end RECORD_LAYOUT
/begin RECORD_LAYOUT Record_UBYTE FNC_VALUES 1 UBYTE COLUMN_DIR DIRECT /end RECORD_LAYOUT
/begin RECORD_LAYOUT Axis_FLOAT32_IEEE AXIS_PTS_X 1 FLOAT32_IEEE INDEX_INCR DIRECT /end RECORD_LAYOUT
/begin RECORD_LAYOUT Record_BOOLEAN FNC_VALUES 1 UBYTE COLUMN_DIR DIRECT /end RECORD_LAYOUT
/begin RECORD_LAYOUT Record_FLOAT32_IEEE FNC_VALUES 1 FLOAT32_IEEE COLUMN_DIR DIRECT /end RECORD_LAYOUT
/begin RECORD_LAYOUT Record_UBYTE FNC_VALUES 1 UBYTE COLUMN_DIR DIRECT /end RECORD_LAYOUT
/begin RECORD_LAYOUT Axis_FLOAT32_IEEE AXIS_PTS_X 1 FLOAT32_IEEE INDEX_INCR DIRECT /end RECORD_LAYOUT
/begin RECORD_LAYOUT Record_BOOLEAN FNC_VALUES 1 UBYTE COLUMN_DIR DIRECT /end RECORD_LAYOUT
/begin RECORD_LAYOUT Record_FLOAT32_IEEE FNC_VALUES 1 FLOAT32_IEEE COLUMN_DIR DIRECT /end RECORD_LAYOUT
/begin RECORD_LAYOUT Record_FLOAT64_IEEE FNC_VALUES 1 FLOAT64_IEEE COLUMN_DIR DIRECT /end RECORD_LAYOUT
/begin RECORD_LAYOUT Record_UBYTE FNC_VALUES 1 UBYTE COLUMN_DIR DIRECT /end RECORD_LAYOUT
/begin RECORD_LAYOUT Record_BOOLEAN FNC_VALUES 1 UBYTE COLUMN_DIR DIRECT /end RECORD_LAYOUT
/begin RECORD_LAYOUT Record_FLOAT32_IEEE FNC_VALUES 1 FLOAT32_IEEE COLUMN_DIR DIRECT /end RECORD_LAYOUT
/begin RECORD_LAYOUT Record_UBYTE FNC_VALUES 1 UBYTE COLUMN_DIR DIRECT /end RECORD_LAYOUT
/begin RECORD_LAYOUT Axis_FLOAT32_IEEE AXIS_PTS_X 1 FLOAT32_IEEE INDEX_INCR DIRECT /end RECORD_LAYOUT
/begin RECORD_LAYOUT Record_BOOLEAN FNC_VALUES 1 UBYTE COLUMN_DIR DIRECT /end RECORD_LAYOUT
/begin RECORD_LAYOUT Record_FLOAT32_IEEE FNC_VALUES 1 FLOAT32_IEEE COLUMN_DIR DIRECT /end RECORD_LAYOUT
/begin RECORD_LAYOUT Record_FLOAT64_IEEE FNC_VALUES 1 FLOAT64_IEEE COLUMN_DIR DIRECT /end RECORD_LAYOUT
/begin RECORD_LAYOUT Record_UBYTE FNC_VALUES 1 UBYTE COLUMN_DIR DIRECT /end RECORD_LAYOUT
/begin RECORD_LAYOUT Axis_FLOAT32_IEEE AXIS_PTS_X 1 FLOAT32_IEEE INDEX_INCR DIRECT /end RECORD_LAYOUT
/begin RECORD_LAYOUT Record_BOOLEAN FNC_VALUES 1 UBYTE COLUMN_DIR DIRECT /end RECORD_LAYOUT
/begin RECORD_LAYOUT Record_FLOAT32_IEEE FNC_VALUES 1 FLOAT32_IEEE COLUMN_DIR DIRECT /end RECORD_LAYOUT
/begin RECORD_LAYOUT Record_FLOAT64_IEEE FNC_VALUES 1 FLOAT64_IEEE COLUMN_DIR DIRECT /end RECORD_LAYOUT
/begin RECORD_LAYOUT Record_UBYTE FNC_VALUES 1 UBYTE COLUMN_DIR DIRECT /end RECORD_LAYOUT
/begin RECORD_LAYOUT Axis_FLOAT32_IEEE AXIS_PTS_X 1 FLOAT32_IEEE INDEX_INCR DIRECT /end RECORD_LAYOUT
/begin RECORD_LAYOUT Record_BOOLEAN FNC_VALUES 1 UBYTE COLUMN_DIR DIRECT /end RECORD_LAYOUT
/begin RECORD_LAYOUT Record_FLOAT32_IEEE FNC_VALUES 1 FLOAT32_IEEE COLUMN_DIR DIRECT /end RECORD_LAYOUT
/begin RECORD_LAYOUT Record_FLOAT64_IEEE FNC_VALUES 1 FLOAT64_IEEE COLUMN_DIR DIRECT /end RECORD_LAYOUT
/begin RECORD_LAYOUT Record_UBYTE FNC_VALUES 1 UBYTE COLUMN_DIR DIRECT /end RECORD_LAYOUT
/begin CHARACTERISTIC P_LATC_A0_Dis_Factor "" CURVE 0xfe822afc /* @ECU_Address@P_LATC_A0_Dis_Factor@ */ Record_FLOAT32_IEEE 0 autosar_swc_vmc_CM_single -3.4E+38 3.4E+38
 /begin AXIS_DESCR COM_AXIS NO_INPUT_QUANTITY autosar_swc_vmc_CM_single 19 -3.4E+38 3.4E+38 AXIS_PTS_REF P_LATC_A0_Dis_BP /end AXIS_DESCR
/end CHARACTERISTIC
/begin CHARACTERISTIC P_LATC_A2S_FliterTime "" VALUE 0xfe821ff0 /* @ECU_Address@P_LATC_A2S_FliterTime@ */ Record_FLOAT32_IEEE 0 autosar_swc_vmc_CM_single -3.4E+38 3.4E+38 /end CHARACTERISTIC
/begin CHARACTERISTIC P_LATC_A2_CurrentOffsetFliterTime "" CURVE 0xfe822138 /* @ECU_Address@P_LATC_A2_CurrentOffsetFliterTime@ */ Record_FLOAT32_IEEE 0 autosar_swc_vmc_CM_single -3.4E+38 3.4E+38
 /begin AXIS_DESCR COM_AXIS NO_INPUT_QUANTITY autosar_swc_vmc_CM_single 10 -3.4E+38 3.4E+38 AXIS_PTS_REF P_LATC_A2_Curve_BP /end AXIS_DESCR
/end CHARACTERISTIC
/begin CHARACTERISTIC P_LATC_A2_Pretime "" VALUE 0xfe821ff4 /* @ECU_Address@P_LATC_A2_Pretime@ */ Record_FLOAT32_IEEE 0 autosar_swc_vmc_CM_single -3.4E+38 3.4E+38 /end CHARACTERISTIC
/begin CHARACTERISTIC P_LATC_AngCmdVld_UpTriggerHoldNum "" VALUE 0xfe822124 /* @ECU_Address@P_LATC_AngCmdVld_UpTriggerHoldNum@ */ Record_UBYTE 0 autosar_swc_vmc_CM_uint8 0 255 /end CHARACTERISTIC
/begin CHARACTERISTIC P_LATC_AngCmdVld_UpTriggerHoldNumSW "" VALUE 0xfe822125 /* @ECU_Address@P_LATC_AngCmdVld_UpTriggerHoldNumSW@ */ Record_BOOLEAN 0 autosar_swc_vmc_CM_boolean 0 1 /end CHARACTERISTIC
/begin CHARACTERISTIC P_LATC_Ang_max "" CURVE 0xfe822640 /* @ECU_Address@P_LATC_Ang_max@ */ Record_FLOAT32_IEEE 0 autosar_swc_vmc_CM_single -3.4E+38 3.4E+38
 /begin AXIS_DESCR COM_AXIS LATC_DisplaySpd_kph autosar_swc_vmc_CM_single 15 -3.4E+38 3.4E+38 AXIS_PTS_REF P_LATC_Ang_spd /end AXIS_DESCR
/end CHARACTERISTIC
/begin CHARACTERISTIC P_LATC_Ang_slopemax "" CURVE 0xfe82267c /* @ECU_Address@P_LATC_Ang_slopemax@ */ Record_FLOAT32_IEEE 0 autosar_swc_vmc_CM_single -3.4E+38 3.4E+38
 /begin AXIS_DESCR COM_AXIS LATC_DisplaySpd_kph autosar_swc_vmc_CM_single 15 -3.4E+38 3.4E+38 AXIS_PTS_REF P_LATC_Ang_spd /end AXIS_DESCR
/end CHARACTERISTIC
/begin CHARACTERISTIC P_LATC_AngleFilterTime "" CURVE 0xfe822b48 /* @ECU_Address@P_LATC_AngleFilterTime@ */ Record_FLOAT32_IEEE 0 autosar_swc_vmc_CM_single -3.4E+38 3.4E+38
 /begin AXIS_DESCR COM_AXIS NO_INPUT_QUANTITY autosar_swc_vmc_CM_single 19 -3.4E+38 3.4E+38 AXIS_PTS_REF P_LATC_A0_Dis_BP /end AXIS_DESCR
/end CHARACTERISTIC
/begin CHARACTERISTIC P_LATC_AngleFilterTime_LC "" CURVE 0xfe822b94 /* @ECU_Address@P_LATC_AngleFilterTime_LC@ */ Record_FLOAT32_IEEE 0 autosar_swc_vmc_CM_single -3.4E+38 3.4E+38
 /begin AXIS_DESCR COM_AXIS NO_INPUT_QUANTITY autosar_swc_vmc_CM_single 19 -3.4E+38 3.4E+38 AXIS_PTS_REF P_LATC_A0_Dis_BP /end AXIS_DESCR
/end CHARACTERISTIC
/begin CHARACTERISTIC P_LATC_AngleFilterTime_LSS "" CURVE 0xfe822be0 /* @ECU_Address@P_LATC_AngleFilterTime_LSS@ */ Record_FLOAT32_IEEE 0 autosar_swc_vmc_CM_single -3.4E+38 3.4E+38
 /begin AXIS_DESCR COM_AXIS NO_INPUT_QUANTITY autosar_swc_vmc_CM_single 19 -3.4E+38 3.4E+38 AXIS_PTS_REF P_LATC_A0_Dis_BP /end AXIS_DESCR
/end CHARACTERISTIC
/begin CHARACTERISTIC P_LATC_AngleSlope_AES_Active "" MAP 0xfe822c2c /* @ECU_Address@P_LATC_AngleSlope_AES_Active@ */ Record_FLOAT32_IEEE 0 autosar_swc_vmc_CM_single -3.4E+38 3.4E+38
 /begin AXIS_DESCR COM_AXIS LATC_DisplaySpd_kph autosar_swc_vmc_CM_single 12 -3.4E+38 3.4E+38 AXIS_PTS_REF P_LATC_AngleSlope_Spd_BP /end AXIS_DESCR
 /begin AXIS_DESCR COM_AXIS NO_INPUT_QUANTITY autosar_swc_vmc_CM_single 19 -3.4E+38 3.4E+38 AXIS_PTS_REF P_LATC_A0_Dis_BP /end AXIS_DESCR
/end CHARACTERISTIC
/begin CHARACTERISTIC P_LATC_AngleSlope_DOP "" MAP 0xfe822fbc /* @ECU_Address@P_LATC_AngleSlope_DOP@ */ Record_FLOAT32_IEEE 0 autosar_swc_vmc_CM_single -3.4E+38 3.4E+38
 /begin AXIS_DESCR COM_AXIS LATC_DisplaySpd_kph autosar_swc_vmc_CM_single 12 -3.4E+38 3.4E+38 AXIS_PTS_REF P_LATC_AngleSlope_Spd_BP /end AXIS_DESCR
 /begin AXIS_DESCR COM_AXIS NO_INPUT_QUANTITY autosar_swc_vmc_CM_single 19 -3.4E+38 3.4E+38 AXIS_PTS_REF P_LATC_A0_Dis_BP /end AXIS_DESCR
/end CHARACTERISTIC
/begin CHARACTERISTIC P_LATC_AngleSlope_ELK "" MAP 0xfe82334c /* @ECU_Address@P_LATC_AngleSlope_ELK@ */ Record_FLOAT32_IEEE 0 autosar_swc_vmc_CM_single -3.4E+38 3.4E+38
 /begin AXIS_DESCR COM_AXIS LATC_DisplaySpd_kph autosar_swc_vmc_CM_single 12 -3.4E+38 3.4E+38 AXIS_PTS_REF P_LATC_AngleSlope_Spd_BP /end AXIS_DESCR
 /begin AXIS_DESCR COM_AXIS NO_INPUT_QUANTITY autosar_swc_vmc_CM_single 19 -3.4E+38 3.4E+38 AXIS_PTS_REF P_LATC_A0_Dis_BP /end AXIS_DESCR
/end CHARACTERISTIC
/begin CHARACTERISTIC P_LATC_AngleSlope_LC "" MAP 0xfe8236dc /* @ECU_Address@P_LATC_AngleSlope_LC@ */ Record_FLOAT32_IEEE 0 autosar_swc_vmc_CM_single -3.4E+38 3.4E+38
 /begin AXIS_DESCR COM_AXIS LATC_DisplaySpd_kph autosar_swc_vmc_CM_single 12 -3.4E+38 3.4E+38 AXIS_PTS_REF P_LATC_AngleSlope_Spd_BP /end AXIS_DESCR
 /begin AXIS_DESCR COM_AXIS NO_INPUT_QUANTITY autosar_swc_vmc_CM_single 19 -3.4E+38 3.4E+38 AXIS_PTS_REF P_LATC_A0_Dis_BP /end AXIS_DESCR
/end CHARACTERISTIC
/begin CHARACTERISTIC P_LATC_AngleSlope_LCK "" MAP 0xfe823a6c /* @ECU_Address@P_LATC_AngleSlope_LCK@ */ Record_FLOAT32_IEEE 0 autosar_swc_vmc_CM_single -3.4E+38 3.4E+38
 /begin AXIS_DESCR COM_AXIS LATC_DisplaySpd_kph autosar_swc_vmc_CM_single 12 -3.4E+38 3.4E+38 AXIS_PTS_REF P_LATC_AngleSlope_Spd_BP /end AXIS_DESCR
 /begin AXIS_DESCR COM_AXIS NO_INPUT_QUANTITY autosar_swc_vmc_CM_single 19 -3.4E+38 3.4E+38 AXIS_PTS_REF P_LATC_A0_Dis_BP /end AXIS_DESCR
/end CHARACTERISTIC
/begin CHARACTERISTIC P_LATC_AngleSlope_LCK_Curve_Fac "" CURVE 0xfe822188 /* @ECU_Address@P_LATC_AngleSlope_LCK_Curve_Fac@ */ Record_FLOAT32_IEEE 0 autosar_swc_vmc_CM_single -3.4E+38 3.4E+38
 /begin AXIS_DESCR COM_AXIS LATC_Predis_Curve autosar_swc_vmc_CM_single 10 -3.4E+38 3.4E+38 AXIS_PTS_REF P_LATC_A2_Curve_BP /end AXIS_DESCR
/end CHARACTERISTIC
/begin CHARACTERISTIC P_LATC_AngleSlope_LCMiddle "" MAP 0xfe823dfc /* @ECU_Address@P_LATC_AngleSlope_LCMiddle@ */ Record_FLOAT32_IEEE 0 autosar_swc_vmc_CM_single -3.4E+38 3.4E+38
 /begin AXIS_DESCR COM_AXIS LATC_DisplaySpd_kph autosar_swc_vmc_CM_single 12 -3.4E+38 3.4E+38 AXIS_PTS_REF P_LATC_AngleSlope_Spd_BP /end AXIS_DESCR
 /begin AXIS_DESCR COM_AXIS NO_INPUT_QUANTITY autosar_swc_vmc_CM_single 19 -3.4E+38 3.4E+38 AXIS_PTS_REF P_LATC_A0_Dis_BP /end AXIS_DESCR
/end CHARACTERISTIC
/begin CHARACTERISTIC P_LATC_AngleSlope_LCSoft "" MAP 0xfe82418c /* @ECU_Address@P_LATC_AngleSlope_LCSoft@ */ Record_FLOAT32_IEEE 0 autosar_swc_vmc_CM_single -3.4E+38 3.4E+38
 /begin AXIS_DESCR COM_AXIS LATC_DisplaySpd_kph autosar_swc_vmc_CM_single 12 -3.4E+38 3.4E+38 AXIS_PTS_REF P_LATC_AngleSlope_Spd_BP /end AXIS_DESCR
 /begin AXIS_DESCR COM_AXIS NO_INPUT_QUANTITY autosar_swc_vmc_CM_single 19 -3.4E+38 3.4E+38 AXIS_PTS_REF P_LATC_A0_Dis_BP /end AXIS_DESCR
/end CHARACTERISTIC
/begin CHARACTERISTIC P_LATC_AngleSlope_LC_Cancel "" MAP 0xfe82451c /* @ECU_Address@P_LATC_AngleSlope_LC_Cancel@ */ Record_FLOAT32_IEEE 0 autosar_swc_vmc_CM_single -3.4E+38 3.4E+38
 /begin AXIS_DESCR COM_AXIS LATC_DisplaySpd_kph autosar_swc_vmc_CM_single 12 -3.4E+38 3.4E+38 AXIS_PTS_REF P_LATC_AngleSlope_Spd_BP /end AXIS_DESCR
 /begin AXIS_DESCR COM_AXIS NO_INPUT_QUANTITY autosar_swc_vmc_CM_single 19 -3.4E+38 3.4E+38 AXIS_PTS_REF P_LATC_A0_Dis_BP /end AXIS_DESCR
/end CHARACTERISTIC
/begin CHARACTERISTIC P_LATC_AngleSlope_LKA "" MAP 0xfe8248ac /* @ECU_Address@P_LATC_AngleSlope_LKA@ */ Record_FLOAT32_IEEE 0 autosar_swc_vmc_CM_single -3.4E+38 3.4E+38
 /begin AXIS_DESCR COM_AXIS LATC_DisplaySpd_kph autosar_swc_vmc_CM_single 12 -3.4E+38 3.4E+38 AXIS_PTS_REF P_LATC_AngleSlope_Spd_BP /end AXIS_DESCR
 /begin AXIS_DESCR COM_AXIS NO_INPUT_QUANTITY autosar_swc_vmc_CM_single 19 -3.4E+38 3.4E+38 AXIS_PTS_REF P_LATC_A0_Dis_BP /end AXIS_DESCR
/end CHARACTERISTIC
/begin CHARACTERISTIC P_LATC_AngleSlope_Split "" MAP 0xfe824c3c /* @ECU_Address@P_LATC_AngleSlope_Split@ */ Record_FLOAT32_IEEE 0 autosar_swc_vmc_CM_single -3.4E+38 3.4E+38
 /begin AXIS_DESCR COM_AXIS LATC_DisplaySpd_kph autosar_swc_vmc_CM_single 12 -3.4E+38 3.4E+38 AXIS_PTS_REF P_LATC_AngleSlope_Spd_BP /end AXIS_DESCR
 /begin AXIS_DESCR COM_AXIS NO_INPUT_QUANTITY autosar_swc_vmc_CM_single 19 -3.4E+38 3.4E+38 AXIS_PTS_REF P_LATC_A0_Dis_BP /end AXIS_DESCR
/end CHARACTERISTIC
/begin CHARACTERISTIC P_LATC_AyLimitTime "" VALUE 0xfe821ff8 /* @ECU_Address@P_LATC_AyLimitTime@ */ Record_FLOAT32_IEEE 0 autosar_swc_vmc_CM_single -3.4E+38 3.4E+38 /end CHARACTERISTIC
/begin CHARACTERISTIC P_LATC_AyLimitVal "" VALUE 0xfe821ffc /* @ECU_Address@P_LATC_AyLimitVal@ */ Record_FLOAT32_IEEE 0 autosar_swc_vmc_CM_single -3.4E+38 3.4E+38 /end CHARACTERISTIC
/begin CHARACTERISTIC P_LATC_CurOffsetA2_FliterTime "" VALUE 0xfe822000 /* @ECU_Address@P_LATC_CurOffsetA2_FliterTime@ */ Record_FLOAT32_IEEE 0 autosar_swc_vmc_CM_single -3.4E+38 3.4E+38 /end CHARACTERISTIC
/begin CHARACTERISTIC P_LATC_CurOffsetVIEOffset_SW "" VALUE 0xfe822126 /* @ECU_Address@P_LATC_CurOffsetVIEOffset_SW@ */ Record_BOOLEAN 0 autosar_swc_vmc_CM_boolean 0 1 /end CHARACTERISTIC
/begin CHARACTERISTIC P_LATC_CurOffset_VehicleSpd_LimitValue "" VALUE 0xfe822004 /* @ECU_Address@P_LATC_CurOffset_VehicleSpd_LimitValue@ */ Record_FLOAT32_IEEE 0 autosar_swc_vmc_CM_single -3.4E+38 3.4E+38 /end CHARACTERISTIC
/begin CHARACTERISTIC P_LATC_CurSteerAngleOffsetLimit "" CURVE 0xfe8221e0 /* @ECU_Address@P_LATC_CurSteerAngleOffsetLimit@ */ Record_FLOAT32_IEEE 0 autosar_swc_vmc_CM_single -3.4E+38 3.4E+38
 /begin AXIS_DESCR COM_AXIS NO_INPUT_QUANTITY autosar_swc_vmc_CM_single 10 -3.4E+38 3.4E+38 AXIS_PTS_REF P_LATC_A2_Curve_BP /end AXIS_DESCR
/end CHARACTERISTIC
/begin CHARACTERISTIC P_LATC_DOP_preDis "" CURVE 0xfe822208 /* @ECU_Address@P_LATC_DOP_preDis@ */ Record_FLOAT32_IEEE 0 autosar_swc_vmc_CM_single -3.4E+38 3.4E+38
 /begin AXIS_DESCR COM_AXIS LATC_DisplaySpd_kph autosar_swc_vmc_CM_single 16 -3.4E+38 3.4E+38 AXIS_PTS_REF P_LATC_preDis_spd /end AXIS_DESCR
/end CHARACTERISTIC
/begin CHARACTERISTIC P_LATC_DangerLevelList "" VAL_BLK 0xfe822a9c /* @ECU_Address@P_LATC_DangerLevelList@ */ Record_UBYTE 0 autosar_swc_vmc_CM_uint8 0 255 MATRIX_DIM 11 1 /end CHARACTERISTIC
/begin CHARACTERISTIC P_LATC_DeltaEps_TimeVal "" CURVE 0xfe822288 /* @ECU_Address@P_LATC_DeltaEps_TimeVal@ */ Record_FLOAT32_IEEE 0 autosar_swc_vmc_CM_single -3.4E+38 3.4E+38
 /begin AXIS_DESCR COM_AXIS LATC_DisplaySpd_kph autosar_swc_vmc_CM_single 16 -3.4E+38 3.4E+38 AXIS_PTS_REF P_LATC_DeltaEps_SpdBp /end AXIS_DESCR
/end CHARACTERISTIC
/begin CHARACTERISTIC P_LATC_DesLaneA0_HighLimit "" VALUE 0xfe822008 /* @ECU_Address@P_LATC_DesLaneA0_HighLimit@ */ Record_FLOAT32_IEEE 0 autosar_swc_vmc_CM_single -3.4E+38 3.4E+38 /end CHARACTERISTIC
/begin CHARACTERISTIC P_LATC_DesLaneA0_LowLimit "" VALUE 0xfe82200c /* @ECU_Address@P_LATC_DesLaneA0_LowLimit@ */ Record_FLOAT32_IEEE 0 autosar_swc_vmc_CM_single -3.4E+38 3.4E+38 /end CHARACTERISTIC
/begin CHARACTERISTIC P_LATC_DxOffestLength "" VALUE 0xfe822010 /* @ECU_Address@P_LATC_DxOffestLength@ */ Record_FLOAT32_IEEE 0 autosar_swc_vmc_CM_single -3.4E+38 3.4E+38 /end CHARACTERISTIC
/begin CHARACTERISTIC P_LATC_EPSNotActiveSpdValue "" VALUE 0xfe822014 /* @ECU_Address@P_LATC_EPSNotActiveSpdValue@ */ Record_FLOAT32_IEEE 0 autosar_swc_vmc_CM_single -3.4E+38 3.4E+38 /end CHARACTERISTIC
/begin CHARACTERISTIC P_LATC_EffectSW "" VALUE 0xfe822127 /* @ECU_Address@P_LATC_EffectSW@ */ Record_BOOLEAN 0 autosar_swc_vmc_CM_boolean 0 1 /end CHARACTERISTIC
/begin CHARACTERISTIC P_LATC_FeedbackAngleSlope_Gain "" CURVE 0xfe82273c /* @ECU_Address@P_LATC_FeedbackAngleSlope_Gain@ */ Record_FLOAT32_IEEE 0 autosar_swc_vmc_CM_single -3.4E+38 3.4E+38
 /begin AXIS_DESCR COM_AXIS NO_INPUT_QUANTITY autosar_swc_vmc_CM_single 9 -3.4E+38 3.4E+38 AXIS_PTS_REF P_LATC_FeedbackAngleSlope_Ang /end AXIS_DESCR
/end CHARACTERISTIC
/begin CHARACTERISTIC P_LATC_FeedbackAngleSlope_SW "" VALUE 0xfe822128 /* @ECU_Address@P_LATC_FeedbackAngleSlope_SW@ */ Record_BOOLEAN 0 autosar_swc_vmc_CM_boolean 0 1 /end CHARACTERISTIC
/begin CHARACTERISTIC P_LATC_LATC_Effect "" MAP 0xfe824fcc /* @ECU_Address@P_LATC_LATC_Effect@ */ Record_FLOAT32_IEEE 0 autosar_swc_vmc_CM_single -3.4E+38 3.4E+38
 /begin AXIS_DESCR COM_AXIS NO_INPUT_QUANTITY autosar_swc_vmc_CM_single 9 -3.4E+38 3.4E+38 AXIS_PTS_REF P_LATC_DesLaneA1 /end AXIS_DESCR
 /begin AXIS_DESCR COM_AXIS NO_INPUT_QUANTITY autosar_swc_vmc_CM_single 8 -3.4E+38 3.4E+38 AXIS_PTS_REF P_LATC_DesLaneA0 /end AXIS_DESCR
/end CHARACTERISTIC
/begin CHARACTERISTIC P_LATC_LCKPreDisFac_Switch "" VALUE 0xfe822129 /* @ECU_Address@P_LATC_LCKPreDisFac_Switch@ */ Record_UBYTE 0 autosar_swc_vmc_CM_uint8 0 255 /end CHARACTERISTIC
/begin CHARACTERISTIC P_LATC_LCK_preDis_Nomal "" CURVE 0xfe8222e8 /* @ECU_Address@P_LATC_LCK_preDis_Nomal@ */ Record_FLOAT32_IEEE 0 autosar_swc_vmc_CM_single -3.4E+38 3.4E+38
 /begin AXIS_DESCR COM_AXIS LATC_DisplaySpd_kph autosar_swc_vmc_CM_single 16 -3.4E+38 3.4E+38 AXIS_PTS_REF P_LATC_preDis_spd /end AXIS_DESCR
/end CHARACTERISTIC
/begin CHARACTERISTIC P_LATC_LC_Complete_PreDisFac "" CURVE 0xfe822760 /* @ECU_Address@P_LATC_LC_Complete_PreDisFac@ */ Record_FLOAT32_IEEE 0 autosar_swc_vmc_CM_single -3.4E+38 3.4E+38
 /begin AXIS_DESCR COM_AXIS LATC_HoldTime autosar_swc_vmc_CM_single 15 -3.4E+38 3.4E+38 AXIS_PTS_REF P_LATC_StateActive_HoldTime_BP /end AXIS_DESCR
/end CHARACTERISTIC
/begin CHARACTERISTIC P_LATC_LaneBigJumpActiveA0Limit "" VALUE 0xfe822018 /* @ECU_Address@P_LATC_LaneBigJumpActiveA0Limit@ */ Record_FLOAT32_IEEE 0 autosar_swc_vmc_CM_single -3.4E+38 3.4E+38 /end CHARACTERISTIC
/begin CHARACTERISTIC P_LATC_LaneBigJumpDeActiveA0Limit "" VALUE 0xfe82201c /* @ECU_Address@P_LATC_LaneBigJumpDeActiveA0Limit@ */ Record_FLOAT32_IEEE 0 autosar_swc_vmc_CM_single -3.4E+38 3.4E+38 /end CHARACTERISTIC
/begin CHARACTERISTIC P_LATC_LaneJumpActiveA0Limit "" VALUE 0xfe822020 /* @ECU_Address@P_LATC_LaneJumpActiveA0Limit@ */ Record_FLOAT32_IEEE 0 autosar_swc_vmc_CM_single -3.4E+38 3.4E+38 /end CHARACTERISTIC
/begin CHARACTERISTIC P_LATC_LaneJumpActivePointLimit "" VALUE 0xfe822024 /* @ECU_Address@P_LATC_LaneJumpActivePointLimit@ */ Record_FLOAT32_IEEE 0 autosar_swc_vmc_CM_single -3.4E+38 3.4E+38 /end CHARACTERISTIC
/begin CHARACTERISTIC P_LATC_LaneJumpAngleSlopeGainSwitch "" VALUE 0xfe82212a /* @ECU_Address@P_LATC_LaneJumpAngleSlopeGainSwitch@ */ Record_BOOLEAN 0 autosar_swc_vmc_CM_boolean 0 1 /end CHARACTERISTIC
/begin CHARACTERISTIC P_LATC_LaneJumpDeActivePointLimit "" VALUE 0xfe822028 /* @ECU_Address@P_LATC_LaneJumpDeActivePointLimit@ */ Record_FLOAT32_IEEE 0 autosar_swc_vmc_CM_single -3.4E+38 3.4E+38 /end CHARACTERISTIC
/begin CHARACTERISTIC P_LATC_LatcEffectC0Val "" VALUE 0xfe82202c /* @ECU_Address@P_LATC_LatcEffectC0Val@ */ Record_FLOAT32_IEEE 0 autosar_swc_vmc_CM_single -3.4E+38 3.4E+38 /end CHARACTERISTIC
/begin CHARACTERISTIC P_LATC_LatcEffectDisVal "" VALUE 0xfe822030 /* @ECU_Address@P_LATC_LatcEffectDisVal@ */ Record_FLOAT32_IEEE 0 autosar_swc_vmc_CM_single -3.4E+38 3.4E+38 /end CHARACTERISTIC
/begin CHARACTERISTIC P_LATC_LatcEffectVal "" VALUE 0xfe822034 /* @ECU_Address@P_LATC_LatcEffectVal@ */ Record_FLOAT32_IEEE 0 autosar_swc_vmc_CM_single -3.4E+38 3.4E+38 /end CHARACTERISTIC
/begin CHARACTERISTIC P_LATC_LinePreViewCurveSW "" VALUE 0xfe82212b /* @ECU_Address@P_LATC_LinePreViewCurveSW@ */ Record_BOOLEAN 0 autosar_swc_vmc_CM_boolean 0 1 /end CHARACTERISTIC
/begin CHARACTERISTIC P_LATC_LinePreviewWithCurve_T "" MAP 0xfe8250ec /* @ECU_Address@P_LATC_LinePreviewWithCurve_T@ */ Record_FLOAT32_IEEE 0 autosar_swc_vmc_CM_single -3.4E+38 3.4E+38
 /begin AXIS_DESCR COM_AXIS LATC_DisplaySpd_kph autosar_swc_vmc_CM_single 15 -3.4E+38 3.4E+38 AXIS_PTS_REF P_LATC_LinePreView_spd /end AXIS_DESCR
 /begin AXIS_DESCR COM_AXIS LATC_PreViewPointsCurve autosar_swc_vmc_CM_single 10 -3.4E+38 3.4E+38 AXIS_PTS_REF P_LATC_A2_Curve_BP /end AXIS_DESCR
/end CHARACTERISTIC
/begin CHARACTERISTIC P_LATC_LinePreview_T "" CURVE 0xfe822328 /* @ECU_Address@P_LATC_LinePreview_T@ */ Record_FLOAT32_IEEE 0 autosar_swc_vmc_CM_single -3.4E+38 3.4E+38
 /begin AXIS_DESCR COM_AXIS LATC_DisplaySpd_kph autosar_swc_vmc_CM_single 16 -3.4E+38 3.4E+38 AXIS_PTS_REF P_LATC_preDis_spd /end AXIS_DESCR
/end CHARACTERISTIC
/begin CHARACTERISTIC P_LATC_OUT_AngCmdReqValVld_TestFlg "" VALUE 0xfe82212c /* @ECU_Address@P_LATC_OUT_AngCmdReqValVld_TestFlg@ */ Record_UBYTE 0 autosar_swc_vmc_CM_uint8 0 255 /end CHARACTERISTIC
/begin CHARACTERISTIC P_LATC_OUT_AngCmdReqValVld_TestSW "" VALUE 0xfe82212d /* @ECU_Address@P_LATC_OUT_AngCmdReqValVld_TestSW@ */ Record_BOOLEAN 0 autosar_swc_vmc_CM_boolean 0 1 /end CHARACTERISTIC
/begin CHARACTERISTIC P_LATC_OUT_AngCmdReqVal_TestSW "" VALUE 0xfe82212e /* @ECU_Address@P_LATC_OUT_AngCmdReqVal_TestSW@ */ Record_UBYTE 0 autosar_swc_vmc_CM_uint8 0 255 /end CHARACTERISTIC
/begin CHARACTERISTIC P_LATC_OUT_AngCmdReqVal_TestValue "" VALUE 0xfe822038 /* @ECU_Address@P_LATC_OUT_AngCmdReqVal_TestValue@ */ Record_FLOAT32_IEEE 0 autosar_swc_vmc_CM_single -3.4E+38 3.4E+38 /end CHARACTERISTIC
/begin CHARACTERISTIC P_LATC_OffsetError_Fac "" CURVE 0xfe822408 /* @ECU_Address@P_LATC_OffsetError_Fac@ */ Record_FLOAT32_IEEE 0 autosar_swc_vmc_CM_single -3.4E+38 3.4E+38
 /begin AXIS_DESCR COM_AXIS LATC_CurOffsetError autosar_swc_vmc_CM_single 8 -3.4E+38 3.4E+38 AXIS_PTS_REF P_LATC_OffsetError_BP /end AXIS_DESCR
/end CHARACTERISTIC
/begin CHARACTERISTIC P_LATC_PreViewPoints_T "" VALUE 0xfe82203c /* @ECU_Address@P_LATC_PreViewPoints_T@ */ Record_FLOAT32_IEEE 0 autosar_swc_vmc_CM_single -3.4E+38 3.4E+38 /end CHARACTERISTIC
/begin CHARACTERISTIC P_LATC_StateActiv_AngleSlope "" MAP 0xfe825344 /* @ECU_Address@P_LATC_StateActiv_AngleSlope@ */ Record_FLOAT32_IEEE 0 autosar_swc_vmc_CM_single -3.4E+38 3.4E+38
 /begin AXIS_DESCR COM_AXIS LATC_HoldTime autosar_swc_vmc_CM_single 15 -3.4E+38 3.4E+38 AXIS_PTS_REF P_LATC_StateActive_HoldTime_BP /end AXIS_DESCR
 /begin AXIS_DESCR COM_AXIS LATC_AngleSlope_Flg autosar_swc_vmc_CM_uint8 9 0 255 AXIS_PTS_REF P_LATC_StateActiveFlg_BP /end AXIS_DESCR
/end CHARACTERISTIC
/begin CHARACTERISTIC P_LATC_StateComplete_AngleSlope "" CURVE 0xfe822814 /* @ECU_Address@P_LATC_StateComplete_AngleSlope@ */ Record_FLOAT32_IEEE 0 autosar_swc_vmc_CM_single -3.4E+38 3.4E+38
 /begin AXIS_DESCR COM_AXIS LATC_HoldTime autosar_swc_vmc_CM_single 15 -3.4E+38 3.4E+38 AXIS_PTS_REF P_LATC_StateActive_HoldTime_BP /end AXIS_DESCR
/end CHARACTERISTIC
/begin CHARACTERISTIC P_LATC_SteerAngleOffset_VirSwitch "" VALUE 0xfe821fc0 /* @ECU_Address@P_LATC_SteerAngleOffset_VirSwitch@ */ Record_FLOAT64_IEEE 0 autosar_swc_vmc_CM_double -1.7E+308 1.7E+308 /end CHARACTERISTIC
/begin CHARACTERISTIC P_LATC_SteerAngleOffset_VirValue "" VALUE 0xfe821fc8 /* @ECU_Address@P_LATC_SteerAngleOffset_VirValue@ */ Record_FLOAT64_IEEE 0 autosar_swc_vmc_CM_double -1.7E+308 1.7E+308 /end CHARACTERISTIC
/begin CHARACTERISTIC P_LATC_StepTime "" VALUE 0xfe82204c /* @ECU_Address@P_LATC_StepTime@ */ Record_FLOAT32_IEEE 0 autosar_swc_vmc_CM_single -3.4E+38 3.4E+38 /end CHARACTERISTIC
/begin CHARACTERISTIC P_LATC_TarLineC1_Slope_Active "" CURVE 0xfe82286c /* @ECU_Address@P_LATC_TarLineC1_Slope_Active@ */ Record_FLOAT32_IEEE 0 autosar_swc_vmc_CM_single -3.4E+38 3.4E+38
 /begin AXIS_DESCR COM_AXIS NO_INPUT_QUANTITY autosar_swc_vmc_CM_single 7 -3.4E+38 3.4E+38 AXIS_PTS_REF P_LATC_TarLineC1_Slope /end AXIS_DESCR
/end CHARACTERISTIC
/begin CHARACTERISTIC P_LATC_TarLineDelaySW "" VALUE 0xfe822130 /* @ECU_Address@P_LATC_TarLineDelaySW@ */ Record_BOOLEAN 0 autosar_swc_vmc_CM_boolean 0 1 /end CHARACTERISTIC
/begin CHARACTERISTIC P_LATC_YawRateLimitTime "" VALUE 0xfe822050 /* @ECU_Address@P_LATC_YawRateLimitTime@ */ Record_FLOAT32_IEEE 0 autosar_swc_vmc_CM_single -3.4E+38 3.4E+38 /end CHARACTERISTIC
/begin CHARACTERISTIC P_LATC_YawRateLimitVal "" VALUE 0xfe822054 /* @ECU_Address@P_LATC_YawRateLimitVal@ */ Record_FLOAT32_IEEE 0 autosar_swc_vmc_CM_single -3.4E+38 3.4E+38 /end CHARACTERISTIC
/begin CHARACTERISTIC P_LATC_communicationTest "" VALUE 0xfe822131 /* @ECU_Address@P_LATC_communicationTest@ */ Record_BOOLEAN 0 autosar_swc_vmc_CM_boolean 0 1 /end CHARACTERISTIC
/begin CHARACTERISTIC P_LATC_communicationTest_SteerAngleSlopeTest_Enable "" VALUE 0xfe822132 /* @ECU_Address@P_LATC_communicationTest_SteerAngleSlopeTest_Enable@ */ Record_UBYTE 0 autosar_swc_vmc_CM_uint8 0 255 /end CHARACTERISTIC
/begin CHARACTERISTIC P_LATC_communicationTest_SteerAngleSlopeTest_MaxValue "" VALUE 0xfe822058 /* @ECU_Address@P_LATC_communicationTest_SteerAngleSlopeTest_MaxValue@ */ Record_FLOAT32_IEEE 0 autosar_swc_vmc_CM_single -3.4E+38 3.4E+38 /end CHARACTERISTIC
/begin CHARACTERISTIC P_LATC_communicationTest_SteerAngleSlopeTest_MinValue "" VALUE 0xfe82205c /* @ECU_Address@P_LATC_communicationTest_SteerAngleSlopeTest_MinValue@ */ Record_FLOAT32_IEEE 0 autosar_swc_vmc_CM_single -3.4E+38 3.4E+38 /end CHARACTERISTIC
/begin CHARACTERISTIC P_LATC_communicationTest_SteerAngleSlopeTest_Slope "" VALUE 0xfe822060 /* @ECU_Address@P_LATC_communicationTest_SteerAngleSlopeTest_Slope@ */ Record_FLOAT32_IEEE 0 autosar_swc_vmc_CM_single -3.4E+38 3.4E+38 /end CHARACTERISTIC
/begin CHARACTERISTIC P_LATC_preDis_AES_Fac "" MAP 0xfe825f2c /* @ECU_Address@P_LATC_preDis_AES_Fac@ */ Record_FLOAT32_IEEE 0 autosar_swc_vmc_CM_single -3.4E+38 3.4E+38
 /begin AXIS_DESCR COM_AXIS LATC_DisplaySpd_kph autosar_swc_vmc_CM_single 16 -3.4E+38 3.4E+38 AXIS_PTS_REF P_LATC_preDis_spd /end AXIS_DESCR
 /begin AXIS_DESCR COM_AXIS NO_INPUT_QUANTITY autosar_swc_vmc_CM_single 19 -3.4E+38 3.4E+38 AXIS_PTS_REF P_LATC_A0_Dis_BP /end AXIS_DESCR
/end CHARACTERISTIC
/begin CHARACTERISTIC P_LATC_preDis_DOP_Fac "" MAP 0xfe8263ec /* @ECU_Address@P_LATC_preDis_DOP_Fac@ */ Record_FLOAT32_IEEE 0 autosar_swc_vmc_CM_single -3.4E+38 3.4E+38
 /begin AXIS_DESCR COM_AXIS LATC_DisplaySpd_kph autosar_swc_vmc_CM_single 16 -3.4E+38 3.4E+38 AXIS_PTS_REF P_LATC_preDis_spd /end AXIS_DESCR
 /begin AXIS_DESCR COM_AXIS NO_INPUT_QUANTITY autosar_swc_vmc_CM_single 19 -3.4E+38 3.4E+38 AXIS_PTS_REF P_LATC_A0_Dis_BP /end AXIS_DESCR
/end CHARACTERISTIC
/begin CHARACTERISTIC P_LATC_preDis_ELK_Fac "" MAP 0xfe8268ac /* @ECU_Address@P_LATC_preDis_ELK_Fac@ */ Record_FLOAT32_IEEE 0 autosar_swc_vmc_CM_single -3.4E+38 3.4E+38
 /begin AXIS_DESCR COM_AXIS LATC_DisplaySpd_kph autosar_swc_vmc_CM_single 16 -3.4E+38 3.4E+38 AXIS_PTS_REF P_LATC_preDis_spd /end AXIS_DESCR
 /begin AXIS_DESCR COM_AXIS NO_INPUT_QUANTITY autosar_swc_vmc_CM_single 19 -3.4E+38 3.4E+38 AXIS_PTS_REF P_LATC_A0_Dis_BP /end AXIS_DESCR
/end CHARACTERISTIC
/begin CHARACTERISTIC P_LATC_preDis_LCCancle_Fac "" MAP 0xfe826d6c /* @ECU_Address@P_LATC_preDis_LCCancle_Fac@ */ Record_FLOAT32_IEEE 0 autosar_swc_vmc_CM_single -3.4E+38 3.4E+38
 /begin AXIS_DESCR COM_AXIS LATC_DisplaySpd_kph autosar_swc_vmc_CM_single 16 -3.4E+38 3.4E+38 AXIS_PTS_REF P_LATC_preDis_spd /end AXIS_DESCR
 /begin AXIS_DESCR COM_AXIS NO_INPUT_QUANTITY autosar_swc_vmc_CM_single 19 -3.4E+38 3.4E+38 AXIS_PTS_REF P_LATC_A0_Dis_BP /end AXIS_DESCR
/end CHARACTERISTIC
/begin CHARACTERISTIC P_LATC_preDis_LCK_A2Curve_Fac2 "" CURVE 0xfe822428 /* @ECU_Address@P_LATC_preDis_LCK_A2Curve_Fac2@ */ Record_FLOAT32_IEEE 0 autosar_swc_vmc_CM_single -3.4E+38 3.4E+38
 /begin AXIS_DESCR COM_AXIS LATC_Predis_Curve autosar_swc_vmc_CM_single 10 -3.4E+38 3.4E+38 AXIS_PTS_REF P_LATC_A2_Curve_BP /end AXIS_DESCR
/end CHARACTERISTIC
/begin CHARACTERISTIC P_LATC_preDis_LCK_Fac "" MAP 0xfe82722c /* @ECU_Address@P_LATC_preDis_LCK_Fac@ */ Record_FLOAT32_IEEE 0 autosar_swc_vmc_CM_single -3.4E+38 3.4E+38
 /begin AXIS_DESCR COM_AXIS LATC_DisplaySpd_kph autosar_swc_vmc_CM_single 16 -3.4E+38 3.4E+38 AXIS_PTS_REF P_LATC_preDis_spd /end AXIS_DESCR
 /begin AXIS_DESCR COM_AXIS NO_INPUT_QUANTITY autosar_swc_vmc_CM_single 19 -3.4E+38 3.4E+38 AXIS_PTS_REF P_LATC_A0_Dis_BP /end AXIS_DESCR
/end CHARACTERISTIC
/begin CHARACTERISTIC P_LATC_preDis_LC_Middle_Fac "" MAP 0xfe8276ec /* @ECU_Address@P_LATC_preDis_LC_Middle_Fac@ */ Record_FLOAT32_IEEE 0 autosar_swc_vmc_CM_single -3.4E+38 3.4E+38
 /begin AXIS_DESCR COM_AXIS LATC_DisplaySpd_kph autosar_swc_vmc_CM_single 16 -3.4E+38 3.4E+38 AXIS_PTS_REF P_LATC_preDis_spd /end AXIS_DESCR
 /begin AXIS_DESCR COM_AXIS NO_INPUT_QUANTITY autosar_swc_vmc_CM_single 19 -3.4E+38 3.4E+38 AXIS_PTS_REF P_LATC_A0_Dis_BP /end AXIS_DESCR
/end CHARACTERISTIC
/begin CHARACTERISTIC P_LATC_preDis_LC_Nomal_Fac "" MAP 0xfe827bac /* @ECU_Address@P_LATC_preDis_LC_Nomal_Fac@ */ Record_FLOAT32_IEEE 0 autosar_swc_vmc_CM_single -3.4E+38 3.4E+38
 /begin AXIS_DESCR COM_AXIS LATC_DisplaySpd_kph autosar_swc_vmc_CM_single 16 -3.4E+38 3.4E+38 AXIS_PTS_REF P_LATC_preDis_spd /end AXIS_DESCR
 /begin AXIS_DESCR COM_AXIS NO_INPUT_QUANTITY autosar_swc_vmc_CM_single 19 -3.4E+38 3.4E+38 AXIS_PTS_REF P_LATC_A0_Dis_BP /end AXIS_DESCR
/end CHARACTERISTIC
/begin CHARACTERISTIC P_LATC_preDis_LC_Soft_Fac "" MAP 0xfe82806c /* @ECU_Address@P_LATC_preDis_LC_Soft_Fac@ */ Record_FLOAT32_IEEE 0 autosar_swc_vmc_CM_single -3.4E+38 3.4E+38
 /begin AXIS_DESCR COM_AXIS LATC_DisplaySpd_kph autosar_swc_vmc_CM_single 16 -3.4E+38 3.4E+38 AXIS_PTS_REF P_LATC_preDis_spd /end AXIS_DESCR
 /begin AXIS_DESCR COM_AXIS NO_INPUT_QUANTITY autosar_swc_vmc_CM_single 19 -3.4E+38 3.4E+38 AXIS_PTS_REF P_LATC_A0_Dis_BP /end AXIS_DESCR
/end CHARACTERISTIC
/begin CHARACTERISTIC P_LATC_preDis_LKA_Fac "" MAP 0xfe82852c /* @ECU_Address@P_LATC_preDis_LKA_Fac@ */ Record_FLOAT32_IEEE 0 autosar_swc_vmc_CM_single -3.4E+38 3.4E+38
 /begin AXIS_DESCR COM_AXIS LATC_DisplaySpd_kph autosar_swc_vmc_CM_single 16 -3.4E+38 3.4E+38 AXIS_PTS_REF P_LATC_preDis_spd /end AXIS_DESCR
 /begin AXIS_DESCR COM_AXIS NO_INPUT_QUANTITY autosar_swc_vmc_CM_single 19 -3.4E+38 3.4E+38 AXIS_PTS_REF P_LATC_A0_Dis_BP /end AXIS_DESCR
/end CHARACTERISTIC
/begin CHARACTERISTIC P_LATC_preDis_Split_Fac "" MAP 0xfe8289ec /* @ECU_Address@P_LATC_preDis_Split_Fac@ */ Record_FLOAT32_IEEE 0 autosar_swc_vmc_CM_single -3.4E+38 3.4E+38
 /begin AXIS_DESCR COM_AXIS LATC_DisplaySpd_kph autosar_swc_vmc_CM_single 16 -3.4E+38 3.4E+38 AXIS_PTS_REF P_LATC_preDis_spd /end AXIS_DESCR
 /begin AXIS_DESCR COM_AXIS NO_INPUT_QUANTITY autosar_swc_vmc_CM_single 19 -3.4E+38 3.4E+38 AXIS_PTS_REF P_LATC_A0_Dis_BP /end AXIS_DESCR
/end CHARACTERISTIC
/begin CHARACTERISTIC P_LongCtrl_CoefNegTorqUse "" VALUE 0xfe822064 /* @ECU_Address@P_LongCtrl_CoefNegTorqUse@ */ Record_FLOAT32_IEEE 0 autosar_swc_vmc_CM_single -3.4E+38 3.4E+38 /end CHARACTERISTIC
/begin CHARACTERISTIC P_LongCtrl_ECDCaxvClosedLoopLowerBand "" VALUE 0xfe822068 /* @ECU_Address@P_LongCtrl_ECDCaxvClosedLoopLowerBand@ */ Record_FLOAT32_IEEE 0 autosar_swc_vmc_CM_single -3.4E+38 3.4E+38 /end CHARACTERISTIC
/begin CHARACTERISTIC P_LongCtrl_ECDCaxvRoadSlopThres "" VALUE 0xfe82206c /* @ECU_Address@P_LongCtrl_ECDCaxvRoadSlopThres@ */ Record_FLOAT32_IEEE 0 autosar_swc_vmc_CM_single -3.4E+38 3.4E+38 /end CHARACTERISTIC
/begin CHARACTERISTIC P_LongCtrl_ECDCfslopScaling "" VALUE 0xfe822070 /* @ECU_Address@P_LongCtrl_ECDCfslopScaling@ */ Record_FLOAT32_IEEE 0 autosar_swc_vmc_CM_single -3.4E+38 3.4E+38 /end CHARACTERISTIC
/begin CHARACTERISTIC P_LongCtrl_ECDCvxvRefThres "" VALUE 0xfe822074 /* @ECU_Address@P_LongCtrl_ECDCvxvRefThres@ */ Record_FLOAT32_IEEE 0 autosar_swc_vmc_CM_single_m_per_s 0.000000 3.4E+38 /end CHARACTERISTIC
/begin CHARACTERISTIC P_LongCtrl_EfficiencyChartYAxis "" CURVE 0xfe82289c /* @ECU_Address@P_LongCtrl_EfficiencyChartYAxis@ */ Record_FLOAT32_IEEE 0 autosar_swc_vmc_CM_single -3.4E+38 3.4E+38
 /begin AXIS_DESCR COM_AXIS NO_INPUT_QUANTITY autosar_swc_vmc_CM_single 5 -3.4E+38 3.4E+38 AXIS_PTS_REF P_LongCtrl_EfficiencyChartXAxis /end AXIS_DESCR
/end CHARACTERISTIC
/begin CHARACTERISTIC P_LongCtrl_EngIdleForce "N" VALUE 0xfe822078 /* @ECU_Address@P_LongCtrl_EngIdleForce@ */ Record_FLOAT32_IEEE 0 autosar_swc_vmc_CM_single 0.000000 300.000000 /end CHARACTERISTIC
/begin CHARACTERISTIC P_LongCtrl_EngIdleForceSwFcnYAxis "" CURVE 0xfe8224a0 /* @ECU_Address@P_LongCtrl_EngIdleForceSwFcnYAxis@ */ Record_FLOAT32_IEEE 0 autosar_swc_vmc_CM_single -3.4E+38 3.4E+38
 /begin AXIS_DESCR COM_AXIS NO_INPUT_QUANTITY autosar_swc_vmc_CM_single 4 -3.4E+38 3.4E+38 AXIS_PTS_REF P_LongCtrl_EngIdleForceSwFcnXAxis /end AXIS_DESCR
/end CHARACTERISTIC
/begin CHARACTERISTIC P_LongCtrl_EngTrqConsiderEfficiencyChartYAxis "" CURVE 0xfe8228c4 /* @ECU_Address@P_LongCtrl_EngTrqConsiderEfficiencyChartYAxis@ */ Record_FLOAT32_IEEE 0 autosar_swc_vmc_CM_single -3.4E+38 3.4E+38
 /begin AXIS_DESCR COM_AXIS NO_INPUT_QUANTITY autosar_swc_vmc_CM_single 5 -3.4E+38 3.4E+38 AXIS_PTS_REF P_LongCtrl_EngTrqConsiderEfficiencyChartXAxis /end AXIS_DESCR
/end CHARACTERISTIC
/begin CHARACTERISTIC P_LongCtrl_FF_Spd_Factor "" CURVE 0xfe8224e0 /* @ECU_Address@P_LongCtrl_FF_Spd_Factor@ */ Record_FLOAT32_IEEE 0 autosar_swc_vmc_CM_single -3.4E+38 3.4E+38
 /begin AXIS_DESCR COM_AXIS NO_INPUT_QUANTITY autosar_swc_vmc_CM_single 12 -3.4E+38 3.4E+38 AXIS_PTS_REF P_LongCtrl_FF_Spd /end AXIS_DESCR
/end CHARACTERISTIC
/begin CHARACTERISTIC P_LongCtrl_IControllerSwFcnXAxis "" VAL_BLK 0xfe822510 /* @ECU_Address@P_LongCtrl_IControllerSwFcnXAxis@ */ Record_FLOAT32_IEEE 0 autosar_swc_vmc_CM_single_m_per_s_2 -10.000000 20.000000 MATRIX_DIM 6 1 /end CHARACTERISTIC
/begin CHARACTERISTIC P_LongCtrl_IControllerSwFcnYAxis "" VAL_BLK 0xfe822528 /* @ECU_Address@P_LongCtrl_IControllerSwFcnYAxis@ */ Record_FLOAT32_IEEE 0 autosar_swc_vmc_CM_single 0.000000 2.000000 MATRIX_DIM 6 1 /end CHARACTERISTIC
/begin CHARACTERISTIC P_LongCtrl_MaRatioChartYAxis "" CURVE 0xfe828ef4 /* @ECU_Address@P_LongCtrl_MaRatioChartYAxis@ */ Record_FLOAT32_IEEE 0 autosar_swc_vmc_CM_single -3.4E+38 3.4E+38
 /begin AXIS_DESCR COM_AXIS NO_INPUT_QUANTITY autosar_swc_vmc_CM_single 18 -3.4E+38 3.4E+38 AXIS_PTS_REF P_LongCtrl_MaRatioChartXAxis /end AXIS_DESCR
/end CHARACTERISTIC
/begin CHARACTERISTIC P_LongCtrl_Ma_Ratio "" VALUE 0xfe82207c /* @ECU_Address@P_LongCtrl_Ma_Ratio@ */ Record_FLOAT32_IEEE 0 autosar_swc_vmc_CM_single -3.4E+38 3.4E+38 /end CHARACTERISTIC
/begin CHARACTERISTIC P_LongCtrl_PI_vxvRefMs_Factor "" CURVE 0xfe822550 /* @ECU_Address@P_LongCtrl_PI_vxvRefMs_Factor@ */ Record_FLOAT32_IEEE 0 autosar_swc_vmc_CM_single -3.4E+38 3.4E+38
 /begin AXIS_DESCR COM_AXIS NO_INPUT_QUANTITY autosar_swc_vmc_CM_single 4 -3.4E+38 3.4E+38 AXIS_PTS_REF P_LongCtrl_PI_vxvRefMs /end AXIS_DESCR
/end CHARACTERISTIC
/begin CHARACTERISTIC P_LongCtrl_UsedMinEngTrqChartYAxis "" CURVE 0xfe822904 /* @ECU_Address@P_LongCtrl_UsedMinEngTrqChartYAxis@ */ Record_FLOAT32_IEEE 0 autosar_swc_vmc_CM_single -3.4E+38 3.4E+38
 /begin AXIS_DESCR COM_AXIS NO_INPUT_QUANTITY autosar_swc_vmc_CM_single 11 -3.4E+38 3.4E+38 AXIS_PTS_REF P_LongCtrl_UsedMinEngTrqChartXAxis /end AXIS_DESCR
/end CHARACTERISTIC
/begin CHARACTERISTIC P_LongCtrl_VLCAxDC7Thrd "" VALUE 0xfe822080 /* @ECU_Address@P_LongCtrl_VLCAxDC7Thrd@ */ Record_FLOAT32_IEEE 0 autosar_swc_vmc_CM_single -3.4E+38 3.4E+38 /end CHARACTERISTIC
/begin CHARACTERISTIC P_LongCtrl_VLCAxTarDtThreEnableI "" VALUE 0xfe822084 /* @ECU_Address@P_LongCtrl_VLCAxTarDtThreEnableI@ */ Record_FLOAT32_IEEE 0 autosar_swc_vmc_CM_single_m_per_s_3 0.000000 5.000000 /end CHARACTERISTIC
/begin CHARACTERISTIC P_LongCtrl_VLCAxvTracMinDevDC1ChartYAxis "" CURVE 0xfe822570 /* @ECU_Address@P_LongCtrl_VLCAxvTracMinDevDC1ChartYAxis@ */ Record_FLOAT32_IEEE 0 autosar_swc_vmc_CM_single_m_per_s_2 -1.000000 1.000000
 /begin AXIS_DESCR COM_AXIS NO_INPUT_QUANTITY autosar_swc_vmc_CM_single_m_per_s 4 0.000000 60.000000 AXIS_PTS_REF P_LongCtrl_VLCAxvTracMinDevDC1ChartXAxis /end AXIS_DESCR
/end CHARACTERISTIC
/begin CHARACTERISTIC P_LongCtrl_VLCCounterAxvTracMinTimeout "" VALUE 0xfe822088 /* @ECU_Address@P_LongCtrl_VLCCounterAxvTracMinTimeout@ */ Record_FLOAT32_IEEE 0 autosar_swc_vmc_CM_single 0.000000 100.000000 /end CHARACTERISTIC
/begin CHARACTERISTIC P_LongCtrl_VLCCounterDC2ECTorqDelay "" VALUE 0xfe82208c /* @ECU_Address@P_LongCtrl_VLCCounterDC2ECTorqDelay@ */ Record_FLOAT32_IEEE 0 autosar_swc_vmc_CM_single 0.000000 100.000000 /end CHARACTERISTIC
/begin CHARACTERISTIC P_LongCtrl_VLCCounterDrvOff2EC "" VALUE 0xfe822090 /* @ECU_Address@P_LongCtrl_VLCCounterDrvOff2EC@ */ Record_FLOAT32_IEEE 0 autosar_swc_vmc_CM_single 0.000000 100.000000 /end CHARACTERISTIC
/begin CHARACTERISTIC P_LongCtrl_VLCDecToStopDecValue "" VALUE 0xfe822094 /* @ECU_Address@P_LongCtrl_VLCDecToStopDecValue@ */ Record_FLOAT32_IEEE 0 autosar_swc_vmc_CM_single -5.000000 5.000000 /end CHARACTERISTIC
/begin CHARACTERISTIC P_LongCtrl_VLCDtAxvRef2UpperBandDC5 "" VALUE 0xfe822098 /* @ECU_Address@P_LongCtrl_VLCDtAxvRef2UpperBandDC5@ */ Record_FLOAT32_IEEE 0 autosar_swc_vmc_CM_single -1.000000 1.000000 /end CHARACTERISTIC
/begin CHARACTERISTIC P_LongCtrl_VLCIACompensionNeg "" VALUE 0xfe82209c /* @ECU_Address@P_LongCtrl_VLCIACompensionNeg@ */ Record_FLOAT32_IEEE 0 autosar_swc_vmc_CM_single_m_per_s_2 -3.000000 0.000000 /end CHARACTERISTIC
/begin CHARACTERISTIC P_LongCtrl_VLCIACompensionPos "" VALUE 0xfe8220a0 /* @ECU_Address@P_LongCtrl_VLCIACompensionPos@ */ Record_FLOAT32_IEEE 0 autosar_swc_vmc_CM_single_m_per_s_2 0.000000 3.000000 /end CHARACTERISTIC
/begin CHARACTERISTIC P_LongCtrl_VLCTaraccelOverrideSwitch "" VALUE 0xfe822133 /* @ECU_Address@P_LongCtrl_VLCTaraccelOverrideSwitch@ */ Record_BOOLEAN 0 autosar_swc_vmc_CM_boolean 0.000000 1.000000 /end CHARACTERISTIC
/begin CHARACTERISTIC P_LongCtrl_VLCTaraccelSlope "" VALUE 0xfe8220a4 /* @ECU_Address@P_LongCtrl_VLCTaraccelSlope@ */ Record_FLOAT32_IEEE 0 autosar_swc_vmc_CM_single -1.000000 1.000000 /end CHARACTERISTIC
/begin CHARACTERISTIC P_LongCtrl_VLCTorqDiffThreAxvTracMinTimeout "" VALUE 0xfe8220a8 /* @ECU_Address@P_LongCtrl_VLCTorqDiffThreAxvTracMinTimeout@ */ Record_FLOAT32_IEEE 0 autosar_swc_vmc_CM_single 0.000000 20.000000 /end CHARACTERISTIC
/begin CHARACTERISTIC P_LongCtrl_VLCTrRatioMax "" VALUE 0xfe8220ac /* @ECU_Address@P_LongCtrl_VLCTrRatioMax@ */ Record_FLOAT32_IEEE 0 autosar_swc_vmc_CM_single 10.000000 30.000000 /end CHARACTERISTIC
/begin CHARACTERISTIC P_LongCtrl_VLCTrRatioMin "" VALUE 0xfe8220b0 /* @ECU_Address@P_LongCtrl_VLCTrRatioMin@ */ Record_FLOAT32_IEEE 0 autosar_swc_vmc_CM_single 0.100000 1.000000 /end CHARACTERISTIC
/begin CHARACTERISTIC P_LongCtrl_VLCVlcAccThresAxvTracMinTimeout "" VALUE 0xfe8220b4 /* @ECU_Address@P_LongCtrl_VLCVlcAccThresAxvTracMinTimeout@ */ Record_FLOAT32_IEEE 0 autosar_swc_vmc_CM_single_m_per_s_2 -5.000000 2.000000 /end CHARACTERISTIC
/begin CHARACTERISTIC P_LongCtrl_VLC_DCECSwitch "" VALUE 0xfe822134 /* @ECU_Address@P_LongCtrl_VLC_DCECSwitch@ */ Record_BOOLEAN 0 autosar_swc_vmc_CM_boolean 0 1 /end CHARACTERISTIC
/begin CHARACTERISTIC P_LongCtrl_VLC_DecelReq "" VALUE 0xfe822135 /* @ECU_Address@P_LongCtrl_VLC_DecelReq@ */ Record_BOOLEAN 0 autosar_swc_vmc_CM_boolean 0 1 /end CHARACTERISTIC
/begin CHARACTERISTIC P_LongCtrl_VLC_DecelReqPosConst "" VALUE 0xfe8220b8 /* @ECU_Address@P_LongCtrl_VLC_DecelReqPosConst@ */ Record_FLOAT32_IEEE 0 autosar_swc_vmc_CM_single -3.4E+38 3.4E+38 /end CHARACTERISTIC
/begin CHARACTERISTIC P_LongCtrl_VLC_WindArea "" VALUE 0xfe8220bc /* @ECU_Address@P_LongCtrl_VLC_WindArea@ */ Record_FLOAT32_IEEE 0 autosar_swc_vmc_CM_single_m_2 -3.4E+38 3.4E+38 /end CHARACTERISTIC
/begin CHARACTERISTIC P_LongCtrl_VLC_fRollCoef "" VALUE 0xfe8220c0 /* @ECU_Address@P_LongCtrl_VLC_fRollCoef@ */ Record_FLOAT32_IEEE 0 autosar_swc_vmc_CM_single -3.4E+38 3.4E+38 /end CHARACTERISTIC
/begin CHARACTERISTIC P_LongCtrl_VLCaDtThresUpdateTorq "" VALUE 0xfe8220c4 /* @ECU_Address@P_LongCtrl_VLCaDtThresUpdateTorq@ */ Record_FLOAT32_IEEE 0 autosar_swc_vmc_CM_single_m_per_s_3 0.000000 10.000000 /end CHARACTERISTIC
/begin CHARACTERISTIC P_LongCtrl_VLCaccelIsAccelerating "" VALUE 0xfe8220c8 /* @ECU_Address@P_LongCtrl_VLCaccelIsAccelerating@ */ Record_FLOAT32_IEEE 0 autosar_swc_vmc_CM_single -3.4E+38 3.4E+38 /end CHARACTERISTIC
/begin CHARACTERISTIC P_LongCtrl_VLCaccelMinHoldYAxis "" CURVE 0xfe821fd8 /* @ECU_Address@P_LongCtrl_VLCaccelMinHoldYAxis@ */ Record_FLOAT32_IEEE 0 autosar_swc_vmc_CM_single_m_per_s_2 -6.000000 0.000000
 /begin AXIS_DESCR COM_AXIS NO_INPUT_QUANTITY autosar_swc_vmc_CM_single_m_per_s_2 2 0.000000 5.000000 AXIS_PTS_REF P_LongCtrl_VLCaccelMinHoldXAxis /end AXIS_DESCR
/end CHARACTERISTIC
/begin CHARACTERISTIC P_LongCtrl_VLCaxCtrlDevEC2DCMax "" VALUE 0xfe8220cc /* @ECU_Address@P_LongCtrl_VLCaxCtrlDevEC2DCMax@ */ Record_FLOAT32_IEEE 0 autosar_swc_vmc_CM_single -3.4E+38 3.4E+38 /end CHARACTERISTIC
/begin CHARACTERISTIC P_LongCtrl_VLCaxCtrlDevFastQuitDCMode "" VALUE 0xfe8220d0 /* @ECU_Address@P_LongCtrl_VLCaxCtrlDevFastQuitDCMode@ */ Record_FLOAT32_IEEE 0 autosar_swc_vmc_CM_single -3.4E+38 3.4E+38 /end CHARACTERISTIC
/begin CHARACTERISTIC P_LongCtrl_VLCcoefFYAxis "" CURVE 0xfe8225a8 /* @ECU_Address@P_LongCtrl_VLCcoefFYAxis@ */ Record_FLOAT32_IEEE 0 autosar_swc_vmc_CM_single 0.000000 1.000000
 /begin AXIS_DESCR COM_AXIS NO_INPUT_QUANTITY autosar_swc_vmc_CM_single_km_per_h 10 0.000000 250.000000 AXIS_PTS_REF P_LongCtrl_VLCcoefFXAxis /end AXIS_DESCR
/end CHARACTERISTIC
/begin CHARACTERISTIC P_LongCtrl_VLCcoefIFadeOut1Calc "" VALUE 0xfe8220d4 /* @ECU_Address@P_LongCtrl_VLCcoefIFadeOut1Calc@ */ Record_FLOAT32_IEEE 0 autosar_swc_vmc_CM_single 1.000000 10.000000 /end CHARACTERISTIC
/begin CHARACTERISTIC P_LongCtrl_VLCcoefIFadeOut1Condition "" VALUE 0xfe8220d8 /* @ECU_Address@P_LongCtrl_VLCcoefIFadeOut1Condition@ */ Record_FLOAT32_IEEE 0 autosar_swc_vmc_CM_single 0.000000 1.000000 /end CHARACTERISTIC
/begin CHARACTERISTIC P_LongCtrl_VLCcoefIFadeOut2Calc "" VALUE 0xfe8220dc /* @ECU_Address@P_LongCtrl_VLCcoefIFadeOut2Calc@ */ Record_FLOAT32_IEEE 0 autosar_swc_vmc_CM_single 1.000000 10.000000 /end CHARACTERISTIC
/begin CHARACTERISTIC P_LongCtrl_VLCcoefIFadeOut2Condition "" VALUE 0xfe8220e0 /* @ECU_Address@P_LongCtrl_VLCcoefIFadeOut2Condition@ */ Record_FLOAT32_IEEE 0 autosar_swc_vmc_CM_single 0.000000 1.000000 /end CHARACTERISTIC
/begin CHARACTERISTIC P_LongCtrl_VLCcoefIFadeOut3Calc "" VALUE 0xfe8220e4 /* @ECU_Address@P_LongCtrl_VLCcoefIFadeOut3Calc@ */ Record_FLOAT32_IEEE 0 autosar_swc_vmc_CM_single 1.000000 10.000000 /end CHARACTERISTIC
/begin CHARACTERISTIC P_LongCtrl_VLCcoefIFadeOut3Condition "" VALUE 0xfe8220e8 /* @ECU_Address@P_LongCtrl_VLCcoefIFadeOut3Condition@ */ Record_FLOAT32_IEEE 0 autosar_swc_vmc_CM_single 0.000000 1.000000 /end CHARACTERISTIC
/begin CHARACTERISTIC P_LongCtrl_VLCdaxTarEC2DCMax "" VALUE 0xfe8220ec /* @ECU_Address@P_LongCtrl_VLCdaxTarEC2DCMax@ */ Record_FLOAT32_IEEE 0 autosar_swc_vmc_CM_single -3.4E+38 3.4E+38 /end CHARACTERISTIC
/begin CHARACTERISTIC P_LongCtrl_VLCdriveOffAxUpLimYAxix "" CURVE 0xfe822944 /* @ECU_Address@P_LongCtrl_VLCdriveOffAxUpLimYAxix@ */ Record_FLOAT32_IEEE 0 autosar_swc_vmc_CM_single -3.4E+38 3.4E+38
 /begin AXIS_DESCR COM_AXIS NO_INPUT_QUANTITY autosar_swc_vmc_CM_single 5 -3.4E+38 3.4E+38 AXIS_PTS_REF P_LongCtrl_VLCdriveOffAxUpLimXAxix /end AXIS_DESCR
/end CHARACTERISTIC
/begin CHARACTERISTIC P_LongCtrl_VLCjerkHoldYAxis "" CURVE 0xfe821fe8 /* @ECU_Address@P_LongCtrl_VLCjerkHoldYAxis@ */ Record_FLOAT32_IEEE 0 autosar_swc_vmc_CM_single_m_per_s_3 -50.000000 0.000000
 /begin AXIS_DESCR COM_AXIS NO_INPUT_QUANTITY autosar_swc_vmc_CM_single_m_per_s_2 2 0.000000 4.000000 AXIS_PTS_REF P_LongCtrl_VLCjerkHoldXAxis /end AXIS_DESCR
/end CHARACTERISTIC
/begin CHARACTERISTIC P_LongCtrl_VLCjerkTorqUp "" VALUE 0xfe8220f0 /* @ECU_Address@P_LongCtrl_VLCjerkTorqUp@ */ Record_FLOAT32_IEEE 0 autosar_swc_vmc_CM_single -3.4E+38 3.4E+38 /end CHARACTERISTIC
/begin CHARACTERISTIC P_LongCtrl_VLCtEngSpdControlMax "" VALUE 0xfe8220f4 /* @ECU_Address@P_LongCtrl_VLCtEngSpdControlMax@ */ Record_FLOAT32_IEEE 0 autosar_swc_vmc_CM_single -3.4E+38 3.4E+38 /end CHARACTERISTIC
/begin CHARACTERISTIC P_LongCtrl_VLCvel1ThresUpdateTorq "" VALUE 0xfe8220f8 /* @ECU_Address@P_LongCtrl_VLCvel1ThresUpdateTorq@ */ Record_FLOAT32_IEEE 0 autosar_swc_vmc_CM_single_km_per_h 0.000000 30.000000 /end CHARACTERISTIC
/begin CHARACTERISTIC P_LongCtrl_VlcAxDiffDtKiCoefChartXAxis "" VAL_BLK 0xfe8225d0 /* @ECU_Address@P_LongCtrl_VlcAxDiffDtKiCoefChartXAxis@ */ Record_FLOAT32_IEEE 0 autosar_swc_vmc_CM_single_m_per_s_3 -10.000000 20.000000 MATRIX_DIM 6 1 /end CHARACTERISTIC
/begin CHARACTERISTIC P_LongCtrl_VlcAxDiffDtKiCoefChartYAxis "" VAL_BLK 0xfe8225e8 /* @ECU_Address@P_LongCtrl_VlcAxDiffDtKiCoefChartYAxis@ */ Record_FLOAT32_IEEE 0 autosar_swc_vmc_CM_single 0.000000 3.000000 MATRIX_DIM 6 1 /end CHARACTERISTIC
/begin CHARACTERISTIC P_LongCtrl_VlcAxDiffKiCoefChartXAxis "" VAL_BLK 0xfe822958 /* @ECU_Address@P_LongCtrl_VlcAxDiffKiCoefChartXAxis@ */ Record_FLOAT32_IEEE 0 autosar_swc_vmc_CM_single_m_per_s_2 -10.000000 10.000000 MATRIX_DIM 11 1 /end CHARACTERISTIC
/begin CHARACTERISTIC P_LongCtrl_VlcAxDiffKiCoefChartYAxis "" VAL_BLK 0xfe822984 /* @ECU_Address@P_LongCtrl_VlcAxDiffKiCoefChartYAxis@ */ Record_FLOAT32_IEEE 0 autosar_swc_vmc_CM_single -3.4E+38 3.4E+38 MATRIX_DIM 11 1 /end CHARACTERISTIC
/begin CHARACTERISTIC P_LongCtrl_VlcAxLowerBandDevThrdChartXAxis "" VAL_BLK 0xfe8229b0 /* @ECU_Address@P_LongCtrl_VlcAxLowerBandDevThrdChartXAxis@ */ Record_FLOAT32_IEEE 0 autosar_swc_vmc_CM_single -3.4E+38 3.4E+38 MATRIX_DIM 5 1 /end CHARACTERISTIC
/begin CHARACTERISTIC P_LongCtrl_VlcAxLowerBandDevThrdChartYAxis "" VAL_BLK 0xfe8229c4 /* @ECU_Address@P_LongCtrl_VlcAxLowerBandDevThrdChartYAxis@ */ Record_FLOAT32_IEEE 0 autosar_swc_vmc_CM_single -3.4E+38 3.4E+38 MATRIX_DIM 5 1 /end CHARACTERISTIC
/begin CHARACTERISTIC P_LongCtrl_VlcAxvRoadSlopeDC4ChartYAxis "" VAL_BLK 0xfe8229d8 /* @ECU_Address@P_LongCtrl_VlcAxvRoadSlopeDC4ChartYAxis@ */ Record_FLOAT32_IEEE 0 autosar_swc_vmc_CM_single 0.000000 1.000000 MATRIX_DIM 5 1 /end CHARACTERISTIC
/begin CHARACTERISTIC P_LongCtrl_VlcDC2ECSmoothCtrlDevThrdChartXAxis "" VAL_BLK 0xfe8229ec /* @ECU_Address@P_LongCtrl_VlcDC2ECSmoothCtrlDevThrdChartXAxis@ */ Record_FLOAT32_IEEE 0 autosar_swc_vmc_CM_single_m_per_s_3 0.000000 2.000000 MATRIX_DIM 5 1 /end CHARACTERISTIC
/begin CHARACTERISTIC P_LongCtrl_VlcDC2ECSmoothCtrlDevThrdChartYAxis "" VAL_BLK 0xfe822a00 /* @ECU_Address@P_LongCtrl_VlcDC2ECSmoothCtrlDevThrdChartYAxis@ */ Record_FLOAT32_IEEE 0 autosar_swc_vmc_CM_single -3.4E+38 3.4E+38 MATRIX_DIM 5 1 /end CHARACTERISTIC
/begin CHARACTERISTIC P_LongCtrl_VlcDriveOff2ECDownhillThrd "" VALUE 0xfe8220fc /* @ECU_Address@P_LongCtrl_VlcDriveOff2ECDownhillThrd@ */ Record_FLOAT32_IEEE 0 autosar_swc_vmc_CM_single -3.4E+38 3.4E+38 /end CHARACTERISTIC
/begin CHARACTERISTIC P_LongCtrl_VlcEC2DCSmoothCtrlDevThrdChartXAxis "" VAL_BLK 0xfe822a14 /* @ECU_Address@P_LongCtrl_VlcEC2DCSmoothCtrlDevThrdChartXAxis@ */ Record_FLOAT32_IEEE 0 autosar_swc_vmc_CM_single -3.4E+38 3.4E+38 MATRIX_DIM 5 1 /end CHARACTERISTIC
/begin CHARACTERISTIC P_LongCtrl_VlcEC2DCSmoothCtrlDevThrdChartYAxis "" VAL_BLK 0xfe822a28 /* @ECU_Address@P_LongCtrl_VlcEC2DCSmoothCtrlDevThrdChartYAxis@ */ Record_FLOAT32_IEEE 0 autosar_swc_vmc_CM_single -3.4E+38 3.4E+38 MATRIX_DIM 5 1 /end CHARACTERISTIC
/begin CHARACTERISTIC P_LongCtrl_VlcEngTrqIncKs "" VALUE 0xfe822100 /* @ECU_Address@P_LongCtrl_VlcEngTrqIncKs@ */ Record_FLOAT32_IEEE 0 autosar_swc_vmc_CM_single -3.4E+38 3.4E+38 /end CHARACTERISTIC
/begin CHARACTERISTIC P_LongCtrl_VlcEngTrqMaxKs "" VALUE 0xfe822104 /* @ECU_Address@P_LongCtrl_VlcEngTrqMaxKs@ */ Record_FLOAT32_IEEE 0 autosar_swc_vmc_CM_single -3.4E+38 3.4E+38 /end CHARACTERISTIC
/begin CHARACTERISTIC P_LongCtrl_VlcEngTrqki "" VALUE 0xfe822108 /* @ECU_Address@P_LongCtrl_VlcEngTrqki@ */ Record_FLOAT32_IEEE 0 autosar_swc_vmc_CM_single -3.4E+38 3.4E+38 /end CHARACTERISTIC
/begin CHARACTERISTIC P_LongCtrl_VlcEngTrqkp "" VALUE 0xfe82210c /* @ECU_Address@P_LongCtrl_VlcEngTrqkp@ */ Record_FLOAT32_IEEE 0 autosar_swc_vmc_CM_single -3.4E+38 3.4E+38 /end CHARACTERISTIC
/begin CHARACTERISTIC P_LongCtrl_VlcIControllerBigDeadzoneValueChartXAxis "" VAL_BLK 0xfe822a3c /* @ECU_Address@P_LongCtrl_VlcIControllerBigDeadzoneValueChartXAxis@ */ Record_FLOAT32_IEEE 0 autosar_swc_vmc_CM_single_km_per_h 0.000000 250.000000 MATRIX_DIM 5 1 /end CHARACTERISTIC
/begin CHARACTERISTIC P_LongCtrl_VlcIControllerBigDeadzoneValueChartYAxis "" VAL_BLK 0xfe822a50 /* @ECU_Address@P_LongCtrl_VlcIControllerBigDeadzoneValueChartYAxis@ */ Record_FLOAT32_IEEE 0 autosar_swc_vmc_CM_single -3.4E+38 3.4E+38 MATRIX_DIM 5 1 /end CHARACTERISTIC
/begin CHARACTERISTIC P_LongCtrl_VlcPControllerBigDeadzoneValueChartXAxis "" VAL_BLK 0xfe822a64 /* @ECU_Address@P_LongCtrl_VlcPControllerBigDeadzoneValueChartXAxis@ */ Record_FLOAT32_IEEE 0 autosar_swc_vmc_CM_single -3.4E+38 3.4E+38 MATRIX_DIM 7 1 /end CHARACTERISTIC
/begin CHARACTERISTIC P_LongCtrl_VlcPControllerBigDeadzoneValueChartYAxis "" VAL_BLK 0xfe822a80 /* @ECU_Address@P_LongCtrl_VlcPControllerBigDeadzoneValueChartYAxis@ */ Record_FLOAT32_IEEE 0 autosar_swc_vmc_CM_single -3.4E+38 3.4E+38 MATRIX_DIM 7 1 /end CHARACTERISTIC
/begin CHARACTERISTIC P_LongCtrl_VlcWheelTrqIncKs "" VALUE 0xfe822110 /* @ECU_Address@P_LongCtrl_VlcWheelTrqIncKs@ */ Record_FLOAT32_IEEE 0 autosar_swc_vmc_CM_single -3.4E+38 3.4E+38 /end CHARACTERISTIC
/begin CHARACTERISTIC P_LongCtrl_VlcWheelTrqMaxKs "" VALUE 0xfe822114 /* @ECU_Address@P_LongCtrl_VlcWheelTrqMaxKs@ */ Record_FLOAT32_IEEE 0 autosar_swc_vmc_CM_single -3.4E+38 3.4E+38 /end CHARACTERISTIC
/begin CHARACTERISTIC P_LongCtrl_VlcWheelTrqki "" VALUE 0xfe822118 /* @ECU_Address@P_LongCtrl_VlcWheelTrqki@ */ Record_FLOAT32_IEEE 0 autosar_swc_vmc_CM_single -3.4E+38 3.4E+38 /end CHARACTERISTIC
/begin CHARACTERISTIC P_LongCtrl_VlcWheelTrqkp "" VALUE 0xfe82211c /* @ECU_Address@P_LongCtrl_VlcWheelTrqkp@ */ Record_FLOAT32_IEEE 0 autosar_swc_vmc_CM_single -3.4E+38 3.4E+38 /end CHARACTERISTIC
/begin CHARACTERISTIC P_VMC_FuSaTestEnable "" VALUE 0xfe822136 /* @ECU_Address@P_VMC_FuSaTestEnable@ */ Record_BOOLEAN 0 autosar_swc_vmc_CM_boolean 0 1 /end CHARACTERISTIC
/begin CHARACTERISTIC P_VMC_FuSaTest_AccelPresets "" VALUE 0xfe822120 /* @ECU_Address@P_VMC_FuSaTest_AccelPresets@ */ Record_FLOAT32_IEEE 0 autosar_swc_vmc_CM_single -3.4E+38 3.4E+38 /end CHARACTERISTIC
/begin CHARACTERISTIC P_VMC_FuSaTest_Accel_A "" CURVE 0xfe822600 /* @ECU_Address@P_VMC_FuSaTest_Accel_A@ */ Record_FLOAT32_IEEE 0 autosar_swc_vmc_CM_single -3.4E+38 3.4E+38
 /begin AXIS_DESCR COM_AXIS NO_INPUT_QUANTITY autosar_swc_vmc_CM_single 8 -3.4E+38 3.4E+38 AXIS_PTS_REF P_VMC_FuSaTest_Accel_T /end AXIS_DESCR
/end CHARACTERISTIC
/begin MEASUREMENT LATC_AckConstValue "" FLOAT32_IEEE autosar_swc_vmc_CM_single 0 0 -3.4E+38 3.4E+38 ECU_ADDRESS 0xfe4cc020 /* @ECU_Address@LATC_AckConstValue@ */ /end MEASUREMENT
/begin MEASUREMENT LATC_AngClcCnt "" UBYTE autosar_swc_vmc_CM_uint8 0 0 0 255 ECU_ADDRESS 0xfe4cc290 /* @ECU_Address@LATC_AngClcCnt@ */ /end MEASUREMENT
/begin MEASUREMENT LATC_AngleSlope_Flg "" UBYTE autosar_swc_vmc_CM_uint8 0 0 0 255 ECU_ADDRESS 0xfe4cc291 /* @ECU_Address@LATC_AngleSlope_Flg@ */ /end MEASUREMENT
/begin MEASUREMENT LATC_CurOffsetError "" FLOAT32_IEEE autosar_swc_vmc_CM_single 0 0 -3.4E+38 3.4E+38 ECU_ADDRESS 0xfe4cc024 /* @ECU_Address@LATC_CurOffsetError@ */ /end MEASUREMENT
/begin MEASUREMENT LATC_CurOffsetFliter_Fac "" FLOAT32_IEEE autosar_swc_vmc_CM_single 0 0 -3.4E+38 3.4E+38 ECU_ADDRESS 0xfe4cc028 /* @ECU_Address@LATC_CurOffsetFliter_Fac@ */ /end MEASUREMENT
/begin MEASUREMENT LATC_CurSteerAngle_deg "" FLOAT32_IEEE autosar_swc_vmc_CM_single 0 0 -3.4E+38 3.4E+38 MATRIX_DIM 1 1 ECU_ADDRESS 0xfe4cc02c /* @ECU_Address@LATC_CurSteerAngle_deg@ */ /end MEASUREMENT
/begin MEASUREMENT LATC_CurrentSteerAngleOffset_deg "" FLOAT32_IEEE autosar_swc_vmc_CM_single 0 0 -3.4E+38 3.4E+38 ECU_ADDRESS 0xfe4cc030 /* @ECU_Address@LATC_CurrentSteerAngleOffset_deg@ */ /end MEASUREMENT
/begin MEASUREMENT LATC_DOP_Predis "" FLOAT32_IEEE autosar_swc_vmc_CM_single 0 0 -3.4E+38 3.4E+38 ECU_ADDRESS 0xfe4cc034 /* @ECU_Address@LATC_DOP_Predis@ */ /end MEASUREMENT
/begin MEASUREMENT LATC_DOP_PredisFac "" FLOAT32_IEEE autosar_swc_vmc_CM_single 0 0 -3.4E+38 3.4E+38 ECU_ADDRESS 0xfe4cc038 /* @ECU_Address@LATC_DOP_PredisFac@ */ /end MEASUREMENT
/begin MEASUREMENT LATC_DeltaAngle "" FLOAT32_IEEE autosar_swc_vmc_CM_single 0 0 -3.4E+38 3.4E+38 ECU_ADDRESS 0xfe4cc03c /* @ECU_Address@LATC_DeltaAngle@ */ /end MEASUREMENT
/begin MEASUREMENT LATC_ELKPredis "" FLOAT32_IEEE autosar_swc_vmc_CM_single 0 0 -3.4E+38 3.4E+38 ECU_ADDRESS 0xfe4cc044 /* @ECU_Address@LATC_ELKPredis@ */ /end MEASUREMENT
/begin MEASUREMENT LATC_ELKPredisFac "" FLOAT32_IEEE autosar_swc_vmc_CM_single 0 0 -3.4E+38 3.4E+38 ECU_ADDRESS 0xfe4cc048 /* @ECU_Address@LATC_ELKPredisFac@ */ /end MEASUREMENT
/begin MEASUREMENT LATC_Effect1 "" UBYTE autosar_swc_vmc_CM_boolean 0 0 0 1 MATRIX_DIM 1 1 ECU_ADDRESS 0xfe4cc293 /* @ECU_Address@LATC_Effect1@ */ /end MEASUREMENT
/begin MEASUREMENT LATC_HoldTime "" FLOAT32_IEEE autosar_swc_vmc_CM_single 0 0 -3.4E+38 3.4E+38 ECU_ADDRESS 0xfe4cc04c /* @ECU_Address@LATC_HoldTime@ */ /end MEASUREMENT
/begin MEASUREMENT LATC_IN_SteerAngOffset_deg "" FLOAT32_IEEE autosar_swc_vmc_CM_single 0 0 -3.4E+38 3.4E+38 ECU_ADDRESS 0xfe4cc050 /* @ECU_Address@LATC_IN_SteerAngOffset_deg@ */ /end MEASUREMENT
/begin MEASUREMENT LATC_IN_SteerWheelAng "" FLOAT32_IEEE autosar_swc_vmc_CM_single 0 0 -3.4E+38 3.4E+38 MATRIX_DIM 1 1 ECU_ADDRESS 0xfe4cc054 /* @ECU_Address@LATC_IN_SteerWheelAng@ */ /end MEASUREMENT
/begin MEASUREMENT LATC_IN_SteerWheelSpd "" FLOAT32_IEEE autosar_swc_vmc_CM_single 0 0 -3.4E+38 3.4E+38 MATRIX_DIM 1 1 ECU_ADDRESS 0xfe4cc058 /* @ECU_Address@LATC_IN_SteerWheelSpd@ */ /end MEASUREMENT
/begin MEASUREMENT LATC_IN_alpSideSlipAngle "" FLOAT32_IEEE autosar_swc_vmc_CM_single 0 0 -3.4E+38 3.4E+38 ECU_ADDRESS 0xfe4cc05c /* @ECU_Address@LATC_IN_alpSideSlipAngle@ */ /end MEASUREMENT
/begin MEASUREMENT LATC_IN_axvRefMs2 "" FLOAT32_IEEE autosar_swc_vmc_CM_single 0 0 -3.4E+38 3.4E+38 ECU_ADDRESS 0xfe4cc060 /* @ECU_Address@LATC_IN_axvRefMs2@ */ /end MEASUREMENT
/begin MEASUREMENT LATC_IN_ayvRefMs2 "" FLOAT32_IEEE autosar_swc_vmc_CM_single 0 0 -3.4E+38 3.4E+38 ECU_ADDRESS 0xfe4cc064 /* @ECU_Address@LATC_IN_ayvRefMs2@ */ /end MEASUREMENT
/begin MEASUREMENT LATC_IN_kapTraj "" FLOAT32_IEEE autosar_swc_vmc_CM_single 0 0 -3.4E+38 3.4E+38 ECU_ADDRESS 0xfe4cc068 /* @ECU_Address@LATC_IN_kapTraj@ */ /end MEASUREMENT
/begin MEASUREMENT LATC_IN_psiDtOpt "" FLOAT32_IEEE autosar_swc_vmc_CM_single 0 0 -3.4E+38 3.4E+38 ECU_ADDRESS 0xfe4cc06c /* @ECU_Address@LATC_IN_psiDtOpt@ */ /end MEASUREMENT
/begin MEASUREMENT LATC_IN_vxvRefMs "" FLOAT32_IEEE autosar_swc_vmc_CM_single 0 0 -3.4E+38 3.4E+38 ECU_ADDRESS 0xfe4cc070 /* @ECU_Address@LATC_IN_vxvRefMs@ */ /end MEASUREMENT
/begin MEASUREMENT LATC_LATC_EffectValue "" FLOAT32_IEEE autosar_swc_vmc_CM_single 0 0 -3.4E+38 3.4E+38 ECU_ADDRESS 0xfe4cc074 /* @ECU_Address@LATC_LATC_EffectValue@ */ /end MEASUREMENT
/begin MEASUREMENT LATC_LATC_Effect_YError "" FLOAT32_IEEE autosar_swc_vmc_CM_single 0 0 -3.4E+38 3.4E+38 ECU_ADDRESS 0xfe4cc078 /* @ECU_Address@LATC_LATC_Effect_YError@ */ /end MEASUREMENT
/begin MEASUREMENT LATC_LCKPredis "" FLOAT32_IEEE autosar_swc_vmc_CM_single 0 0 -3.4E+38 3.4E+38 ECU_ADDRESS 0xfe4cc07c /* @ECU_Address@LATC_LCKPredis@ */ /end MEASUREMENT
/begin MEASUREMENT LATC_LCKPredisFac "" FLOAT32_IEEE autosar_swc_vmc_CM_single 0 0 -3.4E+38 3.4E+38 ECU_ADDRESS 0xfe4cc080 /* @ECU_Address@LATC_LCKPredisFac@ */ /end MEASUREMENT
/begin MEASUREMENT LATC_LCType "" UBYTE autosar_swc_vmc_CM_uint8 0 0 0 255 ECU_ADDRESS 0xfe4cc294 /* @ECU_Address@LATC_LCType@ */ /end MEASUREMENT
/begin MEASUREMENT LATC_LC_Complete_PreDisFac "" FLOAT32_IEEE autosar_swc_vmc_CM_single 0 0 -3.4E+38 3.4E+38 ECU_ADDRESS 0xfe4cc084 /* @ECU_Address@LATC_LC_Complete_PreDisFac@ */ /end MEASUREMENT
/begin MEASUREMENT LATC_LC_LCPredis "" FLOAT32_IEEE autosar_swc_vmc_CM_single 0 0 -3.4E+38 3.4E+38 ECU_ADDRESS 0xfe4cc088 /* @ECU_Address@LATC_LC_LCPredis@ */ /end MEASUREMENT
/begin MEASUREMENT LATC_LC_LCPredisFac "" FLOAT32_IEEE autosar_swc_vmc_CM_single 0 0 -3.4E+38 3.4E+38 ECU_ADDRESS 0xfe4cc08c /* @ECU_Address@LATC_LC_LCPredisFac@ */ /end MEASUREMENT
/begin MEASUREMENT LATC_LC_NomalPredis "" FLOAT32_IEEE autosar_swc_vmc_CM_single 0 0 -3.4E+38 3.4E+38 ECU_ADDRESS 0xfe4cc090 /* @ECU_Address@LATC_LC_NomalPredis@ */ /end MEASUREMENT
/begin MEASUREMENT LATC_LC_NomalPredisFac "" FLOAT32_IEEE autosar_swc_vmc_CM_single 0 0 -3.4E+38 3.4E+38 ECU_ADDRESS 0xfe4cc094 /* @ECU_Address@LATC_LC_NomalPredisFac@ */ /end MEASUREMENT
/begin MEASUREMENT LATC_LC_SportPredis "" FLOAT32_IEEE autosar_swc_vmc_CM_single 0 0 -3.4E+38 3.4E+38 ECU_ADDRESS 0xfe4cc098 /* @ECU_Address@LATC_LC_SportPredis@ */ /end MEASUREMENT
/begin MEASUREMENT LATC_LC_SportPredisFac "" FLOAT32_IEEE autosar_swc_vmc_CM_single 0 0 -3.4E+38 3.4E+38 ECU_ADDRESS 0xfe4cc09c /* @ECU_Address@LATC_LC_SportPredisFac@ */ /end MEASUREMENT
/begin MEASUREMENT LATC_LKAPredis "" FLOAT32_IEEE autosar_swc_vmc_CM_single 0 0 -3.4E+38 3.4E+38 ECU_ADDRESS 0xfe4cc0a0 /* @ECU_Address@LATC_LKAPredis@ */ /end MEASUREMENT
/begin MEASUREMENT LATC_LKAPredisFac "" FLOAT32_IEEE autosar_swc_vmc_CM_single 0 0 -3.4E+38 3.4E+38 ECU_ADDRESS 0xfe4cc0a4 /* @ECU_Address@LATC_LKAPredisFac@ */ /end MEASUREMENT
/begin MEASUREMENT LATC_LastPointWithTarLaneDis "" FLOAT32_IEEE autosar_swc_vmc_CM_single 0 0 -3.4E+38 3.4E+38 ECU_ADDRESS 0xfe4cc0a8 /* @ECU_Address@LATC_LastPointWithTarLaneDis@ */ /end MEASUREMENT
/begin MEASUREMENT LATC_LinePreViewDis "" FLOAT32_IEEE autosar_swc_vmc_CM_single 0 0 -3.4E+38 3.4E+38 ECU_ADDRESS 0xfe4cc0ac /* @ECU_Address@LATC_LinePreViewDis@ */ /end MEASUREMENT
/begin MEASUREMENT LATC_LinePreViewT "" FLOAT32_IEEE autosar_swc_vmc_CM_single 0 0 -3.4E+38 3.4E+38 ECU_ADDRESS 0xfe4cc0b0 /* @ECU_Address@LATC_LinePreViewT@ */ /end MEASUREMENT
/begin MEASUREMENT LATC_OUT_AngCmdReqValVld "" UBYTE autosar_swc_vmc_CM_uint8 0 0 0 255 ECU_ADDRESS 0xfe4cc295 /* @ECU_Address@LATC_OUT_AngCmdReqValVld@ */ /end MEASUREMENT
/begin MEASUREMENT LATC_OUT_ReqEPSTrgAngle "" FLOAT32_IEEE autosar_swc_vmc_CM_single 0 0 -3.4E+38 3.4E+38 ECU_ADDRESS 0xfe4cc0b4 /* @ECU_Address@LATC_OUT_ReqEPSTrgAngle@ */ /end MEASUREMENT
/begin MEASUREMENT LATC_OffSetUpdate_Flg "" UBYTE autosar_swc_vmc_CM_boolean 0 0 0 1 ECU_ADDRESS 0xfe4cc296 /* @ECU_Address@LATC_OffSetUpdate_Flg@ */ /end MEASUREMENT
/begin MEASUREMENT LATC_Poly_vec "" FLOAT32_IEEE autosar_swc_vmc_CM_single 0 0 -3.4E+38 3.4E+38 LAYOUT COLUMN_DIR MATRIX_DIM 6 1 ECU_ADDRESS 0xfe4cbcc0 /* @ECU_Address@LATC_Poly_vec@ */ /end MEASUREMENT
/begin MEASUREMENT LATC_PreDisReductionFlg "" UBYTE autosar_swc_vmc_CM_uint8 0 0 0 255 ECU_ADDRESS 0xfe4cc297 /* @ECU_Address@LATC_PreDisReductionFlg@ */ /end MEASUREMENT
/begin MEASUREMENT LATC_PreViewPointsCurve "" FLOAT32_IEEE autosar_swc_vmc_CM_single 0 0 -3.4E+38 3.4E+38 ECU_ADDRESS 0xfe4cc0b8 /* @ECU_Address@LATC_PreViewPointsCurve@ */ /end MEASUREMENT
/begin MEASUREMENT LATC_Predis_BaseDis "" FLOAT32_IEEE autosar_swc_vmc_CM_single 0 0 -3.4E+38 3.4E+38 ECU_ADDRESS 0xfe4cc0bc /* @ECU_Address@LATC_Predis_BaseDis@ */ /end MEASUREMENT
/begin MEASUREMENT LATC_Predis_Curve "" FLOAT32_IEEE autosar_swc_vmc_CM_single 0 0 -3.4E+38 3.4E+38 ECU_ADDRESS 0xfe4cc0c0 /* @ECU_Address@LATC_Predis_Curve@ */ /end MEASUREMENT
/begin MEASUREMENT LATC_Predis_CurveFac "" FLOAT32_IEEE autosar_swc_vmc_CM_single 0 0 -3.4E+38 3.4E+38 ECU_ADDRESS 0xfe4cc0c4 /* @ECU_Address@LATC_Predis_CurveFac@ */ /end MEASUREMENT
/begin MEASUREMENT LATC_PsiDtAckValue "" FLOAT32_IEEE autosar_swc_vmc_CM_single 0 0 -3.4E+38 3.4E+38 ECU_ADDRESS 0xfe4cc0c8 /* @ECU_Address@LATC_PsiDtAckValue@ */ /end MEASUREMENT
/begin MEASUREMENT LATC_Q "" FLOAT32_IEEE autosar_swc_vmc_CM_single 0 0 -3.4E+38 3.4E+38 ECU_ADDRESS 0xfe4cc0cc /* @ECU_Address@LATC_Q@ */ /end MEASUREMENT
/begin MEASUREMENT LATC_StateActive_AngleSlope "" FLOAT32_IEEE autosar_swc_vmc_CM_single 0 0 -3.4E+38 3.4E+38 ECU_ADDRESS 0xfe4cc0d0 /* @ECU_Address@LATC_StateActive_AngleSlope@ */ /end MEASUREMENT
/begin MEASUREMENT LATC_StateActive_MinAngleSlope "" FLOAT32_IEEE autosar_swc_vmc_CM_single 0 0 -3.4E+38 3.4E+38 ECU_ADDRESS 0xfe4cc0d4 /* @ECU_Address@LATC_StateActive_MinAngleSlope@ */ /end MEASUREMENT
/begin MEASUREMENT LATC_State_AngleSlope "" FLOAT32_IEEE autosar_swc_vmc_CM_single 0 0 -3.4E+38 3.4E+38 ECU_ADDRESS 0xfe4cc0d8 /* @ECU_Address@LATC_State_AngleSlope@ */ /end MEASUREMENT
/begin MEASUREMENT LATC_TarAngleLastPoint_X "" FLOAT32_IEEE autosar_swc_vmc_CM_single 0 0 -3.4E+38 3.4E+38 ECU_ADDRESS 0xfe4cc0dc /* @ECU_Address@LATC_TarAngleLastPoint_X@ */ /end MEASUREMENT
/begin MEASUREMENT LATC_TarAngleLastPoint_Y "" FLOAT32_IEEE autosar_swc_vmc_CM_single 0 0 -3.4E+38 3.4E+38 ECU_ADDRESS 0xfe4cc0e0 /* @ECU_Address@LATC_TarAngleLastPoint_Y@ */ /end MEASUREMENT
/begin MEASUREMENT LATC_TarAngle_MaxAng "" FLOAT32_IEEE autosar_swc_vmc_CM_single 0 0 -3.4E+38 3.4E+38 ECU_ADDRESS 0xfe4cc0e4 /* @ECU_Address@LATC_TarAngle_MaxAng@ */ /end MEASUREMENT
/begin MEASUREMENT LATC_TarAngle_MaxAngSpd "" FLOAT32_IEEE autosar_swc_vmc_CM_single 0 0 -3.4E+38 3.4E+38 ECU_ADDRESS 0xfe4cc0e8 /* @ECU_Address@LATC_TarAngle_MaxAngSpd@ */ /end MEASUREMENT
/begin MEASUREMENT LATC_TarSteerAngleCalc_J "" FLOAT32_IEEE autosar_swc_vmc_CM_single 0 0 -3.4E+38 3.4E+38 LAYOUT COLUMN_DIR MATRIX_DIM 23 ECU_ADDRESS 0xfe4cc0ec /* @ECU_Address@LATC_TarSteerAngleCalc_J@ */ /end MEASUREMENT
/begin MEASUREMENT LATC_TarSteerAngleCalc_Jq "" FLOAT32_IEEE autosar_swc_vmc_CM_single 0 0 -3.4E+38 3.4E+38 LAYOUT COLUMN_DIR MATRIX_DIM 23 ECU_ADDRESS 0xfe4cc148 /* @ECU_Address@LATC_TarSteerAngleCalc_Jq@ */ /end MEASUREMENT
/begin MEASUREMENT LATC_TarSteerAngleCalc_Jr1 "" FLOAT32_IEEE autosar_swc_vmc_CM_single 0 0 -3.4E+38 3.4E+38 LAYOUT COLUMN_DIR MATRIX_DIM 23 ECU_ADDRESS 0xfe4cc1a4 /* @ECU_Address@LATC_TarSteerAngleCalc_Jr1@ */ /end MEASUREMENT
/begin MEASUREMENT LATC_TarSteerAngleCalc_Num "" FLOAT32_IEEE autosar_swc_vmc_CM_single 0 0 -3.4E+38 3.4E+38 ECU_ADDRESS 0xfe4cc200 /* @ECU_Address@LATC_TarSteerAngleCalc_Num@ */ /end MEASUREMENT
/begin MEASUREMENT LATC_TarSteerAngleCalc_XX "" FLOAT32_IEEE autosar_swc_vmc_CM_single 0 0 -3.4E+38 3.4E+38 LAYOUT COLUMN_DIR MATRIX_DIM 20 1 ECU_ADDRESS 0xfe4cbcd8 /* @ECU_Address@LATC_TarSteerAngleCalc_XX@ */ /end MEASUREMENT
/begin MEASUREMENT LATC_TarSteerAngleCalc_YY "" FLOAT32_IEEE autosar_swc_vmc_CM_single 0 0 -3.4E+38 3.4E+38 LAYOUT COLUMN_DIR MATRIX_DIM 20 1 ECU_ADDRESS 0xfe4cbd28 /* @ECU_Address@LATC_TarSteerAngleCalc_YY@ */ /end MEASUREMENT
/begin MEASUREMENT LATC_TarSteerAngleCalc_Yaw "" FLOAT32_IEEE autosar_swc_vmc_CM_single 0 0 -3.4E+38 3.4E+38 ECU_ADDRESS 0xfe4cc204 /* @ECU_Address@LATC_TarSteerAngleCalc_Yaw@ */ /end MEASUREMENT
/begin MEASUREMENT LATC_TarSteerAngleEnd "" FLOAT32_IEEE autosar_swc_vmc_CM_single 0 0 -3.4E+38 3.4E+38 ECU_ADDRESS 0xfe4cc208 /* @ECU_Address@LATC_TarSteerAngleEnd@ */ /end MEASUREMENT
/begin MEASUREMENT LATC_TarSteerAngleSlope "" FLOAT32_IEEE autosar_swc_vmc_CM_single 0 0 -3.4E+38 3.4E+38 ECU_ADDRESS 0xfe4cc20c /* @ECU_Address@LATC_TarSteerAngleSlope@ */ /end MEASUREMENT
/begin MEASUREMENT LATC_TarSteerAngle_Addoffset "" FLOAT32_IEEE autosar_swc_vmc_CM_single 0 0 -3.4E+38 3.4E+38 ECU_ADDRESS 0xfe4cc210 /* @ECU_Address@LATC_TarSteerAngle_Addoffset@ */ /end MEASUREMENT
/begin MEASUREMENT LATC_TarSteerAngle_FilterTime "" FLOAT32_IEEE autosar_swc_vmc_CM_single 0 0 -3.4E+38 3.4E+38 ECU_ADDRESS 0xfe4cc214 /* @ECU_Address@LATC_TarSteerAngle_FilterTime@ */ /end MEASUREMENT
/begin MEASUREMENT LATC_TarSteerAnglecala "" FLOAT32_IEEE autosar_swc_vmc_CM_single 0 0 -3.4E+38 3.4E+38 ECU_ADDRESS 0xfe4cc218 /* @ECU_Address@LATC_TarSteerAnglecala@ */ /end MEASUREMENT
/begin MEASUREMENT LATC_VIE_SteerAngOffset_deg "" FLOAT32_IEEE autosar_swc_vmc_CM_single 0 0 -3.4E+38 3.4E+38 ECU_ADDRESS 0xfe4cc21c /* @ECU_Address@LATC_VIE_SteerAngOffset_deg@ */ /end MEASUREMENT
/begin MEASUREMENT LATC_communicationTest_IFCAngCmdReqValue "" FLOAT32_IEEE autosar_swc_vmc_CM_single 0 0 -3.4E+38 3.4E+38 MATRIX_DIM 1 1 ECU_ADDRESS 0xfe4cc220 /* @ECU_Address@LATC_communicationTest_IFCAngCmdReqValue@ */ /end MEASUREMENT
/begin MEASUREMENT LATC_communicationTest_IFCFuncAngCmdReqFlag "" UBYTE autosar_swc_vmc_CM_uint8 0 0 0 255 MATRIX_DIM 1 1 ECU_ADDRESS 0xfe4cc298 /* @ECU_Address@LATC_communicationTest_IFCFuncAngCmdReqFlag@ */ /end MEASUREMENT
/begin MEASUREMENT LATC_communicationTest_IFCFuncTrqCmdReqFlag "" UBYTE autosar_swc_vmc_CM_uint8 0 0 0 255 MATRIX_DIM 1 1 ECU_ADDRESS 0xfe4cc299 /* @ECU_Address@LATC_communicationTest_IFCFuncTrqCmdReqFlag@ */ /end MEASUREMENT
/begin MEASUREMENT LATC_communicationTest_IFCTrqOvlCmdReqValue "" FLOAT32_IEEE autosar_swc_vmc_CM_single 0 0 -3.4E+38 3.4E+38 MATRIX_DIM 1 1 ECU_ADDRESS 0xfe4cc224 /* @ECU_Address@LATC_communicationTest_IFCTrqOvlCmdReqValue@ */ /end MEASUREMENT
/begin MEASUREMENT LATC_finalPredis "" FLOAT32_IEEE autosar_swc_vmc_CM_single 0 0 -3.4E+38 3.4E+38 ECU_ADDRESS 0xfe4cc228 /* @ECU_Address@LATC_finalPredis@ */ /end MEASUREMENT
/begin MEASUREMENT LongCtrl_VLC_FF_FxvReqRaw "" FLOAT32_IEEE autosar_swc_vmc_CM_single 0 0 -3.4E+38 3.4E+38 MATRIX_DIM 1 1 ECU_ADDRESS 0xfe4cc22c /* @ECU_Address@LongCtrl_VLC_FF_FxvReqRaw@ */ /end MEASUREMENT
/begin MEASUREMENT LongCtrl_VLC_FF_WheelTrqInc "" FLOAT32_IEEE autosar_swc_vmc_CM_single 0 0 -3.4E+38 3.4E+38 MATRIX_DIM 1 1 ECU_ADDRESS 0xfe4cc230 /* @ECU_Address@LongCtrl_VLC_FF_WheelTrqInc@ */ /end MEASUREMENT
/begin MEASUREMENT LongCtrl_VLC_ICtrl_FxvRaw "" FLOAT32_IEEE autosar_swc_vmc_CM_single 0 0 -3.4E+38 3.4E+38 MATRIX_DIM 1 1 ECU_ADDRESS 0xfe4cc234 /* @ECU_Address@LongCtrl_VLC_ICtrl_FxvRaw@ */ /end MEASUREMENT
/begin MEASUREMENT LongCtrl_VLC_ICtrl_Ki "" FLOAT32_IEEE autosar_swc_vmc_CM_single 0 0 -3.4E+38 3.4E+38 MATRIX_DIM 1 1 ECU_ADDRESS 0xfe4cc238 /* @ECU_Address@LongCtrl_VLC_ICtrl_Ki@ */ /end MEASUREMENT
/begin MEASUREMENT LongCtrl_VLC_PCtrl_FxvRaw "" FLOAT32_IEEE autosar_swc_vmc_CM_single 0 0 -3.4E+38 3.4E+38 MATRIX_DIM 1 1 ECU_ADDRESS 0xfe4cc23c /* @ECU_Address@LongCtrl_VLC_PCtrl_FxvRaw@ */ /end MEASUREMENT
/begin MEASUREMENT LongCtrl_VLC_PI_WheelTrqReq "" FLOAT32_IEEE autosar_swc_vmc_CM_single 0 0 -3.4E+38 3.4E+38 MATRIX_DIM 1 1 ECU_ADDRESS 0xfe4cc240 /* @ECU_Address@LongCtrl_VLC_PI_WheelTrqReq@ */ /end MEASUREMENT
/begin MEASUREMENT LongCtrl_VLC_WheelTrqReqMax "" FLOAT32_IEEE autosar_swc_vmc_CM_single 0 0 -3.4E+38 3.4E+38 MATRIX_DIM 1 1 ECU_ADDRESS 0xfe4cc244 /* @ECU_Address@LongCtrl_VLC_WheelTrqReqMax@ */ /end MEASUREMENT
/begin MEASUREMENT LongCtrl_VLC_WheelTrqReqMin "" FLOAT32_IEEE autosar_swc_vmc_CM_single 0 0 -3.4E+38 3.4E+38 MATRIX_DIM 1 1 ECU_ADDRESS 0xfe4cc248 /* @ECU_Address@LongCtrl_VLC_WheelTrqReqMin@ */ /end MEASUREMENT
/begin MEASUREMENT LongCtrl_VLC_WheelTrqReqRaw "" FLOAT32_IEEE autosar_swc_vmc_CM_single 0 0 -3.4E+38 3.4E+38 MATRIX_DIM 1 1 ECU_ADDRESS 0xfe4cc24c /* @ECU_Address@LongCtrl_VLC_WheelTrqReqRaw@ */ /end MEASUREMENT
/begin MEASUREMENT autosar_swc_vmc_rtARID_DEF.Cnt "" UBYTE autosar_swc_vmc_CM_uint8 0 0 0 255 ECU_ADDRESS 0xfe4cc001 /* @ECU_Address@autosar_swc_vmc_rtARID_DEF.Cnt@ */ /end MEASUREMENT
/begin MEASUREMENT autosar_swc_vmc_rtARID_DEF.Cnt_Flag "" UBYTE autosar_swc_vmc_CM_logical 0 0 0 1 ECU_ADDRESS 0xfe4cc01c /* @ECU_Address@autosar_swc_vmc_rtARID_DEF.Cnt_Flag@ */ /end MEASUREMENT
/begin MEASUREMENT autosar_swc_vmc_rtARID_DEF.Compare "" UBYTE autosar_swc_vmc_CM_logical 0 0 0 1 MATRIX_DIM 1 1 ECU_ADDRESS 0xfe4cc008 /* @ECU_Address@autosar_swc_vmc_rtARID_DEF.Compare@ */ /end MEASUREMENT
/begin MEASUREMENT autosar_swc_vmc_rtARID_DEF.DCEnable "" UBYTE autosar_swc_vmc_CM_logical 0 0 0 1 ECU_ADDRESS 0xfe4cc00b /* @ECU_Address@autosar_swc_vmc_rtARID_DEF.DCEnable@ */ /end MEASUREMENT
/begin MEASUREMENT autosar_swc_vmc_rtARID_DEF.DelayInput1_DSTATE "" UBYTE autosar_swc_vmc_CM_logical 0 0 0 1 ECU_ADDRESS 0xfe4cc014 /* @ECU_Address@autosar_swc_vmc_rtARID_DEF.DelayInput1_DSTATE@ */ /end MEASUREMENT
/begin MEASUREMENT autosar_swc_vmc_rtARID_DEF.DirFlg "" UBYTE autosar_swc_vmc_CM_uint8 0 0 0 255 ECU_ADDRESS 0xfe4cbff8 /* @ECU_Address@autosar_swc_vmc_rtARID_DEF.DirFlg@ */ /end MEASUREMENT
/begin MEASUREMENT autosar_swc_vmc_rtARID_DEF.ECEnable "" UBYTE autosar_swc_vmc_CM_logical 0 0 0 1 ECU_ADDRESS 0xfe4cc00a /* @ECU_Address@autosar_swc_vmc_rtARID_DEF.ECEnable@ */ /end MEASUREMENT
/begin MEASUREMENT autosar_swc_vmc_rtARID_DEF.EnableFlg0CountK1 "" UBYTE autosar_swc_vmc_CM_uint8 0 0 0 255 ECU_ADDRESS 0xfe4cbfff /* @ECU_Address@autosar_swc_vmc_rtARID_DEF.EnableFlg0CountK1@ */ /end MEASUREMENT
/begin MEASUREMENT autosar_swc_vmc_rtARID_DEF.EnableFlgK1 "" UBYTE autosar_swc_vmc_CM_uint8 0 0 0 255 ECU_ADDRESS 0xfe4cbffe /* @ECU_Address@autosar_swc_vmc_rtARID_DEF.EnableFlgK1@ */ /end MEASUREMENT
/begin MEASUREMENT autosar_swc_vmc_rtARID_DEF.EnableK1 "" UBYTE autosar_swc_vmc_CM_uint8 0 0 0 255 ECU_ADDRESS 0xfe4cbff9 /* @ECU_Address@autosar_swc_vmc_rtARID_DEF.EnableK1@ */ /end MEASUREMENT
/begin MEASUREMENT autosar_swc_vmc_rtARID_DEF.EnableK1_not_empty "" UBYTE autosar_swc_vmc_CM_logical 0 0 0 1 ECU_ADDRESS 0xfe4cc019 /* @ECU_Address@autosar_swc_vmc_rtARID_DEF.EnableK1_not_empty@ */ /end MEASUREMENT
/begin MEASUREMENT autosar_swc_vmc_rtARID_DEF.EngSpdControl "" UBYTE autosar_swc_vmc_CM_logical 0 0 0 1 ECU_ADDRESS 0xfe4cc009 /* @ECU_Address@autosar_swc_vmc_rtARID_DEF.EngSpdControl@ */ /end MEASUREMENT
/begin MEASUREMENT autosar_swc_vmc_rtARID_DEF.EngSpdControlK1 "" UBYTE autosar_swc_vmc_CM_logical 0 0 0 1 ECU_ADDRESS 0xfe4cc017 /* @ECU_Address@autosar_swc_vmc_rtARID_DEF.EngSpdControlK1@ */ /end MEASUREMENT
/begin MEASUREMENT autosar_swc_vmc_rtARID_DEF.EngTorqReqMax "" FLOAT32_IEEE autosar_swc_vmc_CM_single 0 0 -3.4E+38 3.4E+38 ECU_ADDRESS 0xfe4cbf10 /* @ECU_Address@autosar_swc_vmc_rtARID_DEF.EngTorqReqMax@ */ /end MEASUREMENT
/begin MEASUREMENT autosar_swc_vmc_rtARID_DEF.FLg "" UBYTE autosar_swc_vmc_CM_uint8 0 0 0 255 ECU_ADDRESS 0xfe4cc002 /* @ECU_Address@autosar_swc_vmc_rtARID_DEF.FLg@ */ /end MEASUREMENT
/begin MEASUREMENT autosar_swc_vmc_rtARID_DEF.LONC_EngTrqReqValueK1 "" FLOAT32_IEEE autosar_swc_vmc_CM_single 0 0 -3.4E+38 3.4E+38 ECU_ADDRESS 0xfe4cbfbc /* @ECU_Address@autosar_swc_vmc_rtARID_DEF.LONC_EngTrqReqValueK1@ */ /end MEASUREMENT
/begin MEASUREMENT autosar_swc_vmc_rtARID_DEF.LaneJumpModeActive "" UBYTE autosar_swc_vmc_CM_logical 0 0 0 1 ECU_ADDRESS 0xfe4cc01a /* @ECU_Address@autosar_swc_vmc_rtARID_DEF.LaneJumpModeActive@ */ /end MEASUREMENT
/begin MEASUREMENT autosar_swc_vmc_rtARID_DEF.LastPointWithTarLaneDisK1 "" FLOAT32_IEEE autosar_swc_vmc_CM_single 0 0 -3.4E+38 3.4E+38 ECU_ADDRESS 0xfe4cbfd8 /* @ECU_Address@autosar_swc_vmc_rtARID_DEF.LastPointWithTarLaneDisK1@ */ /end MEASUREMENT
/begin MEASUREMENT autosar_swc_vmc_rtARID_DEF.LastState "" UBYTE autosar_swc_vmc_CM_uint8 0 0 0 255 ECU_ADDRESS 0xfe4cbffb /* @ECU_Address@autosar_swc_vmc_rtARID_DEF.LastState@ */ /end MEASUREMENT
/begin MEASUREMENT autosar_swc_vmc_rtARID_DEF.Mean_AccVal "" FLOAT32_IEEE autosar_swc_vmc_CM_single 0 0 -3.4E+38 3.4E+38 ECU_ADDRESS 0xfe4cbfb4 /* @ECU_Address@autosar_swc_vmc_rtARID_DEF.Mean_AccVal@ */ /end MEASUREMENT
/begin MEASUREMENT autosar_swc_vmc_rtARID_DEF.Memory2_PreviousInput "" FLOAT32_IEEE autosar_swc_vmc_CM_single 0 0 -3.4E+38 3.4E+38 ECU_ADDRESS 0xfe4cbfb8 /* @ECU_Address@autosar_swc_vmc_rtARID_DEF.Memory2_PreviousInput@ */ /end MEASUREMENT
/begin MEASUREMENT autosar_swc_vmc_rtARID_DEF.OutValueK1 "" FLOAT32_IEEE autosar_swc_vmc_CM_single 0 0 -3.4E+38 3.4E+38 ECU_ADDRESS 0xfe4cbfd4 /* @ECU_Address@autosar_swc_vmc_rtARID_DEF.OutValueK1@ */ /end MEASUREMENT
/begin MEASUREMENT autosar_swc_vmc_rtARID_DEF.TappedDelay1_X "" UBYTE autosar_swc_vmc_CM_logical 0 0 0 1 ECU_ADDRESS 0xfe4cc00f /* @ECU_Address@autosar_swc_vmc_rtARID_DEF.TappedDelay1_X@ */ /end MEASUREMENT
/begin MEASUREMENT autosar_swc_vmc_rtARID_DEF.TappedDelay1_X_i "" UBYTE autosar_swc_vmc_CM_logical 0 0 0 1 ECU_ADDRESS 0xfe4cc011 /* @ECU_Address@autosar_swc_vmc_rtARID_DEF.TappedDelay1_X_i@ */ /end MEASUREMENT
/begin MEASUREMENT autosar_swc_vmc_rtARID_DEF.TappedDelay2_X "" UBYTE autosar_swc_vmc_CM_logical 0 0 0 1 LAYOUT COLUMN_DIR MATRIX_DIM 5 ECU_ADDRESS 0xfe4cc003 /* @ECU_Address@autosar_swc_vmc_rtARID_DEF.TappedDelay2_X@ */ /end MEASUREMENT
/begin MEASUREMENT autosar_swc_vmc_rtARID_DEF.TappedDelay4_X "" UBYTE autosar_swc_vmc_CM_logical 0 0 0 1 ECU_ADDRESS 0xfe4cc00d /* @ECU_Address@autosar_swc_vmc_rtARID_DEF.TappedDelay4_X@ */ /end MEASUREMENT
/begin MEASUREMENT autosar_swc_vmc_rtARID_DEF.TappedDelay4_X_b "" UBYTE autosar_swc_vmc_CM_logical 0 0 0 1 ECU_ADDRESS 0xfe4cc010 /* @ECU_Address@autosar_swc_vmc_rtARID_DEF.TappedDelay4_X_b@ */ /end MEASUREMENT
/begin MEASUREMENT autosar_swc_vmc_rtARID_DEF.TappedDelay4_X_i "" UBYTE autosar_swc_vmc_CM_logical 0 0 0 1 ECU_ADDRESS 0xfe4cc00e /* @ECU_Address@autosar_swc_vmc_rtARID_DEF.TappedDelay4_X_i@ */ /end MEASUREMENT
/begin MEASUREMENT autosar_swc_vmc_rtARID_DEF.TappedDelay5_X "" UBYTE autosar_swc_vmc_CM_uint8 0 0 0 255 ECU_ADDRESS 0xfe4cbff3 /* @ECU_Address@autosar_swc_vmc_rtARID_DEF.TappedDelay5_X@ */ /end MEASUREMENT
/begin MEASUREMENT autosar_swc_vmc_rtARID_DEF.TappedDelay_X "" FLOAT32_IEEE autosar_swc_vmc_CM_single 0 0 -3.4E+38 3.4E+38 LAYOUT COLUMN_DIR MATRIX_DIM 5 ECU_ADDRESS 0xfe4cbeb0 /* @ECU_Address@autosar_swc_vmc_rtARID_DEF.TappedDelay_X@ */ /end MEASUREMENT
/begin MEASUREMENT autosar_swc_vmc_rtARID_DEF.TappedDelay_X_d "" UBYTE autosar_swc_vmc_CM_uint8 0 0 0 255 ECU_ADDRESS 0xfe4cbff4 /* @ECU_Address@autosar_swc_vmc_rtARID_DEF.TappedDelay_X_d@ */ /end MEASUREMENT
/begin MEASUREMENT autosar_swc_vmc_rtARID_DEF.Taraccelk1 "" FLOAT32_IEEE autosar_swc_vmc_CM_single 0 0 -3.4E+38 3.4E+38 ECU_ADDRESS 0xfe4cbfd0 /* @ECU_Address@autosar_swc_vmc_rtARID_DEF.Taraccelk1@ */ /end MEASUREMENT
/begin MEASUREMENT autosar_swc_vmc_rtARID_DEF.TmpSignalConversionAtVAL_VEHICLE_STATEOutport1.BlindTemp "" UBYTE autosar_swc_vmc_CM_logical 0 0 0 1 ECU_ADDRESS 0xfe4cbdae /* @ECU_Address@autosar_swc_vmc_rtARID_DEF.TmpSignalConversionAtVAL_VEHICLE_STATEOutport1.BlindTemp@ */ /end MEASUREMENT
/begin MEASUREMENT autosar_swc_vmc_rtARID_DEF.TmpSignalConversionAtVAL_VEHICLE_STATEOutport1.CurrentGear "" UBYTE autosar_swc_vmc_CM_uint8 0 0 0 255 ECU_ADDRESS 0xfe4cbdb0 /* @ECU_Address@autosar_swc_vmc_rtARID_DEF.TmpSignalConversionAtVAL_VEHICLE_STATEOutport1.CurrentGear@ */ /end MEASUREMENT
/begin MEASUREMENT autosar_swc_vmc_rtARID_DEF.TmpSignalConversionAtVAL_VEHICLE_STATEOutport1.EngSpd "" FLOAT32_IEEE autosar_swc_vmc_CM_single 0 0 -3.4E+38 3.4E+38 ECU_ADDRESS 0xfe4cbdf8 /* @ECU_Address@autosar_swc_vmc_rtARID_DEF.TmpSignalConversionAtVAL_VEHICLE_STATEOutport1.EngSpd@ */ /end MEASUREMENT
/begin MEASUREMENT autosar_swc_vmc_rtARID_DEF.TmpSignalConversionAtVAL_VEHICLE_STATEOutport1.EngTrqMinAct "" FLOAT32_IEEE autosar_swc_vmc_CM_single 0 0 -3.4E+38 3.4E+38 ECU_ADDRESS 0xfe4cbdf4 /* @ECU_Address@autosar_swc_vmc_rtARID_DEF.TmpSignalConversionAtVAL_VEHICLE_STATEOutport1.EngTrqMinAct@ */ /end MEASUREMENT
/begin MEASUREMENT autosar_swc_vmc_rtARID_DEF.TmpSignalConversionAtVAL_VEHICLE_STATEOutport1.EngTrqMinNm "" FLOAT32_IEEE autosar_swc_vmc_CM_single 0 0 -3.4E+38 3.4E+38 ECU_ADDRESS 0xfe4cbde8 /* @ECU_Address@autosar_swc_vmc_rtARID_DEF.TmpSignalConversionAtVAL_VEHICLE_STATEOutport1.EngTrqMinNm@ */ /end MEASUREMENT
/begin MEASUREMENT autosar_swc_vmc_rtARID_DEF.TmpSignalConversionAtVAL_VEHICLE_STATEOutport1.EngTrqNm "" FLOAT32_IEEE autosar_swc_vmc_CM_single 0 0 -3.4E+38 3.4E+38 ECU_ADDRESS 0xfe4cbde4 /* @ECU_Address@autosar_swc_vmc_rtARID_DEF.TmpSignalConversionAtVAL_VEHICLE_STATEOutport1.EngTrqNm@ */ /end MEASUREMENT
/begin MEASUREMENT autosar_swc_vmc_rtARID_DEF.TmpSignalConversionAtVAL_VEHICLE_STATEOutport1.EngineOn "" UBYTE autosar_swc_vmc_CM_logical 0 0 0 1 ECU_ADDRESS 0xfe4cbda9 /* @ECU_Address@autosar_swc_vmc_rtARID_DEF.TmpSignalConversionAtVAL_VEHICLE_STATEOutport1.EngineOn@ */ /end MEASUREMENT
/begin MEASUREMENT autosar_swc_vmc_rtARID_DEF.TmpSignalConversionAtVAL_VEHICLE_STATEOutport1.FAShiftInProgress "" UBYTE autosar_swc_vmc_CM_logical 0 0 0 1 ECU_ADDRESS 0xfe4cbdaa /* @ECU_Address@autosar_swc_vmc_rtARID_DEF.TmpSignalConversionAtVAL_VEHICLE_STATEOutport1.FAShiftInProgress@ */ /end MEASUREMENT
/begin MEASUREMENT autosar_swc_vmc_rtARID_DEF.TmpSignalConversionAtVAL_VEHICLE_STATEOutport1.FLWheelPulseCounter "" ULONG autosar_swc_vmc_CM_uint32 0 0 0 4294967295 ECU_ADDRESS 0xfe4cbe20 /* @ECU_Address@autosar_swc_vmc_rtARID_DEF.TmpSignalConversionAtVAL_VEHICLE_STATEOutport1.FLWheelPulseCounter@ */ /end MEASUREMENT
/begin MEASUREMENT autosar_swc_vmc_rtARID_DEF.TmpSignalConversionAtVAL_VEHICLE_STATEOutport1.FLWheelSpdMps "" FLOAT32_IEEE autosar_swc_vmc_CM_single 0 0 -3.4E+38 3.4E+38 ECU_ADDRESS 0xfe4cbdfc /* @ECU_Address@autosar_swc_vmc_rtARID_DEF.TmpSignalConversionAtVAL_VEHICLE_STATEOutport1.FLWheelSpdMps@ */ /end MEASUREMENT
/begin MEASUREMENT autosar_swc_vmc_rtARID_DEF.TmpSignalConversionAtVAL_VEHICLE_STATEOutport1.FRWheelPulseCounter "" ULONG autosar_swc_vmc_CM_uint32 0 0 0 4294967295 ECU_ADDRESS 0xfe4cbe24 /* @ECU_Address@autosar_swc_vmc_rtARID_DEF.TmpSignalConversionAtVAL_VEHICLE_STATEOutport1.FRWheelPulseCounter@ */ /end MEASUREMENT
/begin MEASUREMENT autosar_swc_vmc_rtARID_DEF.TmpSignalConversionAtVAL_VEHICLE_STATEOutport1.FRWheelSpdMps "" FLOAT32_IEEE autosar_swc_vmc_CM_single 0 0 -3.4E+38 3.4E+38 ECU_ADDRESS 0xfe4cbe00 /* @ECU_Address@autosar_swc_vmc_rtARID_DEF.TmpSignalConversionAtVAL_VEHICLE_STATEOutport1.FRWheelSpdMps@ */ /end MEASUREMENT
/begin MEASUREMENT autosar_swc_vmc_rtARID_DEF.TmpSignalConversionAtVAL_VEHICLE_STATEOutport1.FourWhlsBrkTrq "" UWORD autosar_swc_vmc_CM_uint16 0 0 0 65535 ECU_ADDRESS 0xfe4cbdba /* @ECU_Address@autosar_swc_vmc_rtARID_DEF.TmpSignalConversionAtVAL_VEHICLE_STATEOutport1.FourWhlsBrkTrq@ */ /end MEASUREMENT
/begin MEASUREMENT autosar_swc_vmc_rtARID_DEF.TmpSignalConversionAtVAL_VEHICLE_STATEOutport1.GearSts "" UBYTE autosar_swc_vmc_CM_uint8 0 0 0 255 ECU_ADDRESS 0xfe4cbdb2 /* @ECU_Address@autosar_swc_vmc_rtARID_DEF.TmpSignalConversionAtVAL_VEHICLE_STATEOutport1.GearSts@ */ /end MEASUREMENT
/begin MEASUREMENT autosar_swc_vmc_rtARID_DEF.TmpSignalConversionAtVAL_VEHICLE_STATEOutport1.IPVehSpdDispKph "" UWORD autosar_swc_vmc_CM_uint16 0 0 0 65535 ECU_ADDRESS 0xfe4cbdb6 /* @ECU_Address@autosar_swc_vmc_rtARID_DEF.TmpSignalConversionAtVAL_VEHICLE_STATEOutport1.IPVehSpdDispKph@ */ /end MEASUREMENT
/begin MEASUREMENT autosar_swc_vmc_rtARID_DEF.TmpSignalConversionAtVAL_VEHICLE_STATEOutport1.IPVehSpdDispKphFloat "" FLOAT32_IEEE autosar_swc_vmc_CM_single 0 0 -3.4E+38 3.4E+38 ECU_ADDRESS 0xfe4cbdc4 /* @ECU_Address@autosar_swc_vmc_rtARID_DEF.TmpSignalConversionAtVAL_VEHICLE_STATEOutport1.IPVehSpdDispKphFloat@ */ /end MEASUREMENT
/begin MEASUREMENT autosar_swc_vmc_rtARID_DEF.TmpSignalConversionAtVAL_VEHICLE_STATEOutport1.IPVehSpdDispMph "" UWORD autosar_swc_vmc_CM_uint16 0 0 0 65535 ECU_ADDRESS 0xfe4cbdb8 /* @ECU_Address@autosar_swc_vmc_rtARID_DEF.TmpSignalConversionAtVAL_VEHICLE_STATEOutport1.IPVehSpdDispMph@ */ /end MEASUREMENT
/begin MEASUREMENT autosar_swc_vmc_rtARID_DEF.TmpSignalConversionAtVAL_VEHICLE_STATEOutport1.IPVehSpdUnit "" UBYTE autosar_swc_vmc_CM_uint8 0 0 0 255 ECU_ADDRESS 0xfe4cbdb4 /* @ECU_Address@autosar_swc_vmc_rtARID_DEF.TmpSignalConversionAtVAL_VEHICLE_STATEOutport1.IPVehSpdUnit@ */ /end MEASUREMENT
/begin MEASUREMENT autosar_swc_vmc_rtARID_DEF.TmpSignalConversionAtVAL_VEHICLE_STATEOutport1.LKACtrDlvdValue "" FLOAT32_IEEE autosar_swc_vmc_CM_single 0 0 -3.4E+38 3.4E+38 ECU_ADDRESS 0xfe4cbdec /* @ECU_Address@autosar_swc_vmc_rtARID_DEF.TmpSignalConversionAtVAL_VEHICLE_STATEOutport1.LKACtrDlvdValue@ */ /end MEASUREMENT
/begin MEASUREMENT autosar_swc_vmc_rtARID_DEF.TmpSignalConversionAtVAL_VEHICLE_STATEOutport1.MasterCylBrkPress "" FLOAT32_IEEE autosar_swc_vmc_CM_single 0 0 -3.4E+38 3.4E+38 ECU_ADDRESS 0xfe4cbdd4 /* @ECU_Address@autosar_swc_vmc_rtARID_DEF.TmpSignalConversionAtVAL_VEHICLE_STATEOutport1.MasterCylBrkPress@ */ /end MEASUREMENT
/begin MEASUREMENT autosar_swc_vmc_rtARID_DEF.TmpSignalConversionAtVAL_VEHICLE_STATEOutport1.MaxEngTrqNorm "" UWORD autosar_swc_vmc_CM_uint16 0 0 0 65535 ECU_ADDRESS 0xfe4cbdbc /* @ECU_Address@autosar_swc_vmc_rtARID_DEF.TmpSignalConversionAtVAL_VEHICLE_STATEOutport1.MaxEngTrqNorm@ */ /end MEASUREMENT
/begin MEASUREMENT autosar_swc_vmc_rtARID_DEF.TmpSignalConversionAtVAL_VEHICLE_STATEOutport1.NetEngTrq "" FLOAT32_IEEE autosar_swc_vmc_CM_single 0 0 -3.4E+38 3.4E+38 ECU_ADDRESS 0xfe4cbdf0 /* @ECU_Address@autosar_swc_vmc_rtARID_DEF.TmpSignalConversionAtVAL_VEHICLE_STATEOutport1.NetEngTrq@ */ /end MEASUREMENT
/begin MEASUREMENT autosar_swc_vmc_rtARID_DEF.TmpSignalConversionAtVAL_VEHICLE_STATEOutport1.NoBrakeForce "" UBYTE autosar_swc_vmc_CM_logical 0 0 0 1 ECU_ADDRESS 0xfe4cbdac /* @ECU_Address@autosar_swc_vmc_rtARID_DEF.TmpSignalConversionAtVAL_VEHICLE_STATEOutport1.NoBrakeForce@ */ /end MEASUREMENT
/begin MEASUREMENT autosar_swc_vmc_rtARID_DEF.TmpSignalConversionAtVAL_VEHICLE_STATEOutport1.RAShiftInProgress "" UBYTE autosar_swc_vmc_CM_logical 0 0 0 1 ECU_ADDRESS 0xfe4cbdab /* @ECU_Address@autosar_swc_vmc_rtARID_DEF.TmpSignalConversionAtVAL_VEHICLE_STATEOutport1.RAShiftInProgress@ */ /end MEASUREMENT
/begin MEASUREMENT autosar_swc_vmc_rtARID_DEF.TmpSignalConversionAtVAL_VEHICLE_STATEOutport1.RLWheelPulseCounter "" ULONG autosar_swc_vmc_CM_uint32 0 0 0 4294967295 ECU_ADDRESS 0xfe4cbe28 /* @ECU_Address@autosar_swc_vmc_rtARID_DEF.TmpSignalConversionAtVAL_VEHICLE_STATEOutport1.RLWheelPulseCounter@ */ /end MEASUREMENT
/begin MEASUREMENT autosar_swc_vmc_rtARID_DEF.TmpSignalConversionAtVAL_VEHICLE_STATEOutport1.RLWheelSpdMps "" FLOAT32_IEEE autosar_swc_vmc_CM_single 0 0 -3.4E+38 3.4E+38 ECU_ADDRESS 0xfe4cbe04 /* @ECU_Address@autosar_swc_vmc_rtARID_DEF.TmpSignalConversionAtVAL_VEHICLE_STATEOutport1.RLWheelSpdMps@ */ /end MEASUREMENT
/begin MEASUREMENT autosar_swc_vmc_rtARID_DEF.TmpSignalConversionAtVAL_VEHICLE_STATEOutport1.RRWheelPulseCounter "" ULONG autosar_swc_vmc_CM_uint32 0 0 0 4294967295 ECU_ADDRESS 0xfe4cbe2c /* @ECU_Address@autosar_swc_vmc_rtARID_DEF.TmpSignalConversionAtVAL_VEHICLE_STATEOutport1.RRWheelPulseCounter@ */ /end MEASUREMENT
/begin MEASUREMENT autosar_swc_vmc_rtARID_DEF.TmpSignalConversionAtVAL_VEHICLE_STATEOutport1.RRWheelSpdMps "" FLOAT32_IEEE autosar_swc_vmc_CM_single 0 0 -3.4E+38 3.4E+38 ECU_ADDRESS 0xfe4cbe08 /* @ECU_Address@autosar_swc_vmc_rtARID_DEF.TmpSignalConversionAtVAL_VEHICLE_STATEOutport1.RRWheelSpdMps@ */ /end MEASUREMENT
/begin MEASUREMENT autosar_swc_vmc_rtARID_DEF.TmpSignalConversionAtVAL_VEHICLE_STATEOutport1.SensorVehLatAccelMps2 "" FLOAT32_IEEE autosar_swc_vmc_CM_single 0 0 -3.4E+38 3.4E+38 ECU_ADDRESS 0xfe4cbe14 /* @ECU_Address@autosar_swc_vmc_rtARID_DEF.TmpSignalConversionAtVAL_VEHICLE_STATEOutport1.SensorVehLatAccelMps2@ */ /end MEASUREMENT
/begin MEASUREMENT autosar_swc_vmc_rtARID_DEF.TmpSignalConversionAtVAL_VEHICLE_STATEOutport1.SensorVehLonAccelMps2 "" FLOAT32_IEEE autosar_swc_vmc_CM_single 0 0 -3.4E+38 3.4E+38 ECU_ADDRESS 0xfe4cbe10 /* @ECU_Address@autosar_swc_vmc_rtARID_DEF.TmpSignalConversionAtVAL_VEHICLE_STATEOutport1.SensorVehLonAccelMps2@ */ /end MEASUREMENT
/begin MEASUREMENT autosar_swc_vmc_rtARID_DEF.TmpSignalConversionAtVAL_VEHICLE_STATEOutport1.SensorVehYawRateRadps "" FLOAT32_IEEE autosar_swc_vmc_CM_single 0 0 -3.4E+38 3.4E+38 ECU_ADDRESS 0xfe4cbe0c /* @ECU_Address@autosar_swc_vmc_rtARID_DEF.TmpSignalConversionAtVAL_VEHICLE_STATEOutport1.SensorVehYawRateRadps@ */ /end MEASUREMENT
/begin MEASUREMENT autosar_swc_vmc_rtARID_DEF.TmpSignalConversionAtVAL_VEHICLE_STATEOutport1.SteerWheelAngle "" FLOAT32_IEEE autosar_swc_vmc_CM_single 0 0 -3.4E+38 3.4E+38 ECU_ADDRESS 0xfe4cbdc8 /* @ECU_Address@autosar_swc_vmc_rtARID_DEF.TmpSignalConversionAtVAL_VEHICLE_STATEOutport1.SteerWheelAngle@ */ /end MEASUREMENT
/begin MEASUREMENT autosar_swc_vmc_rtARID_DEF.TmpSignalConversionAtVAL_VEHICLE_STATEOutport1.SteerWheelSpd "" FLOAT32_IEEE autosar_swc_vmc_CM_single 0 0 -3.4E+38 3.4E+38 ECU_ADDRESS 0xfe4cbdcc /* @ECU_Address@autosar_swc_vmc_rtARID_DEF.TmpSignalConversionAtVAL_VEHICLE_STATEOutport1.SteerWheelSpd@ */ /end MEASUREMENT
/begin MEASUREMENT autosar_swc_vmc_rtARID_DEF.TmpSignalConversionAtVAL_VEHICLE_STATEOutport1.SteerWheelTor "" FLOAT32_IEEE autosar_swc_vmc_CM_single 0 0 -3.4E+38 3.4E+38 ECU_ADDRESS 0xfe4cbdd0 /* @ECU_Address@autosar_swc_vmc_rtARID_DEF.TmpSignalConversionAtVAL_VEHICLE_STATEOutport1.SteerWheelTor@ */ /end MEASUREMENT
/begin MEASUREMENT autosar_swc_vmc_rtARID_DEF.TmpSignalConversionAtVAL_VEHICLE_STATEOutport1.SysPowerMod "" UBYTE autosar_swc_vmc_CM_uint8 0 0 0 255 ECU_ADDRESS 0xfe4cbdb3 /* @ECU_Address@autosar_swc_vmc_rtARID_DEF.TmpSignalConversionAtVAL_VEHICLE_STATEOutport1.SysPowerMod@ */ /end MEASUREMENT
/begin MEASUREMENT autosar_swc_vmc_rtARID_DEF.TmpSignalConversionAtVAL_VEHICLE_STATEOutport1.TargetGear "" UBYTE autosar_swc_vmc_CM_uint8 0 0 0 255 ECU_ADDRESS 0xfe4cbdb1 /* @ECU_Address@autosar_swc_vmc_rtARID_DEF.TmpSignalConversionAtVAL_VEHICLE_STATEOutport1.TargetGear@ */ /end MEASUREMENT
/begin MEASUREMENT autosar_swc_vmc_rtARID_DEF.TmpSignalConversionAtVAL_VEHICLE_STATEOutport1.TimeStampMs "" A_UINT64 autosar_swc_vmc_CM_uint64 0 0 0 18446744073709551615 ECU_ADDRESS 0xfe4cbe30 /* @ECU_Address@autosar_swc_vmc_rtARID_DEF.TmpSignalConversionAtVAL_VEHICLE_STATEOutport1.TimeStampMs@ */ /end MEASUREMENT
/begin MEASUREMENT autosar_swc_vmc_rtARID_DEF.TmpSignalConversionAtVAL_VEHICLE_STATEOutport1.TotalOdometer_km "" ULONG autosar_swc_vmc_CM_uint32 0 0 0 4294967295 ECU_ADDRESS 0xfe4cbe1c /* @ECU_Address@autosar_swc_vmc_rtARID_DEF.TmpSignalConversionAtVAL_VEHICLE_STATEOutport1.TotalOdometer_km@ */ /end MEASUREMENT
/begin MEASUREMENT autosar_swc_vmc_rtARID_DEF.TmpSignalConversionAtVAL_VEHICLE_STATEOutport1.VCUTrqNm "" FLOAT32_IEEE autosar_swc_vmc_CM_single 0 0 -3.4E+38 3.4E+38 ECU_ADDRESS 0xfe4cbde0 /* @ECU_Address@autosar_swc_vmc_rtARID_DEF.TmpSignalConversionAtVAL_VEHICLE_STATEOutport1.VCUTrqNm@ */ /end MEASUREMENT
/begin MEASUREMENT autosar_swc_vmc_rtARID_DEF.TmpSignalConversionAtVAL_VEHICLE_STATEOutport1.VLC_InternalTargetAcceleration "" FLOAT32_IEEE autosar_swc_vmc_CM_single 0 0 -3.4E+38 3.4E+38 ECU_ADDRESS 0xfe4cbe18 /* @ECU_Address@autosar_swc_vmc_rtARID_DEF.TmpSignalConversionAtVAL_VEHICLE_STATEOutport1.VLC_InternalTargetAcceleration@ */ /end MEASUREMENT
/begin MEASUREMENT autosar_swc_vmc_rtARID_DEF.TmpSignalConversionAtVAL_VEHICLE_STATEOutport1.VLC_InternalTargetAccelerationValid "" UBYTE autosar_swc_vmc_CM_logical 0 0 0 1 ECU_ADDRESS 0xfe4cbdad /* @ECU_Address@autosar_swc_vmc_rtARID_DEF.TmpSignalConversionAtVAL_VEHICLE_STATEOutport1.VLC_InternalTargetAccelerationValid@ */ /end MEASUREMENT
/begin MEASUREMENT autosar_swc_vmc_rtARID_DEF.TmpSignalConversionAtVAL_VEHICLE_STATEOutport1.VehSpdKph "" FLOAT32_IEEE autosar_swc_vmc_CM_single 0 0 -3.4E+38 3.4E+38 ECU_ADDRESS 0xfe4cbdc0 /* @ECU_Address@autosar_swc_vmc_rtARID_DEF.TmpSignalConversionAtVAL_VEHICLE_STATEOutport1.VehSpdKph@ */ /end MEASUREMENT
/begin MEASUREMENT autosar_swc_vmc_rtARID_DEF.TmpSignalConversionAtVAL_VEHICLE_STATEOutport1.VehStandstill "" UBYTE autosar_swc_vmc_CM_logical 0 0 0 1 ECU_ADDRESS 0xfe4cbda8 /* @ECU_Address@autosar_swc_vmc_rtARID_DEF.TmpSignalConversionAtVAL_VEHICLE_STATEOutport1.VehStandstill@ */ /end MEASUREMENT
/begin MEASUREMENT autosar_swc_vmc_rtARID_DEF.TmpSignalConversionAtVAL_VEHICLE_STATEOutport1.WheelPulseCounterValid "" UBYTE autosar_swc_vmc_CM_logical 0 0 0 1 ECU_ADDRESS 0xfe4cbdaf /* @ECU_Address@autosar_swc_vmc_rtARID_DEF.TmpSignalConversionAtVAL_VEHICLE_STATEOutport1.WheelPulseCounterValid@ */ /end MEASUREMENT
/begin MEASUREMENT autosar_swc_vmc_rtARID_DEF.TmpSignalConversionAtVAL_VEHICLE_STATEOutport1.WheelTrqMinNm "" FLOAT32_IEEE autosar_swc_vmc_CM_single 0 0 -3.4E+38 3.4E+38 ECU_ADDRESS 0xfe4cbddc /* @ECU_Address@autosar_swc_vmc_rtARID_DEF.TmpSignalConversionAtVAL_VEHICLE_STATEOutport1.WheelTrqMinNm@ */ /end MEASUREMENT
/begin MEASUREMENT autosar_swc_vmc_rtARID_DEF.TmpSignalConversionAtVAL_VEHICLE_STATEOutport1.WheelTrqNm "" FLOAT32_IEEE autosar_swc_vmc_CM_single 0 0 -3.4E+38 3.4E+38 ECU_ADDRESS 0xfe4cbdd8 /* @ECU_Address@autosar_swc_vmc_rtARID_DEF.TmpSignalConversionAtVAL_VEHICLE_STATEOutport1.WheelTrqNm@ */ /end MEASUREMENT
/begin MEASUREMENT autosar_swc_vmc_rtARID_DEF.UnitDelay19_DSTATE "" UBYTE autosar_swc_vmc_CM_uint8 0 0 0 255 ECU_ADDRESS 0xfe4cbfec /* @ECU_Address@autosar_swc_vmc_rtARID_DEF.UnitDelay19_DSTATE@ */ /end MEASUREMENT
/begin MEASUREMENT autosar_swc_vmc_rtARID_DEF.UnitDelay1_DSTATE_b "" FLOAT32_IEEE autosar_swc_vmc_CM_single 0 0 -3.4E+38 3.4E+38 ECU_ADDRESS 0xfe4cbf54 /* @ECU_Address@autosar_swc_vmc_rtARID_DEF.UnitDelay1_DSTATE_b@ */ /end MEASUREMENT
/begin MEASUREMENT autosar_swc_vmc_rtARID_DEF.UnitDelay1_DSTATE_c "" FLOAT32_IEEE autosar_swc_vmc_CM_single 0 0 -3.4E+38 3.4E+38 ECU_ADDRESS 0xfe4cbf30 /* @ECU_Address@autosar_swc_vmc_rtARID_DEF.UnitDelay1_DSTATE_c@ */ /end MEASUREMENT
/begin MEASUREMENT autosar_swc_vmc_rtARID_DEF.UnitDelay1_DSTATE_d "" FLOAT32_IEEE autosar_swc_vmc_CM_single 0 0 -3.4E+38 3.4E+38 ECU_ADDRESS 0xfe4cbf5c /* @ECU_Address@autosar_swc_vmc_rtARID_DEF.UnitDelay1_DSTATE_d@ */ /end MEASUREMENT
/begin MEASUREMENT autosar_swc_vmc_rtARID_DEF.UnitDelay1_DSTATE_e "" FLOAT32_IEEE autosar_swc_vmc_CM_single 0 0 -3.4E+38 3.4E+38 ECU_ADDRESS 0xfe4cbf40 /* @ECU_Address@autosar_swc_vmc_rtARID_DEF.UnitDelay1_DSTATE_e@ */ /end MEASUREMENT
/begin MEASUREMENT autosar_swc_vmc_rtARID_DEF.UnitDelay1_DSTATE_en "" FLOAT32_IEEE autosar_swc_vmc_CM_single 0 0 -3.4E+38 3.4E+38 ECU_ADDRESS 0xfe4cbf64 /* @ECU_Address@autosar_swc_vmc_rtARID_DEF.UnitDelay1_DSTATE_en@ */ /end MEASUREMENT
/begin MEASUREMENT autosar_swc_vmc_rtARID_DEF.UnitDelay1_DSTATE_f "" UBYTE autosar_swc_vmc_CM_uint8 0 0 0 255 ECU_ADDRESS 0xfe4cbfed /* @ECU_Address@autosar_swc_vmc_rtARID_DEF.UnitDelay1_DSTATE_f@ */ /end MEASUREMENT
/begin MEASUREMENT autosar_swc_vmc_rtARID_DEF.UnitDelay1_DSTATE_g "" FLOAT32_IEEE autosar_swc_vmc_CM_single 0 0 -3.4E+38 3.4E+38 ECU_ADDRESS 0xfe4cbfac /* @ECU_Address@autosar_swc_vmc_rtARID_DEF.UnitDelay1_DSTATE_g@ */ /end MEASUREMENT
/begin MEASUREMENT autosar_swc_vmc_rtARID_DEF.UnitDelay1_DSTATE_kj "" FLOAT32_IEEE autosar_swc_vmc_CM_single 0 0 -3.4E+38 3.4E+38 ECU_ADDRESS 0xfe4cbf78 /* @ECU_Address@autosar_swc_vmc_rtARID_DEF.UnitDelay1_DSTATE_kj@ */ /end MEASUREMENT
/begin MEASUREMENT autosar_swc_vmc_rtARID_DEF.UnitDelay1_DSTATE_o "" FLOAT32_IEEE autosar_swc_vmc_CM_single 0 0 -3.4E+38 3.4E+38 ECU_ADDRESS 0xfe4cbfa4 /* @ECU_Address@autosar_swc_vmc_rtARID_DEF.UnitDelay1_DSTATE_o@ */ /end MEASUREMENT
/begin MEASUREMENT autosar_swc_vmc_rtARID_DEF.UnitDelay1_DSTATE_p "" FLOAT32_IEEE autosar_swc_vmc_CM_single 0 0 -3.4E+38 3.4E+38 ECU_ADDRESS 0xfe4cbf38 /* @ECU_Address@autosar_swc_vmc_rtARID_DEF.UnitDelay1_DSTATE_p@ */ /end MEASUREMENT
/begin MEASUREMENT autosar_swc_vmc_rtARID_DEF.UnitDelay1_DSTATE_p2 "" FLOAT32_IEEE autosar_swc_vmc_CM_single 0 0 -3.4E+38 3.4E+38 ECU_ADDRESS 0xfe4cbf9c /* @ECU_Address@autosar_swc_vmc_rtARID_DEF.UnitDelay1_DSTATE_p2@ */ /end MEASUREMENT
/begin MEASUREMENT autosar_swc_vmc_rtARID_DEF.UnitDelay1_DSTATE_p3 "" UBYTE autosar_swc_vmc_CM_logical 0 0 0 1 ECU_ADDRESS 0xfe4cc00c /* @ECU_Address@autosar_swc_vmc_rtARID_DEF.UnitDelay1_DSTATE_p3@ */ /end MEASUREMENT
/begin MEASUREMENT autosar_swc_vmc_rtARID_DEF.UnitDelay20_DSTATE "" FLOAT32_IEEE autosar_swc_vmc_CM_single 0 0 -3.4E+38 3.4E+38 ECU_ADDRESS 0xfe4cbf24 /* @ECU_Address@autosar_swc_vmc_rtARID_DEF.UnitDelay20_DSTATE@ */ /end MEASUREMENT
/begin MEASUREMENT autosar_swc_vmc_rtARID_DEF.UnitDelay2_DSTATE "" FLOAT32_IEEE autosar_swc_vmc_CM_single 0 0 -3.4E+38 3.4E+38 ECU_ADDRESS 0xfe4cbf28 /* @ECU_Address@autosar_swc_vmc_rtARID_DEF.UnitDelay2_DSTATE@ */ /end MEASUREMENT
/begin MEASUREMENT autosar_swc_vmc_rtARID_DEF.UnitDelay2_DSTATE_b "" FLOAT32_IEEE autosar_swc_vmc_CM_single 0 0 -3.4E+38 3.4E+38 ECU_ADDRESS 0xfe4cbf34 /* @ECU_Address@autosar_swc_vmc_rtARID_DEF.UnitDelay2_DSTATE_b@ */ /end MEASUREMENT
/begin MEASUREMENT autosar_swc_vmc_rtARID_DEF.UnitDelay2_DSTATE_c "" FLOAT32_IEEE autosar_swc_vmc_CM_single 0 0 -3.4E+38 3.4E+38 ECU_ADDRESS 0xfe4cbf4c /* @ECU_Address@autosar_swc_vmc_rtARID_DEF.UnitDelay2_DSTATE_c@ */ /end MEASUREMENT
/begin MEASUREMENT autosar_swc_vmc_rtARID_DEF.UnitDelay2_DSTATE_e "" FLOAT32_IEEE autosar_swc_vmc_CM_single 0 0 -3.4E+38 3.4E+38 ECU_ADDRESS 0xfe4cbf90 /* @ECU_Address@autosar_swc_vmc_rtARID_DEF.UnitDelay2_DSTATE_e@ */ /end MEASUREMENT
/begin MEASUREMENT autosar_swc_vmc_rtARID_DEF.UnitDelay2_DSTATE_j "" FLOAT32_IEEE autosar_swc_vmc_CM_single 0 0 -3.4E+38 3.4E+38 ECU_ADDRESS 0xfe4cbfa8 /* @ECU_Address@autosar_swc_vmc_rtARID_DEF.UnitDelay2_DSTATE_j@ */ /end MEASUREMENT
/begin MEASUREMENT autosar_swc_vmc_rtARID_DEF.UnitDelay2_DSTATE_n "" FLOAT32_IEEE autosar_swc_vmc_CM_single 0 0 -3.4E+38 3.4E+38 ECU_ADDRESS 0xfe4cbf8c /* @ECU_Address@autosar_swc_vmc_rtARID_DEF.UnitDelay2_DSTATE_n@ */ /end MEASUREMENT
/begin MEASUREMENT autosar_swc_vmc_rtARID_DEF.UnitDelay2_DSTATE_n3 "" FLOAT32_IEEE autosar_swc_vmc_CM_single 0 0 -3.4E+38 3.4E+38 ECU_ADDRESS 0xfe4cbfa0 /* @ECU_Address@autosar_swc_vmc_rtARID_DEF.UnitDelay2_DSTATE_n3@ */ /end MEASUREMENT
/begin MEASUREMENT autosar_swc_vmc_rtARID_DEF.UnitDelay2_DSTATE_p "" FLOAT32_IEEE autosar_swc_vmc_CM_single 0 0 -3.4E+38 3.4E+38 ECU_ADDRESS 0xfe4cbf58 /* @ECU_Address@autosar_swc_vmc_rtARID_DEF.UnitDelay2_DSTATE_p@ */ /end MEASUREMENT
/begin MEASUREMENT autosar_swc_vmc_rtARID_DEF.UnitDelay3_DSTATE "" FLOAT32_IEEE autosar_swc_vmc_CM_single 0 0 -3.4E+38 3.4E+38 LAYOUT COLUMN_DIR MATRIX_DIM 2 ECU_ADDRESS 0xfe4cbea8 /* @ECU_Address@autosar_swc_vmc_rtARID_DEF.UnitDelay3_DSTATE@ */ /end MEASUREMENT
/begin MEASUREMENT autosar_swc_vmc_rtARID_DEF.UnitDelay3_DSTATE_j "" UBYTE autosar_swc_vmc_CM_uint8 0 0 0 255 ECU_ADDRESS 0xfe4cbfee /* @ECU_Address@autosar_swc_vmc_rtARID_DEF.UnitDelay3_DSTATE_j@ */ /end MEASUREMENT
/begin MEASUREMENT autosar_swc_vmc_rtARID_DEF.UnitDelay4_DSTATE "" UBYTE autosar_swc_vmc_CM_uint8 0 0 0 255 ECU_ADDRESS 0xfe4cbfef /* @ECU_Address@autosar_swc_vmc_rtARID_DEF.UnitDelay4_DSTATE@ */ /end MEASUREMENT
/begin MEASUREMENT autosar_swc_vmc_rtARID_DEF.UnitDelay5_DSTATE "" UBYTE autosar_swc_vmc_CM_uint8 0 0 0 255 ECU_ADDRESS 0xfe4cbfea /* @ECU_Address@autosar_swc_vmc_rtARID_DEF.UnitDelay5_DSTATE@ */ /end MEASUREMENT
/begin MEASUREMENT autosar_swc_vmc_rtARID_DEF.UnitDelay8_DSTATE "" UBYTE autosar_swc_vmc_CM_uint8 0 0 0 255 ECU_ADDRESS 0xfe4cbff0 /* @ECU_Address@autosar_swc_vmc_rtARID_DEF.UnitDelay8_DSTATE@ */ /end MEASUREMENT
/begin MEASUREMENT autosar_swc_vmc_rtARID_DEF.UnitDelay9_DSTATE "" UBYTE autosar_swc_vmc_CM_uint8 0 0 0 255 ECU_ADDRESS 0xfe4cbff1 /* @ECU_Address@autosar_swc_vmc_rtARID_DEF.UnitDelay9_DSTATE@ */ /end MEASUREMENT
/begin MEASUREMENT autosar_swc_vmc_rtARID_DEF.UnitDelay_DSTATE "" FLOAT64_IEEE autosar_swc_vmc_CM_double 0 0 -1.7E+308 1.7E+308 ECU_ADDRESS 0xfe4cbe98 /* @ECU_Address@autosar_swc_vmc_rtARID_DEF.UnitDelay_DSTATE@ */ /end MEASUREMENT
/begin MEASUREMENT autosar_swc_vmc_rtARID_DEF.UnitDelay_DSTATE_a "" UBYTE autosar_swc_vmc_CM_logical 0 0 0 1 ECU_ADDRESS 0xfe4cc015 /* @ECU_Address@autosar_swc_vmc_rtARID_DEF.UnitDelay_DSTATE_a@ */ /end MEASUREMENT
/begin MEASUREMENT autosar_swc_vmc_rtARID_DEF.UnitDelay_DSTATE_b "" FLOAT32_IEEE autosar_swc_vmc_CM_single 0 0 -3.4E+38 3.4E+38 ECU_ADDRESS 0xfe4cbf44 /* @ECU_Address@autosar_swc_vmc_rtARID_DEF.UnitDelay_DSTATE_b@ */ /end MEASUREMENT
/begin MEASUREMENT autosar_swc_vmc_rtARID_DEF.UnitDelay_DSTATE_bi "" FLOAT32_IEEE autosar_swc_vmc_CM_single 0 0 -3.4E+38 3.4E+38 ECU_ADDRESS 0xfe4cbf68 /* @ECU_Address@autosar_swc_vmc_rtARID_DEF.UnitDelay_DSTATE_bi@ */ /end MEASUREMENT
/begin MEASUREMENT autosar_swc_vmc_rtARID_DEF.UnitDelay_DSTATE_c "" FLOAT64_IEEE autosar_swc_vmc_CM_double 0 0 -1.7E+308 1.7E+308 ECU_ADDRESS 0xfe4cbea0 /* @ECU_Address@autosar_swc_vmc_rtARID_DEF.UnitDelay_DSTATE_c@ */ /end MEASUREMENT
/begin MEASUREMENT autosar_swc_vmc_rtARID_DEF.UnitDelay_DSTATE_cx "" FLOAT32_IEEE autosar_swc_vmc_CM_single 0 0 -3.4E+38 3.4E+38 ECU_ADDRESS 0xfe4cbf7c /* @ECU_Address@autosar_swc_vmc_rtARID_DEF.UnitDelay_DSTATE_cx@ */ /end MEASUREMENT
/begin MEASUREMENT autosar_swc_vmc_rtARID_DEF.UnitDelay_DSTATE_d "" FLOAT32_IEEE autosar_swc_vmc_CM_single 0 0 -3.4E+38 3.4E+38 ECU_ADDRESS 0xfe4cbf2c /* @ECU_Address@autosar_swc_vmc_rtARID_DEF.UnitDelay_DSTATE_d@ */ /end MEASUREMENT
/begin MEASUREMENT autosar_swc_vmc_rtARID_DEF.UnitDelay_DSTATE_f "" FLOAT32_IEEE autosar_swc_vmc_CM_single 0 0 -3.4E+38 3.4E+38 ECU_ADDRESS 0xfe4cbf98 /* @ECU_Address@autosar_swc_vmc_rtARID_DEF.UnitDelay_DSTATE_f@ */ /end MEASUREMENT
/begin MEASUREMENT autosar_swc_vmc_rtARID_DEF.UnitDelay_DSTATE_f3 "" UBYTE autosar_swc_vmc_CM_logical 0 0 0 1 ECU_ADDRESS 0xfe4cc016 /* @ECU_Address@autosar_swc_vmc_rtARID_DEF.UnitDelay_DSTATE_f3@ */ /end MEASUREMENT
/begin MEASUREMENT autosar_swc_vmc_rtARID_DEF.UnitDelay_DSTATE_g "" FLOAT32_IEEE autosar_swc_vmc_CM_single 0 0 -3.4E+38 3.4E+38 ECU_ADDRESS 0xfe4cbf48 /* @ECU_Address@autosar_swc_vmc_rtARID_DEF.UnitDelay_DSTATE_g@ */ /end MEASUREMENT
/begin MEASUREMENT autosar_swc_vmc_rtARID_DEF.UnitDelay_DSTATE_gb "" FLOAT32_IEEE autosar_swc_vmc_CM_single 0 0 -3.4E+38 3.4E+38 ECU_ADDRESS 0xfe4cbf84 /* @ECU_Address@autosar_swc_vmc_rtARID_DEF.UnitDelay_DSTATE_gb@ */ /end MEASUREMENT
/begin MEASUREMENT autosar_swc_vmc_rtARID_DEF.UnitDelay_DSTATE_gn "" FLOAT32_IEEE autosar_swc_vmc_CM_single 0 0 -3.4E+38 3.4E+38 ECU_ADDRESS 0xfe4cbf50 /* @ECU_Address@autosar_swc_vmc_rtARID_DEF.UnitDelay_DSTATE_gn@ */ /end MEASUREMENT
/begin MEASUREMENT autosar_swc_vmc_rtARID_DEF.UnitDelay_DSTATE_h "" FLOAT32_IEEE autosar_swc_vmc_CM_single 0 0 -3.4E+38 3.4E+38 ECU_ADDRESS 0xfe4cbf60 /* @ECU_Address@autosar_swc_vmc_rtARID_DEF.UnitDelay_DSTATE_h@ */ /end MEASUREMENT
/begin MEASUREMENT autosar_swc_vmc_rtARID_DEF.UnitDelay_DSTATE_hl "" FLOAT32_IEEE autosar_swc_vmc_CM_single 0 0 -3.4E+38 3.4E+38 ECU_ADDRESS 0xfe4cbfb0 /* @ECU_Address@autosar_swc_vmc_rtARID_DEF.UnitDelay_DSTATE_hl@ */ /end MEASUREMENT
/begin MEASUREMENT autosar_swc_vmc_rtARID_DEF.UnitDelay_DSTATE_hu "" FLOAT32_IEEE autosar_swc_vmc_CM_single 0 0 -3.4E+38 3.4E+38 ECU_ADDRESS 0xfe4cbf6c /* @ECU_Address@autosar_swc_vmc_rtARID_DEF.UnitDelay_DSTATE_hu@ */ /end MEASUREMENT
/begin MEASUREMENT autosar_swc_vmc_rtARID_DEF.UnitDelay_DSTATE_i1 "" FLOAT32_IEEE autosar_swc_vmc_CM_single 0 0 -3.4E+38 3.4E+38 ECU_ADDRESS 0xfe4cbf20 /* @ECU_Address@autosar_swc_vmc_rtARID_DEF.UnitDelay_DSTATE_i1@ */ /end MEASUREMENT
/begin MEASUREMENT autosar_swc_vmc_rtARID_DEF.UnitDelay_DSTATE_ii "" UBYTE autosar_swc_vmc_CM_logical 0 0 0 1 ECU_ADDRESS 0xfe4cc013 /* @ECU_Address@autosar_swc_vmc_rtARID_DEF.UnitDelay_DSTATE_ii@ */ /end MEASUREMENT
/begin MEASUREMENT autosar_swc_vmc_rtARID_DEF.UnitDelay_DSTATE_iu "" FLOAT32_IEEE autosar_swc_vmc_CM_single 0 0 -3.4E+38 3.4E+38 ECU_ADDRESS 0xfe4cbf80 /* @ECU_Address@autosar_swc_vmc_rtARID_DEF.UnitDelay_DSTATE_iu@ */ /end MEASUREMENT
/begin MEASUREMENT autosar_swc_vmc_rtARID_DEF.UnitDelay_DSTATE_ix "" FLOAT32_IEEE autosar_swc_vmc_CM_single 0 0 -3.4E+38 3.4E+38 ECU_ADDRESS 0xfe4cbf1c /* @ECU_Address@autosar_swc_vmc_rtARID_DEF.UnitDelay_DSTATE_ix@ */ /end MEASUREMENT
/begin MEASUREMENT autosar_swc_vmc_rtARID_DEF.UnitDelay_DSTATE_j "" FLOAT32_IEEE autosar_swc_vmc_CM_single 0 0 -3.4E+38 3.4E+38 ECU_ADDRESS 0xfe4cbf3c /* @ECU_Address@autosar_swc_vmc_rtARID_DEF.UnitDelay_DSTATE_j@ */ /end MEASUREMENT
/begin MEASUREMENT autosar_swc_vmc_rtARID_DEF.UnitDelay_DSTATE_l "" FLOAT32_IEEE autosar_swc_vmc_CM_single 0 0 -3.4E+38 3.4E+38 ECU_ADDRESS 0xfe4cbf94 /* @ECU_Address@autosar_swc_vmc_rtARID_DEF.UnitDelay_DSTATE_l@ */ /end MEASUREMENT
/begin MEASUREMENT autosar_swc_vmc_rtARID_DEF.UnitDelay_DSTATE_m "" FLOAT32_IEEE autosar_swc_vmc_CM_single 0 0 -3.4E+38 3.4E+38 ECU_ADDRESS 0xfe4cbf70 /* @ECU_Address@autosar_swc_vmc_rtARID_DEF.UnitDelay_DSTATE_m@ */ /end MEASUREMENT
/begin MEASUREMENT autosar_swc_vmc_rtARID_DEF.UnitDelay_DSTATE_mr "" UBYTE autosar_swc_vmc_CM_uint8 0 0 0 255 ECU_ADDRESS 0xfe4cbfeb /* @ECU_Address@autosar_swc_vmc_rtARID_DEF.UnitDelay_DSTATE_mr@ */ /end MEASUREMENT
/begin MEASUREMENT autosar_swc_vmc_rtARID_DEF.UnitDelay_DSTATE_ou "" FLOAT32_IEEE autosar_swc_vmc_CM_single 0 0 -3.4E+38 3.4E+38 ECU_ADDRESS 0xfe4cbf74 /* @ECU_Address@autosar_swc_vmc_rtARID_DEF.UnitDelay_DSTATE_ou@ */ /end MEASUREMENT
/begin MEASUREMENT autosar_swc_vmc_rtARID_DEF.UnitDelay_DSTATE_p "" FLOAT32_IEEE autosar_swc_vmc_CM_single 0 0 -3.4E+38 3.4E+38 ECU_ADDRESS 0xfe4cbf88 /* @ECU_Address@autosar_swc_vmc_rtARID_DEF.UnitDelay_DSTATE_p@ */ /end MEASUREMENT
/begin MEASUREMENT autosar_swc_vmc_rtARID_DEF.UnitDelay_DSTATE_pp "" UBYTE autosar_swc_vmc_CM_logical 0 0 0 1 ECU_ADDRESS 0xfe4cc012 /* @ECU_Address@autosar_swc_vmc_rtARID_DEF.UnitDelay_DSTATE_pp@ */ /end MEASUREMENT
/begin MEASUREMENT autosar_swc_vmc_rtARID_DEF.UpTrigger_ValueTemp "" UBYTE autosar_swc_vmc_CM_uint8 0 0 0 255 ECU_ADDRESS 0xfe4cc000 /* @ECU_Address@autosar_swc_vmc_rtARID_DEF.UpTrigger_ValueTemp@ */ /end MEASUREMENT
/begin MEASUREMENT autosar_swc_vmc_rtARID_DEF.VLCSts "" UBYTE autosar_swc_vmc_CM_uint8 0 0 0 255 ECU_ADDRESS 0xfe4cbfe8 /* @ECU_Address@autosar_swc_vmc_rtARID_DEF.VLCSts@ */ /end MEASUREMENT
/begin MEASUREMENT autosar_swc_vmc_rtARID_DEF.accelk1 "" FLOAT32_IEEE autosar_swc_vmc_CM_single 0 0 -3.4E+38 3.4E+38 ECU_ADDRESS 0xfe4cbfcc /* @ECU_Address@autosar_swc_vmc_rtARID_DEF.accelk1@ */ /end MEASUREMENT
/begin MEASUREMENT autosar_swc_vmc_rtARID_DEF.cnt "" UBYTE autosar_swc_vmc_CM_uint8 0 0 0 255 ECU_ADDRESS 0xfe4cbffa /* @ECU_Address@autosar_swc_vmc_rtARID_DEF.cnt@ */ /end MEASUREMENT
/begin MEASUREMENT autosar_swc_vmc_rtARID_DEF.decelReqK1 "" FLOAT32_IEEE autosar_swc_vmc_CM_single 0 0 -3.4E+38 3.4E+38 ECU_ADDRESS 0xfe4cbfc4 /* @ECU_Address@autosar_swc_vmc_rtARID_DEF.decelReqK1@ */ /end MEASUREMENT
/begin MEASUREMENT autosar_swc_vmc_rtARID_DEF.functionActiceCount "" UBYTE autosar_swc_vmc_CM_uint8 0 0 0 255 ECU_ADDRESS 0xfe4cbffd /* @ECU_Address@autosar_swc_vmc_rtARID_DEF.functionActiceCount@ */ /end MEASUREMENT
/begin MEASUREMENT autosar_swc_vmc_rtARID_DEF.is_Active "" UBYTE autosar_swc_vmc_CM_uint8 0 0 0 255 ECU_ADDRESS 0xfe4cbff6 /* @ECU_Address@autosar_swc_vmc_rtARID_DEF.is_Active@ */ /end MEASUREMENT
/begin MEASUREMENT autosar_swc_vmc_rtARID_DEF.is_c19_autosar_swc_vmc "" UBYTE autosar_swc_vmc_CM_uint8 0 0 0 255 ECU_ADDRESS 0xfe4cbff5 /* @ECU_Address@autosar_swc_vmc_rtARID_DEF.is_c19_autosar_swc_vmc@ */ /end MEASUREMENT
/begin MEASUREMENT autosar_swc_vmc_rtARID_DEF.is_first_run_not_empty "" UBYTE autosar_swc_vmc_CM_logical 0 0 0 1 ECU_ADDRESS 0xfe4cc018 /* @ECU_Address@autosar_swc_vmc_rtARID_DEF.is_first_run_not_empty@ */ /end MEASUREMENT
/begin MEASUREMENT autosar_swc_vmc_rtARID_DEF.poly_vecK1 "" FLOAT32_IEEE autosar_swc_vmc_CM_single 0 0 -3.4E+38 3.4E+38 LAYOUT COLUMN_DIR MATRIX_DIM 6 ECU_ADDRESS 0xfe4cbef4 /* @ECU_Address@autosar_swc_vmc_rtARID_DEF.poly_vecK1@ */ /end MEASUREMENT
/begin MEASUREMENT autosar_swc_vmc_rtARID_DEF.poly_vecK1_not_empty "" UBYTE autosar_swc_vmc_CM_logical 0 0 0 1 ECU_ADDRESS 0xfe4cc01b /* @ECU_Address@autosar_swc_vmc_rtARID_DEF.poly_vecK1_not_empty@ */ /end MEASUREMENT
/begin MEASUREMENT autosar_swc_vmc_rtARID_DEF.reflaneidk1 "" ULONG autosar_swc_vmc_CM_uint32 0 0 0 4294967295 ECU_ADDRESS 0xfe4cbfe4 /* @ECU_Address@autosar_swc_vmc_rtARID_DEF.reflaneidk1@ */ /end MEASUREMENT
/begin MEASUREMENT autosar_swc_vmc_rtARID_DEF.tDC "" FLOAT32_IEEE autosar_swc_vmc_CM_single 0 0 -3.4E+38 3.4E+38 ECU_ADDRESS 0xfe4cbf18 /* @ECU_Address@autosar_swc_vmc_rtARID_DEF.tDC@ */ /end MEASUREMENT
/begin MEASUREMENT autosar_swc_vmc_rtARID_DEF.tEC "" FLOAT32_IEEE autosar_swc_vmc_CM_single 0 0 -3.4E+38 3.4E+38 ECU_ADDRESS 0xfe4cbf14 /* @ECU_Address@autosar_swc_vmc_rtARID_DEF.tEC@ */ /end MEASUREMENT
/begin MEASUREMENT autosar_swc_vmc_rtARID_DEF.tEngSpdControl "" FLOAT32_IEEE autosar_swc_vmc_CM_single 0 0 -3.4E+38 3.4E+38 ECU_ADDRESS 0xfe4cbf0c /* @ECU_Address@autosar_swc_vmc_rtARID_DEF.tEngSpdControl@ */ /end MEASUREMENT
/begin MEASUREMENT autosar_swc_vmc_rtARID_DEF.timer "" FLOAT32_IEEE autosar_swc_vmc_CM_single 0 0 -3.4E+38 3.4E+38 ECU_ADDRESS 0xfe4cbfc0 /* @ECU_Address@autosar_swc_vmc_rtARID_DEF.timer@ */ /end MEASUREMENT
/begin MEASUREMENT autosar_swc_vmc_rtARID_DEF.timerFailure "" UBYTE autosar_swc_vmc_CM_uint8 0 0 0 255 ECU_ADDRESS 0xfe4cbff7 /* @ECU_Address@autosar_swc_vmc_rtARID_DEF.timerFailure@ */ /end MEASUREMENT
/begin MEASUREMENT autosar_swc_vmc_rtARID_DEF.timer_h "" FLOAT32_IEEE autosar_swc_vmc_CM_single 0 0 -3.4E+38 3.4E+38 ECU_ADDRESS 0xfe4cbfc8 /* @ECU_Address@autosar_swc_vmc_rtARID_DEF.timer_h@ */ /end MEASUREMENT
/begin MEASUREMENT autosar_swc_vmc_rtARID_DEF.vmp_updatecntK1 "" UBYTE autosar_swc_vmc_CM_uint8 0 0 0 255 ECU_ADDRESS 0xfe4cbffc /* @ECU_Address@autosar_swc_vmc_rtARID_DEF.vmp_updatecntK1@ */ /end MEASUREMENT
/begin MEASUREMENT autosar_swc_vmc_rtARID_DEF.xi "" FLOAT32_IEEE autosar_swc_vmc_CM_single 0 0 -3.4E+38 3.4E+38 LAYOUT COLUMN_DIR MATRIX_DIM 6 ECU_ADDRESS 0xfe4cbedc /* @ECU_Address@autosar_swc_vmc_rtARID_DEF.xi@ */ /end MEASUREMENT
/begin MEASUREMENT autosar_swc_vmc_rtARID_DEF.y "" UBYTE autosar_swc_vmc_CM_uint8 0 0 0 255 ECU_ADDRESS 0xfe4cbfe9 /* @ECU_Address@autosar_swc_vmc_rtARID_DEF.y@ */ /end MEASUREMENT
/begin MEASUREMENT autosar_swc_vmc_rtARID_DEF.yi "" FLOAT32_IEEE autosar_swc_vmc_CM_single 0 0 -3.4E+38 3.4E+38 LAYOUT COLUMN_DIR MATRIX_DIM 6 ECU_ADDRESS 0xfe4cbec4 /* @ECU_Address@autosar_swc_vmc_rtARID_DEF.yi@ */ /end MEASUREMENT
/begin AXIS_PTS P_LATC_A0_Dis_BP "" 0xfe822ab0 /* @ECU_Address@P_LATC_A0_Dis_BP@ */ NO_INPUT_QUANTITY Axis_FLOAT32_IEEE 0 autosar_swc_vmc_CM_single 19 -3.4E+38 3.4E+38 /end AXIS_PTS
/begin AXIS_PTS P_LATC_A2_Curve_BP "" 0xfe822160 /* @ECU_Address@P_LATC_A2_Curve_BP@ */ NO_INPUT_QUANTITY Axis_FLOAT32_IEEE 0 autosar_swc_vmc_CM_single 10 -3.4E+38 3.4E+38 /end AXIS_PTS
/begin AXIS_PTS P_LATC_Ang_spd "" 0xfe8226b8 /* @ECU_Address@P_LATC_Ang_spd@ */ NO_INPUT_QUANTITY Axis_FLOAT32_IEEE 0 autosar_swc_vmc_CM_single 15 -3.4E+38 3.4E+38 /end AXIS_PTS
/begin AXIS_PTS P_LATC_AngleSlope_Spd_BP "" 0xfe8221b0 /* @ECU_Address@P_LATC_AngleSlope_Spd_BP@ */ NO_INPUT_QUANTITY Axis_FLOAT32_IEEE 0 autosar_swc_vmc_CM_single 12 -3.4E+38 3.4E+38 /end AXIS_PTS
/begin AXIS_PTS P_LATC_DeltaEps_SpdBp "" 0xfe822248 /* @ECU_Address@P_LATC_DeltaEps_SpdBp@ */ NO_INPUT_QUANTITY Axis_FLOAT32_IEEE 0 autosar_swc_vmc_CM_single 16 -3.4E+38 3.4E+38 /end AXIS_PTS
/begin AXIS_PTS P_LATC_DesLaneA0 "" 0xfe8222c8 /* @ECU_Address@P_LATC_DesLaneA0@ */ NO_INPUT_QUANTITY Axis_FLOAT32_IEEE 0 autosar_swc_vmc_CM_single 8 -3.4E+38 3.4E+38 /end AXIS_PTS
/begin AXIS_PTS P_LATC_DesLaneA1 "" 0xfe8226f4 /* @ECU_Address@P_LATC_DesLaneA1@ */ NO_INPUT_QUANTITY Axis_FLOAT32_IEEE 0 autosar_swc_vmc_CM_single 9 -3.4E+38 3.4E+38 /end AXIS_PTS
/begin AXIS_PTS P_LATC_FeedbackAngleSlope_Ang "" 0xfe822718 /* @ECU_Address@P_LATC_FeedbackAngleSlope_Ang@ */ NO_INPUT_QUANTITY Axis_FLOAT32_IEEE 0 autosar_swc_vmc_CM_single 9 -3.4E+38 3.4E+38 /end AXIS_PTS
/begin AXIS_PTS P_LATC_LinePreView_spd "" 0xfe82279c /* @ECU_Address@P_LATC_LinePreView_spd@ */ NO_INPUT_QUANTITY Axis_FLOAT32_IEEE 0 autosar_swc_vmc_CM_single 15 -3.4E+38 3.4E+38 /end AXIS_PTS
/begin AXIS_PTS P_LATC_OffsetError_BP "" 0xfe8223e8 /* @ECU_Address@P_LATC_OffsetError_BP@ */ NO_INPUT_QUANTITY Axis_FLOAT32_IEEE 0 autosar_swc_vmc_CM_single 8 -3.4E+38 3.4E+38 /end AXIS_PTS
/begin AXIS_PTS P_LATC_StateActiveFlg_BP "" 0xfe822aa7 /* @ECU_Address@P_LATC_StateActiveFlg_BP@ */ NO_INPUT_QUANTITY Axis_UBYTE 0 autosar_swc_vmc_CM_uint8 9 0 255 /end AXIS_PTS
/begin AXIS_PTS P_LATC_StateActive_HoldTime_BP "" 0xfe8227d8 /* @ECU_Address@P_LATC_StateActive_HoldTime_BP@ */ NO_INPUT_QUANTITY Axis_FLOAT32_IEEE 0 autosar_swc_vmc_CM_single 15 -3.4E+38 3.4E+38 /end AXIS_PTS
/begin AXIS_PTS P_LATC_TarLineC1_Slope "" 0xfe822850 /* @ECU_Address@P_LATC_TarLineC1_Slope@ */ NO_INPUT_QUANTITY Axis_FLOAT32_IEEE 0 autosar_swc_vmc_CM_single 7 -3.4E+38 3.4E+38 /end AXIS_PTS
/begin AXIS_PTS P_LATC_preDis_spd "" 0xfe822450 /* @ECU_Address@P_LATC_preDis_spd@ */ NO_INPUT_QUANTITY Axis_FLOAT32_IEEE 0 autosar_swc_vmc_CM_single 16 -3.4E+38 3.4E+38 /end AXIS_PTS
/begin AXIS_PTS P_LongCtrl_EfficiencyChartXAxis "" 0xfe822888 /* @ECU_Address@P_LongCtrl_EfficiencyChartXAxis@ */ NO_INPUT_QUANTITY Axis_FLOAT32_IEEE 0 autosar_swc_vmc_CM_single 5 -3.4E+38 3.4E+38 /end AXIS_PTS
/begin AXIS_PTS P_LongCtrl_EngIdleForceSwFcnXAxis "" 0xfe822490 /* @ECU_Address@P_LongCtrl_EngIdleForceSwFcnXAxis@ */ NO_INPUT_QUANTITY Axis_FLOAT32_IEEE 0 autosar_swc_vmc_CM_single 4 -3.4E+38 3.4E+38 /end AXIS_PTS
/begin AXIS_PTS P_LongCtrl_EngTrqConsiderEfficiencyChartXAxis "" 0xfe8228b0 /* @ECU_Address@P_LongCtrl_EngTrqConsiderEfficiencyChartXAxis@ */ NO_INPUT_QUANTITY Axis_FLOAT32_IEEE 0 autosar_swc_vmc_CM_single 5 -3.4E+38 3.4E+38 /end AXIS_PTS
/begin AXIS_PTS P_LongCtrl_FF_Spd "" 0xfe8224b0 /* @ECU_Address@P_LongCtrl_FF_Spd@ */ NO_INPUT_QUANTITY Axis_FLOAT32_IEEE 0 autosar_swc_vmc_CM_single 12 -3.4E+38 3.4E+38 /end AXIS_PTS
/begin AXIS_PTS P_LongCtrl_MaRatioChartXAxis "" 0xfe828eac /* @ECU_Address@P_LongCtrl_MaRatioChartXAxis@ */ NO_INPUT_QUANTITY Axis_FLOAT32_IEEE 0 autosar_swc_vmc_CM_single 18 -3.4E+38 3.4E+38 /end AXIS_PTS
/begin AXIS_PTS P_LongCtrl_PI_vxvRefMs "" 0xfe822540 /* @ECU_Address@P_LongCtrl_PI_vxvRefMs@ */ NO_INPUT_QUANTITY Axis_FLOAT32_IEEE 0 autosar_swc_vmc_CM_single 4 -3.4E+38 3.4E+38 /end AXIS_PTS
/begin AXIS_PTS P_LongCtrl_UsedMinEngTrqChartXAxis "" 0xfe8228d8 /* @ECU_Address@P_LongCtrl_UsedMinEngTrqChartXAxis@ */ NO_INPUT_QUANTITY Axis_FLOAT32_IEEE 0 autosar_swc_vmc_CM_single 11 -3.4E+38 3.4E+38 /end AXIS_PTS
/begin AXIS_PTS P_LongCtrl_VLCAxvTracMinDevDC1ChartXAxis "" 0xfe822560 /* @ECU_Address@P_LongCtrl_VLCAxvTracMinDevDC1ChartXAxis@ */ NO_INPUT_QUANTITY Axis_FLOAT32_IEEE 0 autosar_swc_vmc_CM_single_m_per_s 4 0.000000 60.000000 /end AXIS_PTS
/begin AXIS_PTS P_LongCtrl_VLCaccelMinHoldXAxis "" 0xfe821fd0 /* @ECU_Address@P_LongCtrl_VLCaccelMinHoldXAxis@ */ NO_INPUT_QUANTITY Axis_FLOAT32_IEEE 0 autosar_swc_vmc_CM_single_m_per_s_2 2 0.000000 5.000000 /end AXIS_PTS
/begin AXIS_PTS P_LongCtrl_VLCcoefFXAxis "" 0xfe822580 /* @ECU_Address@P_LongCtrl_VLCcoefFXAxis@ */ NO_INPUT_QUANTITY Axis_FLOAT32_IEEE 0 autosar_swc_vmc_CM_single_km_per_h 10 0.000000 250.000000 /end AXIS_PTS
/begin AXIS_PTS P_LongCtrl_VLCdriveOffAxUpLimXAxix "" 0xfe822930 /* @ECU_Address@P_LongCtrl_VLCdriveOffAxUpLimXAxix@ */ NO_INPUT_QUANTITY Axis_FLOAT32_IEEE 0 autosar_swc_vmc_CM_single 5 -3.4E+38 3.4E+38 /end AXIS_PTS
/begin AXIS_PTS P_LongCtrl_VLCjerkHoldXAxis "" 0xfe821fe0 /* @ECU_Address@P_LongCtrl_VLCjerkHoldXAxis@ */ NO_INPUT_QUANTITY Axis_FLOAT32_IEEE 0 autosar_swc_vmc_CM_single_m_per_s_2 2 0.000000 4.000000 /end AXIS_PTS
/begin AXIS_PTS P_VMC_FuSaTest_Accel_T "" 0xfe822620 /* @ECU_Address@P_VMC_FuSaTest_Accel_T@ */ NO_INPUT_QUANTITY Axis_FLOAT32_IEEE 0 autosar_swc_vmc_CM_single 8 -3.4E+38 3.4E+38 /end AXIS_PTS
/begin COMPU_METHOD autosar_swc_vmc_CM_boolean "Q = V" IDENTICAL "%1.0" "" /end COMPU_METHOD
/begin COMPU_METHOD autosar_swc_vmc_CM_double "Q = V" IDENTICAL "%15.10" "" /end COMPU_METHOD
/begin COMPU_METHOD autosar_swc_vmc_CM_logical "Q = V" IDENTICAL "%1.0" "" /end COMPU_METHOD
/begin COMPU_METHOD autosar_swc_vmc_CM_single "Q = V" IDENTICAL "%8.6" "" /end COMPU_METHOD
/begin COMPU_METHOD autosar_swc_vmc_CM_single_km_per_h "Q = V" IDENTICAL "%8.6" "km/h" /end COMPU_METHOD
/begin COMPU_METHOD autosar_swc_vmc_CM_single_m_2 "Q = V" IDENTICAL "%8.6" "m^2" /end COMPU_METHOD
/begin COMPU_METHOD autosar_swc_vmc_CM_single_m_per_s "Q = V" IDENTICAL "%8.6" "m/s" /end COMPU_METHOD
/begin COMPU_METHOD autosar_swc_vmc_CM_single_m_per_s_2 "Q = V" IDENTICAL "%8.6" "m/s^2" /end COMPU_METHOD
/begin COMPU_METHOD autosar_swc_vmc_CM_single_m_per_s_3 "Q = V" IDENTICAL "%8.6" "m/s^3" /end COMPU_METHOD
/begin COMPU_METHOD autosar_swc_vmc_CM_uint16 "Q = V" IDENTICAL "%5.0" "" /end COMPU_METHOD
/begin COMPU_METHOD autosar_swc_vmc_CM_uint32 "Q = V" IDENTICAL "%10.0" "" /end COMPU_METHOD
/begin COMPU_METHOD autosar_swc_vmc_CM_uint64 "Q = V" IDENTICAL "%20.0" "" /end COMPU_METHOD
/begin COMPU_METHOD autosar_swc_vmc_CM_uint8 "Q = V" IDENTICAL "%3.0" "" /end COMPU_METHOD
/begin RECORD_LAYOUT Record_BOOLEAN FNC_VALUES 1 UBYTE COLUMN_DIR DIRECT /end RECORD_LAYOUT
/begin RECORD_LAYOUT Record_FLOAT32_IEEE FNC_VALUES 1 FLOAT32_IEEE COLUMN_DIR DIRECT /end RECORD_LAYOUT
/begin RECORD_LAYOUT Record_FLOAT64_IEEE FNC_VALUES 1 FLOAT64_IEEE COLUMN_DIR DIRECT /end RECORD_LAYOUT
/begin RECORD_LAYOUT Record_UBYTE FNC_VALUES 1 UBYTE COLUMN_DIR DIRECT /end RECORD_LAYOUT
/begin RECORD_LAYOUT Axis_FLOAT32_IEEE AXIS_PTS_X 1 FLOAT32_IEEE INDEX_INCR DIRECT /end RECORD_LAYOUT
/begin RECORD_LAYOUT Axis_UBYTE AXIS_PTS_X 1 UBYTE INDEX_INCR DIRECT /end RECORD_LAYOUT
/begin GROUP autosar_swc_vmc_autosar_swc_vmc_Step_sys_LATC_latc_AngleCalc_latc_angslopeCalc "autosar_swc_vmc/autosar_swc_vmc_Step_sys/LATC/latc_AngleCalc/latc_angslopeCalc"
 /begin SUB_GROUP autosar_swc_vmc_autosar_swc_vmc_Step_sys_LATC_latc_AngleCalc_latc_angslopeCalc_Compare_To_Constant3 autosar_swc_vmc_autosar_swc_vmc_Step_sys_LATC_latc_AngleCalc_latc_angslopeCalc_Switch_Case_Action_Subsystem2 autosar_swc_vmc_autosar_swc_vmc_Step_sys_LATC_latc_AngleCalc_latc_angslopeCalc_Switch_Case_Action_Subsystem3 /end SUB_GROUP
 /begin REF_CHARACTERISTIC P_LATC_A0_Dis_BP P_LATC_A2_Curve_BP P_LATC_AngleSlope_AES_Active P_LATC_AngleSlope_DOP P_LATC_AngleSlope_ELK P_LATC_AngleSlope_LC P_LATC_AngleSlope_LCK P_LATC_AngleSlope_LCK_Curve_Fac P_LATC_AngleSlope_LCMiddle P_LATC_AngleSlope_LCSoft P_LATC_AngleSlope_LC_Cancel P_LATC_AngleSlope_LKA P_LATC_AngleSlope_Spd_BP P_LATC_AngleSlope_Split P_LATC_FeedbackAngleSlope_Ang P_LATC_FeedbackAngleSlope_Gain P_LATC_FeedbackAngleSlope_SW P_LATC_StepTime P_LATC_TarLineC1_Slope P_LATC_TarLineC1_Slope_Active /end REF_CHARACTERISTIC
 /begin REF_MEASUREMENT LATC_AngleSlope_Flg LATC_DeltaAngle LATC_HoldTime LATC_LC_Complete_PreDisFac LATC_Predis_Curve LATC_StateActive_AngleSlope LATC_StateActive_MinAngleSlope LATC_State_AngleSlope LATC_TarSteerAngleSlope autosar_swc_vmc_rtARID_DEF.Cnt autosar_swc_vmc_rtARID_DEF.FLg autosar_swc_vmc_rtARID_DEF.Mean_AccVal autosar_swc_vmc_rtARID_DEF.TappedDelay_X autosar_swc_vmc_rtARID_DEF.UnitDelay5_DSTATE autosar_swc_vmc_rtARID_DEF.reflaneidk1 /end REF_MEASUREMENT
/end GROUP
/begin GROUP autosar_swc_vmc_autosar_swc_vmc_Step_sys_LATC_latc_AngleCalc_latc_angslopeCalc_Compare_To_Constant3 "autosar_swc_vmc/autosar_swc_vmc_Step_sys/LATC/latc_AngleCalc/latc_angslopeCalc/Compare\nTo Constant3" /begin REF_MEASUREMENT LATC_AngleSlope_Flg /end REF_MEASUREMENT /end GROUP
/begin GROUP autosar_swc_vmc_autosar_swc_vmc_Step_sys_LATC_latc_AngleCalc_latc_angslopeCalc_Switch_Case_Action_Subsystem2 "autosar_swc_vmc/autosar_swc_vmc_Step_sys/LATC/latc_AngleCalc/latc_angslopeCalc/Switch Case Action\nSubsystem2"
 /begin REF_CHARACTERISTIC P_LATC_LC_Complete_PreDisFac P_LATC_StateActive_HoldTime_BP P_LATC_StateComplete_AngleSlope /end REF_CHARACTERISTIC
 /begin REF_MEASUREMENT LATC_HoldTime LATC_LC_Complete_PreDisFac /end REF_MEASUREMENT
/end GROUP
/begin GROUP autosar_swc_vmc_autosar_swc_vmc_Step_sys_LATC_latc_AngleCalc_latc_angslopeCalc_Switch_Case_Action_Subsystem3 "autosar_swc_vmc/autosar_swc_vmc_Step_sys/LATC/latc_AngleCalc/latc_angslopeCalc/Switch Case Action\nSubsystem3"
 /begin REF_CHARACTERISTIC P_LATC_StateActiv_AngleSlope P_LATC_StateActiveFlg_BP P_LATC_StateActive_HoldTime_BP /end REF_CHARACTERISTIC
 /begin REF_MEASUREMENT LATC_AngleSlope_Flg LATC_HoldTime LATC_StateActive_AngleSlope /end REF_MEASUREMENT
/end GROUP
/begin GROUP autosar_swc_vmc_autosar_swc_vmc_Step_sys_LATC_latc_AngleCalc_latc_effectCalc "autosar_swc_vmc/autosar_swc_vmc_Step_sys/LATC/latc_AngleCalc/latc_effectCalc"
 /begin SUB_GROUP autosar_swc_vmc_autosar_swc_vmc_Step_sys_LATC_latc_AngleCalc_latc_effectCalc_Compare_To_Constant autosar_swc_vmc_autosar_swc_vmc_Step_sys_LATC_latc_AngleCalc_latc_effectCalc_Compare_To_Constant1 autosar_swc_vmc_autosar_swc_vmc_Step_sys_LATC_latc_AngleCalc_latc_effectCalc_Compare_To_Constant2 autosar_swc_vmc_autosar_swc_vmc_Step_sys_LATC_latc_AngleCalc_latc_effectCalc_Compare_To_Constant3 autosar_swc_vmc_autosar_swc_vmc_Step_sys_LATC_latc_AngleCalc_latc_effectCalc_Compare_To_Constant4 autosar_swc_vmc_autosar_swc_vmc_Step_sys_LATC_latc_AngleCalc_latc_effectCalc_Compare_To_Constant5 autosar_swc_vmc_autosar_swc_vmc_Step_sys_LATC_latc_AngleCalc_latc_effectCalc_Compare_To_Constant6 autosar_swc_vmc_autosar_swc_vmc_Step_sys_LATC_latc_AngleCalc_latc_effectCalc_Compare_To_Constant7 autosar_swc_vmc_autosar_swc_vmc_Step_sys_LATC_latc_AngleCalc_latc_effectCalc_Subsystem1 autosar_swc_vmc_autosar_swc_vmc_Step_sys_LATC_latc_AngleCalc_latc_effectCalc_Subsystem5 /end SUB_GROUP
 /begin REF_CHARACTERISTIC P_LATC_DesLaneA0 P_LATC_DesLaneA1 P_LATC_EffectSW P_LATC_LATC_Effect /end REF_CHARACTERISTIC
 /begin REF_MEASUREMENT LATC_Effect1 LATC_LATC_EffectValue LATC_LATC_Effect_YError LATC_TarAngleLastPoint_X /end REF_MEASUREMENT
/end GROUP
/begin GROUP autosar_swc_vmc_autosar_swc_vmc_Step_sys_LATC_latc_AngleCalc_latc_effectCalc_Compare_To_Constant "autosar_swc_vmc/autosar_swc_vmc_Step_sys/LATC/latc_AngleCalc/latc_effectCalc/Compare\nTo Constant" /begin REF_CHARACTERISTIC P_LATC_YawRateLimitVal /end REF_CHARACTERISTIC /end GROUP
/begin GROUP autosar_swc_vmc_autosar_swc_vmc_Step_sys_LATC_latc_AngleCalc_latc_effectCalc_Compare_To_Constant1 "autosar_swc_vmc/autosar_swc_vmc_Step_sys/LATC/latc_AngleCalc/latc_effectCalc/Compare\nTo Constant1" /begin REF_CHARACTERISTIC P_LATC_AyLimitVal /end REF_CHARACTERISTIC /end GROUP
/begin GROUP autosar_swc_vmc_autosar_swc_vmc_Step_sys_LATC_latc_AngleCalc_latc_effectCalc_Compare_To_Constant2 "autosar_swc_vmc/autosar_swc_vmc_Step_sys/LATC/latc_AngleCalc/latc_effectCalc/Compare\nTo Constant2" /begin REF_CHARACTERISTIC P_LATC_YawRateLimitTime /end REF_CHARACTERISTIC /end GROUP
/begin GROUP autosar_swc_vmc_autosar_swc_vmc_Step_sys_LATC_latc_AngleCalc_latc_effectCalc_Compare_To_Constant3 "autosar_swc_vmc/autosar_swc_vmc_Step_sys/LATC/latc_AngleCalc/latc_effectCalc/Compare\nTo Constant3" /begin REF_CHARACTERISTIC P_LATC_AyLimitTime /end REF_CHARACTERISTIC /end GROUP
/begin GROUP autosar_swc_vmc_autosar_swc_vmc_Step_sys_LATC_latc_AngleCalc_latc_effectCalc_Compare_To_Constant5 "autosar_swc_vmc/autosar_swc_vmc_Step_sys/LATC/latc_AngleCalc/latc_effectCalc/Compare\nTo Constant5" /begin REF_CHARACTERISTIC P_LATC_LatcEffectVal /end REF_CHARACTERISTIC /begin REF_MEASUREMENT LATC_LATC_EffectValue /end REF_MEASUREMENT /end GROUP
/begin GROUP autosar_swc_vmc_autosar_swc_vmc_Step_sys_LATC_latc_AngleCalc_latc_effectCalc_Compare_To_Constant6 "autosar_swc_vmc/autosar_swc_vmc_Step_sys/LATC/latc_AngleCalc/latc_effectCalc/Compare\nTo Constant6" /begin REF_CHARACTERISTIC P_LATC_LatcEffectDisVal /end REF_CHARACTERISTIC /begin REF_MEASUREMENT LATC_LATC_Effect_YError /end REF_MEASUREMENT /end GROUP
/begin GROUP autosar_swc_vmc_autosar_swc_vmc_Step_sys_LATC_latc_AngleCalc_latc_effectCalc_Compare_To_Constant7 "autosar_swc_vmc/autosar_swc_vmc_Step_sys/LATC/latc_AngleCalc/latc_effectCalc/Compare\nTo Constant7" /begin REF_CHARACTERISTIC P_LATC_LatcEffectC0Val /end REF_CHARACTERISTIC /end GROUP
/begin GROUP autosar_swc_vmc_autosar_swc_vmc_Step_sys_LATC_latc_AngleCalc_latc_effectCalc_Subsystem1 "autosar_swc_vmc/autosar_swc_vmc_Step_sys/LATC/latc_AngleCalc/latc_effectCalc/Subsystem1" /begin REF_CHARACTERISTIC P_LATC_StepTime /end REF_CHARACTERISTIC /begin REF_MEASUREMENT autosar_swc_vmc_rtARID_DEF.UnitDelay_DSTATE /end REF_MEASUREMENT /end GROUP
/begin GROUP autosar_swc_vmc_autosar_swc_vmc_Step_sys_LATC_latc_AngleCalc_latc_effectCalc_Subsystem5 "autosar_swc_vmc/autosar_swc_vmc_Step_sys/LATC/latc_AngleCalc/latc_effectCalc/Subsystem5" /begin REF_CHARACTERISTIC P_LATC_StepTime /end REF_CHARACTERISTIC /begin REF_MEASUREMENT autosar_swc_vmc_rtARID_DEF.UnitDelay_DSTATE_c /end REF_MEASUREMENT /end GROUP
/begin GROUP autosar_swc_vmc_autosar_swc_vmc_Step_sys_LATC_latc_AngleCalc_latc_epsreqflgCalc "autosar_swc_vmc/autosar_swc_vmc_Step_sys/LATC/latc_AngleCalc/latc_epsreqflgCalc"
 /begin SUB_GROUP autosar_swc_vmc_autosar_swc_vmc_Step_sys_LATC_latc_AngleCalc_latc_epsreqflgCalc_Compare_To_Constant3 /end SUB_GROUP
 /begin REF_CHARACTERISTIC P_LATC_AngCmdVld_UpTriggerHoldNum P_LATC_AngCmdVld_UpTriggerHoldNumSW P_LATC_OUT_AngCmdReqValVld_TestFlg P_LATC_OUT_AngCmdReqValVld_TestSW /end REF_CHARACTERISTIC
 /begin REF_MEASUREMENT LATC_OUT_AngCmdReqValVld autosar_swc_vmc_rtARID_DEF.Cnt_Flag autosar_swc_vmc_rtARID_DEF.EnableFlg0CountK1 autosar_swc_vmc_rtARID_DEF.EnableFlgK1 autosar_swc_vmc_rtARID_DEF.UpTrigger_ValueTemp /end REF_MEASUREMENT
/end GROUP
/begin GROUP autosar_swc_vmc_autosar_swc_vmc_Step_sys_LATC_latc_AngleCalc_latc_epsreqflgCalc_Compare_To_Constant3 "autosar_swc_vmc/autosar_swc_vmc_Step_sys/LATC/latc_AngleCalc/latc_epsreqflgCalc/Compare\nTo Constant3" /begin REF_CHARACTERISTIC P_LATC_EPSNotActiveSpdValue /end REF_CHARACTERISTIC /end GROUP
/begin GROUP autosar_swc_vmc_autosar_swc_vmc_Step_sys_LATC_latc_AngleCalc_latc_linepreviewCalc "autosar_swc_vmc/autosar_swc_vmc_Step_sys/LATC/latc_AngleCalc/latc_linepreviewCalc"
 /begin SUB_GROUP autosar_swc_vmc_autosar_swc_vmc_Step_sys_LATC_latc_AngleCalc_latc_linepreviewCalc_PreView_Distance /end SUB_GROUP
 /begin REF_CHARACTERISTIC P_LATC_DangerLevelList P_LATC_LaneBigJumpActiveA0Limit P_LATC_LaneBigJumpDeActiveA0Limit P_LATC_LaneJumpActiveA0Limit P_LATC_LaneJumpActivePointLimit P_LATC_LaneJumpAngleSlopeGainSwitch P_LATC_LaneJumpDeActivePointLimit P_LATC_PreViewPoints_T P_LATC_StepTime /end REF_CHARACTERISTIC
 /begin REF_MEASUREMENT LATC_LastPointWithTarLaneDis LATC_Poly_vec autosar_swc_vmc_rtARID_DEF.LaneJumpModeActive autosar_swc_vmc_rtARID_DEF.LastPointWithTarLaneDisK1 autosar_swc_vmc_rtARID_DEF.UnitDelay3_DSTATE autosar_swc_vmc_rtARID_DEF.functionActiceCount autosar_swc_vmc_rtARID_DEF.poly_vecK1 autosar_swc_vmc_rtARID_DEF.poly_vecK1_not_empty /end REF_MEASUREMENT
/end GROUP
/begin GROUP autosar_swc_vmc_autosar_swc_vmc_Step_sys_LATC_latc_AngleCalc_latc_linepreviewCalc_PreView_Distance "autosar_swc_vmc/autosar_swc_vmc_Step_sys/LATC/latc_AngleCalc/latc_linepreviewCalc/PreView_Distance"
 /begin SUB_GROUP autosar_swc_vmc_autosar_swc_vmc_Step_sys_LATC_latc_AngleCalc_latc_linepreviewCalc_PreView_Distance_LP_filter4 /end SUB_GROUP
 /begin REF_CHARACTERISTIC P_LATC_A2S_FliterTime P_LATC_A2_Curve_BP P_LATC_LinePreViewCurveSW P_LATC_LinePreView_spd P_LATC_LinePreviewWithCurve_T P_LATC_LinePreview_T P_LATC_StepTime P_LATC_TarLineDelaySW /end REF_CHARACTERISTIC
 /begin REF_MEASUREMENT LATC_LinePreViewDis LATC_LinePreViewT LATC_Poly_vec LATC_PreViewPointsCurve autosar_swc_vmc_rtARID_DEF.vmp_updatecntK1 autosar_swc_vmc_rtARID_DEF.xi autosar_swc_vmc_rtARID_DEF.yi /end REF_MEASUREMENT
/end GROUP
/begin GROUP autosar_swc_vmc_autosar_swc_vmc_Step_sys_LATC_latc_AngleCalc_latc_linepreviewCalc_PreView_Distance_LP_filter4 "autosar_swc_vmc/autosar_swc_vmc_Step_sys/LATC/latc_AngleCalc/latc_linepreviewCalc/PreView_Distance/LP filter4" /begin REF_CHARACTERISTIC P_LATC_StepTime /end REF_CHARACTERISTIC /begin REF_MEASUREMENT LATC_PreViewPointsCurve /end REF_MEASUREMENT /end GROUP
/begin GROUP autosar_swc_vmc_autosar_swc_vmc_Step_sys_LATC_latc_AngleCalc_latc_predisCalc "autosar_swc_vmc/autosar_swc_vmc_Step_sys/LATC/latc_AngleCalc/latc_predisCalc"
 /begin SUB_GROUP autosar_swc_vmc_autosar_swc_vmc_Step_sys_LATC_latc_AngleCalc_latc_predisCalc_LP_filter autosar_swc_vmc_autosar_swc_vmc_Step_sys_LATC_latc_AngleCalc_latc_predisCalc_Subsystem /end SUB_GROUP
 /begin REF_CHARACTERISTIC P_LATC_A0_Dis_BP P_LATC_A2S_FliterTime P_LATC_A2_Curve_BP P_LATC_A2_Pretime P_LATC_DOP_preDis P_LATC_LCK_preDis_Nomal P_LATC_preDis_AES_Fac P_LATC_preDis_DOP_Fac P_LATC_preDis_ELK_Fac P_LATC_preDis_LCCancle_Fac P_LATC_preDis_LCK_A2Curve_Fac2 P_LATC_preDis_LC_Middle_Fac P_LATC_preDis_LC_Nomal_Fac P_LATC_preDis_LC_Soft_Fac P_LATC_preDis_LKA_Fac P_LATC_preDis_Split_Fac /end REF_CHARACTERISTIC
 /begin REF_MEASUREMENT LATC_DOP_Predis LATC_DOP_PredisFac LATC_ELKPredis LATC_ELKPredisFac LATC_LCKPredis LATC_LCKPredisFac LATC_LCType LATC_LC_Complete_PreDisFac LATC_LC_LCPredis LATC_LC_LCPredisFac LATC_LC_NomalPredis LATC_LC_NomalPredisFac LATC_LC_SportPredis LATC_LC_SportPredisFac LATC_LKAPredis LATC_LKAPredisFac LATC_Predis_BaseDis LATC_Predis_Curve LATC_Predis_CurveFac LATC_finalPredis /end REF_MEASUREMENT
/end GROUP
/begin GROUP autosar_swc_vmc_autosar_swc_vmc_Step_sys_LATC_latc_AngleCalc_latc_predisCalc_LP_filter "autosar_swc_vmc/autosar_swc_vmc_Step_sys/LATC/latc_AngleCalc/latc_predisCalc/LP filter" /begin REF_CHARACTERISTIC P_LATC_StepTime /end REF_CHARACTERISTIC /begin REF_MEASUREMENT LATC_Predis_Curve /end REF_MEASUREMENT /end GROUP
/begin GROUP autosar_swc_vmc_autosar_swc_vmc_Step_sys_LATC_latc_AngleCalc_latc_predisCalc_Subsystem "autosar_swc_vmc/autosar_swc_vmc_Step_sys/LATC/latc_AngleCalc/latc_predisCalc/Subsystem"
 /begin REF_CHARACTERISTIC P_LATC_A0_Dis_BP P_LATC_A0_Dis_Factor P_LATC_DesLaneA0_HighLimit P_LATC_DesLaneA0_LowLimit P_LATC_LCKPreDisFac_Switch P_LATC_preDis_LCK_Fac /end REF_CHARACTERISTIC
 /begin REF_MEASUREMENT LATC_LCKPredisFac autosar_swc_vmc_rtARID_DEF.LastState /end REF_MEASUREMENT
/end GROUP
/begin GROUP autosar_swc_vmc_autosar_swc_vmc_Step_sys_LATC_latc_AngleCalc_latc_tarSteerAngleCalc "autosar_swc_vmc/autosar_swc_vmc_Step_sys/LATC/latc_AngleCalc/latc_tarSteerAngleCalc"
 /begin SUB_GROUP autosar_swc_vmc_autosar_swc_vmc_Step_sys_LATC_latc_AngleCalc_latc_tarSteerAngleCalc_latc_tarSteerAngleCalc /end SUB_GROUP
/end GROUP
/begin GROUP autosar_swc_vmc_autosar_swc_vmc_Step_sys_LATC_latc_AngleCalc_latc_tarSteerAngleCalc_latc_tarSteerAngleCalc "autosar_swc_vmc/autosar_swc_vmc_Step_sys/LATC/latc_AngleCalc/latc_tarSteerAngleCalc/latc_tarSteerAngleCalc"
 /begin SUB_GROUP autosar_swc_vmc_autosar_swc_vmc_Step_sys_LATC_latc_AngleCalc_latc_tarSteerAngleCalc_latc_tarSteerAngleCalc_LP_filter1 autosar_swc_vmc_autosar_swc_vmc_Step_sys_LATC_latc_AngleCalc_latc_tarSteerAngleCalc_latc_tarSteerAngleCalc_Subsystem3 /end SUB_GROUP
 /begin REF_CHARACTERISTIC P_LATC_DeltaEps_SpdBp P_LATC_DeltaEps_TimeVal P_LATC_DxOffestLength P_LATC_StepTime /end REF_CHARACTERISTIC
 /begin REF_MEASUREMENT LATC_AngClcCnt LATC_CurSteerAngle_deg LATC_DeltaAngle LATC_OUT_ReqEPSTrgAngle LATC_PreDisReductionFlg LATC_Q LATC_TarAngleLastPoint_X LATC_TarAngleLastPoint_Y LATC_TarAngle_MaxAng LATC_TarAngle_MaxAngSpd LATC_TarSteerAngleCalc_J LATC_TarSteerAngleCalc_Jq LATC_TarSteerAngleCalc_Jr1 LATC_TarSteerAngleCalc_Num LATC_TarSteerAngleCalc_XX LATC_TarSteerAngleCalc_YY LATC_TarSteerAngleCalc_Yaw LATC_TarSteerAngleEnd LATC_TarSteerAngle_Addoffset LATC_TarSteerAngle_FilterTime LATC_TarSteerAnglecala LATC_finalPredis autosar_swc_vmc_rtARID_DEF.UnitDelay_DSTATE_i1 autosar_swc_vmc_rtARID_DEF.cnt /end REF_MEASUREMENT
/end GROUP
/begin GROUP autosar_swc_vmc_autosar_swc_vmc_Step_sys_LATC_latc_AngleCalc_latc_tarSteerAngleCalc_latc_tarSteerAngleCalc_LP_filter1 "autosar_swc_vmc/autosar_swc_vmc_Step_sys/LATC/latc_AngleCalc/latc_tarSteerAngleCalc/latc_tarSteerAngleCalc/LP filter1" /begin REF_CHARACTERISTIC P_LATC_StepTime /end REF_CHARACTERISTIC /begin REF_MEASUREMENT LATC_TarSteerAngle_FilterTime LATC_TarSteerAnglecala /end REF_MEASUREMENT /end GROUP
/begin GROUP autosar_swc_vmc_autosar_swc_vmc_Step_sys_LATC_latc_AngleCalc_latc_tarSteerAngleCalc_latc_tarSteerAngleCalc_Subsystem3 "autosar_swc_vmc/autosar_swc_vmc_Step_sys/LATC/latc_AngleCalc/latc_tarSteerAngleCalc/latc_tarSteerAngleCalc/Subsystem3"
 /begin REF_CHARACTERISTIC P_LATC_A0_Dis_BP P_LATC_Ang_max P_LATC_Ang_slopemax P_LATC_Ang_spd P_LATC_AngleFilterTime P_LATC_AngleFilterTime_LC P_LATC_AngleFilterTime_LSS P_LATC_StepTime /end REF_CHARACTERISTIC
 /begin REF_MEASUREMENT LATC_TarAngle_MaxAng LATC_TarAngle_MaxAngSpd /end REF_MEASUREMENT
/end GROUP
/begin GROUP autosar_swc_vmc_autosar_swc_vmc_Step_sys_LATC_latc_AngleCalc_latc_valconvertCalc "autosar_swc_vmc/autosar_swc_vmc_Step_sys/LATC/latc_AngleCalc/latc_valconvertCalc" /begin REF_MEASUREMENT LATC_CurSteerAngle_deg /end REF_MEASUREMENT /end GROUP
/begin GROUP autosar_swc_vmc_autosar_swc_vmc_Step_sys_LATC_latc_adaptIn "autosar_swc_vmc/autosar_swc_vmc_Step_sys/LATC/latc_adaptIn"
 /begin SUB_GROUP autosar_swc_vmc_autosar_swc_vmc_Step_sys_LATC_latc_adaptIn_Subsystem2 autosar_swc_vmc_autosar_swc_vmc_Step_sys_LATC_latc_adaptIn_latc_currentsteangoffsetCalc /end SUB_GROUP
 /begin REF_MEASUREMENT LATC_IN_SteerAngOffset_deg LATC_IN_alpSideSlipAngle LATC_IN_axvRefMs2 LATC_IN_ayvRefMs2 LATC_IN_kapTraj LATC_IN_psiDtOpt LATC_IN_vxvRefMs LATC_VIE_SteerAngOffset_deg /end REF_MEASUREMENT
/end GROUP
/begin GROUP autosar_swc_vmc_autosar_swc_vmc_Step_sys_LATC_latc_adaptIn_Subsystem2 "autosar_swc_vmc/autosar_swc_vmc_Step_sys/LATC/latc_adaptIn/Subsystem2" /begin REF_MEASUREMENT LATC_IN_SteerWheelAng LATC_IN_SteerWheelSpd /end REF_MEASUREMENT /end GROUP
/begin GROUP autosar_swc_vmc_autosar_swc_vmc_Step_sys_LATC_latc_adaptIn_latc_currentsteangoffsetCalc "autosar_swc_vmc/autosar_swc_vmc_Step_sys/LATC/latc_adaptIn/latc_currentsteangoffsetCalc"
 /begin SUB_GROUP autosar_swc_vmc_autosar_swc_vmc_Step_sys_LATC_latc_adaptIn_latc_currentsteangoffsetCalc_Compare_To_Constant1 autosar_swc_vmc_autosar_swc_vmc_Step_sys_LATC_latc_adaptIn_latc_currentsteangoffsetCalc_Enabled_Subsystem autosar_swc_vmc_autosar_swc_vmc_Step_sys_LATC_latc_adaptIn_latc_currentsteangoffsetCalc_LP_filter autosar_swc_vmc_autosar_swc_vmc_Step_sys_LATC_latc_adaptIn_latc_currentsteangoffsetCalc_LP_filter1 /end SUB_GROUP
 /begin REF_CHARACTERISTIC P_LATC_CurOffsetA2_FliterTime P_LATC_SteerAngleOffset_VirSwitch P_LATC_SteerAngleOffset_VirValue /end REF_CHARACTERISTIC
 /begin REF_MEASUREMENT LATC_AckConstValue LATC_CurrentSteerAngleOffset_deg LATC_OffSetUpdate_Flg LATC_PsiDtAckValue /end REF_MEASUREMENT
/end GROUP
/begin GROUP autosar_swc_vmc_autosar_swc_vmc_Step_sys_LATC_latc_adaptIn_latc_currentsteangoffsetCalc_Compare_To_Constant1 "autosar_swc_vmc/autosar_swc_vmc_Step_sys/LATC/latc_adaptIn/latc_currentsteangoffsetCalc/Compare\nTo Constant1" /begin REF_CHARACTERISTIC P_LATC_CurOffset_VehicleSpd_LimitValue /end REF_CHARACTERISTIC /end GROUP
/begin GROUP autosar_swc_vmc_autosar_swc_vmc_Step_sys_LATC_latc_adaptIn_latc_currentsteangoffsetCalc_Enabled_Subsystem "autosar_swc_vmc/autosar_swc_vmc_Step_sys/LATC/latc_adaptIn/latc_currentsteangoffsetCalc/Enabled\nSubsystem"
 /begin REF_CHARACTERISTIC P_LATC_A2_CurrentOffsetFliterTime P_LATC_A2_Curve_BP P_LATC_CurOffsetVIEOffset_SW P_LATC_CurSteerAngleOffsetLimit P_LATC_OffsetError_BP P_LATC_OffsetError_Fac P_LATC_StepTime /end REF_CHARACTERISTIC
 /begin REF_MEASUREMENT LATC_CurOffsetError LATC_CurOffsetFliter_Fac autosar_swc_vmc_rtARID_DEF.UnitDelay_DSTATE_hl /end REF_MEASUREMENT
/end GROUP
/begin GROUP autosar_swc_vmc_autosar_swc_vmc_Step_sys_LATC_latc_adaptIn_latc_currentsteangoffsetCalc_LP_filter "autosar_swc_vmc/autosar_swc_vmc_Step_sys/LATC/latc_adaptIn/latc_currentsteangoffsetCalc/LP filter" /begin REF_CHARACTERISTIC P_LATC_StepTime /end REF_CHARACTERISTIC /begin REF_MEASUREMENT autosar_swc_vmc_rtARID_DEF.Memory2_PreviousInput /end REF_MEASUREMENT /end GROUP
/begin GROUP autosar_swc_vmc_autosar_swc_vmc_Step_sys_LATC_latc_adaptIn_latc_currentsteangoffsetCalc_LP_filter1 "autosar_swc_vmc/autosar_swc_vmc_Step_sys/LATC/latc_adaptIn/latc_currentsteangoffsetCalc/LP filter1"
 /begin SUB_GROUP autosar_swc_vmc_autosar_swc_vmc_Step_sys_LATC_latc_adaptIn_latc_currentsteangoffsetCalc_LP_filter1_DiscreteLowPassFilter /end SUB_GROUP
 /begin REF_CHARACTERISTIC P_LATC_StepTime /end REF_CHARACTERISTIC
/end GROUP
/begin GROUP autosar_swc_vmc_autosar_swc_vmc_Step_sys_LATC_latc_adaptIn_latc_currentsteangoffsetCalc_LP_filter1_DiscreteLowPassFilter "autosar_swc_vmc/autosar_swc_vmc_Step_sys/LATC/latc_adaptIn/latc_currentsteangoffsetCalc/LP filter1/DiscreteLowPassFilter" /begin REF_CHARACTERISTIC P_LATC_StepTime /end REF_CHARACTERISTIC
 /begin REF_MEASUREMENT autosar_swc_vmc_rtARID_DEF.UnitDelay1_DSTATE_p3 autosar_swc_vmc_rtARID_DEF.UnitDelay_DSTATE_ix /end REF_MEASUREMENT
/end GROUP
/begin GROUP autosar_swc_vmc_autosar_swc_vmc_Step_sys_LATC_latc_adaptOut "autosar_swc_vmc/autosar_swc_vmc_Step_sys/LATC/latc_adaptOut"
 /begin SUB_GROUP autosar_swc_vmc_autosar_swc_vmc_Step_sys_LATC_latc_adaptOut_latc_steerAngleSlopeTest /end SUB_GROUP
 /begin REF_CHARACTERISTIC P_LATC_communicationTest /end REF_CHARACTERISTIC
 /begin REF_MEASUREMENT LATC_communicationTest_IFCAngCmdReqValue LATC_communicationTest_IFCFuncAngCmdReqFlag LATC_communicationTest_IFCFuncTrqCmdReqFlag LATC_communicationTest_IFCTrqOvlCmdReqValue autosar_swc_vmc_rtARID_DEF.UnitDelay19_DSTATE autosar_swc_vmc_rtARID_DEF.UnitDelay1_DSTATE_f autosar_swc_vmc_rtARID_DEF.UnitDelay20_DSTATE autosar_swc_vmc_rtARID_DEF.UnitDelay2_DSTATE autosar_swc_vmc_rtARID_DEF.UnitDelay3_DSTATE_j autosar_swc_vmc_rtARID_DEF.UnitDelay4_DSTATE autosar_swc_vmc_rtARID_DEF.UnitDelay8_DSTATE autosar_swc_vmc_rtARID_DEF.UnitDelay9_DSTATE /end REF_MEASUREMENT
/end GROUP
/begin GROUP autosar_swc_vmc_autosar_swc_vmc_Step_sys_LATC_latc_adaptOut_latc_steerAngleSlopeTest "autosar_swc_vmc/autosar_swc_vmc_Step_sys/LATC/latc_adaptOut/latc_steerAngleSlopeTest"
 /begin REF_CHARACTERISTIC P_LATC_OUT_AngCmdReqVal_TestSW P_LATC_OUT_AngCmdReqVal_TestValue P_LATC_communicationTest_SteerAngleSlopeTest_Enable P_LATC_communicationTest_SteerAngleSlopeTest_MaxValue P_LATC_communicationTest_SteerAngleSlopeTest_MinValue P_LATC_communicationTest_SteerAngleSlopeTest_Slope /end REF_CHARACTERISTIC
 /begin REF_MEASUREMENT autosar_swc_vmc_rtARID_DEF.DirFlg autosar_swc_vmc_rtARID_DEF.EnableK1 autosar_swc_vmc_rtARID_DEF.EnableK1_not_empty autosar_swc_vmc_rtARID_DEF.OutValueK1 autosar_swc_vmc_rtARID_DEF.is_first_run_not_empty /end REF_MEASUREMENT
/end GROUP
/begin GROUP autosar_swc_vmc_autosar_swc_vmc_Step_sys_LONC "autosar_swc_vmc/autosar_swc_vmc_Step_sys/LONC"
 /begin SUB_GROUP autosar_swc_vmc_autosar_swc_vmc_Step_sys_LONC_lonc_adaptIn autosar_swc_vmc_autosar_swc_vmc_Step_sys_LONC_lonc_adaptOut autosar_swc_vmc_autosar_swc_vmc_Step_sys_LONC_lonc_vlcCalc /end SUB_GROUP
/end GROUP
/begin GROUP autosar_swc_vmc_autosar_swc_vmc_Step_sys_LONC_lonc_adaptIn "autosar_swc_vmc/autosar_swc_vmc_Step_sys/LONC/lonc_adaptIn"
 /begin SUB_GROUP autosar_swc_vmc_autosar_swc_vmc_Step_sys_LONC_lonc_adaptIn_Compare_To_Constant2 /end SUB_GROUP
 /begin REF_CHARACTERISTIC P_LongCtrl_VLCTrRatioMax P_LongCtrl_VLCTrRatioMin /end REF_CHARACTERISTIC
 /begin REF_MEASUREMENT autosar_swc_vmc_rtARID_DEF.y /end REF_MEASUREMENT
/end GROUP
/begin GROUP autosar_swc_vmc_autosar_swc_vmc_Step_sys_LONC_lonc_adaptIn_Compare_To_Constant2 "autosar_swc_vmc/autosar_swc_vmc_Step_sys/LONC/lonc_adaptIn/Compare\nTo Constant2" /begin REF_MEASUREMENT autosar_swc_vmc_rtARID_DEF.Compare /end REF_MEASUREMENT /end GROUP
/begin GROUP autosar_swc_vmc_autosar_swc_vmc_Step_sys_LONC_lonc_adaptOut "autosar_swc_vmc/autosar_swc_vmc_Step_sys/LONC/lonc_adaptOut"
 /begin SUB_GROUP autosar_swc_vmc_autosar_swc_vmc_Step_sys_LONC_lonc_adaptOut_Subsystem autosar_swc_vmc_autosar_swc_vmc_Step_sys_LONC_lonc_adaptOut_Subsystem1 /end SUB_GROUP
 /begin REF_CHARACTERISTIC P_LongCtrl_VLCTaraccelOverrideSwitch P_LongCtrl_VLCTaraccelSlope /end REF_CHARACTERISTIC
 /begin REF_MEASUREMENT autosar_swc_vmc_rtARID_DEF.Compare autosar_swc_vmc_rtARID_DEF.Taraccelk1 /end REF_MEASUREMENT
/end GROUP
/begin GROUP autosar_swc_vmc_autosar_swc_vmc_Step_sys_LONC_lonc_adaptOut_Subsystem "autosar_swc_vmc/autosar_swc_vmc_Step_sys/LONC/lonc_adaptOut/Subsystem"
 /begin REF_CHARACTERISTIC P_VMC_FuSaTestEnable P_VMC_FuSaTest_AccelPresets P_VMC_FuSaTest_Accel_A P_VMC_FuSaTest_Accel_T /end REF_CHARACTERISTIC
 /begin REF_MEASUREMENT autosar_swc_vmc_rtARID_DEF.Compare autosar_swc_vmc_rtARID_DEF.UnitDelay_DSTATE_mr autosar_swc_vmc_rtARID_DEF.accelk1 autosar_swc_vmc_rtARID_DEF.timer_h /end REF_MEASUREMENT
/end GROUP
/begin GROUP autosar_swc_vmc_autosar_swc_vmc_Step_sys_LONC_lonc_adaptOut_Subsystem1 "autosar_swc_vmc/autosar_swc_vmc_Step_sys/LONC/lonc_adaptOut/Subsystem1" /begin REF_CHARACTERISTIC P_LongCtrl_VLCDecToStopDecValue P_VMC_FuSaTestEnable /end REF_CHARACTERISTIC /end GROUP
/begin GROUP autosar_swc_vmc_autosar_swc_vmc_Step_sys_LONC_lonc_vlcCalc "autosar_swc_vmc/autosar_swc_vmc_Step_sys/LONC/lonc_vlcCalc"
 /begin SUB_GROUP autosar_swc_vmc_autosar_swc_vmc_Step_sys_LONC_lonc_vlcCalc_lonc_decelreqCalc autosar_swc_vmc_autosar_swc_vmc_Step_sys_LONC_lonc_vlcCalc_lonc_engTrqInput autosar_swc_vmc_autosar_swc_vmc_Step_sys_LONC_lonc_vlcCalc_lonc_grp_engTrq autosar_swc_vmc_autosar_swc_vmc_Step_sys_LONC_lonc_vlcCalc_lonc_grp_wheelTrq autosar_swc_vmc_autosar_swc_vmc_Step_sys_LONC_lonc_vlcCalc_lonc_wheelTrqInput /end SUB_GROUP
 /begin REF_MEASUREMENT autosar_swc_vmc_rtARID_DEF.UnitDelay1_DSTATE_p autosar_swc_vmc_rtARID_DEF.UnitDelay_DSTATE_b /end REF_MEASUREMENT
/end GROUP
/begin GROUP autosar_swc_vmc_autosar_swc_vmc_Step_sys_LONC_lonc_vlcCalc_lonc_decelreqCalc "autosar_swc_vmc/autosar_swc_vmc_Step_sys/LONC/lonc_vlcCalc/lonc_decelreqCalc"
 /begin SUB_GROUP autosar_swc_vmc_autosar_swc_vmc_Step_sys_LONC_lonc_vlcCalc_lonc_decelreqCalc_lonc_grp_commonMain /end SUB_GROUP
/end GROUP
/begin GROUP autosar_swc_vmc_autosar_swc_vmc_Step_sys_LONC_lonc_vlcCalc_lonc_decelreqCalc_lonc_grp_commonMain "autosar_swc_vmc/autosar_swc_vmc_Step_sys/LONC/lonc_vlcCalc/lonc_decelreqCalc/lonc_grp_commonMain"
 /begin SUB_GROUP autosar_swc_vmc_autosar_swc_vmc_Step_sys_LONC_lonc_vlcCalc_lonc_decelreqCalc_lonc_grp_commonMain_lonc_axvTracMinCalc autosar_swc_vmc_autosar_swc_vmc_Step_sys_LONC_lonc_vlcCalc_lonc_decelreqCalc_lonc_grp_commonMain_lonc_controllerInputCalc autosar_swc_vmc_autosar_swc_vmc_Step_sys_LONC_lonc_vlcCalc_lonc_decelreqCalc_lonc_grp_commonMain_lonc_decelReqCalc autosar_swc_vmc_autosar_swc_vmc_Step_sys_LONC_lonc_vlcCalc_lonc_decelreqCalc_lonc_grp_commonMain_lonc_ffFxvRaw autosar_swc_vmc_autosar_swc_vmc_Step_sys_LONC_lonc_vlcCalc_lonc_decelreqCalc_lonc_grp_commonMain_lonc_piFxvRaw autosar_swc_vmc_autosar_swc_vmc_Step_sys_LONC_lonc_vlcCalc_lonc_decelreqCalc_lonc_grp_commonMain_lonc_switchToBrakeMode autosar_swc_vmc_autosar_swc_vmc_Step_sys_LONC_lonc_vlcCalc_lonc_decelreqCalc_lonc_grp_commonMain_lonc_switchToDriveMode autosar_swc_vmc_autosar_swc_vmc_Step_sys_LONC_lonc_vlcCalc_lonc_decelreqCalc_lonc_grp_commonMain_lonc_switchToDrivenBrakeMode autosar_swc_vmc_autosar_swc_vmc_Step_sys_LONC_lonc_vlcCalc_lonc_decelreqCalc_lonc_grp_commonMain_lonc_vlcInternalAccCalc autosar_swc_vmc_autosar_swc_vmc_Step_sys_LONC_lonc_vlcCalc_lonc_decelreqCalc_lonc_grp_commonMain_lonc_vlcStatusMechine /end SUB_GROUP
/end GROUP
/begin GROUP autosar_swc_vmc_autosar_swc_vmc_Step_sys_LONC_lonc_vlcCalc_lonc_decelreqCalc_lonc_grp_commonMain_lonc_axvTracMinCalc "autosar_swc_vmc/autosar_swc_vmc_Step_sys/LONC/lonc_vlcCalc/lonc_decelreqCalc/lonc_grp_commonMain/lonc_axvTracMinCalc"
 /begin REF_CHARACTERISTIC P_LongCtrl_VLC_WindArea P_LongCtrl_VLC_fRollCoef P_LongCtrl_VLCcoefFXAxis P_LongCtrl_VLCcoefFYAxis /end REF_CHARACTERISTIC
/end GROUP
/begin GROUP autosar_swc_vmc_autosar_swc_vmc_Step_sys_LONC_lonc_vlcCalc_lonc_decelreqCalc_lonc_grp_commonMain_lonc_controllerInputCalc "autosar_swc_vmc/autosar_swc_vmc_Step_sys/LONC/lonc_vlcCalc/lonc_decelreqCalc/lonc_grp_commonMain/lonc_controllerInputCalc"
 /begin SUB_GROUP autosar_swc_vmc_autosar_swc_vmc_Step_sys_LONC_lonc_vlcCalc_lonc_decelreqCalc_lonc_grp_commonMain_lonc_controllerInputCalc_lonc_axvClosedLoopControlCalc autosar_swc_vmc_autosar_swc_vmc_Step_sys_LONC_lonc_vlcCalc_lonc_decelreqCalc_lonc_grp_commonMain_lonc_controllerInputCalc_lonc_axvTracActMeanCalc autosar_swc_vmc_autosar_swc_vmc_Step_sys_LONC_lonc_vlcCalc_lonc_decelreqCalc_lonc_grp_commonMain_lonc_controllerInputCalc_lonc_grp_axvModelResidualCalc autosar_swc_vmc_autosar_swc_vmc_Step_sys_LONC_lonc_vlcCalc_lonc_decelreqCalc_lonc_grp_commonMain_lonc_controllerInputCalc_lonc_tauFxvCvFilter /end SUB_GROUP
/end GROUP
/begin GROUP autosar_swc_vmc_autosar_swc_vmc_Step_sys_LONC_lonc_vlcCalc_lonc_decelreqCalc_lonc_grp_commonMain_lonc_controllerInputCalc_lonc_axvClosedLoopControlCalc "autosar_swc_vmc/autosar_swc_vmc_Step_sys/LONC/lonc_vlcCalc/lonc_decelreqCalc/lonc_grp_commonMain/lonc_controllerInputCalc/lonc_axvClosedLoopControlCalc"
 /begin SUB_GROUP autosar_swc_vmc_autosar_swc_vmc_Step_sys_LONC_lonc_vlcCalc_lonc_decelreqCalc_lonc_grp_commonMain_lonc_controllerInputCalc_lonc_axvClosedLoopControlCalc_Compare_To_Constant /end SUB_GROUP
 /begin REF_CHARACTERISTIC P_LongCtrl_ECDCaxvClosedLoopLowerBand /end REF_CHARACTERISTIC
/end GROUP
/begin GROUP autosar_swc_vmc_autosar_swc_vmc_Step_sys_LONC_lonc_vlcCalc_lonc_decelreqCalc_lonc_grp_commonMain_lonc_controllerInputCalc_lonc_axvClosedLoopControlCalc_Compare_To_Constant "autosar_swc_vmc/autosar_swc_vmc_Step_sys/LONC/lonc_vlcCalc/lonc_decelreqCalc/lonc_grp_commonMain/lonc_controllerInputCalc/lonc_axvClosedLoopControlCalc/Compare\nTo Constant" /begin REF_MEASUREMENT autosar_swc_vmc_rtARID_DEF.VLCSts /end REF_MEASUREMENT /end GROUP
/begin GROUP autosar_swc_vmc_autosar_swc_vmc_Step_sys_LONC_lonc_vlcCalc_lonc_decelreqCalc_lonc_grp_commonMain_lonc_controllerInputCalc_lonc_axvTracActMeanCalc "autosar_swc_vmc/autosar_swc_vmc_Step_sys/LONC/lonc_vlcCalc/lonc_decelreqCalc/lonc_grp_commonMain/lonc_controllerInputCalc/lonc_axvTracActMeanCalc"
 /begin REF_CHARACTERISTIC P_LongCtrl_VLC_WindArea P_LongCtrl_VLC_fRollCoef P_LongCtrl_VLCcoefFXAxis P_LongCtrl_VLCcoefFYAxis /end REF_CHARACTERISTIC
/end GROUP
/begin GROUP autosar_swc_vmc_autosar_swc_vmc_Step_sys_LONC_lonc_vlcCalc_lonc_decelreqCalc_lonc_grp_commonMain_lonc_controllerInputCalc_lonc_grp_axvModelResidualCalc "autosar_swc_vmc/autosar_swc_vmc_Step_sys/LONC/lonc_vlcCalc/lonc_decelreqCalc/lonc_grp_commonMain/lonc_controllerInputCalc/lonc_grp_axvModelResidualCalc"
 /begin SUB_GROUP autosar_swc_vmc_autosar_swc_vmc_Step_sys_LONC_lonc_vlcCalc_lonc_decelreqCalc_lonc_grp_commonMain_lonc_controllerInputCalc_lonc_grp_axvModelResidualCalc_lonc_axvModelResidualCalc autosar_swc_vmc_autosar_swc_vmc_Step_sys_LONC_lonc_vlcCalc_lonc_decelreqCalc_lonc_grp_commonMain_lonc_controllerInputCalc_lonc_grp_axvModelResidualCalc_lonc_updateFlagCalc /end SUB_GROUP
/end GROUP
/begin GROUP autosar_swc_vmc_autosar_swc_vmc_Step_sys_LONC_lonc_vlcCalc_lonc_decelreqCalc_lonc_grp_commonMain_lonc_controllerInputCalc_lonc_grp_axvModelResidualCalc_lonc_axvModelResidualCalc "autosar_swc_vmc/autosar_swc_vmc_Step_sys/LONC/lonc_vlcCalc/lonc_decelreqCalc/lonc_grp_commonMain/lonc_controllerInputCalc/lonc_grp_axvModelResidualCalc/lonc_axvModelResidualCalc" /begin REF_CHARACTERISTIC P_LATC_StepTime /end REF_CHARACTERISTIC /begin REF_MEASUREMENT autosar_swc_vmc_rtARID_DEF.UnitDelay_DSTATE_hu /end REF_MEASUREMENT /end GROUP
/begin GROUP autosar_swc_vmc_autosar_swc_vmc_Step_sys_LONC_lonc_vlcCalc_lonc_decelreqCalc_lonc_grp_commonMain_lonc_controllerInputCalc_lonc_grp_axvModelResidualCalc_lonc_updateFlagCalc "autosar_swc_vmc/autosar_swc_vmc_Step_sys/LONC/lonc_vlcCalc/lonc_decelreqCalc/lonc_grp_commonMain/lonc_controllerInputCalc/lonc_grp_axvModelResidualCalc/lonc_updateFlagCalc"
 /begin SUB_GROUP autosar_swc_vmc_autosar_swc_vmc_Step_sys_LONC_lonc_vlcCalc_lonc_decelreqCalc_lonc_grp_commonMain_lonc_controllerInputCalc_lonc_grp_axvModelResidualCalc_lonc_updateFlagCalc_Compare_To_Constant5 autosar_swc_vmc_autosar_swc_vmc_Step_sys_LONC_lonc_vlcCalc_lonc_decelreqCalc_lonc_grp_commonMain_lonc_controllerInputCalc_lonc_grp_axvModelResidualCalc_lonc_updateFlagCalc_Compare_To_Constant6 autosar_swc_vmc_autosar_swc_vmc_Step_sys_LONC_lonc_vlcCalc_lonc_decelreqCalc_lonc_grp_commonMain_lonc_controllerInputCalc_lonc_grp_axvModelResidualCalc_lonc_updateFlagCalc_Timer1 /end SUB_GROUP
 /begin REF_MEASUREMENT autosar_swc_vmc_rtARID_DEF.TappedDelay2_X /end REF_MEASUREMENT
/end GROUP
/begin GROUP autosar_swc_vmc_autosar_swc_vmc_Step_sys_LONC_lonc_vlcCalc_lonc_decelreqCalc_lonc_grp_commonMain_lonc_controllerInputCalc_lonc_grp_axvModelResidualCalc_lonc_updateFlagCalc_Compare_To_Constant5 "autosar_swc_vmc/autosar_swc_vmc_Step_sys/LONC/lonc_vlcCalc/lonc_decelreqCalc/lonc_grp_commonMain/lonc_controllerInputCalc/lonc_grp_axvModelResidualCalc/lonc_updateFlagCalc/Compare To Constant5" /begin REF_CHARACTERISTIC P_LongCtrl_VLCaDtThresUpdateTorq /end REF_CHARACTERISTIC /end GROUP
/begin GROUP autosar_swc_vmc_autosar_swc_vmc_Step_sys_LONC_lonc_vlcCalc_lonc_decelreqCalc_lonc_grp_commonMain_lonc_controllerInputCalc_lonc_grp_axvModelResidualCalc_lonc_updateFlagCalc_Compare_To_Constant6 "autosar_swc_vmc/autosar_swc_vmc_Step_sys/LONC/lonc_vlcCalc/lonc_decelreqCalc/lonc_grp_commonMain/lonc_controllerInputCalc/lonc_grp_axvModelResidualCalc/lonc_updateFlagCalc/Compare To Constant6" /begin REF_CHARACTERISTIC P_LongCtrl_VLCvel1ThresUpdateTorq /end REF_CHARACTERISTIC /end GROUP
/begin GROUP autosar_swc_vmc_autosar_swc_vmc_Step_sys_LONC_lonc_vlcCalc_lonc_decelreqCalc_lonc_grp_commonMain_lonc_controllerInputCalc_lonc_grp_axvModelResidualCalc_lonc_updateFlagCalc_Timer1 "autosar_swc_vmc/autosar_swc_vmc_Step_sys/LONC/lonc_vlcCalc/lonc_decelreqCalc/lonc_grp_commonMain/lonc_controllerInputCalc/lonc_grp_axvModelResidualCalc/lonc_updateFlagCalc/Timer1"
 /begin SUB_GROUP autosar_swc_vmc_autosar_swc_vmc_Step_sys_LONC_lonc_vlcCalc_lonc_decelreqCalc_lonc_grp_commonMain_lonc_controllerInputCalc_lonc_grp_axvModelResidualCalc_lonc_updateFlagCalc_Timer1_Detect_Decrease /end SUB_GROUP
 /begin REF_MEASUREMENT autosar_swc_vmc_rtARID_DEF.UnitDelay1_DSTATE_kj autosar_swc_vmc_rtARID_DEF.UnitDelay_DSTATE_cx /end REF_MEASUREMENT
/end GROUP
/begin GROUP autosar_swc_vmc_autosar_swc_vmc_Step_sys_LONC_lonc_vlcCalc_lonc_decelreqCalc_lonc_grp_commonMain_lonc_controllerInputCalc_lonc_grp_axvModelResidualCalc_lonc_updateFlagCalc_Timer1_Detect_Decrease "autosar_swc_vmc/autosar_swc_vmc_Step_sys/LONC/lonc_vlcCalc/lonc_decelreqCalc/lonc_grp_commonMain/lonc_controllerInputCalc/lonc_grp_axvModelResidualCalc/lonc_updateFlagCalc/Timer1/Detect\nDecrease" /begin REF_MEASUREMENT autosar_swc_vmc_rtARID_DEF.DelayInput1_DSTATE /end REF_MEASUREMENT /end GROUP
/begin GROUP autosar_swc_vmc_autosar_swc_vmc_Step_sys_LONC_lonc_vlcCalc_lonc_decelreqCalc_lonc_grp_commonMain_lonc_controllerInputCalc_lonc_tauFxvCvFilter "autosar_swc_vmc/autosar_swc_vmc_Step_sys/LONC/lonc_vlcCalc/lonc_decelreqCalc/lonc_grp_commonMain/lonc_controllerInputCalc/lonc_tauFxvCvFilter"
 /begin SUB_GROUP autosar_swc_vmc_autosar_swc_vmc_Step_sys_LONC_lonc_vlcCalc_lonc_decelreqCalc_lonc_grp_commonMain_lonc_controllerInputCalc_lonc_tauFxvCvFilter_LP1 /end SUB_GROUP
 /begin REF_CHARACTERISTIC P_LATC_StepTime /end REF_CHARACTERISTIC
 /begin REF_MEASUREMENT autosar_swc_vmc_rtARID_DEF.UnitDelay_DSTATE_iu /end REF_MEASUREMENT
/end GROUP
/begin GROUP autosar_swc_vmc_autosar_swc_vmc_Step_sys_LONC_lonc_vlcCalc_lonc_decelreqCalc_lonc_grp_commonMain_lonc_controllerInputCalc_lonc_tauFxvCvFilter_LP1 "autosar_swc_vmc/autosar_swc_vmc_Step_sys/LONC/lonc_vlcCalc/lonc_decelreqCalc/lonc_grp_commonMain/lonc_controllerInputCalc/lonc_tauFxvCvFilter/LP1" /begin REF_CHARACTERISTIC P_LATC_StepTime /end REF_CHARACTERISTIC /begin REF_MEASUREMENT autosar_swc_vmc_rtARID_DEF.UnitDelay_DSTATE_bi /end REF_MEASUREMENT /end GROUP
/begin GROUP autosar_swc_vmc_autosar_swc_vmc_Step_sys_LONC_lonc_vlcCalc_lonc_decelreqCalc_lonc_grp_commonMain_lonc_decelReqCalc "autosar_swc_vmc/autosar_swc_vmc_Step_sys/LONC/lonc_vlcCalc/lonc_decelreqCalc/lonc_grp_commonMain/lonc_decelReqCalc"
 /begin REF_CHARACTERISTIC P_LongCtrl_VLC_DecelReq P_LongCtrl_VLC_DecelReqPosConst P_LongCtrl_VLCaccelMinHoldXAxis P_LongCtrl_VLCaccelMinHoldYAxis P_LongCtrl_VLCjerkHoldXAxis P_LongCtrl_VLCjerkHoldYAxis /end REF_CHARACTERISTIC
 /begin REF_MEASUREMENT autosar_swc_vmc_rtARID_DEF.Compare autosar_swc_vmc_rtARID_DEF.DCEnable autosar_swc_vmc_rtARID_DEF.ECEnable autosar_swc_vmc_rtARID_DEF.TappedDelay_X_d autosar_swc_vmc_rtARID_DEF.decelReqK1 autosar_swc_vmc_rtARID_DEF.timer autosar_swc_vmc_rtARID_DEF.timerFailure autosar_swc_vmc_rtARID_DEF.y /end REF_MEASUREMENT
/end GROUP
/begin GROUP autosar_swc_vmc_autosar_swc_vmc_Step_sys_LONC_lonc_vlcCalc_lonc_decelreqCalc_lonc_grp_commonMain_lonc_ffFxvRaw "autosar_swc_vmc/autosar_swc_vmc_Step_sys/LONC/lonc_vlcCalc/lonc_decelreqCalc/lonc_grp_commonMain/lonc_ffFxvRaw"
 /begin SUB_GROUP autosar_swc_vmc_autosar_swc_vmc_Step_sys_LONC_lonc_vlcCalc_lonc_decelreqCalc_lonc_grp_commonMain_lonc_ffFxvRaw_LowPassFilter autosar_swc_vmc_autosar_swc_vmc_Step_sys_LONC_lonc_vlcCalc_lonc_decelreqCalc_lonc_grp_commonMain_lonc_ffFxvRaw_LowPassFilter1 /end SUB_GROUP
 /begin REF_MEASUREMENT LongCtrl_VLC_FF_FxvReqRaw /end REF_MEASUREMENT
/end GROUP
/begin GROUP autosar_swc_vmc_autosar_swc_vmc_Step_sys_LONC_lonc_vlcCalc_lonc_decelreqCalc_lonc_grp_commonMain_lonc_ffFxvRaw_LowPassFilter "autosar_swc_vmc/autosar_swc_vmc_Step_sys/LONC/lonc_vlcCalc/lonc_decelreqCalc/lonc_grp_commonMain/lonc_ffFxvRaw/LowPassFilter" /begin REF_CHARACTERISTIC P_LATC_StepTime /end REF_CHARACTERISTIC /begin REF_MEASUREMENT autosar_swc_vmc_rtARID_DEF.UnitDelay_DSTATE_gb /end REF_MEASUREMENT /end GROUP
/begin GROUP autosar_swc_vmc_autosar_swc_vmc_Step_sys_LONC_lonc_vlcCalc_lonc_decelreqCalc_lonc_grp_commonMain_lonc_ffFxvRaw_LowPassFilter1 "autosar_swc_vmc/autosar_swc_vmc_Step_sys/LONC/lonc_vlcCalc/lonc_decelreqCalc/lonc_grp_commonMain/lonc_ffFxvRaw/LowPassFilter1" /begin REF_MEASUREMENT autosar_swc_vmc_rtARID_DEF.UnitDelay1_DSTATE_en /end REF_MEASUREMENT /end GROUP
/begin GROUP autosar_swc_vmc_autosar_swc_vmc_Step_sys_LONC_lonc_vlcCalc_lonc_decelreqCalc_lonc_grp_commonMain_lonc_piFxvRaw "autosar_swc_vmc/autosar_swc_vmc_Step_sys/LONC/lonc_vlcCalc/lonc_decelreqCalc/lonc_grp_commonMain/lonc_piFxvRaw"
 /begin SUB_GROUP autosar_swc_vmc_autosar_swc_vmc_Step_sys_LONC_lonc_vlcCalc_lonc_decelreqCalc_lonc_grp_commonMain_lonc_piFxvRaw_lonc_iCalc autosar_swc_vmc_autosar_swc_vmc_Step_sys_LONC_lonc_vlcCalc_lonc_decelreqCalc_lonc_grp_commonMain_lonc_piFxvRaw_lonc_kiCalc autosar_swc_vmc_autosar_swc_vmc_Step_sys_LONC_lonc_vlcCalc_lonc_decelreqCalc_lonc_grp_commonMain_lonc_piFxvRaw_lonc_pController /end SUB_GROUP
/end GROUP
/begin GROUP autosar_swc_vmc_autosar_swc_vmc_Step_sys_LONC_lonc_vlcCalc_lonc_decelreqCalc_lonc_grp_commonMain_lonc_piFxvRaw_lonc_iCalc "autosar_swc_vmc/autosar_swc_vmc_Step_sys/LONC/lonc_vlcCalc/lonc_decelreqCalc/lonc_grp_commonMain/lonc_piFxvRaw/lonc_iCalc"
 /begin REF_CHARACTERISTIC P_LATC_StepTime P_LongCtrl_VLCAxTarDtThreEnableI P_LongCtrl_VLCIACompensionNeg P_LongCtrl_VLCIACompensionPos P_LongCtrl_VLCcoefIFadeOut1Calc P_LongCtrl_VLCcoefIFadeOut1Condition P_LongCtrl_VLCcoefIFadeOut2Calc P_LongCtrl_VLCcoefIFadeOut2Condition P_LongCtrl_VLCcoefIFadeOut3Calc P_LongCtrl_VLCcoefIFadeOut3Condition P_LongCtrl_VlcIControllerBigDeadzoneValueChartXAxis P_LongCtrl_VlcIControllerBigDeadzoneValueChartYAxis /end REF_CHARACTERISTIC
 /begin REF_MEASUREMENT LongCtrl_VLC_ICtrl_FxvRaw autosar_swc_vmc_rtARID_DEF.ECEnable autosar_swc_vmc_rtARID_DEF.UnitDelay_DSTATE_h /end REF_MEASUREMENT
/end GROUP
/begin GROUP autosar_swc_vmc_autosar_swc_vmc_Step_sys_LONC_lonc_vlcCalc_lonc_decelreqCalc_lonc_grp_commonMain_lonc_piFxvRaw_lonc_kiCalc "autosar_swc_vmc/autosar_swc_vmc_Step_sys/LONC/lonc_vlcCalc/lonc_decelreqCalc/lonc_grp_commonMain/lonc_piFxvRaw/lonc_kiCalc"
 /begin SUB_GROUP autosar_swc_vmc_autosar_swc_vmc_Step_sys_LONC_lonc_vlcCalc_lonc_decelreqCalc_lonc_grp_commonMain_lonc_piFxvRaw_lonc_kiCalc_LowPassFilter /end SUB_GROUP
 /begin REF_CHARACTERISTIC P_LongCtrl_IControllerSwFcnXAxis P_LongCtrl_IControllerSwFcnYAxis P_LongCtrl_VlcAxDiffDtKiCoefChartXAxis P_LongCtrl_VlcAxDiffDtKiCoefChartYAxis P_LongCtrl_VlcAxDiffKiCoefChartXAxis P_LongCtrl_VlcAxDiffKiCoefChartYAxis P_LongCtrl_VlcEngTrqki P_LongCtrl_VlcWheelTrqki /end REF_CHARACTERISTIC
 /begin REF_MEASUREMENT LongCtrl_VLC_ICtrl_Ki autosar_swc_vmc_rtARID_DEF.UnitDelay_DSTATE_gn /end REF_MEASUREMENT
/end GROUP
/begin GROUP autosar_swc_vmc_autosar_swc_vmc_Step_sys_LONC_lonc_vlcCalc_lonc_decelreqCalc_lonc_grp_commonMain_lonc_piFxvRaw_lonc_kiCalc_LowPassFilter "autosar_swc_vmc/autosar_swc_vmc_Step_sys/LONC/lonc_vlcCalc/lonc_decelreqCalc/lonc_grp_commonMain/lonc_piFxvRaw/lonc_kiCalc/LowPassFilter" /begin REF_CHARACTERISTIC P_LATC_StepTime /end REF_CHARACTERISTIC /begin REF_MEASUREMENT autosar_swc_vmc_rtARID_DEF.UnitDelay2_DSTATE_c /end REF_MEASUREMENT /end GROUP
/begin GROUP autosar_swc_vmc_autosar_swc_vmc_Step_sys_LONC_lonc_vlcCalc_lonc_decelreqCalc_lonc_grp_commonMain_lonc_piFxvRaw_lonc_pController "autosar_swc_vmc/autosar_swc_vmc_Step_sys/LONC/lonc_vlcCalc/lonc_decelreqCalc/lonc_grp_commonMain/lonc_piFxvRaw/lonc_pController"
 /begin REF_CHARACTERISTIC P_LongCtrl_VlcPControllerBigDeadzoneValueChartXAxis P_LongCtrl_VlcPControllerBigDeadzoneValueChartYAxis /end REF_CHARACTERISTIC
 /begin REF_MEASUREMENT LongCtrl_VLC_PCtrl_FxvRaw /end REF_MEASUREMENT
/end GROUP
/begin GROUP autosar_swc_vmc_autosar_swc_vmc_Step_sys_LONC_lonc_vlcCalc_lonc_decelreqCalc_lonc_grp_commonMain_lonc_switchToBrakeMode "autosar_swc_vmc/autosar_swc_vmc_Step_sys/LONC/lonc_vlcCalc/lonc_decelreqCalc/lonc_grp_commonMain/lonc_switchToBrakeMode"
 /begin SUB_GROUP autosar_swc_vmc_autosar_swc_vmc_Step_sys_LONC_lonc_vlcCalc_lonc_decelreqCalc_lonc_grp_commonMain_lonc_switchToBrakeMode_lonc_EngNotResponse autosar_swc_vmc_autosar_swc_vmc_Step_sys_LONC_lonc_vlcCalc_lonc_decelreqCalc_lonc_grp_commonMain_lonc_switchToBrakeMode_lonc_enableCondCalc autosar_swc_vmc_autosar_swc_vmc_Step_sys_LONC_lonc_vlcCalc_lonc_decelreqCalc_lonc_grp_commonMain_lonc_switchToBrakeMode_lonc_preCondSwDCCalc autosar_swc_vmc_autosar_swc_vmc_Step_sys_LONC_lonc_vlcCalc_lonc_decelreqCalc_lonc_grp_commonMain_lonc_switchToBrakeMode_lonc_switchToBrakeModeCalc /end SUB_GROUP
/end GROUP
/begin GROUP autosar_swc_vmc_autosar_swc_vmc_Step_sys_LONC_lonc_vlcCalc_lonc_decelreqCalc_lonc_grp_commonMain_lonc_switchToBrakeMode_lonc_EngNotResponse "autosar_swc_vmc/autosar_swc_vmc_Step_sys/LONC/lonc_vlcCalc/lonc_decelreqCalc/lonc_grp_commonMain/lonc_switchToBrakeMode/lonc_EngNotResponse"
 /begin SUB_GROUP autosar_swc_vmc_autosar_swc_vmc_Step_sys_LONC_lonc_vlcCalc_lonc_decelreqCalc_lonc_grp_commonMain_lonc_switchToBrakeMode_lonc_EngNotResponse_Compare_To_Constant3 /end SUB_GROUP
/end GROUP
/begin GROUP autosar_swc_vmc_autosar_swc_vmc_Step_sys_LONC_lonc_vlcCalc_lonc_decelreqCalc_lonc_grp_commonMain_lonc_switchToBrakeMode_lonc_EngNotResponse_Compare_To_Constant3 "autosar_swc_vmc/autosar_swc_vmc_Step_sys/LONC/lonc_vlcCalc/lonc_decelreqCalc/lonc_grp_commonMain/lonc_switchToBrakeMode/lonc_EngNotResponse/Compare\nTo Constant3" /begin REF_CHARACTERISTIC P_LongCtrl_VLCVlcAccThresAxvTracMinTimeout /end REF_CHARACTERISTIC /end GROUP
/begin GROUP autosar_swc_vmc_autosar_swc_vmc_Step_sys_LONC_lonc_vlcCalc_lonc_decelreqCalc_lonc_grp_commonMain_lonc_switchToBrakeMode_lonc_enableCondCalc "autosar_swc_vmc/autosar_swc_vmc_Step_sys/LONC/lonc_vlcCalc/lonc_decelreqCalc/lonc_grp_commonMain/lonc_switchToBrakeMode/lonc_enableCondCalc"
 /begin REF_CHARACTERISTIC P_LongCtrl_VLCaxCtrlDevEC2DCMax P_LongCtrl_VLCdaxTarEC2DCMax /end REF_CHARACTERISTIC
/end GROUP
/begin GROUP autosar_swc_vmc_autosar_swc_vmc_Step_sys_LONC_lonc_vlcCalc_lonc_decelreqCalc_lonc_grp_commonMain_lonc_switchToBrakeMode_lonc_preCondSwDCCalc "autosar_swc_vmc/autosar_swc_vmc_Step_sys/LONC/lonc_vlcCalc/lonc_decelreqCalc/lonc_grp_commonMain/lonc_switchToBrakeMode/lonc_preCondSwDCCalc"
 /begin SUB_GROUP autosar_swc_vmc_autosar_swc_vmc_Step_sys_LONC_lonc_vlcCalc_lonc_decelreqCalc_lonc_grp_commonMain_lonc_switchToBrakeMode_lonc_preCondSwDCCalc_LP_filter /end SUB_GROUP
 /begin REF_CHARACTERISTIC P_LongCtrl_VLCAxDC7Thrd P_LongCtrl_VLCAxvTracMinDevDC1ChartXAxis P_LongCtrl_VLCAxvTracMinDevDC1ChartYAxis P_LongCtrl_VLCDtAxvRef2UpperBandDC5 P_LongCtrl_VlcAxvRoadSlopeDC4ChartYAxis P_LongCtrl_VlcEC2DCSmoothCtrlDevThrdChartXAxis P_LongCtrl_VlcEC2DCSmoothCtrlDevThrdChartYAxis /end REF_CHARACTERISTIC
 /begin REF_MEASUREMENT autosar_swc_vmc_rtARID_DEF.UnitDelay1_DSTATE_e /end REF_MEASUREMENT
/end GROUP
/begin GROUP autosar_swc_vmc_autosar_swc_vmc_Step_sys_LONC_lonc_vlcCalc_lonc_decelreqCalc_lonc_grp_commonMain_lonc_switchToBrakeMode_lonc_preCondSwDCCalc_LP_filter "autosar_swc_vmc/autosar_swc_vmc_Step_sys/LONC/lonc_vlcCalc/lonc_decelreqCalc/lonc_grp_commonMain/lonc_switchToBrakeMode/lonc_preCondSwDCCalc/LP filter" /begin REF_CHARACTERISTIC P_LATC_StepTime /end REF_CHARACTERISTIC /begin REF_MEASUREMENT autosar_swc_vmc_rtARID_DEF.UnitDelay_DSTATE_j /end REF_MEASUREMENT /end GROUP
/begin GROUP autosar_swc_vmc_autosar_swc_vmc_Step_sys_LONC_lonc_vlcCalc_lonc_decelreqCalc_lonc_grp_commonMain_lonc_switchToBrakeMode_lonc_switchToBrakeModeCalc "autosar_swc_vmc/autosar_swc_vmc_Step_sys/LONC/lonc_vlcCalc/lonc_decelreqCalc/lonc_grp_commonMain/lonc_switchToBrakeMode/lonc_switchToBrakeModeCalc" /begin REF_MEASUREMENT autosar_swc_vmc_rtARID_DEF.y /end REF_MEASUREMENT /end GROUP
/begin GROUP autosar_swc_vmc_autosar_swc_vmc_Step_sys_LONC_lonc_vlcCalc_lonc_decelreqCalc_lonc_grp_commonMain_lonc_switchToDriveMode "autosar_swc_vmc/autosar_swc_vmc_Step_sys/LONC/lonc_vlcCalc/lonc_decelreqCalc/lonc_grp_commonMain/lonc_switchToDriveMode"
 /begin SUB_GROUP autosar_swc_vmc_autosar_swc_vmc_Step_sys_LONC_lonc_vlcCalc_lonc_decelreqCalc_lonc_grp_commonMain_lonc_switchToDriveMode_lonc_preCondSwECCalc autosar_swc_vmc_autosar_swc_vmc_Step_sys_LONC_lonc_vlcCalc_lonc_decelreqCalc_lonc_grp_commonMain_lonc_switchToDriveMode_lonc_switchToDriveModeCalc /end SUB_GROUP
/end GROUP
/begin GROUP autosar_swc_vmc_autosar_swc_vmc_Step_sys_LONC_lonc_vlcCalc_lonc_decelreqCalc_lonc_grp_commonMain_lonc_switchToDriveMode_lonc_preCondSwECCalc "autosar_swc_vmc/autosar_swc_vmc_Step_sys/LONC/lonc_vlcCalc/lonc_decelreqCalc/lonc_grp_commonMain/lonc_switchToDriveMode/lonc_preCondSwECCalc"
 /begin SUB_GROUP autosar_swc_vmc_autosar_swc_vmc_Step_sys_LONC_lonc_vlcCalc_lonc_decelreqCalc_lonc_grp_commonMain_lonc_switchToDriveMode_lonc_preCondSwECCalc_Compare_To_Constant5 /end SUB_GROUP
 /begin REF_CHARACTERISTIC P_LongCtrl_VLCaxCtrlDevFastQuitDCMode P_LongCtrl_VlcAxLowerBandDevThrdChartXAxis P_LongCtrl_VlcAxLowerBandDevThrdChartYAxis P_LongCtrl_VlcDC2ECSmoothCtrlDevThrdChartXAxis P_LongCtrl_VlcDC2ECSmoothCtrlDevThrdChartYAxis P_LongCtrl_VlcDriveOff2ECDownhillThrd /end REF_CHARACTERISTIC
/end GROUP
/begin GROUP autosar_swc_vmc_autosar_swc_vmc_Step_sys_LONC_lonc_vlcCalc_lonc_decelreqCalc_lonc_grp_commonMain_lonc_switchToDriveMode_lonc_preCondSwECCalc_Compare_To_Constant5 "autosar_swc_vmc/autosar_swc_vmc_Step_sys/LONC/lonc_vlcCalc/lonc_decelreqCalc/lonc_grp_commonMain/lonc_switchToDriveMode/lonc_preCondSwECCalc/Compare\nTo Constant5" /begin REF_MEASUREMENT autosar_swc_vmc_rtARID_DEF.Compare /end REF_MEASUREMENT /end GROUP
/begin GROUP autosar_swc_vmc_autosar_swc_vmc_Step_sys_LONC_lonc_vlcCalc_lonc_decelreqCalc_lonc_grp_commonMain_lonc_switchToDriveMode_lonc_switchToDriveModeCalc "autosar_swc_vmc/autosar_swc_vmc_Step_sys/LONC/lonc_vlcCalc/lonc_decelreqCalc/lonc_grp_commonMain/lonc_switchToDriveMode/lonc_switchToDriveModeCalc"
 /begin SUB_GROUP autosar_swc_vmc_autosar_swc_vmc_Step_sys_LONC_lonc_vlcCalc_lonc_decelreqCalc_lonc_grp_commonMain_lonc_switchToDriveMode_lonc_switchToDriveModeCalc_Compare_To_Constant1 /end SUB_GROUP
/end GROUP
/begin GROUP autosar_swc_vmc_autosar_swc_vmc_Step_sys_LONC_lonc_vlcCalc_lonc_decelreqCalc_lonc_grp_commonMain_lonc_switchToDriveMode_lonc_switchToDriveModeCalc_Compare_To_Constant1 "autosar_swc_vmc/autosar_swc_vmc_Step_sys/LONC/lonc_vlcCalc/lonc_decelreqCalc/lonc_grp_commonMain/lonc_switchToDriveMode/lonc_switchToDriveModeCalc/Compare\nTo Constant1" /begin REF_MEASUREMENT autosar_swc_vmc_rtARID_DEF.y /end REF_MEASUREMENT /end GROUP
/begin GROUP autosar_swc_vmc_autosar_swc_vmc_Step_sys_LONC_lonc_vlcCalc_lonc_decelreqCalc_lonc_grp_commonMain_lonc_switchToDrivenBrakeMode "autosar_swc_vmc/autosar_swc_vmc_Step_sys/LONC/lonc_vlcCalc/lonc_decelreqCalc/lonc_grp_commonMain/lonc_switchToDrivenBrakeMode"
 /begin SUB_GROUP autosar_swc_vmc_autosar_swc_vmc_Step_sys_LONC_lonc_vlcCalc_lonc_decelreqCalc_lonc_grp_commonMain_lonc_switchToDrivenBrakeMode_Compare_To_Constant autosar_swc_vmc_autosar_swc_vmc_Step_sys_LONC_lonc_vlcCalc_lonc_decelreqCalc_lonc_grp_commonMain_lonc_switchToDrivenBrakeMode_Compare_To_Constant1 /end SUB_GROUP
 /begin REF_CHARACTERISTIC P_LongCtrl_ECDCfslopScaling /end REF_CHARACTERISTIC
/end GROUP
/begin GROUP autosar_swc_vmc_autosar_swc_vmc_Step_sys_LONC_lonc_vlcCalc_lonc_decelreqCalc_lonc_grp_commonMain_lonc_switchToDrivenBrakeMode_Compare_To_Constant "autosar_swc_vmc/autosar_swc_vmc_Step_sys/LONC/lonc_vlcCalc/lonc_decelreqCalc/lonc_grp_commonMain/lonc_switchToDrivenBrakeMode/Compare\nTo Constant" /begin REF_CHARACTERISTIC P_LongCtrl_ECDCaxvRoadSlopThres /end REF_CHARACTERISTIC /end GROUP
/begin GROUP autosar_swc_vmc_autosar_swc_vmc_Step_sys_LONC_lonc_vlcCalc_lonc_decelreqCalc_lonc_grp_commonMain_lonc_switchToDrivenBrakeMode_Compare_To_Constant1 "autosar_swc_vmc/autosar_swc_vmc_Step_sys/LONC/lonc_vlcCalc/lonc_decelreqCalc/lonc_grp_commonMain/lonc_switchToDrivenBrakeMode/Compare\nTo Constant1" /begin REF_CHARACTERISTIC P_LongCtrl_ECDCvxvRefThres /end REF_CHARACTERISTIC /end GROUP
/begin GROUP autosar_swc_vmc_autosar_swc_vmc_Step_sys_LONC_lonc_vlcCalc_lonc_decelreqCalc_lonc_grp_commonMain_lonc_vlcInternalAccCalc "autosar_swc_vmc/autosar_swc_vmc_Step_sys/LONC/lonc_vlcCalc/lonc_decelreqCalc/lonc_grp_commonMain/lonc_vlcInternalAccCalc"
 /begin SUB_GROUP autosar_swc_vmc_autosar_swc_vmc_Step_sys_LONC_lonc_vlcCalc_lonc_decelreqCalc_lonc_grp_commonMain_lonc_vlcInternalAccCalc_LowPassFilter /end SUB_GROUP
 /begin REF_CHARACTERISTIC P_LongCtrl_VLCTaraccelOverrideSwitch P_LongCtrl_VLCdriveOffAxUpLimXAxix P_LongCtrl_VLCdriveOffAxUpLimYAxix /end REF_CHARACTERISTIC
 /begin REF_MEASUREMENT autosar_swc_vmc_rtARID_DEF.Compare autosar_swc_vmc_rtARID_DEF.TappedDelay4_X autosar_swc_vmc_rtARID_DEF.TappedDelay5_X autosar_swc_vmc_rtARID_DEF.UnitDelay1_DSTATE_c autosar_swc_vmc_rtARID_DEF.UnitDelay2_DSTATE_b autosar_swc_vmc_rtARID_DEF.y /end REF_MEASUREMENT
/end GROUP
/begin GROUP autosar_swc_vmc_autosar_swc_vmc_Step_sys_LONC_lonc_vlcCalc_lonc_decelreqCalc_lonc_grp_commonMain_lonc_vlcInternalAccCalc_LowPassFilter "autosar_swc_vmc/autosar_swc_vmc_Step_sys/LONC/lonc_vlcCalc/lonc_decelreqCalc/lonc_grp_commonMain/lonc_vlcInternalAccCalc/LowPassFilter" /begin REF_CHARACTERISTIC P_LATC_StepTime /end REF_CHARACTERISTIC /begin REF_MEASUREMENT autosar_swc_vmc_rtARID_DEF.UnitDelay_DSTATE_d /end REF_MEASUREMENT /end GROUP
/begin GROUP autosar_swc_vmc_autosar_swc_vmc_Step_sys_LONC_lonc_vlcCalc_lonc_decelreqCalc_lonc_grp_commonMain_lonc_vlcStatusMechine "autosar_swc_vmc/autosar_swc_vmc_Step_sys/LONC/lonc_vlcCalc/lonc_decelreqCalc/lonc_grp_commonMain/lonc_vlcStatusMechine" /begin REF_CHARACTERISTIC P_LongCtrl_VLC_DCECSwitch /end REF_CHARACTERISTIC
 /begin REF_MEASUREMENT autosar_swc_vmc_rtARID_DEF.Compare autosar_swc_vmc_rtARID_DEF.DCEnable autosar_swc_vmc_rtARID_DEF.ECEnable autosar_swc_vmc_rtARID_DEF.VLCSts autosar_swc_vmc_rtARID_DEF.is_Active autosar_swc_vmc_rtARID_DEF.is_c19_autosar_swc_vmc autosar_swc_vmc_rtARID_DEF.tDC autosar_swc_vmc_rtARID_DEF.tEC autosar_swc_vmc_rtARID_DEF.y /end REF_MEASUREMENT
/end GROUP
/begin GROUP autosar_swc_vmc_autosar_swc_vmc_Step_sys_LONC_lonc_vlcCalc_lonc_engTrqInput "autosar_swc_vmc/autosar_swc_vmc_Step_sys/LONC/lonc_vlcCalc/lonc_engTrqInput"
 /begin SUB_GROUP autosar_swc_vmc_autosar_swc_vmc_Step_sys_LONC_lonc_vlcCalc_lonc_engTrqInput_lonc_engNotResponseEng autosar_swc_vmc_autosar_swc_vmc_Step_sys_LONC_lonc_vlcCalc_lonc_engTrqInput_lonc_fdriveEng autosar_swc_vmc_autosar_swc_vmc_Step_sys_LONC_lonc_vlcCalc_lonc_engTrqInput_lonc_fdriveNegEng autosar_swc_vmc_autosar_swc_vmc_Step_sys_LONC_lonc_vlcCalc_lonc_engTrqInput_lonc_idleTrqCompensationEng autosar_swc_vmc_autosar_swc_vmc_Step_sys_LONC_lonc_vlcCalc_lonc_engTrqInput_lonc_maRatioEng /end SUB_GROUP
/end GROUP
/begin GROUP autosar_swc_vmc_autosar_swc_vmc_Step_sys_LONC_lonc_vlcCalc_lonc_engTrqInput_lonc_engNotResponseEng "autosar_swc_vmc/autosar_swc_vmc_Step_sys/LONC/lonc_vlcCalc/lonc_engTrqInput/lonc_engNotResponseEng"
 /begin SUB_GROUP autosar_swc_vmc_autosar_swc_vmc_Step_sys_LONC_lonc_vlcCalc_lonc_engTrqInput_lonc_engNotResponseEng_Compare_To_Constant autosar_swc_vmc_autosar_swc_vmc_Step_sys_LONC_lonc_vlcCalc_lonc_engTrqInput_lonc_engNotResponseEng_Compare_To_Constant2 /end SUB_GROUP
 /begin REF_MEASUREMENT autosar_swc_vmc_rtARID_DEF.UnitDelay_DSTATE_g /end REF_MEASUREMENT
/end GROUP
/begin GROUP autosar_swc_vmc_autosar_swc_vmc_Step_sys_LONC_lonc_vlcCalc_lonc_engTrqInput_lonc_engNotResponseEng_Compare_To_Constant "autosar_swc_vmc/autosar_swc_vmc_Step_sys/LONC/lonc_vlcCalc/lonc_engTrqInput/lonc_engNotResponseEng/Compare\nTo Constant" /begin REF_CHARACTERISTIC P_LongCtrl_VLCTorqDiffThreAxvTracMinTimeout /end REF_CHARACTERISTIC /end GROUP
/begin GROUP autosar_swc_vmc_autosar_swc_vmc_Step_sys_LONC_lonc_vlcCalc_lonc_engTrqInput_lonc_engNotResponseEng_Compare_To_Constant2 "autosar_swc_vmc/autosar_swc_vmc_Step_sys/LONC/lonc_vlcCalc/lonc_engTrqInput/lonc_engNotResponseEng/Compare\nTo Constant2" /begin REF_CHARACTERISTIC P_LongCtrl_VLCCounterAxvTracMinTimeout /end REF_CHARACTERISTIC /end GROUP
/begin GROUP autosar_swc_vmc_autosar_swc_vmc_Step_sys_LONC_lonc_vlcCalc_lonc_engTrqInput_lonc_fdriveEng "autosar_swc_vmc/autosar_swc_vmc_Step_sys/LONC/lonc_vlcCalc/lonc_engTrqInput/lonc_fdriveEng"
 /begin SUB_GROUP autosar_swc_vmc_autosar_swc_vmc_Step_sys_LONC_lonc_vlcCalc_lonc_engTrqInput_lonc_fdriveEng_LowPassFilter1 /end SUB_GROUP
 /begin REF_CHARACTERISTIC P_LongCtrl_EfficiencyChartXAxis P_LongCtrl_EfficiencyChartYAxis /end REF_CHARACTERISTIC
/end GROUP
/begin GROUP autosar_swc_vmc_autosar_swc_vmc_Step_sys_LONC_lonc_vlcCalc_lonc_engTrqInput_lonc_fdriveEng_LowPassFilter1 "autosar_swc_vmc/autosar_swc_vmc_Step_sys/LONC/lonc_vlcCalc/lonc_engTrqInput/lonc_fdriveEng/LowPassFilter1" /begin REF_CHARACTERISTIC P_LATC_StepTime /end REF_CHARACTERISTIC /begin REF_MEASUREMENT autosar_swc_vmc_rtARID_DEF.UnitDelay_DSTATE_m /end REF_MEASUREMENT /end GROUP
/begin GROUP autosar_swc_vmc_autosar_swc_vmc_Step_sys_LONC_lonc_vlcCalc_lonc_engTrqInput_lonc_fdriveNegEng "autosar_swc_vmc/autosar_swc_vmc_Step_sys/LONC/lonc_vlcCalc/lonc_engTrqInput/lonc_fdriveNegEng"
 /begin REF_CHARACTERISTIC P_LongCtrl_EfficiencyChartXAxis P_LongCtrl_EfficiencyChartYAxis P_LongCtrl_UsedMinEngTrqChartXAxis P_LongCtrl_UsedMinEngTrqChartYAxis /end REF_CHARACTERISTIC
/end GROUP
/begin GROUP autosar_swc_vmc_autosar_swc_vmc_Step_sys_LONC_lonc_vlcCalc_lonc_engTrqInput_lonc_idleTrqCompensationEng "autosar_swc_vmc/autosar_swc_vmc_Step_sys/LONC/lonc_vlcCalc/lonc_engTrqInput/lonc_idleTrqCompensationEng"
 /begin SUB_GROUP autosar_swc_vmc_autosar_swc_vmc_Step_sys_LONC_lonc_vlcCalc_lonc_engTrqInput_lonc_idleTrqCompensationEng_Compare_To_Constant /end SUB_GROUP
 /begin REF_CHARACTERISTIC P_LongCtrl_EngIdleForce P_LongCtrl_EngIdleForceSwFcnXAxis P_LongCtrl_EngIdleForceSwFcnYAxis /end REF_CHARACTERISTIC
/end GROUP
/begin GROUP autosar_swc_vmc_autosar_swc_vmc_Step_sys_LONC_lonc_vlcCalc_lonc_engTrqInput_lonc_idleTrqCompensationEng_Compare_To_Constant "autosar_swc_vmc/autosar_swc_vmc_Step_sys/LONC/lonc_vlcCalc/lonc_engTrqInput/lonc_idleTrqCompensationEng/Compare\nTo Constant" /begin REF_MEASUREMENT autosar_swc_vmc_rtARID_DEF.y /end REF_MEASUREMENT /end GROUP
/begin GROUP autosar_swc_vmc_autosar_swc_vmc_Step_sys_LONC_lonc_vlcCalc_lonc_engTrqInput_lonc_maRatioEng "autosar_swc_vmc/autosar_swc_vmc_Step_sys/LONC/lonc_vlcCalc/lonc_engTrqInput/lonc_maRatioEng" /begin REF_CHARACTERISTIC P_LongCtrl_MaRatioChartXAxis P_LongCtrl_MaRatioChartYAxis /end REF_CHARACTERISTIC /end GROUP
/begin GROUP autosar_swc_vmc_autosar_swc_vmc_Step_sys_LONC_lonc_vlcCalc_lonc_grp_engTrq "autosar_swc_vmc/autosar_swc_vmc_Step_sys/LONC/lonc_vlcCalc/lonc_grp_engTrq"
 /begin SUB_GROUP autosar_swc_vmc_autosar_swc_vmc_Step_sys_LONC_lonc_vlcCalc_lonc_grp_engTrq_lonc_ecEngTrq autosar_swc_vmc_autosar_swc_vmc_Step_sys_LONC_lonc_vlcCalc_lonc_grp_engTrq_lonc_esc autosar_swc_vmc_autosar_swc_vmc_Step_sys_LONC_lonc_vlcCalc_lonc_grp_engTrq_lonc_ffEngTrqInc autosar_swc_vmc_autosar_swc_vmc_Step_sys_LONC_lonc_vlcCalc_lonc_grp_engTrq_lonc_piEngTrq /end SUB_GROUP
 /begin REF_MEASUREMENT autosar_swc_vmc_rtARID_DEF.UnitDelay2_DSTATE_e /end REF_MEASUREMENT
/end GROUP
/begin GROUP autosar_swc_vmc_autosar_swc_vmc_Step_sys_LONC_lonc_vlcCalc_lonc_grp_engTrq_lonc_ecEngTrq "autosar_swc_vmc/autosar_swc_vmc_Step_sys/LONC/lonc_vlcCalc/lonc_grp_engTrq/lonc_ecEngTrq"
 /begin SUB_GROUP autosar_swc_vmc_autosar_swc_vmc_Step_sys_LONC_lonc_vlcCalc_lonc_grp_engTrq_lonc_ecEngTrq_lonc_engTrqBandValueCalc autosar_swc_vmc_autosar_swc_vmc_Step_sys_LONC_lonc_vlcCalc_lonc_grp_engTrq_lonc_ecEngTrq_lonc_engTrqReqCalc autosar_swc_vmc_autosar_swc_vmc_Step_sys_LONC_lonc_vlcCalc_lonc_grp_engTrq_lonc_ecEngTrq_lonc_engTrqReqK1Calc /end SUB_GROUP
/end GROUP
/begin GROUP autosar_swc_vmc_autosar_swc_vmc_Step_sys_LONC_lonc_vlcCalc_lonc_grp_engTrq_lonc_ecEngTrq_lonc_engTrqBandValueCalc "autosar_swc_vmc/autosar_swc_vmc_Step_sys/LONC/lonc_vlcCalc/lonc_grp_engTrq/lonc_ecEngTrq/lonc_engTrqBandValueCalc"
 /begin REF_CHARACTERISTIC P_LATC_StepTime P_LongCtrl_VLCCounterDC2ECTorqDelay P_LongCtrl_VLCCounterDrvOff2EC /end REF_CHARACTERISTIC
 /begin REF_MEASUREMENT autosar_swc_vmc_rtARID_DEF.Compare autosar_swc_vmc_rtARID_DEF.DCEnable autosar_swc_vmc_rtARID_DEF.ECEnable autosar_swc_vmc_rtARID_DEF.TappedDelay1_X autosar_swc_vmc_rtARID_DEF.TappedDelay4_X_i autosar_swc_vmc_rtARID_DEF.UnitDelay1_DSTATE_p2 autosar_swc_vmc_rtARID_DEF.UnitDelay2_DSTATE_n3 autosar_swc_vmc_rtARID_DEF.UnitDelay_DSTATE_a autosar_swc_vmc_rtARID_DEF.tEC /end REF_MEASUREMENT
/end GROUP
/begin GROUP autosar_swc_vmc_autosar_swc_vmc_Step_sys_LONC_lonc_vlcCalc_lonc_grp_engTrq_lonc_ecEngTrq_lonc_engTrqReqCalc "autosar_swc_vmc/autosar_swc_vmc_Step_sys/LONC/lonc_vlcCalc/lonc_grp_engTrq/lonc_ecEngTrq/lonc_engTrqReqCalc"
 /begin SUB_GROUP autosar_swc_vmc_autosar_swc_vmc_Step_sys_LONC_lonc_vlcCalc_lonc_grp_engTrq_lonc_ecEngTrq_lonc_engTrqReqCalc_LowPassFilter1 /end SUB_GROUP
 /begin REF_MEASUREMENT autosar_swc_vmc_rtARID_DEF.ECEnable autosar_swc_vmc_rtARID_DEF.UnitDelay_DSTATE_l /end REF_MEASUREMENT
/end GROUP
/begin GROUP autosar_swc_vmc_autosar_swc_vmc_Step_sys_LONC_lonc_vlcCalc_lonc_grp_engTrq_lonc_ecEngTrq_lonc_engTrqReqCalc_LowPassFilter1 "autosar_swc_vmc/autosar_swc_vmc_Step_sys/LONC/lonc_vlcCalc/lonc_grp_engTrq/lonc_ecEngTrq/lonc_engTrqReqCalc/LowPassFilter1" /begin REF_CHARACTERISTIC P_LATC_StepTime /end REF_CHARACTERISTIC /begin REF_MEASUREMENT autosar_swc_vmc_rtARID_DEF.UnitDelay_DSTATE_f /end REF_MEASUREMENT /end GROUP
/begin GROUP autosar_swc_vmc_autosar_swc_vmc_Step_sys_LONC_lonc_vlcCalc_lonc_grp_engTrq_lonc_ecEngTrq_lonc_engTrqReqK1Calc "autosar_swc_vmc/autosar_swc_vmc_Step_sys/LONC/lonc_vlcCalc/lonc_grp_engTrq/lonc_ecEngTrq/lonc_engTrqReqK1Calc"
 /begin REF_MEASUREMENT autosar_swc_vmc_rtARID_DEF.ECEnable autosar_swc_vmc_rtARID_DEF.UnitDelay_DSTATE_f3 /end REF_MEASUREMENT
/end GROUP
/begin GROUP autosar_swc_vmc_autosar_swc_vmc_Step_sys_LONC_lonc_vlcCalc_lonc_grp_engTrq_lonc_esc "autosar_swc_vmc/autosar_swc_vmc_Step_sys/LONC/lonc_vlcCalc/lonc_grp_engTrq/lonc_esc"
 /begin REF_CHARACTERISTIC P_LongCtrl_VLCaccelIsAccelerating P_LongCtrl_VLCjerkTorqUp P_LongCtrl_VLCtEngSpdControlMax /end REF_CHARACTERISTIC
 /begin REF_MEASUREMENT autosar_swc_vmc_rtARID_DEF.EngSpdControl autosar_swc_vmc_rtARID_DEF.EngSpdControlK1 autosar_swc_vmc_rtARID_DEF.EngTorqReqMax autosar_swc_vmc_rtARID_DEF.LONC_EngTrqReqValueK1 autosar_swc_vmc_rtARID_DEF.tEngSpdControl /end REF_MEASUREMENT
/end GROUP
/begin GROUP autosar_swc_vmc_autosar_swc_vmc_Step_sys_LONC_lonc_vlcCalc_lonc_grp_engTrq_lonc_ffEngTrqInc "autosar_swc_vmc/autosar_swc_vmc_Step_sys/LONC/lonc_vlcCalc/lonc_grp_engTrq/lonc_ffEngTrqInc"
 /begin REF_CHARACTERISTIC P_LongCtrl_EngTrqConsiderEfficiencyChartXAxis P_LongCtrl_EngTrqConsiderEfficiencyChartYAxis P_LongCtrl_VlcEngTrqIncKs P_LongCtrl_VlcEngTrqMaxKs /end REF_CHARACTERISTIC
 /begin REF_MEASUREMENT LongCtrl_VLC_FF_FxvReqRaw autosar_swc_vmc_rtARID_DEF.UnitDelay1_DSTATE_o autosar_swc_vmc_rtARID_DEF.UnitDelay2_DSTATE_j /end REF_MEASUREMENT
/end GROUP
/begin GROUP autosar_swc_vmc_autosar_swc_vmc_Step_sys_LONC_lonc_vlcCalc_lonc_grp_engTrq_lonc_piEngTrq "autosar_swc_vmc/autosar_swc_vmc_Step_sys/LONC/lonc_vlcCalc/lonc_grp_engTrq/lonc_piEngTrq" /begin REF_CHARACTERISTIC P_LongCtrl_VlcEngTrqkp /end REF_CHARACTERISTIC
 /begin REF_MEASUREMENT LongCtrl_VLC_ICtrl_FxvRaw LongCtrl_VLC_ICtrl_Ki LongCtrl_VLC_PCtrl_FxvRaw /end REF_MEASUREMENT
/end GROUP
/begin GROUP autosar_swc_vmc_autosar_swc_vmc_Step_sys_LONC_lonc_vlcCalc_lonc_grp_wheelTrq "autosar_swc_vmc/autosar_swc_vmc_Step_sys/LONC/lonc_vlcCalc/lonc_grp_wheelTrq"
 /begin SUB_GROUP autosar_swc_vmc_autosar_swc_vmc_Step_sys_LONC_lonc_vlcCalc_lonc_grp_wheelTrq_lonc_ecWheelTrq autosar_swc_vmc_autosar_swc_vmc_Step_sys_LONC_lonc_vlcCalc_lonc_grp_wheelTrq_lonc_ffWheelTrqInc autosar_swc_vmc_autosar_swc_vmc_Step_sys_LONC_lonc_vlcCalc_lonc_grp_wheelTrq_lonc_piWheelTrq /end SUB_GROUP
 /begin REF_MEASUREMENT autosar_swc_vmc_rtARID_DEF.UnitDelay1_DSTATE_d /end REF_MEASUREMENT
/end GROUP
/begin GROUP autosar_swc_vmc_autosar_swc_vmc_Step_sys_LONC_lonc_vlcCalc_lonc_grp_wheelTrq_lonc_ecWheelTrq "autosar_swc_vmc/autosar_swc_vmc_Step_sys/LONC/lonc_vlcCalc/lonc_grp_wheelTrq/lonc_ecWheelTrq"
 /begin SUB_GROUP autosar_swc_vmc_autosar_swc_vmc_Step_sys_LONC_lonc_vlcCalc_lonc_grp_wheelTrq_lonc_ecWheelTrq_lonc_trqBandValueCalc autosar_swc_vmc_autosar_swc_vmc_Step_sys_LONC_lonc_vlcCalc_lonc_grp_wheelTrq_lonc_ecWheelTrq_lonc_trqReqCalc autosar_swc_vmc_autosar_swc_vmc_Step_sys_LONC_lonc_vlcCalc_lonc_grp_wheelTrq_lonc_ecWheelTrq_lonc_wheelTrqReqK1Calc /end SUB_GROUP
/end GROUP
/begin GROUP autosar_swc_vmc_autosar_swc_vmc_Step_sys_LONC_lonc_vlcCalc_lonc_grp_wheelTrq_lonc_ecWheelTrq_lonc_trqBandValueCalc "autosar_swc_vmc/autosar_swc_vmc_Step_sys/LONC/lonc_vlcCalc/lonc_grp_wheelTrq/lonc_ecWheelTrq/lonc_trqBandValueCalc"
 /begin REF_CHARACTERISTIC P_LATC_StepTime P_LongCtrl_VLCCounterDC2ECTorqDelay P_LongCtrl_VLCCounterDrvOff2EC /end REF_CHARACTERISTIC
 /begin REF_MEASUREMENT LongCtrl_VLC_WheelTrqReqMax LongCtrl_VLC_WheelTrqReqMin autosar_swc_vmc_rtARID_DEF.Compare autosar_swc_vmc_rtARID_DEF.DCEnable autosar_swc_vmc_rtARID_DEF.ECEnable autosar_swc_vmc_rtARID_DEF.TappedDelay1_X_i autosar_swc_vmc_rtARID_DEF.TappedDelay4_X_b autosar_swc_vmc_rtARID_DEF.UnitDelay1_DSTATE_b autosar_swc_vmc_rtARID_DEF.UnitDelay2_DSTATE_p autosar_swc_vmc_rtARID_DEF.UnitDelay_DSTATE_pp autosar_swc_vmc_rtARID_DEF.tEC /end REF_MEASUREMENT
/end GROUP
/begin GROUP autosar_swc_vmc_autosar_swc_vmc_Step_sys_LONC_lonc_vlcCalc_lonc_grp_wheelTrq_lonc_ecWheelTrq_lonc_trqReqCalc "autosar_swc_vmc/autosar_swc_vmc_Step_sys/LONC/lonc_vlcCalc/lonc_grp_wheelTrq/lonc_ecWheelTrq/lonc_trqReqCalc"
 /begin SUB_GROUP autosar_swc_vmc_autosar_swc_vmc_Step_sys_LONC_lonc_vlcCalc_lonc_grp_wheelTrq_lonc_ecWheelTrq_lonc_trqReqCalc_LowPassFilter /end SUB_GROUP
 /begin REF_CHARACTERISTIC P_LongCtrl_PI_vxvRefMs P_LongCtrl_PI_vxvRefMs_Factor /end REF_CHARACTERISTIC
 /begin REF_MEASUREMENT LongCtrl_VLC_FF_WheelTrqInc LongCtrl_VLC_PI_WheelTrqReq LongCtrl_VLC_WheelTrqReqMax LongCtrl_VLC_WheelTrqReqMin LongCtrl_VLC_WheelTrqReqRaw autosar_swc_vmc_rtARID_DEF.ECEnable autosar_swc_vmc_rtARID_DEF.UnitDelay_DSTATE_p /end REF_MEASUREMENT
/end GROUP
/begin GROUP autosar_swc_vmc_autosar_swc_vmc_Step_sys_LONC_lonc_vlcCalc_lonc_grp_wheelTrq_lonc_ecWheelTrq_lonc_trqReqCalc_LowPassFilter "autosar_swc_vmc/autosar_swc_vmc_Step_sys/LONC/lonc_vlcCalc/lonc_grp_wheelTrq/lonc_ecWheelTrq/lonc_trqReqCalc/LowPassFilter" /begin REF_CHARACTERISTIC P_LATC_StepTime /end REF_CHARACTERISTIC /begin REF_MEASUREMENT LongCtrl_VLC_WheelTrqReqRaw /end REF_MEASUREMENT /end GROUP
/begin GROUP autosar_swc_vmc_autosar_swc_vmc_Step_sys_LONC_lonc_vlcCalc_lonc_grp_wheelTrq_lonc_ecWheelTrq_lonc_wheelTrqReqK1Calc "autosar_swc_vmc/autosar_swc_vmc_Step_sys/LONC/lonc_vlcCalc/lonc_grp_wheelTrq/lonc_ecWheelTrq/lonc_wheelTrqReqK1Calc"
 /begin REF_MEASUREMENT autosar_swc_vmc_rtARID_DEF.ECEnable autosar_swc_vmc_rtARID_DEF.UnitDelay_DSTATE_ii /end REF_MEASUREMENT
/end GROUP
/begin GROUP autosar_swc_vmc_autosar_swc_vmc_Step_sys_LONC_lonc_vlcCalc_lonc_grp_wheelTrq_lonc_ffWheelTrqInc "autosar_swc_vmc/autosar_swc_vmc_Step_sys/LONC/lonc_vlcCalc/lonc_grp_wheelTrq/lonc_ffWheelTrqInc"
 /begin REF_CHARACTERISTIC P_LongCtrl_FF_Spd P_LongCtrl_FF_Spd_Factor P_LongCtrl_VlcWheelTrqIncKs P_LongCtrl_VlcWheelTrqMaxKs /end REF_CHARACTERISTIC
 /begin REF_MEASUREMENT LongCtrl_VLC_FF_FxvReqRaw LongCtrl_VLC_FF_WheelTrqInc autosar_swc_vmc_rtARID_DEF.UnitDelay1_DSTATE_g autosar_swc_vmc_rtARID_DEF.UnitDelay2_DSTATE_n /end REF_MEASUREMENT
/end GROUP
/begin GROUP autosar_swc_vmc_autosar_swc_vmc_Step_sys_LONC_lonc_vlcCalc_lonc_grp_wheelTrq_lonc_piWheelTrq "autosar_swc_vmc/autosar_swc_vmc_Step_sys/LONC/lonc_vlcCalc/lonc_grp_wheelTrq/lonc_piWheelTrq" /begin REF_CHARACTERISTIC P_LongCtrl_VlcWheelTrqkp /end REF_CHARACTERISTIC
 /begin REF_MEASUREMENT LongCtrl_VLC_ICtrl_FxvRaw LongCtrl_VLC_ICtrl_Ki LongCtrl_VLC_PCtrl_FxvRaw LongCtrl_VLC_PI_WheelTrqReq /end REF_MEASUREMENT
/end GROUP
/begin GROUP autosar_swc_vmc_autosar_swc_vmc_Step_sys_LONC_lonc_vlcCalc_lonc_wheelTrqInput "autosar_swc_vmc/autosar_swc_vmc_Step_sys/LONC/lonc_vlcCalc/lonc_wheelTrqInput"
 /begin SUB_GROUP autosar_swc_vmc_autosar_swc_vmc_Step_sys_LONC_lonc_vlcCalc_lonc_wheelTrqInput_lonc_fdriveNegWheel autosar_swc_vmc_autosar_swc_vmc_Step_sys_LONC_lonc_vlcCalc_lonc_wheelTrqInput_lonc_fdriveWheel /end SUB_GROUP
 /begin REF_CHARACTERISTIC P_LongCtrl_Ma_Ratio /end REF_CHARACTERISTIC
/end GROUP
/begin GROUP autosar_swc_vmc_autosar_swc_vmc_Step_sys_LONC_lonc_vlcCalc_lonc_wheelTrqInput_lonc_fdriveNegWheel "autosar_swc_vmc/autosar_swc_vmc_Step_sys/LONC/lonc_vlcCalc/lonc_wheelTrqInput/lonc_fdriveNegWheel" /begin REF_CHARACTERISTIC P_LongCtrl_CoefNegTorqUse /end REF_CHARACTERISTIC /end GROUP
/begin GROUP autosar_swc_vmc_autosar_swc_vmc_Step_sys_LONC_lonc_vlcCalc_lonc_wheelTrqInput_lonc_fdriveWheel "autosar_swc_vmc/autosar_swc_vmc_Step_sys/LONC/lonc_vlcCalc/lonc_wheelTrqInput/lonc_fdriveWheel"
 /begin SUB_GROUP autosar_swc_vmc_autosar_swc_vmc_Step_sys_LONC_lonc_vlcCalc_lonc_wheelTrqInput_lonc_fdriveWheel_LowPassFilter /end SUB_GROUP
/end GROUP
/begin GROUP autosar_swc_vmc_autosar_swc_vmc_Step_sys_LONC_lonc_vlcCalc_lonc_wheelTrqInput_lonc_fdriveWheel_LowPassFilter "autosar_swc_vmc/autosar_swc_vmc_Step_sys/LONC/lonc_vlcCalc/lonc_wheelTrqInput/lonc_fdriveWheel/LowPassFilter" /begin REF_CHARACTERISTIC P_LATC_StepTime /end REF_CHARACTERISTIC /begin REF_MEASUREMENT autosar_swc_vmc_rtARID_DEF.UnitDelay_DSTATE_ou /end REF_MEASUREMENT /end GROUP
/begin GROUP autosar_swc_vmc_rtARID_DEF.TmpSignalConversionAtVAL_VEHICLE_STATEOutport1 ""
 /begin REF_MEASUREMENT autosar_swc_vmc_rtARID_DEF.TmpSignalConversionAtVAL_VEHICLE_STATEOutport1.VehStandstill autosar_swc_vmc_rtARID_DEF.TmpSignalConversionAtVAL_VEHICLE_STATEOutport1.EngineOn autosar_swc_vmc_rtARID_DEF.TmpSignalConversionAtVAL_VEHICLE_STATEOutport1.FAShiftInProgress autosar_swc_vmc_rtARID_DEF.TmpSignalConversionAtVAL_VEHICLE_STATEOutport1.RAShiftInProgress autosar_swc_vmc_rtARID_DEF.TmpSignalConversionAtVAL_VEHICLE_STATEOutport1.NoBrakeForce autosar_swc_vmc_rtARID_DEF.TmpSignalConversionAtVAL_VEHICLE_STATEOutport1.VLC_InternalTargetAccelerationValid autosar_swc_vmc_rtARID_DEF.TmpSignalConversionAtVAL_VEHICLE_STATEOutport1.BlindTemp autosar_swc_vmc_rtARID_DEF.TmpSignalConversionAtVAL_VEHICLE_STATEOutport1.WheelPulseCounterValid autosar_swc_vmc_rtARID_DEF.TmpSignalConversionAtVAL_VEHICLE_STATEOutport1.CurrentGear autosar_swc_vmc_rtARID_DEF.TmpSignalConversionAtVAL_VEHICLE_STATEOutport1.TargetGear autosar_swc_vmc_rtARID_DEF.TmpSignalConversionAtVAL_VEHICLE_STATEOutport1.GearSts autosar_swc_vmc_rtARID_DEF.TmpSignalConversionAtVAL_VEHICLE_STATEOutport1.SysPowerMod autosar_swc_vmc_rtARID_DEF.TmpSignalConversionAtVAL_VEHICLE_STATEOutport1.IPVehSpdUnit autosar_swc_vmc_rtARID_DEF.TmpSignalConversionAtVAL_VEHICLE_STATEOutport1.IPVehSpdDispKph autosar_swc_vmc_rtARID_DEF.TmpSignalConversionAtVAL_VEHICLE_STATEOutport1.IPVehSpdDispMph autosar_swc_vmc_rtARID_DEF.TmpSignalConversionAtVAL_VEHICLE_STATEOutport1.FourWhlsBrkTrq autosar_swc_vmc_rtARID_DEF.TmpSignalConversionAtVAL_VEHICLE_STATEOutport1.MaxEngTrqNorm autosar_swc_vmc_rtARID_DEF.TmpSignalConversionAtVAL_VEHICLE_STATEOutport1.VehSpdKph autosar_swc_vmc_rtARID_DEF.TmpSignalConversionAtVAL_VEHICLE_STATEOutport1.IPVehSpdDispKphFloat autosar_swc_vmc_rtARID_DEF.TmpSignalConversionAtVAL_VEHICLE_STATEOutport1.SteerWheelAngle autosar_swc_vmc_rtARID_DEF.TmpSignalConversionAtVAL_VEHICLE_STATEOutport1.SteerWheelSpd autosar_swc_vmc_rtARID_DEF.TmpSignalConversionAtVAL_VEHICLE_STATEOutport1.SteerWheelTor autosar_swc_vmc_rtARID_DEF.TmpSignalConversionAtVAL_VEHICLE_STATEOutport1.MasterCylBrkPress autosar_swc_vmc_rtARID_DEF.TmpSignalConversionAtVAL_VEHICLE_STATEOutport1.WheelTrqNm autosar_swc_vmc_rtARID_DEF.TmpSignalConversionAtVAL_VEHICLE_STATEOutport1.WheelTrqMinNm autosar_swc_vmc_rtARID_DEF.TmpSignalConversionAtVAL_VEHICLE_STATEOutport1.VCUTrqNm autosar_swc_vmc_rtARID_DEF.TmpSignalConversionAtVAL_VEHICLE_STATEOutport1.EngTrqNm autosar_swc_vmc_rtARID_DEF.TmpSignalConversionAtVAL_VEHICLE_STATEOutport1.EngTrqMinNm autosar_swc_vmc_rtARID_DEF.TmpSignalConversionAtVAL_VEHICLE_STATEOutport1.LKACtrDlvdValue autosar_swc_vmc_rtARID_DEF.TmpSignalConversionAtVAL_VEHICLE_STATEOutport1.NetEngTrq autosar_swc_vmc_rtARID_DEF.TmpSignalConversionAtVAL_VEHICLE_STATEOutport1.EngTrqMinAct autosar_swc_vmc_rtARID_DEF.TmpSignalConversionAtVAL_VEHICLE_STATEOutport1.EngSpd autosar_swc_vmc_rtARID_DEF.TmpSignalConversionAtVAL_VEHICLE_STATEOutport1.FLWheelSpdMps autosar_swc_vmc_rtARID_DEF.TmpSignalConversionAtVAL_VEHICLE_STATEOutport1.FRWheelSpdMps autosar_swc_vmc_rtARID_DEF.TmpSignalConversionAtVAL_VEHICLE_STATEOutport1.RLWheelSpdMps autosar_swc_vmc_rtARID_DEF.TmpSignalConversionAtVAL_VEHICLE_STATEOutport1.RRWheelSpdMps autosar_swc_vmc_rtARID_DEF.TmpSignalConversionAtVAL_VEHICLE_STATEOutport1.SensorVehYawRateRadps autosar_swc_vmc_rtARID_DEF.TmpSignalConversionAtVAL_VEHICLE_STATEOutport1.SensorVehLonAccelMps2 autosar_swc_vmc_rtARID_DEF.TmpSignalConversionAtVAL_VEHICLE_STATEOutport1.SensorVehLatAccelMps2 autosar_swc_vmc_rtARID_DEF.TmpSignalConversionAtVAL_VEHICLE_STATEOutport1.VLC_InternalTargetAcceleration autosar_swc_vmc_rtARID_DEF.TmpSignalConversionAtVAL_VEHICLE_STATEOutport1.TotalOdometer_km autosar_swc_vmc_rtARID_DEF.TmpSignalConversionAtVAL_VEHICLE_STATEOutport1.FLWheelPulseCounter autosar_swc_vmc_rtARID_DEF.TmpSignalConversionAtVAL_VEHICLE_STATEOutport1.FRWheelPulseCounter autosar_swc_vmc_rtARID_DEF.TmpSignalConversionAtVAL_VEHICLE_STATEOutport1.RLWheelPulseCounter autosar_swc_vmc_rtARID_DEF.TmpSignalConversionAtVAL_VEHICLE_STATEOutport1.RRWheelPulseCounter autosar_swc_vmc_rtARID_DEF.TmpSignalConversionAtVAL_VEHICLE_STATEOutport1.TimeStampMs /end REF_MEASUREMENT
/end GROUP
/begin MEASUREMENT SwcOut_VME_Herbeat_Info.inner_error "" ULONG autosar_swc_vme_CM_uint32 0 0 0 4294967295 ECU_ADDRESS 0xfe4cc4b4 /* @ECU_Address@SwcOut_VME_Herbeat_Info.inner_error@ */ /end MEASUREMENT
/begin MEASUREMENT SwcOut_VME_Herbeat_Info.module_status "" UBYTE autosar_swc_vme_CM_SM_MODULE_STATUS 0 0 0 3 ECU_ADDRESS 0xfe4cc4b8 /* @ECU_Address@SwcOut_VME_Herbeat_Info.module_status@ */ /end MEASUREMENT
/begin MEASUREMENT SwcOut_VME_Herbeat_Info.sequence_num "" UBYTE autosar_swc_vme_CM_uint8 0 0 0 255 ECU_ADDRESS 0xfe4cc4b1 /* @ECU_Address@SwcOut_VME_Herbeat_Info.sequence_num@ */ /end MEASUREMENT
/begin MEASUREMENT SwcOut_VME_Herbeat_Info.swc_id "" UBYTE autosar_swc_vme_CM_uint8 0 0 0 255 ECU_ADDRESS 0xfe4cc4b0 /* @ECU_Address@SwcOut_VME_Herbeat_Info.swc_id@ */ /end MEASUREMENT
/begin MEASUREMENT VME_ExecTimestamp.nanoseconds "" ULONG autosar_swc_vme_CM_uint32 0 0 0 4294967295 ECU_ADDRESS 0xfe4cc2a4 /* @ECU_Address@VME_ExecTimestamp.nanoseconds@ */ /end MEASUREMENT
/begin MEASUREMENT VME_ExecTimestamp.seconds "" A_UINT64 autosar_swc_vme_CM_uint64 0 0 0 18446744073709551615 ECU_ADDRESS 0xfe4cc2a8 /* @ECU_Address@VME_ExecTimestamp.seconds@ */ /end MEASUREMENT
/begin MEASUREMENT VME_ExecTimestamp.timeBaseStatus "" UBYTE autosar_swc_vme_CM_uint8 0 0 0 255 ECU_ADDRESS 0xfe4cc2a0 /* @ECU_Address@VME_ExecTimestamp.timeBaseStatus@ */ /end MEASUREMENT
/begin COMPU_METHOD autosar_swc_vme_CM_SM_MODULE_STATUS "Enumerated data type: SM_MODULE_STATUS" TAB_VERB "%0.6" "" COMPU_TAB_REF VTAB_FOR_autosar_swc_vme_CM_SM_MODULE_STATUS /end COMPU_METHOD
/begin COMPU_VTAB VTAB_FOR_autosar_swc_vme_CM_SM_MODULE_STATUS "Enumerated data type: SM_MODULE_STATUS" TAB_VERB 4 0 "STATUS_NORMAL" 1 "STATUS_NOT_CONNECTED" 2 "STATUS_HEARTBEAT_MISSED" 3 "STATUS_ABNORMAL" /end COMPU_VTAB
/begin COMPU_METHOD autosar_swc_vme_CM_uint32 "Q = V" IDENTICAL "%10.0" "" /end COMPU_METHOD
/begin COMPU_METHOD autosar_swc_vme_CM_uint64 "Q = V" IDENTICAL "%20.0" "" /end COMPU_METHOD
/begin COMPU_METHOD autosar_swc_vme_CM_uint8 "Q = V" IDENTICAL "%3.0" "" /end COMPU_METHOD
/begin RECORD_LAYOUT Record_BOOLEAN FNC_VALUES 1 UBYTE COLUMN_DIR DIRECT /end RECORD_LAYOUT
/begin RECORD_LAYOUT Record_FLOAT32_IEEE FNC_VALUES 1 FLOAT32_IEEE COLUMN_DIR DIRECT /end RECORD_LAYOUT
/begin RECORD_LAYOUT Record_FLOAT64_IEEE FNC_VALUES 1 FLOAT64_IEEE COLUMN_DIR DIRECT /end RECORD_LAYOUT
/begin RECORD_LAYOUT Record_UBYTE FNC_VALUES 1 UBYTE COLUMN_DIR DIRECT /end RECORD_LAYOUT
/begin RECORD_LAYOUT Axis_FLOAT32_IEEE AXIS_PTS_X 1 FLOAT32_IEEE INDEX_INCR DIRECT /end RECORD_LAYOUT
/begin GROUP SwcOut_VME_Herbeat_Info ""
 /begin REF_MEASUREMENT SwcOut_VME_Herbeat_Info.swc_id SwcOut_VME_Herbeat_Info.sequence_num SwcOut_VME_Herbeat_Info.inner_error SwcOut_VME_Herbeat_Info.module_status /end REF_MEASUREMENT
/end GROUP
/begin GROUP VME_ExecTimestamp ""
 /begin REF_MEASUREMENT VME_ExecTimestamp.timeBaseStatus VME_ExecTimestamp.nanoseconds VME_ExecTimestamp.seconds /end REF_MEASUREMENT
/end GROUP
/begin GROUP ZDrive_BSW_Cal_Cal "" /begin SUB_GROUP ZDrive_BSW_Cal_Cal.ZDrive_BSW_Cal_VehicleInfomationTable /end SUB_GROUP /end GROUP
/begin GROUP autosar_swc_vme "autosar_swc_vme" ROOT
 /begin SUB_GROUP VME_ExecTimestamp autosar_swc_vme_rtARID_DEF.TmpSignalConversionAtVAL_VEHICLE_STATEOutport1 autosar_swc_vme_autosar_swc_vme_Step_sys /end SUB_GROUP
/end GROUP
/begin GROUP autosar_swc_vme_autosar_swc_vme_Step_sys "autosar_swc_vme/autosar_swc_vme_Step_sys"
 /begin SUB_GROUP autosar_swc_vme_autosar_swc_vme_Step_sys_Enabled_Subsystem autosar_swc_vme_autosar_swc_vme_Step_sys_Subsystem /end SUB_GROUP
/end GROUP
/begin RECORD_LAYOUT Record_BOOLEAN FNC_VALUES 1 UBYTE COLUMN_DIR DIRECT /end RECORD_LAYOUT
/begin RECORD_LAYOUT Record_FLOAT32_IEEE FNC_VALUES 1 FLOAT32_IEEE COLUMN_DIR DIRECT /end RECORD_LAYOUT
/begin RECORD_LAYOUT Record_FLOAT64_IEEE FNC_VALUES 1 FLOAT64_IEEE COLUMN_DIR DIRECT /end RECORD_LAYOUT
/begin RECORD_LAYOUT Record_UBYTE FNC_VALUES 1 UBYTE COLUMN_DIR DIRECT /end RECORD_LAYOUT
/begin RECORD_LAYOUT Axis_FLOAT32_IEEE AXIS_PTS_X 1 FLOAT32_IEEE INDEX_INCR DIRECT /end RECORD_LAYOUT
/begin RECORD_LAYOUT Record_BOOLEAN FNC_VALUES 1 UBYTE COLUMN_DIR DIRECT /end RECORD_LAYOUT
/begin RECORD_LAYOUT Record_FLOAT32_IEEE FNC_VALUES 1 FLOAT32_IEEE COLUMN_DIR DIRECT /end RECORD_LAYOUT
/begin RECORD_LAYOUT Record_FLOAT64_IEEE FNC_VALUES 1 FLOAT64_IEEE COLUMN_DIR DIRECT /end RECORD_LAYOUT
/begin RECORD_LAYOUT Record_UBYTE FNC_VALUES 1 UBYTE COLUMN_DIR DIRECT /end RECORD_LAYOUT
/begin RECORD_LAYOUT Axis_FLOAT32_IEEE AXIS_PTS_X 1 FLOAT32_IEEE INDEX_INCR DIRECT /end RECORD_LAYOUT
/end MODULE
/end PROJECT
