ASAP2_VERSION 1 71
/begin PROJECT ProjectName ""
/begin MODULE ModuleName ""
/begin MOD_COMMON "" BYTE_ORDER MSB_LAST ALIGNMENT_BYTE 1 ALIGNMENT_WORD 1 ALIGNMENT_LONG 1 ALIGNMENT_INT64 1 ALIGNMENT_FLOAT16_IEEE 1 ALIGNMENT_FLOAT32_IEEE 1 ALIGNMENT_FLOAT64_IEEE 1 /end MOD_COMMON
/begin RECORD_LAYOUT __SLONG_S FNC_VALUES 1 SLONG COLUMN_DIR DIRECT /end RECORD_LAYOUT
/begin RECORD_LAYOUT Record_BOOLEAN FNC_VALUES 1 UBYTE COLUMN_DIR DIRECT /end RECORD_LAYOUT
/begin RECORD_LAYOUT Record_FLOAT32_IEEE FNC_VALUES 1 FLOAT32_IEEE COLUMN_DIR DIRECT /end RECORD_LAYOUT
/begin RECORD_LAYOUT Record_UBYTE FNC_VALUES 1 UBYTE COLUMN_DIR DIRECT /end RECORD_LAYOUT
/begin RECORD_LAYOUT Record_UWORD FNC_VALUES 1 UWORD COLUMN_DIR DIRECT /end RECORD_LAYOUT
/begin RECORD_LAYOUT Record_BOOLEAN FNC_VALUES 1 UBYTE COLUMN_DIR DIRECT /end RECORD_LAYOUT
/begin RECORD_LAYOUT Record_FLOAT32_IEEE FNC_VALUES 1 FLOAT32_IEEE COLUMN_DIR DIRECT /end RECORD_LAYOUT
/begin RECORD_LAYOUT Record_UBYTE FNC_VALUES 1 UBYTE COLUMN_DIR DIRECT /end RECORD_LAYOUT
/begin RECORD_LAYOUT Record_UWORD FNC_VALUES 1 UWORD COLUMN_DIR DIRECT /end RECORD_LAYOUT
/begin CHARACTERISTIC P_HMI_ConeConfidence "" VALUE 0xfe820e3c /* @ECU_Address@P_HMI_ConeConfidence@ */ Record_UBYTE 0 autosar_swc_hmi_CM_uint8 0 255 /end CHARACTERISTIC
/begin CHARACTERISTIC P_HMI_condistance_X "" VALUE 0xfe820e34 /* @ECU_Address@P_HMI_condistance_X@ */ Record_FLOAT32_IEEE 0 autosar_swc_hmi_CM_single -3.4E+38 3.4E+38 /end CHARACTERISTIC
/begin CHARACTERISTIC P_HMI_condistance_Y "" VALUE 0xfe820e38 /* @ECU_Address@P_HMI_condistance_Y@ */ Record_FLOAT32_IEEE 0 autosar_swc_hmi_CM_single -3.4E+38 3.4E+38 /end CHARACTERISTIC
/begin MEASUREMENT autosar_swc_hmi_rtARID_DEF.DelayInput1_DSTATE "" UBYTE autosar_swc_hmi_CM_uint8 0 0 0 255 ECU_ADDRESS 0xfe4ad5d3 /* @ECU_Address@autosar_swc_hmi_rtARID_DEF.DelayInput1_DSTATE@ */ /end MEASUREMENT
/begin MEASUREMENT autosar_swc_hmi_rtARID_DEF.DelayInput1_DSTATE_d "" UBYTE autosar_swc_hmi_CM_uint8 0 0 0 255 ECU_ADDRESS 0xfe4ad5d4 /* @ECU_Address@autosar_swc_hmi_rtARID_DEF.DelayInput1_DSTATE_d@ */ /end MEASUREMENT
/begin MEASUREMENT autosar_swc_hmi_rtARID_DEF.DelayInput1_DSTATE_h "" UBYTE autosar_swc_hmi_CM_uint8 0 0 0 255 ECU_ADDRESS 0xfe4ad5d5 /* @ECU_Address@autosar_swc_hmi_rtARID_DEF.DelayInput1_DSTATE_h@ */ /end MEASUREMENT
/begin MEASUREMENT autosar_swc_hmi_rtARID_DEF.DelayInput1_DSTATE_hz "" UBYTE autosar_swc_hmi_CM_uint8 0 0 0 255 ECU_ADDRESS 0xfe4ad5d7 /* @ECU_Address@autosar_swc_hmi_rtARID_DEF.DelayInput1_DSTATE_hz@ */ /end MEASUREMENT
/begin MEASUREMENT autosar_swc_hmi_rtARID_DEF.DelayInput1_DSTATE_n "" UBYTE autosar_swc_hmi_CM_uint8 0 0 0 255 ECU_ADDRESS 0xfe4ad5d6 /* @ECU_Address@autosar_swc_hmi_rtARID_DEF.DelayInput1_DSTATE_n@ */ /end MEASUREMENT
/begin MEASUREMENT autosar_swc_hmi_rtARID_DEF.NoPrakSoundwarn "" UBYTE autosar_swc_hmi_CM_logical 0 0 0 1 ECU_ADDRESS 0xfe4ad604 /* @ECU_Address@autosar_swc_hmi_rtARID_DEF.NoPrakSoundwarn@ */ /end MEASUREMENT
/begin MEASUREMENT autosar_swc_hmi_rtARID_DEF.NoPrakwarn "" UBYTE autosar_swc_hmi_CM_logical 0 0 0 1 ECU_ADDRESS 0xfe4ad605 /* @ECU_Address@autosar_swc_hmi_rtARID_DEF.NoPrakwarn@ */ /end MEASUREMENT
/begin MEASUREMENT autosar_swc_hmi_rtARID_DEF.SoundWarn "" UBYTE autosar_swc_hmi_CM_uint8 0 0 0 255 ECU_ADDRESS 0xfe4ad5ce /* @ECU_Address@autosar_swc_hmi_rtARID_DEF.SoundWarn@ */ /end MEASUREMENT
/begin MEASUREMENT autosar_swc_hmi_rtARID_DEF.Time "" FLOAT64_IEEE autosar_swc_hmi_CM_double 0 0 -1.7E+308 1.7E+308 ECU_ADDRESS 0xfe4ad598 /* @ECU_Address@autosar_swc_hmi_rtARID_DEF.Time@ */ /end MEASUREMENT
/begin MEASUREMENT autosar_swc_hmi_rtARID_DEF.UnitDelay3_DSTATE "" ULONG autosar_swc_hmi_CM_uint32 0 0 0 4294967295 ECU_ADDRESS 0xfe4ad5b0 /* @ECU_Address@autosar_swc_hmi_rtARID_DEF.UnitDelay3_DSTATE@ */ /end MEASUREMENT
/begin MEASUREMENT autosar_swc_hmi_rtARID_DEF.UnitDelay3_DSTATE_a "" ULONG autosar_swc_hmi_CM_uint32 0 0 0 4294967295 ECU_ADDRESS 0xfe4ad5b8 /* @ECU_Address@autosar_swc_hmi_rtARID_DEF.UnitDelay3_DSTATE_a@ */ /end MEASUREMENT
/begin MEASUREMENT autosar_swc_hmi_rtARID_DEF.UnitDelay3_DSTATE_d "" ULONG autosar_swc_hmi_CM_uint32 0 0 0 4294967295 ECU_ADDRESS 0xfe4ad5c8 /* @ECU_Address@autosar_swc_hmi_rtARID_DEF.UnitDelay3_DSTATE_d@ */ /end MEASUREMENT
/begin MEASUREMENT autosar_swc_hmi_rtARID_DEF.UnitDelay3_DSTATE_e "" ULONG autosar_swc_hmi_CM_uint32 0 0 0 4294967295 ECU_ADDRESS 0xfe4ad5c0 /* @ECU_Address@autosar_swc_hmi_rtARID_DEF.UnitDelay3_DSTATE_e@ */ /end MEASUREMENT
/begin MEASUREMENT autosar_swc_hmi_rtARID_DEF.UnitDelay3_DSTATE_h "" ULONG autosar_swc_hmi_CM_uint32 0 0 0 4294967295 ECU_ADDRESS 0xfe4ad5c4 /* @ECU_Address@autosar_swc_hmi_rtARID_DEF.UnitDelay3_DSTATE_h@ */ /end MEASUREMENT
/begin MEASUREMENT autosar_swc_hmi_rtARID_DEF.UnitDelay3_DSTATE_i "" ULONG autosar_swc_hmi_CM_uint32 0 0 0 4294967295 ECU_ADDRESS 0xfe4ad5bc /* @ECU_Address@autosar_swc_hmi_rtARID_DEF.UnitDelay3_DSTATE_i@ */ /end MEASUREMENT
/begin MEASUREMENT autosar_swc_hmi_rtARID_DEF.UnitDelay3_DSTATE_m "" ULONG autosar_swc_hmi_CM_uint32 0 0 0 4294967295 ECU_ADDRESS 0xfe4ad5b4 /* @ECU_Address@autosar_swc_hmi_rtARID_DEF.UnitDelay3_DSTATE_m@ */ /end MEASUREMENT
/begin MEASUREMENT autosar_swc_hmi_rtARID_DEF.UnitDelay4_DSTATE "" UBYTE autosar_swc_hmi_CM_logical 0 0 0 1 ECU_ADDRESS 0xfe4ad606 /* @ECU_Address@autosar_swc_hmi_rtARID_DEF.UnitDelay4_DSTATE@ */ /end MEASUREMENT
/begin MEASUREMENT autosar_swc_hmi_rtARID_DEF.UnitDelay4_DSTATE_e "" UBYTE autosar_swc_hmi_CM_logical 0 0 0 1 ECU_ADDRESS 0xfe4ad60a /* @ECU_Address@autosar_swc_hmi_rtARID_DEF.UnitDelay4_DSTATE_e@ */ /end MEASUREMENT
/begin MEASUREMENT autosar_swc_hmi_rtARID_DEF.UnitDelay4_DSTATE_i "" UBYTE autosar_swc_hmi_CM_logical 0 0 0 1 ECU_ADDRESS 0xfe4ad60e /* @ECU_Address@autosar_swc_hmi_rtARID_DEF.UnitDelay4_DSTATE_i@ */ /end MEASUREMENT
/begin MEASUREMENT autosar_swc_hmi_rtARID_DEF.UnitDelay4_DSTATE_ia "" UBYTE autosar_swc_hmi_CM_logical 0 0 0 1 ECU_ADDRESS 0xfe4ad61e /* @ECU_Address@autosar_swc_hmi_rtARID_DEF.UnitDelay4_DSTATE_ia@ */ /end MEASUREMENT
/begin MEASUREMENT autosar_swc_hmi_rtARID_DEF.UnitDelay4_DSTATE_if "" UBYTE autosar_swc_hmi_CM_logical 0 0 0 1 ECU_ADDRESS 0xfe4ad61a /* @ECU_Address@autosar_swc_hmi_rtARID_DEF.UnitDelay4_DSTATE_if@ */ /end MEASUREMENT
/begin MEASUREMENT autosar_swc_hmi_rtARID_DEF.UnitDelay4_DSTATE_k "" UBYTE autosar_swc_hmi_CM_logical 0 0 0 1 ECU_ADDRESS 0xfe4ad616 /* @ECU_Address@autosar_swc_hmi_rtARID_DEF.UnitDelay4_DSTATE_k@ */ /end MEASUREMENT
/begin MEASUREMENT autosar_swc_hmi_rtARID_DEF.UnitDelay4_DSTATE_o "" UBYTE autosar_swc_hmi_CM_logical 0 0 0 1 ECU_ADDRESS 0xfe4ad612 /* @ECU_Address@autosar_swc_hmi_rtARID_DEF.UnitDelay4_DSTATE_o@ */ /end MEASUREMENT
/begin MEASUREMENT autosar_swc_hmi_rtARID_DEF.UnitDelay5_DSTATE "" UBYTE autosar_swc_hmi_CM_logical 0 0 0 1 ECU_ADDRESS 0xfe4ad607 /* @ECU_Address@autosar_swc_hmi_rtARID_DEF.UnitDelay5_DSTATE@ */ /end MEASUREMENT
/begin MEASUREMENT autosar_swc_hmi_rtARID_DEF.UnitDelay5_DSTATE_e "" UBYTE autosar_swc_hmi_CM_logical 0 0 0 1 ECU_ADDRESS 0xfe4ad60f /* @ECU_Address@autosar_swc_hmi_rtARID_DEF.UnitDelay5_DSTATE_e@ */ /end MEASUREMENT
/begin MEASUREMENT autosar_swc_hmi_rtARID_DEF.UnitDelay5_DSTATE_g "" UBYTE autosar_swc_hmi_CM_logical 0 0 0 1 ECU_ADDRESS 0xfe4ad60b /* @ECU_Address@autosar_swc_hmi_rtARID_DEF.UnitDelay5_DSTATE_g@ */ /end MEASUREMENT
/begin MEASUREMENT autosar_swc_hmi_rtARID_DEF.UnitDelay5_DSTATE_ga "" UBYTE autosar_swc_hmi_CM_logical 0 0 0 1 ECU_ADDRESS 0xfe4ad613 /* @ECU_Address@autosar_swc_hmi_rtARID_DEF.UnitDelay5_DSTATE_ga@ */ /end MEASUREMENT
/begin MEASUREMENT autosar_swc_hmi_rtARID_DEF.UnitDelay5_DSTATE_i "" UBYTE autosar_swc_hmi_CM_logical 0 0 0 1 ECU_ADDRESS 0xfe4ad61b /* @ECU_Address@autosar_swc_hmi_rtARID_DEF.UnitDelay5_DSTATE_i@ */ /end MEASUREMENT
/begin MEASUREMENT autosar_swc_hmi_rtARID_DEF.UnitDelay5_DSTATE_l "" UBYTE autosar_swc_hmi_CM_logical 0 0 0 1 ECU_ADDRESS 0xfe4ad61f /* @ECU_Address@autosar_swc_hmi_rtARID_DEF.UnitDelay5_DSTATE_l@ */ /end MEASUREMENT
/begin MEASUREMENT autosar_swc_hmi_rtARID_DEF.UnitDelay5_DSTATE_m "" UBYTE autosar_swc_hmi_CM_logical 0 0 0 1 ECU_ADDRESS 0xfe4ad617 /* @ECU_Address@autosar_swc_hmi_rtARID_DEF.UnitDelay5_DSTATE_m@ */ /end MEASUREMENT
/begin MEASUREMENT autosar_swc_hmi_rtARID_DEF.UnitDelay6_DSTATE "" UBYTE autosar_swc_hmi_CM_logical 0 0 0 1 ECU_ADDRESS 0xfe4ad608 /* @ECU_Address@autosar_swc_hmi_rtARID_DEF.UnitDelay6_DSTATE@ */ /end MEASUREMENT
/begin MEASUREMENT autosar_swc_hmi_rtARID_DEF.UnitDelay6_DSTATE_c "" UBYTE autosar_swc_hmi_CM_logical 0 0 0 1 ECU_ADDRESS 0xfe4ad60c /* @ECU_Address@autosar_swc_hmi_rtARID_DEF.UnitDelay6_DSTATE_c@ */ /end MEASUREMENT
/begin MEASUREMENT autosar_swc_hmi_rtARID_DEF.UnitDelay6_DSTATE_g "" UBYTE autosar_swc_hmi_CM_logical 0 0 0 1 ECU_ADDRESS 0xfe4ad620 /* @ECU_Address@autosar_swc_hmi_rtARID_DEF.UnitDelay6_DSTATE_g@ */ /end MEASUREMENT
/begin MEASUREMENT autosar_swc_hmi_rtARID_DEF.UnitDelay6_DSTATE_h "" UBYTE autosar_swc_hmi_CM_logical 0 0 0 1 ECU_ADDRESS 0xfe4ad614 /* @ECU_Address@autosar_swc_hmi_rtARID_DEF.UnitDelay6_DSTATE_h@ */ /end MEASUREMENT
/begin MEASUREMENT autosar_swc_hmi_rtARID_DEF.UnitDelay6_DSTATE_i "" UBYTE autosar_swc_hmi_CM_logical 0 0 0 1 ECU_ADDRESS 0xfe4ad61c /* @ECU_Address@autosar_swc_hmi_rtARID_DEF.UnitDelay6_DSTATE_i@ */ /end MEASUREMENT
/begin MEASUREMENT autosar_swc_hmi_rtARID_DEF.UnitDelay6_DSTATE_k "" UBYTE autosar_swc_hmi_CM_logical 0 0 0 1 ECU_ADDRESS 0xfe4ad618 /* @ECU_Address@autosar_swc_hmi_rtARID_DEF.UnitDelay6_DSTATE_k@ */ /end MEASUREMENT
/begin MEASUREMENT autosar_swc_hmi_rtARID_DEF.UnitDelay6_DSTATE_m "" UBYTE autosar_swc_hmi_CM_logical 0 0 0 1 ECU_ADDRESS 0xfe4ad610 /* @ECU_Address@autosar_swc_hmi_rtARID_DEF.UnitDelay6_DSTATE_m@ */ /end MEASUREMENT
/begin MEASUREMENT autosar_swc_hmi_rtARID_DEF.UnitDelay7_DSTATE "" UBYTE autosar_swc_hmi_CM_logical 0 0 0 1 ECU_ADDRESS 0xfe4ad609 /* @ECU_Address@autosar_swc_hmi_rtARID_DEF.UnitDelay7_DSTATE@ */ /end MEASUREMENT
/begin MEASUREMENT autosar_swc_hmi_rtARID_DEF.UnitDelay7_DSTATE_a "" UBYTE autosar_swc_hmi_CM_logical 0 0 0 1 ECU_ADDRESS 0xfe4ad619 /* @ECU_Address@autosar_swc_hmi_rtARID_DEF.UnitDelay7_DSTATE_a@ */ /end MEASUREMENT
/begin MEASUREMENT autosar_swc_hmi_rtARID_DEF.UnitDelay7_DSTATE_d "" UBYTE autosar_swc_hmi_CM_logical 0 0 0 1 ECU_ADDRESS 0xfe4ad611 /* @ECU_Address@autosar_swc_hmi_rtARID_DEF.UnitDelay7_DSTATE_d@ */ /end MEASUREMENT
/begin MEASUREMENT autosar_swc_hmi_rtARID_DEF.UnitDelay7_DSTATE_e "" UBYTE autosar_swc_hmi_CM_logical 0 0 0 1 ECU_ADDRESS 0xfe4ad60d /* @ECU_Address@autosar_swc_hmi_rtARID_DEF.UnitDelay7_DSTATE_e@ */ /end MEASUREMENT
/begin MEASUREMENT autosar_swc_hmi_rtARID_DEF.UnitDelay7_DSTATE_h "" UBYTE autosar_swc_hmi_CM_logical 0 0 0 1 ECU_ADDRESS 0xfe4ad615 /* @ECU_Address@autosar_swc_hmi_rtARID_DEF.UnitDelay7_DSTATE_h@ */ /end MEASUREMENT
/begin MEASUREMENT autosar_swc_hmi_rtARID_DEF.UnitDelay7_DSTATE_j "" UBYTE autosar_swc_hmi_CM_logical 0 0 0 1 ECU_ADDRESS 0xfe4ad61d /* @ECU_Address@autosar_swc_hmi_rtARID_DEF.UnitDelay7_DSTATE_j@ */ /end MEASUREMENT
/begin MEASUREMENT autosar_swc_hmi_rtARID_DEF.UnitDelay7_DSTATE_p "" UBYTE autosar_swc_hmi_CM_logical 0 0 0 1 ECU_ADDRESS 0xfe4ad621 /* @ECU_Address@autosar_swc_hmi_rtARID_DEF.UnitDelay7_DSTATE_p@ */ /end MEASUREMENT
/begin MEASUREMENT autosar_swc_hmi_rtARID_DEF.is_active_c103_autosar_swc_hmi "" UBYTE autosar_swc_hmi_CM_uint8 0 0 0 255 ECU_ADDRESS 0xfe4ad5e2 /* @ECU_Address@autosar_swc_hmi_rtARID_DEF.is_active_c103_autosar_swc_hmi@ */ /end MEASUREMENT
/begin MEASUREMENT autosar_swc_hmi_rtARID_DEF.is_active_c104_autosar_swc_hmi "" UBYTE autosar_swc_hmi_CM_uint8 0 0 0 255 ECU_ADDRESS 0xfe4ad601 /* @ECU_Address@autosar_swc_hmi_rtARID_DEF.is_active_c104_autosar_swc_hmi@ */ /end MEASUREMENT
/begin MEASUREMENT autosar_swc_hmi_rtARID_DEF.is_active_c105_autosar_swc_hmi "" UBYTE autosar_swc_hmi_CM_uint8 0 0 0 255 ECU_ADDRESS 0xfe4ad5fc /* @ECU_Address@autosar_swc_hmi_rtARID_DEF.is_active_c105_autosar_swc_hmi@ */ /end MEASUREMENT
/begin MEASUREMENT autosar_swc_hmi_rtARID_DEF.is_active_c106_autosar_swc_hmi "" UBYTE autosar_swc_hmi_CM_uint8 0 0 0 255 ECU_ADDRESS 0xfe4ad5f2 /* @ECU_Address@autosar_swc_hmi_rtARID_DEF.is_active_c106_autosar_swc_hmi@ */ /end MEASUREMENT
/begin MEASUREMENT autosar_swc_hmi_rtARID_DEF.is_active_c108_autosar_swc_hmi "" UBYTE autosar_swc_hmi_CM_uint8 0 0 0 255 ECU_ADDRESS 0xfe4ad5ea /* @ECU_Address@autosar_swc_hmi_rtARID_DEF.is_active_c108_autosar_swc_hmi@ */ /end MEASUREMENT
/begin MEASUREMENT autosar_swc_hmi_rtARID_DEF.is_active_c112_autosar_swc_hmi "" UBYTE autosar_swc_hmi_CM_uint8 0 0 0 255 ECU_ADDRESS 0xfe4ad5e4 /* @ECU_Address@autosar_swc_hmi_rtARID_DEF.is_active_c112_autosar_swc_hmi@ */ /end MEASUREMENT
/begin MEASUREMENT autosar_swc_hmi_rtARID_DEF.is_active_c117_autosar_swc_hmi "" UBYTE autosar_swc_hmi_CM_uint8 0 0 0 255 ECU_ADDRESS 0xfe4ad5dd /* @ECU_Address@autosar_swc_hmi_rtARID_DEF.is_active_c117_autosar_swc_hmi@ */ /end MEASUREMENT
/begin MEASUREMENT autosar_swc_hmi_rtARID_DEF.is_active_c118_autosar_swc_hmi "" UBYTE autosar_swc_hmi_CM_uint8 0 0 0 255 ECU_ADDRESS 0xfe4ad5e7 /* @ECU_Address@autosar_swc_hmi_rtARID_DEF.is_active_c118_autosar_swc_hmi@ */ /end MEASUREMENT
/begin MEASUREMENT autosar_swc_hmi_rtARID_DEF.is_active_c120_autosar_swc_hmi "" UBYTE autosar_swc_hmi_CM_uint8 0 0 0 255 ECU_ADDRESS 0xfe4ad5ef /* @ECU_Address@autosar_swc_hmi_rtARID_DEF.is_active_c120_autosar_swc_hmi@ */ /end MEASUREMENT
/begin MEASUREMENT autosar_swc_hmi_rtARID_DEF.is_active_c121_autosar_swc_hmi "" UBYTE autosar_swc_hmi_CM_uint8 0 0 0 255 ECU_ADDRESS 0xfe4ad5f7 /* @ECU_Address@autosar_swc_hmi_rtARID_DEF.is_active_c121_autosar_swc_hmi@ */ /end MEASUREMENT
/begin MEASUREMENT autosar_swc_hmi_rtARID_DEF.is_c103_autosar_swc_hmi "" UBYTE autosar_swc_hmi_CM_uint8 0 0 0 255 ECU_ADDRESS 0xfe4ad5e3 /* @ECU_Address@autosar_swc_hmi_rtARID_DEF.is_c103_autosar_swc_hmi@ */ /end MEASUREMENT
/begin MEASUREMENT autosar_swc_hmi_rtARID_DEF.is_c104_autosar_swc_hmi "" UBYTE autosar_swc_hmi_CM_uint8 0 0 0 255 ECU_ADDRESS 0xfe4ad602 /* @ECU_Address@autosar_swc_hmi_rtARID_DEF.is_c104_autosar_swc_hmi@ */ /end MEASUREMENT
/begin MEASUREMENT autosar_swc_hmi_rtARID_DEF.is_c105_autosar_swc_hmi "" UBYTE autosar_swc_hmi_CM_uint8 0 0 0 255 ECU_ADDRESS 0xfe4ad5fd /* @ECU_Address@autosar_swc_hmi_rtARID_DEF.is_c105_autosar_swc_hmi@ */ /end MEASUREMENT
/begin MEASUREMENT autosar_swc_hmi_rtARID_DEF.is_c106_autosar_swc_hmi "" UBYTE autosar_swc_hmi_CM_uint8 0 0 0 255 ECU_ADDRESS 0xfe4ad5f3 /* @ECU_Address@autosar_swc_hmi_rtARID_DEF.is_c106_autosar_swc_hmi@ */ /end MEASUREMENT
/begin MEASUREMENT autosar_swc_hmi_rtARID_DEF.is_c108_autosar_swc_hmi "" UBYTE autosar_swc_hmi_CM_uint8 0 0 0 255 ECU_ADDRESS 0xfe4ad5eb /* @ECU_Address@autosar_swc_hmi_rtARID_DEF.is_c108_autosar_swc_hmi@ */ /end MEASUREMENT
/begin MEASUREMENT autosar_swc_hmi_rtARID_DEF.is_c112_autosar_swc_hmi "" UBYTE autosar_swc_hmi_CM_uint8 0 0 0 255 ECU_ADDRESS 0xfe4ad5e5 /* @ECU_Address@autosar_swc_hmi_rtARID_DEF.is_c112_autosar_swc_hmi@ */ /end MEASUREMENT
/begin MEASUREMENT autosar_swc_hmi_rtARID_DEF.is_c117_autosar_swc_hmi "" UBYTE autosar_swc_hmi_CM_uint8 0 0 0 255 ECU_ADDRESS 0xfe4ad5de /* @ECU_Address@autosar_swc_hmi_rtARID_DEF.is_c117_autosar_swc_hmi@ */ /end MEASUREMENT
/begin MEASUREMENT autosar_swc_hmi_rtARID_DEF.is_c118_autosar_swc_hmi "" UBYTE autosar_swc_hmi_CM_uint8 0 0 0 255 ECU_ADDRESS 0xfe4ad5e8 /* @ECU_Address@autosar_swc_hmi_rtARID_DEF.is_c118_autosar_swc_hmi@ */ /end MEASUREMENT
/begin MEASUREMENT autosar_swc_hmi_rtARID_DEF.is_c120_autosar_swc_hmi "" UBYTE autosar_swc_hmi_CM_uint8 0 0 0 255 ECU_ADDRESS 0xfe4ad5f0 /* @ECU_Address@autosar_swc_hmi_rtARID_DEF.is_c120_autosar_swc_hmi@ */ /end MEASUREMENT
/begin MEASUREMENT autosar_swc_hmi_rtARID_DEF.is_c121_autosar_swc_hmi "" UBYTE autosar_swc_hmi_CM_uint8 0 0 0 255 ECU_ADDRESS 0xfe4ad5f8 /* @ECU_Address@autosar_swc_hmi_rtARID_DEF.is_c121_autosar_swc_hmi@ */ /end MEASUREMENT
/begin MEASUREMENT autosar_swc_hmi_rtARID_DEF.text_current "" FLOAT64_IEEE autosar_swc_hmi_CM_double 0 0 -1.7E+308 1.7E+308 ECU_ADDRESS 0xfe4ad5a0 /* @ECU_Address@autosar_swc_hmi_rtARID_DEF.text_current@ */ /end MEASUREMENT
/begin MEASUREMENT autosar_swc_hmi_rtARID_DEF.text_current_b "" UBYTE autosar_swc_hmi_CM_uint8 0 0 0 255 ECU_ADDRESS 0xfe4ad5e0 /* @ECU_Address@autosar_swc_hmi_rtARID_DEF.text_current_b@ */ /end MEASUREMENT
/begin MEASUREMENT autosar_swc_hmi_rtARID_DEF.text_current_c "" UBYTE autosar_swc_hmi_CM_uint8 0 0 0 255 ECU_ADDRESS 0xfe4ad5f5 /* @ECU_Address@autosar_swc_hmi_rtARID_DEF.text_current_c@ */ /end MEASUREMENT
/begin MEASUREMENT autosar_swc_hmi_rtARID_DEF.text_current_d "" UBYTE autosar_swc_hmi_CM_uint8 0 0 0 255 ECU_ADDRESS 0xfe4ad5fa /* @ECU_Address@autosar_swc_hmi_rtARID_DEF.text_current_d@ */ /end MEASUREMENT
/begin MEASUREMENT autosar_swc_hmi_rtARID_DEF.text_current_e "" UBYTE autosar_swc_hmi_CM_uint8 0 0 0 255 ECU_ADDRESS 0xfe4ad5ed /* @ECU_Address@autosar_swc_hmi_rtARID_DEF.text_current_e@ */ /end MEASUREMENT
/begin MEASUREMENT autosar_swc_hmi_rtARID_DEF.text_current_g "" UBYTE autosar_swc_hmi_CM_uint8 0 0 0 255 ECU_ADDRESS 0xfe4ad5ff /* @ECU_Address@autosar_swc_hmi_rtARID_DEF.text_current_g@ */ /end MEASUREMENT
/begin MEASUREMENT autosar_swc_hmi_rtARID_DEF.text_current_l "" UBYTE autosar_swc_hmi_CM_uint8 0 0 0 255 ECU_ADDRESS 0xfe4ad5db /* @ECU_Address@autosar_swc_hmi_rtARID_DEF.text_current_l@ */ /end MEASUREMENT
/begin MEASUREMENT autosar_swc_hmi_rtARID_DEF.text_in_temp "" FLOAT64_IEEE autosar_swc_hmi_CM_double 0 0 -1.7E+308 1.7E+308 ECU_ADDRESS 0xfe4ad5a8 /* @ECU_Address@autosar_swc_hmi_rtARID_DEF.text_in_temp@ */ /end MEASUREMENT
/begin MEASUREMENT autosar_swc_hmi_rtARID_DEF.text_in_temp_c "" UBYTE autosar_swc_hmi_CM_uint8 0 0 0 255 ECU_ADDRESS 0xfe4ad5dc /* @ECU_Address@autosar_swc_hmi_rtARID_DEF.text_in_temp_c@ */ /end MEASUREMENT
/begin MEASUREMENT autosar_swc_hmi_rtARID_DEF.text_in_temp_d "" UBYTE autosar_swc_hmi_CM_uint8 0 0 0 255 ECU_ADDRESS 0xfe4ad5ee /* @ECU_Address@autosar_swc_hmi_rtARID_DEF.text_in_temp_d@ */ /end MEASUREMENT
/begin MEASUREMENT autosar_swc_hmi_rtARID_DEF.text_in_temp_e "" UBYTE autosar_swc_hmi_CM_uint8 0 0 0 255 ECU_ADDRESS 0xfe4ad5fb /* @ECU_Address@autosar_swc_hmi_rtARID_DEF.text_in_temp_e@ */ /end MEASUREMENT
/begin MEASUREMENT autosar_swc_hmi_rtARID_DEF.text_in_temp_g "" UBYTE autosar_swc_hmi_CM_uint8 0 0 0 255 ECU_ADDRESS 0xfe4ad600 /* @ECU_Address@autosar_swc_hmi_rtARID_DEF.text_in_temp_g@ */ /end MEASUREMENT
/begin MEASUREMENT autosar_swc_hmi_rtARID_DEF.text_in_temp_o "" UBYTE autosar_swc_hmi_CM_uint8 0 0 0 255 ECU_ADDRESS 0xfe4ad5f6 /* @ECU_Address@autosar_swc_hmi_rtARID_DEF.text_in_temp_o@ */ /end MEASUREMENT
/begin MEASUREMENT autosar_swc_hmi_rtARID_DEF.text_in_temp_p "" UBYTE autosar_swc_hmi_CM_uint8 0 0 0 255 ECU_ADDRESS 0xfe4ad5e1 /* @ECU_Address@autosar_swc_hmi_rtARID_DEF.text_in_temp_p@ */ /end MEASUREMENT
/begin MEASUREMENT autosar_swc_hmi_rtARID_DEF.text_out "" FLOAT64_IEEE autosar_swc_hmi_CM_double 0 0 -1.7E+308 1.7E+308 ECU_ADDRESS 0xfe4ad590 /* @ECU_Address@autosar_swc_hmi_rtARID_DEF.text_out@ */ /end MEASUREMENT
/begin MEASUREMENT autosar_swc_hmi_rtARID_DEF.text_out_a "" UBYTE autosar_swc_hmi_CM_uint8 0 0 0 255 ECU_ADDRESS 0xfe4ad5cc /* @ECU_Address@autosar_swc_hmi_rtARID_DEF.text_out_a@ */ /end MEASUREMENT
/begin MEASUREMENT autosar_swc_hmi_rtARID_DEF.text_out_af "" UBYTE autosar_swc_hmi_CM_uint8 0 0 0 255 ECU_ADDRESS 0xfe4ad5cd /* @ECU_Address@autosar_swc_hmi_rtARID_DEF.text_out_af@ */ /end MEASUREMENT
/begin MEASUREMENT autosar_swc_hmi_rtARID_DEF.text_out_b "" UBYTE autosar_swc_hmi_CM_uint8 0 0 0 255 ECU_ADDRESS 0xfe4ad5d1 /* @ECU_Address@autosar_swc_hmi_rtARID_DEF.text_out_b@ */ /end MEASUREMENT
/begin MEASUREMENT autosar_swc_hmi_rtARID_DEF.text_out_h "" UBYTE autosar_swc_hmi_CM_uint8 0 0 0 255 ECU_ADDRESS 0xfe4ad5d0 /* @ECU_Address@autosar_swc_hmi_rtARID_DEF.text_out_h@ */ /end MEASUREMENT
/begin MEASUREMENT autosar_swc_hmi_rtARID_DEF.text_out_i "" UBYTE autosar_swc_hmi_CM_uint8 0 0 0 255 ECU_ADDRESS 0xfe4ad5d2 /* @ECU_Address@autosar_swc_hmi_rtARID_DEF.text_out_i@ */ /end MEASUREMENT
/begin MEASUREMENT autosar_swc_hmi_rtARID_DEF.text_out_m "" UBYTE autosar_swc_hmi_CM_uint8 0 0 0 255 ECU_ADDRESS 0xfe4ad5cf /* @ECU_Address@autosar_swc_hmi_rtARID_DEF.text_out_m@ */ /end MEASUREMENT
/begin MEASUREMENT autosar_swc_hmi_rtARID_DEF.time "" UBYTE autosar_swc_hmi_CM_uint8 0 0 0 255 ECU_ADDRESS 0xfe4ad5da /* @ECU_Address@autosar_swc_hmi_rtARID_DEF.time@ */ /end MEASUREMENT
/begin MEASUREMENT autosar_swc_hmi_rtARID_DEF.time_a "" UBYTE autosar_swc_hmi_CM_uint8 0 0 0 255 ECU_ADDRESS 0xfe4ad5e6 /* @ECU_Address@autosar_swc_hmi_rtARID_DEF.time_a@ */ /end MEASUREMENT
/begin MEASUREMENT autosar_swc_hmi_rtARID_DEF.time_b "" UBYTE autosar_swc_hmi_CM_uint8 0 0 0 255 ECU_ADDRESS 0xfe4ad5f1 /* @ECU_Address@autosar_swc_hmi_rtARID_DEF.time_b@ */ /end MEASUREMENT
/begin MEASUREMENT autosar_swc_hmi_rtARID_DEF.time_c "" UBYTE autosar_swc_hmi_CM_uint8 0 0 0 255 ECU_ADDRESS 0xfe4ad5e9 /* @ECU_Address@autosar_swc_hmi_rtARID_DEF.time_c@ */ /end MEASUREMENT
/begin MEASUREMENT autosar_swc_hmi_rtARID_DEF.time_g "" UBYTE autosar_swc_hmi_CM_uint8 0 0 0 255 ECU_ADDRESS 0xfe4ad5f4 /* @ECU_Address@autosar_swc_hmi_rtARID_DEF.time_g@ */ /end MEASUREMENT
/begin MEASUREMENT autosar_swc_hmi_rtARID_DEF.time_h "" UBYTE autosar_swc_hmi_CM_uint8 0 0 0 255 ECU_ADDRESS 0xfe4ad5f9 /* @ECU_Address@autosar_swc_hmi_rtARID_DEF.time_h@ */ /end MEASUREMENT
/begin MEASUREMENT autosar_swc_hmi_rtARID_DEF.time_k "" UBYTE autosar_swc_hmi_CM_uint8 0 0 0 255 ECU_ADDRESS 0xfe4ad5df /* @ECU_Address@autosar_swc_hmi_rtARID_DEF.time_k@ */ /end MEASUREMENT
/begin MEASUREMENT autosar_swc_hmi_rtARID_DEF.time_kc "" UBYTE autosar_swc_hmi_CM_uint8 0 0 0 255 ECU_ADDRESS 0xfe4ad5ec /* @ECU_Address@autosar_swc_hmi_rtARID_DEF.time_kc@ */ /end MEASUREMENT
/begin MEASUREMENT autosar_swc_hmi_rtARID_DEF.time_kh "" UBYTE autosar_swc_hmi_CM_uint8 0 0 0 255 ECU_ADDRESS 0xfe4ad5fe /* @ECU_Address@autosar_swc_hmi_rtARID_DEF.time_kh@ */ /end MEASUREMENT
/begin COMPU_METHOD autosar_swc_hmi_CM_double "Q = V" IDENTICAL "%15.10" "" /end COMPU_METHOD
/begin COMPU_METHOD autosar_swc_hmi_CM_logical "Q = V" IDENTICAL "%1.0" "" /end COMPU_METHOD
/begin COMPU_METHOD autosar_swc_hmi_CM_single "Q = V" IDENTICAL "%8.6" "" /end COMPU_METHOD
/begin COMPU_METHOD autosar_swc_hmi_CM_uint32 "Q = V" IDENTICAL "%10.0" "" /end COMPU_METHOD
/begin COMPU_METHOD autosar_swc_hmi_CM_uint8 "Q = V" IDENTICAL "%3.0" "" /end COMPU_METHOD
/begin RECORD_LAYOUT Record_BOOLEAN FNC_VALUES 1 UBYTE COLUMN_DIR DIRECT /end RECORD_LAYOUT
/begin RECORD_LAYOUT Record_FLOAT32_IEEE FNC_VALUES 1 FLOAT32_IEEE COLUMN_DIR DIRECT /end RECORD_LAYOUT
/begin RECORD_LAYOUT Record_UBYTE FNC_VALUES 1 UBYTE COLUMN_DIR DIRECT /end RECORD_LAYOUT
/begin GROUP autosar_swc_hmi_autosar_swc_hmi_Step_sys_GENERAL_INFO_work "autosar_swc_hmi/autosar_swc_hmi_Step_sys/GENERAL_INFO_work"
 /begin SUB_GROUP autosar_swc_hmi_autosar_swc_hmi_Step_sys_GENERAL_INFO_work_Detect_Change1 autosar_swc_hmi_autosar_swc_hmi_Step_sys_GENERAL_INFO_work_Detect_Change2 autosar_swc_hmi_autosar_swc_hmi_Step_sys_GENERAL_INFO_work_Detect_Change3 autosar_swc_hmi_autosar_swc_hmi_Step_sys_GENERAL_INFO_work_Detect_Change6 autosar_swc_hmi_autosar_swc_hmi_Step_sys_GENERAL_INFO_work_Detect_Change7 /end SUB_GROUP
 /begin REF_MEASUREMENT autosar_swc_hmi_rtARID_DEF.NoPrakSoundwarn autosar_swc_hmi_rtARID_DEF.NoPrakwarn autosar_swc_hmi_rtARID_DEF.SoundWarn autosar_swc_hmi_rtARID_DEF.Time autosar_swc_hmi_rtARID_DEF.is_active_c103_autosar_swc_hmi autosar_swc_hmi_rtARID_DEF.is_active_c104_autosar_swc_hmi autosar_swc_hmi_rtARID_DEF.is_active_c105_autosar_swc_hmi autosar_swc_hmi_rtARID_DEF.is_active_c106_autosar_swc_hmi autosar_swc_hmi_rtARID_DEF.is_active_c108_autosar_swc_hmi autosar_swc_hmi_rtARID_DEF.is_active_c112_autosar_swc_hmi autosar_swc_hmi_rtARID_DEF.is_active_c117_autosar_swc_hmi autosar_swc_hmi_rtARID_DEF.is_active_c118_autosar_swc_hmi autosar_swc_hmi_rtARID_DEF.is_active_c120_autosar_swc_hmi autosar_swc_hmi_rtARID_DEF.is_active_c121_autosar_swc_hmi autosar_swc_hmi_rtARID_DEF.is_c103_autosar_swc_hmi autosar_swc_hmi_rtARID_DEF.is_c104_autosar_swc_hmi autosar_swc_hmi_rtARID_DEF.is_c105_autosar_swc_hmi autosar_swc_hmi_rtARID_DEF.is_c106_autosar_swc_hmi autosar_swc_hmi_rtARID_DEF.is_c108_autosar_swc_hmi autosar_swc_hmi_rtARID_DEF.is_c112_autosar_swc_hmi autosar_swc_hmi_rtARID_DEF.is_c117_autosar_swc_hmi autosar_swc_hmi_rtARID_DEF.is_c118_autosar_swc_hmi autosar_swc_hmi_rtARID_DEF.is_c120_autosar_swc_hmi autosar_swc_hmi_rtARID_DEF.is_c121_autosar_swc_hmi autosar_swc_hmi_rtARID_DEF.text_current autosar_swc_hmi_rtARID_DEF.text_current_b autosar_swc_hmi_rtARID_DEF.text_current_c autosar_swc_hmi_rtARID_DEF.text_current_d autosar_swc_hmi_rtARID_DEF.text_current_e autosar_swc_hmi_rtARID_DEF.text_current_g autosar_swc_hmi_rtARID_DEF.text_current_l autosar_swc_hmi_rtARID_DEF.text_in_temp autosar_swc_hmi_rtARID_DEF.text_in_temp_c autosar_swc_hmi_rtARID_DEF.text_in_temp_d autosar_swc_hmi_rtARID_DEF.text_in_temp_e autosar_swc_hmi_rtARID_DEF.text_in_temp_g autosar_swc_hmi_rtARID_DEF.text_in_temp_o autosar_swc_hmi_rtARID_DEF.text_in_temp_p autosar_swc_hmi_rtARID_DEF.text_out autosar_swc_hmi_rtARID_DEF.text_out_a autosar_swc_hmi_rtARID_DEF.text_out_af autosar_swc_hmi_rtARID_DEF.text_out_b autosar_swc_hmi_rtARID_DEF.text_out_h autosar_swc_hmi_rtARID_DEF.text_out_i autosar_swc_hmi_rtARID_DEF.text_out_m autosar_swc_hmi_rtARID_DEF.time autosar_swc_hmi_rtARID_DEF.time_a autosar_swc_hmi_rtARID_DEF.time_b autosar_swc_hmi_rtARID_DEF.time_c autosar_swc_hmi_rtARID_DEF.time_g autosar_swc_hmi_rtARID_DEF.time_h autosar_swc_hmi_rtARID_DEF.time_k autosar_swc_hmi_rtARID_DEF.time_kc autosar_swc_hmi_rtARID_DEF.time_kh /end REF_MEASUREMENT
/end GROUP
/begin GROUP autosar_swc_hmi_autosar_swc_hmi_Step_sys_GENERAL_INFO_work_Detect_Change1 "autosar_swc_hmi/autosar_swc_hmi_Step_sys/GENERAL_INFO_work/Detect\nChange1" /begin REF_MEASUREMENT autosar_swc_hmi_rtARID_DEF.DelayInput1_DSTATE /end REF_MEASUREMENT /end GROUP
/begin GROUP autosar_swc_hmi_autosar_swc_hmi_Step_sys_GENERAL_INFO_work_Detect_Change2 "autosar_swc_hmi/autosar_swc_hmi_Step_sys/GENERAL_INFO_work/Detect\nChange2" /begin REF_MEASUREMENT autosar_swc_hmi_rtARID_DEF.DelayInput1_DSTATE_d /end REF_MEASUREMENT /end GROUP
/begin GROUP autosar_swc_hmi_autosar_swc_hmi_Step_sys_GENERAL_INFO_work_Detect_Change3 "autosar_swc_hmi/autosar_swc_hmi_Step_sys/GENERAL_INFO_work/Detect\nChange3" /begin REF_MEASUREMENT autosar_swc_hmi_rtARID_DEF.DelayInput1_DSTATE_hz /end REF_MEASUREMENT /end GROUP
/begin GROUP autosar_swc_hmi_autosar_swc_hmi_Step_sys_GENERAL_INFO_work_Detect_Change6 "autosar_swc_hmi/autosar_swc_hmi_Step_sys/GENERAL_INFO_work/Detect\nChange6" /begin REF_MEASUREMENT autosar_swc_hmi_rtARID_DEF.DelayInput1_DSTATE_h /end REF_MEASUREMENT /end GROUP
/begin GROUP autosar_swc_hmi_autosar_swc_hmi_Step_sys_GENERAL_INFO_work_Detect_Change7 "autosar_swc_hmi/autosar_swc_hmi_Step_sys/GENERAL_INFO_work/Detect\nChange7" /begin REF_MEASUREMENT autosar_swc_hmi_rtARID_DEF.DelayInput1_DSTATE_n /end REF_MEASUREMENT /end GROUP
/begin GROUP autosar_swc_hmi_autosar_swc_hmi_Step_sys_HMI_OBJECT_work "autosar_swc_hmi/autosar_swc_hmi_Step_sys/HMI_OBJECT_work"
 /begin SUB_GROUP autosar_swc_hmi_autosar_swc_hmi_Step_sys_HMI_OBJECT_work_Subsystem autosar_swc_hmi_autosar_swc_hmi_Step_sys_HMI_OBJECT_work_Subsystem1 autosar_swc_hmi_autosar_swc_hmi_Step_sys_HMI_OBJECT_work_Subsystem2 autosar_swc_hmi_autosar_swc_hmi_Step_sys_HMI_OBJECT_work_Subsystem3 autosar_swc_hmi_autosar_swc_hmi_Step_sys_HMI_OBJECT_work_Subsystem4 autosar_swc_hmi_autosar_swc_hmi_Step_sys_HMI_OBJECT_work_Subsystem5 autosar_swc_hmi_autosar_swc_hmi_Step_sys_HMI_OBJECT_work_Subsystem6 /end SUB_GROUP
 /begin REF_CHARACTERISTIC P_HMI_ConeConfidence P_HMI_condistance_X P_HMI_condistance_Y /end REF_CHARACTERISTIC
/end GROUP
/begin GROUP autosar_swc_hmi_autosar_swc_hmi_Step_sys_HMI_OBJECT_work_Subsystem "autosar_swc_hmi/autosar_swc_hmi_Step_sys/HMI_OBJECT_work/Subsystem"
 /begin REF_MEASUREMENT autosar_swc_hmi_rtARID_DEF.UnitDelay3_DSTATE autosar_swc_hmi_rtARID_DEF.UnitDelay4_DSTATE autosar_swc_hmi_rtARID_DEF.UnitDelay5_DSTATE autosar_swc_hmi_rtARID_DEF.UnitDelay6_DSTATE autosar_swc_hmi_rtARID_DEF.UnitDelay7_DSTATE /end REF_MEASUREMENT
/end GROUP
/begin GROUP autosar_swc_hmi_autosar_swc_hmi_Step_sys_HMI_OBJECT_work_Subsystem1 "autosar_swc_hmi/autosar_swc_hmi_Step_sys/HMI_OBJECT_work/Subsystem1"
 /begin REF_MEASUREMENT autosar_swc_hmi_rtARID_DEF.UnitDelay3_DSTATE_m autosar_swc_hmi_rtARID_DEF.UnitDelay4_DSTATE_e autosar_swc_hmi_rtARID_DEF.UnitDelay5_DSTATE_g autosar_swc_hmi_rtARID_DEF.UnitDelay6_DSTATE_c autosar_swc_hmi_rtARID_DEF.UnitDelay7_DSTATE_e /end REF_MEASUREMENT
/end GROUP
/begin GROUP autosar_swc_hmi_autosar_swc_hmi_Step_sys_HMI_OBJECT_work_Subsystem2 "autosar_swc_hmi/autosar_swc_hmi_Step_sys/HMI_OBJECT_work/Subsystem2"
 /begin REF_MEASUREMENT autosar_swc_hmi_rtARID_DEF.UnitDelay3_DSTATE_a autosar_swc_hmi_rtARID_DEF.UnitDelay4_DSTATE_i autosar_swc_hmi_rtARID_DEF.UnitDelay5_DSTATE_e autosar_swc_hmi_rtARID_DEF.UnitDelay6_DSTATE_m autosar_swc_hmi_rtARID_DEF.UnitDelay7_DSTATE_d /end REF_MEASUREMENT
/end GROUP
/begin GROUP autosar_swc_hmi_autosar_swc_hmi_Step_sys_HMI_OBJECT_work_Subsystem3 "autosar_swc_hmi/autosar_swc_hmi_Step_sys/HMI_OBJECT_work/Subsystem3"
 /begin REF_MEASUREMENT autosar_swc_hmi_rtARID_DEF.UnitDelay3_DSTATE_i autosar_swc_hmi_rtARID_DEF.UnitDelay4_DSTATE_o autosar_swc_hmi_rtARID_DEF.UnitDelay5_DSTATE_ga autosar_swc_hmi_rtARID_DEF.UnitDelay6_DSTATE_h autosar_swc_hmi_rtARID_DEF.UnitDelay7_DSTATE_h /end REF_MEASUREMENT
/end GROUP
/begin GROUP autosar_swc_hmi_autosar_swc_hmi_Step_sys_HMI_OBJECT_work_Subsystem4 "autosar_swc_hmi/autosar_swc_hmi_Step_sys/HMI_OBJECT_work/Subsystem4"
 /begin REF_MEASUREMENT autosar_swc_hmi_rtARID_DEF.UnitDelay3_DSTATE_e autosar_swc_hmi_rtARID_DEF.UnitDelay4_DSTATE_k autosar_swc_hmi_rtARID_DEF.UnitDelay5_DSTATE_m autosar_swc_hmi_rtARID_DEF.UnitDelay6_DSTATE_k autosar_swc_hmi_rtARID_DEF.UnitDelay7_DSTATE_a /end REF_MEASUREMENT
/end GROUP
/begin GROUP autosar_swc_hmi_autosar_swc_hmi_Step_sys_HMI_OBJECT_work_Subsystem5 "autosar_swc_hmi/autosar_swc_hmi_Step_sys/HMI_OBJECT_work/Subsystem5"
 /begin REF_MEASUREMENT autosar_swc_hmi_rtARID_DEF.UnitDelay3_DSTATE_h autosar_swc_hmi_rtARID_DEF.UnitDelay4_DSTATE_if autosar_swc_hmi_rtARID_DEF.UnitDelay5_DSTATE_i autosar_swc_hmi_rtARID_DEF.UnitDelay6_DSTATE_i autosar_swc_hmi_rtARID_DEF.UnitDelay7_DSTATE_j /end REF_MEASUREMENT
/end GROUP
/begin GROUP autosar_swc_hmi_autosar_swc_hmi_Step_sys_HMI_OBJECT_work_Subsystem6 "autosar_swc_hmi/autosar_swc_hmi_Step_sys/HMI_OBJECT_work/Subsystem6"
 /begin REF_MEASUREMENT autosar_swc_hmi_rtARID_DEF.UnitDelay3_DSTATE_d autosar_swc_hmi_rtARID_DEF.UnitDelay4_DSTATE_ia autosar_swc_hmi_rtARID_DEF.UnitDelay5_DSTATE_l autosar_swc_hmi_rtARID_DEF.UnitDelay6_DSTATE_g autosar_swc_hmi_rtARID_DEF.UnitDelay7_DSTATE_p /end REF_MEASUREMENT
/end GROUP
/begin CHARACTERISTIC P_ACC_AccelThreshholdIn "" VALUE 0xfe820e40 /* @ECU_Address@P_ACC_AccelThreshholdIn@ */ Record_FLOAT32_IEEE 0 autosar_swc_icas_CM_single -3.4E+38 3.4E+38 /end CHARACTERISTIC
/begin CHARACTERISTIC P_ACC_AccelThreshholdOut "" VALUE 0xfe820e44 /* @ECU_Address@P_ACC_AccelThreshholdOut@ */ Record_FLOAT32_IEEE 0 autosar_swc_icas_CM_single -3.4E+38 3.4E+38 /end CHARACTERISTIC
/begin CHARACTERISTIC P_ACC_CurvSpdLimOffsetIn "" VALUE 0xfe820e54 /* @ECU_Address@P_ACC_CurvSpdLimOffsetIn@ */ Record_FLOAT32_IEEE 0 autosar_swc_icas_CM_single -3.4E+38 3.4E+38 /end CHARACTERISTIC
/begin CHARACTERISTIC P_ACC_DriverBrakeIn "" VALUE 0xfe820e5c /* @ECU_Address@P_ACC_DriverBrakeIn@ */ Record_FLOAT32_IEEE 0 autosar_swc_icas_CM_single -3.4E+38 3.4E+38 /end CHARACTERISTIC
/begin CHARACTERISTIC P_ACC_P0Range "" VALUE 0xfe820e6c /* @ECU_Address@P_ACC_P0Range@ */ Record_FLOAT32_IEEE 0 autosar_swc_icas_CM_single -3.4E+38 3.4E+38 /end CHARACTERISTIC
/begin CHARACTERISTIC P_CRUISE_ACC_FastExitFuncStatus "" VALUE 0xfe820f0d /* @ECU_Address@P_CRUISE_ACC_FastExitFuncStatus@ */ Record_BOOLEAN 0 autosar_swc_icas_CM_boolean 0 1 /end CHARACTERISTIC
/begin CHARACTERISTIC P_CSM_NOAOffRampMiniDisVal "" VALUE 0xfe820efa /* @ECU_Address@P_CSM_NOAOffRampMiniDisVal@ */ Record_UWORD 0 autosar_swc_icas_CM_uint16 0 65535 /end CHARACTERISTIC
/begin CHARACTERISTIC P_CSM_NOASPLSpdLimY "" CURVE 0xfe820ff4 /* @ECU_Address@P_CSM_NOASPLSpdLimY@ */ Record_UBYTE 0 autosar_swc_icas_CM_uint8 0 255
 /begin AXIS_DESCR COM_AXIS CSM_ISL_NOA_Distance2SplitAfterLim autosar_swc_icas_CM_uint16 10 0 65535 AXIS_PTS_REF P_CSM_NOASPLSpdLimX /end AXIS_DESCR
/end CHARACTERISTIC
/begin CHARACTERISTIC P_CSM_ORDSpdLimValue "" VALUE 0xfe820f0e /* @ECU_Address@P_CSM_ORDSpdLimValue@ */ Record_UBYTE 0 autosar_swc_icas_CM_uint8 0 255 /end CHARACTERISTIC
/begin CHARACTERISTIC P_CSM_SLAWarningTimeLim "" VALUE 0xfe820efc /* @ECU_Address@P_CSM_SLAWarningTimeLim@ */ Record_UWORD 0 autosar_swc_icas_CM_uint16 0 65535 /end CHARACTERISTIC
/begin CHARACTERISTIC P_CSM_SpeedingWarningHighDis "" VALUE 0xfe820efe /* @ECU_Address@P_CSM_SpeedingWarningHighDis@ */ Record_UWORD 0 autosar_swc_icas_CM_uint16 0 65535 /end CHARACTERISTIC
/begin CHARACTERISTIC P_CSM_SpeedingWarningLowDis "" VALUE 0xfe820f00 /* @ECU_Address@P_CSM_SpeedingWarningLowDis@ */ Record_UWORD 0 autosar_swc_icas_CM_uint16 0 65535 /end CHARACTERISTIC
/begin CHARACTERISTIC P_CSM_SpeedingWarningMidDis "" VALUE 0xfe820f02 /* @ECU_Address@P_CSM_SpeedingWarningMidDis@ */ Record_UWORD 0 autosar_swc_icas_CM_uint16 0 65535 /end CHARACTERISTIC
/begin CHARACTERISTIC P_CSM_SpeedingWarningRevertDis "" VALUE 0xfe820f04 /* @ECU_Address@P_CSM_SpeedingWarningRevertDis@ */ Record_UWORD 0 autosar_swc_icas_CM_uint16 0 65535 /end CHARACTERISTIC
/begin CHARACTERISTIC P_CSM_SpeedingWarningTime "" VALUE 0xfe820f0f /* @ECU_Address@P_CSM_SpeedingWarningTime@ */ Record_UBYTE 0 autosar_swc_icas_CM_uint8 0 255 /end CHARACTERISTIC
/begin CHARACTERISTIC P_CSM_TSRForbiddenDisplayMinTime "" VALUE 0xfe820f10 /* @ECU_Address@P_CSM_TSRForbiddenDisplayMinTime@ */ Record_UBYTE 0 autosar_swc_icas_CM_uint8 0 255 /end CHARACTERISTIC
/begin CHARACTERISTIC P_CSM_TSRGiveWayDisplayMinTime "" VALUE 0xfe820f11 /* @ECU_Address@P_CSM_TSRGiveWayDisplayMinTime@ */ Record_UBYTE 0 autosar_swc_icas_CM_uint8 0 255 /end CHARACTERISTIC
/begin CHARACTERISTIC P_CSM_TSRInhibitYawRate "" VALUE 0xfe820e8c /* @ECU_Address@P_CSM_TSRInhibitYawRate@ */ Record_FLOAT32_IEEE 0 autosar_swc_icas_CM_single -3.4E+38 3.4E+38 /end CHARACTERISTIC
/begin CHARACTERISTIC P_CSM_TSRLongTimeDisplayMinTime "" VALUE 0xfe820f12 /* @ECU_Address@P_CSM_TSRLongTimeDisplayMinTime@ */ Record_UBYTE 0 autosar_swc_icas_CM_uint8 0 255 /end CHARACTERISTIC
/begin CHARACTERISTIC P_CSM_TSRNoStopBeepWaitingTime "" VALUE 0xfe820e90 /* @ECU_Address@P_CSM_TSRNoStopBeepWaitingTime@ */ Record_FLOAT32_IEEE 0 autosar_swc_icas_CM_single -3.4E+38 3.4E+38 /end CHARACTERISTIC
/begin CHARACTERISTIC P_CSM_TSRRecoveryYawRate "" VALUE 0xfe820e94 /* @ECU_Address@P_CSM_TSRRecoveryYawRate@ */ Record_FLOAT32_IEEE 0 autosar_swc_icas_CM_single -3.4E+38 3.4E+38 /end CHARACTERISTIC
/begin CHARACTERISTIC P_CSM_TSRYawRateInhibitTime "" VALUE 0xfe820f06 /* @ECU_Address@P_CSM_TSRYawRateInhibitTime@ */ Record_UWORD 0 autosar_swc_icas_CM_uint16 0 65535 /end CHARACTERISTIC
/begin CHARACTERISTIC P_ICAS_ACCCurveSpdLimSwitch "" VALUE 0xfe820f13 /* @ECU_Address@P_ICAS_ACCCurveSpdLimSwitch@ */ Record_BOOLEAN 0 autosar_swc_icas_CM_boolean 0 1 /end CHARACTERISTIC
/begin CHARACTERISTIC P_ICAS_ACCDoors "" VALUE 0xfe820f14 /* @ECU_Address@P_ICAS_ACCDoors@ */ Record_BOOLEAN 0 autosar_swc_icas_CM_boolean 0 1 /end CHARACTERISTIC
/begin CHARACTERISTIC P_ICAS_ACCDriverBrake "" VALUE 0xfe820f15 /* @ECU_Address@P_ICAS_ACCDriverBrake@ */ Record_BOOLEAN 0 autosar_swc_icas_CM_boolean 0 1 /end CHARACTERISTIC
/begin CHARACTERISTIC P_ICAS_ACCInhibitTTC "" VALUE 0xfe820e98 /* @ECU_Address@P_ICAS_ACCInhibitTTC@ */ Record_FLOAT32_IEEE 0 autosar_swc_icas_CM_single -3.4E+38 3.4E+38 /end CHARACTERISTIC
/begin CHARACTERISTIC P_ICAS_ACCInhibitTimeGapRatio "" VALUE 0xfe820e9c /* @ECU_Address@P_ICAS_ACCInhibitTimeGapRatio@ */ Record_FLOAT32_IEEE 0 autosar_swc_icas_CM_single -3.4E+38 3.4E+38 /end CHARACTERISTIC
/begin CHARACTERISTIC P_ICAS_ACCP0Lost "" VALUE 0xfe820f16 /* @ECU_Address@P_ICAS_ACCP0Lost@ */ Record_BOOLEAN 0 autosar_swc_icas_CM_boolean 0 1 /end CHARACTERISTIC
/begin CHARACTERISTIC P_ICAS_ACCP0VxThreshold "" VALUE 0xfe820ea4 /* @ECU_Address@P_ICAS_ACCP0VxThreshold@ */ Record_FLOAT32_IEEE 0 autosar_swc_icas_CM_single -3.4E+38 3.4E+38 /end CHARACTERISTIC
/begin CHARACTERISTIC P_ICAS_ACCSeatBelt "" VALUE 0xfe820f17 /* @ECU_Address@P_ICAS_ACCSeatBelt@ */ Record_BOOLEAN 0 autosar_swc_icas_CM_boolean 0 1 /end CHARACTERISTIC
/begin CHARACTERISTIC P_ICAS_DFIMSwitch "" VALUE 0xfe820f1c /* @ECU_Address@P_ICAS_DFIMSwitch@ */ Record_BOOLEAN 0 autosar_swc_icas_CM_boolean 0 1 /end CHARACTERISTIC
/begin MEASUREMENT CSC_ISL_InfoDispHMI "" UBYTE autosar_swc_icas_CM_uint8 0 0 0 255 ECU_ADDRESS 0xfe4adaf6 /* @ECU_Address@CSC_ISL_InfoDispHMI@ */ /end MEASUREMENT
/begin MEASUREMENT CSM_AutoAdjSetSpdSts_st "" UBYTE autosar_swc_icas_CM_uint8 0 0 0 255 ECU_ADDRESS 0xfe4adaf7 /* @ECU_Address@CSM_AutoAdjSetSpdSts_st@ */ /end MEASUREMENT
/begin MEASUREMENT CSM_AutoAdjSetSpdVal "" UBYTE autosar_swc_icas_CM_uint8 0 0 0 255 MATRIX_DIM 1 1 ECU_ADDRESS 0xfe4adaf8 /* @ECU_Address@CSM_AutoAdjSetSpdVal@ */ /end MEASUREMENT
/begin MEASUREMENT CSM_ISL_ACCFailure_b "" UBYTE autosar_swc_icas_CM_boolean 0 0 0 1 ECU_ADDRESS 0xfe4adaf9 /* @ECU_Address@CSM_ISL_ACCFailure_b@ */ /end MEASUREMENT
/begin MEASUREMENT CSM_ISL_APSpdLimDistReq_m "" UBYTE autosar_swc_icas_CM_uint8 0 0 0 255 ECU_ADDRESS 0xfe4adafa /* @ECU_Address@CSM_ISL_APSpdLimDistReq_m@ */ /end MEASUREMENT
/begin MEASUREMENT CSM_ISL_APSpdLimSPLReq_kph "" UBYTE autosar_swc_icas_CM_uint8 0 0 0 255 ECU_ADDRESS 0xfe4adafb /* @ECU_Address@CSM_ISL_APSpdLimSPLReq_kph@ */ /end MEASUREMENT
/begin MEASUREMENT CSM_ISL_CurSetSpd_kph "" UBYTE autosar_swc_icas_CM_uint8 0 0 0 255 ECU_ADDRESS 0xfe4adafc /* @ECU_Address@CSM_ISL_CurSetSpd_kph@ */ /end MEASUREMENT
/begin MEASUREMENT CSM_ISL_InfoDispHMI_st "" UBYTE autosar_swc_icas_CM_uint8 0 0 0 255 ECU_ADDRESS 0xfe4adafd /* @ECU_Address@CSM_ISL_InfoDispHMI_st@ */ /end MEASUREMENT
/begin MEASUREMENT CSM_ISL_MRC_SPL_kph "" UBYTE autosar_swc_icas_CM_uint8 0 0 0 255 ECU_ADDRESS 0xfe4adafe /* @ECU_Address@CSM_ISL_MRC_SPL_kph@ */ /end MEASUREMENT
/begin MEASUREMENT CSM_ISL_NOA_Distance2SplitAfterLim "" UWORD autosar_swc_icas_CM_uint16 0 0 0 65535 ECU_ADDRESS 0xfe4adadc /* @ECU_Address@CSM_ISL_NOA_Distance2SplitAfterLim@ */ /end MEASUREMENT
/begin MEASUREMENT CSM_ISL_NOA_SPL_OFFRampStart "" UBYTE autosar_swc_icas_CM_boolean 0 0 0 1 MATRIX_DIM 1 1 ECU_ADDRESS 0xfe4adaff /* @ECU_Address@CSM_ISL_NOA_SPL_OFFRampStart@ */ /end MEASUREMENT
/begin MEASUREMENT CSM_ISL_NOA_SPL_UpLim "" UBYTE autosar_swc_icas_CM_uint8 0 0 0 255 ECU_ADDRESS 0xfe4adb00 /* @ECU_Address@CSM_ISL_NOA_SPL_UpLim@ */ /end MEASUREMENT
/begin MEASUREMENT CSM_ISL_NOA_SPL_kph "" UBYTE autosar_swc_icas_CM_uint8 0 0 0 255 ECU_ADDRESS 0xfe4adb01 /* @ECU_Address@CSM_ISL_NOA_SPL_kph@ */ /end MEASUREMENT
/begin MEASUREMENT CSM_ISL_NOA_SPL_kph_noLim "" UBYTE autosar_swc_icas_CM_uint8 0 0 0 255 ECU_ADDRESS 0xfe4adb02 /* @ECU_Address@CSM_ISL_NOA_SPL_kph_noLim@ */ /end MEASUREMENT
/begin MEASUREMENT CSM_ISL_NOA_Spd_C0_Flag "" UBYTE autosar_swc_icas_CM_boolean 0 0 0 1 ECU_ADDRESS 0xfe4adb03 /* @ECU_Address@CSM_ISL_NOA_Spd_C0_Flag@ */ /end MEASUREMENT
/begin MEASUREMENT CSM_ISL_NOA_Spd_Quality_Flag "" UBYTE autosar_swc_icas_CM_boolean 0 0 0 1 ECU_ADDRESS 0xfe4adb04 /* @ECU_Address@CSM_ISL_NOA_Spd_Quality_Flag@ */ /end MEASUREMENT
/begin MEASUREMENT CSM_ISL_NOA_Spd_SetSpd_Flag "" UBYTE autosar_swc_icas_CM_boolean 0 0 0 1 ECU_ADDRESS 0xfe4adb05 /* @ECU_Address@CSM_ISL_NOA_Spd_SetSpd_Flag@ */ /end MEASUREMENT
/begin MEASUREMENT CSM_ISL_NOA_Spd_Split_Flag "" UBYTE autosar_swc_icas_CM_boolean 0 0 0 1 ECU_ADDRESS 0xfe4adb06 /* @ECU_Address@CSM_ISL_NOA_Spd_Split_Flag@ */ /end MEASUREMENT
/begin MEASUREMENT CSM_ISL_NOA_Spd_TJA_Flag "" UBYTE autosar_swc_icas_CM_boolean 0 0 0 1 ECU_ADDRESS 0xfe4adb07 /* @ECU_Address@CSM_ISL_NOA_Spd_TJA_Flag@ */ /end MEASUREMENT
/begin MEASUREMENT CSM_ISL_NOH_RainMode_SPL "" UBYTE autosar_swc_icas_CM_uint8 0 0 0 255 ECU_ADDRESS 0xfe4adb08 /* @ECU_Address@CSM_ISL_NOH_RainMode_SPL@ */ /end MEASUREMENT
/begin MEASUREMENT CSM_ISL_NavDecResp_b "" UBYTE autosar_swc_icas_CM_boolean 0 0 0 1 ECU_ADDRESS 0xfe4adb09 /* @ECU_Address@CSM_ISL_NavDecResp_b@ */ /end MEASUREMENT
/begin MEASUREMENT CSM_ISL_NavHiLim_kph "" UBYTE autosar_swc_icas_CM_uint8 0 0 0 255 ECU_ADDRESS 0xfe4adb0a /* @ECU_Address@CSM_ISL_NavHiLim_kph@ */ /end MEASUREMENT
/begin MEASUREMENT CSM_ISL_RainModeState "" UBYTE autosar_swc_icas_CM_uint8 0 0 0 255 ECU_ADDRESS 0xfe4adb0b /* @ECU_Address@CSM_ISL_RainModeState@ */ /end MEASUREMENT
/begin MEASUREMENT CSM_ISL_ReqExitReason_st "" UBYTE autosar_swc_icas_CM_uint8 0 0 0 255 ECU_ADDRESS 0xfe4adb0c /* @ECU_Address@CSM_ISL_ReqExitReason_st@ */ /end MEASUREMENT
/begin MEASUREMENT CSM_ISL_Resp_b "" UBYTE autosar_swc_icas_CM_boolean 0 0 0 1 ECU_ADDRESS 0xfe4adb0d /* @ECU_Address@CSM_ISL_Resp_b@ */ /end MEASUREMENT
/begin MEASUREMENT CSM_ISL_SetSpdAdjReq_b "" UBYTE autosar_swc_icas_CM_boolean 0 0 0 1 ECU_ADDRESS 0xfe4adb0e /* @ECU_Address@CSM_ISL_SetSpdAdjReq_b@ */ /end MEASUREMENT
/begin MEASUREMENT CSM_ISL_SetSpdAdjTyp_st "" UBYTE autosar_swc_icas_CM_uint8 0 0 0 255 ECU_ADDRESS 0xfe4adb0f /* @ECU_Address@CSM_ISL_SetSpdAdjTyp_st@ */ /end MEASUREMENT
/begin MEASUREMENT CSM_ISL_SetSpdAdjVal_kph "" UBYTE autosar_swc_icas_CM_uint8 0 0 0 255 ECU_ADDRESS 0xfe4adb10 /* @ECU_Address@CSM_ISL_SetSpdAdjVal_kph@ */ /end MEASUREMENT
/begin MEASUREMENT CSM_ISL_Sts_st "" UBYTE autosar_swc_icas_CM_uint8 0 0 0 255 MATRIX_DIM 1 1 ECU_ADDRESS 0xfe4adb11 /* @ECU_Address@CSM_ISL_Sts_st@ */ /end MEASUREMENT
/begin MEASUREMENT CSM_ISL_funMod_Hdmap_b "" UBYTE autosar_swc_icas_CM_boolean 0 0 0 1 ECU_ADDRESS 0xfe4adb12 /* @ECU_Address@CSM_ISL_funMod_Hdmap_b@ */ /end MEASUREMENT
/begin MEASUREMENT CSM_ISL_funMod_Nav_b "" UBYTE autosar_swc_icas_CM_boolean 0 0 0 1 ECU_ADDRESS 0xfe4adb13 /* @ECU_Address@CSM_ISL_funMod_Nav_b@ */ /end MEASUREMENT
/begin MEASUREMENT CSM_ISL_funMod_Noh_b "" UBYTE autosar_swc_icas_CM_boolean 0 0 0 1 ECU_ADDRESS 0xfe4adb14 /* @ECU_Address@CSM_ISL_funMod_Noh_b@ */ /end MEASUREMENT
/begin MEASUREMENT CSM_ISL_funMod_Rain_b "" UBYTE autosar_swc_icas_CM_boolean 0 0 0 1 ECU_ADDRESS 0xfe4adb15 /* @ECU_Address@CSM_ISL_funMod_Rain_b@ */ /end MEASUREMENT
/begin MEASUREMENT CSM_ISL_funMod_iACCSwt_b "" UBYTE autosar_swc_icas_CM_boolean 0 0 0 1 ECU_ADDRESS 0xfe4adb16 /* @ECU_Address@CSM_ISL_funMod_iACCSwt_b@ */ /end MEASUREMENT
/begin MEASUREMENT CSM_ISL_funMod_iACC_b "" UBYTE autosar_swc_icas_CM_boolean 0 0 0 1 ECU_ADDRESS 0xfe4adb17 /* @ECU_Address@CSM_ISL_funMod_iACC_b@ */ /end MEASUREMENT
/begin MEASUREMENT CSM_ISL_iACCReqConfirm "" UBYTE autosar_swc_icas_CM_boolean 0 0 0 1 ECU_ADDRESS 0xfe4adb18 /* @ECU_Address@CSM_ISL_iACCReqConfirm@ */ /end MEASUREMENT
/begin MEASUREMENT CSM_ISL_iACCSpdChck "" UBYTE autosar_swc_icas_CM_boolean 0 0 0 1 ECU_ADDRESS 0xfe4adb19 /* @ECU_Address@CSM_ISL_iACCSpdChck@ */ /end MEASUREMENT
/begin MEASUREMENT CSM_ISL_iAccHiLim_kph "" UBYTE autosar_swc_icas_CM_uint8 0 0 0 255 ECU_ADDRESS 0xfe4adb1a /* @ECU_Address@CSM_ISL_iAccHiLim_kph@ */ /end MEASUREMENT
/begin MEASUREMENT CSM_ISL_iAccLoLim_kph "" UBYTE autosar_swc_icas_CM_uint8 0 0 0 255 ECU_ADDRESS 0xfe4adb1b /* @ECU_Address@CSM_ISL_iAccLoLim_kph@ */ /end MEASUREMENT
/begin MEASUREMENT CSM_ISL_nohHiLim_kph "" UBYTE autosar_swc_icas_CM_uint8 0 0 0 255 ECU_ADDRESS 0xfe4adb1c /* @ECU_Address@CSM_ISL_nohHiLim_kph@ */ /end MEASUREMENT
/begin MEASUREMENT CSM_ISL_nohLoLim_kph "" UBYTE autosar_swc_icas_CM_uint8 0 0 0 255 ECU_ADDRESS 0xfe4adb1d /* @ECU_Address@CSM_ISL_nohLoLim_kph@ */ /end MEASUREMENT
/begin MEASUREMENT CSM_ISL_nohLoLim_kph_in "" UBYTE autosar_swc_icas_CM_uint8 0 0 0 255 ECU_ADDRESS 0xfe4adb1e /* @ECU_Address@CSM_ISL_nohLoLim_kph_in@ */ /end MEASUREMENT
/begin MEASUREMENT CSM_ManualAdjSetBelow "" UBYTE autosar_swc_icas_CM_uint8 0 0 0 255 ECU_ADDRESS 0xfe4adb1f /* @ECU_Address@CSM_ManualAdjSetBelow@ */ /end MEASUREMENT
/begin MEASUREMENT CSM_ManualAdjSetVal "" UBYTE autosar_swc_icas_CM_uint8 0 0 0 255 ECU_ADDRESS 0xfe4adb20 /* @ECU_Address@CSM_ManualAdjSetVal@ */ /end MEASUREMENT
/begin MEASUREMENT CSM_ManualSetConsSendVal "" UBYTE autosar_swc_icas_CM_uint8 0 0 0 255 ECU_ADDRESS 0xfe4adb21 /* @ECU_Address@CSM_ManualSetConsSendVal@ */ /end MEASUREMENT
/begin MEASUREMENT CSM_ManualSetSpdSts_st "" UBYTE autosar_swc_icas_CM_uint8 0 0 0 255 MATRIX_DIM 1 1 ECU_ADDRESS 0xfe4adb22 /* @ECU_Address@CSM_ManualSetSpdSts_st@ */ /end MEASUREMENT
/begin MEASUREMENT CSM_MergeAccelerateReq "" UBYTE autosar_swc_icas_CM_boolean 0 0 0 1 ECU_ADDRESS 0xfe4adb23 /* @ECU_Address@CSM_MergeAccelerateReq@ */ /end MEASUREMENT
/begin MEASUREMENT CSM_MergeRequest_AfterRelay "" UBYTE autosar_swc_icas_CM_boolean 0 0 0 1 ECU_ADDRESS 0xfe4adb24 /* @ECU_Address@CSM_MergeRequest_AfterRelay@ */ /end MEASUREMENT
/begin MEASUREMENT CSM_MergeRequest_Oringe "" UBYTE autosar_swc_icas_CM_boolean 0 0 0 1 ECU_ADDRESS 0xfe4adb25 /* @ECU_Address@CSM_MergeRequest_Oringe@ */ /end MEASUREMENT
/begin MEASUREMENT CSM_NOAOutflag "" UBYTE autosar_swc_icas_CM_boolean 0 0 0 1 ECU_ADDRESS 0xfe4adb26 /* @ECU_Address@CSM_NOAOutflag@ */ /end MEASUREMENT
/begin MEASUREMENT CSM_NOAReActInHW "" UBYTE autosar_swc_icas_CM_boolean 0 0 0 1 ECU_ADDRESS 0xfe4adb27 /* @ECU_Address@CSM_NOAReActInHW@ */ /end MEASUREMENT
/begin MEASUREMENT CSM_OffRampDisReq "" FLOAT32_IEEE autosar_swc_icas_CM_single 0 0 -3.4E+38 3.4E+38 MATRIX_DIM 1 1 ECU_ADDRESS 0xfe4ada70 /* @ECU_Address@CSM_OffRampDisReq@ */ /end MEASUREMENT
/begin MEASUREMENT CSM_OffRampSpdReq "" UBYTE autosar_swc_icas_CM_uint8 0 0 0 255 MATRIX_DIM 1 1 ECU_ADDRESS 0xfe4adb28 /* @ECU_Address@CSM_OffRampSpdReq@ */ /end MEASUREMENT
/begin MEASUREMENT CSM_SLIF_LaneChange2 "" UBYTE autosar_swc_icas_CM_boolean 0 0 0 1 ECU_ADDRESS 0xfe4adb29 /* @ECU_Address@CSM_SLIF_LaneChange2@ */ /end MEASUREMENT
/begin MEASUREMENT CSM_SLIF_LaneChange_b "" UBYTE autosar_swc_icas_CM_boolean 0 0 0 1 ECU_ADDRESS 0xfe4adb2a /* @ECU_Address@CSM_SLIF_LaneChange_b@ */ /end MEASUREMENT
/begin MEASUREMENT CSM_SPLRawUpdateFlag "" UBYTE autosar_swc_icas_CM_boolean 0 0 0 1 ECU_ADDRESS 0xfe4adb2b /* @ECU_Address@CSM_SPLRawUpdateFlag@ */ /end MEASUREMENT
/begin MEASUREMENT CSM_SPL_End_b "" UBYTE autosar_swc_icas_CM_boolean 0 0 0 1 ECU_ADDRESS 0xfe4adb2c /* @ECU_Address@CSM_SPL_End_b@ */ /end MEASUREMENT
/begin MEASUREMENT CSM_SenarioUpdate "" UBYTE autosar_swc_icas_CM_boolean 0 0 0 1 ECU_ADDRESS 0xfe4adb2d /* @ECU_Address@CSM_SenarioUpdate@ */ /end MEASUREMENT
/begin MEASUREMENT CSM_SenarioUpdateAftDeb "" UBYTE autosar_swc_icas_CM_boolean 0 0 0 1 ECU_ADDRESS 0xfe4adb2e /* @ECU_Address@CSM_SenarioUpdateAftDeb@ */ /end MEASUREMENT
/begin MEASUREMENT CSM_SetSpdMsg_SetBelow "" UBYTE autosar_swc_icas_CM_uint8 0 0 0 255 ECU_ADDRESS 0xfe4adb2f /* @ECU_Address@CSM_SetSpdMsg_SetBelow@ */ /end MEASUREMENT
/begin MEASUREMENT CSM_SetSpdMsg_Sts "" UBYTE autosar_swc_icas_CM_uint8 0 0 0 255 ECU_ADDRESS 0xfe4adb30 /* @ECU_Address@CSM_SetSpdMsg_Sts@ */ /end MEASUREMENT
/begin MEASUREMENT CSM_SetSpdMsg_Type "" UBYTE autosar_swc_icas_CM_uint8 0 0 0 255 ECU_ADDRESS 0xfe4adb31 /* @ECU_Address@CSM_SetSpdMsg_Type@ */ /end MEASUREMENT
/begin MEASUREMENT CSM_SetSpdMsg_Val "" UBYTE autosar_swc_icas_CM_uint8 0 0 0 255 ECU_ADDRESS 0xfe4adb32 /* @ECU_Address@CSM_SetSpdMsg_Val@ */ /end MEASUREMENT
/begin MEASUREMENT CSM_Sign_SPL_kph "" UBYTE autosar_swc_icas_CM_uint8 0 0 0 255 ECU_ADDRESS 0xfe4adb33 /* @ECU_Address@CSM_Sign_SPL_kph@ */ /end MEASUREMENT
/begin MEASUREMENT CSM_Sign_Source_st "" UBYTE autosar_swc_icas_CM_uint8 0 0 0 255 ECU_ADDRESS 0xfe4adb34 /* @ECU_Address@CSM_Sign_Source_st@ */ /end MEASUREMENT
/begin MEASUREMENT CSM_SpdLimAfterDebounce "" UBYTE autosar_swc_icas_CM_uint8 0 0 0 255 ECU_ADDRESS 0xfe4adb35 /* @ECU_Address@CSM_SpdLimAfterDebounce@ */ /end MEASUREMENT
/begin MEASUREMENT CSM_TSRSpdLimCfdc_st "" UBYTE autosar_swc_icas_CM_uint8 0 0 0 255 ECU_ADDRESS 0xfe4adb36 /* @ECU_Address@CSM_TSRSpdLimCfdc_st@ */ /end MEASUREMENT
/begin MEASUREMENT CSM_TSRSpdLimSts_st "" UBYTE autosar_swc_icas_CM_uint8 0 0 0 255 ECU_ADDRESS 0xfe4adb37 /* @ECU_Address@CSM_TSRSpdLimSts_st@ */ /end MEASUREMENT
/begin MEASUREMENT CSM_TSRSpdLimWarn_b "" UBYTE autosar_swc_icas_CM_boolean 0 0 0 1 ECU_ADDRESS 0xfe4adb38 /* @ECU_Address@CSM_TSRSpdLimWarn_b@ */ /end MEASUREMENT
/begin MEASUREMENT CSM_TSRSpdLim_kph "" UBYTE autosar_swc_icas_CM_uint8 0 0 0 255 ECU_ADDRESS 0xfe4adb39 /* @ECU_Address@CSM_TSRSpdLim_kph@ */ /end MEASUREMENT
/begin MEASUREMENT CSM_TSRTrfcSignValCfdc_st "" UBYTE autosar_swc_icas_CM_uint8 0 0 0 255 ECU_ADDRESS 0xfe4adb3a /* @ECU_Address@CSM_TSRTrfcSignValCfdc_st@ */ /end MEASUREMENT
/begin MEASUREMENT CSM_TSRTrfcSignVal_st "" UBYTE autosar_swc_icas_CM_uint8 0 0 0 255 ECU_ADDRESS 0xfe4adb3b /* @ECU_Address@CSM_TSRTrfcSignVal_st@ */ /end MEASUREMENT
/begin MEASUREMENT CSM_TSR_J3SPLEND "" UBYTE autosar_swc_icas_CM_uint8 0 0 0 255 ECU_ADDRESS 0xfe4adb3c /* @ECU_Address@CSM_TSR_J3SPLEND@ */ /end MEASUREMENT
/begin MEASUREMENT CSM_TSR_J3SPLVAL "" UBYTE autosar_swc_icas_CM_uint8 0 0 0 255 MATRIX_DIM 1 1 ECU_ADDRESS 0xfe4adb3d /* @ECU_Address@CSM_TSR_J3SPLVAL@ */ /end MEASUREMENT
/begin MEASUREMENT CSM_TSR_SPL_Memry "" UBYTE autosar_swc_icas_CM_uint8 0 0 0 255 ECU_ADDRESS 0xfe4adb3e /* @ECU_Address@CSM_TSR_SPL_Memry@ */ /end MEASUREMENT
/begin MEASUREMENT CSM_TimeGapInit "" UBYTE autosar_swc_icas_CM_uint8 0 0 0 255 ECU_ADDRESS 0xfe4adb3f /* @ECU_Address@CSM_TimeGapInit@ */ /end MEASUREMENT
/begin MEASUREMENT CSM_TimeGapLevel "" UBYTE autosar_swc_icas_CM_uint8 0 0 0 255 ECU_ADDRESS 0xfe4adb40 /* @ECU_Address@CSM_TimeGapLevel@ */ /end MEASUREMENT
/begin MEASUREMENT CSM_User_DecSetSpd_L_b "" UBYTE autosar_swc_icas_CM_boolean 0 0 0 1 ECU_ADDRESS 0xfe4adb41 /* @ECU_Address@CSM_User_DecSetSpd_L_b@ */ /end MEASUREMENT
/begin MEASUREMENT CSM_User_DecSetSpd_S_b "" UBYTE autosar_swc_icas_CM_boolean 0 0 0 1 ECU_ADDRESS 0xfe4adb42 /* @ECU_Address@CSM_User_DecSetSpd_S_b@ */ /end MEASUREMENT
/begin MEASUREMENT CSM_User_IncSetSpd_L_b "" UBYTE autosar_swc_icas_CM_boolean 0 0 0 1 ECU_ADDRESS 0xfe4adb43 /* @ECU_Address@CSM_User_IncSetSpd_L_b@ */ /end MEASUREMENT
/begin MEASUREMENT CSM_User_IncSetSpd_S_b "" UBYTE autosar_swc_icas_CM_boolean 0 0 0 1 ECU_ADDRESS 0xfe4adb44 /* @ECU_Address@CSM_User_IncSetSpd_S_b@ */ /end MEASUREMENT
/begin MEASUREMENT CSM_Version "" ULONG autosar_swc_icas_CM_uint32 0 0 0 4294967295 ECU_ADDRESS 0xfe4ada74 /* @ECU_Address@CSM_Version@ */ /end MEASUREMENT
/begin MEASUREMENT ICAS_ACCActCondF "" UBYTE autosar_swc_icas_CM_boolean 0 0 0 1 MATRIX_DIM 1 1 ECU_ADDRESS 0xfe4adb45 /* @ECU_Address@ICAS_ACCActCondF@ */ /end MEASUREMENT
/begin MEASUREMENT ICAS_ACCActiveConEnable "" UBYTE autosar_swc_icas_CM_boolean 0 0 0 1 ECU_ADDRESS 0xfe4adb46 /* @ECU_Address@ICAS_ACCActiveConEnable@ */ /end MEASUREMENT
/begin MEASUREMENT ICAS_ACCFastExit "" UBYTE autosar_swc_icas_CM_boolean 0 0 0 1 ECU_ADDRESS 0xfe4adb47 /* @ECU_Address@ICAS_ACCFastExit@ */ /end MEASUREMENT
/begin MEASUREMENT ICAS_ACCFastExitCons_HoodOpen "" UBYTE autosar_swc_icas_CM_boolean 0 0 0 1 ECU_ADDRESS 0xfe4adb48 /* @ECU_Address@ICAS_ACCFastExitCons_HoodOpen@ */ /end MEASUREMENT
/begin MEASUREMENT ICAS_ACCFastExitCons_LRDoorOpen "" UBYTE autosar_swc_icas_CM_boolean 0 0 0 1 ECU_ADDRESS 0xfe4adb49 /* @ECU_Address@ICAS_ACCFastExitCons_LRDoorOpen@ */ /end MEASUREMENT
/begin MEASUREMENT ICAS_ACCFastExitCons_PassengerDoorOpen "" UBYTE autosar_swc_icas_CM_boolean 0 0 0 1 ECU_ADDRESS 0xfe4adb4a /* @ECU_Address@ICAS_ACCFastExitCons_PassengerDoorOpen@ */ /end MEASUREMENT
/begin MEASUREMENT ICAS_ACCFastExitCons_RRDoorOpen "" UBYTE autosar_swc_icas_CM_boolean 0 0 0 1 ECU_ADDRESS 0xfe4adb4b /* @ECU_Address@ICAS_ACCFastExitCons_RRDoorOpen@ */ /end MEASUREMENT
/begin MEASUREMENT ICAS_ACCSlowExit "" UBYTE autosar_swc_icas_CM_boolean 0 0 0 1 ECU_ADDRESS 0xfe4adb4c /* @ECU_Address@ICAS_ACCSlowExit@ */ /end MEASUREMENT
/begin MEASUREMENT ICAS_ACC_ACCSts "" UBYTE autosar_swc_icas_CM_uint8 0 0 0 255 MATRIX_DIM 1 1 ECU_ADDRESS 0xfe4adb4d /* @ECU_Address@ICAS_ACC_ACCSts@ */ /end MEASUREMENT
/begin MEASUREMENT ICAS_ACC_AVPFunStatus "" UBYTE autosar_swc_icas_CM_uint8 0 0 0 255 ECU_ADDRESS 0xfe4adb4e /* @ECU_Address@ICAS_ACC_AVPFunStatus@ */ /end MEASUREMENT
/begin MEASUREMENT ICAS_ACC_BOMExit "" UBYTE autosar_swc_icas_CM_boolean 0 0 0 1 MATRIX_DIM 1 1 ECU_ADDRESS 0xfe4adb4f /* @ECU_Address@ICAS_ACC_BOMExit@ */ /end MEASUREMENT
/begin MEASUREMENT ICAS_ACC_DrvOFFReq "" UBYTE autosar_swc_icas_CM_boolean 0 0 0 1 ECU_ADDRESS 0xfe4adb50 /* @ECU_Address@ICAS_ACC_DrvOFFReq@ */ /end MEASUREMENT
/begin MEASUREMENT ICAS_ACC_StandActiveTime "" UWORD autosar_swc_icas_CM_uint16 0 0 0 65535 MATRIX_DIM 1 1 ECU_ADDRESS 0xfe4adade /* @ECU_Address@ICAS_ACC_StandActiveTime@ */ /end MEASUREMENT
/begin MEASUREMENT ICAS_ACC_USS_ACCP0rangeEN "" FLOAT32_IEEE autosar_swc_icas_CM_single 0 0 -3.4E+38 3.4E+38 ECU_ADDRESS 0xfe4ada78 /* @ECU_Address@ICAS_ACC_USS_ACCP0rangeEN@ */ /end MEASUREMENT
/begin MEASUREMENT ICAS_ACC_USS_DrvroffConEn "" UBYTE autosar_swc_icas_CM_boolean 0 0 0 1 MATRIX_DIM 1 1 ECU_ADDRESS 0xfe4adb53 /* @ECU_Address@ICAS_ACC_USS_DrvroffConEn@ */ /end MEASUREMENT
/begin MEASUREMENT ICAS_ACC_USS_TOSP0TypeChange "" UBYTE autosar_swc_icas_CM_boolean 0 0 0 1 ECU_ADDRESS 0xfe4adb55 /* @ECU_Address@ICAS_ACC_USS_TOSP0TypeChange@ */ /end MEASUREMENT
/begin MEASUREMENT ICAS_ACC_USS_USSObjExist "" UBYTE autosar_swc_icas_CM_boolean 0 0 0 1 ECU_ADDRESS 0xfe4adb56 /* @ECU_Address@ICAS_ACC_USS_USSObjExist@ */ /end MEASUREMENT
/begin MEASUREMENT ICAS_ACC_USS_rangeP0DetDec "" UBYTE autosar_swc_icas_CM_boolean 0 0 0 1 ECU_ADDRESS 0xfe4adb57 /* @ECU_Address@ICAS_ACC_USS_rangeP0DetDec@ */ /end MEASUREMENT
/begin MEASUREMENT ICAS_ExecTimestamp.nanoseconds "" ULONG autosar_swc_icas_CM_uint32 0 0 0 4294967295 ECU_ADDRESS 0xfe4ad644 /* @ECU_Address@ICAS_ExecTimestamp.nanoseconds@ */ /end MEASUREMENT
/begin MEASUREMENT ICAS_ExecTimestamp.seconds "" A_UINT64 autosar_swc_icas_CM_uint64 0 0 0 18446744073709551615 ECU_ADDRESS 0xfe4ad648 /* @ECU_Address@ICAS_ExecTimestamp.seconds@ */ /end MEASUREMENT
/begin MEASUREMENT ICAS_ExecTimestamp.timeBaseStatus "" UBYTE autosar_swc_icas_CM_uint8 0 0 0 255 ECU_ADDRESS 0xfe4ad640 /* @ECU_Address@ICAS_ExecTimestamp.timeBaseStatus@ */ /end MEASUREMENT
/begin MEASUREMENT ICAS_HWAFastExitCond_ACCExit "" UBYTE autosar_swc_icas_CM_boolean 0 0 0 1 ECU_ADDRESS 0xfe4adb59 /* @ECU_Address@ICAS_HWAFastExitCond_ACCExit@ */ /end MEASUREMENT
/begin MEASUREMENT ICAS_HWASlowExitConditions_b "" UBYTE autosar_swc_icas_CM_boolean 0 0 0 1 ECU_ADDRESS 0xfe4adb5a /* @ECU_Address@ICAS_HWASlowExitConditions_b@ */ /end MEASUREMENT
/begin MEASUREMENT ICAS_HWASlowExitCons_EspActive400ms "" UBYTE autosar_swc_icas_CM_boolean 0 0 0 1 ECU_ADDRESS 0xfe4adb5b /* @ECU_Address@ICAS_HWASlowExitCons_EspActive400ms@ */ /end MEASUREMENT
/begin MEASUREMENT ICAS_HWATJA_HWAWarningLevel "" UBYTE autosar_swc_icas_CM_uint8 0 0 0 255 ECU_ADDRESS 0xfe4adb5c /* @ECU_Address@ICAS_HWATJA_HWAWarningLevel@ */ /end MEASUREMENT
/begin MEASUREMENT ICAS_HWATJA_MRC2SafeStopCon_b "" UBYTE autosar_swc_icas_CM_boolean 0 0 0 1 ECU_ADDRESS 0xfe4adb5d /* @ECU_Address@ICAS_HWATJA_MRC2SafeStopCon_b@ */ /end MEASUREMENT
/begin MEASUREMENT ICAS_LongHMI_Number "" UWORD autosar_swc_icas_CM_uint16 0 0 0 65535 ECU_ADDRESS 0xfe4adae0 /* @ECU_Address@ICAS_LongHMI_Number@ */ /end MEASUREMENT
/begin MEASUREMENT ICAS_TJAHandsOffWarningLevel "" UBYTE autosar_swc_icas_CM_uint8 0 0 0 255 ECU_ADDRESS 0xfe4adb5e /* @ECU_Address@ICAS_TJAHandsOffWarningLevel@ */ /end MEASUREMENT
/begin MEASUREMENT ICAS_TJALCK_Con_TJAActive_LatCondition_b "" UBYTE autosar_swc_icas_CM_boolean 0 0 0 1 ECU_ADDRESS 0xfe4adb5f /* @ECU_Address@ICAS_TJALCK_Con_TJAActive_LatCondition_b@ */ /end MEASUREMENT
/begin MEASUREMENT ICAS_TJALCK_Con_TJAExit_LatCondition_b "" UBYTE autosar_swc_icas_CM_boolean 0 0 0 1 ECU_ADDRESS 0xfe4adb60 /* @ECU_Address@ICAS_TJALCK_Con_TJAExit_LatCondition_b@ */ /end MEASUREMENT
/begin MEASUREMENT ICAS_TJALCK_preDis "" FLOAT32_IEEE autosar_swc_icas_CM_single 0 0 -3.4E+38 3.4E+38 ECU_ADDRESS 0xfe4ada80 /* @ECU_Address@ICAS_TJALCK_preDis@ */ /end MEASUREMENT
/begin MEASUREMENT ICAS_TJA_Number "" UWORD autosar_swc_icas_CM_uint16 0 0 0 65535 ECU_ADDRESS 0xfe4adae2 /* @ECU_Address@ICAS_TJA_Number@ */ /end MEASUREMENT
/begin MEASUREMENT ICAS_TJA_VERSION "" ULONG autosar_swc_icas_CM_uint32 0 0 0 4294967295 ECU_ADDRESS 0xfe4ada84 /* @ECU_Address@ICAS_TJA_VERSION@ */ /end MEASUREMENT
/begin MEASUREMENT ICAS_Version "" ULONG autosar_swc_icas_CM_uint32 0 0 0 4294967295 ECU_ADDRESS 0xfe4ada88 /* @ECU_Address@ICAS_Version@ */ /end MEASUREMENT
/begin MEASUREMENT ICAS_longHMI_CRUISETextDisp "" UBYTE autosar_swc_icas_CM_uint8 0 0 0 255 ECU_ADDRESS 0xfe4adb62 /* @ECU_Address@ICAS_longHMI_CRUISETextDisp@ */ /end MEASUREMENT
/begin MEASUREMENT ICAS_longHMI_TruckCount "" UBYTE autosar_swc_icas_CM_uint8 0 0 0 255 MATRIX_DIM 1 1 ECU_ADDRESS 0xfe4adb65 /* @ECU_Address@ICAS_longHMI_TruckCount@ */ /end MEASUREMENT
/begin MEASUREMENT ICAS_reserve01 "" FLOAT32_IEEE autosar_swc_icas_CM_single 0 0 -3.4E+38 3.4E+38 MATRIX_DIM 1 1 ECU_ADDRESS 0xfe4ada8c /* @ECU_Address@ICAS_reserve01@ */ /end MEASUREMENT
/begin MEASUREMENT ICAS_reserve02 "" FLOAT32_IEEE autosar_swc_icas_CM_single 0 0 -3.4E+38 3.4E+38 MATRIX_DIM 1 1 ECU_ADDRESS 0xfe4ada90 /* @ECU_Address@ICAS_reserve02@ */ /end MEASUREMENT
/begin MEASUREMENT ICAS_reserve04 "" UBYTE autosar_swc_icas_CM_boolean 0 0 0 1 ECU_ADDRESS 0xfe4adb66 /* @ECU_Address@ICAS_reserve04@ */ /end MEASUREMENT
/begin MEASUREMENT ICAS_reserve05 "" FLOAT32_IEEE autosar_swc_icas_CM_single 0 0 -3.4E+38 3.4E+38 ECU_ADDRESS 0xfe4ada98 /* @ECU_Address@ICAS_reserve05@ */ /end MEASUREMENT
/begin MEASUREMENT ICAS_reserve06 "" FLOAT32_IEEE autosar_swc_icas_CM_single 0 0 -3.4E+38 3.4E+38 ECU_ADDRESS 0xfe4ada9c /* @ECU_Address@ICAS_reserve06@ */ /end MEASUREMENT
/begin MEASUREMENT ICAS_reserve07 "" FLOAT32_IEEE autosar_swc_icas_CM_single 0 0 -3.4E+38 3.4E+38 ECU_ADDRESS 0xfe4adaa0 /* @ECU_Address@ICAS_reserve07@ */ /end MEASUREMENT
/begin MEASUREMENT ICAS_reserve08 "" FLOAT32_IEEE autosar_swc_icas_CM_single 0 0 -3.4E+38 3.4E+38 ECU_ADDRESS 0xfe4adaa4 /* @ECU_Address@ICAS_reserve08@ */ /end MEASUREMENT
/begin MEASUREMENT ICAS_reserve09 "" FLOAT32_IEEE autosar_swc_icas_CM_single 0 0 -3.4E+38 3.4E+38 ECU_ADDRESS 0xfe4adaa8 /* @ECU_Address@ICAS_reserve09@ */ /end MEASUREMENT
/begin MEASUREMENT ICAS_reserve10 "" FLOAT32_IEEE autosar_swc_icas_CM_single 0 0 -3.4E+38 3.4E+38 ECU_ADDRESS 0xfe4adaac /* @ECU_Address@ICAS_reserve10@ */ /end MEASUREMENT
/begin MEASUREMENT IHC_Version "" ULONG autosar_swc_icas_CM_uint32 0 0 0 4294967295 ECU_ADDRESS 0xfe4adab0 /* @ECU_Address@IHC_Version@ */ /end MEASUREMENT
/begin MEASUREMENT MAP_TSR_SpdLim_in "" UBYTE autosar_swc_icas_CM_uint8 0 0 0 255 ECU_ADDRESS 0xfe4adb67 /* @ECU_Address@MAP_TSR_SpdLim_in@ */ /end MEASUREMENT
/begin MEASUREMENT SwcOut_CSM_CSC_HMI.CruiseSpdValueHMI "" UBYTE autosar_swc_icas_CM_uint8 0 0 0 255 ECU_ADDRESS 0xfe4adab4 /* @ECU_Address@SwcOut_CSM_CSC_HMI.CruiseSpdValueHMI@ */ /end MEASUREMENT
/begin MEASUREMENT SwcOut_CSM_CSC_HMI.ISL_NOA_SPL_Distance2Split "" FLOAT32_IEEE autosar_swc_icas_CM_single 0 0 -3.4E+38 3.4E+38 ECU_ADDRESS 0xfe4adac4 /* @ECU_Address@SwcOut_CSM_CSC_HMI.ISL_NOA_SPL_Distance2Split@ */ /end MEASUREMENT
/begin MEASUREMENT SwcOut_CSM_CSC_HMI.ISL_NOA_SPL_kph "" FLOAT32_IEEE autosar_swc_icas_CM_single 0 0 -3.4E+38 3.4E+38 ECU_ADDRESS 0xfe4adac0 /* @ECU_Address@SwcOut_CSM_CSC_HMI.ISL_NOA_SPL_kph@ */ /end MEASUREMENT
/begin MEASUREMENT SwcOut_CSM_CSC_HMI.ISL_SetSpdAdjReq "" UBYTE autosar_swc_icas_CM_uint8 0 0 0 255 ECU_ADDRESS 0xfe4adab8 /* @ECU_Address@SwcOut_CSM_CSC_HMI.ISL_SetSpdAdjReq@ */ /end MEASUREMENT
/begin MEASUREMENT SwcOut_CSM_CSC_HMI.ISL_SetSpdAdjVal "" FLOAT32_IEEE autosar_swc_icas_CM_single 0 0 -3.4E+38 3.4E+38 ECU_ADDRESS 0xfe4adabc /* @ECU_Address@SwcOut_CSM_CSC_HMI.ISL_SetSpdAdjVal@ */ /end MEASUREMENT
/begin MEASUREMENT SwcOut_CSM_CSC_HMI.ISL_Sts "" UBYTE autosar_swc_icas_CM_uint8 0 0 0 255 ECU_ADDRESS 0xfe4adab7 /* @ECU_Address@SwcOut_CSM_CSC_HMI.ISL_Sts@ */ /end MEASUREMENT
/begin MEASUREMENT SwcOut_CSM_CSC_HMI.ISL_iAccHiLim_kph "" FLOAT32_IEEE autosar_swc_icas_CM_single 0 0 -3.4E+38 3.4E+38 ECU_ADDRESS 0xfe4adacc /* @ECU_Address@SwcOut_CSM_CSC_HMI.ISL_iAccHiLim_kph@ */ /end MEASUREMENT
/begin MEASUREMENT SwcOut_CSM_CSC_HMI.ISL_iAccLoLim_kph "" FLOAT32_IEEE autosar_swc_icas_CM_single 0 0 -3.4E+38 3.4E+38 ECU_ADDRESS 0xfe4adac8 /* @ECU_Address@SwcOut_CSM_CSC_HMI.ISL_iAccLoLim_kph@ */ /end MEASUREMENT
/begin MEASUREMENT SwcOut_CSM_CSC_HMI.InfoDispHMI "" UBYTE autosar_swc_icas_CM_uint8 0 0 0 255 ECU_ADDRESS 0xfe4adab6 /* @ECU_Address@SwcOut_CSM_CSC_HMI.InfoDispHMI@ */ /end MEASUREMENT
/begin MEASUREMENT SwcOut_CSM_CSC_HMI.TimeGapLevelHMI "" UBYTE autosar_swc_icas_CM_uint8 0 0 0 255 ECU_ADDRESS 0xfe4adab5 /* @ECU_Address@SwcOut_CSM_CSC_HMI.TimeGapLevelHMI@ */ /end MEASUREMENT
/begin MEASUREMENT SwcOut_CSM_CTRL.CruiseSpdCtrlLevel "" UBYTE autosar_swc_icas_CM_uint8 0 0 0 255 ECU_ADDRESS 0xfe4ad651 /* @ECU_Address@SwcOut_CSM_CTRL.CruiseSpdCtrlLevel@ */ /end MEASUREMENT
/begin MEASUREMENT SwcOut_CSM_CTRL.CruiseSpdKmh "" FLOAT32_IEEE autosar_swc_icas_CM_single 0 0 -3.4E+38 3.4E+38 ECU_ADDRESS 0xfe4ad654 /* @ECU_Address@SwcOut_CSM_CTRL.CruiseSpdKmh@ */ /end MEASUREMENT
/begin MEASUREMENT SwcOut_CSM_CTRL.ISL_APSpdLimDist "" FLOAT32_IEEE autosar_swc_icas_CM_single 0 0 -3.4E+38 3.4E+38 ECU_ADDRESS 0xfe4ad65c /* @ECU_Address@SwcOut_CSM_CTRL.ISL_APSpdLimDist@ */ /end MEASUREMENT
/begin MEASUREMENT SwcOut_CSM_CTRL.ISL_APSpdLimSPL "" FLOAT32_IEEE autosar_swc_icas_CM_single 0 0 -3.4E+38 3.4E+38 ECU_ADDRESS 0xfe4ad658 /* @ECU_Address@SwcOut_CSM_CTRL.ISL_APSpdLimSPL@ */ /end MEASUREMENT
/begin MEASUREMENT SwcOut_CSM_CTRL.TimeGapLevel "" UBYTE autosar_swc_icas_CM_uint8 0 0 0 255 ECU_ADDRESS 0xfe4ad652 /* @ECU_Address@SwcOut_CSM_CTRL.TimeGapLevel@ */ /end MEASUREMENT
/begin MEASUREMENT SwcOut_CSM_CTRL.VsetBelowMin "" UBYTE autosar_swc_icas_CM_boolean 0 0 0 1 ECU_ADDRESS 0xfe4ad650 /* @ECU_Address@SwcOut_CSM_CTRL.VsetBelowMin@ */ /end MEASUREMENT
/begin MEASUREMENT SwcOut_CSM_TSR_HMI.TSRConSpdLim "" UBYTE autosar_swc_icas_CM_uint8 0 0 0 255 ECU_ADDRESS 0xfe4adb70 /* @ECU_Address@SwcOut_CSM_TSR_HMI.TSRConSpdLim@ */ /end MEASUREMENT
/begin MEASUREMENT SwcOut_CSM_TSR_HMI.TSRConSpdLimWarn "" UBYTE autosar_swc_icas_CM_boolean 0 0 0 1 ECU_ADDRESS 0xfe4adb69 /* @ECU_Address@SwcOut_CSM_TSR_HMI.TSRConSpdLimWarn@ */ /end MEASUREMENT
/begin MEASUREMENT SwcOut_CSM_TSR_HMI.TSRSpdLim "" UBYTE autosar_swc_icas_CM_uint8 0 0 0 255 ECU_ADDRESS 0xfe4adb6e /* @ECU_Address@SwcOut_CSM_TSR_HMI.TSRSpdLim@ */ /end MEASUREMENT
/begin MEASUREMENT SwcOut_CSM_TSR_HMI.TSRSpdLimCfdc "" UBYTE autosar_swc_icas_CM_uint8 0 0 0 255 ECU_ADDRESS 0xfe4adb6f /* @ECU_Address@SwcOut_CSM_TSR_HMI.TSRSpdLimCfdc@ */ /end MEASUREMENT
/begin MEASUREMENT SwcOut_CSM_TSR_HMI.TSRSpdLimSts "" UBYTE autosar_swc_icas_CM_uint8 0 0 0 255 ECU_ADDRESS 0xfe4adb6d /* @ECU_Address@SwcOut_CSM_TSR_HMI.TSRSpdLimSts@ */ /end MEASUREMENT
/begin MEASUREMENT SwcOut_CSM_TSR_HMI.TSRSpdLimUnit "" UBYTE autosar_swc_icas_CM_uint8 0 0 0 255 ECU_ADDRESS 0xfe4adb6c /* @ECU_Address@SwcOut_CSM_TSR_HMI.TSRSpdLimUnit@ */ /end MEASUREMENT
/begin MEASUREMENT SwcOut_CSM_TSR_HMI.TSRSpdLimWarn "" UBYTE autosar_swc_icas_CM_boolean 0 0 0 1 ECU_ADDRESS 0xfe4adb68 /* @ECU_Address@SwcOut_CSM_TSR_HMI.TSRSpdLimWarn@ */ /end MEASUREMENT
/begin MEASUREMENT SwcOut_CSM_TSR_HMI.TSRSts "" UBYTE autosar_swc_icas_CM_uint8 0 0 0 255 ECU_ADDRESS 0xfe4adb6b /* @ECU_Address@SwcOut_CSM_TSR_HMI.TSRSts@ */ /end MEASUREMENT
/begin MEASUREMENT SwcOut_CSM_TSR_HMI.TSRTrfcSignValCfdc "" UBYTE autosar_swc_icas_CM_uint8 0 0 0 255 ECU_ADDRESS 0xfe4adb74 /* @ECU_Address@SwcOut_CSM_TSR_HMI.TSRTrfcSignValCfdc@ */ /end MEASUREMENT
/begin MEASUREMENT SwcOut_CSM_TSR_HMI.TSR_Forbidden "" UBYTE autosar_swc_icas_CM_uint8 0 0 0 255 ECU_ADDRESS 0xfe4adb73 /* @ECU_Address@SwcOut_CSM_TSR_HMI.TSR_Forbidden@ */ /end MEASUREMENT
/begin MEASUREMENT SwcOut_CSM_TSR_HMI.TSR_GiveWay "" UBYTE autosar_swc_icas_CM_uint8 0 0 0 255 ECU_ADDRESS 0xfe4adb71 /* @ECU_Address@SwcOut_CSM_TSR_HMI.TSR_GiveWay@ */ /end MEASUREMENT
/begin MEASUREMENT SwcOut_CSM_TSR_HMI.TSR_LongTimeDisplay "" UBYTE autosar_swc_icas_CM_uint8 0 0 0 255 ECU_ADDRESS 0xfe4adb72 /* @ECU_Address@SwcOut_CSM_TSR_HMI.TSR_LongTimeDisplay@ */ /end MEASUREMENT
/begin MEASUREMENT SwcOut_CSM_TSR_HMI.TSR_Snvty "" SBYTE autosar_swc_icas_CM_int8 0 0 -128 127 ECU_ADDRESS 0xfe4adb6a /* @ECU_Address@SwcOut_CSM_TSR_HMI.TSR_Snvty@ */ /end MEASUREMENT
/begin MEASUREMENT SwcOut_ICAS_ADAS_Request "" UBYTE autosar_swc_icas_CM_uint8 0 0 0 255 ECU_ADDRESS 0xfe4adb75 /* @ECU_Address@SwcOut_ICAS_ADAS_Request@ */ /end MEASUREMENT
/begin MEASUREMENT SwcOut_ICAS_HMI.ACC_ModDisp "" UBYTE autosar_swc_icas_CM_uint8 0 0 0 255 ECU_ADDRESS 0xfe4adae6 /* @ECU_Address@SwcOut_ICAS_HMI.ACC_ModDisp@ */ /end MEASUREMENT
/begin MEASUREMENT SwcOut_ICAS_HMI.ALC_ModeDisp "" UBYTE autosar_swc_icas_CM_uint8 0 0 0 255 ECU_ADDRESS 0xfe4adae8 /* @ECU_Address@SwcOut_ICAS_HMI.ALC_ModeDisp@ */ /end MEASUREMENT
/begin MEASUREMENT SwcOut_ICAS_HMI.DAI_ModeDisp "" UBYTE autosar_swc_icas_CM_uint8 0 0 0 255 ECU_ADDRESS 0xfe4adaea /* @ECU_Address@SwcOut_ICAS_HMI.DAI_ModeDisp@ */ /end MEASUREMENT
/begin MEASUREMENT SwcOut_ICAS_HMI.DriveOffDisp "" UBYTE autosar_swc_icas_CM_uint8 0 0 0 255 ECU_ADDRESS 0xfe4adaf0 /* @ECU_Address@SwcOut_ICAS_HMI.DriveOffDisp@ */ /end MEASUREMENT
/begin MEASUREMENT SwcOut_ICAS_HMI.DriverInloopMonitor "" UBYTE autosar_swc_icas_CM_uint8 0 0 0 255 ECU_ADDRESS 0xfe4adaf2 /* @ECU_Address@SwcOut_ICAS_HMI.DriverInloopMonitor@ */ /end MEASUREMENT
/begin MEASUREMENT SwcOut_ICAS_HMI.EcallReq "" UBYTE autosar_swc_icas_CM_boolean 0 0 0 1 ECU_ADDRESS 0xfe4adae4 /* @ECU_Address@SwcOut_ICAS_HMI.EcallReq@ */ /end MEASUREMENT
/begin MEASUREMENT SwcOut_ICAS_HMI.HandsOffWarningLevel "" UBYTE autosar_swc_icas_CM_uint8 0 0 0 255 ECU_ADDRESS 0xfe4adaf1 /* @ECU_Address@SwcOut_ICAS_HMI.HandsOffWarningLevel@ */ /end MEASUREMENT
/begin MEASUREMENT SwcOut_ICAS_HMI.HazActv "" UBYTE autosar_swc_icas_CM_uint8 0 0 0 255 ECU_ADDRESS 0xfe4adaee /* @ECU_Address@SwcOut_ICAS_HMI.HazActv@ */ /end MEASUREMENT
/begin MEASUREMENT SwcOut_ICAS_HMI.HighLowBeamReq "" UBYTE autosar_swc_icas_CM_uint8 0 0 0 255 ECU_ADDRESS 0xfe4adaed /* @ECU_Address@SwcOut_ICAS_HMI.HighLowBeamReq@ */ /end MEASUREMENT
/begin MEASUREMENT SwcOut_ICAS_HMI.IHBC_ModeDisp "" UBYTE autosar_swc_icas_CM_uint8 0 0 0 255 ECU_ADDRESS 0xfe4adaec /* @ECU_Address@SwcOut_ICAS_HMI.IHBC_ModeDisp@ */ /end MEASUREMENT
/begin MEASUREMENT SwcOut_ICAS_HMI.InfoDispHMI "" UBYTE autosar_swc_icas_CM_uint8 0 0 0 255 LAYOUT COLUMN_DIR MATRIX_DIM 2 ECU_ADDRESS 0xfe4adaf4 /* @ECU_Address@SwcOut_ICAS_HMI.InfoDispHMI@ */ /end MEASUREMENT
/begin MEASUREMENT SwcOut_ICAS_HMI.LCC_ModeDisp "" UBYTE autosar_swc_icas_CM_uint8 0 0 0 255 ECU_ADDRESS 0xfe4adae7 /* @ECU_Address@SwcOut_ICAS_HMI.LCC_ModeDisp@ */ /end MEASUREMENT
/begin MEASUREMENT SwcOut_ICAS_HMI.NOA_ModeDisp "" UBYTE autosar_swc_icas_CM_uint8 0 0 0 255 ECU_ADDRESS 0xfe4adae9 /* @ECU_Address@SwcOut_ICAS_HMI.NOA_ModeDisp@ */ /end MEASUREMENT
/begin MEASUREMENT SwcOut_ICAS_HMI.Nudge_ModeDisp "" UBYTE autosar_swc_icas_CM_uint8 0 0 0 255 ECU_ADDRESS 0xfe4adaeb /* @ECU_Address@SwcOut_ICAS_HMI.Nudge_ModeDisp@ */ /end MEASUREMENT
/begin MEASUREMENT SwcOut_ICAS_HMI.ParkShiftReq "" UBYTE autosar_swc_icas_CM_boolean 0 0 0 1 ECU_ADDRESS 0xfe4adae5 /* @ECU_Address@SwcOut_ICAS_HMI.ParkShiftReq@ */ /end MEASUREMENT
/begin MEASUREMENT SwcOut_ICAS_HMI.TurnLampReq "" UBYTE autosar_swc_icas_CM_uint8 0 0 0 255 ECU_ADDRESS 0xfe4adaef /* @ECU_Address@SwcOut_ICAS_HMI.TurnLampReq@ */ /end MEASUREMENT
/begin MEASUREMENT SwcOut_ICAS_HMI.WarningLevel "" UBYTE autosar_swc_icas_CM_uint8 0 0 0 255 ECU_ADDRESS 0xfe4adaf3 /* @ECU_Address@SwcOut_ICAS_HMI.WarningLevel@ */ /end MEASUREMENT
/begin MEASUREMENT SwcOut_ICAS_Herbeat_Info.inner_error "" ULONG autosar_swc_icas_CM_uint32 0 0 0 4294967295 ECU_ADDRESS 0xfe4adad4 /* @ECU_Address@SwcOut_ICAS_Herbeat_Info.inner_error@ */ /end MEASUREMENT
/begin MEASUREMENT SwcOut_ICAS_Herbeat_Info.module_status "" UBYTE autosar_swc_icas_CM_SM_MODULE_STATUS 0 0 0 3 ECU_ADDRESS 0xfe4adad8 /* @ECU_Address@SwcOut_ICAS_Herbeat_Info.module_status@ */ /end MEASUREMENT
/begin MEASUREMENT SwcOut_ICAS_Herbeat_Info.sequence_num "" UBYTE autosar_swc_icas_CM_uint8 0 0 0 255 ECU_ADDRESS 0xfe4adad1 /* @ECU_Address@SwcOut_ICAS_Herbeat_Info.sequence_num@ */ /end MEASUREMENT
/begin MEASUREMENT SwcOut_ICAS_Herbeat_Info.swc_id "" UBYTE autosar_swc_icas_CM_uint8 0 0 0 255 ECU_ADDRESS 0xfe4adad0 /* @ECU_Address@SwcOut_ICAS_Herbeat_Info.swc_id@ */ /end MEASUREMENT
/begin MEASUREMENT SwcOut_ICAS_NvM_Set_ACCStsInit "" UBYTE autosar_swc_icas_CM_uint8 0 0 0 255 ECU_ADDRESS 0xfe4adb76 /* @ECU_Address@SwcOut_ICAS_NvM_Set_ACCStsInit@ */ /end MEASUREMENT
/begin MEASUREMENT SwcOut_ICAS_STATE.acc_exit_reason "" ULONG autosar_swc_icas_CM_uint32 0 0 0 4294967295 ECU_ADDRESS 0xfe4ad66c /* @ECU_Address@SwcOut_ICAS_STATE.acc_exit_reason@ */ /end MEASUREMENT
/begin MEASUREMENT SwcOut_ICAS_STATE.acc_manual_act_faile_reason "" ULONG autosar_swc_icas_CM_uint32 0 0 0 4294967295 ECU_ADDRESS 0xfe4ad668 /* @ECU_Address@SwcOut_ICAS_STATE.acc_manual_act_faile_reason@ */ /end MEASUREMENT
/begin MEASUREMENT SwcOut_ICAS_STATE.acc_sts "" UBYTE autosar_swc_icas_CM_uint8 0 0 0 255 ECU_ADDRESS 0xfe4ad660 /* @ECU_Address@SwcOut_ICAS_STATE.acc_sts@ */ /end MEASUREMENT
/begin MEASUREMENT SwcOut_ICAS_STATE.alc_sts "" UBYTE autosar_swc_icas_CM_uint8 0 0 0 255 ECU_ADDRESS 0xfe4ad663 /* @ECU_Address@SwcOut_ICAS_STATE.alc_sts@ */ /end MEASUREMENT
/begin MEASUREMENT SwcOut_ICAS_STATE.lc_req_sync_id "" UBYTE autosar_swc_icas_CM_uint8 0 0 0 255 ECU_ADDRESS 0xfe4ad665 /* @ECU_Address@SwcOut_ICAS_STATE.lc_req_sync_id@ */ /end MEASUREMENT
/begin MEASUREMENT SwcOut_ICAS_STATE.lcc_auto_act_faile_reason "" ULONG autosar_swc_icas_CM_uint32 0 0 0 4294967295 ECU_ADDRESS 0xfe4ad674 /* @ECU_Address@SwcOut_ICAS_STATE.lcc_auto_act_faile_reason@ */ /end MEASUREMENT
/begin MEASUREMENT SwcOut_ICAS_STATE.lcc_exit_to_idle_reason "" ULONG autosar_swc_icas_CM_uint32 0 0 0 4294967295 ECU_ADDRESS 0xfe4ad678 /* @ECU_Address@SwcOut_ICAS_STATE.lcc_exit_to_idle_reason@ */ /end MEASUREMENT
/begin MEASUREMENT SwcOut_ICAS_STATE.lcc_exit_to_mrc_reason "" ULONG autosar_swc_icas_CM_uint32 0 0 0 4294967295 ECU_ADDRESS 0xfe4ad680 /* @ECU_Address@SwcOut_ICAS_STATE.lcc_exit_to_mrc_reason@ */ /end MEASUREMENT
/begin MEASUREMENT SwcOut_ICAS_STATE.lcc_exit_to_wait_reason "" ULONG autosar_swc_icas_CM_uint32 0 0 0 4294967295 ECU_ADDRESS 0xfe4ad67c /* @ECU_Address@SwcOut_ICAS_STATE.lcc_exit_to_wait_reason@ */ /end MEASUREMENT
/begin MEASUREMENT SwcOut_ICAS_STATE.lcc_manual_act_faile_reason "" ULONG autosar_swc_icas_CM_uint32 0 0 0 4294967295 ECU_ADDRESS 0xfe4ad670 /* @ECU_Address@SwcOut_ICAS_STATE.lcc_manual_act_faile_reason@ */ /end MEASUREMENT
/begin MEASUREMENT SwcOut_ICAS_STATE.lcc_mrc_exit_reason "" ULONG autosar_swc_icas_CM_uint32 0 0 0 4294967295 ECU_ADDRESS 0xfe4ad684 /* @ECU_Address@SwcOut_ICAS_STATE.lcc_mrc_exit_reason@ */ /end MEASUREMENT
/begin MEASUREMENT SwcOut_ICAS_STATE.lcc_sts "" UBYTE autosar_swc_icas_CM_uint8 0 0 0 255 ECU_ADDRESS 0xfe4ad661 /* @ECU_Address@SwcOut_ICAS_STATE.lcc_sts@ */ /end MEASUREMENT
/begin MEASUREMENT SwcOut_ICAS_STATE.noa_auto_act_faile_reason "" ULONG autosar_swc_icas_CM_uint32 0 0 0 4294967295 ECU_ADDRESS 0xfe4ad688 /* @ECU_Address@SwcOut_ICAS_STATE.noa_auto_act_faile_reason@ */ /end MEASUREMENT
/begin MEASUREMENT SwcOut_ICAS_STATE.noa_exit_reason "" ULONG autosar_swc_icas_CM_uint32 0 0 0 4294967295 ECU_ADDRESS 0xfe4ad68c /* @ECU_Address@SwcOut_ICAS_STATE.noa_exit_reason@ */ /end MEASUREMENT
/begin MEASUREMENT SwcOut_ICAS_STATE.noa_sts "" UBYTE autosar_swc_icas_CM_uint8 0 0 0 255 ECU_ADDRESS 0xfe4ad664 /* @ECU_Address@SwcOut_ICAS_STATE.noa_sts@ */ /end MEASUREMENT
/begin MEASUREMENT SwcOut_ICAS_STATE.nudge_sts "" UBYTE autosar_swc_icas_CM_uint8 0 0 0 255 ECU_ADDRESS 0xfe4ad662 /* @ECU_Address@SwcOut_ICAS_STATE.nudge_sts@ */ /end MEASUREMENT
/begin MEASUREMENT SwcOut_NvM_Set_TSRInit.SPL_SuppName_Value_Init "" UBYTE autosar_swc_icas_CM_uint8 0 0 0 255 ECU_ADDRESS 0xfe4ad693 /* @ECU_Address@SwcOut_NvM_Set_TSRInit.SPL_SuppName_Value_Init@ */ /end MEASUREMENT
/begin MEASUREMENT SwcOut_NvM_Set_TSRInit.SPL_noSupp_Dist_Init "" FLOAT32_IEEE autosar_swc_icas_CM_single 0 0 -3.4E+38 3.4E+38 ECU_ADDRESS 0xfe4ad694 /* @ECU_Address@SwcOut_NvM_Set_TSRInit.SPL_noSupp_Dist_Init@ */ /end MEASUREMENT
/begin MEASUREMENT SwcOut_NvM_Set_TSRInit.SPL_noSupp_Value_Init "" UBYTE autosar_swc_icas_CM_uint8 0 0 0 255 ECU_ADDRESS 0xfe4ad690 /* @ECU_Address@SwcOut_NvM_Set_TSRInit.SPL_noSupp_Value_Init@ */ /end MEASUREMENT
/begin MEASUREMENT SwcOut_NvM_Set_TSRInit.SPL_whSupp_Dist_Init "" FLOAT32_IEEE autosar_swc_icas_CM_single 0 0 -3.4E+38 3.4E+38 ECU_ADDRESS 0xfe4ad698 /* @ECU_Address@SwcOut_NvM_Set_TSRInit.SPL_whSupp_Dist_Init@ */ /end MEASUREMENT
/begin MEASUREMENT SwcOut_NvM_Set_TSRInit.SPL_whSupp_Value_Init "" UBYTE autosar_swc_icas_CM_uint8 0 0 0 255 ECU_ADDRESS 0xfe4ad691 /* @ECU_Address@SwcOut_NvM_Set_TSRInit.SPL_whSupp_Value_Init@ */ /end MEASUREMENT
/begin MEASUREMENT SwcOut_NvM_Set_TSRInit.TS_SignName_Dist_Init "" FLOAT32_IEEE autosar_swc_icas_CM_single 0 0 -3.4E+38 3.4E+38 ECU_ADDRESS 0xfe4ad69c /* @ECU_Address@SwcOut_NvM_Set_TSRInit.TS_SignName_Dist_Init@ */ /end MEASUREMENT
/begin MEASUREMENT SwcOut_NvM_Set_TSRInit.TS_SignName_Value_Init "" UBYTE autosar_swc_icas_CM_uint8 0 0 0 255 ECU_ADDRESS 0xfe4ad692 /* @ECU_Address@SwcOut_NvM_Set_TSRInit.TS_SignName_Value_Init@ */ /end MEASUREMENT
/begin MEASUREMENT SwcOut_NvM_Set_TimeGapInit "" UBYTE autosar_swc_icas_CM_uint8 0 0 0 255 ECU_ADDRESS 0xfe4adb77 /* @ECU_Address@SwcOut_NvM_Set_TimeGapInit@ */ /end MEASUREMENT
/begin MEASUREMENT Swcout_ICAS_NvM_Set_ICASStsInit "" UBYTE autosar_swc_icas_CM_uint8 0 0 0 255 MATRIX_DIM 1 1 ECU_ADDRESS 0xfe4adb78 /* @ECU_Address@Swcout_ICAS_NvM_Set_ICASStsInit@ */ /end MEASUREMENT
/begin MEASUREMENT autosar_swc_icas_rtARID_DEF.AND2 "" UBYTE autosar_swc_icas_CM_logical 0 0 0 1 MATRIX_DIM 1 1 ECU_ADDRESS 0xfe4ad9c8 /* @ECU_Address@autosar_swc_icas_rtARID_DEF.AND2@ */ /end MEASUREMENT
/begin MEASUREMENT autosar_swc_icas_rtARID_DEF.AND4 "" UBYTE autosar_swc_icas_CM_logical 0 0 0 1 MATRIX_DIM 1 1 ECU_ADDRESS 0xfe4ad9cb /* @ECU_Address@autosar_swc_icas_rtARID_DEF.AND4@ */ /end MEASUREMENT
/begin MEASUREMENT autosar_swc_icas_rtARID_DEF.AND5 "" UBYTE autosar_swc_icas_CM_logical 0 0 0 1 MATRIX_DIM 1 1 ECU_ADDRESS 0xfe4ad9c9 /* @ECU_Address@autosar_swc_icas_rtARID_DEF.AND5@ */ /end MEASUREMENT
/begin MEASUREMENT autosar_swc_icas_rtARID_DEF.Beep "" UBYTE autosar_swc_icas_CM_logical 0 0 0 1 MATRIX_DIM 1 1 ECU_ADDRESS 0xfe4ad9d6 /* @ECU_Address@autosar_swc_icas_rtARID_DEF.Beep@ */ /end MEASUREMENT
/begin MEASUREMENT autosar_swc_icas_rtARID_DEF.CRUISE_longHMI_HazSts "" UBYTE autosar_swc_icas_CM_uint8 0 0 0 255 MATRIX_DIM 1 1 ECU_ADDRESS 0xfe4ad918 /* @ECU_Address@autosar_swc_icas_rtARID_DEF.CRUISE_longHMI_HazSts@ */ /end MEASUREMENT
/begin MEASUREMENT autosar_swc_icas_rtARID_DEF.DelayInput1_DSTATE_a "" UBYTE autosar_swc_icas_CM_uint8 0 0 0 255 ECU_ADDRESS 0xfe4ad91e /* @ECU_Address@autosar_swc_icas_rtARID_DEF.DelayInput1_DSTATE_a@ */ /end MEASUREMENT
/begin MEASUREMENT autosar_swc_icas_rtARID_DEF.DelayInput1_DSTATE_bp "" UBYTE autosar_swc_icas_CM_uint8 0 0 0 255 ECU_ADDRESS 0xfe4ad922 /* @ECU_Address@autosar_swc_icas_rtARID_DEF.DelayInput1_DSTATE_bp@ */ /end MEASUREMENT
/begin MEASUREMENT autosar_swc_icas_rtARID_DEF.DelayInput1_DSTATE_c1 "" UBYTE autosar_swc_icas_CM_uint8 0 0 0 255 ECU_ADDRESS 0xfe4ad944 /* @ECU_Address@autosar_swc_icas_rtARID_DEF.DelayInput1_DSTATE_c1@ */ /end MEASUREMENT
/begin MEASUREMENT autosar_swc_icas_rtARID_DEF.DelayInput1_DSTATE_cc "" UBYTE autosar_swc_icas_CM_logical 0 0 0 1 ECU_ADDRESS 0xfe4ada1d /* @ECU_Address@autosar_swc_icas_rtARID_DEF.DelayInput1_DSTATE_cc@ */ /end MEASUREMENT
/begin MEASUREMENT autosar_swc_icas_rtARID_DEF.DelayInput1_DSTATE_d5 "" UBYTE autosar_swc_icas_CM_logical 0 0 0 1 ECU_ADDRESS 0xfe4ada5d /* @ECU_Address@autosar_swc_icas_rtARID_DEF.DelayInput1_DSTATE_d5@ */ /end MEASUREMENT
/begin MEASUREMENT autosar_swc_icas_rtARID_DEF.DelayInput1_DSTATE_e "" UBYTE autosar_swc_icas_CM_uint8 0 0 0 255 ECU_ADDRESS 0xfe4ad945 /* @ECU_Address@autosar_swc_icas_rtARID_DEF.DelayInput1_DSTATE_e@ */ /end MEASUREMENT
/begin MEASUREMENT autosar_swc_icas_rtARID_DEF.DelayInput1_DSTATE_ec "" UBYTE autosar_swc_icas_CM_uint8 0 0 0 255 ECU_ADDRESS 0xfe4ad947 /* @ECU_Address@autosar_swc_icas_rtARID_DEF.DelayInput1_DSTATE_ec@ */ /end MEASUREMENT
/begin MEASUREMENT autosar_swc_icas_rtARID_DEF.DelayInput1_DSTATE_f "" UBYTE autosar_swc_icas_CM_uint8 0 0 0 255 ECU_ADDRESS 0xfe4ad921 /* @ECU_Address@autosar_swc_icas_rtARID_DEF.DelayInput1_DSTATE_f@ */ /end MEASUREMENT
/begin MEASUREMENT autosar_swc_icas_rtARID_DEF.DelayInput1_DSTATE_fnq "" UBYTE autosar_swc_icas_CM_logical 0 0 0 1 ECU_ADDRESS 0xfe4ada60 /* @ECU_Address@autosar_swc_icas_rtARID_DEF.DelayInput1_DSTATE_fnq@ */ /end MEASUREMENT
/begin MEASUREMENT autosar_swc_icas_rtARID_DEF.DelayInput1_DSTATE_ge "" UBYTE autosar_swc_icas_CM_logical 0 0 0 1 ECU_ADDRESS 0xfe4ada64 /* @ECU_Address@autosar_swc_icas_rtARID_DEF.DelayInput1_DSTATE_ge@ */ /end MEASUREMENT
/begin MEASUREMENT autosar_swc_icas_rtARID_DEF.DelayInput1_DSTATE_gr "" UBYTE autosar_swc_icas_CM_uint8 0 0 0 255 ECU_ADDRESS 0xfe4ad943 /* @ECU_Address@autosar_swc_icas_rtARID_DEF.DelayInput1_DSTATE_gr@ */ /end MEASUREMENT
/begin MEASUREMENT autosar_swc_icas_rtARID_DEF.DelayInput1_DSTATE_ip "" UBYTE autosar_swc_icas_CM_logical 0 0 0 1 ECU_ADDRESS 0xfe4ada63 /* @ECU_Address@autosar_swc_icas_rtARID_DEF.DelayInput1_DSTATE_ip@ */ /end MEASUREMENT
/begin MEASUREMENT autosar_swc_icas_rtARID_DEF.DelayInput1_DSTATE_j2 "" UBYTE autosar_swc_icas_CM_uint8 0 0 0 255 ECU_ADDRESS 0xfe4ad920 /* @ECU_Address@autosar_swc_icas_rtARID_DEF.DelayInput1_DSTATE_j2@ */ /end MEASUREMENT
/begin MEASUREMENT autosar_swc_icas_rtARID_DEF.DelayInput1_DSTATE_k "" UBYTE autosar_swc_icas_CM_uint8 0 0 0 255 ECU_ADDRESS 0xfe4ad942 /* @ECU_Address@autosar_swc_icas_rtARID_DEF.DelayInput1_DSTATE_k@ */ /end MEASUREMENT
/begin MEASUREMENT autosar_swc_icas_rtARID_DEF.DelayInput1_DSTATE_kk "" UBYTE autosar_swc_icas_CM_logical 0 0 0 1 ECU_ADDRESS 0xfe4ada65 /* @ECU_Address@autosar_swc_icas_rtARID_DEF.DelayInput1_DSTATE_kk@ */ /end MEASUREMENT
/begin MEASUREMENT autosar_swc_icas_rtARID_DEF.DelayInput1_DSTATE_l "" UBYTE autosar_swc_icas_CM_uint8 0 0 0 255 ECU_ADDRESS 0xfe4ad91f /* @ECU_Address@autosar_swc_icas_rtARID_DEF.DelayInput1_DSTATE_l@ */ /end MEASUREMENT
/begin MEASUREMENT autosar_swc_icas_rtARID_DEF.DelayInput1_DSTATE_li "" UBYTE autosar_swc_icas_CM_logical 0 0 0 1 ECU_ADDRESS 0xfe4ada62 /* @ECU_Address@autosar_swc_icas_rtARID_DEF.DelayInput1_DSTATE_li@ */ /end MEASUREMENT
/begin MEASUREMENT autosar_swc_icas_rtARID_DEF.DelayInput1_DSTATE_lt "" UBYTE autosar_swc_icas_CM_uint8 0 0 0 255 ECU_ADDRESS 0xfe4ad946 /* @ECU_Address@autosar_swc_icas_rtARID_DEF.DelayInput1_DSTATE_lt@ */ /end MEASUREMENT
/begin MEASUREMENT autosar_swc_icas_rtARID_DEF.DelayInput1_DSTATE_n "" UBYTE autosar_swc_icas_CM_logical 0 0 0 1 ECU_ADDRESS 0xfe4ada61 /* @ECU_Address@autosar_swc_icas_rtARID_DEF.DelayInput1_DSTATE_n@ */ /end MEASUREMENT
/begin MEASUREMENT autosar_swc_icas_rtARID_DEF.DelayInput1_DSTATE_ps "" UBYTE autosar_swc_icas_CM_logical 0 0 0 1 ECU_ADDRESS 0xfe4ada5b /* @ECU_Address@autosar_swc_icas_rtARID_DEF.DelayInput1_DSTATE_ps@ */ /end MEASUREMENT
/begin MEASUREMENT autosar_swc_icas_rtARID_DEF.DelayInput1_DSTATE_px "" UBYTE autosar_swc_icas_CM_logical 0 0 0 1 ECU_ADDRESS 0xfe4ada5a /* @ECU_Address@autosar_swc_icas_rtARID_DEF.DelayInput1_DSTATE_px@ */ /end MEASUREMENT
/begin MEASUREMENT autosar_swc_icas_rtARID_DEF.Inhibit "" UBYTE autosar_swc_icas_CM_logical 0 0 0 1 ECU_ADDRESS 0xfe4ad9d5 /* @ECU_Address@autosar_swc_icas_rtARID_DEF.Inhibit@ */ /end MEASUREMENT
/begin MEASUREMENT autosar_swc_icas_rtARID_DEF.LogicalOperator76 "" UBYTE autosar_swc_icas_CM_logical 0 0 0 1 MATRIX_DIM 1 1 ECU_ADDRESS 0xfe4ad9c7 /* @ECU_Address@autosar_swc_icas_rtARID_DEF.LogicalOperator76@ */ /end MEASUREMENT
/begin MEASUREMENT autosar_swc_icas_rtARID_DEF.LogicalOperator79 "" UBYTE autosar_swc_icas_CM_logical 0 0 0 1 MATRIX_DIM 1 1 ECU_ADDRESS 0xfe4ad9ca /* @ECU_Address@autosar_swc_icas_rtARID_DEF.LogicalOperator79@ */ /end MEASUREMENT
/begin MEASUREMENT autosar_swc_icas_rtARID_DEF.LogicalOperator81 "" UBYTE autosar_swc_icas_CM_logical 0 0 0 1 MATRIX_DIM 1 1 ECU_ADDRESS 0xfe4ad9cc /* @ECU_Address@autosar_swc_icas_rtARID_DEF.LogicalOperator81@ */ /end MEASUREMENT
/begin MEASUREMENT autosar_swc_icas_rtARID_DEF.Out "" UBYTE autosar_swc_icas_CM_logical 0 0 0 1 ECU_ADDRESS 0xfe4ad9d7 /* @ECU_Address@autosar_swc_icas_rtARID_DEF.Out@ */ /end MEASUREMENT
/begin MEASUREMENT autosar_swc_icas_rtARID_DEF.Speed "" UBYTE autosar_swc_icas_CM_uint8 0 0 0 255 MATRIX_DIM 1 1 ECU_ADDRESS 0xfe4ad91b /* @ECU_Address@autosar_swc_icas_rtARID_DEF.Speed@ */ /end MEASUREMENT
/begin MEASUREMENT autosar_swc_icas_rtARID_DEF.Time "" UWORD autosar_swc_icas_CM_uint16 0 0 0 65535 ECU_ADDRESS 0xfe4ad830 /* @ECU_Address@autosar_swc_icas_rtARID_DEF.Time@ */ /end MEASUREMENT
/begin MEASUREMENT autosar_swc_icas_rtARID_DEF.TimeGap "" UBYTE autosar_swc_icas_CM_uint8 0 0 0 255 ECU_ADDRESS 0xfe4ad919 /* @ECU_Address@autosar_swc_icas_rtARID_DEF.TimeGap@ */ /end MEASUREMENT
/begin MEASUREMENT autosar_swc_icas_rtARID_DEF.Time_e "" UWORD autosar_swc_icas_CM_uint16 0 0 0 65535 ECU_ADDRESS 0xfe4ad834 /* @ECU_Address@autosar_swc_icas_rtARID_DEF.Time_e@ */ /end MEASUREMENT
/begin MEASUREMENT autosar_swc_icas_rtARID_DEF.Time_k "" UWORD autosar_swc_icas_CM_uint16 0 0 0 65535 ECU_ADDRESS 0xfe4ad832 /* @ECU_Address@autosar_swc_icas_rtARID_DEF.Time_k@ */ /end MEASUREMENT
/begin MEASUREMENT autosar_swc_icas_rtARID_DEF.UnitDelay1_DSTATE_bd "" UWORD autosar_swc_icas_CM_uint16 0 0 0 65535 ECU_ADDRESS 0xfe4ad89e /* @ECU_Address@autosar_swc_icas_rtARID_DEF.UnitDelay1_DSTATE_bd@ */ /end MEASUREMENT
/begin MEASUREMENT autosar_swc_icas_rtARID_DEF.UnitDelay1_DSTATE_bp "" UWORD autosar_swc_icas_CM_uint16 0 0 0 65535 ECU_ADDRESS 0xfe4ad8fe /* @ECU_Address@autosar_swc_icas_rtARID_DEF.UnitDelay1_DSTATE_bp@ */ /end MEASUREMENT
/begin MEASUREMENT autosar_swc_icas_rtARID_DEF.UnitDelay1_DSTATE_d0 "" UBYTE autosar_swc_icas_CM_logical 0 0 0 1 ECU_ADDRESS 0xfe4ad9da /* @ECU_Address@autosar_swc_icas_rtARID_DEF.UnitDelay1_DSTATE_d0@ */ /end MEASUREMENT
/begin MEASUREMENT autosar_swc_icas_rtARID_DEF.UnitDelay1_DSTATE_dw "" UWORD autosar_swc_icas_CM_uint16 0 0 0 65535 ECU_ADDRESS 0xfe4ad88e /* @ECU_Address@autosar_swc_icas_rtARID_DEF.UnitDelay1_DSTATE_dw@ */ /end MEASUREMENT
/begin MEASUREMENT autosar_swc_icas_rtARID_DEF.UnitDelay1_DSTATE_fw "" UWORD autosar_swc_icas_CM_uint16 0 0 0 65535 ECU_ADDRESS 0xfe4ad900 /* @ECU_Address@autosar_swc_icas_rtARID_DEF.UnitDelay1_DSTATE_fw@ */ /end MEASUREMENT
/begin MEASUREMENT autosar_swc_icas_rtARID_DEF.UnitDelay1_DSTATE_g2 "" UWORD autosar_swc_icas_CM_uint16 0 0 0 65535 ECU_ADDRESS 0xfe4ad892 /* @ECU_Address@autosar_swc_icas_rtARID_DEF.UnitDelay1_DSTATE_g2@ */ /end MEASUREMENT
/begin MEASUREMENT autosar_swc_icas_rtARID_DEF.UnitDelay1_DSTATE_gn "" UWORD autosar_swc_icas_CM_uint16 0 0 0 65535 ECU_ADDRESS 0xfe4ad87c /* @ECU_Address@autosar_swc_icas_rtARID_DEF.UnitDelay1_DSTATE_gn@ */ /end MEASUREMENT
/begin MEASUREMENT autosar_swc_icas_rtARID_DEF.UnitDelay1_DSTATE_gv "" UWORD autosar_swc_icas_CM_uint16 0 0 0 65535 ECU_ADDRESS 0xfe4ad8a4 /* @ECU_Address@autosar_swc_icas_rtARID_DEF.UnitDelay1_DSTATE_gv@ */ /end MEASUREMENT
/begin MEASUREMENT autosar_swc_icas_rtARID_DEF.UnitDelay1_DSTATE_gx "" UWORD autosar_swc_icas_CM_uint16 0 0 0 65535 ECU_ADDRESS 0xfe4ad8a8 /* @ECU_Address@autosar_swc_icas_rtARID_DEF.UnitDelay1_DSTATE_gx@ */ /end MEASUREMENT
/begin MEASUREMENT autosar_swc_icas_rtARID_DEF.UnitDelay1_DSTATE_hc "" UWORD autosar_swc_icas_CM_uint16 0 0 0 65535 ECU_ADDRESS 0xfe4ad898 /* @ECU_Address@autosar_swc_icas_rtARID_DEF.UnitDelay1_DSTATE_hc@ */ /end MEASUREMENT
/begin MEASUREMENT autosar_swc_icas_rtARID_DEF.UnitDelay1_DSTATE_hd "" UWORD autosar_swc_icas_CM_uint16 0 0 0 65535 ECU_ADDRESS 0xfe4ad8aa /* @ECU_Address@autosar_swc_icas_rtARID_DEF.UnitDelay1_DSTATE_hd@ */ /end MEASUREMENT
/begin MEASUREMENT autosar_swc_icas_rtARID_DEF.UnitDelay1_DSTATE_jc "" UWORD autosar_swc_icas_CM_uint16 0 0 0 65535 ECU_ADDRESS 0xfe4ad894 /* @ECU_Address@autosar_swc_icas_rtARID_DEF.UnitDelay1_DSTATE_jc@ */ /end MEASUREMENT
/begin MEASUREMENT autosar_swc_icas_rtARID_DEF.UnitDelay1_DSTATE_jl "" UBYTE autosar_swc_icas_CM_uint8 0 0 0 255 ECU_ADDRESS 0xfe4ad94a /* @ECU_Address@autosar_swc_icas_rtARID_DEF.UnitDelay1_DSTATE_jl@ */ /end MEASUREMENT
/begin MEASUREMENT autosar_swc_icas_rtARID_DEF.UnitDelay1_DSTATE_kc "" UWORD autosar_swc_icas_CM_uint16 0 0 0 65535 ECU_ADDRESS 0xfe4ad8a2 /* @ECU_Address@autosar_swc_icas_rtARID_DEF.UnitDelay1_DSTATE_kc@ */ /end MEASUREMENT
/begin MEASUREMENT autosar_swc_icas_rtARID_DEF.UnitDelay1_DSTATE_kk "" UWORD autosar_swc_icas_CM_uint16 0 0 0 65535 ECU_ADDRESS 0xfe4ad88c /* @ECU_Address@autosar_swc_icas_rtARID_DEF.UnitDelay1_DSTATE_kk@ */ /end MEASUREMENT
/begin MEASUREMENT autosar_swc_icas_rtARID_DEF.UnitDelay1_DSTATE_l "" UWORD autosar_swc_icas_CM_uint16 0 0 0 65535 ECU_ADDRESS 0xfe4ad896 /* @ECU_Address@autosar_swc_icas_rtARID_DEF.UnitDelay1_DSTATE_l@ */ /end MEASUREMENT
/begin MEASUREMENT autosar_swc_icas_rtARID_DEF.UnitDelay1_DSTATE_l2 "" UWORD autosar_swc_icas_CM_uint16 0 0 0 65535 ECU_ADDRESS 0xfe4ad89c /* @ECU_Address@autosar_swc_icas_rtARID_DEF.UnitDelay1_DSTATE_l2@ */ /end MEASUREMENT
/begin MEASUREMENT autosar_swc_icas_rtARID_DEF.UnitDelay1_DSTATE_n5 "" UWORD autosar_swc_icas_CM_uint16 0 0 0 65535 ECU_ADDRESS 0xfe4ad890 /* @ECU_Address@autosar_swc_icas_rtARID_DEF.UnitDelay1_DSTATE_n5@ */ /end MEASUREMENT
/begin MEASUREMENT autosar_swc_icas_rtARID_DEF.UnitDelay1_DSTATE_o2 "" UBYTE autosar_swc_icas_CM_uint8 0 0 0 255 ECU_ADDRESS 0xfe4ad950 /* @ECU_Address@autosar_swc_icas_rtARID_DEF.UnitDelay1_DSTATE_o2@ */ /end MEASUREMENT
/begin MEASUREMENT autosar_swc_icas_rtARID_DEF.UnitDelay1_DSTATE_oi "" UBYTE autosar_swc_icas_CM_uint8 0 0 0 255 ECU_ADDRESS 0xfe4ad94d /* @ECU_Address@autosar_swc_icas_rtARID_DEF.UnitDelay1_DSTATE_oi@ */ /end MEASUREMENT
/begin MEASUREMENT autosar_swc_icas_rtARID_DEF.UnitDelay1_DSTATE_ol "" UWORD autosar_swc_icas_CM_uint16 0 0 0 65535 ECU_ADDRESS 0xfe4ad89a /* @ECU_Address@autosar_swc_icas_rtARID_DEF.UnitDelay1_DSTATE_ol@ */ /end MEASUREMENT
/begin MEASUREMENT autosar_swc_icas_rtARID_DEF.UnitDelay1_DSTATE_or "" UWORD autosar_swc_icas_CM_uint16 0 0 0 65535 ECU_ADDRESS 0xfe4ad8a6 /* @ECU_Address@autosar_swc_icas_rtARID_DEF.UnitDelay1_DSTATE_or@ */ /end MEASUREMENT
/begin MEASUREMENT autosar_swc_icas_rtARID_DEF.UnitDelay1_DSTATE_p3 "" UWORD autosar_swc_icas_CM_uint16 0 0 0 65535 ECU_ADDRESS 0xfe4ad8a0 /* @ECU_Address@autosar_swc_icas_rtARID_DEF.UnitDelay1_DSTATE_p3@ */ /end MEASUREMENT
/begin MEASUREMENT autosar_swc_icas_rtARID_DEF.UnitDelay1_DSTATE_pq "" UBYTE autosar_swc_icas_CM_uint8 0 0 0 255 ECU_ADDRESS 0xfe4ad925 /* @ECU_Address@autosar_swc_icas_rtARID_DEF.UnitDelay1_DSTATE_pq@ */ /end MEASUREMENT
/begin MEASUREMENT autosar_swc_icas_rtARID_DEF.UnitDelay1_DSTATE_ps "" UWORD autosar_swc_icas_CM_uint16 0 0 0 65535 ECU_ADDRESS 0xfe4ad87a /* @ECU_Address@autosar_swc_icas_rtARID_DEF.UnitDelay1_DSTATE_ps@ */ /end MEASUREMENT
/begin MEASUREMENT autosar_swc_icas_rtARID_DEF.UnitDelay1_DSTATE_pt "" UWORD autosar_swc_icas_CM_uint16 0 0 0 65535 ECU_ADDRESS 0xfe4ad8fc /* @ECU_Address@autosar_swc_icas_rtARID_DEF.UnitDelay1_DSTATE_pt@ */ /end MEASUREMENT
/begin MEASUREMENT autosar_swc_icas_rtARID_DEF.UnitDelay2_DSTATE_a0 "" UBYTE autosar_swc_icas_CM_logical 0 0 0 1 ECU_ADDRESS 0xfe4ada01 /* @ECU_Address@autosar_swc_icas_rtARID_DEF.UnitDelay2_DSTATE_a0@ */ /end MEASUREMENT
/begin MEASUREMENT autosar_swc_icas_rtARID_DEF.UnitDelay2_DSTATE_c2 "" UBYTE autosar_swc_icas_CM_logical 0 0 0 1 ECU_ADDRESS 0xfe4ada0d /* @ECU_Address@autosar_swc_icas_rtARID_DEF.UnitDelay2_DSTATE_c2@ */ /end MEASUREMENT
/begin MEASUREMENT autosar_swc_icas_rtARID_DEF.UnitDelay2_DSTATE_cp "" UBYTE autosar_swc_icas_CM_logical 0 0 0 1 ECU_ADDRESS 0xfe4ada0b /* @ECU_Address@autosar_swc_icas_rtARID_DEF.UnitDelay2_DSTATE_cp@ */ /end MEASUREMENT
/begin MEASUREMENT autosar_swc_icas_rtARID_DEF.UnitDelay2_DSTATE_e1 "" UBYTE autosar_swc_icas_CM_uint8 0 0 0 255 ECU_ADDRESS 0xfe4ad94b /* @ECU_Address@autosar_swc_icas_rtARID_DEF.UnitDelay2_DSTATE_e1@ */ /end MEASUREMENT
/begin MEASUREMENT autosar_swc_icas_rtARID_DEF.UnitDelay2_DSTATE_ee "" UBYTE autosar_swc_icas_CM_logical 0 0 0 1 ECU_ADDRESS 0xfe4ada17 /* @ECU_Address@autosar_swc_icas_rtARID_DEF.UnitDelay2_DSTATE_ee@ */ /end MEASUREMENT
/begin MEASUREMENT autosar_swc_icas_rtARID_DEF.UnitDelay2_DSTATE_ey "" UBYTE autosar_swc_icas_CM_logical 0 0 0 1 ECU_ADDRESS 0xfe4ada13 /* @ECU_Address@autosar_swc_icas_rtARID_DEF.UnitDelay2_DSTATE_ey@ */ /end MEASUREMENT
/begin MEASUREMENT autosar_swc_icas_rtARID_DEF.UnitDelay2_DSTATE_fh "" UBYTE autosar_swc_icas_CM_logical 0 0 0 1 ECU_ADDRESS 0xfe4ada0a /* @ECU_Address@autosar_swc_icas_rtARID_DEF.UnitDelay2_DSTATE_fh@ */ /end MEASUREMENT
/begin MEASUREMENT autosar_swc_icas_rtARID_DEF.UnitDelay2_DSTATE_fl "" UBYTE autosar_swc_icas_CM_logical 0 0 0 1 ECU_ADDRESS 0xfe4ada16 /* @ECU_Address@autosar_swc_icas_rtARID_DEF.UnitDelay2_DSTATE_fl@ */ /end MEASUREMENT
/begin MEASUREMENT autosar_swc_icas_rtARID_DEF.UnitDelay2_DSTATE_gs "" UBYTE autosar_swc_icas_CM_logical 0 0 0 1 ECU_ADDRESS 0xfe4ada0e /* @ECU_Address@autosar_swc_icas_rtARID_DEF.UnitDelay2_DSTATE_gs@ */ /end MEASUREMENT
/begin MEASUREMENT autosar_swc_icas_rtARID_DEF.UnitDelay2_DSTATE_i1 "" UBYTE autosar_swc_icas_CM_logical 0 0 0 1 ECU_ADDRESS 0xfe4ada0f /* @ECU_Address@autosar_swc_icas_rtARID_DEF.UnitDelay2_DSTATE_i1@ */ /end MEASUREMENT
/begin MEASUREMENT autosar_swc_icas_rtARID_DEF.UnitDelay2_DSTATE_i5 "" UBYTE autosar_swc_icas_CM_logical 0 0 0 1 ECU_ADDRESS 0xfe4ada00 /* @ECU_Address@autosar_swc_icas_rtARID_DEF.UnitDelay2_DSTATE_i5@ */ /end MEASUREMENT
/begin MEASUREMENT autosar_swc_icas_rtARID_DEF.UnitDelay2_DSTATE_ik "" UBYTE autosar_swc_icas_CM_uint8 0 0 0 255 ECU_ADDRESS 0xfe4ad948 /* @ECU_Address@autosar_swc_icas_rtARID_DEF.UnitDelay2_DSTATE_ik@ */ /end MEASUREMENT
/begin MEASUREMENT autosar_swc_icas_rtARID_DEF.UnitDelay2_DSTATE_jj "" UBYTE autosar_swc_icas_CM_logical 0 0 0 1 ECU_ADDRESS 0xfe4ada15 /* @ECU_Address@autosar_swc_icas_rtARID_DEF.UnitDelay2_DSTATE_jj@ */ /end MEASUREMENT
/begin MEASUREMENT autosar_swc_icas_rtARID_DEF.UnitDelay2_DSTATE_k "" UBYTE autosar_swc_icas_CM_uint8 0 0 0 255 ECU_ADDRESS 0xfe4ad94e /* @ECU_Address@autosar_swc_icas_rtARID_DEF.UnitDelay2_DSTATE_k@ */ /end MEASUREMENT
/begin MEASUREMENT autosar_swc_icas_rtARID_DEF.UnitDelay2_DSTATE_kp "" UBYTE autosar_swc_icas_CM_logical 0 0 0 1 ECU_ADDRESS 0xfe4ada10 /* @ECU_Address@autosar_swc_icas_rtARID_DEF.UnitDelay2_DSTATE_kp@ */ /end MEASUREMENT
/begin MEASUREMENT autosar_swc_icas_rtARID_DEF.UnitDelay2_DSTATE_lj "" UBYTE autosar_swc_icas_CM_logical 0 0 0 1 ECU_ADDRESS 0xfe4ada11 /* @ECU_Address@autosar_swc_icas_rtARID_DEF.UnitDelay2_DSTATE_lj@ */ /end MEASUREMENT
/begin MEASUREMENT autosar_swc_icas_rtARID_DEF.UnitDelay2_DSTATE_lu "" UBYTE autosar_swc_icas_CM_logical 0 0 0 1 ECU_ADDRESS 0xfe4ada09 /* @ECU_Address@autosar_swc_icas_rtARID_DEF.UnitDelay2_DSTATE_lu@ */ /end MEASUREMENT
/begin MEASUREMENT autosar_swc_icas_rtARID_DEF.UnitDelay2_DSTATE_m5 "" UBYTE autosar_swc_icas_CM_logical 0 0 0 1 ECU_ADDRESS 0xfe4ada12 /* @ECU_Address@autosar_swc_icas_rtARID_DEF.UnitDelay2_DSTATE_m5@ */ /end MEASUREMENT
/begin MEASUREMENT autosar_swc_icas_rtARID_DEF.UnitDelay2_DSTATE_ml "" UBYTE autosar_swc_icas_CM_logical 0 0 0 1 ECU_ADDRESS 0xfe4ada5c /* @ECU_Address@autosar_swc_icas_rtARID_DEF.UnitDelay2_DSTATE_ml@ */ /end MEASUREMENT
/begin MEASUREMENT autosar_swc_icas_rtARID_DEF.UnitDelay2_DSTATE_nf "" UBYTE autosar_swc_icas_CM_logical 0 0 0 1 ECU_ADDRESS 0xfe4ada5e /* @ECU_Address@autosar_swc_icas_rtARID_DEF.UnitDelay2_DSTATE_nf@ */ /end MEASUREMENT
/begin MEASUREMENT autosar_swc_icas_rtARID_DEF.UnitDelay2_DSTATE_ob "" UBYTE autosar_swc_icas_CM_logical 0 0 0 1 ECU_ADDRESS 0xfe4ada0c /* @ECU_Address@autosar_swc_icas_rtARID_DEF.UnitDelay2_DSTATE_ob@ */ /end MEASUREMENT
/begin MEASUREMENT autosar_swc_icas_rtARID_DEF.UnitDelay2_DSTATE_oz "" UBYTE autosar_swc_icas_CM_logical 0 0 0 1 ECU_ADDRESS 0xfe4ada14 /* @ECU_Address@autosar_swc_icas_rtARID_DEF.UnitDelay2_DSTATE_oz@ */ /end MEASUREMENT
/begin MEASUREMENT autosar_swc_icas_rtARID_DEF.UnitDelay2_DSTATE_p "" UBYTE autosar_swc_icas_CM_uint8 0 0 0 255 ECU_ADDRESS 0xfe4ad928 /* @ECU_Address@autosar_swc_icas_rtARID_DEF.UnitDelay2_DSTATE_p@ */ /end MEASUREMENT
/begin MEASUREMENT autosar_swc_icas_rtARID_DEF.UnitDelay2_DSTATE_pb "" UBYTE autosar_swc_icas_CM_uint8 0 0 0 255 ECU_ADDRESS 0xfe4ad941 /* @ECU_Address@autosar_swc_icas_rtARID_DEF.UnitDelay2_DSTATE_pb@ */ /end MEASUREMENT
/begin MEASUREMENT autosar_swc_icas_rtARID_DEF.UnitDelay2_DSTATE_pf "" UBYTE autosar_swc_icas_CM_logical 0 0 0 1 ECU_ADDRESS 0xfe4ada18 /* @ECU_Address@autosar_swc_icas_rtARID_DEF.UnitDelay2_DSTATE_pf@ */ /end MEASUREMENT
/begin MEASUREMENT autosar_swc_icas_rtARID_DEF.UnitDelay2_DSTATE_pi "" UBYTE autosar_swc_icas_CM_logical 0 0 0 1 ECU_ADDRESS 0xfe4ada5f /* @ECU_Address@autosar_swc_icas_rtARID_DEF.UnitDelay2_DSTATE_pi@ */ /end MEASUREMENT
/begin MEASUREMENT autosar_swc_icas_rtARID_DEF.UnitDelay3_DSTATE "" UBYTE autosar_swc_icas_CM_uint8 0 0 0 255 ECU_ADDRESS 0xfe4ad923 /* @ECU_Address@autosar_swc_icas_rtARID_DEF.UnitDelay3_DSTATE@ */ /end MEASUREMENT
/begin MEASUREMENT autosar_swc_icas_rtARID_DEF.UnitDelay3_DSTATE_d "" UBYTE autosar_swc_icas_CM_logical 0 0 0 1 ECU_ADDRESS 0xfe4ada68 /* @ECU_Address@autosar_swc_icas_rtARID_DEF.UnitDelay3_DSTATE_d@ */ /end MEASUREMENT
/begin MEASUREMENT autosar_swc_icas_rtARID_DEF.UnitDelay3_DSTATE_f "" UBYTE autosar_swc_icas_CM_uint8 0 0 0 255 ECU_ADDRESS 0xfe4ad924 /* @ECU_Address@autosar_swc_icas_rtARID_DEF.UnitDelay3_DSTATE_f@ */ /end MEASUREMENT
/begin MEASUREMENT autosar_swc_icas_rtARID_DEF.UnitDelay3_DSTATE_g "" UBYTE autosar_swc_icas_CM_logical 0 0 0 1 ECU_ADDRESS 0xfe4ada66 /* @ECU_Address@autosar_swc_icas_rtARID_DEF.UnitDelay3_DSTATE_g@ */ /end MEASUREMENT
/begin MEASUREMENT autosar_swc_icas_rtARID_DEF.UnitDelay3_DSTATE_i "" UBYTE autosar_swc_icas_CM_logical 0 0 0 1 ECU_ADDRESS 0xfe4ada67 /* @ECU_Address@autosar_swc_icas_rtARID_DEF.UnitDelay3_DSTATE_i@ */ /end MEASUREMENT
/begin MEASUREMENT autosar_swc_icas_rtARID_DEF.UnitDelay4_DSTATE_f "" UBYTE autosar_swc_icas_CM_logical 0 0 0 1 ECU_ADDRESS 0xfe4ad9db /* @ECU_Address@autosar_swc_icas_rtARID_DEF.UnitDelay4_DSTATE_f@ */ /end MEASUREMENT
/begin MEASUREMENT autosar_swc_icas_rtARID_DEF.UnitDelay5_DSTATE "" UBYTE autosar_swc_icas_CM_uint8 0 0 0 255 ECU_ADDRESS 0xfe4ad926 /* @ECU_Address@autosar_swc_icas_rtARID_DEF.UnitDelay5_DSTATE@ */ /end MEASUREMENT
/begin MEASUREMENT autosar_swc_icas_rtARID_DEF.UnitDelay_DSTATE_a "" UBYTE autosar_swc_icas_CM_uint8 0 0 0 255 ECU_ADDRESS 0xfe4ad940 /* @ECU_Address@autosar_swc_icas_rtARID_DEF.UnitDelay_DSTATE_a@ */ /end MEASUREMENT
/begin MEASUREMENT autosar_swc_icas_rtARID_DEF.UnitDelay_DSTATE_g "" UWORD autosar_swc_icas_CM_uint16 0 0 0 65535 ECU_ADDRESS 0xfe4ad906 /* @ECU_Address@autosar_swc_icas_rtARID_DEF.UnitDelay_DSTATE_g@ */ /end MEASUREMENT
/begin MEASUREMENT autosar_swc_icas_rtARID_DEF.UnitDelay_DSTATE_h "" UWORD autosar_swc_icas_CM_uint16 0 0 0 65535 ECU_ADDRESS 0xfe4ad904 /* @ECU_Address@autosar_swc_icas_rtARID_DEF.UnitDelay_DSTATE_h@ */ /end MEASUREMENT
/begin MEASUREMENT autosar_swc_icas_rtARID_DEF.UnitDelay_DSTATE_jw "" UBYTE autosar_swc_icas_CM_uint8 0 0 0 255 ECU_ADDRESS 0xfe4ad94f /* @ECU_Address@autosar_swc_icas_rtARID_DEF.UnitDelay_DSTATE_jw@ */ /end MEASUREMENT
/begin MEASUREMENT autosar_swc_icas_rtARID_DEF.UnitDelay_DSTATE_l "" UWORD autosar_swc_icas_CM_uint16 0 0 0 65535 ECU_ADDRESS 0xfe4ad902 /* @ECU_Address@autosar_swc_icas_rtARID_DEF.UnitDelay_DSTATE_l@ */ /end MEASUREMENT
/begin MEASUREMENT autosar_swc_icas_rtARID_DEF.UnitDelay_DSTATE_n "" UBYTE autosar_swc_icas_CM_uint8 0 0 0 255 ECU_ADDRESS 0xfe4ad949 /* @ECU_Address@autosar_swc_icas_rtARID_DEF.UnitDelay_DSTATE_n@ */ /end MEASUREMENT
/begin MEASUREMENT autosar_swc_icas_rtARID_DEF.UnitDelay_DSTATE_ps "" UBYTE autosar_swc_icas_CM_uint8 0 0 0 255 ECU_ADDRESS 0xfe4ad94c /* @ECU_Address@autosar_swc_icas_rtARID_DEF.UnitDelay_DSTATE_ps@ */ /end MEASUREMENT
/begin MEASUREMENT autosar_swc_icas_rtARID_DEF.a "" UBYTE autosar_swc_icas_CM_uint8 0 0 0 255 ECU_ADDRESS 0xfe4ad9ac /* @ECU_Address@autosar_swc_icas_rtARID_DEF.a@ */ /end MEASUREMENT
/begin MEASUREMENT autosar_swc_icas_rtARID_DEF.cnt "" UBYTE autosar_swc_icas_CM_uint8 0 0 0 255 ECU_ADDRESS 0xfe4ad91a /* @ECU_Address@autosar_swc_icas_rtARID_DEF.cnt@ */ /end MEASUREMENT
/begin MEASUREMENT autosar_swc_icas_rtARID_DEF.cnt_m "" UBYTE autosar_swc_icas_CM_uint8 0 0 0 255 ECU_ADDRESS 0xfe4ad959 /* @ECU_Address@autosar_swc_icas_rtARID_DEF.cnt_m@ */ /end MEASUREMENT
/begin MEASUREMENT autosar_swc_icas_rtARID_DEF.dis "" FLOAT32_IEEE autosar_swc_icas_CM_single 0 0 -3.4E+38 3.4E+38 ECU_ADDRESS 0xfe4ad7f8 /* @ECU_Address@autosar_swc_icas_rtARID_DEF.dis@ */ /end MEASUREMENT
/begin MEASUREMENT autosar_swc_icas_rtARID_DEF.i_d "" UBYTE autosar_swc_icas_CM_uint8 0 0 0 255 ECU_ADDRESS 0xfe4ad9b0 /* @ECU_Address@autosar_swc_icas_rtARID_DEF.i_d@ */ /end MEASUREMENT
/begin MEASUREMENT autosar_swc_icas_rtARID_DEF.i_dh "" UBYTE autosar_swc_icas_CM_uint8 0 0 0 255 ECU_ADDRESS 0xfe4ad9bc /* @ECU_Address@autosar_swc_icas_rtARID_DEF.i_dh@ */ /end MEASUREMENT
/begin MEASUREMENT autosar_swc_icas_rtARID_DEF.i_ef "" UBYTE autosar_swc_icas_CM_uint8 0 0 0 255 ECU_ADDRESS 0xfe4ad9a1 /* @ECU_Address@autosar_swc_icas_rtARID_DEF.i_ef@ */ /end MEASUREMENT
/begin MEASUREMENT autosar_swc_icas_rtARID_DEF.i_fr "" UBYTE autosar_swc_icas_CM_uint8 0 0 0 255 ECU_ADDRESS 0xfe4ad9b6 /* @ECU_Address@autosar_swc_icas_rtARID_DEF.i_fr@ */ /end MEASUREMENT
/begin MEASUREMENT autosar_swc_icas_rtARID_DEF.i_g "" UBYTE autosar_swc_icas_CM_uint8 0 0 0 255 ECU_ADDRESS 0xfe4ad990 /* @ECU_Address@autosar_swc_icas_rtARID_DEF.i_g@ */ /end MEASUREMENT
/begin MEASUREMENT autosar_swc_icas_rtARID_DEF.i_i "" UBYTE autosar_swc_icas_CM_uint8 0 0 0 255 ECU_ADDRESS 0xfe4ad9a7 /* @ECU_Address@autosar_swc_icas_rtARID_DEF.i_i@ */ /end MEASUREMENT
/begin MEASUREMENT autosar_swc_icas_rtARID_DEF.i_k "" UWORD autosar_swc_icas_CM_uint16 0 0 0 65535 ECU_ADDRESS 0xfe4ad90c /* @ECU_Address@autosar_swc_icas_rtARID_DEF.i_k@ */ /end MEASUREMENT
/begin MEASUREMENT autosar_swc_icas_rtARID_DEF.i_m "" UWORD autosar_swc_icas_CM_uint16 0 0 0 65535 ECU_ADDRESS 0xfe4ad90a /* @ECU_Address@autosar_swc_icas_rtARID_DEF.i_m@ */ /end MEASUREMENT
/begin MEASUREMENT autosar_swc_icas_rtARID_DEF.i_n "" UBYTE autosar_swc_icas_CM_uint8 0 0 0 255 ECU_ADDRESS 0xfe4ad987 /* @ECU_Address@autosar_swc_icas_rtARID_DEF.i_n@ */ /end MEASUREMENT
/begin MEASUREMENT autosar_swc_icas_rtARID_DEF.io "" UWORD autosar_swc_icas_CM_uint16 0 0 0 65535 ECU_ADDRESS 0xfe4ad836 /* @ECU_Address@autosar_swc_icas_rtARID_DEF.io@ */ /end MEASUREMENT
/begin MEASUREMENT autosar_swc_icas_rtARID_DEF.is_Active_d "" UBYTE autosar_swc_icas_CM_uint8 0 0 0 255 ECU_ADDRESS 0xfe4ad99a /* @ECU_Address@autosar_swc_icas_rtARID_DEF.is_Active_d@ */ /end MEASUREMENT
/begin MEASUREMENT autosar_swc_icas_rtARID_DEF.is_Available "" UBYTE autosar_swc_icas_CM_uint8 0 0 0 255 ECU_ADDRESS 0xfe4ad9c4 /* @ECU_Address@autosar_swc_icas_rtARID_DEF.is_Available@ */ /end MEASUREMENT
/begin MEASUREMENT autosar_swc_icas_rtARID_DEF.is_Inform "" UBYTE autosar_swc_icas_CM_uint8 0 0 0 255 ECU_ADDRESS 0xfe4ad9a6 /* @ECU_Address@autosar_swc_icas_rtARID_DEF.is_Inform@ */ /end MEASUREMENT
/begin MEASUREMENT autosar_swc_icas_rtARID_DEF.is_InformActive "" UBYTE autosar_swc_icas_CM_uint8 0 0 0 255 ECU_ADDRESS 0xfe4ad99e /* @ECU_Address@autosar_swc_icas_rtARID_DEF.is_InformActive@ */ /end MEASUREMENT
/begin MEASUREMENT autosar_swc_icas_rtARID_DEF.is_NOA "" UBYTE autosar_swc_icas_CM_uint8 0 0 0 255 ECU_ADDRESS 0xfe4ad9bf /* @ECU_Address@autosar_swc_icas_rtARID_DEF.is_NOA@ */ /end MEASUREMENT
/begin MEASUREMENT autosar_swc_icas_rtARID_DEF.is_OUTPUT "" UBYTE autosar_swc_icas_CM_uint8 0 0 0 255 ECU_ADDRESS 0xfe4ad9af /* @ECU_Address@autosar_swc_icas_rtARID_DEF.is_OUTPUT@ */ /end MEASUREMENT
/begin MEASUREMENT autosar_swc_icas_rtARID_DEF.is_On_c "" UBYTE autosar_swc_icas_CM_uint8 0 0 0 255 ECU_ADDRESS 0xfe4ad99d /* @ECU_Address@autosar_swc_icas_rtARID_DEF.is_On_c@ */ /end MEASUREMENT
/begin MEASUREMENT autosar_swc_icas_rtARID_DEF.is_On_p "" UBYTE autosar_swc_icas_CM_uint8 0 0 0 255 ECU_ADDRESS 0xfe4ad999 /* @ECU_Address@autosar_swc_icas_rtARID_DEF.is_On_p@ */ /end MEASUREMENT
/begin MEASUREMENT autosar_swc_icas_rtARID_DEF.is_Ready "" UBYTE autosar_swc_icas_CM_uint8 0 0 0 255 ECU_ADDRESS 0xfe4ad9b3 /* @ECU_Address@autosar_swc_icas_rtARID_DEF.is_Ready@ */ /end MEASUREMENT
/begin MEASUREMENT autosar_swc_icas_rtARID_DEF.is_active_c117_autosar_swc_icas "" UBYTE autosar_swc_icas_CM_uint8 0 0 0 255 ECU_ADDRESS 0xfe4ad9c2 /* @ECU_Address@autosar_swc_icas_rtARID_DEF.is_active_c117_autosar_swc_icas@ */ /end MEASUREMENT
/begin MEASUREMENT autosar_swc_icas_rtARID_DEF.is_active_c123_autosar_swc_icas "" UBYTE autosar_swc_icas_CM_uint8 0 0 0 255 ECU_ADDRESS 0xfe4ad9c0 /* @ECU_Address@autosar_swc_icas_rtARID_DEF.is_active_c123_autosar_swc_icas@ */ /end MEASUREMENT
/begin MEASUREMENT autosar_swc_icas_rtARID_DEF.is_active_c126_autosar_swc_icas "" UBYTE autosar_swc_icas_CM_uint8 0 0 0 255 ECU_ADDRESS 0xfe4ad9b4 /* @ECU_Address@autosar_swc_icas_rtARID_DEF.is_active_c126_autosar_swc_icas@ */ /end MEASUREMENT
/begin MEASUREMENT autosar_swc_icas_rtARID_DEF.is_active_c135_autosar_swc_icas "" UBYTE autosar_swc_icas_CM_uint8 0 0 0 255 ECU_ADDRESS 0xfe4ad9ad /* @ECU_Address@autosar_swc_icas_rtARID_DEF.is_active_c135_autosar_swc_icas@ */ /end MEASUREMENT
/begin MEASUREMENT autosar_swc_icas_rtARID_DEF.is_active_c148_autosar_swc_icas "" UBYTE autosar_swc_icas_CM_uint8 0 0 0 255 ECU_ADDRESS 0xfe4ad9aa /* @ECU_Address@autosar_swc_icas_rtARID_DEF.is_active_c148_autosar_swc_icas@ */ /end MEASUREMENT
/begin MEASUREMENT autosar_swc_icas_rtARID_DEF.is_active_c149_autosar_swc_icas "" UBYTE autosar_swc_icas_CM_uint8 0 0 0 255 ECU_ADDRESS 0xfe4ad9a8 /* @ECU_Address@autosar_swc_icas_rtARID_DEF.is_active_c149_autosar_swc_icas@ */ /end MEASUREMENT
/begin MEASUREMENT autosar_swc_icas_rtARID_DEF.is_active_c20_autosar_swc_icas "" UBYTE autosar_swc_icas_CM_uint8 0 0 0 255 ECU_ADDRESS 0xfe4ad9b1 /* @ECU_Address@autosar_swc_icas_rtARID_DEF.is_active_c20_autosar_swc_icas@ */ /end MEASUREMENT
/begin MEASUREMENT autosar_swc_icas_rtARID_DEF.is_active_c21_autosar_swc_icas "" UBYTE autosar_swc_icas_CM_uint8 0 0 0 255 ECU_ADDRESS 0xfe4ad9bd /* @ECU_Address@autosar_swc_icas_rtARID_DEF.is_active_c21_autosar_swc_icas@ */ /end MEASUREMENT
/begin MEASUREMENT autosar_swc_icas_rtARID_DEF.is_active_c22_autosar_swc_icas "" UBYTE autosar_swc_icas_CM_uint8 0 0 0 255 ECU_ADDRESS 0xfe4ad9ba /* @ECU_Address@autosar_swc_icas_rtARID_DEF.is_active_c22_autosar_swc_icas@ */ /end MEASUREMENT
/begin MEASUREMENT autosar_swc_icas_rtARID_DEF.is_active_c237_autosar_swc_icas "" UBYTE autosar_swc_icas_CM_uint8 0 0 0 255 ECU_ADDRESS 0xfe4ad99b /* @ECU_Address@autosar_swc_icas_rtARID_DEF.is_active_c237_autosar_swc_icas@ */ /end MEASUREMENT
/begin MEASUREMENT autosar_swc_icas_rtARID_DEF.is_active_c269_autosar_swc_icas "" UBYTE autosar_swc_icas_CM_uint8 0 0 0 255 ECU_ADDRESS 0xfe4ad997 /* @ECU_Address@autosar_swc_icas_rtARID_DEF.is_active_c269_autosar_swc_icas@ */ /end MEASUREMENT
/begin MEASUREMENT autosar_swc_icas_rtARID_DEF.is_active_c271_autosar_swc_icas "" UBYTE autosar_swc_icas_CM_uint8 0 0 0 255 ECU_ADDRESS 0xfe4ad995 /* @ECU_Address@autosar_swc_icas_rtARID_DEF.is_active_c271_autosar_swc_icas@ */ /end MEASUREMENT
/begin MEASUREMENT autosar_swc_icas_rtARID_DEF.is_active_c272_autosar_swc_icas "" UBYTE autosar_swc_icas_CM_uint8 0 0 0 255 ECU_ADDRESS 0xfe4ad993 /* @ECU_Address@autosar_swc_icas_rtARID_DEF.is_active_c272_autosar_swc_icas@ */ /end MEASUREMENT
/begin MEASUREMENT autosar_swc_icas_rtARID_DEF.is_active_c27_autosar_swc_icas "" UBYTE autosar_swc_icas_CM_uint8 0 0 0 255 ECU_ADDRESS 0xfe4ad9b7 /* @ECU_Address@autosar_swc_icas_rtARID_DEF.is_active_c27_autosar_swc_icas@ */ /end MEASUREMENT
/begin MEASUREMENT autosar_swc_icas_rtARID_DEF.is_active_c38_autosar_swc_icas "" UBYTE autosar_swc_icas_CM_uint8 0 0 0 255 ECU_ADDRESS 0xfe4ad98b /* @ECU_Address@autosar_swc_icas_rtARID_DEF.is_active_c38_autosar_swc_icas@ */ /end MEASUREMENT
/begin MEASUREMENT autosar_swc_icas_rtARID_DEF.is_active_c39_autosar_swc_icas "" UBYTE autosar_swc_icas_CM_uint8 0 0 0 255 ECU_ADDRESS 0xfe4ad988 /* @ECU_Address@autosar_swc_icas_rtARID_DEF.is_active_c39_autosar_swc_icas@ */ /end MEASUREMENT
/begin MEASUREMENT autosar_swc_icas_rtARID_DEF.is_active_c3_autosar_swc_icas "" UBYTE autosar_swc_icas_CM_uint8 0 0 0 255 ECU_ADDRESS 0xfe4ad9a4 /* @ECU_Address@autosar_swc_icas_rtARID_DEF.is_active_c3_autosar_swc_icas@ */ /end MEASUREMENT
/begin MEASUREMENT autosar_swc_icas_rtARID_DEF.is_active_c40_autosar_swc_icas "" UBYTE autosar_swc_icas_CM_uint8 0 0 0 255 ECU_ADDRESS 0xfe4ad991 /* @ECU_Address@autosar_swc_icas_rtARID_DEF.is_active_c40_autosar_swc_icas@ */ /end MEASUREMENT
/begin MEASUREMENT autosar_swc_icas_rtARID_DEF.is_active_c47_autosar_swc_icas "" UBYTE autosar_swc_icas_CM_uint8 0 0 0 255 ECU_ADDRESS 0xfe4ad9a2 /* @ECU_Address@autosar_swc_icas_rtARID_DEF.is_active_c47_autosar_swc_icas@ */ /end MEASUREMENT
/begin MEASUREMENT autosar_swc_icas_rtARID_DEF.is_active_c774_autosar_swc_icas "" UBYTE autosar_swc_icas_CM_uint8 0 0 0 255 ECU_ADDRESS 0xfe4ad98e /* @ECU_Address@autosar_swc_icas_rtARID_DEF.is_active_c774_autosar_swc_icas@ */ /end MEASUREMENT
/begin MEASUREMENT autosar_swc_icas_rtARID_DEF.is_buffer "" UBYTE autosar_swc_icas_CM_uint8 0 0 0 255 ECU_ADDRESS 0xfe4ad98a /* @ECU_Address@autosar_swc_icas_rtARID_DEF.is_buffer@ */ /end MEASUREMENT
/begin MEASUREMENT autosar_swc_icas_rtARID_DEF.is_c117_autosar_swc_icas "" UBYTE autosar_swc_icas_CM_uint8 0 0 0 255 ECU_ADDRESS 0xfe4ad9c3 /* @ECU_Address@autosar_swc_icas_rtARID_DEF.is_c117_autosar_swc_icas@ */ /end MEASUREMENT
/begin MEASUREMENT autosar_swc_icas_rtARID_DEF.is_c123_autosar_swc_icas "" UBYTE autosar_swc_icas_CM_uint8 0 0 0 255 ECU_ADDRESS 0xfe4ad9c1 /* @ECU_Address@autosar_swc_icas_rtARID_DEF.is_c123_autosar_swc_icas@ */ /end MEASUREMENT
/begin MEASUREMENT autosar_swc_icas_rtARID_DEF.is_c126_autosar_swc_icas "" UBYTE autosar_swc_icas_CM_uint8 0 0 0 255 ECU_ADDRESS 0xfe4ad9b5 /* @ECU_Address@autosar_swc_icas_rtARID_DEF.is_c126_autosar_swc_icas@ */ /end MEASUREMENT
/begin MEASUREMENT autosar_swc_icas_rtARID_DEF.is_c135_autosar_swc_icas "" UBYTE autosar_swc_icas_CM_uint8 0 0 0 255 ECU_ADDRESS 0xfe4ad9ae /* @ECU_Address@autosar_swc_icas_rtARID_DEF.is_c135_autosar_swc_icas@ */ /end MEASUREMENT
/begin MEASUREMENT autosar_swc_icas_rtARID_DEF.is_c148_autosar_swc_icas "" UBYTE autosar_swc_icas_CM_uint8 0 0 0 255 ECU_ADDRESS 0xfe4ad9ab /* @ECU_Address@autosar_swc_icas_rtARID_DEF.is_c148_autosar_swc_icas@ */ /end MEASUREMENT
/begin MEASUREMENT autosar_swc_icas_rtARID_DEF.is_c149_autosar_swc_icas "" UBYTE autosar_swc_icas_CM_uint8 0 0 0 255 ECU_ADDRESS 0xfe4ad9a9 /* @ECU_Address@autosar_swc_icas_rtARID_DEF.is_c149_autosar_swc_icas@ */ /end MEASUREMENT
/begin MEASUREMENT autosar_swc_icas_rtARID_DEF.is_c20_autosar_swc_icas "" UBYTE autosar_swc_icas_CM_uint8 0 0 0 255 ECU_ADDRESS 0xfe4ad9b2 /* @ECU_Address@autosar_swc_icas_rtARID_DEF.is_c20_autosar_swc_icas@ */ /end MEASUREMENT
/begin MEASUREMENT autosar_swc_icas_rtARID_DEF.is_c21_autosar_swc_icas "" UBYTE autosar_swc_icas_CM_uint8 0 0 0 255 ECU_ADDRESS 0xfe4ad9be /* @ECU_Address@autosar_swc_icas_rtARID_DEF.is_c21_autosar_swc_icas@ */ /end MEASUREMENT
/begin MEASUREMENT autosar_swc_icas_rtARID_DEF.is_c22_autosar_swc_icas "" UBYTE autosar_swc_icas_CM_uint8 0 0 0 255 ECU_ADDRESS 0xfe4ad9bb /* @ECU_Address@autosar_swc_icas_rtARID_DEF.is_c22_autosar_swc_icas@ */ /end MEASUREMENT
/begin MEASUREMENT autosar_swc_icas_rtARID_DEF.is_c237_autosar_swc_icas "" UBYTE autosar_swc_icas_CM_uint8 0 0 0 255 ECU_ADDRESS 0xfe4ad99c /* @ECU_Address@autosar_swc_icas_rtARID_DEF.is_c237_autosar_swc_icas@ */ /end MEASUREMENT
/begin MEASUREMENT autosar_swc_icas_rtARID_DEF.is_c269_autosar_swc_icas "" UBYTE autosar_swc_icas_CM_uint8 0 0 0 255 ECU_ADDRESS 0xfe4ad998 /* @ECU_Address@autosar_swc_icas_rtARID_DEF.is_c269_autosar_swc_icas@ */ /end MEASUREMENT
/begin MEASUREMENT autosar_swc_icas_rtARID_DEF.is_c271_autosar_swc_icas "" UBYTE autosar_swc_icas_CM_uint8 0 0 0 255 ECU_ADDRESS 0xfe4ad996 /* @ECU_Address@autosar_swc_icas_rtARID_DEF.is_c271_autosar_swc_icas@ */ /end MEASUREMENT
/begin MEASUREMENT autosar_swc_icas_rtARID_DEF.is_c272_autosar_swc_icas "" UBYTE autosar_swc_icas_CM_uint8 0 0 0 255 ECU_ADDRESS 0xfe4ad994 /* @ECU_Address@autosar_swc_icas_rtARID_DEF.is_c272_autosar_swc_icas@ */ /end MEASUREMENT
/begin MEASUREMENT autosar_swc_icas_rtARID_DEF.is_c27_autosar_swc_icas "" UBYTE autosar_swc_icas_CM_uint8 0 0 0 255 ECU_ADDRESS 0xfe4ad9b8 /* @ECU_Address@autosar_swc_icas_rtARID_DEF.is_c27_autosar_swc_icas@ */ /end MEASUREMENT
/begin MEASUREMENT autosar_swc_icas_rtARID_DEF.is_c38_autosar_swc_icas "" UBYTE autosar_swc_icas_CM_uint8 0 0 0 255 ECU_ADDRESS 0xfe4ad98c /* @ECU_Address@autosar_swc_icas_rtARID_DEF.is_c38_autosar_swc_icas@ */ /end MEASUREMENT
/begin MEASUREMENT autosar_swc_icas_rtARID_DEF.is_c39_autosar_swc_icas "" UBYTE autosar_swc_icas_CM_uint8 0 0 0 255 ECU_ADDRESS 0xfe4ad989 /* @ECU_Address@autosar_swc_icas_rtARID_DEF.is_c39_autosar_swc_icas@ */ /end MEASUREMENT
/begin MEASUREMENT autosar_swc_icas_rtARID_DEF.is_c3_autosar_swc_icas "" UBYTE autosar_swc_icas_CM_uint8 0 0 0 255 ECU_ADDRESS 0xfe4ad9a5 /* @ECU_Address@autosar_swc_icas_rtARID_DEF.is_c3_autosar_swc_icas@ */ /end MEASUREMENT
/begin MEASUREMENT autosar_swc_icas_rtARID_DEF.is_c40_autosar_swc_icas "" UBYTE autosar_swc_icas_CM_uint8 0 0 0 255 ECU_ADDRESS 0xfe4ad992 /* @ECU_Address@autosar_swc_icas_rtARID_DEF.is_c40_autosar_swc_icas@ */ /end MEASUREMENT
/begin MEASUREMENT autosar_swc_icas_rtARID_DEF.is_c47_autosar_swc_icas "" UBYTE autosar_swc_icas_CM_uint8 0 0 0 255 ECU_ADDRESS 0xfe4ad9a3 /* @ECU_Address@autosar_swc_icas_rtARID_DEF.is_c47_autosar_swc_icas@ */ /end MEASUREMENT
/begin MEASUREMENT autosar_swc_icas_rtARID_DEF.is_c774_autosar_swc_icas "" UBYTE autosar_swc_icas_CM_uint8 0 0 0 255 ECU_ADDRESS 0xfe4ad98f /* @ECU_Address@autosar_swc_icas_rtARID_DEF.is_c774_autosar_swc_icas@ */ /end MEASUREMENT
/begin MEASUREMENT autosar_swc_icas_rtARID_DEF.is_debounce "" UBYTE autosar_swc_icas_CM_uint8 0 0 0 255 ECU_ADDRESS 0xfe4ad9b9 /* @ECU_Address@autosar_swc_icas_rtARID_DEF.is_debounce@ */ /end MEASUREMENT
/begin MEASUREMENT autosar_swc_icas_rtARID_DEF.is_waiting "" UBYTE autosar_swc_icas_CM_uint8 0 0 0 255 ECU_ADDRESS 0xfe4ad98d /* @ECU_Address@autosar_swc_icas_rtARID_DEF.is_waiting@ */ /end MEASUREMENT
/begin MEASUREMENT autosar_swc_icas_rtARID_DEF.j "" UWORD autosar_swc_icas_CM_uint16 0 0 0 65535 ECU_ADDRESS 0xfe4ad910 /* @ECU_Address@autosar_swc_icas_rtARID_DEF.j@ */ /end MEASUREMENT
/begin MEASUREMENT autosar_swc_icas_rtARID_DEF.out_d "" UBYTE autosar_swc_icas_CM_logical 0 0 0 1 ECU_ADDRESS 0xfe4ad9d3 /* @ECU_Address@autosar_swc_icas_rtARID_DEF.out_d@ */ /end MEASUREMENT
/begin MEASUREMENT autosar_swc_icas_rtARID_DEF.out_di "" UBYTE autosar_swc_icas_CM_logical 0 0 0 1 LAYOUT COLUMN_DIR MATRIX_DIM 2 ECU_ADDRESS 0xfe4ad9c5 /* @ECU_Address@autosar_swc_icas_rtARID_DEF.out_di@ */ /end MEASUREMENT
/begin MEASUREMENT autosar_swc_icas_rtARID_DEF.out_g "" UBYTE autosar_swc_icas_CM_logical 0 0 0 1 MATRIX_DIM 1 1 ECU_ADDRESS 0xfe4ad9d8 /* @ECU_Address@autosar_swc_icas_rtARID_DEF.out_g@ */ /end MEASUREMENT
/begin MEASUREMENT autosar_swc_icas_rtARID_DEF.out_k2 "" UBYTE autosar_swc_icas_CM_logical 0 0 0 1 ECU_ADDRESS 0xfe4ad9d2 /* @ECU_Address@autosar_swc_icas_rtARID_DEF.out_k2@ */ /end MEASUREMENT
/begin MEASUREMENT autosar_swc_icas_rtARID_DEF.out_l "" UBYTE autosar_swc_icas_CM_logical 0 0 0 1 MATRIX_DIM 1 1 ECU_ADDRESS 0xfe4ad9d9 /* @ECU_Address@autosar_swc_icas_rtARID_DEF.out_l@ */ /end MEASUREMENT
/begin MEASUREMENT autosar_swc_icas_rtARID_DEF.out_n "" UBYTE autosar_swc_icas_CM_uint8 0 0 0 255 MATRIX_DIM 1 1 ECU_ADDRESS 0xfe4ad91c /* @ECU_Address@autosar_swc_icas_rtARID_DEF.out_n@ */ /end MEASUREMENT
/begin MEASUREMENT autosar_swc_icas_rtARID_DEF.out_o "" UBYTE autosar_swc_icas_CM_logical 0 0 0 1 ECU_ADDRESS 0xfe4ad9d4 /* @ECU_Address@autosar_swc_icas_rtARID_DEF.out_o@ */ /end MEASUREMENT
/begin MEASUREMENT autosar_swc_icas_rtARID_DEF.output "" UBYTE autosar_swc_icas_CM_uint8 0 0 0 255 MATRIX_DIM 1 1 ECU_ADDRESS 0xfe4ad91d /* @ECU_Address@autosar_swc_icas_rtARID_DEF.output@ */ /end MEASUREMENT
/begin MEASUREMENT autosar_swc_icas_rtARID_DEF.s "" UWORD autosar_swc_icas_CM_uint16 0 0 0 65535 ECU_ADDRESS 0xfe4ad90e /* @ECU_Address@autosar_swc_icas_rtARID_DEF.s@ */ /end MEASUREMENT
/begin MEASUREMENT autosar_swc_icas_rtARID_DEF.spd1 "" UBYTE autosar_swc_icas_CM_uint8 0 0 0 255 ECU_ADDRESS 0xfe4ad99f /* @ECU_Address@autosar_swc_icas_rtARID_DEF.spd1@ */ /end MEASUREMENT
/begin MEASUREMENT autosar_swc_icas_rtARID_DEF.spd2 "" UBYTE autosar_swc_icas_CM_uint8 0 0 0 255 ECU_ADDRESS 0xfe4ad9a0 /* @ECU_Address@autosar_swc_icas_rtARID_DEF.spd2@ */ /end MEASUREMENT
/begin AXIS_PTS P_CSM_NOASPLSpdLimX "" 0xfe820f90 /* @ECU_Address@P_CSM_NOASPLSpdLimX@ */ NO_INPUT_QUANTITY Axis_UWORD 0 autosar_swc_icas_CM_uint16 10 0 65535 /end AXIS_PTS
/begin COMPU_METHOD autosar_swc_icas_CM_SM_MODULE_STATUS "Enumerated data type: SM_MODULE_STATUS" TAB_VERB "%0.6" "" COMPU_TAB_REF VTAB_FOR_autosar_swc_icas_CM_SM_MODULE_STATUS /end COMPU_METHOD
/begin COMPU_VTAB VTAB_FOR_autosar_swc_icas_CM_SM_MODULE_STATUS "Enumerated data type: SM_MODULE_STATUS" TAB_VERB 4 0 "STATUS_NORMAL" 1 "STATUS_NOT_CONNECTED" 2 "STATUS_HEARTBEAT_MISSED" 3 "STATUS_ABNORMAL" /end COMPU_VTAB
/begin COMPU_METHOD autosar_swc_icas_CM_boolean "Q = V" IDENTICAL "%1.0" "" /end COMPU_METHOD
/begin COMPU_METHOD autosar_swc_icas_CM_int8 "Q = V" IDENTICAL "%3.0" "" /end COMPU_METHOD
/begin COMPU_METHOD autosar_swc_icas_CM_logical "Q = V" IDENTICAL "%1.0" "" /end COMPU_METHOD
/begin COMPU_METHOD autosar_swc_icas_CM_single "Q = V" IDENTICAL "%8.6" "" /end COMPU_METHOD
/begin COMPU_METHOD autosar_swc_icas_CM_uint16 "Q = V" IDENTICAL "%5.0" "" /end COMPU_METHOD
/begin COMPU_METHOD autosar_swc_icas_CM_uint32 "Q = V" IDENTICAL "%10.0" "" /end COMPU_METHOD
/begin COMPU_METHOD autosar_swc_icas_CM_uint64 "Q = V" IDENTICAL "%20.0" "" /end COMPU_METHOD
/begin COMPU_METHOD autosar_swc_icas_CM_uint8 "Q = V" IDENTICAL "%3.0" "" /end COMPU_METHOD
/begin RECORD_LAYOUT Record_BOOLEAN FNC_VALUES 1 UBYTE COLUMN_DIR DIRECT /end RECORD_LAYOUT
/begin RECORD_LAYOUT Record_FLOAT32_IEEE FNC_VALUES 1 FLOAT32_IEEE COLUMN_DIR DIRECT /end RECORD_LAYOUT
/begin RECORD_LAYOUT Record_UBYTE FNC_VALUES 1 UBYTE COLUMN_DIR DIRECT /end RECORD_LAYOUT
/begin RECORD_LAYOUT Record_UWORD FNC_VALUES 1 UWORD COLUMN_DIR DIRECT /end RECORD_LAYOUT
/begin RECORD_LAYOUT Axis_UWORD AXIS_PTS_X 1 UWORD INDEX_INCR DIRECT /end RECORD_LAYOUT
/begin GROUP ICAS_ExecTimestamp ""
 /begin REF_MEASUREMENT ICAS_ExecTimestamp.timeBaseStatus ICAS_ExecTimestamp.nanoseconds ICAS_ExecTimestamp.seconds /end REF_MEASUREMENT
/end GROUP
/begin GROUP SwcOut_CSM_CSC_HMI ""
 /begin REF_MEASUREMENT SwcOut_CSM_CSC_HMI.CruiseSpdValueHMI SwcOut_CSM_CSC_HMI.TimeGapLevelHMI SwcOut_CSM_CSC_HMI.InfoDispHMI SwcOut_CSM_CSC_HMI.ISL_Sts SwcOut_CSM_CSC_HMI.ISL_SetSpdAdjReq SwcOut_CSM_CSC_HMI.ISL_SetSpdAdjVal SwcOut_CSM_CSC_HMI.ISL_NOA_SPL_kph SwcOut_CSM_CSC_HMI.ISL_NOA_SPL_Distance2Split SwcOut_CSM_CSC_HMI.ISL_iAccLoLim_kph SwcOut_CSM_CSC_HMI.ISL_iAccHiLim_kph /end REF_MEASUREMENT
/end GROUP
/begin GROUP SwcOut_CSM_CTRL ""
 /begin REF_MEASUREMENT SwcOut_CSM_CTRL.VsetBelowMin SwcOut_CSM_CTRL.CruiseSpdCtrlLevel SwcOut_CSM_CTRL.TimeGapLevel SwcOut_CSM_CTRL.CruiseSpdKmh SwcOut_CSM_CTRL.ISL_APSpdLimSPL SwcOut_CSM_CTRL.ISL_APSpdLimDist /end REF_MEASUREMENT
/end GROUP
/begin GROUP SwcOut_CSM_TSR_HMI ""
 /begin REF_MEASUREMENT SwcOut_CSM_TSR_HMI.TSRSpdLimWarn SwcOut_CSM_TSR_HMI.TSRConSpdLimWarn SwcOut_CSM_TSR_HMI.TSR_Snvty SwcOut_CSM_TSR_HMI.TSRSts SwcOut_CSM_TSR_HMI.TSRSpdLimUnit SwcOut_CSM_TSR_HMI.TSRSpdLimSts SwcOut_CSM_TSR_HMI.TSRSpdLim SwcOut_CSM_TSR_HMI.TSRSpdLimCfdc SwcOut_CSM_TSR_HMI.TSRConSpdLim SwcOut_CSM_TSR_HMI.TSR_GiveWay SwcOut_CSM_TSR_HMI.TSR_LongTimeDisplay SwcOut_CSM_TSR_HMI.TSR_Forbidden SwcOut_CSM_TSR_HMI.TSRTrfcSignValCfdc /end REF_MEASUREMENT
/end GROUP
/begin GROUP SwcOut_ICAS_HMI ""
 /begin REF_MEASUREMENT SwcOut_ICAS_HMI.EcallReq SwcOut_ICAS_HMI.ParkShiftReq SwcOut_ICAS_HMI.ACC_ModDisp SwcOut_ICAS_HMI.LCC_ModeDisp SwcOut_ICAS_HMI.ALC_ModeDisp SwcOut_ICAS_HMI.NOA_ModeDisp SwcOut_ICAS_HMI.DAI_ModeDisp SwcOut_ICAS_HMI.Nudge_ModeDisp SwcOut_ICAS_HMI.IHBC_ModeDisp SwcOut_ICAS_HMI.HighLowBeamReq SwcOut_ICAS_HMI.HazActv SwcOut_ICAS_HMI.TurnLampReq SwcOut_ICAS_HMI.DriveOffDisp SwcOut_ICAS_HMI.HandsOffWarningLevel SwcOut_ICAS_HMI.DriverInloopMonitor SwcOut_ICAS_HMI.WarningLevel SwcOut_ICAS_HMI.InfoDispHMI /end REF_MEASUREMENT
/end GROUP
/begin GROUP SwcOut_ICAS_Herbeat_Info ""
 /begin REF_MEASUREMENT SwcOut_ICAS_Herbeat_Info.swc_id SwcOut_ICAS_Herbeat_Info.sequence_num SwcOut_ICAS_Herbeat_Info.inner_error SwcOut_ICAS_Herbeat_Info.module_status /end REF_MEASUREMENT
/end GROUP
/begin GROUP SwcOut_ICAS_STATE ""
 /begin REF_MEASUREMENT SwcOut_ICAS_STATE.acc_sts SwcOut_ICAS_STATE.lcc_sts SwcOut_ICAS_STATE.nudge_sts SwcOut_ICAS_STATE.alc_sts SwcOut_ICAS_STATE.noa_sts SwcOut_ICAS_STATE.lc_req_sync_id SwcOut_ICAS_STATE.acc_manual_act_faile_reason SwcOut_ICAS_STATE.acc_exit_reason SwcOut_ICAS_STATE.lcc_manual_act_faile_reason SwcOut_ICAS_STATE.lcc_auto_act_faile_reason SwcOut_ICAS_STATE.lcc_exit_to_idle_reason SwcOut_ICAS_STATE.lcc_exit_to_wait_reason SwcOut_ICAS_STATE.lcc_exit_to_mrc_reason SwcOut_ICAS_STATE.lcc_mrc_exit_reason SwcOut_ICAS_STATE.noa_auto_act_faile_reason SwcOut_ICAS_STATE.noa_exit_reason /end REF_MEASUREMENT
/end GROUP
/begin GROUP SwcOut_NvM_Set_TSRInit ""
 /begin REF_MEASUREMENT SwcOut_NvM_Set_TSRInit.SPL_noSupp_Value_Init SwcOut_NvM_Set_TSRInit.SPL_whSupp_Value_Init SwcOut_NvM_Set_TSRInit.TS_SignName_Value_Init SwcOut_NvM_Set_TSRInit.SPL_SuppName_Value_Init SwcOut_NvM_Set_TSRInit.SPL_noSupp_Dist_Init SwcOut_NvM_Set_TSRInit.SPL_whSupp_Dist_Init SwcOut_NvM_Set_TSRInit.TS_SignName_Dist_Init /end REF_MEASUREMENT
/end GROUP
/begin GROUP autosar_swc_icas "autosar_swc_icas" ROOT
 /begin SUB_GROUP ICAS_ExecTimestamp SwcOut_CSM_CSC_HMI SwcOut_CSM_CTRL SwcOut_CSM_TSR_HMI SwcOut_ICAS_HMI SwcOut_ICAS_Herbeat_Info SwcOut_ICAS_STATE SwcOut_NvM_Set_TSRInit autosar_swc_icas_autosar_swc_icas_Step_sys /end SUB_GROUP
/end GROUP
/begin GROUP autosar_swc_icas_autosar_swc_icas_Step_sys "autosar_swc_icas/autosar_swc_icas_Step_sys"
 /begin SUB_GROUP autosar_swc_icas_autosar_swc_icas_Step_sys_CSM autosar_swc_icas_autosar_swc_icas_Step_sys_ICAS autosar_swc_icas_autosar_swc_icas_Step_sys_Subsystem /end SUB_GROUP
 /begin REF_MEASUREMENT CSM_Version ICAS_ACC_AVPFunStatus ICAS_Version ICAS_longHMI_CRUISETextDisp IHC_Version SwcOut_ICAS_ADAS_Request SwcOut_ICAS_NvM_Set_ACCStsInit SwcOut_NvM_Set_TimeGapInit Swcout_ICAS_NvM_Set_ICASStsInit autosar_swc_icas_rtARID_DEF.cnt_m /end REF_MEASUREMENT
/end GROUP
/begin GROUP autosar_swc_icas_autosar_swc_icas_Step_sys_CSM "autosar_swc_icas/autosar_swc_icas_Step_sys/CSM"
 /begin SUB_GROUP autosar_swc_icas_autosar_swc_icas_Step_sys_CSM_ACCSpeedSet autosar_swc_icas_autosar_swc_icas_Step_sys_CSM_DisplayTime__SpeedLimitOutput autosar_swc_icas_autosar_swc_icas_Step_sys_CSM_Genuine_TSR autosar_swc_icas_autosar_swc_icas_Step_sys_CSM_SCF_STATEMACHINE autosar_swc_icas_autosar_swc_icas_Step_sys_CSM_SLA_Statemachine autosar_swc_icas_autosar_swc_icas_Step_sys_CSM_TSR_StateMachine autosar_swc_icas_autosar_swc_icas_Step_sys_CSM_csc_accTimeGapCal /end SUB_GROUP
 /begin REF_MEASUREMENT CSC_ISL_InfoDispHMI CSM_AutoAdjSetSpdSts_st CSM_ISL_ACCFailure_b CSM_ISL_APSpdLimDistReq_m CSM_ISL_APSpdLimSPLReq_kph CSM_ISL_CurSetSpd_kph CSM_ISL_InfoDispHMI_st CSM_ISL_MRC_SPL_kph CSM_ISL_NOA_SPL_UpLim CSM_ISL_NOA_SPL_kph CSM_ISL_NOA_SPL_kph_noLim CSM_ISL_NOA_Spd_C0_Flag CSM_ISL_NOA_Spd_Quality_Flag CSM_ISL_NOA_Spd_SetSpd_Flag CSM_ISL_NOA_Spd_Split_Flag CSM_ISL_NOA_Spd_TJA_Flag CSM_ISL_NOH_RainMode_SPL CSM_ISL_NavDecResp_b CSM_ISL_NavHiLim_kph CSM_ISL_RainModeState CSM_ISL_ReqExitReason_st CSM_ISL_Resp_b CSM_ISL_SetSpdAdjReq_b CSM_ISL_SetSpdAdjTyp_st CSM_ISL_SetSpdAdjVal_kph CSM_ISL_funMod_Hdmap_b CSM_ISL_funMod_Nav_b CSM_ISL_funMod_Noh_b CSM_ISL_funMod_Rain_b CSM_ISL_funMod_iACCSwt_b CSM_ISL_funMod_iACC_b CSM_ISL_iACCReqConfirm CSM_ISL_iACCSpdChck CSM_ISL_iAccHiLim_kph CSM_ISL_iAccLoLim_kph CSM_ISL_nohHiLim_kph CSM_ISL_nohLoLim_kph CSM_ISL_nohLoLim_kph_in CSM_ManualAdjSetBelow CSM_ManualAdjSetVal CSM_ManualSetConsSendVal CSM_MergeAccelerateReq CSM_MergeRequest_AfterRelay CSM_MergeRequest_Oringe CSM_NOAOutflag CSM_NOAReActInHW CSM_SLIF_LaneChange2 CSM_SLIF_LaneChange_b CSM_SPLRawUpdateFlag CSM_SPL_End_b CSM_SenarioUpdate CSM_SenarioUpdateAftDeb CSM_SetSpdMsg_SetBelow CSM_SetSpdMsg_Sts CSM_SetSpdMsg_Type CSM_SetSpdMsg_Val CSM_Sign_SPL_kph CSM_Sign_Source_st CSM_SpdLimAfterDebounce CSM_TSRSpdLimCfdc_st CSM_TSRTrfcSignValCfdc_st CSM_TSRTrfcSignVal_st CSM_TSR_J3SPLEND CSM_TSR_J3SPLVAL CSM_User_DecSetSpd_L_b CSM_User_DecSetSpd_S_b CSM_User_IncSetSpd_L_b CSM_User_IncSetSpd_S_b MAP_TSR_SpdLim_in autosar_swc_icas_rtARID_DEF.Beep autosar_swc_icas_rtARID_DEF.TimeGap autosar_swc_icas_rtARID_DEF.i_fr autosar_swc_icas_rtARID_DEF.is_active_c27_autosar_swc_icas autosar_swc_icas_rtARID_DEF.is_c27_autosar_swc_icas autosar_swc_icas_rtARID_DEF.is_debounce autosar_swc_icas_rtARID_DEF.out_g /end REF_MEASUREMENT
/end GROUP
/begin GROUP autosar_swc_icas_autosar_swc_icas_Step_sys_CSM_ACCSpeedSet "autosar_swc_icas/autosar_swc_icas_Step_sys/CSM/ACCSpeedSet"
 /begin SUB_GROUP autosar_swc_icas_autosar_swc_icas_Step_sys_CSM_ACCSpeedSet_Compare_To_Constant23 autosar_swc_icas_autosar_swc_icas_Step_sys_CSM_ACCSpeedSet_Detect_Change1 autosar_swc_icas_autosar_swc_icas_Step_sys_CSM_ACCSpeedSet_Detect_Change2 autosar_swc_icas_autosar_swc_icas_Step_sys_CSM_ACCSpeedSet_Detect_Change3 autosar_swc_icas_autosar_swc_icas_Step_sys_CSM_ACCSpeedSet_Detect_Decrease autosar_swc_icas_autosar_swc_icas_Step_sys_CSM_ACCSpeedSet_Detect_Increase autosar_swc_icas_autosar_swc_icas_Step_sys_CSM_ACCSpeedSet_Detect_Increase1 autosar_swc_icas_autosar_swc_icas_Step_sys_CSM_ACCSpeedSet_Detect_Increase2 autosar_swc_icas_autosar_swc_icas_Step_sys_CSM_ACCSpeedSet_Detect_Increase3 autosar_swc_icas_autosar_swc_icas_Step_sys_CSM_ACCSpeedSet_Detect_Increase4 autosar_swc_icas_autosar_swc_icas_Step_sys_CSM_ACCSpeedSet_Enabled_Subsystem2 autosar_swc_icas_autosar_swc_icas_Step_sys_CSM_ACCSpeedSet_TrueDurationTime5 /end SUB_GROUP
 /begin REF_CHARACTERISTIC P_CSM_NOAOffRampMiniDisVal P_CSM_NOASPLSpdLimX P_CSM_NOASPLSpdLimY P_CSM_ORDSpdLimValue /end REF_CHARACTERISTIC
 /begin REF_MEASUREMENT CSM_AutoAdjSetSpdVal CSM_ISL_NOA_Distance2SplitAfterLim CSM_ISL_NOA_SPL_OFFRampStart CSM_ManualSetSpdSts_st CSM_OffRampDisReq CSM_OffRampSpdReq ICAS_reserve01 autosar_swc_icas_rtARID_DEF.Speed autosar_swc_icas_rtARID_DEF.UnitDelay1_DSTATE_pt autosar_swc_icas_rtARID_DEF.UnitDelay2_DSTATE_pb autosar_swc_icas_rtARID_DEF.UnitDelay_DSTATE_a autosar_swc_icas_rtARID_DEF.i_dh autosar_swc_icas_rtARID_DEF.is_Available autosar_swc_icas_rtARID_DEF.is_NOA autosar_swc_icas_rtARID_DEF.is_active_c117_autosar_swc_icas autosar_swc_icas_rtARID_DEF.is_active_c123_autosar_swc_icas autosar_swc_icas_rtARID_DEF.is_active_c21_autosar_swc_icas autosar_swc_icas_rtARID_DEF.is_active_c22_autosar_swc_icas autosar_swc_icas_rtARID_DEF.is_c117_autosar_swc_icas autosar_swc_icas_rtARID_DEF.is_c123_autosar_swc_icas autosar_swc_icas_rtARID_DEF.is_c21_autosar_swc_icas autosar_swc_icas_rtARID_DEF.is_c22_autosar_swc_icas autosar_swc_icas_rtARID_DEF.j autosar_swc_icas_rtARID_DEF.out_l autosar_swc_icas_rtARID_DEF.out_n autosar_swc_icas_rtARID_DEF.output autosar_swc_icas_rtARID_DEF.s /end REF_MEASUREMENT
/end GROUP
/begin GROUP autosar_swc_icas_autosar_swc_icas_Step_sys_CSM_ACCSpeedSet_Compare_To_Constant23 "autosar_swc_icas/autosar_swc_icas_Step_sys/CSM/ACCSpeedSet/Compare\nTo Constant23" /begin REF_MEASUREMENT autosar_swc_icas_rtARID_DEF.out_n /end REF_MEASUREMENT /end GROUP
/begin GROUP autosar_swc_icas_autosar_swc_icas_Step_sys_CSM_ACCSpeedSet_Detect_Change1 "autosar_swc_icas/autosar_swc_icas_Step_sys/CSM/ACCSpeedSet/Detect\nChange1" /begin REF_MEASUREMENT autosar_swc_icas_rtARID_DEF.DelayInput1_DSTATE_lt /end REF_MEASUREMENT /end GROUP
/begin GROUP autosar_swc_icas_autosar_swc_icas_Step_sys_CSM_ACCSpeedSet_Detect_Change2 "autosar_swc_icas/autosar_swc_icas_Step_sys/CSM/ACCSpeedSet/Detect\nChange2" /begin REF_MEASUREMENT autosar_swc_icas_rtARID_DEF.DelayInput1_DSTATE_k /end REF_MEASUREMENT /end GROUP
/begin GROUP autosar_swc_icas_autosar_swc_icas_Step_sys_CSM_ACCSpeedSet_Detect_Change3 "autosar_swc_icas/autosar_swc_icas_Step_sys/CSM/ACCSpeedSet/Detect\nChange3" /begin REF_MEASUREMENT autosar_swc_icas_rtARID_DEF.DelayInput1_DSTATE_e /end REF_MEASUREMENT /end GROUP
/begin GROUP autosar_swc_icas_autosar_swc_icas_Step_sys_CSM_ACCSpeedSet_Detect_Decrease "autosar_swc_icas/autosar_swc_icas_Step_sys/CSM/ACCSpeedSet/Detect\nDecrease" /begin REF_MEASUREMENT autosar_swc_icas_rtARID_DEF.DelayInput1_DSTATE_n /end REF_MEASUREMENT /end GROUP
/begin GROUP autosar_swc_icas_autosar_swc_icas_Step_sys_CSM_ACCSpeedSet_Detect_Increase "autosar_swc_icas/autosar_swc_icas_Step_sys/CSM/ACCSpeedSet/Detect\nIncrease" /begin REF_MEASUREMENT autosar_swc_icas_rtARID_DEF.DelayInput1_DSTATE_px /end REF_MEASUREMENT /end GROUP
/begin GROUP autosar_swc_icas_autosar_swc_icas_Step_sys_CSM_ACCSpeedSet_Detect_Increase1 "autosar_swc_icas/autosar_swc_icas_Step_sys/CSM/ACCSpeedSet/Detect\nIncrease1" /begin REF_MEASUREMENT autosar_swc_icas_rtARID_DEF.DelayInput1_DSTATE_ps /end REF_MEASUREMENT /end GROUP
/begin GROUP autosar_swc_icas_autosar_swc_icas_Step_sys_CSM_ACCSpeedSet_Detect_Increase2 "autosar_swc_icas/autosar_swc_icas_Step_sys/CSM/ACCSpeedSet/Detect\nIncrease2" /begin REF_MEASUREMENT autosar_swc_icas_rtARID_DEF.DelayInput1_DSTATE_fnq /end REF_MEASUREMENT /end GROUP
/begin GROUP autosar_swc_icas_autosar_swc_icas_Step_sys_CSM_ACCSpeedSet_Detect_Increase3 "autosar_swc_icas/autosar_swc_icas_Step_sys/CSM/ACCSpeedSet/Detect\nIncrease3" /begin REF_MEASUREMENT autosar_swc_icas_rtARID_DEF.DelayInput1_DSTATE_c1 /end REF_MEASUREMENT /end GROUP
/begin GROUP autosar_swc_icas_autosar_swc_icas_Step_sys_CSM_ACCSpeedSet_Detect_Increase4 "autosar_swc_icas/autosar_swc_icas_Step_sys/CSM/ACCSpeedSet/Detect\nIncrease4" /begin REF_MEASUREMENT autosar_swc_icas_rtARID_DEF.DelayInput1_DSTATE_gr /end REF_MEASUREMENT /end GROUP
/begin GROUP autosar_swc_icas_autosar_swc_icas_Step_sys_CSM_ACCSpeedSet_Enabled_Subsystem2 "autosar_swc_icas/autosar_swc_icas_Step_sys/CSM/ACCSpeedSet/Enabled\nSubsystem2" /begin REF_MEASUREMENT autosar_swc_icas_rtARID_DEF.Speed /end REF_MEASUREMENT /end GROUP
/begin GROUP autosar_swc_icas_autosar_swc_icas_Step_sys_CSM_ACCSpeedSet_TrueDurationTime5 "autosar_swc_icas/autosar_swc_icas_Step_sys/CSM/ACCSpeedSet/TrueDurationTime5"
 /begin REF_MEASUREMENT autosar_swc_icas_rtARID_DEF.UnitDelay1_DSTATE_bp autosar_swc_icas_rtARID_DEF.UnitDelay2_DSTATE_ml /end REF_MEASUREMENT
/end GROUP
/begin GROUP autosar_swc_icas_autosar_swc_icas_Step_sys_CSM_DisplayTime__SpeedLimitOutput "autosar_swc_icas/autosar_swc_icas_Step_sys/CSM/DisplayTime&&SpeedLimitOutput"
 /begin SUB_GROUP autosar_swc_icas_autosar_swc_icas_Step_sys_CSM_DisplayTime__SpeedLimitOutput_Compare_To_Constant13 autosar_swc_icas_autosar_swc_icas_Step_sys_CSM_DisplayTime__SpeedLimitOutput_Compare_To_Constant15 autosar_swc_icas_autosar_swc_icas_Step_sys_CSM_DisplayTime__SpeedLimitOutput_Detect_Change autosar_swc_icas_autosar_swc_icas_Step_sys_CSM_DisplayTime__SpeedLimitOutput_Detect_Change1 autosar_swc_icas_autosar_swc_icas_Step_sys_CSM_DisplayTime__SpeedLimitOutput_Detect_Increase autosar_swc_icas_autosar_swc_icas_Step_sys_CSM_DisplayTime__SpeedLimitOutput_SignalChange autosar_swc_icas_autosar_swc_icas_Step_sys_CSM_DisplayTime__SpeedLimitOutput_SignalChange1 /end SUB_GROUP
 /begin REF_CHARACTERISTIC P_CSM_SLAWarningTimeLim P_CSM_SpeedingWarningHighDis P_CSM_SpeedingWarningLowDis P_CSM_SpeedingWarningMidDis P_CSM_SpeedingWarningRevertDis P_CSM_SpeedingWarningTime /end REF_CHARACTERISTIC
 /begin REF_MEASUREMENT CSM_TSRSpdLimWarn_b CSM_TSRSpdLim_kph CSM_TSR_J3SPLVAL ICAS_reserve04 autosar_swc_icas_rtARID_DEF.Out autosar_swc_icas_rtARID_DEF.a autosar_swc_icas_rtARID_DEF.dis autosar_swc_icas_rtARID_DEF.i_d autosar_swc_icas_rtARID_DEF.i_k autosar_swc_icas_rtARID_DEF.is_OUTPUT autosar_swc_icas_rtARID_DEF.is_Ready autosar_swc_icas_rtARID_DEF.is_active_c126_autosar_swc_icas autosar_swc_icas_rtARID_DEF.is_active_c135_autosar_swc_icas autosar_swc_icas_rtARID_DEF.is_active_c20_autosar_swc_icas autosar_swc_icas_rtARID_DEF.is_c126_autosar_swc_icas autosar_swc_icas_rtARID_DEF.is_c135_autosar_swc_icas autosar_swc_icas_rtARID_DEF.is_c20_autosar_swc_icas /end REF_MEASUREMENT
/end GROUP
/begin GROUP autosar_swc_icas_autosar_swc_icas_Step_sys_CSM_DisplayTime__SpeedLimitOutput_Compare_To_Constant13 "autosar_swc_icas/autosar_swc_icas_Step_sys/CSM/DisplayTime&&SpeedLimitOutput/Compare\nTo Constant13" /begin REF_MEASUREMENT CSM_TSR_J3SPLVAL /end REF_MEASUREMENT /end GROUP
/begin GROUP autosar_swc_icas_autosar_swc_icas_Step_sys_CSM_DisplayTime__SpeedLimitOutput_Compare_To_Constant15 "autosar_swc_icas/autosar_swc_icas_Step_sys/CSM/DisplayTime&&SpeedLimitOutput/Compare\nTo Constant15" /begin REF_MEASUREMENT CSM_TSR_J3SPLVAL /end REF_MEASUREMENT /end GROUP
/begin GROUP autosar_swc_icas_autosar_swc_icas_Step_sys_CSM_DisplayTime__SpeedLimitOutput_Detect_Change "autosar_swc_icas/autosar_swc_icas_Step_sys/CSM/DisplayTime&&SpeedLimitOutput/Detect\nChange" /begin REF_MEASUREMENT autosar_swc_icas_rtARID_DEF.DelayInput1_DSTATE_ec /end REF_MEASUREMENT /end GROUP
/begin GROUP autosar_swc_icas_autosar_swc_icas_Step_sys_CSM_DisplayTime__SpeedLimitOutput_Detect_Change1 "autosar_swc_icas/autosar_swc_icas_Step_sys/CSM/DisplayTime&&SpeedLimitOutput/Detect\nChange1" /begin REF_MEASUREMENT autosar_swc_icas_rtARID_DEF.DelayInput1_DSTATE_a /end REF_MEASUREMENT /end GROUP
/begin GROUP autosar_swc_icas_autosar_swc_icas_Step_sys_CSM_DisplayTime__SpeedLimitOutput_Detect_Increase "autosar_swc_icas/autosar_swc_icas_Step_sys/CSM/DisplayTime&&SpeedLimitOutput/Detect\nIncrease" /begin REF_MEASUREMENT autosar_swc_icas_rtARID_DEF.DelayInput1_DSTATE_kk /end REF_MEASUREMENT /end GROUP
/begin GROUP autosar_swc_icas_autosar_swc_icas_Step_sys_CSM_DisplayTime__SpeedLimitOutput_SignalChange "autosar_swc_icas/autosar_swc_icas_Step_sys/CSM/DisplayTime&&SpeedLimitOutput/SignalChange"
 /begin SUB_GROUP autosar_swc_icas_autosar_swc_icas_Step_sys_CSM_DisplayTime__SpeedLimitOutput_SignalChange_Detect_Decrease autosar_swc_icas_autosar_swc_icas_Step_sys_CSM_DisplayTime__SpeedLimitOutput_SignalChange_Detect_Increase3 /end SUB_GROUP
/end GROUP
/begin GROUP autosar_swc_icas_autosar_swc_icas_Step_sys_CSM_DisplayTime__SpeedLimitOutput_SignalChange1 "autosar_swc_icas/autosar_swc_icas_Step_sys/CSM/DisplayTime&&SpeedLimitOutput/SignalChange1"
 /begin SUB_GROUP autosar_swc_icas_autosar_swc_icas_Step_sys_CSM_DisplayTime__SpeedLimitOutput_SignalChange1_Detect_Decrease autosar_swc_icas_autosar_swc_icas_Step_sys_CSM_DisplayTime__SpeedLimitOutput_SignalChange1_Detect_Increase3 /end SUB_GROUP
/end GROUP
/begin GROUP autosar_swc_icas_autosar_swc_icas_Step_sys_CSM_DisplayTime__SpeedLimitOutput_SignalChange1_Detect_Decrease "autosar_swc_icas/autosar_swc_icas_Step_sys/CSM/DisplayTime&&SpeedLimitOutput/SignalChange1/Detect\nDecrease" /begin REF_MEASUREMENT autosar_swc_icas_rtARID_DEF.DelayInput1_DSTATE_f /end REF_MEASUREMENT /end GROUP
/begin GROUP autosar_swc_icas_autosar_swc_icas_Step_sys_CSM_DisplayTime__SpeedLimitOutput_SignalChange1_Detect_Increase3 "autosar_swc_icas/autosar_swc_icas_Step_sys/CSM/DisplayTime&&SpeedLimitOutput/SignalChange1/Detect\nIncrease3" /begin REF_MEASUREMENT autosar_swc_icas_rtARID_DEF.DelayInput1_DSTATE_bp /end REF_MEASUREMENT /end GROUP
/begin GROUP autosar_swc_icas_autosar_swc_icas_Step_sys_CSM_DisplayTime__SpeedLimitOutput_SignalChange_Detect_Decrease "autosar_swc_icas/autosar_swc_icas_Step_sys/CSM/DisplayTime&&SpeedLimitOutput/SignalChange/Detect\nDecrease" /begin REF_MEASUREMENT autosar_swc_icas_rtARID_DEF.DelayInput1_DSTATE_l /end REF_MEASUREMENT /end GROUP
/begin GROUP autosar_swc_icas_autosar_swc_icas_Step_sys_CSM_DisplayTime__SpeedLimitOutput_SignalChange_Detect_Increase3 "autosar_swc_icas/autosar_swc_icas_Step_sys/CSM/DisplayTime&&SpeedLimitOutput/SignalChange/Detect\nIncrease3" /begin REF_MEASUREMENT autosar_swc_icas_rtARID_DEF.DelayInput1_DSTATE_j2 /end REF_MEASUREMENT /end GROUP
/begin GROUP autosar_swc_icas_autosar_swc_icas_Step_sys_CSM_Genuine_TSR "autosar_swc_icas/autosar_swc_icas_Step_sys/CSM/Genuine_TSR"
 /begin SUB_GROUP autosar_swc_icas_autosar_swc_icas_Step_sys_CSM_Genuine_TSR_Enlong2s autosar_swc_icas_autosar_swc_icas_Step_sys_CSM_Genuine_TSR_Enlong2s1 autosar_swc_icas_autosar_swc_icas_Step_sys_CSM_Genuine_TSR_Enlong40s /end SUB_GROUP
 /begin REF_CHARACTERISTIC P_CSM_TSRInhibitYawRate P_CSM_TSRNoStopBeepWaitingTime P_CSM_TSRRecoveryYawRate /end REF_CHARACTERISTIC
 /begin REF_MEASUREMENT autosar_swc_icas_rtARID_DEF.Beep autosar_swc_icas_rtARID_DEF.i_i autosar_swc_icas_rtARID_DEF.is_active_c148_autosar_swc_icas autosar_swc_icas_rtARID_DEF.is_active_c149_autosar_swc_icas autosar_swc_icas_rtARID_DEF.is_c148_autosar_swc_icas autosar_swc_icas_rtARID_DEF.is_c149_autosar_swc_icas /end REF_MEASUREMENT
/end GROUP
/begin GROUP autosar_swc_icas_autosar_swc_icas_Step_sys_CSM_Genuine_TSR_Enlong2s "autosar_swc_icas/autosar_swc_icas_Step_sys/CSM/Genuine_TSR/Enlong2s"
 /begin SUB_GROUP autosar_swc_icas_autosar_swc_icas_Step_sys_CSM_Genuine_TSR_Enlong2s_SignalChange /end SUB_GROUP
 /begin REF_CHARACTERISTIC P_CSM_TSRGiveWayDisplayMinTime /end REF_CHARACTERISTIC
 /begin REF_MEASUREMENT autosar_swc_icas_rtARID_DEF.Time_k autosar_swc_icas_rtARID_DEF.UnitDelay1_DSTATE_oi autosar_swc_icas_rtARID_DEF.UnitDelay2_DSTATE_e1 autosar_swc_icas_rtARID_DEF.UnitDelay3_DSTATE_i autosar_swc_icas_rtARID_DEF.UnitDelay_DSTATE_h /end REF_MEASUREMENT
/end GROUP
/begin GROUP autosar_swc_icas_autosar_swc_icas_Step_sys_CSM_Genuine_TSR_Enlong2s1 "autosar_swc_icas/autosar_swc_icas_Step_sys/CSM/Genuine_TSR/Enlong2s1"
 /begin SUB_GROUP autosar_swc_icas_autosar_swc_icas_Step_sys_CSM_Genuine_TSR_Enlong2s1_SignalChange /end SUB_GROUP
 /begin REF_CHARACTERISTIC P_CSM_TSRForbiddenDisplayMinTime /end REF_CHARACTERISTIC
 /begin REF_MEASUREMENT autosar_swc_icas_rtARID_DEF.Time_e autosar_swc_icas_rtARID_DEF.UnitDelay1_DSTATE_o2 autosar_swc_icas_rtARID_DEF.UnitDelay2_DSTATE_k autosar_swc_icas_rtARID_DEF.UnitDelay3_DSTATE_d autosar_swc_icas_rtARID_DEF.UnitDelay_DSTATE_g /end REF_MEASUREMENT
/end GROUP
/begin GROUP autosar_swc_icas_autosar_swc_icas_Step_sys_CSM_Genuine_TSR_Enlong2s1_SignalChange "autosar_swc_icas/autosar_swc_icas_Step_sys/CSM/Genuine_TSR/Enlong2s1/SignalChange" /begin REF_MEASUREMENT autosar_swc_icas_rtARID_DEF.UnitDelay_DSTATE_jw /end REF_MEASUREMENT /end GROUP
/begin GROUP autosar_swc_icas_autosar_swc_icas_Step_sys_CSM_Genuine_TSR_Enlong2s_SignalChange "autosar_swc_icas/autosar_swc_icas_Step_sys/CSM/Genuine_TSR/Enlong2s/SignalChange" /begin REF_MEASUREMENT autosar_swc_icas_rtARID_DEF.UnitDelay_DSTATE_ps /end REF_MEASUREMENT /end GROUP
/begin GROUP autosar_swc_icas_autosar_swc_icas_Step_sys_CSM_Genuine_TSR_Enlong40s "autosar_swc_icas/autosar_swc_icas_Step_sys/CSM/Genuine_TSR/Enlong40s"
 /begin SUB_GROUP autosar_swc_icas_autosar_swc_icas_Step_sys_CSM_Genuine_TSR_Enlong40s_SignalChange /end SUB_GROUP
 /begin REF_CHARACTERISTIC P_CSM_TSRLongTimeDisplayMinTime /end REF_CHARACTERISTIC
 /begin REF_MEASUREMENT autosar_swc_icas_rtARID_DEF.Time autosar_swc_icas_rtARID_DEF.UnitDelay1_DSTATE_jl autosar_swc_icas_rtARID_DEF.UnitDelay2_DSTATE_ik autosar_swc_icas_rtARID_DEF.UnitDelay3_DSTATE_g autosar_swc_icas_rtARID_DEF.UnitDelay_DSTATE_l /end REF_MEASUREMENT
/end GROUP
/begin GROUP autosar_swc_icas_autosar_swc_icas_Step_sys_CSM_Genuine_TSR_Enlong40s_SignalChange "autosar_swc_icas/autosar_swc_icas_Step_sys/CSM/Genuine_TSR/Enlong40s/SignalChange" /begin REF_MEASUREMENT autosar_swc_icas_rtARID_DEF.UnitDelay_DSTATE_n /end REF_MEASUREMENT /end GROUP
/begin GROUP autosar_swc_icas_autosar_swc_icas_Step_sys_CSM_SCF_STATEMACHINE "autosar_swc_icas/autosar_swc_icas_Step_sys/CSM/SCF_STATEMACHINE"
 /begin SUB_GROUP autosar_swc_icas_autosar_swc_icas_Step_sys_CSM_SCF_STATEMACHINE_Compare_To_Constant18 autosar_swc_icas_autosar_swc_icas_Step_sys_CSM_SCF_STATEMACHINE_Compare_To_Constant19 autosar_swc_icas_autosar_swc_icas_Step_sys_CSM_SCF_STATEMACHINE_Detect_Increase autosar_swc_icas_autosar_swc_icas_Step_sys_CSM_SCF_STATEMACHINE_Detect_Increase3 autosar_swc_icas_autosar_swc_icas_Step_sys_CSM_SCF_STATEMACHINE_TrueDurationTime5 /end SUB_GROUP
 /begin REF_MEASUREMENT CSM_ISL_Sts_st CSM_TSR_SPL_Memry ICAS_reserve02 autosar_swc_icas_rtARID_DEF.UnitDelay1_DSTATE_d0 autosar_swc_icas_rtARID_DEF.UnitDelay2_DSTATE_pi autosar_swc_icas_rtARID_DEF.UnitDelay3_DSTATE autosar_swc_icas_rtARID_DEF.cnt autosar_swc_icas_rtARID_DEF.i_ef autosar_swc_icas_rtARID_DEF.io autosar_swc_icas_rtARID_DEF.is_Inform autosar_swc_icas_rtARID_DEF.is_InformActive autosar_swc_icas_rtARID_DEF.is_On_c autosar_swc_icas_rtARID_DEF.is_active_c237_autosar_swc_icas autosar_swc_icas_rtARID_DEF.is_active_c3_autosar_swc_icas autosar_swc_icas_rtARID_DEF.is_active_c47_autosar_swc_icas autosar_swc_icas_rtARID_DEF.is_c237_autosar_swc_icas autosar_swc_icas_rtARID_DEF.is_c3_autosar_swc_icas autosar_swc_icas_rtARID_DEF.is_c47_autosar_swc_icas autosar_swc_icas_rtARID_DEF.out_di autosar_swc_icas_rtARID_DEF.spd1 autosar_swc_icas_rtARID_DEF.spd2 /end REF_MEASUREMENT
/end GROUP
/begin GROUP autosar_swc_icas_autosar_swc_icas_Step_sys_CSM_SCF_STATEMACHINE_Compare_To_Constant18 "autosar_swc_icas/autosar_swc_icas_Step_sys/CSM/SCF_STATEMACHINE/Compare\nTo Constant18" /begin REF_MEASUREMENT autosar_swc_icas_rtARID_DEF.io /end REF_MEASUREMENT /end GROUP
/begin GROUP autosar_swc_icas_autosar_swc_icas_Step_sys_CSM_SCF_STATEMACHINE_Compare_To_Constant19 "autosar_swc_icas/autosar_swc_icas_Step_sys/CSM/SCF_STATEMACHINE/Compare\nTo Constant19" /begin REF_MEASUREMENT autosar_swc_icas_rtARID_DEF.cnt /end REF_MEASUREMENT /end GROUP
/begin GROUP autosar_swc_icas_autosar_swc_icas_Step_sys_CSM_SCF_STATEMACHINE_Detect_Increase "autosar_swc_icas/autosar_swc_icas_Step_sys/CSM/SCF_STATEMACHINE/Detect\nIncrease" /begin REF_MEASUREMENT autosar_swc_icas_rtARID_DEF.DelayInput1_DSTATE_d5 /end REF_MEASUREMENT /end GROUP
/begin GROUP autosar_swc_icas_autosar_swc_icas_Step_sys_CSM_SCF_STATEMACHINE_Detect_Increase3 "autosar_swc_icas/autosar_swc_icas_Step_sys/CSM/SCF_STATEMACHINE/Detect\nIncrease3" /begin REF_MEASUREMENT autosar_swc_icas_rtARID_DEF.DelayInput1_DSTATE_ge /end REF_MEASUREMENT /end GROUP
/begin GROUP autosar_swc_icas_autosar_swc_icas_Step_sys_CSM_SCF_STATEMACHINE_TrueDurationTime5 "autosar_swc_icas/autosar_swc_icas_Step_sys/CSM/SCF_STATEMACHINE/TrueDurationTime5"
 /begin REF_MEASUREMENT autosar_swc_icas_rtARID_DEF.UnitDelay1_DSTATE_fw autosar_swc_icas_rtARID_DEF.UnitDelay2_DSTATE_nf /end REF_MEASUREMENT
/end GROUP
/begin GROUP autosar_swc_icas_autosar_swc_icas_Step_sys_CSM_SLA_Statemachine "autosar_swc_icas/autosar_swc_icas_Step_sys/CSM/SLA_Statemachine"
 /begin SUB_GROUP autosar_swc_icas_autosar_swc_icas_Step_sys_CSM_SLA_Statemachine_Compare_To_Constant10 autosar_swc_icas_autosar_swc_icas_Step_sys_CSM_SLA_Statemachine_Compare_To_Constant12 autosar_swc_icas_autosar_swc_icas_Step_sys_CSM_SLA_Statemachine_Compare_To_Constant14 /end SUB_GROUP
 /begin REF_CHARACTERISTIC P_CSM_TSRYawRateInhibitTime /end REF_CHARACTERISTIC
 /begin REF_MEASUREMENT CSM_TSRSpdLimSts_st autosar_swc_icas_rtARID_DEF.Inhibit autosar_swc_icas_rtARID_DEF.i_m autosar_swc_icas_rtARID_DEF.is_Active_d autosar_swc_icas_rtARID_DEF.is_On_p autosar_swc_icas_rtARID_DEF.is_active_c269_autosar_swc_icas autosar_swc_icas_rtARID_DEF.is_active_c271_autosar_swc_icas autosar_swc_icas_rtARID_DEF.is_c269_autosar_swc_icas autosar_swc_icas_rtARID_DEF.is_c271_autosar_swc_icas /end REF_MEASUREMENT
/end GROUP
/begin GROUP autosar_swc_icas_autosar_swc_icas_Step_sys_CSM_SLA_Statemachine_Compare_To_Constant10 "autosar_swc_icas/autosar_swc_icas_Step_sys/CSM/SLA_Statemachine/Compare\nTo Constant10" /begin REF_MEASUREMENT autosar_swc_icas_rtARID_DEF.Inhibit /end REF_MEASUREMENT /end GROUP
/begin GROUP autosar_swc_icas_autosar_swc_icas_Step_sys_CSM_SLA_Statemachine_Compare_To_Constant12 "autosar_swc_icas/autosar_swc_icas_Step_sys/CSM/SLA_Statemachine/Compare\nTo Constant12" /begin REF_MEASUREMENT autosar_swc_icas_rtARID_DEF.Inhibit /end REF_MEASUREMENT /end GROUP
/begin GROUP autosar_swc_icas_autosar_swc_icas_Step_sys_CSM_SLA_Statemachine_Compare_To_Constant14 "autosar_swc_icas/autosar_swc_icas_Step_sys/CSM/SLA_Statemachine/Compare\nTo Constant14" /begin REF_MEASUREMENT autosar_swc_icas_rtARID_DEF.Inhibit /end REF_MEASUREMENT /end GROUP
/begin GROUP autosar_swc_icas_autosar_swc_icas_Step_sys_CSM_TSR_StateMachine "autosar_swc_icas/autosar_swc_icas_Step_sys/CSM/TSR_StateMachine"
 /begin REF_MEASUREMENT autosar_swc_icas_rtARID_DEF.is_active_c272_autosar_swc_icas autosar_swc_icas_rtARID_DEF.is_c272_autosar_swc_icas /end REF_MEASUREMENT
/end GROUP
/begin GROUP autosar_swc_icas_autosar_swc_icas_Step_sys_CSM_csc_accTimeGapCal "autosar_swc_icas/autosar_swc_icas_Step_sys/CSM/csc_accTimeGapCal"
 /begin SUB_GROUP autosar_swc_icas_autosar_swc_icas_Step_sys_CSM_csc_accTimeGapCal_Detect_Increase autosar_swc_icas_autosar_swc_icas_Step_sys_CSM_csc_accTimeGapCal_Detect_Increase1 /end SUB_GROUP
 /begin REF_MEASUREMENT CSM_TimeGapInit CSM_TimeGapLevel SwcOut_NvM_Set_TimeGapInit autosar_swc_icas_rtARID_DEF.TimeGap autosar_swc_icas_rtARID_DEF.i_g autosar_swc_icas_rtARID_DEF.is_active_c40_autosar_swc_icas autosar_swc_icas_rtARID_DEF.is_active_c774_autosar_swc_icas autosar_swc_icas_rtARID_DEF.is_c40_autosar_swc_icas autosar_swc_icas_rtARID_DEF.is_c774_autosar_swc_icas autosar_swc_icas_rtARID_DEF.out_o /end REF_MEASUREMENT
/end GROUP
/begin GROUP autosar_swc_icas_autosar_swc_icas_Step_sys_CSM_csc_accTimeGapCal_Detect_Increase "autosar_swc_icas/autosar_swc_icas_Step_sys/CSM/csc_accTimeGapCal/Detect\nIncrease" /begin REF_MEASUREMENT autosar_swc_icas_rtARID_DEF.DelayInput1_DSTATE_li /end REF_MEASUREMENT /end GROUP
/begin GROUP autosar_swc_icas_autosar_swc_icas_Step_sys_CSM_csc_accTimeGapCal_Detect_Increase1 "autosar_swc_icas/autosar_swc_icas_Step_sys/CSM/csc_accTimeGapCal/Detect\nIncrease1" /begin REF_MEASUREMENT autosar_swc_icas_rtARID_DEF.DelayInput1_DSTATE_ip /end REF_MEASUREMENT /end GROUP
/begin GROUP autosar_swc_icas_autosar_swc_icas_Step_sys_ICAS "autosar_swc_icas/autosar_swc_icas_Step_sys/ICAS" /begin SUB_GROUP autosar_swc_icas_autosar_swc_icas_Step_sys_ICAS_icas /end SUB_GROUP /end GROUP
/begin GROUP autosar_swc_icas_autosar_swc_icas_Step_sys_ICAS_icas "autosar_swc_icas/autosar_swc_icas_Step_sys/ICAS/icas"
 /begin SUB_GROUP autosar_swc_icas_autosar_swc_icas_Step_sys_ICAS_icas_CRUISE_ACC1 autosar_swc_icas_autosar_swc_icas_Step_sys_ICAS_icas_CRUISE_LongHMI autosar_swc_icas_autosar_swc_icas_Step_sys_ICAS_icas_Compare_To_Constant autosar_swc_icas_autosar_swc_icas_Step_sys_ICAS_icas_DataCollect autosar_swc_icas_autosar_swc_icas_Step_sys_ICAS_icas_HOD autosar_swc_icas_autosar_swc_icas_Step_sys_ICAS_icas_Subsystem autosar_swc_icas_autosar_swc_icas_Step_sys_ICAS_icas_Subsystem1 autosar_swc_icas_autosar_swc_icas_Step_sys_ICAS_icas_Subsystem3 autosar_swc_icas_autosar_swc_icas_Step_sys_ICAS_icas_Subsystem4 /end SUB_GROUP
 /begin REF_CHARACTERISTIC P_ICAS_DFIMSwitch /end REF_CHARACTERISTIC
 /begin REF_MEASUREMENT ICAS_ACC_ACCSts ICAS_ACC_DrvOFFReq ICAS_ACC_StandActiveTime ICAS_ACC_USS_ACCP0rangeEN ICAS_ACC_USS_TOSP0TypeChange ICAS_ACC_USS_USSObjExist ICAS_ACC_USS_rangeP0DetDec ICAS_HWAFastExitCond_ACCExit ICAS_HWASlowExitConditions_b ICAS_HWASlowExitCons_EspActive400ms ICAS_HWATJA_HWAWarningLevel ICAS_HWATJA_MRC2SafeStopCon_b ICAS_LongHMI_Number ICAS_TJAHandsOffWarningLevel ICAS_TJALCK_Con_TJAActive_LatCondition_b ICAS_TJALCK_Con_TJAExit_LatCondition_b ICAS_TJALCK_preDis ICAS_TJA_Number ICAS_TJA_VERSION ICAS_longHMI_TruckCount ICAS_reserve05 ICAS_reserve06 ICAS_reserve07 ICAS_reserve08 ICAS_reserve09 ICAS_reserve10 autosar_swc_icas_rtARID_DEF.CRUISE_longHMI_HazSts autosar_swc_icas_rtARID_DEF.UnitDelay2_DSTATE_p autosar_swc_icas_rtARID_DEF.UnitDelay3_DSTATE_f autosar_swc_icas_rtARID_DEF.UnitDelay4_DSTATE_f autosar_swc_icas_rtARID_DEF.UnitDelay5_DSTATE /end REF_MEASUREMENT
/end GROUP
/begin GROUP autosar_swc_icas_autosar_swc_icas_Step_sys_ICAS_icas_CRUISE_ACC1 "autosar_swc_icas/autosar_swc_icas_Step_sys/ICAS/icas/CRUISE_ACC1"
 /begin SUB_GROUP autosar_swc_icas_autosar_swc_icas_Step_sys_ICAS_icas_CRUISE_ACC1_Detect_Increase autosar_swc_icas_autosar_swc_icas_Step_sys_ICAS_icas_CRUISE_ACC1_Stand_to_DrvrOff autosar_swc_icas_autosar_swc_icas_Step_sys_ICAS_icas_CRUISE_ACC1_Subsystem autosar_swc_icas_autosar_swc_icas_Step_sys_ICAS_icas_CRUISE_ACC1_Subsystem1 autosar_swc_icas_autosar_swc_icas_Step_sys_ICAS_icas_CRUISE_ACC1_Subsystem2 autosar_swc_icas_autosar_swc_icas_Step_sys_ICAS_icas_CRUISE_ACC1_Subsystem3 autosar_swc_icas_autosar_swc_icas_Step_sys_ICAS_icas_CRUISE_ACC1_TrueDurationTime14 /end SUB_GROUP
 /begin REF_MEASUREMENT ICAS_ACC_ACCSts autosar_swc_icas_rtARID_DEF.UnitDelay1_DSTATE_pq /end REF_MEASUREMENT
/end GROUP
/begin GROUP autosar_swc_icas_autosar_swc_icas_Step_sys_ICAS_icas_CRUISE_ACC1_Detect_Increase "autosar_swc_icas/autosar_swc_icas_Step_sys/ICAS/icas/CRUISE_ACC1/Detect\nIncrease" /begin REF_MEASUREMENT autosar_swc_icas_rtARID_DEF.DelayInput1_DSTATE_cc /end REF_MEASUREMENT /end GROUP
/begin GROUP autosar_swc_icas_autosar_swc_icas_Step_sys_ICAS_icas_CRUISE_ACC1_Stand_to_DrvrOff "autosar_swc_icas/autosar_swc_icas_Step_sys/ICAS/icas/CRUISE_ACC1/Stand_to_DrvrOff" /begin REF_MEASUREMENT ICAS_ACC_USS_DrvroffConEn /end REF_MEASUREMENT /end GROUP
/begin GROUP autosar_swc_icas_autosar_swc_icas_Step_sys_ICAS_icas_CRUISE_ACC1_Subsystem "autosar_swc_icas/autosar_swc_icas_Step_sys/ICAS/icas/CRUISE_ACC1/Subsystem"
 /begin SUB_GROUP autosar_swc_icas_autosar_swc_icas_Step_sys_ICAS_icas_CRUISE_ACC1_Subsystem_Compare_To_Constant101 autosar_swc_icas_autosar_swc_icas_Step_sys_ICAS_icas_CRUISE_ACC1_Subsystem_Compare_To_Constant103 autosar_swc_icas_autosar_swc_icas_Step_sys_ICAS_icas_CRUISE_ACC1_Subsystem_Compare_To_Constant106 autosar_swc_icas_autosar_swc_icas_Step_sys_ICAS_icas_CRUISE_ACC1_Subsystem_Compare_To_Constant107 autosar_swc_icas_autosar_swc_icas_Step_sys_ICAS_icas_CRUISE_ACC1_Subsystem_Compare_To_Constant12 autosar_swc_icas_autosar_swc_icas_Step_sys_ICAS_icas_CRUISE_ACC1_Subsystem_Compare_To_Constant122 autosar_swc_icas_autosar_swc_icas_Step_sys_ICAS_icas_CRUISE_ACC1_Subsystem_Compare_To_Constant124 autosar_swc_icas_autosar_swc_icas_Step_sys_ICAS_icas_CRUISE_ACC1_Subsystem_Compare_To_Constant17 autosar_swc_icas_autosar_swc_icas_Step_sys_ICAS_icas_CRUISE_ACC1_Subsystem_Compare_To_Constant2 autosar_swc_icas_autosar_swc_icas_Step_sys_ICAS_icas_CRUISE_ACC1_Subsystem_Compare_To_Constant20 autosar_swc_icas_autosar_swc_icas_Step_sys_ICAS_icas_CRUISE_ACC1_Subsystem_Compare_To_Constant29 autosar_swc_icas_autosar_swc_icas_Step_sys_ICAS_icas_CRUISE_ACC1_Subsystem_Compare_To_Constant39 autosar_swc_icas_autosar_swc_icas_Step_sys_ICAS_icas_CRUISE_ACC1_Subsystem_Compare_To_Constant49 autosar_swc_icas_autosar_swc_icas_Step_sys_ICAS_icas_CRUISE_ACC1_Subsystem_Compare_To_Constant50 autosar_swc_icas_autosar_swc_icas_Step_sys_ICAS_icas_CRUISE_ACC1_Subsystem_Compare_To_Constant51 autosar_swc_icas_autosar_swc_icas_Step_sys_ICAS_icas_CRUISE_ACC1_Subsystem_Compare_To_Constant52 autosar_swc_icas_autosar_swc_icas_Step_sys_ICAS_icas_CRUISE_ACC1_Subsystem_Compare_To_Constant57 autosar_swc_icas_autosar_swc_icas_Step_sys_ICAS_icas_CRUISE_ACC1_Subsystem_Compare_To_Constant71 autosar_swc_icas_autosar_swc_icas_Step_sys_ICAS_icas_CRUISE_ACC1_Subsystem_Compare_To_Constant75 autosar_swc_icas_autosar_swc_icas_Step_sys_ICAS_icas_CRUISE_ACC1_Subsystem_Compare_To_Constant8 autosar_swc_icas_autosar_swc_icas_Step_sys_ICAS_icas_CRUISE_ACC1_Subsystem_Compare_To_Constant93 autosar_swc_icas_autosar_swc_icas_Step_sys_ICAS_icas_CRUISE_ACC1_Subsystem_Compare_To_Constant99 autosar_swc_icas_autosar_swc_icas_Step_sys_ICAS_icas_CRUISE_ACC1_Subsystem_Subsystem autosar_swc_icas_autosar_swc_icas_Step_sys_ICAS_icas_CRUISE_ACC1_Subsystem_Subsystem3 autosar_swc_icas_autosar_swc_icas_Step_sys_ICAS_icas_CRUISE_ACC1_Subsystem_Subsystem5 autosar_swc_icas_autosar_swc_icas_Step_sys_ICAS_icas_CRUISE_ACC1_Subsystem_Subsystem6 autosar_swc_icas_autosar_swc_icas_Step_sys_ICAS_icas_CRUISE_ACC1_Subsystem_TrueDurationTime1 autosar_swc_icas_autosar_swc_icas_Step_sys_ICAS_icas_CRUISE_ACC1_Subsystem_TrueDurationTime10 autosar_swc_icas_autosar_swc_icas_Step_sys_ICAS_icas_CRUISE_ACC1_Subsystem_TrueDurationTime11 autosar_swc_icas_autosar_swc_icas_Step_sys_ICAS_icas_CRUISE_ACC1_Subsystem_TrueDurationTime12 autosar_swc_icas_autosar_swc_icas_Step_sys_ICAS_icas_CRUISE_ACC1_Subsystem_TrueDurationTime13 autosar_swc_icas_autosar_swc_icas_Step_sys_ICAS_icas_CRUISE_ACC1_Subsystem_TrueDurationTime14 autosar_swc_icas_autosar_swc_icas_Step_sys_ICAS_icas_CRUISE_ACC1_Subsystem_TrueDurationTime15 autosar_swc_icas_autosar_swc_icas_Step_sys_ICAS_icas_CRUISE_ACC1_Subsystem_TrueDurationTime16 autosar_swc_icas_autosar_swc_icas_Step_sys_ICAS_icas_CRUISE_ACC1_Subsystem_TrueDurationTime17 autosar_swc_icas_autosar_swc_icas_Step_sys_ICAS_icas_CRUISE_ACC1_Subsystem_TrueDurationTime18 autosar_swc_icas_autosar_swc_icas_Step_sys_ICAS_icas_CRUISE_ACC1_Subsystem_TrueDurationTime19 autosar_swc_icas_autosar_swc_icas_Step_sys_ICAS_icas_CRUISE_ACC1_Subsystem_TrueDurationTime2 autosar_swc_icas_autosar_swc_icas_Step_sys_ICAS_icas_CRUISE_ACC1_Subsystem_TrueDurationTime20 autosar_swc_icas_autosar_swc_icas_Step_sys_ICAS_icas_CRUISE_ACC1_Subsystem_TrueDurationTime21 autosar_swc_icas_autosar_swc_icas_Step_sys_ICAS_icas_CRUISE_ACC1_Subsystem_TrueDurationTime22 autosar_swc_icas_autosar_swc_icas_Step_sys_ICAS_icas_CRUISE_ACC1_Subsystem_TrueDurationTime23 autosar_swc_icas_autosar_swc_icas_Step_sys_ICAS_icas_CRUISE_ACC1_Subsystem_TrueDurationTime24 autosar_swc_icas_autosar_swc_icas_Step_sys_ICAS_icas_CRUISE_ACC1_Subsystem_TrueDurationTime25 autosar_swc_icas_autosar_swc_icas_Step_sys_ICAS_icas_CRUISE_ACC1_Subsystem_TrueDurationTime26 autosar_swc_icas_autosar_swc_icas_Step_sys_ICAS_icas_CRUISE_ACC1_Subsystem_TrueDurationTime27 autosar_swc_icas_autosar_swc_icas_Step_sys_ICAS_icas_CRUISE_ACC1_Subsystem_TrueDurationTime28 autosar_swc_icas_autosar_swc_icas_Step_sys_ICAS_icas_CRUISE_ACC1_Subsystem_TrueDurationTime29 autosar_swc_icas_autosar_swc_icas_Step_sys_ICAS_icas_CRUISE_ACC1_Subsystem_TrueDurationTime3 autosar_swc_icas_autosar_swc_icas_Step_sys_ICAS_icas_CRUISE_ACC1_Subsystem_TrueDurationTime30 autosar_swc_icas_autosar_swc_icas_Step_sys_ICAS_icas_CRUISE_ACC1_Subsystem_TrueDurationTime31 autosar_swc_icas_autosar_swc_icas_Step_sys_ICAS_icas_CRUISE_ACC1_Subsystem_TrueDurationTime32 autosar_swc_icas_autosar_swc_icas_Step_sys_ICAS_icas_CRUISE_ACC1_Subsystem_TrueDurationTime33 autosar_swc_icas_autosar_swc_icas_Step_sys_ICAS_icas_CRUISE_ACC1_Subsystem_TrueDurationTime34 autosar_swc_icas_autosar_swc_icas_Step_sys_ICAS_icas_CRUISE_ACC1_Subsystem_TrueDurationTime35 autosar_swc_icas_autosar_swc_icas_Step_sys_ICAS_icas_CRUISE_ACC1_Subsystem_TrueDurationTime36 autosar_swc_icas_autosar_swc_icas_Step_sys_ICAS_icas_CRUISE_ACC1_Subsystem_TrueDurationTime37 autosar_swc_icas_autosar_swc_icas_Step_sys_ICAS_icas_CRUISE_ACC1_Subsystem_TrueDurationTime38 autosar_swc_icas_autosar_swc_icas_Step_sys_ICAS_icas_CRUISE_ACC1_Subsystem_TrueDurationTime39 autosar_swc_icas_autosar_swc_icas_Step_sys_ICAS_icas_CRUISE_ACC1_Subsystem_TrueDurationTime4 autosar_swc_icas_autosar_swc_icas_Step_sys_ICAS_icas_CRUISE_ACC1_Subsystem_TrueDurationTime40 autosar_swc_icas_autosar_swc_icas_Step_sys_ICAS_icas_CRUISE_ACC1_Subsystem_TrueDurationTime5 autosar_swc_icas_autosar_swc_icas_Step_sys_ICAS_icas_CRUISE_ACC1_Subsystem_TrueDurationTime6 autosar_swc_icas_autosar_swc_icas_Step_sys_ICAS_icas_CRUISE_ACC1_Subsystem_TrueDurationTime7 autosar_swc_icas_autosar_swc_icas_Step_sys_ICAS_icas_CRUISE_ACC1_Subsystem_TrueDurationTime8 autosar_swc_icas_autosar_swc_icas_Step_sys_ICAS_icas_CRUISE_ACC1_Subsystem_TrueDurationTime9 /end SUB_GROUP
 /begin REF_CHARACTERISTIC P_ACC_CurvSpdLimOffsetIn P_CRUISE_ACC_FastExitFuncStatus P_ICAS_ACCCurveSpdLimSwitch P_ICAS_ACCDoors P_ICAS_ACCDriverBrake P_ICAS_ACCInhibitTimeGapRatio P_ICAS_ACCP0Lost P_ICAS_ACCSeatBelt /end REF_CHARACTERISTIC
 /begin REF_MEASUREMENT ICAS_ACCActCondF ICAS_ACCFastExit ICAS_ACCFastExitCons_HoodOpen ICAS_ACCFastExitCons_LRDoorOpen ICAS_ACCFastExitCons_PassengerDoorOpen ICAS_ACCFastExitCons_RRDoorOpen ICAS_ACCSlowExit ICAS_ACC_BOMExit autosar_swc_icas_rtARID_DEF.AND2 autosar_swc_icas_rtARID_DEF.AND4 autosar_swc_icas_rtARID_DEF.AND5 autosar_swc_icas_rtARID_DEF.LogicalOperator76 autosar_swc_icas_rtARID_DEF.LogicalOperator79 autosar_swc_icas_rtARID_DEF.LogicalOperator81 autosar_swc_icas_rtARID_DEF.i_n autosar_swc_icas_rtARID_DEF.is_active_c38_autosar_swc_icas autosar_swc_icas_rtARID_DEF.is_active_c39_autosar_swc_icas autosar_swc_icas_rtARID_DEF.is_buffer autosar_swc_icas_rtARID_DEF.is_c38_autosar_swc_icas autosar_swc_icas_rtARID_DEF.is_c39_autosar_swc_icas autosar_swc_icas_rtARID_DEF.is_waiting autosar_swc_icas_rtARID_DEF.out_d autosar_swc_icas_rtARID_DEF.out_k2 /end REF_MEASUREMENT
/end GROUP
/begin GROUP autosar_swc_icas_autosar_swc_icas_Step_sys_ICAS_icas_CRUISE_ACC1_Subsystem1 "autosar_swc_icas/autosar_swc_icas_Step_sys/ICAS/icas/CRUISE_ACC1/Subsystem1"
 /begin SUB_GROUP autosar_swc_icas_autosar_swc_icas_Step_sys_ICAS_icas_CRUISE_ACC1_Subsystem1_Compare_To_Constant106 autosar_swc_icas_autosar_swc_icas_Step_sys_ICAS_icas_CRUISE_ACC1_Subsystem1_Compare_To_Constant107 autosar_swc_icas_autosar_swc_icas_Step_sys_ICAS_icas_CRUISE_ACC1_Subsystem1_Compare_To_Constant12 autosar_swc_icas_autosar_swc_icas_Step_sys_ICAS_icas_CRUISE_ACC1_Subsystem1_Compare_To_Constant124 autosar_swc_icas_autosar_swc_icas_Step_sys_ICAS_icas_CRUISE_ACC1_Subsystem1_Compare_To_Constant20 autosar_swc_icas_autosar_swc_icas_Step_sys_ICAS_icas_CRUISE_ACC1_Subsystem1_Compare_To_Constant44 autosar_swc_icas_autosar_swc_icas_Step_sys_ICAS_icas_CRUISE_ACC1_Subsystem1_Subsystem autosar_swc_icas_autosar_swc_icas_Step_sys_ICAS_icas_CRUISE_ACC1_Subsystem1_TrueDurationTime1 autosar_swc_icas_autosar_swc_icas_Step_sys_ICAS_icas_CRUISE_ACC1_Subsystem1_TrueDurationTime10 autosar_swc_icas_autosar_swc_icas_Step_sys_ICAS_icas_CRUISE_ACC1_Subsystem1_TrueDurationTime11 autosar_swc_icas_autosar_swc_icas_Step_sys_ICAS_icas_CRUISE_ACC1_Subsystem1_TrueDurationTime12 autosar_swc_icas_autosar_swc_icas_Step_sys_ICAS_icas_CRUISE_ACC1_Subsystem1_TrueDurationTime13 autosar_swc_icas_autosar_swc_icas_Step_sys_ICAS_icas_CRUISE_ACC1_Subsystem1_TrueDurationTime14 autosar_swc_icas_autosar_swc_icas_Step_sys_ICAS_icas_CRUISE_ACC1_Subsystem1_TrueDurationTime15 autosar_swc_icas_autosar_swc_icas_Step_sys_ICAS_icas_CRUISE_ACC1_Subsystem1_TrueDurationTime16 autosar_swc_icas_autosar_swc_icas_Step_sys_ICAS_icas_CRUISE_ACC1_Subsystem1_TrueDurationTime17 autosar_swc_icas_autosar_swc_icas_Step_sys_ICAS_icas_CRUISE_ACC1_Subsystem1_TrueDurationTime18 autosar_swc_icas_autosar_swc_icas_Step_sys_ICAS_icas_CRUISE_ACC1_Subsystem1_TrueDurationTime19 autosar_swc_icas_autosar_swc_icas_Step_sys_ICAS_icas_CRUISE_ACC1_Subsystem1_TrueDurationTime2 autosar_swc_icas_autosar_swc_icas_Step_sys_ICAS_icas_CRUISE_ACC1_Subsystem1_TrueDurationTime20 autosar_swc_icas_autosar_swc_icas_Step_sys_ICAS_icas_CRUISE_ACC1_Subsystem1_TrueDurationTime21 autosar_swc_icas_autosar_swc_icas_Step_sys_ICAS_icas_CRUISE_ACC1_Subsystem1_TrueDurationTime22 autosar_swc_icas_autosar_swc_icas_Step_sys_ICAS_icas_CRUISE_ACC1_Subsystem1_TrueDurationTime23 autosar_swc_icas_autosar_swc_icas_Step_sys_ICAS_icas_CRUISE_ACC1_Subsystem1_TrueDurationTime24 autosar_swc_icas_autosar_swc_icas_Step_sys_ICAS_icas_CRUISE_ACC1_Subsystem1_TrueDurationTime25 autosar_swc_icas_autosar_swc_icas_Step_sys_ICAS_icas_CRUISE_ACC1_Subsystem1_TrueDurationTime26 autosar_swc_icas_autosar_swc_icas_Step_sys_ICAS_icas_CRUISE_ACC1_Subsystem1_TrueDurationTime27 autosar_swc_icas_autosar_swc_icas_Step_sys_ICAS_icas_CRUISE_ACC1_Subsystem1_TrueDurationTime3 autosar_swc_icas_autosar_swc_icas_Step_sys_ICAS_icas_CRUISE_ACC1_Subsystem1_TrueDurationTime4 autosar_swc_icas_autosar_swc_icas_Step_sys_ICAS_icas_CRUISE_ACC1_Subsystem1_TrueDurationTime5 autosar_swc_icas_autosar_swc_icas_Step_sys_ICAS_icas_CRUISE_ACC1_Subsystem1_TrueDurationTime6 autosar_swc_icas_autosar_swc_icas_Step_sys_ICAS_icas_CRUISE_ACC1_Subsystem1_TrueDurationTime7 autosar_swc_icas_autosar_swc_icas_Step_sys_ICAS_icas_CRUISE_ACC1_Subsystem1_TrueDurationTime8 autosar_swc_icas_autosar_swc_icas_Step_sys_ICAS_icas_CRUISE_ACC1_Subsystem1_TrueDurationTime9 /end SUB_GROUP
 /begin REF_CHARACTERISTIC P_ACC_CurvSpdLimOffsetIn P_CRUISE_ACC_FastExitFuncStatus P_ICAS_ACCCurveSpdLimSwitch P_ICAS_ACCDoors P_ICAS_ACCDriverBrake P_ICAS_ACCInhibitTTC P_ICAS_ACCInhibitTimeGapRatio P_ICAS_ACCSeatBelt /end REF_CHARACTERISTIC
 /begin REF_MEASUREMENT ICAS_ACCActiveConEnable /end REF_MEASUREMENT
/end GROUP
/begin GROUP autosar_swc_icas_autosar_swc_icas_Step_sys_ICAS_icas_CRUISE_ACC1_Subsystem1_Compare_To_Constant106 "autosar_swc_icas/autosar_swc_icas_Step_sys/ICAS/icas/CRUISE_ACC1/Subsystem1/Compare\nTo Constant106" /begin REF_MEASUREMENT ICAS_ACC_AVPFunStatus /end REF_MEASUREMENT /end GROUP
/begin GROUP autosar_swc_icas_autosar_swc_icas_Step_sys_ICAS_icas_CRUISE_ACC1_Subsystem1_Compare_To_Constant107 "autosar_swc_icas/autosar_swc_icas_Step_sys/ICAS/icas/CRUISE_ACC1/Subsystem1/Compare\nTo Constant107" /begin REF_MEASUREMENT ICAS_ACC_AVPFunStatus /end REF_MEASUREMENT /end GROUP
/begin GROUP autosar_swc_icas_autosar_swc_icas_Step_sys_ICAS_icas_CRUISE_ACC1_Subsystem1_Compare_To_Constant12 "autosar_swc_icas/autosar_swc_icas_Step_sys/ICAS/icas/CRUISE_ACC1/Subsystem1/Compare\nTo Constant12" /begin REF_CHARACTERISTIC P_ACC_DriverBrakeIn /end REF_CHARACTERISTIC /end GROUP
/begin GROUP autosar_swc_icas_autosar_swc_icas_Step_sys_ICAS_icas_CRUISE_ACC1_Subsystem1_Compare_To_Constant124 "autosar_swc_icas/autosar_swc_icas_Step_sys/ICAS/icas/CRUISE_ACC1/Subsystem1/Compare\nTo Constant124" /begin REF_CHARACTERISTIC P_ICAS_ACCP0VxThreshold /end REF_CHARACTERISTIC /end GROUP
/begin GROUP autosar_swc_icas_autosar_swc_icas_Step_sys_ICAS_icas_CRUISE_ACC1_Subsystem1_Compare_To_Constant20 "autosar_swc_icas/autosar_swc_icas_Step_sys/ICAS/icas/CRUISE_ACC1/Subsystem1/Compare\nTo Constant20" /begin REF_CHARACTERISTIC P_ACC_AccelThreshholdIn /end REF_CHARACTERISTIC /end GROUP
/begin GROUP autosar_swc_icas_autosar_swc_icas_Step_sys_ICAS_icas_CRUISE_ACC1_Subsystem1_Compare_To_Constant44 "autosar_swc_icas/autosar_swc_icas_Step_sys/ICAS/icas/CRUISE_ACC1/Subsystem1/Compare\nTo Constant44" /begin REF_CHARACTERISTIC P_ACC_AccelThreshholdOut /end REF_CHARACTERISTIC /end GROUP
/begin GROUP autosar_swc_icas_autosar_swc_icas_Step_sys_ICAS_icas_CRUISE_ACC1_Subsystem1_Subsystem "autosar_swc_icas/autosar_swc_icas_Step_sys/ICAS/icas/CRUISE_ACC1/Subsystem1/Subsystem"
 /begin SUB_GROUP autosar_swc_icas_autosar_swc_icas_Step_sys_ICAS_icas_CRUISE_ACC1_Subsystem1_Subsystem_Compare_To_Constant7 /end SUB_GROUP
/end GROUP
/begin GROUP autosar_swc_icas_autosar_swc_icas_Step_sys_ICAS_icas_CRUISE_ACC1_Subsystem1_Subsystem_Compare_To_Constant7 "autosar_swc_icas/autosar_swc_icas_Step_sys/ICAS/icas/CRUISE_ACC1/Subsystem1/Subsystem/Compare\nTo Constant7" /begin REF_CHARACTERISTIC P_ACC_P0Range /end REF_CHARACTERISTIC /end GROUP
/begin GROUP autosar_swc_icas_autosar_swc_icas_Step_sys_ICAS_icas_CRUISE_ACC1_Subsystem1_TrueDurationTime1 "autosar_swc_icas/autosar_swc_icas_Step_sys/ICAS/icas/CRUISE_ACC1/Subsystem1/TrueDurationTime1"
 /begin REF_MEASUREMENT autosar_swc_icas_rtARID_DEF.UnitDelay1_DSTATE_gn autosar_swc_icas_rtARID_DEF.UnitDelay2_DSTATE_a0 /end REF_MEASUREMENT
/end GROUP
/begin GROUP autosar_swc_icas_autosar_swc_icas_Step_sys_ICAS_icas_CRUISE_ACC1_Subsystem1_TrueDurationTime10 "autosar_swc_icas/autosar_swc_icas_Step_sys/ICAS/icas/CRUISE_ACC1/Subsystem1/TrueDurationTime10"
 /begin REF_MEASUREMENT autosar_swc_icas_rtARID_DEF.UnitDelay1_DSTATE_kk autosar_swc_icas_rtARID_DEF.UnitDelay2_DSTATE_lu /end REF_MEASUREMENT
/end GROUP
/begin GROUP autosar_swc_icas_autosar_swc_icas_Step_sys_ICAS_icas_CRUISE_ACC1_Subsystem1_TrueDurationTime11 "autosar_swc_icas/autosar_swc_icas_Step_sys/ICAS/icas/CRUISE_ACC1/Subsystem1/TrueDurationTime11"
 /begin REF_MEASUREMENT autosar_swc_icas_rtARID_DEF.UnitDelay1_DSTATE_dw autosar_swc_icas_rtARID_DEF.UnitDelay2_DSTATE_fh /end REF_MEASUREMENT
/end GROUP
/begin GROUP autosar_swc_icas_autosar_swc_icas_Step_sys_ICAS_icas_CRUISE_ACC1_Subsystem1_TrueDurationTime12 "autosar_swc_icas/autosar_swc_icas_Step_sys/ICAS/icas/CRUISE_ACC1/Subsystem1/TrueDurationTime12"
 /begin REF_MEASUREMENT autosar_swc_icas_rtARID_DEF.UnitDelay1_DSTATE_n5 autosar_swc_icas_rtARID_DEF.UnitDelay2_DSTATE_cp /end REF_MEASUREMENT
/end GROUP
/begin GROUP autosar_swc_icas_autosar_swc_icas_Step_sys_ICAS_icas_CRUISE_ACC1_Subsystem1_TrueDurationTime13 "autosar_swc_icas/autosar_swc_icas_Step_sys/ICAS/icas/CRUISE_ACC1/Subsystem1/TrueDurationTime13"
 /begin REF_MEASUREMENT autosar_swc_icas_rtARID_DEF.UnitDelay1_DSTATE_g2 autosar_swc_icas_rtARID_DEF.UnitDelay2_DSTATE_ob /end REF_MEASUREMENT
/end GROUP
/begin GROUP autosar_swc_icas_autosar_swc_icas_Step_sys_ICAS_icas_CRUISE_ACC1_Subsystem1_TrueDurationTime14 "autosar_swc_icas/autosar_swc_icas_Step_sys/ICAS/icas/CRUISE_ACC1/Subsystem1/TrueDurationTime14"
 /begin REF_MEASUREMENT autosar_swc_icas_rtARID_DEF.UnitDelay1_DSTATE_jc autosar_swc_icas_rtARID_DEF.UnitDelay2_DSTATE_c2 /end REF_MEASUREMENT
/end GROUP
/begin GROUP autosar_swc_icas_autosar_swc_icas_Step_sys_ICAS_icas_CRUISE_ACC1_Subsystem1_TrueDurationTime15 "autosar_swc_icas/autosar_swc_icas_Step_sys/ICAS/icas/CRUISE_ACC1/Subsystem1/TrueDurationTime15"
 /begin REF_MEASUREMENT autosar_swc_icas_rtARID_DEF.UnitDelay1_DSTATE_l autosar_swc_icas_rtARID_DEF.UnitDelay2_DSTATE_gs /end REF_MEASUREMENT
/end GROUP
/begin GROUP autosar_swc_icas_autosar_swc_icas_Step_sys_ICAS_icas_CRUISE_ACC1_Subsystem1_TrueDurationTime16 "autosar_swc_icas/autosar_swc_icas_Step_sys/ICAS/icas/CRUISE_ACC1/Subsystem1/TrueDurationTime16"
 /begin REF_MEASUREMENT autosar_swc_icas_rtARID_DEF.UnitDelay1_DSTATE_hc autosar_swc_icas_rtARID_DEF.UnitDelay2_DSTATE_i1 /end REF_MEASUREMENT
/end GROUP
/begin GROUP autosar_swc_icas_autosar_swc_icas_Step_sys_ICAS_icas_CRUISE_ACC1_Subsystem1_TrueDurationTime17 "autosar_swc_icas/autosar_swc_icas_Step_sys/ICAS/icas/CRUISE_ACC1/Subsystem1/TrueDurationTime17"
 /begin REF_MEASUREMENT autosar_swc_icas_rtARID_DEF.UnitDelay1_DSTATE_ol autosar_swc_icas_rtARID_DEF.UnitDelay2_DSTATE_kp /end REF_MEASUREMENT
/end GROUP
/begin GROUP autosar_swc_icas_autosar_swc_icas_Step_sys_ICAS_icas_CRUISE_ACC1_Subsystem1_TrueDurationTime18 "autosar_swc_icas/autosar_swc_icas_Step_sys/ICAS/icas/CRUISE_ACC1/Subsystem1/TrueDurationTime18"
 /begin REF_MEASUREMENT autosar_swc_icas_rtARID_DEF.UnitDelay1_DSTATE_p3 autosar_swc_icas_rtARID_DEF.UnitDelay2_DSTATE_ey /end REF_MEASUREMENT
/end GROUP
/begin GROUP autosar_swc_icas_autosar_swc_icas_Step_sys_ICAS_icas_CRUISE_ACC1_Subsystem1_TrueDurationTime19 "autosar_swc_icas/autosar_swc_icas_Step_sys/ICAS/icas/CRUISE_ACC1/Subsystem1/TrueDurationTime19"
 /begin REF_MEASUREMENT autosar_swc_icas_rtARID_DEF.UnitDelay1_DSTATE_l2 autosar_swc_icas_rtARID_DEF.UnitDelay2_DSTATE_lj /end REF_MEASUREMENT
/end GROUP
/begin GROUP autosar_swc_icas_autosar_swc_icas_Step_sys_ICAS_icas_CRUISE_ACC1_Subsystem1_TrueDurationTime2 "autosar_swc_icas/autosar_swc_icas_Step_sys/ICAS/icas/CRUISE_ACC1/Subsystem1/TrueDurationTime2"
 /begin REF_MEASUREMENT autosar_swc_icas_rtARID_DEF.UnitDelay1_DSTATE_ps autosar_swc_icas_rtARID_DEF.UnitDelay2_DSTATE_i5 /end REF_MEASUREMENT
/end GROUP
/begin GROUP autosar_swc_icas_autosar_swc_icas_Step_sys_ICAS_icas_CRUISE_ACC1_Subsystem1_TrueDurationTime20 "autosar_swc_icas/autosar_swc_icas_Step_sys/ICAS/icas/CRUISE_ACC1/Subsystem1/TrueDurationTime20"
 /begin REF_MEASUREMENT autosar_swc_icas_rtARID_DEF.UnitDelay1_DSTATE_kc autosar_swc_icas_rtARID_DEF.UnitDelay2_DSTATE_oz /end REF_MEASUREMENT
/end GROUP
/begin GROUP autosar_swc_icas_autosar_swc_icas_Step_sys_ICAS_icas_CRUISE_ACC1_Subsystem1_TrueDurationTime21 "autosar_swc_icas/autosar_swc_icas_Step_sys/ICAS/icas/CRUISE_ACC1/Subsystem1/TrueDurationTime21"
 /begin REF_MEASUREMENT autosar_swc_icas_rtARID_DEF.UnitDelay1_DSTATE_gv autosar_swc_icas_rtARID_DEF.UnitDelay2_DSTATE_jj /end REF_MEASUREMENT
/end GROUP
/begin GROUP autosar_swc_icas_autosar_swc_icas_Step_sys_ICAS_icas_CRUISE_ACC1_Subsystem1_TrueDurationTime22 "autosar_swc_icas/autosar_swc_icas_Step_sys/ICAS/icas/CRUISE_ACC1/Subsystem1/TrueDurationTime22"
 /begin REF_MEASUREMENT autosar_swc_icas_rtARID_DEF.UnitDelay1_DSTATE_or autosar_swc_icas_rtARID_DEF.UnitDelay2_DSTATE_fl /end REF_MEASUREMENT
/end GROUP
/begin GROUP autosar_swc_icas_autosar_swc_icas_Step_sys_ICAS_icas_CRUISE_ACC1_Subsystem1_TrueDurationTime23 "autosar_swc_icas/autosar_swc_icas_Step_sys/ICAS/icas/CRUISE_ACC1/Subsystem1/TrueDurationTime23"
 /begin REF_MEASUREMENT autosar_swc_icas_rtARID_DEF.UnitDelay1_DSTATE_bd autosar_swc_icas_rtARID_DEF.UnitDelay2_DSTATE_m5 /end REF_MEASUREMENT
/end GROUP
/begin GROUP autosar_swc_icas_autosar_swc_icas_Step_sys_ICAS_icas_CRUISE_ACC1_Subsystem1_TrueDurationTime24 "autosar_swc_icas/autosar_swc_icas_Step_sys/ICAS/icas/CRUISE_ACC1/Subsystem1/TrueDurationTime24"
 /begin REF_MEASUREMENT autosar_swc_icas_rtARID_DEF.UnitDelay1_DSTATE_gx autosar_swc_icas_rtARID_DEF.UnitDelay2_DSTATE_ee /end REF_MEASUREMENT
/end GROUP
/begin GROUP autosar_swc_icas_autosar_swc_icas_Step_sys_ICAS_icas_CRUISE_ACC1_Subsystem1_TrueDurationTime25 "autosar_swc_icas/autosar_swc_icas_Step_sys/ICAS/icas/CRUISE_ACC1/Subsystem1/TrueDurationTime25"
 /begin REF_MEASUREMENT autosar_swc_icas_rtARID_DEF.UnitDelay1_DSTATE_hd autosar_swc_icas_rtARID_DEF.UnitDelay2_DSTATE_pf /end REF_MEASUREMENT
/end GROUP
/begin GROUP autosar_swc_icas_autosar_swc_icas_Step_sys_ICAS_icas_CRUISE_ACC1_Subsystem2 "autosar_swc_icas/autosar_swc_icas_Step_sys/ICAS/icas/CRUISE_ACC1/Subsystem2"
 /begin REF_MEASUREMENT ICAS_ACCActCondF ICAS_ACCActiveConEnable ICAS_ACCFastExit ICAS_ACCSlowExit ICAS_ACC_ACCSts ICAS_ACC_BOMExit SwcOut_ICAS_NvM_Set_ACCStsInit autosar_swc_icas_rtARID_DEF.AND2 autosar_swc_icas_rtARID_DEF.AND4 autosar_swc_icas_rtARID_DEF.AND5 autosar_swc_icas_rtARID_DEF.LogicalOperator76 autosar_swc_icas_rtARID_DEF.LogicalOperator79 autosar_swc_icas_rtARID_DEF.LogicalOperator81 /end REF_MEASUREMENT
/end GROUP
/begin GROUP autosar_swc_icas_autosar_swc_icas_Step_sys_ICAS_icas_CRUISE_ACC1_Subsystem3 "autosar_swc_icas/autosar_swc_icas_Step_sys/ICAS/icas/CRUISE_ACC1/Subsystem3" /begin REF_MEASUREMENT ICAS_ACC_ACCSts /end REF_MEASUREMENT /end GROUP
/begin GROUP autosar_swc_icas_autosar_swc_icas_Step_sys_ICAS_icas_CRUISE_ACC1_Subsystem_Compare_To_Constant103 "autosar_swc_icas/autosar_swc_icas_Step_sys/ICAS/icas/CRUISE_ACC1/Subsystem/Compare\nTo Constant103" /begin REF_MEASUREMENT ICAS_ACC_USS_DrvroffConEn /end REF_MEASUREMENT /end GROUP
/begin GROUP autosar_swc_icas_autosar_swc_icas_Step_sys_ICAS_icas_CRUISE_ACC1_Subsystem_Compare_To_Constant106 "autosar_swc_icas/autosar_swc_icas_Step_sys/ICAS/icas/CRUISE_ACC1/Subsystem/Compare\nTo Constant106" /begin REF_MEASUREMENT ICAS_ACC_AVPFunStatus /end REF_MEASUREMENT /end GROUP
/begin GROUP autosar_swc_icas_autosar_swc_icas_Step_sys_ICAS_icas_CRUISE_ACC1_Subsystem_Compare_To_Constant107 "autosar_swc_icas/autosar_swc_icas_Step_sys/ICAS/icas/CRUISE_ACC1/Subsystem/Compare\nTo Constant107" /begin REF_MEASUREMENT ICAS_ACC_AVPFunStatus /end REF_MEASUREMENT /end GROUP
/begin GROUP autosar_swc_icas_autosar_swc_icas_Step_sys_ICAS_icas_CRUISE_ACC1_Subsystem_Compare_To_Constant124 "autosar_swc_icas/autosar_swc_icas_Step_sys/ICAS/icas/CRUISE_ACC1/Subsystem/Compare\nTo Constant124" /begin REF_CHARACTERISTIC P_ICAS_ACCP0VxThreshold /end REF_CHARACTERISTIC /end GROUP
/begin GROUP autosar_swc_icas_autosar_swc_icas_Step_sys_ICAS_icas_CRUISE_ACC1_Subsystem_Compare_To_Constant2 "autosar_swc_icas/autosar_swc_icas_Step_sys/ICAS/icas/CRUISE_ACC1/Subsystem/Compare\nTo Constant2" /begin REF_CHARACTERISTIC P_ICAS_ACCInhibitTTC /end REF_CHARACTERISTIC /end GROUP
/begin GROUP autosar_swc_icas_autosar_swc_icas_Step_sys_ICAS_icas_CRUISE_ACC1_Subsystem_Compare_To_Constant20 "autosar_swc_icas/autosar_swc_icas_Step_sys/ICAS/icas/CRUISE_ACC1/Subsystem/Compare\nTo Constant20" /begin REF_CHARACTERISTIC P_ACC_AccelThreshholdIn /end REF_CHARACTERISTIC /end GROUP
/begin GROUP autosar_swc_icas_autosar_swc_icas_Step_sys_ICAS_icas_CRUISE_ACC1_Subsystem_Compare_To_Constant51 "autosar_swc_icas/autosar_swc_icas_Step_sys/ICAS/icas/CRUISE_ACC1/Subsystem/Compare\nTo Constant51" /begin REF_CHARACTERISTIC P_ACC_AccelThreshholdOut /end REF_CHARACTERISTIC /end GROUP
/begin GROUP autosar_swc_icas_autosar_swc_icas_Step_sys_ICAS_icas_CRUISE_ACC1_Subsystem_Compare_To_Constant71 "autosar_swc_icas/autosar_swc_icas_Step_sys/ICAS/icas/CRUISE_ACC1/Subsystem/Compare\nTo Constant71" /begin REF_MEASUREMENT ICAS_ACCSlowExit /end REF_MEASUREMENT /end GROUP
/begin GROUP autosar_swc_icas_autosar_swc_icas_Step_sys_ICAS_icas_CRUISE_ACC1_Subsystem_Compare_To_Constant93 "autosar_swc_icas/autosar_swc_icas_Step_sys/ICAS/icas/CRUISE_ACC1/Subsystem/Compare\nTo Constant93" /begin REF_MEASUREMENT ICAS_ACCSlowExit /end REF_MEASUREMENT /end GROUP
/begin GROUP autosar_swc_icas_autosar_swc_icas_Step_sys_ICAS_icas_CRUISE_ACC1_Subsystem_Compare_To_Constant99 "autosar_swc_icas/autosar_swc_icas_Step_sys/ICAS/icas/CRUISE_ACC1/Subsystem/Compare\nTo Constant99" /begin REF_MEASUREMENT ICAS_ACC_USS_DrvroffConEn /end REF_MEASUREMENT /end GROUP
/begin GROUP autosar_swc_icas_autosar_swc_icas_Step_sys_ICAS_icas_CRUISE_ACC1_Subsystem_Subsystem_Compare_To_Constant7 "autosar_swc_icas/autosar_swc_icas_Step_sys/ICAS/icas/CRUISE_ACC1/Subsystem/Subsystem/Compare\nTo Constant7" /begin REF_CHARACTERISTIC P_ACC_P0Range /end REF_CHARACTERISTIC /end GROUP
/begin GROUP autosar_swc_icas_autosar_swc_icas_Step_sys_ICAS_icas_CRUISE_LongHMI "autosar_swc_icas/autosar_swc_icas_Step_sys/ICAS/icas/CRUISE_LongHMI"
 /begin REF_MEASUREMENT ICAS_ACC_ACCSts ICAS_longHMI_CRUISETextDisp autosar_swc_icas_rtARID_DEF.CRUISE_longHMI_HazSts /end REF_MEASUREMENT
/end GROUP
/begin GROUP autosar_swc_icas_autosar_swc_icas_Step_sys_ICAS_icas_CRUISE_LongHMI_Compare_To_Constant1 "autosar_swc_icas/autosar_swc_icas_Step_sys/ICAS/icas/CRUISE_LongHMI/Compare\nTo Constant1" /begin REF_MEASUREMENT ICAS_ACC_ACCSts /end REF_MEASUREMENT /end GROUP
/begin GROUP autosar_swc_icas_autosar_swc_icas_Step_sys_ICAS_icas_CRUISE_LongHMI_Compare_To_Constant10 "autosar_swc_icas/autosar_swc_icas_Step_sys/ICAS/icas/CRUISE_LongHMI/Compare\nTo Constant10" /begin REF_MEASUREMENT ICAS_TJAHandsOffWarningLevel /end REF_MEASUREMENT /end GROUP
/begin GROUP autosar_swc_icas_autosar_swc_icas_Step_sys_ICAS_icas_CRUISE_LongHMI_Compare_To_Constant102 "autosar_swc_icas/autosar_swc_icas_Step_sys/ICAS/icas/CRUISE_LongHMI/Compare\nTo Constant102" /begin REF_MEASUREMENT ICAS_ACC_ACCSts /end REF_MEASUREMENT /end GROUP
/begin GROUP autosar_swc_icas_autosar_swc_icas_Step_sys_ICAS_icas_CRUISE_LongHMI_Compare_To_Constant104 "autosar_swc_icas/autosar_swc_icas_Step_sys/ICAS/icas/CRUISE_LongHMI/Compare\nTo Constant104" /begin REF_MEASUREMENT ICAS_ACC_ACCSts /end REF_MEASUREMENT /end GROUP
/begin GROUP autosar_swc_icas_autosar_swc_icas_Step_sys_ICAS_icas_CRUISE_LongHMI_Compare_To_Constant105 "autosar_swc_icas/autosar_swc_icas_Step_sys/ICAS/icas/CRUISE_LongHMI/Compare\nTo Constant105" /begin REF_MEASUREMENT ICAS_ACC_ACCSts /end REF_MEASUREMENT /end GROUP
/begin GROUP autosar_swc_icas_autosar_swc_icas_Step_sys_ICAS_icas_CRUISE_LongHMI_Compare_To_Constant113 "autosar_swc_icas/autosar_swc_icas_Step_sys/ICAS/icas/CRUISE_LongHMI/Compare\nTo Constant113" /begin REF_MEASUREMENT ICAS_ACC_ACCSts /end REF_MEASUREMENT /end GROUP
/begin GROUP autosar_swc_icas_autosar_swc_icas_Step_sys_ICAS_icas_CRUISE_LongHMI_Compare_To_Constant140 "autosar_swc_icas/autosar_swc_icas_Step_sys/ICAS/icas/CRUISE_LongHMI/Compare\nTo Constant140" /begin REF_MEASUREMENT ICAS_TJAHandsOffWarningLevel /end REF_MEASUREMENT /end GROUP
/begin GROUP autosar_swc_icas_autosar_swc_icas_Step_sys_ICAS_icas_CRUISE_LongHMI_Compare_To_Constant149 "autosar_swc_icas/autosar_swc_icas_Step_sys/ICAS/icas/CRUISE_LongHMI/Compare\nTo Constant149" /begin REF_MEASUREMENT ICAS_ACC_ACCSts /end REF_MEASUREMENT /end GROUP
/begin GROUP autosar_swc_icas_autosar_swc_icas_Step_sys_ICAS_icas_CRUISE_LongHMI_Compare_To_Constant16 "autosar_swc_icas/autosar_swc_icas_Step_sys/ICAS/icas/CRUISE_LongHMI/Compare\nTo Constant16" /begin REF_MEASUREMENT ICAS_ACC_ACCSts /end REF_MEASUREMENT /end GROUP
/begin GROUP autosar_swc_icas_autosar_swc_icas_Step_sys_ICAS_icas_CRUISE_LongHMI_Compare_To_Constant170 "autosar_swc_icas/autosar_swc_icas_Step_sys/ICAS/icas/CRUISE_LongHMI/Compare\nTo Constant170" /begin REF_MEASUREMENT ICAS_ACC_ACCSts /end REF_MEASUREMENT /end GROUP
/begin GROUP autosar_swc_icas_autosar_swc_icas_Step_sys_ICAS_icas_CRUISE_LongHMI_Compare_To_Constant18 "autosar_swc_icas/autosar_swc_icas_Step_sys/ICAS/icas/CRUISE_LongHMI/Compare\nTo Constant18" /begin REF_MEASUREMENT ICAS_ACC_ACCSts /end REF_MEASUREMENT /end GROUP
/begin GROUP autosar_swc_icas_autosar_swc_icas_Step_sys_ICAS_icas_CRUISE_LongHMI_Compare_To_Constant19 "autosar_swc_icas/autosar_swc_icas_Step_sys/ICAS/icas/CRUISE_LongHMI/Compare\nTo Constant19" /begin REF_MEASUREMENT ICAS_ACC_ACCSts /end REF_MEASUREMENT /end GROUP
/begin GROUP autosar_swc_icas_autosar_swc_icas_Step_sys_ICAS_icas_CRUISE_LongHMI_Compare_To_Constant20 "autosar_swc_icas/autosar_swc_icas_Step_sys/ICAS/icas/CRUISE_LongHMI/Compare\nTo Constant20" /begin REF_MEASUREMENT ICAS_ACC_ACCSts /end REF_MEASUREMENT /end GROUP
/begin GROUP autosar_swc_icas_autosar_swc_icas_Step_sys_ICAS_icas_CRUISE_LongHMI_Compare_To_Constant3 "autosar_swc_icas/autosar_swc_icas_Step_sys/ICAS/icas/CRUISE_LongHMI/Compare\nTo Constant3" /begin REF_MEASUREMENT ICAS_ACC_ACCSts /end REF_MEASUREMENT /end GROUP
/begin GROUP autosar_swc_icas_autosar_swc_icas_Step_sys_ICAS_icas_CRUISE_LongHMI_Compare_To_Constant33 "autosar_swc_icas/autosar_swc_icas_Step_sys/ICAS/icas/CRUISE_LongHMI/Compare\nTo Constant33" /begin REF_MEASUREMENT ICAS_ACC_ACCSts /end REF_MEASUREMENT /end GROUP
/begin GROUP autosar_swc_icas_autosar_swc_icas_Step_sys_ICAS_icas_CRUISE_LongHMI_Compare_To_Constant40 "autosar_swc_icas/autosar_swc_icas_Step_sys/ICAS/icas/CRUISE_LongHMI/Compare\nTo Constant40" /begin REF_MEASUREMENT ICAS_ACC_ACCSts /end REF_MEASUREMENT /end GROUP
/begin GROUP autosar_swc_icas_autosar_swc_icas_Step_sys_ICAS_icas_CRUISE_LongHMI_Compare_To_Constant45 "autosar_swc_icas/autosar_swc_icas_Step_sys/ICAS/icas/CRUISE_LongHMI/Compare\nTo Constant45" /begin REF_MEASUREMENT ICAS_ACC_ACCSts /end REF_MEASUREMENT /end GROUP
/begin GROUP autosar_swc_icas_autosar_swc_icas_Step_sys_ICAS_icas_CRUISE_LongHMI_Compare_To_Constant6 "autosar_swc_icas/autosar_swc_icas_Step_sys/ICAS/icas/CRUISE_LongHMI/Compare\nTo Constant6" /begin REF_MEASUREMENT ICAS_TJAHandsOffWarningLevel /end REF_MEASUREMENT /end GROUP
/begin GROUP autosar_swc_icas_autosar_swc_icas_Step_sys_ICAS_icas_CRUISE_LongHMI_Compare_To_Constant68 "autosar_swc_icas/autosar_swc_icas_Step_sys/ICAS/icas/CRUISE_LongHMI/Compare\nTo Constant68" /begin REF_MEASUREMENT ICAS_ACC_ACCSts /end REF_MEASUREMENT /end GROUP
/begin GROUP autosar_swc_icas_autosar_swc_icas_Step_sys_ICAS_icas_CRUISE_LongHMI_Compare_To_Constant69 "autosar_swc_icas/autosar_swc_icas_Step_sys/ICAS/icas/CRUISE_LongHMI/Compare\nTo Constant69" /begin REF_MEASUREMENT ICAS_TJAHandsOffWarningLevel /end REF_MEASUREMENT /end GROUP
/begin GROUP autosar_swc_icas_autosar_swc_icas_Step_sys_ICAS_icas_CRUISE_LongHMI_Compare_To_Constant9 "autosar_swc_icas/autosar_swc_icas_Step_sys/ICAS/icas/CRUISE_LongHMI/Compare\nTo Constant9" /begin REF_MEASUREMENT ICAS_ACC_ACCSts /end REF_MEASUREMENT /end GROUP
/begin GROUP autosar_swc_icas_autosar_swc_icas_Step_sys_ICAS_icas_CRUISE_LongHMI_Compare_To_Constant96 "autosar_swc_icas/autosar_swc_icas_Step_sys/ICAS/icas/CRUISE_LongHMI/Compare\nTo Constant96" /begin REF_MEASUREMENT ICAS_ACC_ACCSts /end REF_MEASUREMENT /end GROUP
/begin GROUP autosar_swc_icas_autosar_swc_icas_Step_sys_ICAS_icas_CRUISE_LongHMI_Subsystem1 "autosar_swc_icas/autosar_swc_icas_Step_sys/ICAS/icas/CRUISE_LongHMI/Subsystem1" /begin REF_MEASUREMENT ICAS_ACC_ACCSts /end REF_MEASUREMENT /end GROUP
/begin GROUP autosar_swc_icas_autosar_swc_icas_Step_sys_ICAS_icas_CRUISE_LongHMI_Subsystem1_Compare_To_Constant3 "autosar_swc_icas/autosar_swc_icas_Step_sys/ICAS/icas/CRUISE_LongHMI/Subsystem1/Compare\nTo Constant3" /begin REF_MEASUREMENT ICAS_ACC_ACCSts /end REF_MEASUREMENT /end GROUP
/begin GROUP autosar_swc_icas_autosar_swc_icas_Step_sys_ICAS_icas_CRUISE_LongHMI_Subsystem2 "autosar_swc_icas/autosar_swc_icas_Step_sys/ICAS/icas/CRUISE_LongHMI/Subsystem2" /begin REF_MEASUREMENT ICAS_ACC_ACCSts /end REF_MEASUREMENT /end GROUP
/begin GROUP autosar_swc_icas_autosar_swc_icas_Step_sys_ICAS_icas_CRUISE_LongHMI_Subsystem2_Compare_To_Constant1 "autosar_swc_icas/autosar_swc_icas_Step_sys/ICAS/icas/CRUISE_LongHMI/Subsystem2/Compare\nTo Constant1" /begin REF_MEASUREMENT ICAS_ACC_ACCSts /end REF_MEASUREMENT /end GROUP
/begin GROUP autosar_swc_icas_autosar_swc_icas_Step_sys_ICAS_icas_Compare_To_Constant "autosar_swc_icas/autosar_swc_icas_Step_sys/ICAS/icas/Compare\nTo Constant" /begin REF_MEASUREMENT ICAS_TJAHandsOffWarningLevel /end REF_MEASUREMENT /end GROUP
/begin GROUP autosar_swc_icas_autosar_swc_icas_Step_sys_ICAS_icas_DataCollect_Compare_To_Constant "autosar_swc_icas/autosar_swc_icas_Step_sys/ICAS/icas/DataCollect/Compare\nTo Constant" /begin REF_MEASUREMENT ICAS_ACC_ACCSts /end REF_MEASUREMENT /end GROUP
/begin GROUP autosar_swc_icas_autosar_swc_icas_Step_sys_ICAS_icas_DataCollect_Compare_To_Constant1 "autosar_swc_icas/autosar_swc_icas_Step_sys/ICAS/icas/DataCollect/Compare\nTo Constant1" /begin REF_MEASUREMENT ICAS_ACC_ACCSts /end REF_MEASUREMENT /end GROUP
/begin GROUP autosar_swc_icas_autosar_swc_icas_Step_sys_ICAS_icas_DataCollect_Compare_To_Constant15 "autosar_swc_icas/autosar_swc_icas_Step_sys/ICAS/icas/DataCollect/Compare\nTo Constant15" /begin REF_MEASUREMENT ICAS_ACC_ACCSts /end REF_MEASUREMENT /end GROUP
/begin GROUP autosar_swc_icas_autosar_swc_icas_Step_sys_ICAS_icas_HOD "autosar_swc_icas/autosar_swc_icas_Step_sys/ICAS/icas/HOD" /begin REF_MEASUREMENT ICAS_TJAHandsOffWarningLevel /end REF_MEASUREMENT /end GROUP
/begin GROUP autosar_swc_icas_autosar_swc_icas_Step_sys_ICAS_icas_Subsystem "autosar_swc_icas/autosar_swc_icas_Step_sys/ICAS/icas/Subsystem" /begin REF_MEASUREMENT SwcOut_ICAS_ADAS_Request /end REF_MEASUREMENT /end GROUP
/begin GROUP autosar_swc_icas_autosar_swc_icas_Step_sys_ICAS_icas_Subsystem1_Compare_To_Constant10 "autosar_swc_icas/autosar_swc_icas_Step_sys/ICAS/icas/Subsystem1/Compare\nTo Constant10" /begin REF_MEASUREMENT ICAS_ACC_ACCSts /end REF_MEASUREMENT /end GROUP
/begin GROUP autosar_swc_icas_autosar_swc_icas_Step_sys_ICAS_icas_Subsystem1_Compare_To_Constant24 "autosar_swc_icas/autosar_swc_icas_Step_sys/ICAS/icas/Subsystem1/Compare\nTo Constant24" /begin REF_MEASUREMENT ICAS_ACC_ACCSts /end REF_MEASUREMENT /end GROUP
/begin GROUP autosar_swc_icas_autosar_swc_icas_Step_sys_ICAS_icas_Subsystem1_Compare_To_Constant30 "autosar_swc_icas/autosar_swc_icas_Step_sys/ICAS/icas/Subsystem1/Compare\nTo Constant30" /begin REF_MEASUREMENT ICAS_ACC_ACCSts /end REF_MEASUREMENT /end GROUP
/begin GROUP autosar_swc_icas_autosar_swc_icas_Step_sys_ICAS_icas_Subsystem1_Compare_To_Constant31 "autosar_swc_icas/autosar_swc_icas_Step_sys/ICAS/icas/Subsystem1/Compare\nTo Constant31" /begin REF_MEASUREMENT ICAS_ACC_ACCSts /end REF_MEASUREMENT /end GROUP
/begin GROUP autosar_swc_icas_autosar_swc_icas_Step_sys_ICAS_icas_Subsystem1_Compare_To_Constant5 "autosar_swc_icas/autosar_swc_icas_Step_sys/ICAS/icas/Subsystem1/Compare\nTo Constant5" /begin REF_MEASUREMENT ICAS_ACC_ACCSts /end REF_MEASUREMENT /end GROUP
/begin GROUP autosar_swc_icas_autosar_swc_icas_Step_sys_ICAS_icas_Subsystem4_LCC_CONDITIONS "autosar_swc_icas/autosar_swc_icas_Step_sys/ICAS/icas/Subsystem4/LCC_CONDITIONS" /begin REF_MEASUREMENT ICAS_ACC_ACCSts /end REF_MEASUREMENT /end GROUP
/begin GROUP autosar_swc_icas_autosar_swc_icas_Step_sys_ICAS_icas_Subsystem4_LCC_CONDITIONS_Compare_To_Constant14 "autosar_swc_icas/autosar_swc_icas_Step_sys/ICAS/icas/Subsystem4/LCC_CONDITIONS/Compare\nTo Constant14" /begin REF_MEASUREMENT ICAS_ACC_ACCSts /end REF_MEASUREMENT /end GROUP
/begin GROUP autosar_swc_icas_autosar_swc_icas_Step_sys_ICAS_icas_Subsystem4_LCC_CONDITIONS_Compare_To_Constant38 "autosar_swc_icas/autosar_swc_icas_Step_sys/ICAS/icas/Subsystem4/LCC_CONDITIONS/Compare\nTo Constant38" /begin REF_MEASUREMENT ICAS_ACC_ACCSts /end REF_MEASUREMENT /end GROUP
/begin GROUP autosar_swc_icas_autosar_swc_icas_Step_sys_ICAS_icas_Subsystem4_LCC_CONDITIONS_Compare_To_Constant40 "autosar_swc_icas/autosar_swc_icas_Step_sys/ICAS/icas/Subsystem4/LCC_CONDITIONS/Compare\nTo Constant40" /begin REF_MEASUREMENT ICAS_ACC_ACCSts /end REF_MEASUREMENT /end GROUP
/begin GROUP autosar_swc_icas_autosar_swc_icas_Step_sys_ICAS_icas_Subsystem4_LCC_CONDITIONS_Compare_To_Constant41 "autosar_swc_icas/autosar_swc_icas_Step_sys/ICAS/icas/Subsystem4/LCC_CONDITIONS/Compare\nTo Constant41" /begin REF_MEASUREMENT ICAS_ACC_ACCSts /end REF_MEASUREMENT /end GROUP
/begin GROUP autosar_swc_icas_autosar_swc_icas_Step_sys_ICAS_icas_Subsystem4_LCC_CONDITIONS_Compare_To_Constant42 "autosar_swc_icas/autosar_swc_icas_Step_sys/ICAS/icas/Subsystem4/LCC_CONDITIONS/Compare\nTo Constant42" /begin REF_MEASUREMENT ICAS_ACC_ACCSts /end REF_MEASUREMENT /end GROUP
/begin GROUP autosar_swc_icas_autosar_swc_icas_Step_sys_ICAS_icas_Subsystem4_LCC_CONDITIONS_Compare_To_Constant43 "autosar_swc_icas/autosar_swc_icas_Step_sys/ICAS/icas/Subsystem4/LCC_CONDITIONS/Compare\nTo Constant43" /begin REF_MEASUREMENT ICAS_ACC_ACCSts /end REF_MEASUREMENT /end GROUP
/begin GROUP autosar_swc_icas_autosar_swc_icas_Step_sys_ICAS_icas_Subsystem4_LCC_CONDITIONS_Compare_To_Constant54 "autosar_swc_icas/autosar_swc_icas_Step_sys/ICAS/icas/Subsystem4/LCC_CONDITIONS/Compare\nTo Constant54" /begin REF_MEASUREMENT ICAS_ACC_ACCSts /end REF_MEASUREMENT /end GROUP
/begin GROUP autosar_swc_icas_autosar_swc_icas_Step_sys_ICAS_icas_Subsystem4_LCC_CONDITIONS_Compare_To_Constant55 "autosar_swc_icas/autosar_swc_icas_Step_sys/ICAS/icas/Subsystem4/LCC_CONDITIONS/Compare\nTo Constant55" /begin REF_MEASUREMENT ICAS_ACC_ACCSts /end REF_MEASUREMENT /end GROUP
/begin GROUP autosar_swc_icas_autosar_swc_icas_Step_sys_ICAS_icas_Subsystem4_LCC_CONDITIONS_Compare_To_Constant56 "autosar_swc_icas/autosar_swc_icas_Step_sys/ICAS/icas/Subsystem4/LCC_CONDITIONS/Compare\nTo Constant56" /begin REF_MEASUREMENT ICAS_ACC_ACCSts /end REF_MEASUREMENT /end GROUP
/begin GROUP autosar_swc_icas_autosar_swc_icas_Step_sys_ICAS_icas_Subsystem4_LCC_CONDITIONS_Compare_To_Constant57 "autosar_swc_icas/autosar_swc_icas_Step_sys/ICAS/icas/Subsystem4/LCC_CONDITIONS/Compare\nTo Constant57" /begin REF_MEASUREMENT ICAS_TJAHandsOffWarningLevel /end REF_MEASUREMENT /end GROUP
/begin GROUP autosar_swc_icas_autosar_swc_icas_Step_sys_ICAS_icas_Subsystem_ACC_ActiveControl "autosar_swc_icas/autosar_swc_icas_Step_sys/ICAS/icas/Subsystem/ACC_ActiveControl" /begin REF_MEASUREMENT ICAS_ACC_ACCSts /end REF_MEASUREMENT /end GROUP
/begin GROUP autosar_swc_icas_autosar_swc_icas_Step_sys_ICAS_icas_Subsystem_ACC_BrakeOnly "autosar_swc_icas/autosar_swc_icas_Step_sys/ICAS/icas/Subsystem/ACC_BrakeOnly" /begin REF_MEASUREMENT ICAS_ACC_ACCSts /end REF_MEASUREMENT /end GROUP
/begin GROUP autosar_swc_icas_autosar_swc_icas_Step_sys_ICAS_icas_Subsystem_ACC_ComfortExit "autosar_swc_icas/autosar_swc_icas_Step_sys/ICAS/icas/Subsystem/ACC_ComfortExit" /begin REF_MEASUREMENT ICAS_ACC_ACCSts /end REF_MEASUREMENT /end GROUP
/begin GROUP autosar_swc_icas_autosar_swc_icas_Step_sys_ICAS_icas_Subsystem_ACC_Override "autosar_swc_icas/autosar_swc_icas_Step_sys/ICAS/icas/Subsystem/ACC_Override" /begin REF_MEASUREMENT ICAS_ACC_ACCSts /end REF_MEASUREMENT /end GROUP
/begin GROUP autosar_swc_icas_autosar_swc_icas_Step_sys_ICAS_icas_Subsystem_ACC_StandActive "autosar_swc_icas/autosar_swc_icas_Step_sys/ICAS/icas/Subsystem/ACC_StandActive" /begin REF_MEASUREMENT ICAS_ACC_ACCSts /end REF_MEASUREMENT /end GROUP
/begin GROUP autosar_swc_icas_autosar_swc_icas_Step_sys_ICAS_icas_Subsystem_ACC_StandWait "autosar_swc_icas/autosar_swc_icas_Step_sys/ICAS/icas/Subsystem/ACC_StandWait" /begin REF_MEASUREMENT ICAS_ACC_ACCSts /end REF_MEASUREMENT /end GROUP
/begin RECORD_LAYOUT Record_BOOLEAN FNC_VALUES 1 UBYTE COLUMN_DIR DIRECT /end RECORD_LAYOUT
/begin RECORD_LAYOUT Record_FLOAT32_IEEE FNC_VALUES 1 FLOAT32_IEEE COLUMN_DIR DIRECT /end RECORD_LAYOUT
/begin RECORD_LAYOUT Record_UBYTE FNC_VALUES 1 UBYTE COLUMN_DIR DIRECT /end RECORD_LAYOUT
/begin RECORD_LAYOUT Record_UWORD FNC_VALUES 1 UWORD COLUMN_DIR DIRECT /end RECORD_LAYOUT
/begin RECORD_LAYOUT Record_BOOLEAN FNC_VALUES 1 UBYTE COLUMN_DIR DIRECT /end RECORD_LAYOUT
/begin RECORD_LAYOUT Record_FLOAT32_IEEE FNC_VALUES 1 FLOAT32_IEEE COLUMN_DIR DIRECT /end RECORD_LAYOUT
/begin RECORD_LAYOUT Record_UBYTE FNC_VALUES 1 UBYTE COLUMN_DIR DIRECT /end RECORD_LAYOUT
/begin RECORD_LAYOUT Record_UWORD FNC_VALUES 1 UWORD COLUMN_DIR DIRECT /end RECORD_LAYOUT
/begin RECORD_LAYOUT Record_BOOLEAN FNC_VALUES 1 UBYTE COLUMN_DIR DIRECT /end RECORD_LAYOUT
/begin RECORD_LAYOUT Record_FLOAT32_IEEE FNC_VALUES 1 FLOAT32_IEEE COLUMN_DIR DIRECT /end RECORD_LAYOUT
/begin RECORD_LAYOUT Record_UBYTE FNC_VALUES 1 UBYTE COLUMN_DIR DIRECT /end RECORD_LAYOUT
/begin RECORD_LAYOUT Record_UWORD FNC_VALUES 1 UWORD COLUMN_DIR DIRECT /end RECORD_LAYOUT
/begin RECORD_LAYOUT Record_BOOLEAN FNC_VALUES 1 UBYTE COLUMN_DIR DIRECT /end RECORD_LAYOUT
/begin RECORD_LAYOUT Record_FLOAT32_IEEE FNC_VALUES 1 FLOAT32_IEEE COLUMN_DIR DIRECT /end RECORD_LAYOUT
/begin RECORD_LAYOUT Record_UBYTE FNC_VALUES 1 UBYTE COLUMN_DIR DIRECT /end RECORD_LAYOUT
/begin RECORD_LAYOUT Record_UWORD FNC_VALUES 1 UWORD COLUMN_DIR DIRECT /end RECORD_LAYOUT
/begin RECORD_LAYOUT Record_BOOLEAN FNC_VALUES 1 UBYTE COLUMN_DIR DIRECT /end RECORD_LAYOUT
/begin RECORD_LAYOUT Record_FLOAT32_IEEE FNC_VALUES 1 FLOAT32_IEEE COLUMN_DIR DIRECT /end RECORD_LAYOUT
/begin RECORD_LAYOUT Record_UBYTE FNC_VALUES 1 UBYTE COLUMN_DIR DIRECT /end RECORD_LAYOUT
/begin RECORD_LAYOUT Record_UWORD FNC_VALUES 1 UWORD COLUMN_DIR DIRECT /end RECORD_LAYOUT
/begin RECORD_LAYOUT Record_BOOLEAN FNC_VALUES 1 UBYTE COLUMN_DIR DIRECT /end RECORD_LAYOUT
/begin RECORD_LAYOUT Record_FLOAT32_IEEE FNC_VALUES 1 FLOAT32_IEEE COLUMN_DIR DIRECT /end RECORD_LAYOUT
/begin RECORD_LAYOUT Record_UBYTE FNC_VALUES 1 UBYTE COLUMN_DIR DIRECT /end RECORD_LAYOUT
/begin RECORD_LAYOUT Record_UWORD FNC_VALUES 1 UWORD COLUMN_DIR DIRECT /end RECORD_LAYOUT
/begin RECORD_LAYOUT Record_BOOLEAN FNC_VALUES 1 UBYTE COLUMN_DIR DIRECT /end RECORD_LAYOUT
/begin RECORD_LAYOUT Record_FLOAT32_IEEE FNC_VALUES 1 FLOAT32_IEEE COLUMN_DIR DIRECT /end RECORD_LAYOUT
/begin RECORD_LAYOUT Record_UBYTE FNC_VALUES 1 UBYTE COLUMN_DIR DIRECT /end RECORD_LAYOUT
/begin RECORD_LAYOUT Record_UWORD FNC_VALUES 1 UWORD COLUMN_DIR DIRECT /end RECORD_LAYOUT
/end MODULE
/end PROJECT
