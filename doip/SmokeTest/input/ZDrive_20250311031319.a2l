ASAP2_VERSION 1 71
/begin PROJECT ProjectName ""
/begin MODULE ModuleName ""
/begin MOD_COMMON "" BYTE_ORDER MSB_LAST ALIGNMENT_BYTE 1 ALIGNMENT_WORD 1 ALIGNMENT_LONG 1 ALIGNMENT_INT64 1 ALIGNMENT_FLOAT16_IEEE 1 ALIGNMENT_FLOAT32_IEEE 1 ALIGNMENT_FLOAT64_IEEE 1 /end MOD_COMMON
/begin CHARACTERISTIC CLTS_AgDirForBicycleSteerMinInAsyEvlrCritEve_Ca "Minimum heading angle for bicycles, for evaluation of steering out of path." VALUE 0xfe5072a8 /* @ECU_Address@CLTS_AgDirForBicycleSteerMinInAsyEvlrCritEve_Ca@ */ Record_FLOAT32_IEEE 0 autosar_swc_aeb_CM_single_rad 0.000000 3.140000 /end CHARACTERISTIC
/begin CHARACTERISTIC CLTS_AgDirForSteerMinInAsyEvlrCritEve_Ca "Minimum object heading angle for evaluation of steering out of path." VALUE 0xfe5072b0 /* @ECU_Address@CLTS_AgDirForSteerMinInAsyEvlrCritEve_Ca@ */ Record_FLOAT32_IEEE 0 autosar_swc_aeb_CM_single_rad 0.000000 3.140000 /end CHARACTERISTIC
/begin CHARACTERISTIC CLTS_AgDirInPahCalcnLongInAsyEvlrCritEve_Ca "Maximum heading angle for a stricter in path calculation, long prediction time." VALUE 0xfe5072b4 /* @ECU_Address@CLTS_AgDirInPahCalcnLongInAsyEvlrCritEve_Ca@ */ Record_FLOAT32_IEEE 0 autosar_swc_aeb_CM_single_rad 0.000000 3.140000 /end CHARACTERISTIC
/begin CHARACTERISTIC CLTS_AgDirInPahCalcnShoInAsyEvlrCritEve_Ca "Maximum heading angle for a stricter in path calculation, short prediction time." VALUE 0xfe5072b8 /* @ECU_Address@CLTS_AgDirInPahCalcnShoInAsyEvlrCritEve_Ca@ */ Record_FLOAT32_IEEE 0 autosar_swc_aeb_CM_single_rad 0.000000 3.140000 /end CHARACTERISTIC
/begin CHARACTERISTIC CLTS_BicycleDecelPredLongInAsyEvlrCritEve_Ca "Default deceleration for bicycles at long prediction time." VALUE 0xfe5072c8 /* @ECU_Address@CLTS_BicycleDecelPredLongInAsyEvlrCritEve_Ca@ */ Record_FLOAT32_IEEE 0 autosar_swc_aeb_CM_single_m_per_s -10.000000 0.000000 /end CHARACTERISTIC
/begin CHARACTERISTIC CLTS_BicycleDecelPredShoInAsyEvlrCritEve_Ca "Default deceleration for bicycles at short prediction time." VALUE 0xfe5072cc /* @ECU_Address@CLTS_BicycleDecelPredShoInAsyEvlrCritEve_Ca@ */ Record_FLOAT32_IEEE 0 autosar_swc_aeb_CM_single_m_per_s -10.000000 0.000000 /end CHARACTERISTIC
/begin CHARACTERISTIC CLTS_BicycleSteerPredInAsyEvlrCritEve_Ca "Lateral acceleration for bicycles when turning." VALUE 0xfe5072dc /* @ECU_Address@CLTS_BicycleSteerPredInAsyEvlrCritEve_Ca@ */ Record_FLOAT32_IEEE 0 autosar_swc_aeb_CM_single_m_per_s 0.000000 10.000000 /end CHARACTERISTIC
/begin CHARACTERISTIC CLTS_CyclistOffsLatInAsyEvlrCritEve_Ca "Lookup table for determine lateral safety margin for vehicles. " MAP 0xfe508274 /* @ECU_Address@CLTS_CyclistOffsLatInAsyEvlrCritEve_Ca@ */ Record_FLOAT32_IEEE 0 autosar_swc_aeb_CM_single_m -1.000000 3.000000
 /begin AXIS_DESCR COM_AXIS NO_INPUT_QUANTITY autosar_swc_aeb_CM_single_m_per_s 8 -40.000000 40.000000 AXIS_PTS_REF CLTS_VLatRelValForCyclistOffsLatInAsyEvlrCritEve_Ca /end AXIS_DESCR
 /begin AXIS_DESCR COM_AXIS NO_INPUT_QUANTITY autosar_swc_aeb_CM_single_m_per_s 8 -40.000000 40.000000 AXIS_PTS_REF CLTS_VLgtRelValForCyclistOffsLatInAsyEvlrCritEve_Ca /end AXIS_DESCR
/end CHARACTERISTIC
/begin CHARACTERISTIC CLTS_CyclistOffsLatInPahManvInAsyEvlrCritEve_Ca "Lookup table to determine lateral safety margin used during the in path decision for manoeuvering bicycles. " CURVE 0xfe507800 /* @ECU_Address@CLTS_CyclistOffsLatInPahManvInAsyEvlrCritEve_Ca@ */ Record_FLOAT32_IEEE 0 autosar_swc_aeb_CM_single_m -1.000000 1.000000
 /begin AXIS_DESCR COM_AXIS NO_INPUT_QUANTITY autosar_swc_aeb_CM_single_m_per_s 8 -40.000000 40.000000 AXIS_PTS_REF CLTS_VLgtValForCyclistOffsLatInPahManvInAsyEvlrCritEve_Ca /end AXIS_DESCR
/end CHARACTERISTIC
/begin CHARACTERISTIC CLTS_CyclistOffsLgtForTiLongInAsyEvlrCritEve_Ca "Safety margin values in lookup table for determine longitudinal safety margin for vehicles when using long prediction times. " CURVE 0xfe507820 /* @ECU_Address@CLTS_CyclistOffsLgtForTiLongInAsyEvlrCritEve_Ca@ */ Record_FLOAT32_IEEE 0 autosar_swc_aeb_CM_single_m -1.000000 3.000000
 /begin AXIS_DESCR COM_AXIS NO_INPUT_QUANTITY autosar_swc_aeb_CM_single_m_per_s 8 -40.000000 40.000000 AXIS_PTS_REF CLTS_VLgtRelValForCyclistOffsLgtInAsyEvlrCritEve_Ca /end AXIS_DESCR
/end CHARACTERISTIC
/begin CHARACTERISTIC CLTS_CyclistOffsLgtInAsyEvlrCritEve_Ca "Safety margin values in lookup table for determine longitudinal safety margin for vehicles. " CURVE 0xfe507840 /* @ECU_Address@CLTS_CyclistOffsLgtInAsyEvlrCritEve_Ca@ */ Record_FLOAT32_IEEE 0 autosar_swc_aeb_CM_single_m -1.000000 3.000000
 /begin AXIS_DESCR COM_AXIS NO_INPUT_QUANTITY autosar_swc_aeb_CM_single_m 8 0.000000 50.000000 AXIS_PTS_REF CLTS_PosnLgtValForCyclistOffsLgtInAsyEvlrCritEve_Ca /end AXIS_DESCR
/end CHARACTERISTIC
/begin CHARACTERISTIC CLTS_OffsLatInPahPrimTarInAsyEvlrCritEve_Ca "Lateral margin in the in path decision, used by the LTAP algorithm." VALUE 0xfe507340 /* @ECU_Address@CLTS_OffsLatInPahPrimTarInAsyEvlrCritEve_Ca@ */ Record_FLOAT32_IEEE 0 autosar_swc_aeb_CM_single_m 0.000000 3.000000 /end CHARACTERISTIC
/begin CHARACTERISTIC CLTS_OffsLatInPahRemEdgeActvInAsyEvlrCritEve_Ca "Lateral margin when CMbB is active for far edge in inpath decision " CURVE 0xfe507f70 /* @ECU_Address@CLTS_OffsLatInPahRemEdgeActvInAsyEvlrCritEve_Ca@ */ Record_FLOAT32_IEEE 0 autosar_swc_aeb_CM_single_m -1.000000 10.000000
 /begin AXIS_DESCR COM_AXIS NO_INPUT_QUANTITY autosar_swc_aeb_CM_single_m 9 0.000000 5.000000 AXIS_PTS_REF CLTS_DstValForOffsLatInPahRemEdgeActvInAsyEvlrCritEve_Ca /end AXIS_DESCR
/end CHARACTERISTIC
/begin CHARACTERISTIC CLTS_OffsLatInPahRemEdgeInAsyEvlrCritEve_Ca "Lateral margin for far edge in inpath decision " CURVE 0xfe507f94 /* @ECU_Address@CLTS_OffsLatInPahRemEdgeInAsyEvlrCritEve_Ca@ */ Record_FLOAT32_IEEE 0 autosar_swc_aeb_CM_single_m -1.000000 3.000000
 /begin AXIS_DESCR COM_AXIS NO_INPUT_QUANTITY autosar_swc_aeb_CM_single_m 9 0.000000 3.000000 AXIS_PTS_REF CLTS_DstValForOffsLatInPahRemEdgeInAsyEvlrCritEve_Ca /end AXIS_DESCR
/end CHARACTERISTIC
/begin CHARACTERISTIC CLTS_OffsLatInPahRemLimitEdgeInAsyEvlrCritEve_Ca "Max assymmetric offset as function of speed" CURVE 0xfe507fb8 /* @ECU_Address@CLTS_OffsLatInPahRemLimitEdgeInAsyEvlrCritEve_Ca@ */ Record_FLOAT32_IEEE 0 autosar_swc_aeb_CM_single_m 0.000000 2.000000
 /begin AXIS_DESCR COM_AXIS NO_INPUT_QUANTITY autosar_swc_aeb_CM_single_m_per_s 5 0.000000 50.000000 AXIS_PTS_REF CLTS_VLgtValForOffsLatInPahRemLimitEdgeInAsyEvlrCritEve_Ca /end AXIS_DESCR
/end CHARACTERISTIC
/begin CHARACTERISTIC CLTS_OffsMinForCllsnRednByBrkgActvInAsyEvlrCritEve_Ca "Minimum lateral margin when CMbB is active, for in path decision." VALUE 0xfe507344 /* @ECU_Address@CLTS_OffsMinForCllsnRednByBrkgActvInAsyEvlrCritEve_Ca@ */ Record_FLOAT32_IEEE 0 autosar_swc_aeb_CM_single_m -1.000000 1.000000 /end CHARACTERISTIC
/begin CHARACTERISTIC CLTS_PedDecelPredLongInAsyEvlrCritEve_Ca "Default deceleration for pedestrians at long prediction time." VALUE 0xfe507348 /* @ECU_Address@CLTS_PedDecelPredLongInAsyEvlrCritEve_Ca@ */ Record_FLOAT32_IEEE 0 autosar_swc_aeb_CM_single_m_per_s -10.000000 0.000000 /end CHARACTERISTIC
/begin CHARACTERISTIC CLTS_PedDecelPredShoInAsyEvlrCritEve_Ca "Default deceleration for pedestrians at short prediction time." VALUE 0xfe50734c /* @ECU_Address@CLTS_PedDecelPredShoInAsyEvlrCritEve_Ca@ */ Record_FLOAT32_IEEE 0 autosar_swc_aeb_CM_single_m_per_s -10.000000 0.000000 /end CHARACTERISTIC
/begin CHARACTERISTIC CLTS_PedOffsLatInAsyEvlrCritEve_Ca "Lookup table for determine lateral safety margin for VRUs. " MAP 0xfe508374 /* @ECU_Address@CLTS_PedOffsLatInAsyEvlrCritEve_Ca@ */ Record_FLOAT32_IEEE 0 autosar_swc_aeb_CM_single_m -1.000000 3.000000
 /begin AXIS_DESCR COM_AXIS NO_INPUT_QUANTITY autosar_swc_aeb_CM_single_m_per_s 8 -10.000000 10.000000 AXIS_PTS_REF CLTS_VLatRelValForPedOffsLatInAsyEvlrCritEve_Ca /end AXIS_DESCR
 /begin AXIS_DESCR COM_AXIS NO_INPUT_QUANTITY autosar_swc_aeb_CM_single_m_per_s 8 -40.000000 40.000000 AXIS_PTS_REF CLTS_VLgtRelValForPedOffsLatInAsyEvlrCritEve_Ca /end AXIS_DESCR
/end CHARACTERISTIC
/begin CHARACTERISTIC CLTS_PedOffsLatInPahInAsyEvlrCritEve_Ca "Lookup table to determine close edge lateral safety margin used during the no braking/steering in path decision for pedestrians, animals and general objects. " CURVE 0xfe507860 /* @ECU_Address@CLTS_PedOffsLatInPahInAsyEvlrCritEve_Ca@ */ Record_FLOAT32_IEEE 0 autosar_swc_aeb_CM_single_m -1.000000 1.000000
 /begin AXIS_DESCR COM_AXIS NO_INPUT_QUANTITY autosar_swc_aeb_CM_single_m_per_s 8 0.000000 72.000000 AXIS_PTS_REF CLTS_VLgtValForPedOffsLatInPahInAsyEvlrCritEve_Ca /end AXIS_DESCR
/end CHARACTERISTIC
/begin CHARACTERISTIC CLTS_PedOffsLatInPahManvInAsyEvlrCritEve_Ca "Safety margin values in lookup table in inpath calculation for pedestrians" CURVE 0xfe507880 /* @ECU_Address@CLTS_PedOffsLatInPahManvInAsyEvlrCritEve_Ca@ */ Record_FLOAT32_IEEE 0 autosar_swc_aeb_CM_single_m -1.000000 3.000000
 /begin AXIS_DESCR COM_AXIS NO_INPUT_QUANTITY autosar_swc_aeb_CM_single_m_per_s 8 -40.000000 40.000000 AXIS_PTS_REF CLTS_VLgtValForPedOffsLatInPahManvInAsyEvlrCritEve_Ca /end AXIS_DESCR
/end CHARACTERISTIC
/begin CHARACTERISTIC CLTS_PedOffsLatMplTarInAsyEvlrCritEve_Ca "Lookup table for determine lateral safety margin for VRUs. " MAP 0xfe508474 /* @ECU_Address@CLTS_PedOffsLatMplTarInAsyEvlrCritEve_Ca@ */ Record_FLOAT32_IEEE 0 autosar_swc_aeb_CM_single_m -1.000000 3.000000
 /begin AXIS_DESCR COM_AXIS NO_INPUT_QUANTITY autosar_swc_aeb_CM_single_m_per_s 8 -3.4E+38 3.4E+38 AXIS_PTS_REF CLTS_VLatRelValForPedOffsLatMplTarInAsyEvlrCritEve_Ca /end AXIS_DESCR
 /begin AXIS_DESCR COM_AXIS NO_INPUT_QUANTITY autosar_swc_aeb_CM_single_m_per_s 8 -40.000000 40.000000 AXIS_PTS_REF CLTS_VLgtRelValForPedOffsLatMplTarInAsyEvlrCritEve_Ca /end AXIS_DESCR
/end CHARACTERISTIC
/begin CHARACTERISTIC CLTS_PedOffsLgtInAsyEvlrCritEve_Ca "Safety margin values in lookup table for determine longitudinal safety margin for VRUs. " CURVE 0xfe5078a0 /* @ECU_Address@CLTS_PedOffsLgtInAsyEvlrCritEve_Ca@ */ Record_FLOAT32_IEEE 0 autosar_swc_aeb_CM_single_m -1.000000 3.000000
 /begin AXIS_DESCR COM_AXIS NO_INPUT_QUANTITY autosar_swc_aeb_CM_single_m 8 -40.000000 40.000000 AXIS_PTS_REF CLTS_VLgtRelValForPedOffsLgtInAsyEvlrCritEve_Ca /end AXIS_DESCR
/end CHARACTERISTIC
/begin CHARACTERISTIC CLTS_PedSteerPredInAsyEvlrCritEve_Ca "Lateral acceleration for pedestrians when turning." VALUE 0xfe507354 /* @ECU_Address@CLTS_PedSteerPredInAsyEvlrCritEve_Ca@ */ Record_FLOAT32_IEEE 0 autosar_swc_aeb_CM_single_m_per_s 0.000000 10.000000 /end CHARACTERISTIC
/begin CHARACTERISTIC CLTS_TruckMaxOffsLatInPahInAsyEvlrCritEve_Ca "Max lateral offset for in in-path decision for trucks." CURVE 0xfe508024 /* @ECU_Address@CLTS_TruckMaxOffsLatInPahInAsyEvlrCritEve_Ca@ */ Record_FLOAT32_IEEE 0 autosar_swc_aeb_CM_single_m -2.000000 1.000000
 /begin AXIS_DESCR COM_AXIS NO_INPUT_QUANTITY autosar_swc_aeb_CM_single_m 11 0.000000 100.000000 AXIS_PTS_REF CLTS_PosnLgtValForTruckMaxOffsLatInPahInAsyEvlrCritEve_Ca /end AXIS_DESCR
/end CHARACTERISTIC
/begin CHARACTERISTIC CLTS_VehBrkgOffsLatInAsyEvlrCritEve_Ca "Lookup table for lateral safety margin for vehicles. " CURVE 0xfe508064 /* @ECU_Address@CLTS_VehBrkgOffsLatInAsyEvlrCritEve_Ca@ */ Record_FLOAT32_IEEE 0 autosar_swc_aeb_CM_single_m 0.000000 2.000000
 /begin AXIS_DESCR COM_AXIS NO_INPUT_QUANTITY autosar_swc_aeb_CM_single_m_per_s 9 -10.000000 10.000000 AXIS_PTS_REF CLTS_ALgtValForVehBrkgOffsLatInAsyEvlrCritEve_Ca /end AXIS_DESCR
/end CHARACTERISTIC
/begin CHARACTERISTIC CLTS_VehBrkgOffsLatMplTarInAsyEvlrCritEve_Ca "Lookup table for lateral safety margin for vehicles. " CURVE 0xfe508088 /* @ECU_Address@CLTS_VehBrkgOffsLatMplTarInAsyEvlrCritEve_Ca@ */ Record_FLOAT32_IEEE 0 autosar_swc_aeb_CM_single_m 0.000000 2.000000
 /begin AXIS_DESCR COM_AXIS NO_INPUT_QUANTITY autosar_swc_aeb_CM_single_m_per_s 9 -10.000000 10.000000 AXIS_PTS_REF CLTS_ALgtValForVehBrkgOffsLatMplTarInAsyEvlrCritEve_Ca /end AXIS_DESCR
/end CHARACTERISTIC
/begin CHARACTERISTIC CLTS_VehDecelPredLongInAsyEvlrCritEve_Ca "Default deceleration for vehicles at long prediction time." VALUE 0xfe5073b4 /* @ECU_Address@CLTS_VehDecelPredLongInAsyEvlrCritEve_Ca@ */ Record_FLOAT32_IEEE 0 autosar_swc_aeb_CM_single_m_per_s -10.000000 0.000000 /end CHARACTERISTIC
/begin CHARACTERISTIC CLTS_VehDecelPredShoInAsyEvlrCritEve_Ca "Default deceleration for vehicles at short prediction time." VALUE 0xfe5073b8 /* @ECU_Address@CLTS_VehDecelPredShoInAsyEvlrCritEve_Ca@ */ Record_FLOAT32_IEEE 0 autosar_swc_aeb_CM_single_m_per_s -10.000000 0.000000 /end CHARACTERISTIC
/begin CHARACTERISTIC CLTS_VehMaxOffsLatInPahInAsyEvlrCritEve_Ca "Max lateral offset for in in-path decision for vehicles other than trucks." CURVE 0xfe5080ac /* @ECU_Address@CLTS_VehMaxOffsLatInPahInAsyEvlrCritEve_Ca@ */ Record_FLOAT32_IEEE 0 autosar_swc_aeb_CM_single_m -2.000000 1.000000
 /begin AXIS_DESCR COM_AXIS NO_INPUT_QUANTITY autosar_swc_aeb_CM_single_m 11 0.000000 100.000000 AXIS_PTS_REF CLTS_PosnLgtValForVehMaxOffsLatInPahInAsyEvlrCritEve_Ca /end AXIS_DESCR
/end CHARACTERISTIC
/begin CHARACTERISTIC CLTS_VehOffsLatInAsyEvlrCritEve_Ca "Lookup table for determine lateral safety margin for vehicles. " MAP 0xfe508574 /* @ECU_Address@CLTS_VehOffsLatInAsyEvlrCritEve_Ca@ */ Record_FLOAT32_IEEE 0 autosar_swc_aeb_CM_single_m -1.000000 3.000000
 /begin AXIS_DESCR COM_AXIS NO_INPUT_QUANTITY autosar_swc_aeb_CM_single_m_per_s 8 -40.000000 40.000000 AXIS_PTS_REF CLTS_VLatRelValForVehOffsLatInAsyEvlrCritEve_Ca /end AXIS_DESCR
 /begin AXIS_DESCR COM_AXIS NO_INPUT_QUANTITY autosar_swc_aeb_CM_single_m_per_s 8 -40.000000 40.000000 AXIS_PTS_REF CLTS_VLgtRelValForVehOffsLatInAsyEvlrCritEve_Ca /end AXIS_DESCR
/end CHARACTERISTIC
/begin CHARACTERISTIC CLTS_VehOffsLatInIntscnInAsyEvlrCritEve_Ca "Lateral margin to the object in calculation of required curvature to avoid a collision." CURVE 0xfe507b68 /* @ECU_Address@CLTS_VehOffsLatInIntscnInAsyEvlrCritEve_Ca@ */ Record_FLOAT32_IEEE 0 autosar_swc_aeb_CM_single_m 0.000000 5.000000
 /begin AXIS_DESCR COM_AXIS NO_INPUT_QUANTITY autosar_swc_aeb_CM_single_m_per_s 8 -100.000000 100.000000 AXIS_PTS_REF CLTS_VLgtRelValForVehOffsLatInIntscnInAsyEvlrCritEve_Ca /end AXIS_DESCR
/end CHARACTERISTIC
/begin CHARACTERISTIC CLTS_VehOffsLatInPahInAsyEvlrCritEve_Ca "Lookup table to determine close edge lateral safety margin used during the no braking/steering in path decision for vehicles. " MAP 0xfe508674 /* @ECU_Address@CLTS_VehOffsLatInPahInAsyEvlrCritEve_Ca@ */ Record_FLOAT32_IEEE 0 autosar_swc_aeb_CM_single_m -1.000000 1.000000
 /begin AXIS_DESCR COM_AXIS NO_INPUT_QUANTITY autosar_swc_aeb_CM_single_rad_per_s 8 -100.000000 100.000000 AXIS_PTS_REF CLTS_YawRateValForVehOffsLatInPahInAsyEvlrCritEve_Ca /end AXIS_DESCR
 /begin AXIS_DESCR COM_AXIS NO_INPUT_QUANTITY autosar_swc_aeb_CM_single_m_per_s 8 0.000000 72.000000 AXIS_PTS_REF CLTS_VLgtValForVehOffsLatInPahInAsyEvlrCritEve_Ca /end AXIS_DESCR
/end CHARACTERISTIC
/begin CHARACTERISTIC CLTS_VehOffsLatInPahManvInAsyEvlrCritEve_Ca "Safety margin values in lookup table in inpath calculation for vehicles." CURVE 0xfe507b88 /* @ECU_Address@CLTS_VehOffsLatInPahManvInAsyEvlrCritEve_Ca@ */ Record_FLOAT32_IEEE 0 autosar_swc_aeb_CM_single_m -1.000000 3.000000
 /begin AXIS_DESCR COM_AXIS NO_INPUT_QUANTITY autosar_swc_aeb_CM_single_m_per_s 8 -40.000000 40.000000 AXIS_PTS_REF CLTS_VLgtRelValForVehOffsLatInPahManvInAsyEvlrCritEve_Ca /end AXIS_DESCR
/end CHARACTERISTIC
/begin CHARACTERISTIC CLTS_VehOffsLatMplTarInAsyEvlrCritEve_Ca "Lookup table for determine lateral safety margin for vehicles. " MAP 0xfe508774 /* @ECU_Address@CLTS_VehOffsLatMplTarInAsyEvlrCritEve_Ca@ */ Record_FLOAT32_IEEE 0 autosar_swc_aeb_CM_single_m -1.000000 3.000000
 /begin AXIS_DESCR COM_AXIS NO_INPUT_QUANTITY autosar_swc_aeb_CM_single_m_per_s 8 -40.000000 40.000000 AXIS_PTS_REF CLTS_VLatRelValForVehOffsLatMplTarInAsyEvlrCritEve_Ca /end AXIS_DESCR
 /begin AXIS_DESCR COM_AXIS NO_INPUT_QUANTITY autosar_swc_aeb_CM_single_m_per_s 8 -40.000000 40.000000 AXIS_PTS_REF CLTS_VLgtRelValForVehOffsLatMplTarInAsyEvlrCritEve_Ca /end AXIS_DESCR
/end CHARACTERISTIC
/begin CHARACTERISTIC CLTS_VehOffsLgtActvInAsyEvlrCritEve_Ca "Longitudinal safety margin when CMbB is active " VALUE 0xfe5073c4 /* @ECU_Address@CLTS_VehOffsLgtActvInAsyEvlrCritEve_Ca@ */ Record_FLOAT32_IEEE 0 autosar_swc_aeb_CM_single_m 0.000000 2.000000 /end CHARACTERISTIC
/begin CHARACTERISTIC CLTS_VehOffsLgtForTiLongInAsyEvlrCritEve_Ca "Safety margin values in lookup table for determine longitudinal safety margin for vehicles when using long prediction times. " CURVE 0xfe507ba8 /* @ECU_Address@CLTS_VehOffsLgtForTiLongInAsyEvlrCritEve_Ca@ */ Record_FLOAT32_IEEE 0 autosar_swc_aeb_CM_single_m -1.000000 3.000000
 /begin AXIS_DESCR COM_AXIS NO_INPUT_QUANTITY autosar_swc_aeb_CM_single_m_per_s 8 -40.000000 40.000000 AXIS_PTS_REF CLTS_VLgtRelValForVehOffsLgtInAsyEvlrCritEve_Ca /end AXIS_DESCR
/end CHARACTERISTIC
/begin CHARACTERISTIC CLTS_VehOffsLgtInAsyEvlrCritEve_Ca "Safety margin values in lookup table for determine longitudinal safety margin for vehicles. " CURVE 0xfe507bc8 /* @ECU_Address@CLTS_VehOffsLgtInAsyEvlrCritEve_Ca@ */ Record_FLOAT32_IEEE 0 autosar_swc_aeb_CM_single_m -1.000000 5.000000
 /begin AXIS_DESCR COM_AXIS NO_INPUT_QUANTITY autosar_swc_aeb_CM_single_m 10 0.000000 50.000000 AXIS_PTS_REF CLTS_PosnLgtValForVehOffsLgtInAsyEvlrCritEve_Ca /end AXIS_DESCR
/end CHARACTERISTIC
/begin CHARACTERISTIC CLTS_VehSteerPredValDataTblInAsyEvlrCritEve_Ca "The lateral acceleration a vehicle is assumed to achieve as a function of speed." CURVE 0xfe5080fc /* @ECU_Address@CLTS_VehSteerPredValDataTblInAsyEvlrCritEve_Ca@ */ Record_FLOAT32_IEEE 0 autosar_swc_aeb_CM_single_m_per_s 0.000000 5.000000
 /begin AXIS_DESCR COM_AXIS NO_INPUT_QUANTITY autosar_swc_aeb_CM_single_m_per_s 9 0.000000 50.000000 AXIS_PTS_REF CLTS_VehSteerPredDataTblInAsyEvlrCritEve_Ca /end AXIS_DESCR
/end CHARACTERISTIC
/begin CHARACTERISTIC CLTS_YawRatePedOffsLatInPahInAsyEvlrCritEve_Ca "Lookup table to determine close edge lateral safety margin used during the no braking/steering in path decision for pedestrians, animals and general objects. " MAP 0xfe508874 /* @ECU_Address@CLTS_YawRatePedOffsLatInPahInAsyEvlrCritEve_Ca@ */ Record_FLOAT32_IEEE 0 autosar_swc_aeb_CM_single_m -1.000000 1.000000
 /begin AXIS_DESCR COM_AXIS NO_INPUT_QUANTITY autosar_swc_aeb_CM_single_rad_per_s 8 -100.000000 100.000000 AXIS_PTS_REF CLTS_YawRateValForPedOffsLatInPahInAsyEvlrCritEve_Ca /end AXIS_DESCR
 /begin AXIS_DESCR COM_AXIS NO_INPUT_QUANTITY autosar_swc_aeb_CM_single_m_per_s 8 0.000000 72.000000 AXIS_PTS_REF CLTS_VLgtValForPedOffsLatInPahInAsyEvlrCritEve_Ca /end AXIS_DESCR
/end CHARACTERISTIC
/begin CHARACTERISTIC PedOffsLgtLongPredTimeInAsyEvlrCritEve "Safety margin values in lookup table for determine longitudinal safety margin for VRUs. " CURVE 0xfe507eb0 /* @ECU_Address@PedOffsLgtLongPredTimeInAsyEvlrCritEve@ */ Record_FLOAT32_IEEE 0 autosar_swc_aeb_CM_single_m -10.000000 3.000000
 /begin AXIS_DESCR COM_AXIS NO_INPUT_QUANTITY autosar_swc_aeb_CM_single_m 6 -40.000000 40.000000 AXIS_PTS_REF VLgtRelValForPedOffsLgtLongPredTimeInAsyEvlrCritEve /end AXIS_DESCR
/end CHARACTERISTIC
/begin MEASUREMENT autosar_swc_aeb_rtARID_DEF.ALatObj_o "" FLOAT32_IEEE autosar_swc_aeb_CM_single 0 0 -3.4E+38 3.4E+38 ECU_ADDRESS 0xfe4ab6e4 /* @ECU_Address@autosar_swc_aeb_rtARID_DEF.ALatObj_o@ */ /end MEASUREMENT
/begin MEASUREMENT autosar_swc_aeb_rtARID_DEF.ALatObj_on "" FLOAT32_IEEE autosar_swc_aeb_CM_single 0 0 -3.4E+38 3.4E+38 ECU_ADDRESS 0xfe4ab6e8 /* @ECU_Address@autosar_swc_aeb_rtARID_DEF.ALatObj_on@ */ /end MEASUREMENT
/begin MEASUREMENT autosar_swc_aeb_rtARID_DEF.ALatObj_onh "" FLOAT32_IEEE autosar_swc_aeb_CM_single 0 0 -3.4E+38 3.4E+38 ECU_ADDRESS 0xfe4ab6f0 /* @ECU_Address@autosar_swc_aeb_rtARID_DEF.ALatObj_onh@ */ /end MEASUREMENT
/begin MEASUREMENT autosar_swc_aeb_rtARID_DEF.ALatObj_onhu "" FLOAT32_IEEE autosar_swc_aeb_CM_single 0 0 -3.4E+38 3.4E+38 ECU_ADDRESS 0xfe4ab71c /* @ECU_Address@autosar_swc_aeb_rtARID_DEF.ALatObj_onhu@ */ /end MEASUREMENT
/begin MEASUREMENT autosar_swc_aeb_rtARID_DEF.ALgtObj_c "" FLOAT32_IEEE autosar_swc_aeb_CM_single 0 0 -3.4E+38 3.4E+38 ECU_ADDRESS 0xfe4ab6d8 /* @ECU_Address@autosar_swc_aeb_rtARID_DEF.ALgtObj_c@ */ /end MEASUREMENT
/begin MEASUREMENT autosar_swc_aeb_rtARID_DEF.ALgtObj_cm "" FLOAT32_IEEE autosar_swc_aeb_CM_single 0 0 -3.4E+38 3.4E+38 ECU_ADDRESS 0xfe4ab6dc /* @ECU_Address@autosar_swc_aeb_rtARID_DEF.ALgtObj_cm@ */ /end MEASUREMENT
/begin MEASUREMENT autosar_swc_aeb_rtARID_DEF.ALgtObj_cmo "" FLOAT32_IEEE autosar_swc_aeb_CM_single 0 0 -3.4E+38 3.4E+38 ECU_ADDRESS 0xfe4ab6e0 /* @ECU_Address@autosar_swc_aeb_rtARID_DEF.ALgtObj_cmo@ */ /end MEASUREMENT
/begin MEASUREMENT autosar_swc_aeb_rtARID_DEF.ALgtObj_cmoa "" FLOAT32_IEEE autosar_swc_aeb_CM_single 0 0 -3.4E+38 3.4E+38 ECU_ADDRESS 0xfe4ab718 /* @ECU_Address@autosar_swc_aeb_rtARID_DEF.ALgtObj_cmoa@ */ /end MEASUREMENT
/begin MEASUREMENT autosar_swc_aeb_rtARID_DEF.CrvtObj_lk "" FLOAT32_IEEE autosar_swc_aeb_CM_single 0 0 -3.4E+38 3.4E+38 ECU_ADDRESS 0xfe4ab6f4 /* @ECU_Address@autosar_swc_aeb_rtARID_DEF.CrvtObj_lk@ */ /end MEASUREMENT
/begin MEASUREMENT autosar_swc_aeb_rtARID_DEF.HeadingObj_mh "" FLOAT32_IEEE autosar_swc_aeb_CM_single 0 0 -3.4E+38 3.4E+38 ECU_ADDRESS 0xfe4ab6bc /* @ECU_Address@autosar_swc_aeb_rtARID_DEF.HeadingObj_mh@ */ /end MEASUREMENT
/begin MEASUREMENT autosar_swc_aeb_rtARID_DEF.HeadingObj_mhz "" FLOAT32_IEEE autosar_swc_aeb_CM_single 0 0 -3.4E+38 3.4E+38 ECU_ADDRESS 0xfe4ab6c8 /* @ECU_Address@autosar_swc_aeb_rtARID_DEF.HeadingObj_mhz@ */ /end MEASUREMENT
/begin MEASUREMENT autosar_swc_aeb_rtARID_DEF.HeadingObj_mhzx "" FLOAT32_IEEE autosar_swc_aeb_CM_single 0 0 -3.4E+38 3.4E+38 ECU_ADDRESS 0xfe4ab6d4 /* @ECU_Address@autosar_swc_aeb_rtARID_DEF.HeadingObj_mhzx@ */ /end MEASUREMENT
/begin MEASUREMENT autosar_swc_aeb_rtARID_DEF.HeadingObj_mhzxn "" FLOAT32_IEEE autosar_swc_aeb_CM_single 0 0 -3.4E+38 3.4E+38 ECU_ADDRESS 0xfe4ab714 /* @ECU_Address@autosar_swc_aeb_rtARID_DEF.HeadingObj_mhzxn@ */ /end MEASUREMENT
/begin MEASUREMENT autosar_swc_aeb_rtARID_DEF.PosnLatObj_p3 "" FLOAT32_IEEE autosar_swc_aeb_CM_single 0 0 -3.4E+38 3.4E+38 ECU_ADDRESS 0xfe4ab6b8 /* @ECU_Address@autosar_swc_aeb_rtARID_DEF.PosnLatObj_p3@ */ /end MEASUREMENT
/begin MEASUREMENT autosar_swc_aeb_rtARID_DEF.PosnLatObj_p3hk "" FLOAT32_IEEE autosar_swc_aeb_CM_single 0 0 -3.4E+38 3.4E+38 ECU_ADDRESS 0xfe4ab6d0 /* @ECU_Address@autosar_swc_aeb_rtARID_DEF.PosnLatObj_p3hk@ */ /end MEASUREMENT
/begin MEASUREMENT autosar_swc_aeb_rtARID_DEF.PosnLatObj_p3hko "" FLOAT32_IEEE autosar_swc_aeb_CM_single 0 0 -3.4E+38 3.4E+38 ECU_ADDRESS 0xfe4ab710 /* @ECU_Address@autosar_swc_aeb_rtARID_DEF.PosnLatObj_p3hko@ */ /end MEASUREMENT
/begin MEASUREMENT autosar_swc_aeb_rtARID_DEF.PosnLgtObj_o0 "" FLOAT32_IEEE autosar_swc_aeb_CM_single 0 0 -3.4E+38 3.4E+38 ECU_ADDRESS 0xfe4ab6b4 /* @ECU_Address@autosar_swc_aeb_rtARID_DEF.PosnLgtObj_o0@ */ /end MEASUREMENT
/begin MEASUREMENT autosar_swc_aeb_rtARID_DEF.PosnLgtObj_o0e3 "" FLOAT32_IEEE autosar_swc_aeb_CM_single 0 0 -3.4E+38 3.4E+38 ECU_ADDRESS 0xfe4ab6cc /* @ECU_Address@autosar_swc_aeb_rtARID_DEF.PosnLgtObj_o0e3@ */ /end MEASUREMENT
/begin MEASUREMENT autosar_swc_aeb_rtARID_DEF.PosnLgtObj_o0e3h "" FLOAT32_IEEE autosar_swc_aeb_CM_single 0 0 -3.4E+38 3.4E+38 ECU_ADDRESS 0xfe4ab70c /* @ECU_Address@autosar_swc_aeb_rtARID_DEF.PosnLgtObj_o0e3h@ */ /end MEASUREMENT
/begin MEASUREMENT autosar_swc_aeb_rtARID_DEF.VLatObj_ja "" FLOAT32_IEEE autosar_swc_aeb_CM_single 0 0 -3.4E+38 3.4E+38 ECU_ADDRESS 0xfe4ab724 /* @ECU_Address@autosar_swc_aeb_rtARID_DEF.VLatObj_ja@ */ /end MEASUREMENT
/begin MEASUREMENT autosar_swc_aeb_rtARID_DEF.VLatObj_ja0 "" FLOAT32_IEEE autosar_swc_aeb_CM_single 0 0 -3.4E+38 3.4E+38 ECU_ADDRESS 0xfe4ab72c /* @ECU_Address@autosar_swc_aeb_rtARID_DEF.VLatObj_ja0@ */ /end MEASUREMENT
/begin MEASUREMENT autosar_swc_aeb_rtARID_DEF.VLatObj_ja0h "" FLOAT32_IEEE autosar_swc_aeb_CM_single 0 0 -3.4E+38 3.4E+38 ECU_ADDRESS 0xfe4ab734 /* @ECU_Address@autosar_swc_aeb_rtARID_DEF.VLatObj_ja0h@ */ /end MEASUREMENT
/begin MEASUREMENT autosar_swc_aeb_rtARID_DEF.VLatObj_ja0hf "" FLOAT32_IEEE autosar_swc_aeb_CM_single 0 0 -3.4E+38 3.4E+38 ECU_ADDRESS 0xfe4ab73c /* @ECU_Address@autosar_swc_aeb_rtARID_DEF.VLatObj_ja0hf@ */ /end MEASUREMENT
/begin MEASUREMENT autosar_swc_aeb_rtARID_DEF.VLgtObj_fo "" FLOAT32_IEEE autosar_swc_aeb_CM_single 0 0 -3.4E+38 3.4E+38 ECU_ADDRESS 0xfe4ab720 /* @ECU_Address@autosar_swc_aeb_rtARID_DEF.VLgtObj_fo@ */ /end MEASUREMENT
/begin MEASUREMENT autosar_swc_aeb_rtARID_DEF.VLgtObj_foi "" FLOAT32_IEEE autosar_swc_aeb_CM_single 0 0 -3.4E+38 3.4E+38 ECU_ADDRESS 0xfe4ab728 /* @ECU_Address@autosar_swc_aeb_rtARID_DEF.VLgtObj_foi@ */ /end MEASUREMENT
/begin MEASUREMENT autosar_swc_aeb_rtARID_DEF.VLgtObj_foij "" FLOAT32_IEEE autosar_swc_aeb_CM_single 0 0 -3.4E+38 3.4E+38 ECU_ADDRESS 0xfe4ab730 /* @ECU_Address@autosar_swc_aeb_rtARID_DEF.VLgtObj_foij@ */ /end MEASUREMENT
/begin MEASUREMENT autosar_swc_aeb_rtARID_DEF.VLgtObj_foijp "" FLOAT32_IEEE autosar_swc_aeb_CM_single 0 0 -3.4E+38 3.4E+38 ECU_ADDRESS 0xfe4ab738 /* @ECU_Address@autosar_swc_aeb_rtARID_DEF.VLgtObj_foijp@ */ /end MEASUREMENT
/begin AXIS_PTS CLTS_ALgtValForVehBrkgOffsLatInAsyEvlrCritEve_Ca "" 0xfe507ee0 /* @ECU_Address@CLTS_ALgtValForVehBrkgOffsLatInAsyEvlrCritEve_Ca@ */ NO_INPUT_QUANTITY Axis_FLOAT32_IEEE 0 autosar_swc_aeb_CM_single_m_per_s 9 -10.000000 10.000000 /end AXIS_PTS
/begin AXIS_PTS CLTS_ALgtValForVehBrkgOffsLatMplTarInAsyEvlrCritEve_Ca "" 0xfe507f04 /* @ECU_Address@CLTS_ALgtValForVehBrkgOffsLatMplTarInAsyEvlrCritEve_Ca@ */ NO_INPUT_QUANTITY Axis_FLOAT32_IEEE 0 autosar_swc_aeb_CM_single_m_per_s 9 -10.000000 10.000000 /end AXIS_PTS
/begin AXIS_PTS CLTS_DstValForOffsLatInPahRemEdgeActvInAsyEvlrCritEve_Ca "" 0xfe507f28 /* @ECU_Address@CLTS_DstValForOffsLatInPahRemEdgeActvInAsyEvlrCritEve_Ca@ */ NO_INPUT_QUANTITY Axis_FLOAT32_IEEE 0 autosar_swc_aeb_CM_single_m 9 0.000000 5.000000 /end AXIS_PTS
/begin AXIS_PTS CLTS_DstValForOffsLatInPahRemEdgeInAsyEvlrCritEve_Ca "" 0xfe507f4c /* @ECU_Address@CLTS_DstValForOffsLatInPahRemEdgeInAsyEvlrCritEve_Ca@ */ NO_INPUT_QUANTITY Axis_FLOAT32_IEEE 0 autosar_swc_aeb_CM_single_m 9 0.000000 3.000000 /end AXIS_PTS
/begin AXIS_PTS CLTS_PosnLgtValForCyclistOffsLgtInAsyEvlrCritEve_Ca "" 0xfe5078c0 /* @ECU_Address@CLTS_PosnLgtValForCyclistOffsLgtInAsyEvlrCritEve_Ca@ */ NO_INPUT_QUANTITY Axis_FLOAT32_IEEE 0 autosar_swc_aeb_CM_single_m 8 0.000000 50.000000 /end AXIS_PTS
/begin AXIS_PTS CLTS_PosnLgtValForTruckMaxOffsLatInPahInAsyEvlrCritEve_Ca "" 0xfe507fcc /* @ECU_Address@CLTS_PosnLgtValForTruckMaxOffsLatInPahInAsyEvlrCritEve_Ca@ */ NO_INPUT_QUANTITY Axis_FLOAT32_IEEE 0 autosar_swc_aeb_CM_single_m 11 0.000000 100.000000 /end AXIS_PTS
/begin AXIS_PTS CLTS_PosnLgtValForVehMaxOffsLatInPahInAsyEvlrCritEve_Ca "" 0xfe507ff8 /* @ECU_Address@CLTS_PosnLgtValForVehMaxOffsLatInPahInAsyEvlrCritEve_Ca@ */ NO_INPUT_QUANTITY Axis_FLOAT32_IEEE 0 autosar_swc_aeb_CM_single_m 11 0.000000 100.000000 /end AXIS_PTS
/begin AXIS_PTS CLTS_PosnLgtValForVehOffsLgtInAsyEvlrCritEve_Ca "" 0xfe5078e0 /* @ECU_Address@CLTS_PosnLgtValForVehOffsLgtInAsyEvlrCritEve_Ca@ */ NO_INPUT_QUANTITY Axis_FLOAT32_IEEE 0 autosar_swc_aeb_CM_single_m 10 0.000000 50.000000 /end AXIS_PTS
/begin AXIS_PTS CLTS_VLatRelValForCyclistOffsLatInAsyEvlrCritEve_Ca "" 0xfe507908 /* @ECU_Address@CLTS_VLatRelValForCyclistOffsLatInAsyEvlrCritEve_Ca@ */ NO_INPUT_QUANTITY Axis_FLOAT32_IEEE 0 autosar_swc_aeb_CM_single_m_per_s 8 -40.000000 40.000000 /end AXIS_PTS
/begin AXIS_PTS CLTS_VLatRelValForPedOffsLatInAsyEvlrCritEve_Ca "" 0xfe507928 /* @ECU_Address@CLTS_VLatRelValForPedOffsLatInAsyEvlrCritEve_Ca@ */ NO_INPUT_QUANTITY Axis_FLOAT32_IEEE 0 autosar_swc_aeb_CM_single_m_per_s 8 -10.000000 10.000000 /end AXIS_PTS
/begin AXIS_PTS CLTS_VLatRelValForPedOffsLatMplTarInAsyEvlrCritEve_Ca "" 0xfe507948 /* @ECU_Address@CLTS_VLatRelValForPedOffsLatMplTarInAsyEvlrCritEve_Ca@ */ NO_INPUT_QUANTITY Axis_FLOAT32_IEEE 0 autosar_swc_aeb_CM_single_m_per_s 8 -3.4E+38 3.4E+38 /end AXIS_PTS
/begin AXIS_PTS CLTS_VLatRelValForVehOffsLatInAsyEvlrCritEve_Ca "" 0xfe507968 /* @ECU_Address@CLTS_VLatRelValForVehOffsLatInAsyEvlrCritEve_Ca@ */ NO_INPUT_QUANTITY Axis_FLOAT32_IEEE 0 autosar_swc_aeb_CM_single_m_per_s 8 -40.000000 40.000000 /end AXIS_PTS
/begin AXIS_PTS CLTS_VLatRelValForVehOffsLatMplTarInAsyEvlrCritEve_Ca "" 0xfe507988 /* @ECU_Address@CLTS_VLatRelValForVehOffsLatMplTarInAsyEvlrCritEve_Ca@ */ NO_INPUT_QUANTITY Axis_FLOAT32_IEEE 0 autosar_swc_aeb_CM_single_m_per_s 8 -40.000000 40.000000 /end AXIS_PTS
/begin AXIS_PTS CLTS_VLgtRelValForCyclistOffsLatInAsyEvlrCritEve_Ca "" 0xfe5079a8 /* @ECU_Address@CLTS_VLgtRelValForCyclistOffsLatInAsyEvlrCritEve_Ca@ */ NO_INPUT_QUANTITY Axis_FLOAT32_IEEE 0 autosar_swc_aeb_CM_single_m_per_s 8 -40.000000 40.000000 /end AXIS_PTS
/begin AXIS_PTS CLTS_VLgtRelValForCyclistOffsLgtInAsyEvlrCritEve_Ca "" 0xfe5079c8 /* @ECU_Address@CLTS_VLgtRelValForCyclistOffsLgtInAsyEvlrCritEve_Ca@ */ NO_INPUT_QUANTITY Axis_FLOAT32_IEEE 0 autosar_swc_aeb_CM_single_m_per_s 8 -40.000000 40.000000 /end AXIS_PTS
/begin AXIS_PTS CLTS_VLgtRelValForPedOffsLatInAsyEvlrCritEve_Ca "" 0xfe5079e8 /* @ECU_Address@CLTS_VLgtRelValForPedOffsLatInAsyEvlrCritEve_Ca@ */ NO_INPUT_QUANTITY Axis_FLOAT32_IEEE 0 autosar_swc_aeb_CM_single_m_per_s 8 -40.000000 40.000000 /end AXIS_PTS
/begin AXIS_PTS CLTS_VLgtRelValForPedOffsLatMplTarInAsyEvlrCritEve_Ca "" 0xfe507a08 /* @ECU_Address@CLTS_VLgtRelValForPedOffsLatMplTarInAsyEvlrCritEve_Ca@ */ NO_INPUT_QUANTITY Axis_FLOAT32_IEEE 0 autosar_swc_aeb_CM_single_m_per_s 8 -40.000000 40.000000 /end AXIS_PTS
/begin AXIS_PTS CLTS_VLgtRelValForPedOffsLgtInAsyEvlrCritEve_Ca "" 0xfe507a28 /* @ECU_Address@CLTS_VLgtRelValForPedOffsLgtInAsyEvlrCritEve_Ca@ */ NO_INPUT_QUANTITY Axis_FLOAT32_IEEE 0 autosar_swc_aeb_CM_single_m 8 -40.000000 40.000000 /end AXIS_PTS
/begin AXIS_PTS CLTS_VLgtRelValForVehOffsLatInAsyEvlrCritEve_Ca "" 0xfe507a48 /* @ECU_Address@CLTS_VLgtRelValForVehOffsLatInAsyEvlrCritEve_Ca@ */ NO_INPUT_QUANTITY Axis_FLOAT32_IEEE 0 autosar_swc_aeb_CM_single_m_per_s 8 -40.000000 40.000000 /end AXIS_PTS
/begin AXIS_PTS CLTS_VLgtRelValForVehOffsLatInIntscnInAsyEvlrCritEve_Ca "" 0xfe507a68 /* @ECU_Address@CLTS_VLgtRelValForVehOffsLatInIntscnInAsyEvlrCritEve_Ca@ */ NO_INPUT_QUANTITY Axis_FLOAT32_IEEE 0 autosar_swc_aeb_CM_single_m_per_s 8 -100.000000 100.000000 /end AXIS_PTS
/begin AXIS_PTS CLTS_VLgtRelValForVehOffsLatInPahManvInAsyEvlrCritEve_Ca "" 0xfe507a88 /* @ECU_Address@CLTS_VLgtRelValForVehOffsLatInPahManvInAsyEvlrCritEve_Ca@ */ NO_INPUT_QUANTITY Axis_FLOAT32_IEEE 0 autosar_swc_aeb_CM_single_m_per_s 8 -40.000000 40.000000 /end AXIS_PTS
/begin AXIS_PTS CLTS_VLgtRelValForVehOffsLatMplTarInAsyEvlrCritEve_Ca "" 0xfe507aa8 /* @ECU_Address@CLTS_VLgtRelValForVehOffsLatMplTarInAsyEvlrCritEve_Ca@ */ NO_INPUT_QUANTITY Axis_FLOAT32_IEEE 0 autosar_swc_aeb_CM_single_m_per_s 8 -40.000000 40.000000 /end AXIS_PTS
/begin AXIS_PTS CLTS_VLgtRelValForVehOffsLgtInAsyEvlrCritEve_Ca "" 0xfe507ac8 /* @ECU_Address@CLTS_VLgtRelValForVehOffsLgtInAsyEvlrCritEve_Ca@ */ NO_INPUT_QUANTITY Axis_FLOAT32_IEEE 0 autosar_swc_aeb_CM_single_m_per_s 8 -40.000000 40.000000 /end AXIS_PTS
/begin AXIS_PTS CLTS_VLgtValForCyclistOffsLatInPahManvInAsyEvlrCritEve_Ca "" 0xfe507ae8 /* @ECU_Address@CLTS_VLgtValForCyclistOffsLatInPahManvInAsyEvlrCritEve_Ca@ */ NO_INPUT_QUANTITY Axis_FLOAT32_IEEE 0 autosar_swc_aeb_CM_single_m_per_s 8 -40.000000 40.000000 /end AXIS_PTS
/begin AXIS_PTS CLTS_VLgtValForOffsLatInPahRemLimitEdgeInAsyEvlrCritEve_Ca "" 0xfe508050 /* @ECU_Address@CLTS_VLgtValForOffsLatInPahRemLimitEdgeInAsyEvlrCritEve_Ca@ */ NO_INPUT_QUANTITY Axis_FLOAT32_IEEE 0 autosar_swc_aeb_CM_single_m_per_s 5 0.000000 50.000000 /end AXIS_PTS
/begin AXIS_PTS CLTS_VLgtValForPedOffsLatInPahInAsyEvlrCritEve_Ca "" 0xfe507b08 /* @ECU_Address@CLTS_VLgtValForPedOffsLatInPahInAsyEvlrCritEve_Ca@ */ NO_INPUT_QUANTITY Axis_FLOAT32_IEEE 0 autosar_swc_aeb_CM_single_m_per_s 8 0.000000 72.000000 /end AXIS_PTS
/begin AXIS_PTS CLTS_VLgtValForPedOffsLatInPahManvInAsyEvlrCritEve_Ca "" 0xfe507b28 /* @ECU_Address@CLTS_VLgtValForPedOffsLatInPahManvInAsyEvlrCritEve_Ca@ */ NO_INPUT_QUANTITY Axis_FLOAT32_IEEE 0 autosar_swc_aeb_CM_single_m_per_s 8 -40.000000 40.000000 /end AXIS_PTS
/begin AXIS_PTS CLTS_VLgtValForVehOffsLatInPahInAsyEvlrCritEve_Ca "" 0xfe507b48 /* @ECU_Address@CLTS_VLgtValForVehOffsLatInPahInAsyEvlrCritEve_Ca@ */ NO_INPUT_QUANTITY Axis_FLOAT32_IEEE 0 autosar_swc_aeb_CM_single_m_per_s 8 0.000000 72.000000 /end AXIS_PTS
/begin AXIS_PTS CLTS_VehSteerPredDataTblInAsyEvlrCritEve_Ca "" 0xfe5080d8 /* @ECU_Address@CLTS_VehSteerPredDataTblInAsyEvlrCritEve_Ca@ */ NO_INPUT_QUANTITY Axis_FLOAT32_IEEE 0 autosar_swc_aeb_CM_single_m_per_s 9 0.000000 50.000000 /end AXIS_PTS
/begin AXIS_PTS CLTS_YawRateValForPedOffsLatInPahInAsyEvlrCritEve_Ca "" 0xfe507bf0 /* @ECU_Address@CLTS_YawRateValForPedOffsLatInPahInAsyEvlrCritEve_Ca@ */ NO_INPUT_QUANTITY Axis_FLOAT32_IEEE 0 autosar_swc_aeb_CM_single_rad_per_s 8 -100.000000 100.000000 /end AXIS_PTS
/begin AXIS_PTS CLTS_YawRateValForVehOffsLatInPahInAsyEvlrCritEve_Ca "" 0xfe507c10 /* @ECU_Address@CLTS_YawRateValForVehOffsLatInPahInAsyEvlrCritEve_Ca@ */ NO_INPUT_QUANTITY Axis_FLOAT32_IEEE 0 autosar_swc_aeb_CM_single_rad_per_s 8 -100.000000 100.000000 /end AXIS_PTS
/begin AXIS_PTS VLgtRelValForPedOffsLgtLongPredTimeInAsyEvlrCritEve "" 0xfe507ec8 /* @ECU_Address@VLgtRelValForPedOffsLgtLongPredTimeInAsyEvlrCritEve@ */ NO_INPUT_QUANTITY Axis_FLOAT32_IEEE 0 autosar_swc_aeb_CM_single_m 6 -40.000000 40.000000 /end AXIS_PTS
/begin COMPU_METHOD autosar_swc_aeb_CM_single "Q = V" IDENTICAL "%8.6" "" /end COMPU_METHOD
/begin COMPU_METHOD autosar_swc_aeb_CM_single_m "Q = V" IDENTICAL "%8.6" "m" /end COMPU_METHOD
/begin COMPU_METHOD autosar_swc_aeb_CM_single_m_per_s "Q = V" IDENTICAL "%8.6" "m/s" /end COMPU_METHOD
/begin COMPU_METHOD autosar_swc_aeb_CM_single_rad "Q = V" IDENTICAL "%8.6" "rad" /end COMPU_METHOD
/begin COMPU_METHOD autosar_swc_aeb_CM_single_rad_per_s "Q = V" IDENTICAL "%8.6" "rad/s" /end COMPU_METHOD
/begin RECORD_LAYOUT Record_FLOAT32_IEEE FNC_VALUES 1 FLOAT32_IEEE COLUMN_DIR DIRECT /end RECORD_LAYOUT
/begin RECORD_LAYOUT Axis_FLOAT32_IEEE AXIS_PTS_X 1 FLOAT32_IEEE INDEX_INCR DIRECT /end RECORD_LAYOUT
/begin GROUP autosar_swc_aeb_autosar_swc_aeb_Step_sys_Subsystem_Reference_AEB_Function_Run_AsyEvlrCritEve_Step_Func_Run_AsyEvlrCritEve_Step_Func_TAWrapper_PreProcessor_ObjectPreProcessor_ObjectPreProcessorLoop_ValidObject_CalculateTTRAndTTM_LongitudinalTTRComputer_SelectTTI "autosar_swc_aeb/autosar_swc_aeb_Step_sys/Subsystem Reference/AEB Function/Run_AsyEvlrCritEve_Step_Func/Run_AsyEvlrCritEve_Step_Func/TAWrapper/PreProcessor/ObjectPreProcessor/ObjectPreProcessorLoop/ValidObject/CalculateTTRAndTTM/LongitudinalTTRComputer/SelectTTI"
 /begin SUB_GROUP autosar_swc_aeb_autosar_swc_aeb_Step_sys_Subsystem_Reference_AEB_Function_Run_AsyEvlrCritEve_Step_Func_Run_AsyEvlrCritEve_Step_Func_TAWrapper_PreProcessor_ObjectPreProcessor_ObjectPreProcessorLoop_ValidObject_CalculateTTRAndTTM_LongitudinalTTRComputer_SelectTTI_CheckIfVehicleStops autosar_swc_aeb_autosar_swc_aeb_Step_sys_Subsystem_Reference_AEB_Function_Run_AsyEvlrCritEve_Step_Func_Run_AsyEvlrCritEve_Step_Func_TAWrapper_PreProcessor_ObjectPreProcessor_ObjectPreProcessorLoop_ValidObject_CalculateTTRAndTTM_LongitudinalTTRComputer_SelectTTI_CheckIfVehicleStops1 /end SUB_GROUP
/end GROUP
/begin GROUP autosar_swc_aeb_autosar_swc_aeb_Step_sys_Subsystem_Reference_AEB_Function_Run_AsyEvlrCritEve_Step_Func_Run_AsyEvlrCritEve_Step_Func_TAWrapper_PreProcessor_ObjectPreProcessor_ObjectPreProcessorLoop_ValidObject_DetermineMotionType "autosar_swc_aeb/autosar_swc_aeb_Step_sys/Subsystem Reference/AEB Function/Run_AsyEvlrCritEve_Step_Func/Run_AsyEvlrCritEve_Step_Func/TAWrapper/PreProcessor/ObjectPreProcessor/ObjectPreProcessorLoop/ValidObject/DetermineMotionType"
 /begin REF_CHARACTERISTIC CLTS_AgDirForBicycleSteerMinInAsyEvlrCritEve_Ca CLTS_AgDirInPahCalcnLongInAsyEvlrCritEve_Ca CLTS_AgDirInPahCalcnShoInAsyEvlrCritEve_Ca /end REF_CHARACTERISTIC
/end GROUP
/begin GROUP autosar_swc_aeb_autosar_swc_aeb_Step_sys_Subsystem_Reference_AEB_Function_Run_AsyEvlrCritEve_Step_Func_Run_AsyEvlrCritEve_Step_Func_TAWrapper_PreProcessor_ObjectPreProcessor_ObjectPreProcessorLoop_ValidObject_SafetyMarginFrontObjects "autosar_swc_aeb/autosar_swc_aeb_Step_sys/Subsystem Reference/AEB Function/Run_AsyEvlrCritEve_Step_Func/Run_AsyEvlrCritEve_Step_Func/TAWrapper/PreProcessor/ObjectPreProcessor/ObjectPreProcessorLoop/ValidObject/SafetyMarginFrontObjects"
 /begin SUB_GROUP autosar_swc_aeb_autosar_swc_aeb_Step_sys_Subsystem_Reference_AEB_Function_Run_AsyEvlrCritEve_Step_Func_Run_AsyEvlrCritEve_Step_Func_TAWrapper_PreProcessor_ObjectPreProcessor_ObjectPreProcessorLoop_ValidObject_SafetyMarginFrontObjects_CheckPredictionValidity autosar_swc_aeb_autosar_swc_aeb_Step_sys_Subsystem_Reference_AEB_Function_Run_AsyEvlrCritEve_Step_Func_Run_AsyEvlrCritEve_Step_Func_TAWrapper_PreProcessor_ObjectPreProcessor_ObjectPreProcessorLoop_ValidObject_SafetyMarginFrontObjects_DetermineOffsets autosar_swc_aeb_autosar_swc_aeb_Step_sys_Subsystem_Reference_AEB_Function_Run_AsyEvlrCritEve_Step_Func_Run_AsyEvlrCritEve_Step_Func_TAWrapper_PreProcessor_ObjectPreProcessor_ObjectPreProcessorLoop_ValidObject_SafetyMarginFrontObjects_InPathCalculationWithCurrentObjPositions autosar_swc_aeb_autosar_swc_aeb_Step_sys_Subsystem_Reference_AEB_Function_Run_AsyEvlrCritEve_Step_Func_Run_AsyEvlrCritEve_Step_Func_TAWrapper_PreProcessor_ObjectPreProcessor_ObjectPreProcessorLoop_ValidObject_SafetyMarginFrontObjects_InPathCalculationWithPredictedObjPositions autosar_swc_aeb_autosar_swc_aeb_Step_sys_Subsystem_Reference_AEB_Function_Run_AsyEvlrCritEve_Step_Func_Run_AsyEvlrCritEve_Step_Func_TAWrapper_PreProcessor_ObjectPreProcessor_ObjectPreProcessorLoop_ValidObject_SafetyMarginFrontObjects_PosnLatRelByCoordSysTransform autosar_swc_aeb_autosar_swc_aeb_Step_sys_Subsystem_Reference_AEB_Function_Run_AsyEvlrCritEve_Step_Func_Run_AsyEvlrCritEve_Step_Func_TAWrapper_PreProcessor_ObjectPreProcessor_ObjectPreProcessorLoop_ValidObject_SafetyMarginFrontObjects_SaturateTTR autosar_swc_aeb_autosar_swc_aeb_Step_sys_Subsystem_Reference_AEB_Function_Run_AsyEvlrCritEve_Step_Func_Run_AsyEvlrCritEve_Step_Func_TAWrapper_PreProcessor_ObjectPreProcessor_ObjectPreProcessorLoop_ValidObject_SafetyMarginFrontObjects_SelectInPathData /end SUB_GROUP
/end GROUP
/begin GROUP autosar_swc_aeb_autosar_swc_aeb_Step_sys_Subsystem_Reference_AEB_Function_Run_AsyEvlrCritEve_Step_Func_Run_AsyEvlrCritEve_Step_Func_TAWrapper_PreProcessor_ObjectPreProcessor_ObjectPreProcessorLoop_ValidObject_SafetyMarginFrontObjects_CheckPredictionValidity "autosar_swc_aeb/autosar_swc_aeb_Step_sys/Subsystem Reference/AEB Function/Run_AsyEvlrCritEve_Step_Func/Run_AsyEvlrCritEve_Step_Func/TAWrapper/PreProcessor/ObjectPreProcessor/ObjectPreProcessorLoop/ValidObject/SafetyMarginFrontObjects/CheckPredictionValidity"
 /begin SUB_GROUP autosar_swc_aeb_autosar_swc_aeb_Step_sys_Subsystem_Reference_AEB_Function_Run_AsyEvlrCritEve_Step_Func_Run_AsyEvlrCritEve_Step_Func_TAWrapper_PreProcessor_ObjectPreProcessor_ObjectPreProcessorLoop_ValidObject_SafetyMarginFrontObjects_CheckPredictionValidity_CheckPredictionValidityForTTM autosar_swc_aeb_autosar_swc_aeb_Step_sys_Subsystem_Reference_AEB_Function_Run_AsyEvlrCritEve_Step_Func_Run_AsyEvlrCritEve_Step_Func_TAWrapper_PreProcessor_ObjectPreProcessor_ObjectPreProcessorLoop_ValidObject_SafetyMarginFrontObjects_CheckPredictionValidity_CheckPredictionValidityForTTR /end SUB_GROUP
/end GROUP
/begin GROUP autosar_swc_aeb_autosar_swc_aeb_Step_sys_Subsystem_Reference_AEB_Function_Run_AsyEvlrCritEve_Step_Func_Run_AsyEvlrCritEve_Step_Func_TAWrapper_PreProcessor_ObjectPreProcessor_ObjectPreProcessorLoop_ValidObject_SafetyMarginFrontObjects_CheckPredictionValidity_CheckPredictionValidityForTTM "autosar_swc_aeb/autosar_swc_aeb_Step_sys/Subsystem Reference/AEB Function/Run_AsyEvlrCritEve_Step_Func/Run_AsyEvlrCritEve_Step_Func/TAWrapper/PreProcessor/ObjectPreProcessor/ObjectPreProcessorLoop/ValidObject/SafetyMarginFrontObjects/CheckPredictionValidity/CheckPredictionValidityForTTM"
 /begin SUB_GROUP autosar_swc_aeb_autosar_swc_aeb_Step_sys_Subsystem_Reference_AEB_Function_Run_AsyEvlrCritEve_Step_Func_Run_AsyEvlrCritEve_Step_Func_TAWrapper_PreProcessor_ObjectPreProcessor_ObjectPreProcessorLoop_ValidObject_SafetyMarginFrontObjects_CheckPredictionValidity_CheckPredictionValidityForTTM_CheckConfidenceForHeading autosar_swc_aeb_autosar_swc_aeb_Step_sys_Subsystem_Reference_AEB_Function_Run_AsyEvlrCritEve_Step_Func_Run_AsyEvlrCritEve_Step_Func_TAWrapper_PreProcessor_ObjectPreProcessor_ObjectPreProcessorLoop_ValidObject_SafetyMarginFrontObjects_CheckPredictionValidity_CheckPredictionValidityForTTM_CheckPredictionDistanceBelowThreshold autosar_swc_aeb_autosar_swc_aeb_Step_sys_Subsystem_Reference_AEB_Function_Run_AsyEvlrCritEve_Step_Func_Run_AsyEvlrCritEve_Step_Func_TAWrapper_PreProcessor_ObjectPreProcessor_ObjectPreProcessorLoop_ValidObject_SafetyMarginFrontObjects_CheckPredictionValidity_CheckPredictionValidityForTTM_CheckPredictionTimeBelowThreshold autosar_swc_aeb_autosar_swc_aeb_Step_sys_Subsystem_Reference_AEB_Function_Run_AsyEvlrCritEve_Step_Func_Run_AsyEvlrCritEve_Step_Func_TAWrapper_PreProcessor_ObjectPreProcessor_ObjectPreProcessorLoop_ValidObject_SafetyMarginFrontObjects_CheckPredictionValidity_CheckPredictionValidityForTTM_CheckSpeedAboveThreshold /end SUB_GROUP
/end GROUP
/begin GROUP autosar_swc_aeb_autosar_swc_aeb_Step_sys_Subsystem_Reference_AEB_Function_Run_AsyEvlrCritEve_Step_Func_Run_AsyEvlrCritEve_Step_Func_TAWrapper_PreProcessor_ObjectPreProcessor_ObjectPreProcessorLoop_ValidObject_SafetyMarginFrontObjects_CheckPredictionValidity_CheckPredictionValidityForTTR "autosar_swc_aeb/autosar_swc_aeb_Step_sys/Subsystem Reference/AEB Function/Run_AsyEvlrCritEve_Step_Func/Run_AsyEvlrCritEve_Step_Func/TAWrapper/PreProcessor/ObjectPreProcessor/ObjectPreProcessorLoop/ValidObject/SafetyMarginFrontObjects/CheckPredictionValidity/CheckPredictionValidityForTTR"
 /begin SUB_GROUP autosar_swc_aeb_autosar_swc_aeb_Step_sys_Subsystem_Reference_AEB_Function_Run_AsyEvlrCritEve_Step_Func_Run_AsyEvlrCritEve_Step_Func_TAWrapper_PreProcessor_ObjectPreProcessor_ObjectPreProcessorLoop_ValidObject_SafetyMarginFrontObjects_CheckPredictionValidity_CheckPredictionValidityForTTR_CheckConfidenceForHeading autosar_swc_aeb_autosar_swc_aeb_Step_sys_Subsystem_Reference_AEB_Function_Run_AsyEvlrCritEve_Step_Func_Run_AsyEvlrCritEve_Step_Func_TAWrapper_PreProcessor_ObjectPreProcessor_ObjectPreProcessorLoop_ValidObject_SafetyMarginFrontObjects_CheckPredictionValidity_CheckPredictionValidityForTTR_CheckPredictionDistanceBelowThreshold autosar_swc_aeb_autosar_swc_aeb_Step_sys_Subsystem_Reference_AEB_Function_Run_AsyEvlrCritEve_Step_Func_Run_AsyEvlrCritEve_Step_Func_TAWrapper_PreProcessor_ObjectPreProcessor_ObjectPreProcessorLoop_ValidObject_SafetyMarginFrontObjects_CheckPredictionValidity_CheckPredictionValidityForTTR_CheckPredictionTimeBelowThreshold autosar_swc_aeb_autosar_swc_aeb_Step_sys_Subsystem_Reference_AEB_Function_Run_AsyEvlrCritEve_Step_Func_Run_AsyEvlrCritEve_Step_Func_TAWrapper_PreProcessor_ObjectPreProcessor_ObjectPreProcessorLoop_ValidObject_SafetyMarginFrontObjects_CheckPredictionValidity_CheckPredictionValidityForTTR_CheckSpeedAboveThreshold /end SUB_GROUP
/end GROUP
/begin GROUP autosar_swc_aeb_autosar_swc_aeb_Step_sys_Subsystem_Reference_AEB_Function_Run_AsyEvlrCritEve_Step_Func_Run_AsyEvlrCritEve_Step_Func_TAWrapper_PreProcessor_ObjectPreProcessor_ObjectPreProcessorLoop_ValidObject_SafetyMarginFrontObjects_DetermineOffsets "autosar_swc_aeb/autosar_swc_aeb_Step_sys/Subsystem Reference/AEB Function/Run_AsyEvlrCritEve_Step_Func/Run_AsyEvlrCritEve_Step_Func/TAWrapper/PreProcessor/ObjectPreProcessor/ObjectPreProcessorLoop/ValidObject/SafetyMarginFrontObjects/DetermineOffsets"
 /begin SUB_GROUP autosar_swc_aeb_autosar_swc_aeb_Step_sys_Subsystem_Reference_AEB_Function_Run_AsyEvlrCritEve_Step_Func_Run_AsyEvlrCritEve_Step_Func_TAWrapper_PreProcessor_ObjectPreProcessor_ObjectPreProcessorLoop_ValidObject_SafetyMarginFrontObjects_DetermineOffsets_LateralInPathOffset autosar_swc_aeb_autosar_swc_aeb_Step_sys_Subsystem_Reference_AEB_Function_Run_AsyEvlrCritEve_Step_Func_Run_AsyEvlrCritEve_Step_Func_TAWrapper_PreProcessor_ObjectPreProcessor_ObjectPreProcessorLoop_ValidObject_SafetyMarginFrontObjects_DetermineOffsets_LateralInPathOffsetForLTAP autosar_swc_aeb_autosar_swc_aeb_Step_sys_Subsystem_Reference_AEB_Function_Run_AsyEvlrCritEve_Step_Func_Run_AsyEvlrCritEve_Step_Func_TAWrapper_PreProcessor_ObjectPreProcessor_ObjectPreProcessorLoop_ValidObject_SafetyMarginFrontObjects_DetermineOffsets_LateralIntersectionOffset autosar_swc_aeb_autosar_swc_aeb_Step_sys_Subsystem_Reference_AEB_Function_Run_AsyEvlrCritEve_Step_Func_Run_AsyEvlrCritEve_Step_Func_TAWrapper_PreProcessor_ObjectPreProcessor_ObjectPreProcessorLoop_ValidObject_SafetyMarginFrontObjects_DetermineOffsets_LateralManoeuvreOffset autosar_swc_aeb_autosar_swc_aeb_Step_sys_Subsystem_Reference_AEB_Function_Run_AsyEvlrCritEve_Step_Func_Run_AsyEvlrCritEve_Step_Func_TAWrapper_PreProcessor_ObjectPreProcessor_ObjectPreProcessorLoop_ValidObject_SafetyMarginFrontObjects_DetermineOffsets_LateralOffsetForMultipleTarget autosar_swc_aeb_autosar_swc_aeb_Step_sys_Subsystem_Reference_AEB_Function_Run_AsyEvlrCritEve_Step_Func_Run_AsyEvlrCritEve_Step_Func_TAWrapper_PreProcessor_ObjectPreProcessor_ObjectPreProcessorLoop_ValidObject_SafetyMarginFrontObjects_DetermineOffsets_OffsetLongPredTime autosar_swc_aeb_autosar_swc_aeb_Step_sys_Subsystem_Reference_AEB_Function_Run_AsyEvlrCritEve_Step_Func_Run_AsyEvlrCritEve_Step_Func_TAWrapper_PreProcessor_ObjectPreProcessor_ObjectPreProcessorLoop_ValidObject_SafetyMarginFrontObjects_DetermineOffsets_OffsetShortPredTime /end SUB_GROUP
/end GROUP
/begin GROUP autosar_swc_aeb_autosar_swc_aeb_Step_sys_Subsystem_Reference_AEB_Function_Run_AsyEvlrCritEve_Step_Func_Run_AsyEvlrCritEve_Step_Func_TAWrapper_PreProcessor_ObjectPreProcessor_ObjectPreProcessorLoop_ValidObject_SafetyMarginFrontObjects_DetermineOffsets_LateralInPathOffset "autosar_swc_aeb/autosar_swc_aeb_Step_sys/Subsystem Reference/AEB Function/Run_AsyEvlrCritEve_Step_Func/Run_AsyEvlrCritEve_Step_Func/TAWrapper/PreProcessor/ObjectPreProcessor/ObjectPreProcessorLoop/ValidObject/SafetyMarginFrontObjects/DetermineOffsets/LateralInPathOffset"
 /begin SUB_GROUP autosar_swc_aeb_autosar_swc_aeb_Step_sys_Subsystem_Reference_AEB_Function_Run_AsyEvlrCritEve_Step_Func_Run_AsyEvlrCritEve_Step_Func_TAWrapper_PreProcessor_ObjectPreProcessor_ObjectPreProcessorLoop_ValidObject_SafetyMarginFrontObjects_DetermineOffsets_LateralInPathOffset_CalcAdditionalFarEdgeOffset autosar_swc_aeb_autosar_swc_aeb_Step_sys_Subsystem_Reference_AEB_Function_Run_AsyEvlrCritEve_Step_Func_Run_AsyEvlrCritEve_Step_Func_TAWrapper_PreProcessor_ObjectPreProcessor_ObjectPreProcessorLoop_ValidObject_SafetyMarginFrontObjects_DetermineOffsets_LateralInPathOffset_SelectObjectWidth autosar_swc_aeb_autosar_swc_aeb_Step_sys_Subsystem_Reference_AEB_Function_Run_AsyEvlrCritEve_Step_Func_Run_AsyEvlrCritEve_Step_Func_TAWrapper_PreProcessor_ObjectPreProcessor_ObjectPreProcessorLoop_ValidObject_SafetyMarginFrontObjects_DetermineOffsets_LateralInPathOffset_VerifyOffsetOverlap /end SUB_GROUP
 /begin REF_CHARACTERISTIC CLTS_OffsMinForCllsnRednByBrkgActvInAsyEvlrCritEve_Ca CLTS_PedOffsLatInPahInAsyEvlrCritEve_Ca CLTS_PosnLgtValForTruckMaxOffsLatInPahInAsyEvlrCritEve_Ca CLTS_PosnLgtValForVehMaxOffsLatInPahInAsyEvlrCritEve_Ca CLTS_TruckMaxOffsLatInPahInAsyEvlrCritEve_Ca CLTS_VLgtValForPedOffsLatInPahInAsyEvlrCritEve_Ca CLTS_VLgtValForVehOffsLatInPahInAsyEvlrCritEve_Ca CLTS_VehMaxOffsLatInPahInAsyEvlrCritEve_Ca CLTS_VehOffsLatInPahInAsyEvlrCritEve_Ca CLTS_YawRatePedOffsLatInPahInAsyEvlrCritEve_Ca CLTS_YawRateValForPedOffsLatInPahInAsyEvlrCritEve_Ca CLTS_YawRateValForVehOffsLatInPahInAsyEvlrCritEve_Ca /end REF_CHARACTERISTIC
/end GROUP
/begin GROUP autosar_swc_aeb_autosar_swc_aeb_Step_sys_Subsystem_Reference_AEB_Function_Run_AsyEvlrCritEve_Step_Func_Run_AsyEvlrCritEve_Step_Func_TAWrapper_PreProcessor_ObjectPreProcessor_ObjectPreProcessorLoop_ValidObject_SafetyMarginFrontObjects_DetermineOffsets_LateralInPathOffsetForLTAP "autosar_swc_aeb/autosar_swc_aeb_Step_sys/Subsystem Reference/AEB Function/Run_AsyEvlrCritEve_Step_Func/Run_AsyEvlrCritEve_Step_Func/TAWrapper/PreProcessor/ObjectPreProcessor/ObjectPreProcessorLoop/ValidObject/SafetyMarginFrontObjects/DetermineOffsets/LateralInPathOffsetForLTAP" /begin REF_CHARACTERISTIC CLTS_OffsLatInPahPrimTarInAsyEvlrCritEve_Ca /end REF_CHARACTERISTIC /end GROUP
/begin GROUP autosar_swc_aeb_autosar_swc_aeb_Step_sys_Subsystem_Reference_AEB_Function_Run_AsyEvlrCritEve_Step_Func_Run_AsyEvlrCritEve_Step_Func_TAWrapper_PreProcessor_ObjectPreProcessor_ObjectPreProcessorLoop_ValidObject_SafetyMarginFrontObjects_DetermineOffsets_LateralInPathOffset_CalcAdditionalFarEdgeOffset "autosar_swc_aeb/autosar_swc_aeb_Step_sys/Subsystem Reference/AEB Function/Run_AsyEvlrCritEve_Step_Func/Run_AsyEvlrCritEve_Step_Func/TAWrapper/PreProcessor/ObjectPreProcessor/ObjectPreProcessorLoop/ValidObject/SafetyMarginFrontObjects/DetermineOffsets/LateralInPathOffset/CalcAdditionalFarEdgeOffset"
 /begin REF_CHARACTERISTIC CLTS_DstValForOffsLatInPahRemEdgeActvInAsyEvlrCritEve_Ca CLTS_DstValForOffsLatInPahRemEdgeInAsyEvlrCritEve_Ca CLTS_OffsLatInPahRemEdgeActvInAsyEvlrCritEve_Ca CLTS_OffsLatInPahRemEdgeInAsyEvlrCritEve_Ca CLTS_OffsLatInPahRemLimitEdgeInAsyEvlrCritEve_Ca CLTS_VLgtValForOffsLatInPahRemLimitEdgeInAsyEvlrCritEve_Ca /end REF_CHARACTERISTIC
/end GROUP
/begin GROUP autosar_swc_aeb_autosar_swc_aeb_Step_sys_Subsystem_Reference_AEB_Function_Run_AsyEvlrCritEve_Step_Func_Run_AsyEvlrCritEve_Step_Func_TAWrapper_PreProcessor_ObjectPreProcessor_ObjectPreProcessorLoop_ValidObject_SafetyMarginFrontObjects_DetermineOffsets_LateralIntersectionOffset "autosar_swc_aeb/autosar_swc_aeb_Step_sys/Subsystem Reference/AEB Function/Run_AsyEvlrCritEve_Step_Func/Run_AsyEvlrCritEve_Step_Func/TAWrapper/PreProcessor/ObjectPreProcessor/ObjectPreProcessorLoop/ValidObject/SafetyMarginFrontObjects/DetermineOffsets/LateralIntersectionOffset"
 /begin REF_CHARACTERISTIC CLTS_VLgtRelValForVehOffsLatInIntscnInAsyEvlrCritEve_Ca CLTS_VehOffsLatInIntscnInAsyEvlrCritEve_Ca /end REF_CHARACTERISTIC
/end GROUP
/begin GROUP autosar_swc_aeb_autosar_swc_aeb_Step_sys_Subsystem_Reference_AEB_Function_Run_AsyEvlrCritEve_Step_Func_Run_AsyEvlrCritEve_Step_Func_TAWrapper_PreProcessor_ObjectPreProcessor_ObjectPreProcessorLoop_ValidObject_SafetyMarginFrontObjects_DetermineOffsets_LateralManoeuvreOffset "autosar_swc_aeb/autosar_swc_aeb_Step_sys/Subsystem Reference/AEB Function/Run_AsyEvlrCritEve_Step_Func/Run_AsyEvlrCritEve_Step_Func/TAWrapper/PreProcessor/ObjectPreProcessor/ObjectPreProcessorLoop/ValidObject/SafetyMarginFrontObjects/DetermineOffsets/LateralManoeuvreOffset"
 /begin REF_CHARACTERISTIC CLTS_CyclistOffsLatInPahManvInAsyEvlrCritEve_Ca CLTS_PedOffsLatInPahManvInAsyEvlrCritEve_Ca CLTS_VLgtRelValForVehOffsLatInPahManvInAsyEvlrCritEve_Ca CLTS_VLgtValForCyclistOffsLatInPahManvInAsyEvlrCritEve_Ca CLTS_VLgtValForPedOffsLatInPahManvInAsyEvlrCritEve_Ca CLTS_VehOffsLatInPahManvInAsyEvlrCritEve_Ca /end REF_CHARACTERISTIC
/end GROUP
/begin GROUP autosar_swc_aeb_autosar_swc_aeb_Step_sys_Subsystem_Reference_AEB_Function_Run_AsyEvlrCritEve_Step_Func_Run_AsyEvlrCritEve_Step_Func_TAWrapper_PreProcessor_ObjectPreProcessor_ObjectPreProcessorLoop_ValidObject_SafetyMarginFrontObjects_DetermineOffsets_LateralOffsetForMultipleTarget "autosar_swc_aeb/autosar_swc_aeb_Step_sys/Subsystem Reference/AEB Function/Run_AsyEvlrCritEve_Step_Func/Run_AsyEvlrCritEve_Step_Func/TAWrapper/PreProcessor/ObjectPreProcessor/ObjectPreProcessorLoop/ValidObject/SafetyMarginFrontObjects/DetermineOffsets/LateralOffsetForMultipleTarget"
 /begin SUB_GROUP autosar_swc_aeb_autosar_swc_aeb_Step_sys_Subsystem_Reference_AEB_Function_Run_AsyEvlrCritEve_Step_Func_Run_AsyEvlrCritEve_Step_Func_TAWrapper_PreProcessor_ObjectPreProcessor_ObjectPreProcessorLoop_ValidObject_SafetyMarginFrontObjects_DetermineOffsets_LateralOffsetForMultipleTarget_LookupLateralOffset /end SUB_GROUP
/end GROUP
/begin GROUP autosar_swc_aeb_autosar_swc_aeb_Step_sys_Subsystem_Reference_AEB_Function_Run_AsyEvlrCritEve_Step_Func_Run_AsyEvlrCritEve_Step_Func_TAWrapper_PreProcessor_ObjectPreProcessor_ObjectPreProcessorLoop_ValidObject_SafetyMarginFrontObjects_DetermineOffsets_LateralOffsetForMultipleTarget_LookupLateralOffset "autosar_swc_aeb/autosar_swc_aeb_Step_sys/Subsystem Reference/AEB Function/Run_AsyEvlrCritEve_Step_Func/Run_AsyEvlrCritEve_Step_Func/TAWrapper/PreProcessor/ObjectPreProcessor/ObjectPreProcessorLoop/ValidObject/SafetyMarginFrontObjects/DetermineOffsets/LateralOffsetForMultipleTarget/LookupLateralOffset"
 /begin REF_CHARACTERISTIC CLTS_ALgtValForVehBrkgOffsLatMplTarInAsyEvlrCritEve_Ca CLTS_PedOffsLatMplTarInAsyEvlrCritEve_Ca CLTS_VLatRelValForPedOffsLatMplTarInAsyEvlrCritEve_Ca CLTS_VLatRelValForVehOffsLatMplTarInAsyEvlrCritEve_Ca CLTS_VLgtRelValForPedOffsLatMplTarInAsyEvlrCritEve_Ca CLTS_VLgtRelValForVehOffsLatMplTarInAsyEvlrCritEve_Ca CLTS_VehBrkgOffsLatMplTarInAsyEvlrCritEve_Ca CLTS_VehOffsLatMplTarInAsyEvlrCritEve_Ca /end REF_CHARACTERISTIC
/end GROUP
/begin GROUP autosar_swc_aeb_autosar_swc_aeb_Step_sys_Subsystem_Reference_AEB_Function_Run_AsyEvlrCritEve_Step_Func_Run_AsyEvlrCritEve_Step_Func_TAWrapper_PreProcessor_ObjectPreProcessor_ObjectPreProcessorLoop_ValidObject_SafetyMarginFrontObjects_DetermineOffsets_OffsetLongPredTime "autosar_swc_aeb/autosar_swc_aeb_Step_sys/Subsystem Reference/AEB Function/Run_AsyEvlrCritEve_Step_Func/Run_AsyEvlrCritEve_Step_Func/TAWrapper/PreProcessor/ObjectPreProcessor/ObjectPreProcessorLoop/ValidObject/SafetyMarginFrontObjects/DetermineOffsets/OffsetLongPredTime"
 /begin SUB_GROUP autosar_swc_aeb_autosar_swc_aeb_Step_sys_Subsystem_Reference_AEB_Function_Run_AsyEvlrCritEve_Step_Func_Run_AsyEvlrCritEve_Step_Func_TAWrapper_PreProcessor_ObjectPreProcessor_ObjectPreProcessorLoop_ValidObject_SafetyMarginFrontObjects_DetermineOffsets_OffsetLongPredTime_LookupLateralOffset autosar_swc_aeb_autosar_swc_aeb_Step_sys_Subsystem_Reference_AEB_Function_Run_AsyEvlrCritEve_Step_Func_Run_AsyEvlrCritEve_Step_Func_TAWrapper_PreProcessor_ObjectPreProcessor_ObjectPreProcessorLoop_ValidObject_SafetyMarginFrontObjects_DetermineOffsets_OffsetLongPredTime_LookupLongitudinalOffset /end SUB_GROUP
/end GROUP
/begin GROUP autosar_swc_aeb_autosar_swc_aeb_Step_sys_Subsystem_Reference_AEB_Function_Run_AsyEvlrCritEve_Step_Func_Run_AsyEvlrCritEve_Step_Func_TAWrapper_PreProcessor_ObjectPreProcessor_ObjectPreProcessorLoop_ValidObject_SafetyMarginFrontObjects_DetermineOffsets_OffsetLongPredTime_LookupLateralOffset "autosar_swc_aeb/autosar_swc_aeb_Step_sys/Subsystem Reference/AEB Function/Run_AsyEvlrCritEve_Step_Func/Run_AsyEvlrCritEve_Step_Func/TAWrapper/PreProcessor/ObjectPreProcessor/ObjectPreProcessorLoop/ValidObject/SafetyMarginFrontObjects/DetermineOffsets/OffsetLongPredTime/LookupLateralOffset"
 /begin REF_CHARACTERISTIC CLTS_ALgtValForVehBrkgOffsLatInAsyEvlrCritEve_Ca CLTS_CyclistOffsLatInAsyEvlrCritEve_Ca CLTS_PedOffsLatInAsyEvlrCritEve_Ca CLTS_VLatRelValForCyclistOffsLatInAsyEvlrCritEve_Ca CLTS_VLatRelValForPedOffsLatInAsyEvlrCritEve_Ca CLTS_VLatRelValForVehOffsLatInAsyEvlrCritEve_Ca CLTS_VLgtRelValForCyclistOffsLatInAsyEvlrCritEve_Ca CLTS_VLgtRelValForPedOffsLatInAsyEvlrCritEve_Ca CLTS_VLgtRelValForVehOffsLatInAsyEvlrCritEve_Ca CLTS_VehBrkgOffsLatInAsyEvlrCritEve_Ca CLTS_VehOffsLatInAsyEvlrCritEve_Ca /end REF_CHARACTERISTIC
/end GROUP
/begin GROUP autosar_swc_aeb_autosar_swc_aeb_Step_sys_Subsystem_Reference_AEB_Function_Run_AsyEvlrCritEve_Step_Func_Run_AsyEvlrCritEve_Step_Func_TAWrapper_PreProcessor_ObjectPreProcessor_ObjectPreProcessorLoop_ValidObject_SafetyMarginFrontObjects_DetermineOffsets_OffsetLongPredTime_LookupLongitudinalOffset "autosar_swc_aeb/autosar_swc_aeb_Step_sys/Subsystem Reference/AEB Function/Run_AsyEvlrCritEve_Step_Func/Run_AsyEvlrCritEve_Step_Func/TAWrapper/PreProcessor/ObjectPreProcessor/ObjectPreProcessorLoop/ValidObject/SafetyMarginFrontObjects/DetermineOffsets/OffsetLongPredTime/LookupLongitudinalOffset"
 /begin REF_CHARACTERISTIC CLTS_CyclistOffsLgtForTiLongInAsyEvlrCritEve_Ca CLTS_VLgtRelValForCyclistOffsLgtInAsyEvlrCritEve_Ca CLTS_VLgtRelValForVehOffsLgtInAsyEvlrCritEve_Ca CLTS_VehOffsLgtForTiLongInAsyEvlrCritEve_Ca PedOffsLgtLongPredTimeInAsyEvlrCritEve VLgtRelValForPedOffsLgtLongPredTimeInAsyEvlrCritEve /end REF_CHARACTERISTIC
/end GROUP
/begin GROUP autosar_swc_aeb_autosar_swc_aeb_Step_sys_Subsystem_Reference_AEB_Function_Run_AsyEvlrCritEve_Step_Func_Run_AsyEvlrCritEve_Step_Func_TAWrapper_PreProcessor_ObjectPreProcessor_ObjectPreProcessorLoop_ValidObject_SafetyMarginFrontObjects_DetermineOffsets_OffsetShortPredTime "autosar_swc_aeb/autosar_swc_aeb_Step_sys/Subsystem Reference/AEB Function/Run_AsyEvlrCritEve_Step_Func/Run_AsyEvlrCritEve_Step_Func/TAWrapper/PreProcessor/ObjectPreProcessor/ObjectPreProcessorLoop/ValidObject/SafetyMarginFrontObjects/DetermineOffsets/OffsetShortPredTime"
 /begin SUB_GROUP autosar_swc_aeb_autosar_swc_aeb_Step_sys_Subsystem_Reference_AEB_Function_Run_AsyEvlrCritEve_Step_Func_Run_AsyEvlrCritEve_Step_Func_TAWrapper_PreProcessor_ObjectPreProcessor_ObjectPreProcessorLoop_ValidObject_SafetyMarginFrontObjects_DetermineOffsets_OffsetShortPredTime_LookupLateralOffset autosar_swc_aeb_autosar_swc_aeb_Step_sys_Subsystem_Reference_AEB_Function_Run_AsyEvlrCritEve_Step_Func_Run_AsyEvlrCritEve_Step_Func_TAWrapper_PreProcessor_ObjectPreProcessor_ObjectPreProcessorLoop_ValidObject_SafetyMarginFrontObjects_DetermineOffsets_OffsetShortPredTime_LookupLongitudinalOffset /end SUB_GROUP
/end GROUP
/begin GROUP autosar_swc_aeb_autosar_swc_aeb_Step_sys_Subsystem_Reference_AEB_Function_Run_AsyEvlrCritEve_Step_Func_Run_AsyEvlrCritEve_Step_Func_TAWrapper_PreProcessor_ObjectPreProcessor_ObjectPreProcessorLoop_ValidObject_SafetyMarginFrontObjects_DetermineOffsets_OffsetShortPredTime_LookupLateralOffset "autosar_swc_aeb/autosar_swc_aeb_Step_sys/Subsystem Reference/AEB Function/Run_AsyEvlrCritEve_Step_Func/Run_AsyEvlrCritEve_Step_Func/TAWrapper/PreProcessor/ObjectPreProcessor/ObjectPreProcessorLoop/ValidObject/SafetyMarginFrontObjects/DetermineOffsets/OffsetShortPredTime/LookupLateralOffset"
 /begin REF_CHARACTERISTIC CLTS_ALgtValForVehBrkgOffsLatInAsyEvlrCritEve_Ca CLTS_CyclistOffsLatInAsyEvlrCritEve_Ca CLTS_PedOffsLatInAsyEvlrCritEve_Ca CLTS_VLatRelValForCyclistOffsLatInAsyEvlrCritEve_Ca CLTS_VLatRelValForPedOffsLatInAsyEvlrCritEve_Ca CLTS_VLatRelValForVehOffsLatInAsyEvlrCritEve_Ca CLTS_VLgtRelValForCyclistOffsLatInAsyEvlrCritEve_Ca CLTS_VLgtRelValForPedOffsLatInAsyEvlrCritEve_Ca CLTS_VLgtRelValForVehOffsLatInAsyEvlrCritEve_Ca CLTS_VehBrkgOffsLatInAsyEvlrCritEve_Ca CLTS_VehOffsLatInAsyEvlrCritEve_Ca /end REF_CHARACTERISTIC
/end GROUP
/begin GROUP autosar_swc_aeb_autosar_swc_aeb_Step_sys_Subsystem_Reference_AEB_Function_Run_AsyEvlrCritEve_Step_Func_Run_AsyEvlrCritEve_Step_Func_TAWrapper_PreProcessor_ObjectPreProcessor_ObjectPreProcessorLoop_ValidObject_SafetyMarginFrontObjects_DetermineOffsets_OffsetShortPredTime_LookupLongitudinalOffset "autosar_swc_aeb/autosar_swc_aeb_Step_sys/Subsystem Reference/AEB Function/Run_AsyEvlrCritEve_Step_Func/Run_AsyEvlrCritEve_Step_Func/TAWrapper/PreProcessor/ObjectPreProcessor/ObjectPreProcessorLoop/ValidObject/SafetyMarginFrontObjects/DetermineOffsets/OffsetShortPredTime/LookupLongitudinalOffset"
 /begin REF_CHARACTERISTIC CLTS_CyclistOffsLgtInAsyEvlrCritEve_Ca CLTS_PedOffsLgtInAsyEvlrCritEve_Ca CLTS_PosnLgtValForCyclistOffsLgtInAsyEvlrCritEve_Ca CLTS_PosnLgtValForVehOffsLgtInAsyEvlrCritEve_Ca CLTS_VLgtRelValForPedOffsLgtInAsyEvlrCritEve_Ca CLTS_VehOffsLgtActvInAsyEvlrCritEve_Ca CLTS_VehOffsLgtInAsyEvlrCritEve_Ca /end REF_CHARACTERISTIC
/end GROUP
/begin GROUP autosar_swc_aeb_autosar_swc_aeb_Step_sys_Subsystem_Reference_AEB_Function_Run_AsyEvlrCritEve_Step_Func_Run_AsyEvlrCritEve_Step_Func_TAWrapper_PreProcessor_ObjectPreProcessor_ObjectPreProcessorLoop_ValidObject_SafetyMarginFrontObjects_InPathCalculationWithCurrentObjPositions "autosar_swc_aeb/autosar_swc_aeb_Step_sys/Subsystem Reference/AEB Function/Run_AsyEvlrCritEve_Step_Func/Run_AsyEvlrCritEve_Step_Func/TAWrapper/PreProcessor/ObjectPreProcessor/ObjectPreProcessorLoop/ValidObject/SafetyMarginFrontObjects/InPathCalculationWithCurrentObjPositions"
 /begin SUB_GROUP autosar_swc_aeb_autosar_swc_aeb_Step_sys_Subsystem_Reference_AEB_Function_Run_AsyEvlrCritEve_Step_Func_Run_AsyEvlrCritEve_Step_Func_TAWrapper_PreProcessor_ObjectPreProcessor_ObjectPreProcessorLoop_ValidObject_SafetyMarginFrontObjects_InPathCalculationWithCurrentObjPositions_CheckSteeringOutOfPath autosar_swc_aeb_autosar_swc_aeb_Step_sys_Subsystem_Reference_AEB_Function_Run_AsyEvlrCritEve_Step_Func_Run_AsyEvlrCritEve_Step_Func_TAWrapper_PreProcessor_ObjectPreProcessor_ObjectPreProcessorLoop_ValidObject_SafetyMarginFrontObjects_InPathCalculationWithCurrentObjPositions_FindClosestCornerDistance /end SUB_GROUP
/end GROUP
/begin GROUP autosar_swc_aeb_autosar_swc_aeb_Step_sys_Subsystem_Reference_AEB_Function_Run_AsyEvlrCritEve_Step_Func_Run_AsyEvlrCritEve_Step_Func_TAWrapper_PreProcessor_ObjectPreProcessor_ObjectPreProcessorLoop_ValidObject_SafetyMarginFrontObjects_InPathCalculationWithCurrentObjPositions_CheckSteeringOutOfPath "autosar_swc_aeb/autosar_swc_aeb_Step_sys/Subsystem Reference/AEB Function/Run_AsyEvlrCritEve_Step_Func/Run_AsyEvlrCritEve_Step_Func/TAWrapper/PreProcessor/ObjectPreProcessor/ObjectPreProcessorLoop/ValidObject/SafetyMarginFrontObjects/InPathCalculationWithCurrentObjPositions/CheckSteeringOutOfPath"
 /begin SUB_GROUP autosar_swc_aeb_autosar_swc_aeb_Step_sys_Subsystem_Reference_AEB_Function_Run_AsyEvlrCritEve_Step_Func_Run_AsyEvlrCritEve_Step_Func_TAWrapper_PreProcessor_ObjectPreProcessor_ObjectPreProcessorLoop_ValidObject_SafetyMarginFrontObjects_InPathCalculationWithCurrentObjPositions_CheckSteeringOutOfPath_CheckIfObjectTriesToManoeuver autosar_swc_aeb_autosar_swc_aeb_Step_sys_Subsystem_Reference_AEB_Function_Run_AsyEvlrCritEve_Step_Func_Run_AsyEvlrCritEve_Step_Func_TAWrapper_PreProcessor_ObjectPreProcessor_ObjectPreProcessorLoop_ValidObject_SafetyMarginFrontObjects_InPathCalculationWithCurrentObjPositions_CheckSteeringOutOfPath_CheckPredictionTimeBelowThreshold /end SUB_GROUP
/end GROUP
/begin GROUP autosar_swc_aeb_autosar_swc_aeb_Step_sys_Subsystem_Reference_AEB_Function_Run_AsyEvlrCritEve_Step_Func_Run_AsyEvlrCritEve_Step_Func_TAWrapper_PreProcessor_ObjectPreProcessor_ObjectPreProcessorLoop_ValidObject_SafetyMarginFrontObjects_InPathCalculationWithCurrentObjPositions_CheckSteeringOutOfPath_CheckIfObjectTriesToManoeuver "autosar_swc_aeb/autosar_swc_aeb_Step_sys/Subsystem Reference/AEB Function/Run_AsyEvlrCritEve_Step_Func/Run_AsyEvlrCritEve_Step_Func/TAWrapper/PreProcessor/ObjectPreProcessor/ObjectPreProcessorLoop/ValidObject/SafetyMarginFrontObjects/InPathCalculationWithCurrentObjPositions/CheckSteeringOutOfPath/CheckIfObjectTriesToManoeuver" /begin REF_CHARACTERISTIC CLTS_AgDirForSteerMinInAsyEvlrCritEve_Ca /end REF_CHARACTERISTIC /end GROUP
/begin GROUP autosar_swc_aeb_autosar_swc_aeb_Step_sys_Subsystem_Reference_AEB_Function_Run_AsyEvlrCritEve_Step_Func_Run_AsyEvlrCritEve_Step_Func_TAWrapper_PreProcessor_ObjectPreProcessor_ObjectPreProcessorLoop_ValidObject_SafetyMarginFrontObjects_InPathCalculationWithCurrentObjPositions_FindClosestCornerDistance "autosar_swc_aeb/autosar_swc_aeb_Step_sys/Subsystem Reference/AEB Function/Run_AsyEvlrCritEve_Step_Func/Run_AsyEvlrCritEve_Step_Func/TAWrapper/PreProcessor/ObjectPreProcessor/ObjectPreProcessorLoop/ValidObject/SafetyMarginFrontObjects/InPathCalculationWithCurrentObjPositions/FindClosestCornerDistance"
 /begin SUB_GROUP autosar_swc_aeb_autosar_swc_aeb_Step_sys_Subsystem_Reference_AEB_Function_Run_AsyEvlrCritEve_Step_Func_Run_AsyEvlrCritEve_Step_Func_TAWrapper_PreProcessor_ObjectPreProcessor_ObjectPreProcessorLoop_ValidObject_SafetyMarginFrontObjects_InPathCalculationWithCurrentObjPositions_FindClosestCornerDistance_TransformCloseLeftToCurvedCoordSys autosar_swc_aeb_autosar_swc_aeb_Step_sys_Subsystem_Reference_AEB_Function_Run_AsyEvlrCritEve_Step_Func_Run_AsyEvlrCritEve_Step_Func_TAWrapper_PreProcessor_ObjectPreProcessor_ObjectPreProcessorLoop_ValidObject_SafetyMarginFrontObjects_InPathCalculationWithCurrentObjPositions_FindClosestCornerDistance_TransformCloseRightToCurvedCoordSys autosar_swc_aeb_autosar_swc_aeb_Step_sys_Subsystem_Reference_AEB_Function_Run_AsyEvlrCritEve_Step_Func_Run_AsyEvlrCritEve_Step_Func_TAWrapper_PreProcessor_ObjectPreProcessor_ObjectPreProcessorLoop_ValidObject_SafetyMarginFrontObjects_InPathCalculationWithCurrentObjPositions_FindClosestCornerDistance_TransformRemoteLeftToCurvedCoordSys autosar_swc_aeb_autosar_swc_aeb_Step_sys_Subsystem_Reference_AEB_Function_Run_AsyEvlrCritEve_Step_Func_Run_AsyEvlrCritEve_Step_Func_TAWrapper_PreProcessor_ObjectPreProcessor_ObjectPreProcessorLoop_ValidObject_SafetyMarginFrontObjects_InPathCalculationWithCurrentObjPositions_FindClosestCornerDistance_TransformRemoteRightToCurvedCoordSys /end SUB_GROUP
/end GROUP
/begin GROUP autosar_swc_aeb_autosar_swc_aeb_Step_sys_Subsystem_Reference_AEB_Function_Run_AsyEvlrCritEve_Step_Func_Run_AsyEvlrCritEve_Step_Func_TAWrapper_PreProcessor_ObjectPreProcessor_ObjectPreProcessorLoop_ValidObject_SafetyMarginFrontObjects_InPathCalculationWithPredictedObjPositions "autosar_swc_aeb/autosar_swc_aeb_Step_sys/Subsystem Reference/AEB Function/Run_AsyEvlrCritEve_Step_Func/Run_AsyEvlrCritEve_Step_Func/TAWrapper/PreProcessor/ObjectPreProcessor/ObjectPreProcessorLoop/ValidObject/SafetyMarginFrontObjects/InPathCalculationWithPredictedObjPositions"
 /begin SUB_GROUP autosar_swc_aeb_autosar_swc_aeb_Step_sys_Subsystem_Reference_AEB_Function_Run_AsyEvlrCritEve_Step_Func_Run_AsyEvlrCritEve_Step_Func_TAWrapper_PreProcessor_ObjectPreProcessor_ObjectPreProcessorLoop_ValidObject_SafetyMarginFrontObjects_InPathCalculationWithPredictedObjPositions_AvoidanceManoeuvers autosar_swc_aeb_autosar_swc_aeb_Step_sys_Subsystem_Reference_AEB_Function_Run_AsyEvlrCritEve_Step_Func_Run_AsyEvlrCritEve_Step_Func_TAWrapper_PreProcessor_ObjectPreProcessor_ObjectPreProcessorLoop_ValidObject_SafetyMarginFrontObjects_InPathCalculationWithPredictedObjPositions_CreateInPathDataTTM autosar_swc_aeb_autosar_swc_aeb_Step_sys_Subsystem_Reference_AEB_Function_Run_AsyEvlrCritEve_Step_Func_Run_AsyEvlrCritEve_Step_Func_TAWrapper_PreProcessor_ObjectPreProcessor_ObjectPreProcessorLoop_ValidObject_SafetyMarginFrontObjects_InPathCalculationWithPredictedObjPositions_CreateInPathDataTTR /end SUB_GROUP
/end GROUP
/begin GROUP autosar_swc_aeb_autosar_swc_aeb_Step_sys_Subsystem_Reference_AEB_Function_Run_AsyEvlrCritEve_Step_Func_Run_AsyEvlrCritEve_Step_Func_TAWrapper_PreProcessor_ObjectPreProcessor_ObjectPreProcessorLoop_ValidObject_SafetyMarginFrontObjects_InPathCalculationWithPredictedObjPositions_AvoidanceManoeuvers "autosar_swc_aeb/autosar_swc_aeb_Step_sys/Subsystem Reference/AEB Function/Run_AsyEvlrCritEve_Step_Func/Run_AsyEvlrCritEve_Step_Func/TAWrapper/PreProcessor/ObjectPreProcessor/ObjectPreProcessorLoop/ValidObject/SafetyMarginFrontObjects/InPathCalculationWithPredictedObjPositions/AvoidanceManoeuvers"
 /begin SUB_GROUP autosar_swc_aeb_autosar_swc_aeb_Step_sys_Subsystem_Reference_AEB_Function_Run_AsyEvlrCritEve_Step_Func_Run_AsyEvlrCritEve_Step_Func_TAWrapper_PreProcessor_ObjectPreProcessor_ObjectPreProcessorLoop_ValidObject_SafetyMarginFrontObjects_InPathCalculationWithPredictedObjPositions_AvoidanceManoeuvers_AccelerationIfSteering autosar_swc_aeb_autosar_swc_aeb_Step_sys_Subsystem_Reference_AEB_Function_Run_AsyEvlrCritEve_Step_Func_Run_AsyEvlrCritEve_Step_Func_TAWrapper_PreProcessor_ObjectPreProcessor_ObjectPreProcessorLoop_ValidObject_SafetyMarginFrontObjects_InPathCalculationWithPredictedObjPositions_AvoidanceManoeuvers_DecelerationAtLongPredictionTime autosar_swc_aeb_autosar_swc_aeb_Step_sys_Subsystem_Reference_AEB_Function_Run_AsyEvlrCritEve_Step_Func_Run_AsyEvlrCritEve_Step_Func_TAWrapper_PreProcessor_ObjectPreProcessor_ObjectPreProcessorLoop_ValidObject_SafetyMarginFrontObjects_InPathCalculationWithPredictedObjPositions_AvoidanceManoeuvers_DecelerationAtShortPredictionTime /end SUB_GROUP
/end GROUP
/begin GROUP autosar_swc_aeb_autosar_swc_aeb_Step_sys_Subsystem_Reference_AEB_Function_Run_AsyEvlrCritEve_Step_Func_Run_AsyEvlrCritEve_Step_Func_TAWrapper_PreProcessor_ObjectPreProcessor_ObjectPreProcessorLoop_ValidObject_SafetyMarginFrontObjects_InPathCalculationWithPredictedObjPositions_AvoidanceManoeuvers_AccelerationIfSteering "autosar_swc_aeb/autosar_swc_aeb_Step_sys/Subsystem Reference/AEB Function/Run_AsyEvlrCritEve_Step_Func/Run_AsyEvlrCritEve_Step_Func/TAWrapper/PreProcessor/ObjectPreProcessor/ObjectPreProcessorLoop/ValidObject/SafetyMarginFrontObjects/InPathCalculationWithPredictedObjPositions/AvoidanceManoeuvers/AccelerationIfSteering"
 /begin REF_CHARACTERISTIC CLTS_BicycleSteerPredInAsyEvlrCritEve_Ca CLTS_PedSteerPredInAsyEvlrCritEve_Ca CLTS_VehSteerPredDataTblInAsyEvlrCritEve_Ca CLTS_VehSteerPredValDataTblInAsyEvlrCritEve_Ca /end REF_CHARACTERISTIC
/end GROUP
/begin GROUP autosar_swc_aeb_autosar_swc_aeb_Step_sys_Subsystem_Reference_AEB_Function_Run_AsyEvlrCritEve_Step_Func_Run_AsyEvlrCritEve_Step_Func_TAWrapper_PreProcessor_ObjectPreProcessor_ObjectPreProcessorLoop_ValidObject_SafetyMarginFrontObjects_InPathCalculationWithPredictedObjPositions_AvoidanceManoeuvers_DecelerationAtLongPredictionTime "autosar_swc_aeb/autosar_swc_aeb_Step_sys/Subsystem Reference/AEB Function/Run_AsyEvlrCritEve_Step_Func/Run_AsyEvlrCritEve_Step_Func/TAWrapper/PreProcessor/ObjectPreProcessor/ObjectPreProcessorLoop/ValidObject/SafetyMarginFrontObjects/InPathCalculationWithPredictedObjPositions/AvoidanceManoeuvers/DecelerationAtLongPredictionTime"
 /begin REF_CHARACTERISTIC CLTS_BicycleDecelPredLongInAsyEvlrCritEve_Ca CLTS_PedDecelPredLongInAsyEvlrCritEve_Ca CLTS_VehDecelPredLongInAsyEvlrCritEve_Ca /end REF_CHARACTERISTIC
/end GROUP
/begin GROUP autosar_swc_aeb_autosar_swc_aeb_Step_sys_Subsystem_Reference_AEB_Function_Run_AsyEvlrCritEve_Step_Func_Run_AsyEvlrCritEve_Step_Func_TAWrapper_PreProcessor_ObjectPreProcessor_ObjectPreProcessorLoop_ValidObject_SafetyMarginFrontObjects_InPathCalculationWithPredictedObjPositions_AvoidanceManoeuvers_DecelerationAtShortPredictionTime "autosar_swc_aeb/autosar_swc_aeb_Step_sys/Subsystem Reference/AEB Function/Run_AsyEvlrCritEve_Step_Func/Run_AsyEvlrCritEve_Step_Func/TAWrapper/PreProcessor/ObjectPreProcessor/ObjectPreProcessorLoop/ValidObject/SafetyMarginFrontObjects/InPathCalculationWithPredictedObjPositions/AvoidanceManoeuvers/DecelerationAtShortPredictionTime"
 /begin REF_CHARACTERISTIC CLTS_BicycleDecelPredShoInAsyEvlrCritEve_Ca CLTS_PedDecelPredShoInAsyEvlrCritEve_Ca CLTS_VehDecelPredShoInAsyEvlrCritEve_Ca /end REF_CHARACTERISTIC
/end GROUP
/begin GROUP autosar_swc_aeb_autosar_swc_aeb_Step_sys_Subsystem_Reference_AEB_Function_Run_AsyEvlrCritEve_Step_Func_Run_AsyEvlrCritEve_Step_Func_TAWrapper_PreProcessor_ObjectPreProcessor_ObjectPreProcessorLoop_ValidObject_SafetyMarginFrontObjects_InPathCalculationWithPredictedObjPositions_CreateInPathDataTTM "autosar_swc_aeb/autosar_swc_aeb_Step_sys/Subsystem Reference/AEB Function/Run_AsyEvlrCritEve_Step_Func/Run_AsyEvlrCritEve_Step_Func/TAWrapper/PreProcessor/ObjectPreProcessor/ObjectPreProcessorLoop/ValidObject/SafetyMarginFrontObjects/InPathCalculationWithPredictedObjPositions/CreateInPathDataTTM"
 /begin SUB_GROUP autosar_swc_aeb_autosar_swc_aeb_Step_sys_Subsystem_Reference_AEB_Function_Run_AsyEvlrCritEve_Step_Func_Run_AsyEvlrCritEve_Step_Func_TAWrapper_PreProcessor_ObjectPreProcessor_ObjectPreProcessorLoop_ValidObject_SafetyMarginFrontObjects_InPathCalculationWithPredictedObjPositions_CreateInPathDataTTM_CalculateAccelerationAndPredictPosition autosar_swc_aeb_autosar_swc_aeb_Step_sys_Subsystem_Reference_AEB_Function_Run_AsyEvlrCritEve_Step_Func_Run_AsyEvlrCritEve_Step_Func_TAWrapper_PreProcessor_ObjectPreProcessor_ObjectPreProcessorLoop_ValidObject_SafetyMarginFrontObjects_InPathCalculationWithPredictedObjPositions_CreateInPathDataTTM_CheckBrakingAndSteering autosar_swc_aeb_autosar_swc_aeb_Step_sys_Subsystem_Reference_AEB_Function_Run_AsyEvlrCritEve_Step_Func_Run_AsyEvlrCritEve_Step_Func_TAWrapper_PreProcessor_ObjectPreProcessor_ObjectPreProcessorLoop_ValidObject_SafetyMarginFrontObjects_InPathCalculationWithPredictedObjPositions_CreateInPathDataTTM_CreateInPathData autosar_swc_aeb_autosar_swc_aeb_Step_sys_Subsystem_Reference_AEB_Function_Run_AsyEvlrCritEve_Step_Func_Run_AsyEvlrCritEve_Step_Func_TAWrapper_PreProcessor_ObjectPreProcessor_ObjectPreProcessorLoop_ValidObject_SafetyMarginFrontObjects_InPathCalculationWithPredictedObjPositions_CreateInPathDataTTM_RelativePositionAtTTR autosar_swc_aeb_autosar_swc_aeb_Step_sys_Subsystem_Reference_AEB_Function_Run_AsyEvlrCritEve_Step_Func_Run_AsyEvlrCritEve_Step_Func_TAWrapper_PreProcessor_ObjectPreProcessor_ObjectPreProcessorLoop_ValidObject_SafetyMarginFrontObjects_InPathCalculationWithPredictedObjPositions_CreateInPathDataTTM_ToDiag /end SUB_GROUP
/end GROUP
/begin GROUP autosar_swc_aeb_autosar_swc_aeb_Step_sys_Subsystem_Reference_AEB_Function_Run_AsyEvlrCritEve_Step_Func_Run_AsyEvlrCritEve_Step_Func_TAWrapper_PreProcessor_ObjectPreProcessor_ObjectPreProcessorLoop_ValidObject_SafetyMarginFrontObjects_InPathCalculationWithPredictedObjPositions_CreateInPathDataTTM_CalculateAccelerationAndPredictPosition "autosar_swc_aeb/autosar_swc_aeb_Step_sys/Subsystem Reference/AEB Function/Run_AsyEvlrCritEve_Step_Func/Run_AsyEvlrCritEve_Step_Func/TAWrapper/PreProcessor/ObjectPreProcessor/ObjectPreProcessorLoop/ValidObject/SafetyMarginFrontObjects/InPathCalculationWithPredictedObjPositions/CreateInPathDataTTM/CalculateAccelerationAndPredictPosition"
 /begin SUB_GROUP autosar_swc_aeb_autosar_swc_aeb_Step_sys_Subsystem_Reference_AEB_Function_Run_AsyEvlrCritEve_Step_Func_Run_AsyEvlrCritEve_Step_Func_TAWrapper_PreProcessor_ObjectPreProcessor_ObjectPreProcessorLoop_ValidObject_SafetyMarginFrontObjects_InPathCalculationWithPredictedObjPositions_CreateInPathDataTTM_CalculateAccelerationAndPredictPosition_CircularPrediction autosar_swc_aeb_autosar_swc_aeb_Step_sys_Subsystem_Reference_AEB_Function_Run_AsyEvlrCritEve_Step_Func_Run_AsyEvlrCritEve_Step_Func_TAWrapper_PreProcessor_ObjectPreProcessor_ObjectPreProcessorLoop_ValidObject_SafetyMarginFrontObjects_InPathCalculationWithPredictedObjPositions_CreateInPathDataTTM_CalculateAccelerationAndPredictPosition_LinearPrediction autosar_swc_aeb_autosar_swc_aeb_Step_sys_Subsystem_Reference_AEB_Function_Run_AsyEvlrCritEve_Step_Func_Run_AsyEvlrCritEve_Step_Func_TAWrapper_PreProcessor_ObjectPreProcessor_ObjectPreProcessorLoop_ValidObject_SafetyMarginFrontObjects_InPathCalculationWithPredictedObjPositions_CreateInPathDataTTM_CalculateAccelerationAndPredictPosition_NoPrediction autosar_swc_aeb_autosar_swc_aeb_Step_sys_Subsystem_Reference_AEB_Function_Run_AsyEvlrCritEve_Step_Func_Run_AsyEvlrCritEve_Step_Func_TAWrapper_PreProcessor_ObjectPreProcessor_ObjectPreProcessorLoop_ValidObject_SafetyMarginFrontObjects_InPathCalculationWithPredictedObjPositions_CreateInPathDataTTM_CalculateAccelerationAndPredictPosition_PredictHostLateralPositionAtTTR /end SUB_GROUP
/end GROUP
/begin GROUP autosar_swc_aeb_autosar_swc_aeb_Step_sys_Subsystem_Reference_AEB_Function_Run_AsyEvlrCritEve_Step_Func_Run_AsyEvlrCritEve_Step_Func_TAWrapper_PreProcessor_ObjectPreProcessor_ObjectPreProcessorLoop_ValidObject_SafetyMarginFrontObjects_InPathCalculationWithPredictedObjPositions_CreateInPathDataTTM_CalculateAccelerationAndPredictPosition_CircularPrediction "autosar_swc_aeb/autosar_swc_aeb_Step_sys/Subsystem Reference/AEB Function/Run_AsyEvlrCritEve_Step_Func/Run_AsyEvlrCritEve_Step_Func/TAWrapper/PreProcessor/ObjectPreProcessor/ObjectPreProcessorLoop/ValidObject/SafetyMarginFrontObjects/InPathCalculationWithPredictedObjPositions/CreateInPathDataTTM/CalculateAccelerationAndPredictPosition/CircularPrediction"
 /begin SUB_GROUP autosar_swc_aeb_autosar_swc_aeb_Step_sys_Subsystem_Reference_AEB_Function_Run_AsyEvlrCritEve_Step_Func_Run_AsyEvlrCritEve_Step_Func_TAWrapper_PreProcessor_ObjectPreProcessor_ObjectPreProcessorLoop_ValidObject_SafetyMarginFrontObjects_InPathCalculationWithPredictedObjPositions_CreateInPathDataTTM_CalculateAccelerationAndPredictPosition_CircularPrediction_AccelerationCalculationAndCircularPredictionOfBrakingObjAtTTR autosar_swc_aeb_autosar_swc_aeb_Step_sys_Subsystem_Reference_AEB_Function_Run_AsyEvlrCritEve_Step_Func_Run_AsyEvlrCritEve_Step_Func_TAWrapper_PreProcessor_ObjectPreProcessor_ObjectPreProcessorLoop_ValidObject_SafetyMarginFrontObjects_InPathCalculationWithPredictedObjPositions_CreateInPathDataTTM_CalculateAccelerationAndPredictPosition_CircularPrediction_AccelerationCalculationAndCircularPredictionOfBrakingObjAtTTR1 autosar_swc_aeb_autosar_swc_aeb_Step_sys_Subsystem_Reference_AEB_Function_Run_AsyEvlrCritEve_Step_Func_Run_AsyEvlrCritEve_Step_Func_TAWrapper_PreProcessor_ObjectPreProcessor_ObjectPreProcessorLoop_ValidObject_SafetyMarginFrontObjects_InPathCalculationWithPredictedObjPositions_CreateInPathDataTTM_CalculateAccelerationAndPredictPosition_CircularPrediction_AccelerationCalculationAndCircularPredictionOfTurningObjAtTTR autosar_swc_aeb_autosar_swc_aeb_Step_sys_Subsystem_Reference_AEB_Function_Run_AsyEvlrCritEve_Step_Func_Run_AsyEvlrCritEve_Step_Func_TAWrapper_PreProcessor_ObjectPreProcessor_ObjectPreProcessorLoop_ValidObject_SafetyMarginFrontObjects_InPathCalculationWithPredictedObjPositions_CreateInPathDataTTM_CalculateAccelerationAndPredictPosition_CircularPrediction_AccelerationCalculationAndCircularPredictionOfTurningObjAtTTR1 autosar_swc_aeb_autosar_swc_aeb_Step_sys_Subsystem_Reference_AEB_Function_Run_AsyEvlrCritEve_Step_Func_Run_AsyEvlrCritEve_Step_Func_TAWrapper_PreProcessor_ObjectPreProcessor_ObjectPreProcessorLoop_ValidObject_SafetyMarginFrontObjects_InPathCalculationWithPredictedObjPositions_CreateInPathDataTTM_CalculateAccelerationAndPredictPosition_CircularPrediction_CircularPredictionOfObjAtTTR /end SUB_GROUP
/end GROUP
/begin GROUP autosar_swc_aeb_autosar_swc_aeb_Step_sys_Subsystem_Reference_AEB_Function_Run_AsyEvlrCritEve_Step_Func_Run_AsyEvlrCritEve_Step_Func_TAWrapper_PreProcessor_ObjectPreProcessor_ObjectPreProcessorLoop_ValidObject_SafetyMarginFrontObjects_InPathCalculationWithPredictedObjPositions_CreateInPathDataTTM_CalculateAccelerationAndPredictPosition_CircularPrediction_AccelerationCalculationAndCircularPredictionOfBrakingObjAtTTR "autosar_swc_aeb/autosar_swc_aeb_Step_sys/Subsystem Reference/AEB Function/Run_AsyEvlrCritEve_Step_Func/Run_AsyEvlrCritEve_Step_Func/TAWrapper/PreProcessor/ObjectPreProcessor/ObjectPreProcessorLoop/ValidObject/SafetyMarginFrontObjects/InPathCalculationWithPredictedObjPositions/CreateInPathDataTTM/CalculateAccelerationAndPredictPosition/CircularPrediction/AccelerationCalculationAndCircularPredictionOfBrakingObjAtTTR"
 /begin SUB_GROUP autosar_swc_aeb_autosar_swc_aeb_Step_sys_Subsystem_Reference_AEB_Function_Run_AsyEvlrCritEve_Step_Func_Run_AsyEvlrCritEve_Step_Func_TAWrapper_PreProcessor_ObjectPreProcessor_ObjectPreProcessorLoop_ValidObject_SafetyMarginFrontObjects_InPathCalculationWithPredictedObjPositions_CreateInPathDataTTM_CalculateAccelerationAndPredictPosition_CircularPrediction_AccelerationCalculationAndCircularPredictionOfBrakingObjAtTTR_ComputeCartesianMovement autosar_swc_aeb_autosar_swc_aeb_Step_sys_Subsystem_Reference_AEB_Function_Run_AsyEvlrCritEve_Step_Func_Run_AsyEvlrCritEve_Step_Func_TAWrapper_PreProcessor_ObjectPreProcessor_ObjectPreProcessorLoop_ValidObject_SafetyMarginFrontObjects_InPathCalculationWithPredictedObjPositions_CreateInPathDataTTM_CalculateAccelerationAndPredictPosition_CircularPrediction_AccelerationCalculationAndCircularPredictionOfBrakingObjAtTTR_NoOperation autosar_swc_aeb_autosar_swc_aeb_Step_sys_Subsystem_Reference_AEB_Function_Run_AsyEvlrCritEve_Step_Func_Run_AsyEvlrCritEve_Step_Func_TAWrapper_PreProcessor_ObjectPreProcessor_ObjectPreProcessorLoop_ValidObject_SafetyMarginFrontObjects_InPathCalculationWithPredictedObjPositions_CreateInPathDataTTM_CalculateAccelerationAndPredictPosition_CircularPrediction_AccelerationCalculationAndCircularPredictionOfBrakingObjAtTTR_PredictedPositionAtTimeHeadingAngleAndCurvatureBased /end SUB_GROUP
 /begin REF_MEASUREMENT autosar_swc_aeb_rtARID_DEF.VLatObj_ja0hf autosar_swc_aeb_rtARID_DEF.VLgtObj_foijp /end REF_MEASUREMENT
/end GROUP
/begin GROUP autosar_swc_aeb_autosar_swc_aeb_Step_sys_Subsystem_Reference_AEB_Function_Run_AsyEvlrCritEve_Step_Func_Run_AsyEvlrCritEve_Step_Func_TAWrapper_PreProcessor_ObjectPreProcessor_ObjectPreProcessorLoop_ValidObject_SafetyMarginFrontObjects_InPathCalculationWithPredictedObjPositions_CreateInPathDataTTM_CalculateAccelerationAndPredictPosition_CircularPrediction_AccelerationCalculationAndCircularPredictionOfBrakingObjAtTTR1 "autosar_swc_aeb/autosar_swc_aeb_Step_sys/Subsystem Reference/AEB Function/Run_AsyEvlrCritEve_Step_Func/Run_AsyEvlrCritEve_Step_Func/TAWrapper/PreProcessor/ObjectPreProcessor/ObjectPreProcessorLoop/ValidObject/SafetyMarginFrontObjects/InPathCalculationWithPredictedObjPositions/CreateInPathDataTTM/CalculateAccelerationAndPredictPosition/CircularPrediction/AccelerationCalculationAndCircularPredictionOfBrakingObjAtTTR1"
 /begin SUB_GROUP autosar_swc_aeb_autosar_swc_aeb_Step_sys_Subsystem_Reference_AEB_Function_Run_AsyEvlrCritEve_Step_Func_Run_AsyEvlrCritEve_Step_Func_TAWrapper_PreProcessor_ObjectPreProcessor_ObjectPreProcessorLoop_ValidObject_SafetyMarginFrontObjects_InPathCalculationWithPredictedObjPositions_CreateInPathDataTTM_CalculateAccelerationAndPredictPosition_CircularPrediction_AccelerationCalculationAndCircularPredictionOfBrakingObjAtTTR1_ComputeCartesianMovement autosar_swc_aeb_autosar_swc_aeb_Step_sys_Subsystem_Reference_AEB_Function_Run_AsyEvlrCritEve_Step_Func_Run_AsyEvlrCritEve_Step_Func_TAWrapper_PreProcessor_ObjectPreProcessor_ObjectPreProcessorLoop_ValidObject_SafetyMarginFrontObjects_InPathCalculationWithPredictedObjPositions_CreateInPathDataTTM_CalculateAccelerationAndPredictPosition_CircularPrediction_AccelerationCalculationAndCircularPredictionOfBrakingObjAtTTR1_NoOperation autosar_swc_aeb_autosar_swc_aeb_Step_sys_Subsystem_Reference_AEB_Function_Run_AsyEvlrCritEve_Step_Func_Run_AsyEvlrCritEve_Step_Func_TAWrapper_PreProcessor_ObjectPreProcessor_ObjectPreProcessorLoop_ValidObject_SafetyMarginFrontObjects_InPathCalculationWithPredictedObjPositions_CreateInPathDataTTM_CalculateAccelerationAndPredictPosition_CircularPrediction_AccelerationCalculationAndCircularPredictionOfBrakingObjAtTTR1_PredictedPositionAtTimeHeadingAngleAndCurvatureBased /end SUB_GROUP
 /begin REF_MEASUREMENT autosar_swc_aeb_rtARID_DEF.VLatObj_ja autosar_swc_aeb_rtARID_DEF.VLgtObj_fo /end REF_MEASUREMENT
/end GROUP
/begin GROUP autosar_swc_aeb_autosar_swc_aeb_Step_sys_Subsystem_Reference_AEB_Function_Run_AsyEvlrCritEve_Step_Func_Run_AsyEvlrCritEve_Step_Func_TAWrapper_PreProcessor_ObjectPreProcessor_ObjectPreProcessorLoop_ValidObject_SafetyMarginFrontObjects_InPathCalculationWithPredictedObjPositions_CreateInPathDataTTM_CalculateAccelerationAndPredictPosition_CircularPrediction_AccelerationCalculationAndCircularPredictionOfBrakingObjAtTTR1_ComputeCartesianMovement "autosar_swc_aeb/autosar_swc_aeb_Step_sys/Subsystem Reference/AEB Function/Run_AsyEvlrCritEve_Step_Func/Run_AsyEvlrCritEve_Step_Func/TAWrapper/PreProcessor/ObjectPreProcessor/ObjectPreProcessorLoop/ValidObject/SafetyMarginFrontObjects/InPathCalculationWithPredictedObjPositions/CreateInPathDataTTM/CalculateAccelerationAndPredictPosition/CircularPrediction/AccelerationCalculationAndCircularPredictionOfBrakingObjAtTTR1/ComputeCartesianMovement"
 /begin REF_MEASUREMENT autosar_swc_aeb_rtARID_DEF.ALatObj_onhu autosar_swc_aeb_rtARID_DEF.ALgtObj_cmoa /end REF_MEASUREMENT
/end GROUP
/begin GROUP autosar_swc_aeb_autosar_swc_aeb_Step_sys_Subsystem_Reference_AEB_Function_Run_AsyEvlrCritEve_Step_Func_Run_AsyEvlrCritEve_Step_Func_TAWrapper_PreProcessor_ObjectPreProcessor_ObjectPreProcessorLoop_ValidObject_SafetyMarginFrontObjects_InPathCalculationWithPredictedObjPositions_CreateInPathDataTTM_CalculateAccelerationAndPredictPosition_CircularPrediction_AccelerationCalculationAndCircularPredictionOfBrakingObjAtTTR1_NoOperation "autosar_swc_aeb/autosar_swc_aeb_Step_sys/Subsystem Reference/AEB Function/Run_AsyEvlrCritEve_Step_Func/Run_AsyEvlrCritEve_Step_Func/TAWrapper/PreProcessor/ObjectPreProcessor/ObjectPreProcessorLoop/ValidObject/SafetyMarginFrontObjects/InPathCalculationWithPredictedObjPositions/CreateInPathDataTTM/CalculateAccelerationAndPredictPosition/CircularPrediction/AccelerationCalculationAndCircularPredictionOfBrakingObjAtTTR1/NoOperation" /begin REF_MEASUREMENT autosar_swc_aeb_rtARID_DEF.HeadingObj_mhzxn /end REF_MEASUREMENT /end GROUP
/begin GROUP autosar_swc_aeb_autosar_swc_aeb_Step_sys_Subsystem_Reference_AEB_Function_Run_AsyEvlrCritEve_Step_Func_Run_AsyEvlrCritEve_Step_Func_TAWrapper_PreProcessor_ObjectPreProcessor_ObjectPreProcessorLoop_ValidObject_SafetyMarginFrontObjects_InPathCalculationWithPredictedObjPositions_CreateInPathDataTTM_CalculateAccelerationAndPredictPosition_CircularPrediction_AccelerationCalculationAndCircularPredictionOfBrakingObjAtTTR1_PredictedPositionAtTimeHeadingAngleAndCurvatureBased "autosar_swc_aeb/autosar_swc_aeb_Step_sys/Subsystem Reference/AEB Function/Run_AsyEvlrCritEve_Step_Func/Run_AsyEvlrCritEve_Step_Func/TAWrapper/PreProcessor/ObjectPreProcessor/ObjectPreProcessorLoop/ValidObject/SafetyMarginFrontObjects/InPathCalculationWithPredictedObjPositions/CreateInPathDataTTM/CalculateAccelerationAndPredictPosition/CircularPrediction/AccelerationCalculationAndCircularPredictionOfBrakingObjAtTTR1/PredictedPositionAtTimeHeadingAngleAndCurvatureBased"
 /begin REF_MEASUREMENT autosar_swc_aeb_rtARID_DEF.PosnLatObj_p3hko autosar_swc_aeb_rtARID_DEF.PosnLgtObj_o0e3h /end REF_MEASUREMENT
/end GROUP
/begin GROUP autosar_swc_aeb_autosar_swc_aeb_Step_sys_Subsystem_Reference_AEB_Function_Run_AsyEvlrCritEve_Step_Func_Run_AsyEvlrCritEve_Step_Func_TAWrapper_PreProcessor_ObjectPreProcessor_ObjectPreProcessorLoop_ValidObject_SafetyMarginFrontObjects_InPathCalculationWithPredictedObjPositions_CreateInPathDataTTM_CalculateAccelerationAndPredictPosition_CircularPrediction_AccelerationCalculationAndCircularPredictionOfBrakingObjAtTTR_ComputeCartesianMovement "autosar_swc_aeb/autosar_swc_aeb_Step_sys/Subsystem Reference/AEB Function/Run_AsyEvlrCritEve_Step_Func/Run_AsyEvlrCritEve_Step_Func/TAWrapper/PreProcessor/ObjectPreProcessor/ObjectPreProcessorLoop/ValidObject/SafetyMarginFrontObjects/InPathCalculationWithPredictedObjPositions/CreateInPathDataTTM/CalculateAccelerationAndPredictPosition/CircularPrediction/AccelerationCalculationAndCircularPredictionOfBrakingObjAtTTR/ComputeCartesianMovement"
 /begin REF_MEASUREMENT autosar_swc_aeb_rtARID_DEF.ALatObj_o autosar_swc_aeb_rtARID_DEF.ALgtObj_c /end REF_MEASUREMENT
/end GROUP
/begin GROUP autosar_swc_aeb_autosar_swc_aeb_Step_sys_Subsystem_Reference_AEB_Function_Run_AsyEvlrCritEve_Step_Func_Run_AsyEvlrCritEve_Step_Func_TAWrapper_PreProcessor_ObjectPreProcessor_ObjectPreProcessorLoop_ValidObject_SafetyMarginFrontObjects_InPathCalculationWithPredictedObjPositions_CreateInPathDataTTM_CalculateAccelerationAndPredictPosition_CircularPrediction_AccelerationCalculationAndCircularPredictionOfBrakingObjAtTTR_NoOperation "autosar_swc_aeb/autosar_swc_aeb_Step_sys/Subsystem Reference/AEB Function/Run_AsyEvlrCritEve_Step_Func/Run_AsyEvlrCritEve_Step_Func/TAWrapper/PreProcessor/ObjectPreProcessor/ObjectPreProcessorLoop/ValidObject/SafetyMarginFrontObjects/InPathCalculationWithPredictedObjPositions/CreateInPathDataTTM/CalculateAccelerationAndPredictPosition/CircularPrediction/AccelerationCalculationAndCircularPredictionOfBrakingObjAtTTR/NoOperation" /begin REF_MEASUREMENT autosar_swc_aeb_rtARID_DEF.HeadingObj_mh /end REF_MEASUREMENT /end GROUP
/begin GROUP autosar_swc_aeb_autosar_swc_aeb_Step_sys_Subsystem_Reference_AEB_Function_Run_AsyEvlrCritEve_Step_Func_Run_AsyEvlrCritEve_Step_Func_TAWrapper_PreProcessor_ObjectPreProcessor_ObjectPreProcessorLoop_ValidObject_SafetyMarginFrontObjects_InPathCalculationWithPredictedObjPositions_CreateInPathDataTTM_CalculateAccelerationAndPredictPosition_CircularPrediction_AccelerationCalculationAndCircularPredictionOfBrakingObjAtTTR_PredictedPositionAtTimeHeadingAngleAndCurvatureBased "autosar_swc_aeb/autosar_swc_aeb_Step_sys/Subsystem Reference/AEB Function/Run_AsyEvlrCritEve_Step_Func/Run_AsyEvlrCritEve_Step_Func/TAWrapper/PreProcessor/ObjectPreProcessor/ObjectPreProcessorLoop/ValidObject/SafetyMarginFrontObjects/InPathCalculationWithPredictedObjPositions/CreateInPathDataTTM/CalculateAccelerationAndPredictPosition/CircularPrediction/AccelerationCalculationAndCircularPredictionOfBrakingObjAtTTR/PredictedPositionAtTimeHeadingAngleAndCurvatureBased"
 /begin REF_MEASUREMENT autosar_swc_aeb_rtARID_DEF.PosnLatObj_p3 autosar_swc_aeb_rtARID_DEF.PosnLgtObj_o0 /end REF_MEASUREMENT
/end GROUP
/begin GROUP autosar_swc_aeb_autosar_swc_aeb_Step_sys_Subsystem_Reference_AEB_Function_Run_AsyEvlrCritEve_Step_Func_Run_AsyEvlrCritEve_Step_Func_TAWrapper_PreProcessor_ObjectPreProcessor_ObjectPreProcessorLoop_ValidObject_SafetyMarginFrontObjects_InPathCalculationWithPredictedObjPositions_CreateInPathDataTTM_CalculateAccelerationAndPredictPosition_CircularPrediction_AccelerationCalculationAndCircularPredictionOfTurningObjAtTTR "autosar_swc_aeb/autosar_swc_aeb_Step_sys/Subsystem Reference/AEB Function/Run_AsyEvlrCritEve_Step_Func/Run_AsyEvlrCritEve_Step_Func/TAWrapper/PreProcessor/ObjectPreProcessor/ObjectPreProcessorLoop/ValidObject/SafetyMarginFrontObjects/InPathCalculationWithPredictedObjPositions/CreateInPathDataTTM/CalculateAccelerationAndPredictPosition/CircularPrediction/AccelerationCalculationAndCircularPredictionOfTurningObjAtTTR"
 /begin SUB_GROUP autosar_swc_aeb_autosar_swc_aeb_Step_sys_Subsystem_Reference_AEB_Function_Run_AsyEvlrCritEve_Step_Func_Run_AsyEvlrCritEve_Step_Func_TAWrapper_PreProcessor_ObjectPreProcessor_ObjectPreProcessorLoop_ValidObject_SafetyMarginFrontObjects_InPathCalculationWithPredictedObjPositions_CreateInPathDataTTM_CalculateAccelerationAndPredictPosition_CircularPrediction_AccelerationCalculationAndCircularPredictionOfTurningObjAtTTR_CalculateCurvature autosar_swc_aeb_autosar_swc_aeb_Step_sys_Subsystem_Reference_AEB_Function_Run_AsyEvlrCritEve_Step_Func_Run_AsyEvlrCritEve_Step_Func_TAWrapper_PreProcessor_ObjectPreProcessor_ObjectPreProcessorLoop_ValidObject_SafetyMarginFrontObjects_InPathCalculationWithPredictedObjPositions_CreateInPathDataTTM_CalculateAccelerationAndPredictPosition_CircularPrediction_AccelerationCalculationAndCircularPredictionOfTurningObjAtTTR_ComputeCartesianMovement autosar_swc_aeb_autosar_swc_aeb_Step_sys_Subsystem_Reference_AEB_Function_Run_AsyEvlrCritEve_Step_Func_Run_AsyEvlrCritEve_Step_Func_TAWrapper_PreProcessor_ObjectPreProcessor_ObjectPreProcessorLoop_ValidObject_SafetyMarginFrontObjects_InPathCalculationWithPredictedObjPositions_CreateInPathDataTTM_CalculateAccelerationAndPredictPosition_CircularPrediction_AccelerationCalculationAndCircularPredictionOfTurningObjAtTTR_NoOperation autosar_swc_aeb_autosar_swc_aeb_Step_sys_Subsystem_Reference_AEB_Function_Run_AsyEvlrCritEve_Step_Func_Run_AsyEvlrCritEve_Step_Func_TAWrapper_PreProcessor_ObjectPreProcessor_ObjectPreProcessorLoop_ValidObject_SafetyMarginFrontObjects_InPathCalculationWithPredictedObjPositions_CreateInPathDataTTM_CalculateAccelerationAndPredictPosition_CircularPrediction_AccelerationCalculationAndCircularPredictionOfTurningObjAtTTR_NoOperation1 autosar_swc_aeb_autosar_swc_aeb_Step_sys_Subsystem_Reference_AEB_Function_Run_AsyEvlrCritEve_Step_Func_Run_AsyEvlrCritEve_Step_Func_TAWrapper_PreProcessor_ObjectPreProcessor_ObjectPreProcessorLoop_ValidObject_SafetyMarginFrontObjects_InPathCalculationWithPredictedObjPositions_CreateInPathDataTTM_CalculateAccelerationAndPredictPosition_CircularPrediction_AccelerationCalculationAndCircularPredictionOfTurningObjAtTTR_PredictedPositionAtTimeHeadingAngleAndCurvatureBased /end SUB_GROUP
 /begin REF_MEASUREMENT autosar_swc_aeb_rtARID_DEF.VLatObj_ja0 autosar_swc_aeb_rtARID_DEF.VLgtObj_foi /end REF_MEASUREMENT
/end GROUP
/begin GROUP autosar_swc_aeb_autosar_swc_aeb_Step_sys_Subsystem_Reference_AEB_Function_Run_AsyEvlrCritEve_Step_Func_Run_AsyEvlrCritEve_Step_Func_TAWrapper_PreProcessor_ObjectPreProcessor_ObjectPreProcessorLoop_ValidObject_SafetyMarginFrontObjects_InPathCalculationWithPredictedObjPositions_CreateInPathDataTTM_CalculateAccelerationAndPredictPosition_CircularPrediction_AccelerationCalculationAndCircularPredictionOfTurningObjAtTTR1 "autosar_swc_aeb/autosar_swc_aeb_Step_sys/Subsystem Reference/AEB Function/Run_AsyEvlrCritEve_Step_Func/Run_AsyEvlrCritEve_Step_Func/TAWrapper/PreProcessor/ObjectPreProcessor/ObjectPreProcessorLoop/ValidObject/SafetyMarginFrontObjects/InPathCalculationWithPredictedObjPositions/CreateInPathDataTTM/CalculateAccelerationAndPredictPosition/CircularPrediction/AccelerationCalculationAndCircularPredictionOfTurningObjAtTTR1"
 /begin SUB_GROUP autosar_swc_aeb_autosar_swc_aeb_Step_sys_Subsystem_Reference_AEB_Function_Run_AsyEvlrCritEve_Step_Func_Run_AsyEvlrCritEve_Step_Func_TAWrapper_PreProcessor_ObjectPreProcessor_ObjectPreProcessorLoop_ValidObject_SafetyMarginFrontObjects_InPathCalculationWithPredictedObjPositions_CreateInPathDataTTM_CalculateAccelerationAndPredictPosition_CircularPrediction_AccelerationCalculationAndCircularPredictionOfTurningObjAtTTR1_CalculateCurvature autosar_swc_aeb_autosar_swc_aeb_Step_sys_Subsystem_Reference_AEB_Function_Run_AsyEvlrCritEve_Step_Func_Run_AsyEvlrCritEve_Step_Func_TAWrapper_PreProcessor_ObjectPreProcessor_ObjectPreProcessorLoop_ValidObject_SafetyMarginFrontObjects_InPathCalculationWithPredictedObjPositions_CreateInPathDataTTM_CalculateAccelerationAndPredictPosition_CircularPrediction_AccelerationCalculationAndCircularPredictionOfTurningObjAtTTR1_ComputeCartesianMovement autosar_swc_aeb_autosar_swc_aeb_Step_sys_Subsystem_Reference_AEB_Function_Run_AsyEvlrCritEve_Step_Func_Run_AsyEvlrCritEve_Step_Func_TAWrapper_PreProcessor_ObjectPreProcessor_ObjectPreProcessorLoop_ValidObject_SafetyMarginFrontObjects_InPathCalculationWithPredictedObjPositions_CreateInPathDataTTM_CalculateAccelerationAndPredictPosition_CircularPrediction_AccelerationCalculationAndCircularPredictionOfTurningObjAtTTR1_NoOperation autosar_swc_aeb_autosar_swc_aeb_Step_sys_Subsystem_Reference_AEB_Function_Run_AsyEvlrCritEve_Step_Func_Run_AsyEvlrCritEve_Step_Func_TAWrapper_PreProcessor_ObjectPreProcessor_ObjectPreProcessorLoop_ValidObject_SafetyMarginFrontObjects_InPathCalculationWithPredictedObjPositions_CreateInPathDataTTM_CalculateAccelerationAndPredictPosition_CircularPrediction_AccelerationCalculationAndCircularPredictionOfTurningObjAtTTR1_NoOperation1 autosar_swc_aeb_autosar_swc_aeb_Step_sys_Subsystem_Reference_AEB_Function_Run_AsyEvlrCritEve_Step_Func_Run_AsyEvlrCritEve_Step_Func_TAWrapper_PreProcessor_ObjectPreProcessor_ObjectPreProcessorLoop_ValidObject_SafetyMarginFrontObjects_InPathCalculationWithPredictedObjPositions_CreateInPathDataTTM_CalculateAccelerationAndPredictPosition_CircularPrediction_AccelerationCalculationAndCircularPredictionOfTurningObjAtTTR1_PredictedPositionAtTimeHeadingAngleAndCurvatureBased /end SUB_GROUP
 /begin REF_MEASUREMENT autosar_swc_aeb_rtARID_DEF.VLatObj_ja0h autosar_swc_aeb_rtARID_DEF.VLgtObj_foij /end REF_MEASUREMENT
/end GROUP
/begin GROUP autosar_swc_aeb_autosar_swc_aeb_Step_sys_Subsystem_Reference_AEB_Function_Run_AsyEvlrCritEve_Step_Func_Run_AsyEvlrCritEve_Step_Func_TAWrapper_PreProcessor_ObjectPreProcessor_ObjectPreProcessorLoop_ValidObject_SafetyMarginFrontObjects_InPathCalculationWithPredictedObjPositions_CreateInPathDataTTM_CalculateAccelerationAndPredictPosition_CircularPrediction_AccelerationCalculationAndCircularPredictionOfTurningObjAtTTR1_ComputeCartesianMovement "autosar_swc_aeb/autosar_swc_aeb_Step_sys/Subsystem Reference/AEB Function/Run_AsyEvlrCritEve_Step_Func/Run_AsyEvlrCritEve_Step_Func/TAWrapper/PreProcessor/ObjectPreProcessor/ObjectPreProcessorLoop/ValidObject/SafetyMarginFrontObjects/InPathCalculationWithPredictedObjPositions/CreateInPathDataTTM/CalculateAccelerationAndPredictPosition/CircularPrediction/AccelerationCalculationAndCircularPredictionOfTurningObjAtTTR1/ComputeCartesianMovement"
 /begin REF_MEASUREMENT autosar_swc_aeb_rtARID_DEF.ALatObj_onh autosar_swc_aeb_rtARID_DEF.ALgtObj_cmo /end REF_MEASUREMENT
/end GROUP
/begin GROUP autosar_swc_aeb_autosar_swc_aeb_Step_sys_Subsystem_Reference_AEB_Function_Run_AsyEvlrCritEve_Step_Func_Run_AsyEvlrCritEve_Step_Func_TAWrapper_PreProcessor_ObjectPreProcessor_ObjectPreProcessorLoop_ValidObject_SafetyMarginFrontObjects_InPathCalculationWithPredictedObjPositions_CreateInPathDataTTM_CalculateAccelerationAndPredictPosition_CircularPrediction_AccelerationCalculationAndCircularPredictionOfTurningObjAtTTR1_NoOperation "autosar_swc_aeb/autosar_swc_aeb_Step_sys/Subsystem Reference/AEB Function/Run_AsyEvlrCritEve_Step_Func/Run_AsyEvlrCritEve_Step_Func/TAWrapper/PreProcessor/ObjectPreProcessor/ObjectPreProcessorLoop/ValidObject/SafetyMarginFrontObjects/InPathCalculationWithPredictedObjPositions/CreateInPathDataTTM/CalculateAccelerationAndPredictPosition/CircularPrediction/AccelerationCalculationAndCircularPredictionOfTurningObjAtTTR1/NoOperation" /begin REF_MEASUREMENT autosar_swc_aeb_rtARID_DEF.HeadingObj_mhzx /end REF_MEASUREMENT /end GROUP
/begin GROUP autosar_swc_aeb_autosar_swc_aeb_Step_sys_Subsystem_Reference_AEB_Function_Run_AsyEvlrCritEve_Step_Func_Run_AsyEvlrCritEve_Step_Func_TAWrapper_PreProcessor_ObjectPreProcessor_ObjectPreProcessorLoop_ValidObject_SafetyMarginFrontObjects_InPathCalculationWithPredictedObjPositions_CreateInPathDataTTM_CalculateAccelerationAndPredictPosition_CircularPrediction_AccelerationCalculationAndCircularPredictionOfTurningObjAtTTR1_NoOperation1 "autosar_swc_aeb/autosar_swc_aeb_Step_sys/Subsystem Reference/AEB Function/Run_AsyEvlrCritEve_Step_Func/Run_AsyEvlrCritEve_Step_Func/TAWrapper/PreProcessor/ObjectPreProcessor/ObjectPreProcessorLoop/ValidObject/SafetyMarginFrontObjects/InPathCalculationWithPredictedObjPositions/CreateInPathDataTTM/CalculateAccelerationAndPredictPosition/CircularPrediction/AccelerationCalculationAndCircularPredictionOfTurningObjAtTTR1/NoOperation1" /begin REF_MEASUREMENT autosar_swc_aeb_rtARID_DEF.CrvtObj_lk /end REF_MEASUREMENT /end GROUP
/begin GROUP autosar_swc_aeb_autosar_swc_aeb_Step_sys_Subsystem_Reference_AEB_Function_Run_AsyEvlrCritEve_Step_Func_Run_AsyEvlrCritEve_Step_Func_TAWrapper_PreProcessor_ObjectPreProcessor_ObjectPreProcessorLoop_ValidObject_SafetyMarginFrontObjects_InPathCalculationWithPredictedObjPositions_CreateInPathDataTTM_CalculateAccelerationAndPredictPosition_CircularPrediction_AccelerationCalculationAndCircularPredictionOfTurningObjAtTTR1_PredictedPositionAtTimeHeadingAngleAndCurvatureBased "autosar_swc_aeb/autosar_swc_aeb_Step_sys/Subsystem Reference/AEB Function/Run_AsyEvlrCritEve_Step_Func/Run_AsyEvlrCritEve_Step_Func/TAWrapper/PreProcessor/ObjectPreProcessor/ObjectPreProcessorLoop/ValidObject/SafetyMarginFrontObjects/InPathCalculationWithPredictedObjPositions/CreateInPathDataTTM/CalculateAccelerationAndPredictPosition/CircularPrediction/AccelerationCalculationAndCircularPredictionOfTurningObjAtTTR1/PredictedPositionAtTimeHeadingAngleAndCurvatureBased"
 /begin REF_MEASUREMENT autosar_swc_aeb_rtARID_DEF.PosnLatObj_p3hk autosar_swc_aeb_rtARID_DEF.PosnLgtObj_o0e3 /end REF_MEASUREMENT
/end GROUP
/begin GROUP autosar_swc_aeb_autosar_swc_aeb_Step_sys_Subsystem_Reference_AEB_Function_Run_AsyEvlrCritEve_Step_Func_Run_AsyEvlrCritEve_Step_Func_TAWrapper_PreProcessor_ObjectPreProcessor_ObjectPreProcessorLoop_ValidObject_SafetyMarginFrontObjects_InPathCalculationWithPredictedObjPositions_CreateInPathDataTTM_CalculateAccelerationAndPredictPosition_CircularPrediction_AccelerationCalculationAndCircularPredictionOfTurningObjAtTTR_ComputeCartesianMovement "autosar_swc_aeb/autosar_swc_aeb_Step_sys/Subsystem Reference/AEB Function/Run_AsyEvlrCritEve_Step_Func/Run_AsyEvlrCritEve_Step_Func/TAWrapper/PreProcessor/ObjectPreProcessor/ObjectPreProcessorLoop/ValidObject/SafetyMarginFrontObjects/InPathCalculationWithPredictedObjPositions/CreateInPathDataTTM/CalculateAccelerationAndPredictPosition/CircularPrediction/AccelerationCalculationAndCircularPredictionOfTurningObjAtTTR/ComputeCartesianMovement"
 /begin REF_MEASUREMENT autosar_swc_aeb_rtARID_DEF.ALatObj_on autosar_swc_aeb_rtARID_DEF.ALgtObj_cm /end REF_MEASUREMENT
/end GROUP
/begin GROUP autosar_swc_aeb_autosar_swc_aeb_Step_sys_Subsystem_Reference_AEB_Function_Run_AsyEvlrCritEve_Step_Func_Run_AsyEvlrCritEve_Step_Func_TAWrapper_PreProcessor_ObjectPreProcessor_ObjectPreProcessorLoop_ValidObject_SafetyMarginFrontObjects_InPathCalculationWithPredictedObjPositions_CreateInPathDataTTM_CalculateAccelerationAndPredictPosition_CircularPrediction_AccelerationCalculationAndCircularPredictionOfTurningObjAtTTR_NoOperation "autosar_swc_aeb/autosar_swc_aeb_Step_sys/Subsystem Reference/AEB Function/Run_AsyEvlrCritEve_Step_Func/Run_AsyEvlrCritEve_Step_Func/TAWrapper/PreProcessor/ObjectPreProcessor/ObjectPreProcessorLoop/ValidObject/SafetyMarginFrontObjects/InPathCalculationWithPredictedObjPositions/CreateInPathDataTTM/CalculateAccelerationAndPredictPosition/CircularPrediction/AccelerationCalculationAndCircularPredictionOfTurningObjAtTTR/NoOperation" /begin REF_MEASUREMENT autosar_swc_aeb_rtARID_DEF.HeadingObj_mhz /end REF_MEASUREMENT /end GROUP
/begin GROUP autosar_swc_aeb_autosar_swc_aeb_Step_sys_Subsystem_Reference_AEB_Function_Run_AsyEvlrCritEve_Step_Func_Run_AsyEvlrCritEve_Step_Func_TAWrapper_PreProcessor_ObjectPreProcessor_ObjectPreProcessorLoop_ValidObject_SafetyMarginFrontObjects_InPathCalculationWithPredictedObjPositions_CreateInPathDataTTM_CalculateAccelerationAndPredictPosition_LinearPrediction_AccelerationCalculationAndLinearPredictionOfBrakingObjAtTTR1_LinearMovementPredictorWithStopDetection1_LinearMovementPredictor "autosar_swc_aeb/autosar_swc_aeb_Step_sys/Subsystem Reference/AEB Function/Run_AsyEvlrCritEve_Step_Func/Run_AsyEvlrCritEve_Step_Func/TAWrapper/PreProcessor/ObjectPreProcessor/ObjectPreProcessorLoop/ValidObject/SafetyMarginFrontObjects/InPathCalculationWithPredictedObjPositions/CreateInPathDataTTM/CalculateAccelerationAndPredictPosition/LinearPrediction/AccelerationCalculationAndLinearPredictionOfBrakingObjAtTTR1/LinearMovementPredictorWithStopDetection1/LinearMovementPredictor" /begin REF_MEASUREMENT autosar_swc_aeb_rtARID_DEF.PosnLatObj_p3hko /end REF_MEASUREMENT /end GROUP
/begin GROUP autosar_swc_aeb_autosar_swc_aeb_Step_sys_Subsystem_Reference_AEB_Function_Run_AsyEvlrCritEve_Step_Func_Run_AsyEvlrCritEve_Step_Func_TAWrapper_PreProcessor_ObjectPreProcessor_ObjectPreProcessorLoop_ValidObject_SafetyMarginFrontObjects_InPathCalculationWithPredictedObjPositions_CreateInPathDataTTM_CalculateAccelerationAndPredictPosition_LinearPrediction_AccelerationCalculationAndLinearPredictionOfBrakingObjAtTTR1_LinearMovementPredictorWithStopDetection_LinearMovementPredictor "autosar_swc_aeb/autosar_swc_aeb_Step_sys/Subsystem Reference/AEB Function/Run_AsyEvlrCritEve_Step_Func/Run_AsyEvlrCritEve_Step_Func/TAWrapper/PreProcessor/ObjectPreProcessor/ObjectPreProcessorLoop/ValidObject/SafetyMarginFrontObjects/InPathCalculationWithPredictedObjPositions/CreateInPathDataTTM/CalculateAccelerationAndPredictPosition/LinearPrediction/AccelerationCalculationAndLinearPredictionOfBrakingObjAtTTR1/LinearMovementPredictorWithStopDetection/LinearMovementPredictor" /begin REF_MEASUREMENT autosar_swc_aeb_rtARID_DEF.PosnLgtObj_o0e3h /end REF_MEASUREMENT /end GROUP
/begin GROUP autosar_swc_aeb_autosar_swc_aeb_Step_sys_Subsystem_Reference_AEB_Function_Run_AsyEvlrCritEve_Step_Func_Run_AsyEvlrCritEve_Step_Func_TAWrapper_PreProcessor_ObjectPreProcessor_ObjectPreProcessorLoop_ValidObject_SafetyMarginFrontObjects_InPathCalculationWithPredictedObjPositions_CreateInPathDataTTM_CalculateAccelerationAndPredictPosition_LinearPrediction_AccelerationCalculationAndLinearPredictionOfBrakingObjAtTTR1_NoOperation1 "autosar_swc_aeb/autosar_swc_aeb_Step_sys/Subsystem Reference/AEB Function/Run_AsyEvlrCritEve_Step_Func/Run_AsyEvlrCritEve_Step_Func/TAWrapper/PreProcessor/ObjectPreProcessor/ObjectPreProcessorLoop/ValidObject/SafetyMarginFrontObjects/InPathCalculationWithPredictedObjPositions/CreateInPathDataTTM/CalculateAccelerationAndPredictPosition/LinearPrediction/AccelerationCalculationAndLinearPredictionOfBrakingObjAtTTR1/NoOperation1" /begin REF_MEASUREMENT autosar_swc_aeb_rtARID_DEF.VLgtObj_fo /end REF_MEASUREMENT /end GROUP
/begin GROUP autosar_swc_aeb_autosar_swc_aeb_Step_sys_Subsystem_Reference_AEB_Function_Run_AsyEvlrCritEve_Step_Func_Run_AsyEvlrCritEve_Step_Func_TAWrapper_PreProcessor_ObjectPreProcessor_ObjectPreProcessorLoop_ValidObject_SafetyMarginFrontObjects_InPathCalculationWithPredictedObjPositions_CreateInPathDataTTM_CalculateAccelerationAndPredictPosition_LinearPrediction_AccelerationCalculationAndLinearPredictionOfBrakingObjAtTTR1_NoOperation2 "autosar_swc_aeb/autosar_swc_aeb_Step_sys/Subsystem Reference/AEB Function/Run_AsyEvlrCritEve_Step_Func/Run_AsyEvlrCritEve_Step_Func/TAWrapper/PreProcessor/ObjectPreProcessor/ObjectPreProcessorLoop/ValidObject/SafetyMarginFrontObjects/InPathCalculationWithPredictedObjPositions/CreateInPathDataTTM/CalculateAccelerationAndPredictPosition/LinearPrediction/AccelerationCalculationAndLinearPredictionOfBrakingObjAtTTR1/NoOperation2" /begin REF_MEASUREMENT autosar_swc_aeb_rtARID_DEF.VLatObj_ja /end REF_MEASUREMENT /end GROUP
/begin GROUP autosar_swc_aeb_autosar_swc_aeb_Step_sys_Subsystem_Reference_AEB_Function_Run_AsyEvlrCritEve_Step_Func_Run_AsyEvlrCritEve_Step_Func_TAWrapper_PreProcessor_ObjectPreProcessor_ObjectPreProcessorLoop_ValidObject_SafetyMarginFrontObjects_InPathCalculationWithPredictedObjPositions_CreateInPathDataTTM_CalculateAccelerationAndPredictPosition_LinearPrediction_AccelerationCalculationAndLinearPredictionOfBrakingObjAtTTR1_NoOperation3 "autosar_swc_aeb/autosar_swc_aeb_Step_sys/Subsystem Reference/AEB Function/Run_AsyEvlrCritEve_Step_Func/Run_AsyEvlrCritEve_Step_Func/TAWrapper/PreProcessor/ObjectPreProcessor/ObjectPreProcessorLoop/ValidObject/SafetyMarginFrontObjects/InPathCalculationWithPredictedObjPositions/CreateInPathDataTTM/CalculateAccelerationAndPredictPosition/LinearPrediction/AccelerationCalculationAndLinearPredictionOfBrakingObjAtTTR1/NoOperation3" /begin REF_MEASUREMENT autosar_swc_aeb_rtARID_DEF.ALgtObj_cmoa /end REF_MEASUREMENT /end GROUP
/begin GROUP autosar_swc_aeb_autosar_swc_aeb_Step_sys_Subsystem_Reference_AEB_Function_Run_AsyEvlrCritEve_Step_Func_Run_AsyEvlrCritEve_Step_Func_TAWrapper_PreProcessor_ObjectPreProcessor_ObjectPreProcessorLoop_ValidObject_SafetyMarginFrontObjects_InPathCalculationWithPredictedObjPositions_CreateInPathDataTTM_CalculateAccelerationAndPredictPosition_LinearPrediction_AccelerationCalculationAndLinearPredictionOfBrakingObjAtTTR1_NoOperation4 "autosar_swc_aeb/autosar_swc_aeb_Step_sys/Subsystem Reference/AEB Function/Run_AsyEvlrCritEve_Step_Func/Run_AsyEvlrCritEve_Step_Func/TAWrapper/PreProcessor/ObjectPreProcessor/ObjectPreProcessorLoop/ValidObject/SafetyMarginFrontObjects/InPathCalculationWithPredictedObjPositions/CreateInPathDataTTM/CalculateAccelerationAndPredictPosition/LinearPrediction/AccelerationCalculationAndLinearPredictionOfBrakingObjAtTTR1/NoOperation4" /begin REF_MEASUREMENT autosar_swc_aeb_rtARID_DEF.ALatObj_onhu /end REF_MEASUREMENT /end GROUP
/begin GROUP autosar_swc_aeb_autosar_swc_aeb_Step_sys_Subsystem_Reference_AEB_Function_Run_AsyEvlrCritEve_Step_Func_Run_AsyEvlrCritEve_Step_Func_TAWrapper_PreProcessor_ObjectPreProcessor_ObjectPreProcessorLoop_ValidObject_SafetyMarginFrontObjects_InPathCalculationWithPredictedObjPositions_CreateInPathDataTTM_CalculateAccelerationAndPredictPosition_LinearPrediction_AccelerationCalculationAndLinearPredictionOfBrakingObjAtTTR1_NoOperation5 "autosar_swc_aeb/autosar_swc_aeb_Step_sys/Subsystem Reference/AEB Function/Run_AsyEvlrCritEve_Step_Func/Run_AsyEvlrCritEve_Step_Func/TAWrapper/PreProcessor/ObjectPreProcessor/ObjectPreProcessorLoop/ValidObject/SafetyMarginFrontObjects/InPathCalculationWithPredictedObjPositions/CreateInPathDataTTM/CalculateAccelerationAndPredictPosition/LinearPrediction/AccelerationCalculationAndLinearPredictionOfBrakingObjAtTTR1/NoOperation5" /begin REF_MEASUREMENT autosar_swc_aeb_rtARID_DEF.HeadingObj_mhzxn /end REF_MEASUREMENT /end GROUP
/begin GROUP autosar_swc_aeb_autosar_swc_aeb_Step_sys_Subsystem_Reference_AEB_Function_Run_AsyEvlrCritEve_Step_Func_Run_AsyEvlrCritEve_Step_Func_TAWrapper_PreProcessor_ObjectPreProcessor_ObjectPreProcessorLoop_ValidObject_SafetyMarginFrontObjects_InPathCalculationWithPredictedObjPositions_CreateInPathDataTTM_CalculateAccelerationAndPredictPosition_LinearPrediction_AccelerationCalculationAndLinearPredictionOfBrakingObjAtTTR_LinearMovementPredictorWithStopDetection1_LinearMovementPredictor "autosar_swc_aeb/autosar_swc_aeb_Step_sys/Subsystem Reference/AEB Function/Run_AsyEvlrCritEve_Step_Func/Run_AsyEvlrCritEve_Step_Func/TAWrapper/PreProcessor/ObjectPreProcessor/ObjectPreProcessorLoop/ValidObject/SafetyMarginFrontObjects/InPathCalculationWithPredictedObjPositions/CreateInPathDataTTM/CalculateAccelerationAndPredictPosition/LinearPrediction/AccelerationCalculationAndLinearPredictionOfBrakingObjAtTTR/LinearMovementPredictorWithStopDetection1/LinearMovementPredictor" /begin REF_MEASUREMENT autosar_swc_aeb_rtARID_DEF.PosnLatObj_p3 /end REF_MEASUREMENT /end GROUP
/begin GROUP autosar_swc_aeb_autosar_swc_aeb_Step_sys_Subsystem_Reference_AEB_Function_Run_AsyEvlrCritEve_Step_Func_Run_AsyEvlrCritEve_Step_Func_TAWrapper_PreProcessor_ObjectPreProcessor_ObjectPreProcessorLoop_ValidObject_SafetyMarginFrontObjects_InPathCalculationWithPredictedObjPositions_CreateInPathDataTTM_CalculateAccelerationAndPredictPosition_LinearPrediction_AccelerationCalculationAndLinearPredictionOfBrakingObjAtTTR_LinearMovementPredictorWithStopDetection_LinearMovementPredictor "autosar_swc_aeb/autosar_swc_aeb_Step_sys/Subsystem Reference/AEB Function/Run_AsyEvlrCritEve_Step_Func/Run_AsyEvlrCritEve_Step_Func/TAWrapper/PreProcessor/ObjectPreProcessor/ObjectPreProcessorLoop/ValidObject/SafetyMarginFrontObjects/InPathCalculationWithPredictedObjPositions/CreateInPathDataTTM/CalculateAccelerationAndPredictPosition/LinearPrediction/AccelerationCalculationAndLinearPredictionOfBrakingObjAtTTR/LinearMovementPredictorWithStopDetection/LinearMovementPredictor" /begin REF_MEASUREMENT autosar_swc_aeb_rtARID_DEF.PosnLgtObj_o0 /end REF_MEASUREMENT /end GROUP
/begin GROUP autosar_swc_aeb_autosar_swc_aeb_Step_sys_Subsystem_Reference_AEB_Function_Run_AsyEvlrCritEve_Step_Func_Run_AsyEvlrCritEve_Step_Func_TAWrapper_PreProcessor_ObjectPreProcessor_ObjectPreProcessorLoop_ValidObject_SafetyMarginFrontObjects_InPathCalculationWithPredictedObjPositions_CreateInPathDataTTM_CalculateAccelerationAndPredictPosition_LinearPrediction_AccelerationCalculationAndLinearPredictionOfBrakingObjAtTTR_NoOperation1 "autosar_swc_aeb/autosar_swc_aeb_Step_sys/Subsystem Reference/AEB Function/Run_AsyEvlrCritEve_Step_Func/Run_AsyEvlrCritEve_Step_Func/TAWrapper/PreProcessor/ObjectPreProcessor/ObjectPreProcessorLoop/ValidObject/SafetyMarginFrontObjects/InPathCalculationWithPredictedObjPositions/CreateInPathDataTTM/CalculateAccelerationAndPredictPosition/LinearPrediction/AccelerationCalculationAndLinearPredictionOfBrakingObjAtTTR/NoOperation1" /begin REF_MEASUREMENT autosar_swc_aeb_rtARID_DEF.VLgtObj_foijp /end REF_MEASUREMENT /end GROUP
/begin GROUP autosar_swc_aeb_autosar_swc_aeb_Step_sys_Subsystem_Reference_AEB_Function_Run_AsyEvlrCritEve_Step_Func_Run_AsyEvlrCritEve_Step_Func_TAWrapper_PreProcessor_ObjectPreProcessor_ObjectPreProcessorLoop_ValidObject_SafetyMarginFrontObjects_InPathCalculationWithPredictedObjPositions_CreateInPathDataTTM_CalculateAccelerationAndPredictPosition_LinearPrediction_AccelerationCalculationAndLinearPredictionOfBrakingObjAtTTR_NoOperation2 "autosar_swc_aeb/autosar_swc_aeb_Step_sys/Subsystem Reference/AEB Function/Run_AsyEvlrCritEve_Step_Func/Run_AsyEvlrCritEve_Step_Func/TAWrapper/PreProcessor/ObjectPreProcessor/ObjectPreProcessorLoop/ValidObject/SafetyMarginFrontObjects/InPathCalculationWithPredictedObjPositions/CreateInPathDataTTM/CalculateAccelerationAndPredictPosition/LinearPrediction/AccelerationCalculationAndLinearPredictionOfBrakingObjAtTTR/NoOperation2" /begin REF_MEASUREMENT autosar_swc_aeb_rtARID_DEF.VLatObj_ja0hf /end REF_MEASUREMENT /end GROUP
/begin GROUP autosar_swc_aeb_autosar_swc_aeb_Step_sys_Subsystem_Reference_AEB_Function_Run_AsyEvlrCritEve_Step_Func_Run_AsyEvlrCritEve_Step_Func_TAWrapper_PreProcessor_ObjectPreProcessor_ObjectPreProcessorLoop_ValidObject_SafetyMarginFrontObjects_InPathCalculationWithPredictedObjPositions_CreateInPathDataTTM_CalculateAccelerationAndPredictPosition_LinearPrediction_AccelerationCalculationAndLinearPredictionOfBrakingObjAtTTR_NoOperation3 "autosar_swc_aeb/autosar_swc_aeb_Step_sys/Subsystem Reference/AEB Function/Run_AsyEvlrCritEve_Step_Func/Run_AsyEvlrCritEve_Step_Func/TAWrapper/PreProcessor/ObjectPreProcessor/ObjectPreProcessorLoop/ValidObject/SafetyMarginFrontObjects/InPathCalculationWithPredictedObjPositions/CreateInPathDataTTM/CalculateAccelerationAndPredictPosition/LinearPrediction/AccelerationCalculationAndLinearPredictionOfBrakingObjAtTTR/NoOperation3" /begin REF_MEASUREMENT autosar_swc_aeb_rtARID_DEF.ALgtObj_c /end REF_MEASUREMENT /end GROUP
/begin GROUP autosar_swc_aeb_autosar_swc_aeb_Step_sys_Subsystem_Reference_AEB_Function_Run_AsyEvlrCritEve_Step_Func_Run_AsyEvlrCritEve_Step_Func_TAWrapper_PreProcessor_ObjectPreProcessor_ObjectPreProcessorLoop_ValidObject_SafetyMarginFrontObjects_InPathCalculationWithPredictedObjPositions_CreateInPathDataTTM_CalculateAccelerationAndPredictPosition_LinearPrediction_AccelerationCalculationAndLinearPredictionOfBrakingObjAtTTR_NoOperation4 "autosar_swc_aeb/autosar_swc_aeb_Step_sys/Subsystem Reference/AEB Function/Run_AsyEvlrCritEve_Step_Func/Run_AsyEvlrCritEve_Step_Func/TAWrapper/PreProcessor/ObjectPreProcessor/ObjectPreProcessorLoop/ValidObject/SafetyMarginFrontObjects/InPathCalculationWithPredictedObjPositions/CreateInPathDataTTM/CalculateAccelerationAndPredictPosition/LinearPrediction/AccelerationCalculationAndLinearPredictionOfBrakingObjAtTTR/NoOperation4" /begin REF_MEASUREMENT autosar_swc_aeb_rtARID_DEF.ALatObj_o /end REF_MEASUREMENT /end GROUP
/begin GROUP autosar_swc_aeb_autosar_swc_aeb_Step_sys_Subsystem_Reference_AEB_Function_Run_AsyEvlrCritEve_Step_Func_Run_AsyEvlrCritEve_Step_Func_TAWrapper_PreProcessor_ObjectPreProcessor_ObjectPreProcessorLoop_ValidObject_SafetyMarginFrontObjects_InPathCalculationWithPredictedObjPositions_CreateInPathDataTTM_CalculateAccelerationAndPredictPosition_LinearPrediction_AccelerationCalculationAndLinearPredictionOfBrakingObjAtTTR_NoOperation5 "autosar_swc_aeb/autosar_swc_aeb_Step_sys/Subsystem Reference/AEB Function/Run_AsyEvlrCritEve_Step_Func/Run_AsyEvlrCritEve_Step_Func/TAWrapper/PreProcessor/ObjectPreProcessor/ObjectPreProcessorLoop/ValidObject/SafetyMarginFrontObjects/InPathCalculationWithPredictedObjPositions/CreateInPathDataTTM/CalculateAccelerationAndPredictPosition/LinearPrediction/AccelerationCalculationAndLinearPredictionOfBrakingObjAtTTR/NoOperation5" /begin REF_MEASUREMENT autosar_swc_aeb_rtARID_DEF.HeadingObj_mh /end REF_MEASUREMENT /end GROUP
/begin GROUP autosar_swc_aeb_autosar_swc_aeb_Step_sys_Subsystem_Reference_AEB_Function_Run_AsyEvlrCritEve_Step_Func_Run_AsyEvlrCritEve_Step_Func_TAWrapper_PreProcessor_ObjectPreProcessor_ObjectPreProcessorLoop_ValidObject_SafetyMarginFrontObjects_InPathCalculationWithPredictedObjPositions_CreateInPathDataTTM_CalculateAccelerationAndPredictPosition_LinearPrediction_AccelerationCalculationAndLinearPredictionOfTurningObjAtTTR1 "autosar_swc_aeb/autosar_swc_aeb_Step_sys/Subsystem Reference/AEB Function/Run_AsyEvlrCritEve_Step_Func/Run_AsyEvlrCritEve_Step_Func/TAWrapper/PreProcessor/ObjectPreProcessor/ObjectPreProcessorLoop/ValidObject/SafetyMarginFrontObjects/InPathCalculationWithPredictedObjPositions/CreateInPathDataTTM/CalculateAccelerationAndPredictPosition/LinearPrediction/AccelerationCalculationAndLinearPredictionOfTurningObjAtTTR1"
 /begin REF_MEASUREMENT autosar_swc_aeb_rtARID_DEF.PosnLatObj_p3hk autosar_swc_aeb_rtARID_DEF.PosnLgtObj_o0e3 /end REF_MEASUREMENT
/end GROUP
/begin GROUP autosar_swc_aeb_autosar_swc_aeb_Step_sys_Subsystem_Reference_AEB_Function_Run_AsyEvlrCritEve_Step_Func_Run_AsyEvlrCritEve_Step_Func_TAWrapper_PreProcessor_ObjectPreProcessor_ObjectPreProcessorLoop_ValidObject_SafetyMarginFrontObjects_InPathCalculationWithPredictedObjPositions_CreateInPathDataTTM_CalculateAccelerationAndPredictPosition_LinearPrediction_AccelerationCalculationAndLinearPredictionOfTurningObjAtTTR1_NoOperation "autosar_swc_aeb/autosar_swc_aeb_Step_sys/Subsystem Reference/AEB Function/Run_AsyEvlrCritEve_Step_Func/Run_AsyEvlrCritEve_Step_Func/TAWrapper/PreProcessor/ObjectPreProcessor/ObjectPreProcessorLoop/ValidObject/SafetyMarginFrontObjects/InPathCalculationWithPredictedObjPositions/CreateInPathDataTTM/CalculateAccelerationAndPredictPosition/LinearPrediction/AccelerationCalculationAndLinearPredictionOfTurningObjAtTTR1/NoOperation" /begin REF_MEASUREMENT autosar_swc_aeb_rtARID_DEF.VLgtObj_foij /end REF_MEASUREMENT /end GROUP
/begin GROUP autosar_swc_aeb_autosar_swc_aeb_Step_sys_Subsystem_Reference_AEB_Function_Run_AsyEvlrCritEve_Step_Func_Run_AsyEvlrCritEve_Step_Func_TAWrapper_PreProcessor_ObjectPreProcessor_ObjectPreProcessorLoop_ValidObject_SafetyMarginFrontObjects_InPathCalculationWithPredictedObjPositions_CreateInPathDataTTM_CalculateAccelerationAndPredictPosition_LinearPrediction_AccelerationCalculationAndLinearPredictionOfTurningObjAtTTR1_NoOperation1 "autosar_swc_aeb/autosar_swc_aeb_Step_sys/Subsystem Reference/AEB Function/Run_AsyEvlrCritEve_Step_Func/Run_AsyEvlrCritEve_Step_Func/TAWrapper/PreProcessor/ObjectPreProcessor/ObjectPreProcessorLoop/ValidObject/SafetyMarginFrontObjects/InPathCalculationWithPredictedObjPositions/CreateInPathDataTTM/CalculateAccelerationAndPredictPosition/LinearPrediction/AccelerationCalculationAndLinearPredictionOfTurningObjAtTTR1/NoOperation1" /begin REF_MEASUREMENT autosar_swc_aeb_rtARID_DEF.VLatObj_ja0h /end REF_MEASUREMENT /end GROUP
/begin GROUP autosar_swc_aeb_autosar_swc_aeb_Step_sys_Subsystem_Reference_AEB_Function_Run_AsyEvlrCritEve_Step_Func_Run_AsyEvlrCritEve_Step_Func_TAWrapper_PreProcessor_ObjectPreProcessor_ObjectPreProcessorLoop_ValidObject_SafetyMarginFrontObjects_InPathCalculationWithPredictedObjPositions_CreateInPathDataTTM_CalculateAccelerationAndPredictPosition_LinearPrediction_AccelerationCalculationAndLinearPredictionOfTurningObjAtTTR1_NoOperation2 "autosar_swc_aeb/autosar_swc_aeb_Step_sys/Subsystem Reference/AEB Function/Run_AsyEvlrCritEve_Step_Func/Run_AsyEvlrCritEve_Step_Func/TAWrapper/PreProcessor/ObjectPreProcessor/ObjectPreProcessorLoop/ValidObject/SafetyMarginFrontObjects/InPathCalculationWithPredictedObjPositions/CreateInPathDataTTM/CalculateAccelerationAndPredictPosition/LinearPrediction/AccelerationCalculationAndLinearPredictionOfTurningObjAtTTR1/NoOperation2" /begin REF_MEASUREMENT autosar_swc_aeb_rtARID_DEF.CrvtObj_lk /end REF_MEASUREMENT /end GROUP
/begin GROUP autosar_swc_aeb_autosar_swc_aeb_Step_sys_Subsystem_Reference_AEB_Function_Run_AsyEvlrCritEve_Step_Func_Run_AsyEvlrCritEve_Step_Func_TAWrapper_PreProcessor_ObjectPreProcessor_ObjectPreProcessorLoop_ValidObject_SafetyMarginFrontObjects_InPathCalculationWithPredictedObjPositions_CreateInPathDataTTM_CalculateAccelerationAndPredictPosition_LinearPrediction_AccelerationCalculationAndLinearPredictionOfTurningObjAtTTR1_NoOperation3 "autosar_swc_aeb/autosar_swc_aeb_Step_sys/Subsystem Reference/AEB Function/Run_AsyEvlrCritEve_Step_Func/Run_AsyEvlrCritEve_Step_Func/TAWrapper/PreProcessor/ObjectPreProcessor/ObjectPreProcessorLoop/ValidObject/SafetyMarginFrontObjects/InPathCalculationWithPredictedObjPositions/CreateInPathDataTTM/CalculateAccelerationAndPredictPosition/LinearPrediction/AccelerationCalculationAndLinearPredictionOfTurningObjAtTTR1/NoOperation3" /begin REF_MEASUREMENT autosar_swc_aeb_rtARID_DEF.ALatObj_onh /end REF_MEASUREMENT /end GROUP
/begin GROUP autosar_swc_aeb_autosar_swc_aeb_Step_sys_Subsystem_Reference_AEB_Function_Run_AsyEvlrCritEve_Step_Func_Run_AsyEvlrCritEve_Step_Func_TAWrapper_PreProcessor_ObjectPreProcessor_ObjectPreProcessorLoop_ValidObject_SafetyMarginFrontObjects_InPathCalculationWithPredictedObjPositions_CreateInPathDataTTM_CalculateAccelerationAndPredictPosition_LinearPrediction_AccelerationCalculationAndLinearPredictionOfTurningObjAtTTR1_NoOperation4 "autosar_swc_aeb/autosar_swc_aeb_Step_sys/Subsystem Reference/AEB Function/Run_AsyEvlrCritEve_Step_Func/Run_AsyEvlrCritEve_Step_Func/TAWrapper/PreProcessor/ObjectPreProcessor/ObjectPreProcessorLoop/ValidObject/SafetyMarginFrontObjects/InPathCalculationWithPredictedObjPositions/CreateInPathDataTTM/CalculateAccelerationAndPredictPosition/LinearPrediction/AccelerationCalculationAndLinearPredictionOfTurningObjAtTTR1/NoOperation4" /begin REF_MEASUREMENT autosar_swc_aeb_rtARID_DEF.ALgtObj_cmo /end REF_MEASUREMENT /end GROUP
/begin GROUP autosar_swc_aeb_autosar_swc_aeb_Step_sys_Subsystem_Reference_AEB_Function_Run_AsyEvlrCritEve_Step_Func_Run_AsyEvlrCritEve_Step_Func_TAWrapper_PreProcessor_ObjectPreProcessor_ObjectPreProcessorLoop_ValidObject_SafetyMarginFrontObjects_InPathCalculationWithPredictedObjPositions_CreateInPathDataTTM_CalculateAccelerationAndPredictPosition_LinearPrediction_AccelerationCalculationAndLinearPredictionOfTurningObjAtTTR1_NoOperation5 "autosar_swc_aeb/autosar_swc_aeb_Step_sys/Subsystem Reference/AEB Function/Run_AsyEvlrCritEve_Step_Func/Run_AsyEvlrCritEve_Step_Func/TAWrapper/PreProcessor/ObjectPreProcessor/ObjectPreProcessorLoop/ValidObject/SafetyMarginFrontObjects/InPathCalculationWithPredictedObjPositions/CreateInPathDataTTM/CalculateAccelerationAndPredictPosition/LinearPrediction/AccelerationCalculationAndLinearPredictionOfTurningObjAtTTR1/NoOperation5" /begin REF_MEASUREMENT autosar_swc_aeb_rtARID_DEF.HeadingObj_mhzx /end REF_MEASUREMENT /end GROUP
/begin GROUP autosar_swc_aeb_autosar_swc_aeb_Step_sys_Subsystem_Reference_AEB_Function_Run_AsyEvlrCritEve_Step_Func_Run_AsyEvlrCritEve_Step_Func_TAWrapper_PreProcessor_ObjectPreProcessor_ObjectPreProcessorLoop_ValidObject_SafetyMarginFrontObjects_InPathCalculationWithPredictedObjPositions_CreateInPathDataTTM_CalculateAccelerationAndPredictPosition_LinearPrediction_AccelerationCalculationAndLinearPredictionOfTurningObjAtTTR_NoOperation "autosar_swc_aeb/autosar_swc_aeb_Step_sys/Subsystem Reference/AEB Function/Run_AsyEvlrCritEve_Step_Func/Run_AsyEvlrCritEve_Step_Func/TAWrapper/PreProcessor/ObjectPreProcessor/ObjectPreProcessorLoop/ValidObject/SafetyMarginFrontObjects/InPathCalculationWithPredictedObjPositions/CreateInPathDataTTM/CalculateAccelerationAndPredictPosition/LinearPrediction/AccelerationCalculationAndLinearPredictionOfTurningObjAtTTR/NoOperation" /begin REF_MEASUREMENT autosar_swc_aeb_rtARID_DEF.VLgtObj_foi /end REF_MEASUREMENT /end GROUP
/begin GROUP autosar_swc_aeb_autosar_swc_aeb_Step_sys_Subsystem_Reference_AEB_Function_Run_AsyEvlrCritEve_Step_Func_Run_AsyEvlrCritEve_Step_Func_TAWrapper_PreProcessor_ObjectPreProcessor_ObjectPreProcessorLoop_ValidObject_SafetyMarginFrontObjects_InPathCalculationWithPredictedObjPositions_CreateInPathDataTTM_CalculateAccelerationAndPredictPosition_LinearPrediction_AccelerationCalculationAndLinearPredictionOfTurningObjAtTTR_NoOperation1 "autosar_swc_aeb/autosar_swc_aeb_Step_sys/Subsystem Reference/AEB Function/Run_AsyEvlrCritEve_Step_Func/Run_AsyEvlrCritEve_Step_Func/TAWrapper/PreProcessor/ObjectPreProcessor/ObjectPreProcessorLoop/ValidObject/SafetyMarginFrontObjects/InPathCalculationWithPredictedObjPositions/CreateInPathDataTTM/CalculateAccelerationAndPredictPosition/LinearPrediction/AccelerationCalculationAndLinearPredictionOfTurningObjAtTTR/NoOperation1" /begin REF_MEASUREMENT autosar_swc_aeb_rtARID_DEF.VLatObj_ja0 /end REF_MEASUREMENT /end GROUP
/begin GROUP autosar_swc_aeb_autosar_swc_aeb_Step_sys_Subsystem_Reference_AEB_Function_Run_AsyEvlrCritEve_Step_Func_Run_AsyEvlrCritEve_Step_Func_TAWrapper_PreProcessor_ObjectPreProcessor_ObjectPreProcessorLoop_ValidObject_SafetyMarginFrontObjects_InPathCalculationWithPredictedObjPositions_CreateInPathDataTTM_CalculateAccelerationAndPredictPosition_LinearPrediction_AccelerationCalculationAndLinearPredictionOfTurningObjAtTTR_NoOperation3 "autosar_swc_aeb/autosar_swc_aeb_Step_sys/Subsystem Reference/AEB Function/Run_AsyEvlrCritEve_Step_Func/Run_AsyEvlrCritEve_Step_Func/TAWrapper/PreProcessor/ObjectPreProcessor/ObjectPreProcessorLoop/ValidObject/SafetyMarginFrontObjects/InPathCalculationWithPredictedObjPositions/CreateInPathDataTTM/CalculateAccelerationAndPredictPosition/LinearPrediction/AccelerationCalculationAndLinearPredictionOfTurningObjAtTTR/NoOperation3" /begin REF_MEASUREMENT autosar_swc_aeb_rtARID_DEF.ALatObj_on /end REF_MEASUREMENT /end GROUP
/begin GROUP autosar_swc_aeb_autosar_swc_aeb_Step_sys_Subsystem_Reference_AEB_Function_Run_AsyEvlrCritEve_Step_Func_Run_AsyEvlrCritEve_Step_Func_TAWrapper_PreProcessor_ObjectPreProcessor_ObjectPreProcessorLoop_ValidObject_SafetyMarginFrontObjects_InPathCalculationWithPredictedObjPositions_CreateInPathDataTTM_CalculateAccelerationAndPredictPosition_LinearPrediction_AccelerationCalculationAndLinearPredictionOfTurningObjAtTTR_NoOperation4 "autosar_swc_aeb/autosar_swc_aeb_Step_sys/Subsystem Reference/AEB Function/Run_AsyEvlrCritEve_Step_Func/Run_AsyEvlrCritEve_Step_Func/TAWrapper/PreProcessor/ObjectPreProcessor/ObjectPreProcessorLoop/ValidObject/SafetyMarginFrontObjects/InPathCalculationWithPredictedObjPositions/CreateInPathDataTTM/CalculateAccelerationAndPredictPosition/LinearPrediction/AccelerationCalculationAndLinearPredictionOfTurningObjAtTTR/NoOperation4" /begin REF_MEASUREMENT autosar_swc_aeb_rtARID_DEF.ALgtObj_cm /end REF_MEASUREMENT /end GROUP
/begin GROUP autosar_swc_aeb_autosar_swc_aeb_Step_sys_Subsystem_Reference_AEB_Function_Run_AsyEvlrCritEve_Step_Func_Run_AsyEvlrCritEve_Step_Func_TAWrapper_PreProcessor_ObjectPreProcessor_ObjectPreProcessorLoop_ValidObject_SafetyMarginFrontObjects_InPathCalculationWithPredictedObjPositions_CreateInPathDataTTM_CalculateAccelerationAndPredictPosition_LinearPrediction_AccelerationCalculationAndLinearPredictionOfTurningObjAtTTR_NoOperation5 "autosar_swc_aeb/autosar_swc_aeb_Step_sys/Subsystem Reference/AEB Function/Run_AsyEvlrCritEve_Step_Func/Run_AsyEvlrCritEve_Step_Func/TAWrapper/PreProcessor/ObjectPreProcessor/ObjectPreProcessorLoop/ValidObject/SafetyMarginFrontObjects/InPathCalculationWithPredictedObjPositions/CreateInPathDataTTM/CalculateAccelerationAndPredictPosition/LinearPrediction/AccelerationCalculationAndLinearPredictionOfTurningObjAtTTR/NoOperation5" /begin REF_MEASUREMENT autosar_swc_aeb_rtARID_DEF.HeadingObj_mhz /end REF_MEASUREMENT /end GROUP
/begin GROUP autosar_swc_aeb_autosar_swc_aeb_Step_sys_Subsystem_Reference_AEB_Function_Run_AsyEvlrCritEve_Step_Func_Run_AsyEvlrCritEve_Step_Func_TAWrapper_PreProcessor_ObjectPreProcessor_ObjectPreProcessorLoop_ValidObject_SafetyMarginFrontObjects_InPathCalculationWithPredictedObjPositions_CreateInPathDataTTM_CalculateAccelerationAndPredictPosition_NoPrediction_NoOperation10 "autosar_swc_aeb/autosar_swc_aeb_Step_sys/Subsystem Reference/AEB Function/Run_AsyEvlrCritEve_Step_Func/Run_AsyEvlrCritEve_Step_Func/TAWrapper/PreProcessor/ObjectPreProcessor/ObjectPreProcessorLoop/ValidObject/SafetyMarginFrontObjects/InPathCalculationWithPredictedObjPositions/CreateInPathDataTTM/CalculateAccelerationAndPredictPosition/NoPrediction/NoOperation10" /begin REF_MEASUREMENT autosar_swc_aeb_rtARID_DEF.PosnLgtObj_o0e3h /end REF_MEASUREMENT /end GROUP
/begin GROUP autosar_swc_aeb_autosar_swc_aeb_Step_sys_Subsystem_Reference_AEB_Function_Run_AsyEvlrCritEve_Step_Func_Run_AsyEvlrCritEve_Step_Func_TAWrapper_PreProcessor_ObjectPreProcessor_ObjectPreProcessorLoop_ValidObject_SafetyMarginFrontObjects_InPathCalculationWithPredictedObjPositions_CreateInPathDataTTM_CalculateAccelerationAndPredictPosition_NoPrediction_NoOperation13 "autosar_swc_aeb/autosar_swc_aeb_Step_sys/Subsystem Reference/AEB Function/Run_AsyEvlrCritEve_Step_Func/Run_AsyEvlrCritEve_Step_Func/TAWrapper/PreProcessor/ObjectPreProcessor/ObjectPreProcessorLoop/ValidObject/SafetyMarginFrontObjects/InPathCalculationWithPredictedObjPositions/CreateInPathDataTTM/CalculateAccelerationAndPredictPosition/NoPrediction/NoOperation13" /begin REF_MEASUREMENT autosar_swc_aeb_rtARID_DEF.VLgtObj_foi /end REF_MEASUREMENT /end GROUP
/begin GROUP autosar_swc_aeb_autosar_swc_aeb_Step_sys_Subsystem_Reference_AEB_Function_Run_AsyEvlrCritEve_Step_Func_Run_AsyEvlrCritEve_Step_Func_TAWrapper_PreProcessor_ObjectPreProcessor_ObjectPreProcessorLoop_ValidObject_SafetyMarginFrontObjects_InPathCalculationWithPredictedObjPositions_CreateInPathDataTTM_CalculateAccelerationAndPredictPosition_NoPrediction_NoOperation14 "autosar_swc_aeb/autosar_swc_aeb_Step_sys/Subsystem Reference/AEB Function/Run_AsyEvlrCritEve_Step_Func/Run_AsyEvlrCritEve_Step_Func/TAWrapper/PreProcessor/ObjectPreProcessor/ObjectPreProcessorLoop/ValidObject/SafetyMarginFrontObjects/InPathCalculationWithPredictedObjPositions/CreateInPathDataTTM/CalculateAccelerationAndPredictPosition/NoPrediction/NoOperation14" /begin REF_MEASUREMENT autosar_swc_aeb_rtARID_DEF.VLatObj_ja0 /end REF_MEASUREMENT /end GROUP
/begin GROUP autosar_swc_aeb_autosar_swc_aeb_Step_sys_Subsystem_Reference_AEB_Function_Run_AsyEvlrCritEve_Step_Func_Run_AsyEvlrCritEve_Step_Func_TAWrapper_PreProcessor_ObjectPreProcessor_ObjectPreProcessorLoop_ValidObject_SafetyMarginFrontObjects_InPathCalculationWithPredictedObjPositions_CreateInPathDataTTM_CalculateAccelerationAndPredictPosition_NoPrediction_NoOperation15 "autosar_swc_aeb/autosar_swc_aeb_Step_sys/Subsystem Reference/AEB Function/Run_AsyEvlrCritEve_Step_Func/Run_AsyEvlrCritEve_Step_Func/TAWrapper/PreProcessor/ObjectPreProcessor/ObjectPreProcessorLoop/ValidObject/SafetyMarginFrontObjects/InPathCalculationWithPredictedObjPositions/CreateInPathDataTTM/CalculateAccelerationAndPredictPosition/NoPrediction/NoOperation15" /begin REF_MEASUREMENT autosar_swc_aeb_rtARID_DEF.ALgtObj_cm /end REF_MEASUREMENT /end GROUP
/begin GROUP autosar_swc_aeb_autosar_swc_aeb_Step_sys_Subsystem_Reference_AEB_Function_Run_AsyEvlrCritEve_Step_Func_Run_AsyEvlrCritEve_Step_Func_TAWrapper_PreProcessor_ObjectPreProcessor_ObjectPreProcessorLoop_ValidObject_SafetyMarginFrontObjects_InPathCalculationWithPredictedObjPositions_CreateInPathDataTTM_CalculateAccelerationAndPredictPosition_NoPrediction_NoOperation16 "autosar_swc_aeb/autosar_swc_aeb_Step_sys/Subsystem Reference/AEB Function/Run_AsyEvlrCritEve_Step_Func/Run_AsyEvlrCritEve_Step_Func/TAWrapper/PreProcessor/ObjectPreProcessor/ObjectPreProcessorLoop/ValidObject/SafetyMarginFrontObjects/InPathCalculationWithPredictedObjPositions/CreateInPathDataTTM/CalculateAccelerationAndPredictPosition/NoPrediction/NoOperation16" /begin REF_MEASUREMENT autosar_swc_aeb_rtARID_DEF.PosnLatObj_p3hko /end REF_MEASUREMENT /end GROUP
/begin GROUP autosar_swc_aeb_autosar_swc_aeb_Step_sys_Subsystem_Reference_AEB_Function_Run_AsyEvlrCritEve_Step_Func_Run_AsyEvlrCritEve_Step_Func_TAWrapper_PreProcessor_ObjectPreProcessor_ObjectPreProcessorLoop_ValidObject_SafetyMarginFrontObjects_InPathCalculationWithPredictedObjPositions_CreateInPathDataTTM_CalculateAccelerationAndPredictPosition_NoPrediction_NoOperation17 "autosar_swc_aeb/autosar_swc_aeb_Step_sys/Subsystem Reference/AEB Function/Run_AsyEvlrCritEve_Step_Func/Run_AsyEvlrCritEve_Step_Func/TAWrapper/PreProcessor/ObjectPreProcessor/ObjectPreProcessorLoop/ValidObject/SafetyMarginFrontObjects/InPathCalculationWithPredictedObjPositions/CreateInPathDataTTM/CalculateAccelerationAndPredictPosition/NoPrediction/NoOperation17" /begin REF_MEASUREMENT autosar_swc_aeb_rtARID_DEF.ALgtObj_c /end REF_MEASUREMENT /end GROUP
/begin GROUP autosar_swc_aeb_autosar_swc_aeb_Step_sys_Subsystem_Reference_AEB_Function_Run_AsyEvlrCritEve_Step_Func_Run_AsyEvlrCritEve_Step_Func_TAWrapper_PreProcessor_ObjectPreProcessor_ObjectPreProcessorLoop_ValidObject_SafetyMarginFrontObjects_InPathCalculationWithPredictedObjPositions_CreateInPathDataTTM_CalculateAccelerationAndPredictPosition_NoPrediction_NoOperation18 "autosar_swc_aeb/autosar_swc_aeb_Step_sys/Subsystem Reference/AEB Function/Run_AsyEvlrCritEve_Step_Func/Run_AsyEvlrCritEve_Step_Func/TAWrapper/PreProcessor/ObjectPreProcessor/ObjectPreProcessorLoop/ValidObject/SafetyMarginFrontObjects/InPathCalculationWithPredictedObjPositions/CreateInPathDataTTM/CalculateAccelerationAndPredictPosition/NoPrediction/NoOperation18" /begin REF_MEASUREMENT autosar_swc_aeb_rtARID_DEF.ALatObj_o /end REF_MEASUREMENT /end GROUP
/begin GROUP autosar_swc_aeb_autosar_swc_aeb_Step_sys_Subsystem_Reference_AEB_Function_Run_AsyEvlrCritEve_Step_Func_Run_AsyEvlrCritEve_Step_Func_TAWrapper_PreProcessor_ObjectPreProcessor_ObjectPreProcessorLoop_ValidObject_SafetyMarginFrontObjects_InPathCalculationWithPredictedObjPositions_CreateInPathDataTTM_CalculateAccelerationAndPredictPosition_NoPrediction_NoOperation19 "autosar_swc_aeb/autosar_swc_aeb_Step_sys/Subsystem Reference/AEB Function/Run_AsyEvlrCritEve_Step_Func/Run_AsyEvlrCritEve_Step_Func/TAWrapper/PreProcessor/ObjectPreProcessor/ObjectPreProcessorLoop/ValidObject/SafetyMarginFrontObjects/InPathCalculationWithPredictedObjPositions/CreateInPathDataTTM/CalculateAccelerationAndPredictPosition/NoPrediction/NoOperation19" /begin REF_MEASUREMENT autosar_swc_aeb_rtARID_DEF.ALatObj_on /end REF_MEASUREMENT /end GROUP
/begin GROUP autosar_swc_aeb_autosar_swc_aeb_Step_sys_Subsystem_Reference_AEB_Function_Run_AsyEvlrCritEve_Step_Func_Run_AsyEvlrCritEve_Step_Func_TAWrapper_PreProcessor_ObjectPreProcessor_ObjectPreProcessorLoop_ValidObject_SafetyMarginFrontObjects_InPathCalculationWithPredictedObjPositions_CreateInPathDataTTM_CalculateAccelerationAndPredictPosition_NoPrediction_NoOperation21 "autosar_swc_aeb/autosar_swc_aeb_Step_sys/Subsystem Reference/AEB Function/Run_AsyEvlrCritEve_Step_Func/Run_AsyEvlrCritEve_Step_Func/TAWrapper/PreProcessor/ObjectPreProcessor/ObjectPreProcessorLoop/ValidObject/SafetyMarginFrontObjects/InPathCalculationWithPredictedObjPositions/CreateInPathDataTTM/CalculateAccelerationAndPredictPosition/NoPrediction/NoOperation21" /begin REF_MEASUREMENT autosar_swc_aeb_rtARID_DEF.VLgtObj_fo /end REF_MEASUREMENT /end GROUP
/begin GROUP autosar_swc_aeb_autosar_swc_aeb_Step_sys_Subsystem_Reference_AEB_Function_Run_AsyEvlrCritEve_Step_Func_Run_AsyEvlrCritEve_Step_Func_TAWrapper_PreProcessor_ObjectPreProcessor_ObjectPreProcessorLoop_ValidObject_SafetyMarginFrontObjects_InPathCalculationWithPredictedObjPositions_CreateInPathDataTTM_CalculateAccelerationAndPredictPosition_NoPrediction_NoOperation22 "autosar_swc_aeb/autosar_swc_aeb_Step_sys/Subsystem Reference/AEB Function/Run_AsyEvlrCritEve_Step_Func/Run_AsyEvlrCritEve_Step_Func/TAWrapper/PreProcessor/ObjectPreProcessor/ObjectPreProcessorLoop/ValidObject/SafetyMarginFrontObjects/InPathCalculationWithPredictedObjPositions/CreateInPathDataTTM/CalculateAccelerationAndPredictPosition/NoPrediction/NoOperation22" /begin REF_MEASUREMENT autosar_swc_aeb_rtARID_DEF.HeadingObj_mh /end REF_MEASUREMENT /end GROUP
/begin GROUP autosar_swc_aeb_autosar_swc_aeb_Step_sys_Subsystem_Reference_AEB_Function_Run_AsyEvlrCritEve_Step_Func_Run_AsyEvlrCritEve_Step_Func_TAWrapper_PreProcessor_ObjectPreProcessor_ObjectPreProcessorLoop_ValidObject_SafetyMarginFrontObjects_InPathCalculationWithPredictedObjPositions_CreateInPathDataTTM_CalculateAccelerationAndPredictPosition_NoPrediction_NoOperation23 "autosar_swc_aeb/autosar_swc_aeb_Step_sys/Subsystem Reference/AEB Function/Run_AsyEvlrCritEve_Step_Func/Run_AsyEvlrCritEve_Step_Func/TAWrapper/PreProcessor/ObjectPreProcessor/ObjectPreProcessorLoop/ValidObject/SafetyMarginFrontObjects/InPathCalculationWithPredictedObjPositions/CreateInPathDataTTM/CalculateAccelerationAndPredictPosition/NoPrediction/NoOperation23" /begin REF_MEASUREMENT autosar_swc_aeb_rtARID_DEF.HeadingObj_mhz /end REF_MEASUREMENT /end GROUP
/begin GROUP autosar_swc_aeb_autosar_swc_aeb_Step_sys_Subsystem_Reference_AEB_Function_Run_AsyEvlrCritEve_Step_Func_Run_AsyEvlrCritEve_Step_Func_TAWrapper_PreProcessor_ObjectPreProcessor_ObjectPreProcessorLoop_ValidObject_SafetyMarginFrontObjects_InPathCalculationWithPredictedObjPositions_CreateInPathDataTTM_CalculateAccelerationAndPredictPosition_NoPrediction_NoOperation24 "autosar_swc_aeb/autosar_swc_aeb_Step_sys/Subsystem Reference/AEB Function/Run_AsyEvlrCritEve_Step_Func/Run_AsyEvlrCritEve_Step_Func/TAWrapper/PreProcessor/ObjectPreProcessor/ObjectPreProcessorLoop/ValidObject/SafetyMarginFrontObjects/InPathCalculationWithPredictedObjPositions/CreateInPathDataTTM/CalculateAccelerationAndPredictPosition/NoPrediction/NoOperation24" /begin REF_MEASUREMENT autosar_swc_aeb_rtARID_DEF.VLatObj_ja /end REF_MEASUREMENT /end GROUP
/begin GROUP autosar_swc_aeb_autosar_swc_aeb_Step_sys_Subsystem_Reference_AEB_Function_Run_AsyEvlrCritEve_Step_Func_Run_AsyEvlrCritEve_Step_Func_TAWrapper_PreProcessor_ObjectPreProcessor_ObjectPreProcessorLoop_ValidObject_SafetyMarginFrontObjects_InPathCalculationWithPredictedObjPositions_CreateInPathDataTTM_CalculateAccelerationAndPredictPosition_NoPrediction_NoOperation25 "autosar_swc_aeb/autosar_swc_aeb_Step_sys/Subsystem Reference/AEB Function/Run_AsyEvlrCritEve_Step_Func/Run_AsyEvlrCritEve_Step_Func/TAWrapper/PreProcessor/ObjectPreProcessor/ObjectPreProcessorLoop/ValidObject/SafetyMarginFrontObjects/InPathCalculationWithPredictedObjPositions/CreateInPathDataTTM/CalculateAccelerationAndPredictPosition/NoPrediction/NoOperation25" /begin REF_MEASUREMENT autosar_swc_aeb_rtARID_DEF.PosnLgtObj_o0e3 /end REF_MEASUREMENT /end GROUP
/begin GROUP autosar_swc_aeb_autosar_swc_aeb_Step_sys_Subsystem_Reference_AEB_Function_Run_AsyEvlrCritEve_Step_Func_Run_AsyEvlrCritEve_Step_Func_TAWrapper_PreProcessor_ObjectPreProcessor_ObjectPreProcessorLoop_ValidObject_SafetyMarginFrontObjects_InPathCalculationWithPredictedObjPositions_CreateInPathDataTTM_CalculateAccelerationAndPredictPosition_NoPrediction_NoOperation26 "autosar_swc_aeb/autosar_swc_aeb_Step_sys/Subsystem Reference/AEB Function/Run_AsyEvlrCritEve_Step_Func/Run_AsyEvlrCritEve_Step_Func/TAWrapper/PreProcessor/ObjectPreProcessor/ObjectPreProcessorLoop/ValidObject/SafetyMarginFrontObjects/InPathCalculationWithPredictedObjPositions/CreateInPathDataTTM/CalculateAccelerationAndPredictPosition/NoPrediction/NoOperation26" /begin REF_MEASUREMENT autosar_swc_aeb_rtARID_DEF.PosnLatObj_p3hk /end REF_MEASUREMENT /end GROUP
/begin GROUP autosar_swc_aeb_autosar_swc_aeb_Step_sys_Subsystem_Reference_AEB_Function_Run_AsyEvlrCritEve_Step_Func_Run_AsyEvlrCritEve_Step_Func_TAWrapper_PreProcessor_ObjectPreProcessor_ObjectPreProcessorLoop_ValidObject_SafetyMarginFrontObjects_InPathCalculationWithPredictedObjPositions_CreateInPathDataTTM_CalculateAccelerationAndPredictPosition_NoPrediction_NoOperation27 "autosar_swc_aeb/autosar_swc_aeb_Step_sys/Subsystem Reference/AEB Function/Run_AsyEvlrCritEve_Step_Func/Run_AsyEvlrCritEve_Step_Func/TAWrapper/PreProcessor/ObjectPreProcessor/ObjectPreProcessorLoop/ValidObject/SafetyMarginFrontObjects/InPathCalculationWithPredictedObjPositions/CreateInPathDataTTM/CalculateAccelerationAndPredictPosition/NoPrediction/NoOperation27" /begin REF_MEASUREMENT autosar_swc_aeb_rtARID_DEF.VLgtObj_foij /end REF_MEASUREMENT /end GROUP
/begin GROUP autosar_swc_aeb_autosar_swc_aeb_Step_sys_Subsystem_Reference_AEB_Function_Run_AsyEvlrCritEve_Step_Func_Run_AsyEvlrCritEve_Step_Func_TAWrapper_PreProcessor_ObjectPreProcessor_ObjectPreProcessorLoop_ValidObject_SafetyMarginFrontObjects_InPathCalculationWithPredictedObjPositions_CreateInPathDataTTM_CalculateAccelerationAndPredictPosition_NoPrediction_NoOperation28 "autosar_swc_aeb/autosar_swc_aeb_Step_sys/Subsystem Reference/AEB Function/Run_AsyEvlrCritEve_Step_Func/Run_AsyEvlrCritEve_Step_Func/TAWrapper/PreProcessor/ObjectPreProcessor/ObjectPreProcessorLoop/ValidObject/SafetyMarginFrontObjects/InPathCalculationWithPredictedObjPositions/CreateInPathDataTTM/CalculateAccelerationAndPredictPosition/NoPrediction/NoOperation28" /begin REF_MEASUREMENT autosar_swc_aeb_rtARID_DEF.VLatObj_ja0h /end REF_MEASUREMENT /end GROUP
/begin GROUP autosar_swc_aeb_autosar_swc_aeb_Step_sys_Subsystem_Reference_AEB_Function_Run_AsyEvlrCritEve_Step_Func_Run_AsyEvlrCritEve_Step_Func_TAWrapper_PreProcessor_ObjectPreProcessor_ObjectPreProcessorLoop_ValidObject_SafetyMarginFrontObjects_InPathCalculationWithPredictedObjPositions_CreateInPathDataTTM_CalculateAccelerationAndPredictPosition_NoPrediction_NoOperation29 "autosar_swc_aeb/autosar_swc_aeb_Step_sys/Subsystem Reference/AEB Function/Run_AsyEvlrCritEve_Step_Func/Run_AsyEvlrCritEve_Step_Func/TAWrapper/PreProcessor/ObjectPreProcessor/ObjectPreProcessorLoop/ValidObject/SafetyMarginFrontObjects/InPathCalculationWithPredictedObjPositions/CreateInPathDataTTM/CalculateAccelerationAndPredictPosition/NoPrediction/NoOperation29" /begin REF_MEASUREMENT autosar_swc_aeb_rtARID_DEF.HeadingObj_mhzx /end REF_MEASUREMENT /end GROUP
/begin GROUP autosar_swc_aeb_autosar_swc_aeb_Step_sys_Subsystem_Reference_AEB_Function_Run_AsyEvlrCritEve_Step_Func_Run_AsyEvlrCritEve_Step_Func_TAWrapper_PreProcessor_ObjectPreProcessor_ObjectPreProcessorLoop_ValidObject_SafetyMarginFrontObjects_InPathCalculationWithPredictedObjPositions_CreateInPathDataTTM_CalculateAccelerationAndPredictPosition_NoPrediction_NoOperation30 "autosar_swc_aeb/autosar_swc_aeb_Step_sys/Subsystem Reference/AEB Function/Run_AsyEvlrCritEve_Step_Func/Run_AsyEvlrCritEve_Step_Func/TAWrapper/PreProcessor/ObjectPreProcessor/ObjectPreProcessorLoop/ValidObject/SafetyMarginFrontObjects/InPathCalculationWithPredictedObjPositions/CreateInPathDataTTM/CalculateAccelerationAndPredictPosition/NoPrediction/NoOperation30" /begin REF_MEASUREMENT autosar_swc_aeb_rtARID_DEF.ALgtObj_cmoa /end REF_MEASUREMENT /end GROUP
/begin GROUP autosar_swc_aeb_autosar_swc_aeb_Step_sys_Subsystem_Reference_AEB_Function_Run_AsyEvlrCritEve_Step_Func_Run_AsyEvlrCritEve_Step_Func_TAWrapper_PreProcessor_ObjectPreProcessor_ObjectPreProcessorLoop_ValidObject_SafetyMarginFrontObjects_InPathCalculationWithPredictedObjPositions_CreateInPathDataTTM_CalculateAccelerationAndPredictPosition_NoPrediction_NoOperation31 "autosar_swc_aeb/autosar_swc_aeb_Step_sys/Subsystem Reference/AEB Function/Run_AsyEvlrCritEve_Step_Func/Run_AsyEvlrCritEve_Step_Func/TAWrapper/PreProcessor/ObjectPreProcessor/ObjectPreProcessorLoop/ValidObject/SafetyMarginFrontObjects/InPathCalculationWithPredictedObjPositions/CreateInPathDataTTM/CalculateAccelerationAndPredictPosition/NoPrediction/NoOperation31" /begin REF_MEASUREMENT autosar_swc_aeb_rtARID_DEF.ALatObj_onhu /end REF_MEASUREMENT /end GROUP
/begin GROUP autosar_swc_aeb_autosar_swc_aeb_Step_sys_Subsystem_Reference_AEB_Function_Run_AsyEvlrCritEve_Step_Func_Run_AsyEvlrCritEve_Step_Func_TAWrapper_PreProcessor_ObjectPreProcessor_ObjectPreProcessorLoop_ValidObject_SafetyMarginFrontObjects_InPathCalculationWithPredictedObjPositions_CreateInPathDataTTM_CalculateAccelerationAndPredictPosition_NoPrediction_NoOperation32 "autosar_swc_aeb/autosar_swc_aeb_Step_sys/Subsystem Reference/AEB Function/Run_AsyEvlrCritEve_Step_Func/Run_AsyEvlrCritEve_Step_Func/TAWrapper/PreProcessor/ObjectPreProcessor/ObjectPreProcessorLoop/ValidObject/SafetyMarginFrontObjects/InPathCalculationWithPredictedObjPositions/CreateInPathDataTTM/CalculateAccelerationAndPredictPosition/NoPrediction/NoOperation32" /begin REF_MEASUREMENT autosar_swc_aeb_rtARID_DEF.ALgtObj_cmo /end REF_MEASUREMENT /end GROUP
/begin GROUP autosar_swc_aeb_autosar_swc_aeb_Step_sys_Subsystem_Reference_AEB_Function_Run_AsyEvlrCritEve_Step_Func_Run_AsyEvlrCritEve_Step_Func_TAWrapper_PreProcessor_ObjectPreProcessor_ObjectPreProcessorLoop_ValidObject_SafetyMarginFrontObjects_InPathCalculationWithPredictedObjPositions_CreateInPathDataTTM_CalculateAccelerationAndPredictPosition_NoPrediction_NoOperation33 "autosar_swc_aeb/autosar_swc_aeb_Step_sys/Subsystem Reference/AEB Function/Run_AsyEvlrCritEve_Step_Func/Run_AsyEvlrCritEve_Step_Func/TAWrapper/PreProcessor/ObjectPreProcessor/ObjectPreProcessorLoop/ValidObject/SafetyMarginFrontObjects/InPathCalculationWithPredictedObjPositions/CreateInPathDataTTM/CalculateAccelerationAndPredictPosition/NoPrediction/NoOperation33" /begin REF_MEASUREMENT autosar_swc_aeb_rtARID_DEF.ALatObj_onh /end REF_MEASUREMENT /end GROUP
/begin GROUP autosar_swc_aeb_autosar_swc_aeb_Step_sys_Subsystem_Reference_AEB_Function_Run_AsyEvlrCritEve_Step_Func_Run_AsyEvlrCritEve_Step_Func_TAWrapper_PreProcessor_ObjectPreProcessor_ObjectPreProcessorLoop_ValidObject_SafetyMarginFrontObjects_InPathCalculationWithPredictedObjPositions_CreateInPathDataTTM_CalculateAccelerationAndPredictPosition_NoPrediction_NoOperation34 "autosar_swc_aeb/autosar_swc_aeb_Step_sys/Subsystem Reference/AEB Function/Run_AsyEvlrCritEve_Step_Func/Run_AsyEvlrCritEve_Step_Func/TAWrapper/PreProcessor/ObjectPreProcessor/ObjectPreProcessorLoop/ValidObject/SafetyMarginFrontObjects/InPathCalculationWithPredictedObjPositions/CreateInPathDataTTM/CalculateAccelerationAndPredictPosition/NoPrediction/NoOperation34" /begin REF_MEASUREMENT autosar_swc_aeb_rtARID_DEF.CrvtObj_lk /end REF_MEASUREMENT /end GROUP
/begin GROUP autosar_swc_aeb_autosar_swc_aeb_Step_sys_Subsystem_Reference_AEB_Function_Run_AsyEvlrCritEve_Step_Func_Run_AsyEvlrCritEve_Step_Func_TAWrapper_PreProcessor_ObjectPreProcessor_ObjectPreProcessorLoop_ValidObject_SafetyMarginFrontObjects_InPathCalculationWithPredictedObjPositions_CreateInPathDataTTM_CalculateAccelerationAndPredictPosition_NoPrediction_NoOperation4 "autosar_swc_aeb/autosar_swc_aeb_Step_sys/Subsystem Reference/AEB Function/Run_AsyEvlrCritEve_Step_Func/Run_AsyEvlrCritEve_Step_Func/TAWrapper/PreProcessor/ObjectPreProcessor/ObjectPreProcessorLoop/ValidObject/SafetyMarginFrontObjects/InPathCalculationWithPredictedObjPositions/CreateInPathDataTTM/CalculateAccelerationAndPredictPosition/NoPrediction/NoOperation4" /begin REF_MEASUREMENT autosar_swc_aeb_rtARID_DEF.HeadingObj_mhzxn /end REF_MEASUREMENT /end GROUP
/begin GROUP autosar_swc_aeb_autosar_swc_aeb_Step_sys_Subsystem_Reference_AEB_Function_Run_AsyEvlrCritEve_Step_Func_Run_AsyEvlrCritEve_Step_Func_TAWrapper_PreProcessor_ObjectPreProcessor_ObjectPreProcessorLoop_ValidObject_SafetyMarginFrontObjects_InPathCalculationWithPredictedObjPositions_CreateInPathDataTTM_CalculateAccelerationAndPredictPosition_NoPrediction_NoOperation5 "autosar_swc_aeb/autosar_swc_aeb_Step_sys/Subsystem Reference/AEB Function/Run_AsyEvlrCritEve_Step_Func/Run_AsyEvlrCritEve_Step_Func/TAWrapper/PreProcessor/ObjectPreProcessor/ObjectPreProcessorLoop/ValidObject/SafetyMarginFrontObjects/InPathCalculationWithPredictedObjPositions/CreateInPathDataTTM/CalculateAccelerationAndPredictPosition/NoPrediction/NoOperation5" /begin REF_MEASUREMENT autosar_swc_aeb_rtARID_DEF.PosnLgtObj_o0 /end REF_MEASUREMENT /end GROUP
/begin GROUP autosar_swc_aeb_autosar_swc_aeb_Step_sys_Subsystem_Reference_AEB_Function_Run_AsyEvlrCritEve_Step_Func_Run_AsyEvlrCritEve_Step_Func_TAWrapper_PreProcessor_ObjectPreProcessor_ObjectPreProcessorLoop_ValidObject_SafetyMarginFrontObjects_InPathCalculationWithPredictedObjPositions_CreateInPathDataTTM_CalculateAccelerationAndPredictPosition_NoPrediction_NoOperation6 "autosar_swc_aeb/autosar_swc_aeb_Step_sys/Subsystem Reference/AEB Function/Run_AsyEvlrCritEve_Step_Func/Run_AsyEvlrCritEve_Step_Func/TAWrapper/PreProcessor/ObjectPreProcessor/ObjectPreProcessorLoop/ValidObject/SafetyMarginFrontObjects/InPathCalculationWithPredictedObjPositions/CreateInPathDataTTM/CalculateAccelerationAndPredictPosition/NoPrediction/NoOperation6" /begin REF_MEASUREMENT autosar_swc_aeb_rtARID_DEF.PosnLatObj_p3 /end REF_MEASUREMENT /end GROUP
/begin GROUP autosar_swc_aeb_autosar_swc_aeb_Step_sys_Subsystem_Reference_AEB_Function_Run_AsyEvlrCritEve_Step_Func_Run_AsyEvlrCritEve_Step_Func_TAWrapper_PreProcessor_ObjectPreProcessor_ObjectPreProcessorLoop_ValidObject_SafetyMarginFrontObjects_InPathCalculationWithPredictedObjPositions_CreateInPathDataTTM_CalculateAccelerationAndPredictPosition_NoPrediction_NoOperation7 "autosar_swc_aeb/autosar_swc_aeb_Step_sys/Subsystem Reference/AEB Function/Run_AsyEvlrCritEve_Step_Func/Run_AsyEvlrCritEve_Step_Func/TAWrapper/PreProcessor/ObjectPreProcessor/ObjectPreProcessorLoop/ValidObject/SafetyMarginFrontObjects/InPathCalculationWithPredictedObjPositions/CreateInPathDataTTM/CalculateAccelerationAndPredictPosition/NoPrediction/NoOperation7" /begin REF_MEASUREMENT autosar_swc_aeb_rtARID_DEF.VLgtObj_foijp /end REF_MEASUREMENT /end GROUP
/begin GROUP autosar_swc_aeb_autosar_swc_aeb_Step_sys_Subsystem_Reference_AEB_Function_Run_AsyEvlrCritEve_Step_Func_Run_AsyEvlrCritEve_Step_Func_TAWrapper_PreProcessor_ObjectPreProcessor_ObjectPreProcessorLoop_ValidObject_SafetyMarginFrontObjects_InPathCalculationWithPredictedObjPositions_CreateInPathDataTTM_CalculateAccelerationAndPredictPosition_NoPrediction_NoOperation8 "autosar_swc_aeb/autosar_swc_aeb_Step_sys/Subsystem Reference/AEB Function/Run_AsyEvlrCritEve_Step_Func/Run_AsyEvlrCritEve_Step_Func/TAWrapper/PreProcessor/ObjectPreProcessor/ObjectPreProcessorLoop/ValidObject/SafetyMarginFrontObjects/InPathCalculationWithPredictedObjPositions/CreateInPathDataTTM/CalculateAccelerationAndPredictPosition/NoPrediction/NoOperation8" /begin REF_MEASUREMENT autosar_swc_aeb_rtARID_DEF.VLatObj_ja0hf /end REF_MEASUREMENT /end GROUP
/begin GROUP autosar_swc_aeb_autosar_swc_aeb_Step_sys_Subsystem_Reference_AEB_Function_Run_AsyEvlrCritEve_Step_Func_Run_AsyEvlrCritEve_Step_Func_TAWrapper_PreProcessor_ObjectPreProcessor_ObjectPreProcessorLoop_ValidObject_SafetyMarginFrontObjects_InPathCalculationWithPredictedObjPositions_CreateInPathDataTTM_CheckBrakingAndSteering_CheckIfObjectTriesToManoeuver "autosar_swc_aeb/autosar_swc_aeb_Step_sys/Subsystem Reference/AEB Function/Run_AsyEvlrCritEve_Step_Func/Run_AsyEvlrCritEve_Step_Func/TAWrapper/PreProcessor/ObjectPreProcessor/ObjectPreProcessorLoop/ValidObject/SafetyMarginFrontObjects/InPathCalculationWithPredictedObjPositions/CreateInPathDataTTM/CheckBrakingAndSteering/CheckIfObjectTriesToManoeuver" /begin REF_CHARACTERISTIC CLTS_AgDirForSteerMinInAsyEvlrCritEve_Ca /end REF_CHARACTERISTIC /end GROUP
/begin GROUP autosar_swc_aeb_autosar_swc_aeb_Step_sys_Subsystem_Reference_AEB_Function_Run_AsyEvlrCritEve_Step_Func_Run_AsyEvlrCritEve_Step_Func_TAWrapper_PreProcessor_ObjectPreProcessor_ObjectPreProcessorLoop_ValidObject_SafetyMarginFrontObjects_InPathCalculationWithPredictedObjPositions_CreateInPathDataTTM_CreateInPathData_DetermineInPathDataLongPredTime "autosar_swc_aeb/autosar_swc_aeb_Step_sys/Subsystem Reference/AEB Function/Run_AsyEvlrCritEve_Step_Func/Run_AsyEvlrCritEve_Step_Func/TAWrapper/PreProcessor/ObjectPreProcessor/ObjectPreProcessorLoop/ValidObject/SafetyMarginFrontObjects/InPathCalculationWithPredictedObjPositions/CreateInPathDataTTM/CreateInPathData/DetermineInPathDataLongPredTime"
 /begin REF_MEASUREMENT autosar_swc_aeb_rtARID_DEF.ALgtObj_c autosar_swc_aeb_rtARID_DEF.ALgtObj_cm autosar_swc_aeb_rtARID_DEF.ALgtObj_cmo /end REF_MEASUREMENT
/end GROUP
/begin GROUP autosar_swc_aeb_autosar_swc_aeb_Step_sys_Subsystem_Reference_AEB_Function_Run_AsyEvlrCritEve_Step_Func_Run_AsyEvlrCritEve_Step_Func_TAWrapper_PreProcessor_ObjectPreProcessor_ObjectPreProcessorLoop_ValidObject_SafetyMarginFrontObjects_InPathCalculationWithPredictedObjPositions_CreateInPathDataTTM_CreateInPathData_DetermineInPathDataLongPredTime_ObjectWillBrake_NoOperation_3 "autosar_swc_aeb/autosar_swc_aeb_Step_sys/Subsystem Reference/AEB Function/Run_AsyEvlrCritEve_Step_Func/Run_AsyEvlrCritEve_Step_Func/TAWrapper/PreProcessor/ObjectPreProcessor/ObjectPreProcessorLoop/ValidObject/SafetyMarginFrontObjects/InPathCalculationWithPredictedObjPositions/CreateInPathDataTTM/CreateInPathData/DetermineInPathDataLongPredTime/ObjectWillBrake/NoOperation_3" /begin REF_MEASUREMENT autosar_swc_aeb_rtARID_DEF.ALgtObj_c /end REF_MEASUREMENT /end GROUP
/begin GROUP autosar_swc_aeb_autosar_swc_aeb_Step_sys_Subsystem_Reference_AEB_Function_Run_AsyEvlrCritEve_Step_Func_Run_AsyEvlrCritEve_Step_Func_TAWrapper_PreProcessor_ObjectPreProcessor_ObjectPreProcessorLoop_ValidObject_SafetyMarginFrontObjects_InPathCalculationWithPredictedObjPositions_CreateInPathDataTTM_CreateInPathData_DetermineInPathDataLongPredTime_ObjectWillBrake_NoOperation_4 "autosar_swc_aeb/autosar_swc_aeb_Step_sys/Subsystem Reference/AEB Function/Run_AsyEvlrCritEve_Step_Func/Run_AsyEvlrCritEve_Step_Func/TAWrapper/PreProcessor/ObjectPreProcessor/ObjectPreProcessorLoop/ValidObject/SafetyMarginFrontObjects/InPathCalculationWithPredictedObjPositions/CreateInPathDataTTM/CreateInPathData/DetermineInPathDataLongPredTime/ObjectWillBrake/NoOperation_4" /begin REF_MEASUREMENT autosar_swc_aeb_rtARID_DEF.ALatObj_o /end REF_MEASUREMENT /end GROUP
/begin GROUP autosar_swc_aeb_autosar_swc_aeb_Step_sys_Subsystem_Reference_AEB_Function_Run_AsyEvlrCritEve_Step_Func_Run_AsyEvlrCritEve_Step_Func_TAWrapper_PreProcessor_ObjectPreProcessor_ObjectPreProcessorLoop_ValidObject_SafetyMarginFrontObjects_InPathCalculationWithPredictedObjPositions_CreateInPathDataTTM_CreateInPathData_DetermineInPathDataLongPredTime_ObjectWillSteerLeft_NoOperation_3 "autosar_swc_aeb/autosar_swc_aeb_Step_sys/Subsystem Reference/AEB Function/Run_AsyEvlrCritEve_Step_Func/Run_AsyEvlrCritEve_Step_Func/TAWrapper/PreProcessor/ObjectPreProcessor/ObjectPreProcessorLoop/ValidObject/SafetyMarginFrontObjects/InPathCalculationWithPredictedObjPositions/CreateInPathDataTTM/CreateInPathData/DetermineInPathDataLongPredTime/ObjectWillSteerLeft/NoOperation_3" /begin REF_MEASUREMENT autosar_swc_aeb_rtARID_DEF.ALgtObj_cm /end REF_MEASUREMENT /end GROUP
/begin GROUP autosar_swc_aeb_autosar_swc_aeb_Step_sys_Subsystem_Reference_AEB_Function_Run_AsyEvlrCritEve_Step_Func_Run_AsyEvlrCritEve_Step_Func_TAWrapper_PreProcessor_ObjectPreProcessor_ObjectPreProcessorLoop_ValidObject_SafetyMarginFrontObjects_InPathCalculationWithPredictedObjPositions_CreateInPathDataTTM_CreateInPathData_DetermineInPathDataLongPredTime_ObjectWillSteerLeft_NoOperation_4 "autosar_swc_aeb/autosar_swc_aeb_Step_sys/Subsystem Reference/AEB Function/Run_AsyEvlrCritEve_Step_Func/Run_AsyEvlrCritEve_Step_Func/TAWrapper/PreProcessor/ObjectPreProcessor/ObjectPreProcessorLoop/ValidObject/SafetyMarginFrontObjects/InPathCalculationWithPredictedObjPositions/CreateInPathDataTTM/CreateInPathData/DetermineInPathDataLongPredTime/ObjectWillSteerLeft/NoOperation_4" /begin REF_MEASUREMENT autosar_swc_aeb_rtARID_DEF.ALatObj_on /end REF_MEASUREMENT /end GROUP
/begin GROUP autosar_swc_aeb_autosar_swc_aeb_Step_sys_Subsystem_Reference_AEB_Function_Run_AsyEvlrCritEve_Step_Func_Run_AsyEvlrCritEve_Step_Func_TAWrapper_PreProcessor_ObjectPreProcessor_ObjectPreProcessorLoop_ValidObject_SafetyMarginFrontObjects_InPathCalculationWithPredictedObjPositions_CreateInPathDataTTM_CreateInPathData_DetermineInPathDataLongPredTime_ObjectWillSteerRight_NoOperation_1 "autosar_swc_aeb/autosar_swc_aeb_Step_sys/Subsystem Reference/AEB Function/Run_AsyEvlrCritEve_Step_Func/Run_AsyEvlrCritEve_Step_Func/TAWrapper/PreProcessor/ObjectPreProcessor/ObjectPreProcessorLoop/ValidObject/SafetyMarginFrontObjects/InPathCalculationWithPredictedObjPositions/CreateInPathDataTTM/CreateInPathData/DetermineInPathDataLongPredTime/ObjectWillSteerRight/NoOperation_1" /begin REF_MEASUREMENT autosar_swc_aeb_rtARID_DEF.CrvtObj_lk /end REF_MEASUREMENT /end GROUP
/begin GROUP autosar_swc_aeb_autosar_swc_aeb_Step_sys_Subsystem_Reference_AEB_Function_Run_AsyEvlrCritEve_Step_Func_Run_AsyEvlrCritEve_Step_Func_TAWrapper_PreProcessor_ObjectPreProcessor_ObjectPreProcessorLoop_ValidObject_SafetyMarginFrontObjects_InPathCalculationWithPredictedObjPositions_CreateInPathDataTTM_CreateInPathData_DetermineInPathDataLongPredTime_ObjectWillSteerRight_NoOperation_2 "autosar_swc_aeb/autosar_swc_aeb_Step_sys/Subsystem Reference/AEB Function/Run_AsyEvlrCritEve_Step_Func/Run_AsyEvlrCritEve_Step_Func/TAWrapper/PreProcessor/ObjectPreProcessor/ObjectPreProcessorLoop/ValidObject/SafetyMarginFrontObjects/InPathCalculationWithPredictedObjPositions/CreateInPathDataTTM/CreateInPathData/DetermineInPathDataLongPredTime/ObjectWillSteerRight/NoOperation_2" /begin REF_MEASUREMENT autosar_swc_aeb_rtARID_DEF.ALatObj_onh /end REF_MEASUREMENT /end GROUP
/begin GROUP autosar_swc_aeb_autosar_swc_aeb_Step_sys_Subsystem_Reference_AEB_Function_Run_AsyEvlrCritEve_Step_Func_Run_AsyEvlrCritEve_Step_Func_TAWrapper_PreProcessor_ObjectPreProcessor_ObjectPreProcessorLoop_ValidObject_SafetyMarginFrontObjects_InPathCalculationWithPredictedObjPositions_CreateInPathDataTTM_CreateInPathData_DetermineInPathDataLongPredTime_ObjectWillSteerRight_NoOperation_3 "autosar_swc_aeb/autosar_swc_aeb_Step_sys/Subsystem Reference/AEB Function/Run_AsyEvlrCritEve_Step_Func/Run_AsyEvlrCritEve_Step_Func/TAWrapper/PreProcessor/ObjectPreProcessor/ObjectPreProcessorLoop/ValidObject/SafetyMarginFrontObjects/InPathCalculationWithPredictedObjPositions/CreateInPathDataTTM/CreateInPathData/DetermineInPathDataLongPredTime/ObjectWillSteerRight/NoOperation_3" /begin REF_MEASUREMENT autosar_swc_aeb_rtARID_DEF.ALgtObj_cmo /end REF_MEASUREMENT /end GROUP
/begin GROUP autosar_swc_aeb_autosar_swc_aeb_Step_sys_Subsystem_Reference_AEB_Function_Run_AsyEvlrCritEve_Step_Func_Run_AsyEvlrCritEve_Step_Func_TAWrapper_PreProcessor_ObjectPreProcessor_ObjectPreProcessorLoop_ValidObject_SafetyMarginFrontObjects_InPathCalculationWithPredictedObjPositions_CreateInPathDataTTM_CreateInPathData_DetermineInPathDataShortPredTime "autosar_swc_aeb/autosar_swc_aeb_Step_sys/Subsystem Reference/AEB Function/Run_AsyEvlrCritEve_Step_Func/Run_AsyEvlrCritEve_Step_Func/TAWrapper/PreProcessor/ObjectPreProcessor/ObjectPreProcessorLoop/ValidObject/SafetyMarginFrontObjects/InPathCalculationWithPredictedObjPositions/CreateInPathDataTTM/CreateInPathData/DetermineInPathDataShortPredTime"
 /begin REF_MEASUREMENT autosar_swc_aeb_rtARID_DEF.ALgtObj_cm autosar_swc_aeb_rtARID_DEF.ALgtObj_cmo autosar_swc_aeb_rtARID_DEF.ALgtObj_cmoa /end REF_MEASUREMENT
/end GROUP
/begin GROUP autosar_swc_aeb_autosar_swc_aeb_Step_sys_Subsystem_Reference_AEB_Function_Run_AsyEvlrCritEve_Step_Func_Run_AsyEvlrCritEve_Step_Func_TAWrapper_PreProcessor_ObjectPreProcessor_ObjectPreProcessorLoop_ValidObject_SafetyMarginFrontObjects_InPathCalculationWithPredictedObjPositions_CreateInPathDataTTM_CreateInPathData_DetermineInPathDataShortPredTime_ObjectWillBrake_NoOperation_3 "autosar_swc_aeb/autosar_swc_aeb_Step_sys/Subsystem Reference/AEB Function/Run_AsyEvlrCritEve_Step_Func/Run_AsyEvlrCritEve_Step_Func/TAWrapper/PreProcessor/ObjectPreProcessor/ObjectPreProcessorLoop/ValidObject/SafetyMarginFrontObjects/InPathCalculationWithPredictedObjPositions/CreateInPathDataTTM/CreateInPathData/DetermineInPathDataShortPredTime/ObjectWillBrake/NoOperation_3" /begin REF_MEASUREMENT autosar_swc_aeb_rtARID_DEF.ALgtObj_cmoa /end REF_MEASUREMENT /end GROUP
/begin GROUP autosar_swc_aeb_autosar_swc_aeb_Step_sys_Subsystem_Reference_AEB_Function_Run_AsyEvlrCritEve_Step_Func_Run_AsyEvlrCritEve_Step_Func_TAWrapper_PreProcessor_ObjectPreProcessor_ObjectPreProcessorLoop_ValidObject_SafetyMarginFrontObjects_InPathCalculationWithPredictedObjPositions_CreateInPathDataTTM_CreateInPathData_DetermineInPathDataShortPredTime_ObjectWillBrake_NoOperation_4 "autosar_swc_aeb/autosar_swc_aeb_Step_sys/Subsystem Reference/AEB Function/Run_AsyEvlrCritEve_Step_Func/Run_AsyEvlrCritEve_Step_Func/TAWrapper/PreProcessor/ObjectPreProcessor/ObjectPreProcessorLoop/ValidObject/SafetyMarginFrontObjects/InPathCalculationWithPredictedObjPositions/CreateInPathDataTTM/CreateInPathData/DetermineInPathDataShortPredTime/ObjectWillBrake/NoOperation_4" /begin REF_MEASUREMENT autosar_swc_aeb_rtARID_DEF.ALatObj_onhu /end REF_MEASUREMENT /end GROUP
/begin GROUP autosar_swc_aeb_autosar_swc_aeb_Step_sys_Subsystem_Reference_AEB_Function_Run_AsyEvlrCritEve_Step_Func_Run_AsyEvlrCritEve_Step_Func_TAWrapper_PreProcessor_ObjectPreProcessor_ObjectPreProcessorLoop_ValidObject_SafetyMarginFrontObjects_InPathCalculationWithPredictedObjPositions_CreateInPathDataTTM_CreateInPathData_DetermineInPathDataShortPredTime_ObjectWillSteerLeft_NoOperation_3 "autosar_swc_aeb/autosar_swc_aeb_Step_sys/Subsystem Reference/AEB Function/Run_AsyEvlrCritEve_Step_Func/Run_AsyEvlrCritEve_Step_Func/TAWrapper/PreProcessor/ObjectPreProcessor/ObjectPreProcessorLoop/ValidObject/SafetyMarginFrontObjects/InPathCalculationWithPredictedObjPositions/CreateInPathDataTTM/CreateInPathData/DetermineInPathDataShortPredTime/ObjectWillSteerLeft/NoOperation_3" /begin REF_MEASUREMENT autosar_swc_aeb_rtARID_DEF.ALgtObj_cm /end REF_MEASUREMENT /end GROUP
/begin GROUP autosar_swc_aeb_autosar_swc_aeb_Step_sys_Subsystem_Reference_AEB_Function_Run_AsyEvlrCritEve_Step_Func_Run_AsyEvlrCritEve_Step_Func_TAWrapper_PreProcessor_ObjectPreProcessor_ObjectPreProcessorLoop_ValidObject_SafetyMarginFrontObjects_InPathCalculationWithPredictedObjPositions_CreateInPathDataTTM_CreateInPathData_DetermineInPathDataShortPredTime_ObjectWillSteerLeft_NoOperation_4 "autosar_swc_aeb/autosar_swc_aeb_Step_sys/Subsystem Reference/AEB Function/Run_AsyEvlrCritEve_Step_Func/Run_AsyEvlrCritEve_Step_Func/TAWrapper/PreProcessor/ObjectPreProcessor/ObjectPreProcessorLoop/ValidObject/SafetyMarginFrontObjects/InPathCalculationWithPredictedObjPositions/CreateInPathDataTTM/CreateInPathData/DetermineInPathDataShortPredTime/ObjectWillSteerLeft/NoOperation_4" /begin REF_MEASUREMENT autosar_swc_aeb_rtARID_DEF.ALatObj_on /end REF_MEASUREMENT /end GROUP
/begin GROUP autosar_swc_aeb_autosar_swc_aeb_Step_sys_Subsystem_Reference_AEB_Function_Run_AsyEvlrCritEve_Step_Func_Run_AsyEvlrCritEve_Step_Func_TAWrapper_PreProcessor_ObjectPreProcessor_ObjectPreProcessorLoop_ValidObject_SafetyMarginFrontObjects_InPathCalculationWithPredictedObjPositions_CreateInPathDataTTM_CreateInPathData_DetermineInPathDataShortPredTime_ObjectWillSteerRight_NoOperation_1 "autosar_swc_aeb/autosar_swc_aeb_Step_sys/Subsystem Reference/AEB Function/Run_AsyEvlrCritEve_Step_Func/Run_AsyEvlrCritEve_Step_Func/TAWrapper/PreProcessor/ObjectPreProcessor/ObjectPreProcessorLoop/ValidObject/SafetyMarginFrontObjects/InPathCalculationWithPredictedObjPositions/CreateInPathDataTTM/CreateInPathData/DetermineInPathDataShortPredTime/ObjectWillSteerRight/NoOperation_1" /begin REF_MEASUREMENT autosar_swc_aeb_rtARID_DEF.CrvtObj_lk /end REF_MEASUREMENT /end GROUP
/begin GROUP autosar_swc_aeb_autosar_swc_aeb_Step_sys_Subsystem_Reference_AEB_Function_Run_AsyEvlrCritEve_Step_Func_Run_AsyEvlrCritEve_Step_Func_TAWrapper_PreProcessor_ObjectPreProcessor_ObjectPreProcessorLoop_ValidObject_SafetyMarginFrontObjects_InPathCalculationWithPredictedObjPositions_CreateInPathDataTTM_CreateInPathData_DetermineInPathDataShortPredTime_ObjectWillSteerRight_NoOperation_2 "autosar_swc_aeb/autosar_swc_aeb_Step_sys/Subsystem Reference/AEB Function/Run_AsyEvlrCritEve_Step_Func/Run_AsyEvlrCritEve_Step_Func/TAWrapper/PreProcessor/ObjectPreProcessor/ObjectPreProcessorLoop/ValidObject/SafetyMarginFrontObjects/InPathCalculationWithPredictedObjPositions/CreateInPathDataTTM/CreateInPathData/DetermineInPathDataShortPredTime/ObjectWillSteerRight/NoOperation_2" /begin REF_MEASUREMENT autosar_swc_aeb_rtARID_DEF.ALatObj_onh /end REF_MEASUREMENT /end GROUP
/begin GROUP autosar_swc_aeb_autosar_swc_aeb_Step_sys_Subsystem_Reference_AEB_Function_Run_AsyEvlrCritEve_Step_Func_Run_AsyEvlrCritEve_Step_Func_TAWrapper_PreProcessor_ObjectPreProcessor_ObjectPreProcessorLoop_ValidObject_SafetyMarginFrontObjects_InPathCalculationWithPredictedObjPositions_CreateInPathDataTTM_CreateInPathData_DetermineInPathDataShortPredTime_ObjectWillSteerRight_NoOperation_3 "autosar_swc_aeb/autosar_swc_aeb_Step_sys/Subsystem Reference/AEB Function/Run_AsyEvlrCritEve_Step_Func/Run_AsyEvlrCritEve_Step_Func/TAWrapper/PreProcessor/ObjectPreProcessor/ObjectPreProcessorLoop/ValidObject/SafetyMarginFrontObjects/InPathCalculationWithPredictedObjPositions/CreateInPathDataTTM/CreateInPathData/DetermineInPathDataShortPredTime/ObjectWillSteerRight/NoOperation_3" /begin REF_MEASUREMENT autosar_swc_aeb_rtARID_DEF.ALgtObj_cmo /end REF_MEASUREMENT /end GROUP
/begin GROUP autosar_swc_aeb_autosar_swc_aeb_Step_sys_Subsystem_Reference_AEB_Function_Run_AsyEvlrCritEve_Step_Func_Run_AsyEvlrCritEve_Step_Func_TAWrapper_PreProcessor_ObjectPreProcessor_ObjectPreProcessorLoop_ValidObject_SafetyMarginFrontObjects_InPathCalculationWithPredictedObjPositions_CreateInPathDataTTM_RelativePositionAtTTR_RelativePositionToHostPath1_RelativeHeadingAndRotation_MovingObject "autosar_swc_aeb/autosar_swc_aeb_Step_sys/Subsystem Reference/AEB Function/Run_AsyEvlrCritEve_Step_Func/Run_AsyEvlrCritEve_Step_Func/TAWrapper/PreProcessor/ObjectPreProcessor/ObjectPreProcessorLoop/ValidObject/SafetyMarginFrontObjects/InPathCalculationWithPredictedObjPositions/CreateInPathDataTTM/RelativePositionAtTTR/RelativePositionToHostPath1/RelativeHeadingAndRotation/MovingObject" /begin REF_MEASUREMENT autosar_swc_aeb_rtARID_DEF.HeadingObj_mh /end REF_MEASUREMENT /end GROUP
/begin GROUP autosar_swc_aeb_autosar_swc_aeb_Step_sys_Subsystem_Reference_AEB_Function_Run_AsyEvlrCritEve_Step_Func_Run_AsyEvlrCritEve_Step_Func_TAWrapper_PreProcessor_ObjectPreProcessor_ObjectPreProcessorLoop_ValidObject_SafetyMarginFrontObjects_InPathCalculationWithPredictedObjPositions_CreateInPathDataTTM_RelativePositionAtTTR_RelativePositionToHostPath1_RelativeHeadingAndRotation_StationaryObject "autosar_swc_aeb/autosar_swc_aeb_Step_sys/Subsystem Reference/AEB Function/Run_AsyEvlrCritEve_Step_Func/Run_AsyEvlrCritEve_Step_Func/TAWrapper/PreProcessor/ObjectPreProcessor/ObjectPreProcessorLoop/ValidObject/SafetyMarginFrontObjects/InPathCalculationWithPredictedObjPositions/CreateInPathDataTTM/RelativePositionAtTTR/RelativePositionToHostPath1/RelativeHeadingAndRotation/StationaryObject" /begin REF_MEASUREMENT autosar_swc_aeb_rtARID_DEF.HeadingObj_mh /end REF_MEASUREMENT /end GROUP
/begin GROUP autosar_swc_aeb_autosar_swc_aeb_Step_sys_Subsystem_Reference_AEB_Function_Run_AsyEvlrCritEve_Step_Func_Run_AsyEvlrCritEve_Step_Func_TAWrapper_PreProcessor_ObjectPreProcessor_ObjectPreProcessorLoop_ValidObject_SafetyMarginFrontObjects_InPathCalculationWithPredictedObjPositions_CreateInPathDataTTM_RelativePositionAtTTR_RelativePositionToHostPath1_RelativePosnLatAndVLat "autosar_swc_aeb/autosar_swc_aeb_Step_sys/Subsystem Reference/AEB Function/Run_AsyEvlrCritEve_Step_Func/Run_AsyEvlrCritEve_Step_Func/TAWrapper/PreProcessor/ObjectPreProcessor/ObjectPreProcessorLoop/ValidObject/SafetyMarginFrontObjects/InPathCalculationWithPredictedObjPositions/CreateInPathDataTTM/RelativePositionAtTTR/RelativePositionToHostPath1/RelativePosnLatAndVLat"
 /begin REF_MEASUREMENT autosar_swc_aeb_rtARID_DEF.PosnLatObj_p3 autosar_swc_aeb_rtARID_DEF.PosnLgtObj_o0 autosar_swc_aeb_rtARID_DEF.VLatObj_ja0hf autosar_swc_aeb_rtARID_DEF.VLgtObj_foijp /end REF_MEASUREMENT
/end GROUP
/begin GROUP autosar_swc_aeb_autosar_swc_aeb_Step_sys_Subsystem_Reference_AEB_Function_Run_AsyEvlrCritEve_Step_Func_Run_AsyEvlrCritEve_Step_Func_TAWrapper_PreProcessor_ObjectPreProcessor_ObjectPreProcessorLoop_ValidObject_SafetyMarginFrontObjects_InPathCalculationWithPredictedObjPositions_CreateInPathDataTTM_RelativePositionAtTTR_RelativePositionToHostPath2_RelativeHeadingAndRotation_MovingObject "autosar_swc_aeb/autosar_swc_aeb_Step_sys/Subsystem Reference/AEB Function/Run_AsyEvlrCritEve_Step_Func/Run_AsyEvlrCritEve_Step_Func/TAWrapper/PreProcessor/ObjectPreProcessor/ObjectPreProcessorLoop/ValidObject/SafetyMarginFrontObjects/InPathCalculationWithPredictedObjPositions/CreateInPathDataTTM/RelativePositionAtTTR/RelativePositionToHostPath2/RelativeHeadingAndRotation/MovingObject" /begin REF_MEASUREMENT autosar_swc_aeb_rtARID_DEF.HeadingObj_mhzxn /end REF_MEASUREMENT /end GROUP
/begin GROUP autosar_swc_aeb_autosar_swc_aeb_Step_sys_Subsystem_Reference_AEB_Function_Run_AsyEvlrCritEve_Step_Func_Run_AsyEvlrCritEve_Step_Func_TAWrapper_PreProcessor_ObjectPreProcessor_ObjectPreProcessorLoop_ValidObject_SafetyMarginFrontObjects_InPathCalculationWithPredictedObjPositions_CreateInPathDataTTM_RelativePositionAtTTR_RelativePositionToHostPath2_RelativeHeadingAndRotation_StationaryObject "autosar_swc_aeb/autosar_swc_aeb_Step_sys/Subsystem Reference/AEB Function/Run_AsyEvlrCritEve_Step_Func/Run_AsyEvlrCritEve_Step_Func/TAWrapper/PreProcessor/ObjectPreProcessor/ObjectPreProcessorLoop/ValidObject/SafetyMarginFrontObjects/InPathCalculationWithPredictedObjPositions/CreateInPathDataTTM/RelativePositionAtTTR/RelativePositionToHostPath2/RelativeHeadingAndRotation/StationaryObject" /begin REF_MEASUREMENT autosar_swc_aeb_rtARID_DEF.HeadingObj_mhzxn /end REF_MEASUREMENT /end GROUP
/begin GROUP autosar_swc_aeb_autosar_swc_aeb_Step_sys_Subsystem_Reference_AEB_Function_Run_AsyEvlrCritEve_Step_Func_Run_AsyEvlrCritEve_Step_Func_TAWrapper_PreProcessor_ObjectPreProcessor_ObjectPreProcessorLoop_ValidObject_SafetyMarginFrontObjects_InPathCalculationWithPredictedObjPositions_CreateInPathDataTTM_RelativePositionAtTTR_RelativePositionToHostPath2_RelativePosnLatAndVLat "autosar_swc_aeb/autosar_swc_aeb_Step_sys/Subsystem Reference/AEB Function/Run_AsyEvlrCritEve_Step_Func/Run_AsyEvlrCritEve_Step_Func/TAWrapper/PreProcessor/ObjectPreProcessor/ObjectPreProcessorLoop/ValidObject/SafetyMarginFrontObjects/InPathCalculationWithPredictedObjPositions/CreateInPathDataTTM/RelativePositionAtTTR/RelativePositionToHostPath2/RelativePosnLatAndVLat"
 /begin REF_MEASUREMENT autosar_swc_aeb_rtARID_DEF.PosnLatObj_p3hko autosar_swc_aeb_rtARID_DEF.PosnLgtObj_o0e3h autosar_swc_aeb_rtARID_DEF.VLatObj_ja autosar_swc_aeb_rtARID_DEF.VLgtObj_fo /end REF_MEASUREMENT
/end GROUP
/begin GROUP autosar_swc_aeb_autosar_swc_aeb_Step_sys_Subsystem_Reference_AEB_Function_Run_AsyEvlrCritEve_Step_Func_Run_AsyEvlrCritEve_Step_Func_TAWrapper_PreProcessor_ObjectPreProcessor_ObjectPreProcessorLoop_ValidObject_SafetyMarginFrontObjects_InPathCalculationWithPredictedObjPositions_CreateInPathDataTTM_RelativePositionAtTTR_RelativePositionToHostPath3_RelativeHeadingAndRotation_MovingObject "autosar_swc_aeb/autosar_swc_aeb_Step_sys/Subsystem Reference/AEB Function/Run_AsyEvlrCritEve_Step_Func/Run_AsyEvlrCritEve_Step_Func/TAWrapper/PreProcessor/ObjectPreProcessor/ObjectPreProcessorLoop/ValidObject/SafetyMarginFrontObjects/InPathCalculationWithPredictedObjPositions/CreateInPathDataTTM/RelativePositionAtTTR/RelativePositionToHostPath3/RelativeHeadingAndRotation/MovingObject" /begin REF_MEASUREMENT autosar_swc_aeb_rtARID_DEF.HeadingObj_mhz /end REF_MEASUREMENT /end GROUP
/begin GROUP autosar_swc_aeb_autosar_swc_aeb_Step_sys_Subsystem_Reference_AEB_Function_Run_AsyEvlrCritEve_Step_Func_Run_AsyEvlrCritEve_Step_Func_TAWrapper_PreProcessor_ObjectPreProcessor_ObjectPreProcessorLoop_ValidObject_SafetyMarginFrontObjects_InPathCalculationWithPredictedObjPositions_CreateInPathDataTTM_RelativePositionAtTTR_RelativePositionToHostPath3_RelativeHeadingAndRotation_StationaryObject "autosar_swc_aeb/autosar_swc_aeb_Step_sys/Subsystem Reference/AEB Function/Run_AsyEvlrCritEve_Step_Func/Run_AsyEvlrCritEve_Step_Func/TAWrapper/PreProcessor/ObjectPreProcessor/ObjectPreProcessorLoop/ValidObject/SafetyMarginFrontObjects/InPathCalculationWithPredictedObjPositions/CreateInPathDataTTM/RelativePositionAtTTR/RelativePositionToHostPath3/RelativeHeadingAndRotation/StationaryObject" /begin REF_MEASUREMENT autosar_swc_aeb_rtARID_DEF.HeadingObj_mhz /end REF_MEASUREMENT /end GROUP
/begin GROUP autosar_swc_aeb_autosar_swc_aeb_Step_sys_Subsystem_Reference_AEB_Function_Run_AsyEvlrCritEve_Step_Func_Run_AsyEvlrCritEve_Step_Func_TAWrapper_PreProcessor_ObjectPreProcessor_ObjectPreProcessorLoop_ValidObject_SafetyMarginFrontObjects_InPathCalculationWithPredictedObjPositions_CreateInPathDataTTM_RelativePositionAtTTR_RelativePositionToHostPath3_RelativePosnLatAndVLat "autosar_swc_aeb/autosar_swc_aeb_Step_sys/Subsystem Reference/AEB Function/Run_AsyEvlrCritEve_Step_Func/Run_AsyEvlrCritEve_Step_Func/TAWrapper/PreProcessor/ObjectPreProcessor/ObjectPreProcessorLoop/ValidObject/SafetyMarginFrontObjects/InPathCalculationWithPredictedObjPositions/CreateInPathDataTTM/RelativePositionAtTTR/RelativePositionToHostPath3/RelativePosnLatAndVLat"
 /begin REF_MEASUREMENT autosar_swc_aeb_rtARID_DEF.VLatObj_ja0 autosar_swc_aeb_rtARID_DEF.VLgtObj_foi /end REF_MEASUREMENT
/end GROUP
/begin GROUP autosar_swc_aeb_autosar_swc_aeb_Step_sys_Subsystem_Reference_AEB_Function_Run_AsyEvlrCritEve_Step_Func_Run_AsyEvlrCritEve_Step_Func_TAWrapper_PreProcessor_ObjectPreProcessor_ObjectPreProcessorLoop_ValidObject_SafetyMarginFrontObjects_InPathCalculationWithPredictedObjPositions_CreateInPathDataTTM_RelativePositionAtTTR_RelativePositionToHostPath4_RelativeHeadingAndRotation_MovingObject "autosar_swc_aeb/autosar_swc_aeb_Step_sys/Subsystem Reference/AEB Function/Run_AsyEvlrCritEve_Step_Func/Run_AsyEvlrCritEve_Step_Func/TAWrapper/PreProcessor/ObjectPreProcessor/ObjectPreProcessorLoop/ValidObject/SafetyMarginFrontObjects/InPathCalculationWithPredictedObjPositions/CreateInPathDataTTM/RelativePositionAtTTR/RelativePositionToHostPath4/RelativeHeadingAndRotation/MovingObject" /begin REF_MEASUREMENT autosar_swc_aeb_rtARID_DEF.HeadingObj_mhzx /end REF_MEASUREMENT /end GROUP
/begin GROUP autosar_swc_aeb_autosar_swc_aeb_Step_sys_Subsystem_Reference_AEB_Function_Run_AsyEvlrCritEve_Step_Func_Run_AsyEvlrCritEve_Step_Func_TAWrapper_PreProcessor_ObjectPreProcessor_ObjectPreProcessorLoop_ValidObject_SafetyMarginFrontObjects_InPathCalculationWithPredictedObjPositions_CreateInPathDataTTM_RelativePositionAtTTR_RelativePositionToHostPath4_RelativeHeadingAndRotation_StationaryObject "autosar_swc_aeb/autosar_swc_aeb_Step_sys/Subsystem Reference/AEB Function/Run_AsyEvlrCritEve_Step_Func/Run_AsyEvlrCritEve_Step_Func/TAWrapper/PreProcessor/ObjectPreProcessor/ObjectPreProcessorLoop/ValidObject/SafetyMarginFrontObjects/InPathCalculationWithPredictedObjPositions/CreateInPathDataTTM/RelativePositionAtTTR/RelativePositionToHostPath4/RelativeHeadingAndRotation/StationaryObject" /begin REF_MEASUREMENT autosar_swc_aeb_rtARID_DEF.HeadingObj_mhzx /end REF_MEASUREMENT /end GROUP
/begin GROUP autosar_swc_aeb_autosar_swc_aeb_Step_sys_Subsystem_Reference_AEB_Function_Run_AsyEvlrCritEve_Step_Func_Run_AsyEvlrCritEve_Step_Func_TAWrapper_PreProcessor_ObjectPreProcessor_ObjectPreProcessorLoop_ValidObject_SafetyMarginFrontObjects_InPathCalculationWithPredictedObjPositions_CreateInPathDataTTM_RelativePositionAtTTR_RelativePositionToHostPath4_RelativePosnLatAndVLat "autosar_swc_aeb/autosar_swc_aeb_Step_sys/Subsystem Reference/AEB Function/Run_AsyEvlrCritEve_Step_Func/Run_AsyEvlrCritEve_Step_Func/TAWrapper/PreProcessor/ObjectPreProcessor/ObjectPreProcessorLoop/ValidObject/SafetyMarginFrontObjects/InPathCalculationWithPredictedObjPositions/CreateInPathDataTTM/RelativePositionAtTTR/RelativePositionToHostPath4/RelativePosnLatAndVLat"
 /begin REF_MEASUREMENT autosar_swc_aeb_rtARID_DEF.PosnLatObj_p3hk autosar_swc_aeb_rtARID_DEF.PosnLgtObj_o0e3 autosar_swc_aeb_rtARID_DEF.VLatObj_ja0h autosar_swc_aeb_rtARID_DEF.VLgtObj_foij /end REF_MEASUREMENT
/end GROUP
/begin GROUP autosar_swc_aeb_autosar_swc_aeb_Step_sys_Subsystem_Reference_AEB_Function_Run_AsyEvlrCritEve_Step_Func_Run_AsyEvlrCritEve_Step_Func_TAWrapper_PreProcessor_ObjectPreProcessor_ObjectPreProcessorLoop_ValidObject_SafetyMarginFrontObjects_InPathCalculationWithPredictedObjPositions_CreateInPathDataTTM_ToDiag_DIAG_TA_Inpath_PredObjAnBL_TTM_off_ALVTerm "autosar_swc_aeb/autosar_swc_aeb_Step_sys/Subsystem Reference/AEB Function/Run_AsyEvlrCritEve_Step_Func/Run_AsyEvlrCritEve_Step_Func/TAWrapper/PreProcessor/ObjectPreProcessor/ObjectPreProcessorLoop/ValidObject/SafetyMarginFrontObjects/InPathCalculationWithPredictedObjPositions/CreateInPathDataTTM/ToDiag/DIAG_TA_Inpath_PredObjAnBL_TTM/off/ALVTerm" /begin REF_MEASUREMENT autosar_swc_aeb_rtARID_DEF.HeadingObj_mh /end REF_MEASUREMENT /end GROUP
/begin GROUP autosar_swc_aeb_autosar_swc_aeb_Step_sys_Subsystem_Reference_AEB_Function_Run_AsyEvlrCritEve_Step_Func_Run_AsyEvlrCritEve_Step_Func_TAWrapper_PreProcessor_ObjectPreProcessor_ObjectPreProcessorLoop_ValidObject_SafetyMarginFrontObjects_InPathCalculationWithPredictedObjPositions_CreateInPathDataTTM_ToDiag_DIAG_TA_Inpath_PredObjAnBS_TTM_off_ALVTerm "autosar_swc_aeb/autosar_swc_aeb_Step_sys/Subsystem Reference/AEB Function/Run_AsyEvlrCritEve_Step_Func/Run_AsyEvlrCritEve_Step_Func/TAWrapper/PreProcessor/ObjectPreProcessor/ObjectPreProcessorLoop/ValidObject/SafetyMarginFrontObjects/InPathCalculationWithPredictedObjPositions/CreateInPathDataTTM/ToDiag/DIAG_TA_Inpath_PredObjAnBS_TTM/off/ALVTerm" /begin REF_MEASUREMENT autosar_swc_aeb_rtARID_DEF.HeadingObj_mhzxn /end REF_MEASUREMENT /end GROUP
/begin GROUP autosar_swc_aeb_autosar_swc_aeb_Step_sys_Subsystem_Reference_AEB_Function_Run_AsyEvlrCritEve_Step_Func_Run_AsyEvlrCritEve_Step_Func_TAWrapper_PreProcessor_ObjectPreProcessor_ObjectPreProcessorLoop_ValidObject_SafetyMarginFrontObjects_InPathCalculationWithPredictedObjPositions_CreateInPathDataTTM_ToDiag_DIAG_TA_Inpath_PredObjAn_Le_TTM_off_ALVTerm "autosar_swc_aeb/autosar_swc_aeb_Step_sys/Subsystem Reference/AEB Function/Run_AsyEvlrCritEve_Step_Func/Run_AsyEvlrCritEve_Step_Func/TAWrapper/PreProcessor/ObjectPreProcessor/ObjectPreProcessorLoop/ValidObject/SafetyMarginFrontObjects/InPathCalculationWithPredictedObjPositions/CreateInPathDataTTM/ToDiag/DIAG_TA_Inpath_PredObjAn_Le_TTM/off/ALVTerm" /begin REF_MEASUREMENT autosar_swc_aeb_rtARID_DEF.HeadingObj_mhz /end REF_MEASUREMENT /end GROUP
/begin GROUP autosar_swc_aeb_autosar_swc_aeb_Step_sys_Subsystem_Reference_AEB_Function_Run_AsyEvlrCritEve_Step_Func_Run_AsyEvlrCritEve_Step_Func_TAWrapper_PreProcessor_ObjectPreProcessor_ObjectPreProcessorLoop_ValidObject_SafetyMarginFrontObjects_InPathCalculationWithPredictedObjPositions_CreateInPathDataTTM_ToDiag_DIAG_TA_Inpath_PredObjAn_Ri_TTM_off_ALVTerm "autosar_swc_aeb/autosar_swc_aeb_Step_sys/Subsystem Reference/AEB Function/Run_AsyEvlrCritEve_Step_Func/Run_AsyEvlrCritEve_Step_Func/TAWrapper/PreProcessor/ObjectPreProcessor/ObjectPreProcessorLoop/ValidObject/SafetyMarginFrontObjects/InPathCalculationWithPredictedObjPositions/CreateInPathDataTTM/ToDiag/DIAG_TA_Inpath_PredObjAn_Ri_TTM/off/ALVTerm" /begin REF_MEASUREMENT autosar_swc_aeb_rtARID_DEF.HeadingObj_mhzx /end REF_MEASUREMENT /end GROUP
/begin GROUP autosar_swc_aeb_autosar_swc_aeb_Step_sys_Subsystem_Reference_AEB_Function_Run_AsyEvlrCritEve_Step_Func_Run_AsyEvlrCritEve_Step_Func_TAWrapper_PreProcessor_ObjectPreProcessor_ObjectPreProcessorLoop_ValidObject_SafetyMarginFrontObjects_InPathCalculationWithPredictedObjPositions_CreateInPathDataTTM_ToDiag_DIAG_TA_Inpath_PredObjLatBL_TTM_off_ALVTerm "autosar_swc_aeb/autosar_swc_aeb_Step_sys/Subsystem Reference/AEB Function/Run_AsyEvlrCritEve_Step_Func/Run_AsyEvlrCritEve_Step_Func/TAWrapper/PreProcessor/ObjectPreProcessor/ObjectPreProcessorLoop/ValidObject/SafetyMarginFrontObjects/InPathCalculationWithPredictedObjPositions/CreateInPathDataTTM/ToDiag/DIAG_TA_Inpath_PredObjLatBL_TTM/off/ALVTerm" /begin REF_MEASUREMENT autosar_swc_aeb_rtARID_DEF.PosnLatObj_p3 /end REF_MEASUREMENT /end GROUP
/begin GROUP autosar_swc_aeb_autosar_swc_aeb_Step_sys_Subsystem_Reference_AEB_Function_Run_AsyEvlrCritEve_Step_Func_Run_AsyEvlrCritEve_Step_Func_TAWrapper_PreProcessor_ObjectPreProcessor_ObjectPreProcessorLoop_ValidObject_SafetyMarginFrontObjects_InPathCalculationWithPredictedObjPositions_CreateInPathDataTTM_ToDiag_DIAG_TA_Inpath_PredObjLatBS_TTM_off_ALVTerm "autosar_swc_aeb/autosar_swc_aeb_Step_sys/Subsystem Reference/AEB Function/Run_AsyEvlrCritEve_Step_Func/Run_AsyEvlrCritEve_Step_Func/TAWrapper/PreProcessor/ObjectPreProcessor/ObjectPreProcessorLoop/ValidObject/SafetyMarginFrontObjects/InPathCalculationWithPredictedObjPositions/CreateInPathDataTTM/ToDiag/DIAG_TA_Inpath_PredObjLatBS_TTM/off/ALVTerm" /begin REF_MEASUREMENT autosar_swc_aeb_rtARID_DEF.PosnLatObj_p3hko /end REF_MEASUREMENT /end GROUP
/begin GROUP autosar_swc_aeb_autosar_swc_aeb_Step_sys_Subsystem_Reference_AEB_Function_Run_AsyEvlrCritEve_Step_Func_Run_AsyEvlrCritEve_Step_Func_TAWrapper_PreProcessor_ObjectPreProcessor_ObjectPreProcessorLoop_ValidObject_SafetyMarginFrontObjects_InPathCalculationWithPredictedObjPositions_CreateInPathDataTTM_ToDiag_DIAG_TA_Inpath_PredObjLat_Ri_TTM_off_ALVTerm "autosar_swc_aeb/autosar_swc_aeb_Step_sys/Subsystem Reference/AEB Function/Run_AsyEvlrCritEve_Step_Func/Run_AsyEvlrCritEve_Step_Func/TAWrapper/PreProcessor/ObjectPreProcessor/ObjectPreProcessorLoop/ValidObject/SafetyMarginFrontObjects/InPathCalculationWithPredictedObjPositions/CreateInPathDataTTM/ToDiag/DIAG_TA_Inpath_PredObjLat_Ri_TTM/off/ALVTerm" /begin REF_MEASUREMENT autosar_swc_aeb_rtARID_DEF.PosnLatObj_p3hk /end REF_MEASUREMENT /end GROUP
/begin GROUP autosar_swc_aeb_autosar_swc_aeb_Step_sys_Subsystem_Reference_AEB_Function_Run_AsyEvlrCritEve_Step_Func_Run_AsyEvlrCritEve_Step_Func_TAWrapper_PreProcessor_ObjectPreProcessor_ObjectPreProcessorLoop_ValidObject_SafetyMarginFrontObjects_InPathCalculationWithPredictedObjPositions_CreateInPathDataTTM_ToDiag_DIAG_TA_Inpath_PredObjLgtBS_TTM_off_ALVTerm "autosar_swc_aeb/autosar_swc_aeb_Step_sys/Subsystem Reference/AEB Function/Run_AsyEvlrCritEve_Step_Func/Run_AsyEvlrCritEve_Step_Func/TAWrapper/PreProcessor/ObjectPreProcessor/ObjectPreProcessorLoop/ValidObject/SafetyMarginFrontObjects/InPathCalculationWithPredictedObjPositions/CreateInPathDataTTM/ToDiag/DIAG_TA_Inpath_PredObjLgtBS_TTM/off/ALVTerm" /begin REF_MEASUREMENT autosar_swc_aeb_rtARID_DEF.PosnLgtObj_o0e3h /end REF_MEASUREMENT /end GROUP
/begin GROUP autosar_swc_aeb_autosar_swc_aeb_Step_sys_Subsystem_Reference_AEB_Function_Run_AsyEvlrCritEve_Step_Func_Run_AsyEvlrCritEve_Step_Func_TAWrapper_PreProcessor_ObjectPreProcessor_ObjectPreProcessorLoop_ValidObject_SafetyMarginFrontObjects_InPathCalculationWithPredictedObjPositions_CreateInPathDataTTM_ToDiag_DIAG_TA_Inpath_PredObjLgt_BL_TTM_off_ALVTerm "autosar_swc_aeb/autosar_swc_aeb_Step_sys/Subsystem Reference/AEB Function/Run_AsyEvlrCritEve_Step_Func/Run_AsyEvlrCritEve_Step_Func/TAWrapper/PreProcessor/ObjectPreProcessor/ObjectPreProcessorLoop/ValidObject/SafetyMarginFrontObjects/InPathCalculationWithPredictedObjPositions/CreateInPathDataTTM/ToDiag/DIAG_TA_Inpath_PredObjLgt_BL_TTM/off/ALVTerm" /begin REF_MEASUREMENT autosar_swc_aeb_rtARID_DEF.PosnLgtObj_o0 /end REF_MEASUREMENT /end GROUP
/begin GROUP autosar_swc_aeb_autosar_swc_aeb_Step_sys_Subsystem_Reference_AEB_Function_Run_AsyEvlrCritEve_Step_Func_Run_AsyEvlrCritEve_Step_Func_TAWrapper_PreProcessor_ObjectPreProcessor_ObjectPreProcessorLoop_ValidObject_SafetyMarginFrontObjects_InPathCalculationWithPredictedObjPositions_CreateInPathDataTTM_ToDiag_DIAG_TA_Inpath_PredObjLgt_Ri_TTM_off_ALVTerm "autosar_swc_aeb/autosar_swc_aeb_Step_sys/Subsystem Reference/AEB Function/Run_AsyEvlrCritEve_Step_Func/Run_AsyEvlrCritEve_Step_Func/TAWrapper/PreProcessor/ObjectPreProcessor/ObjectPreProcessorLoop/ValidObject/SafetyMarginFrontObjects/InPathCalculationWithPredictedObjPositions/CreateInPathDataTTM/ToDiag/DIAG_TA_Inpath_PredObjLgt_Ri_TTM/off/ALVTerm" /begin REF_MEASUREMENT autosar_swc_aeb_rtARID_DEF.PosnLgtObj_o0e3 /end REF_MEASUREMENT /end GROUP
/begin GROUP autosar_swc_aeb_autosar_swc_aeb_Step_sys_Subsystem_Reference_AEB_Function_Run_AsyEvlrCritEve_Step_Func_Run_AsyEvlrCritEve_Step_Func_TAWrapper_PreProcessor_ObjectPreProcessor_ObjectPreProcessorLoop_ValidObject_SafetyMarginFrontObjects_InPathCalculationWithPredictedObjPositions_CreateInPathDataTTR_CheckBrakingAndSteering_CheckIfObjectTriesToManoeuver "autosar_swc_aeb/autosar_swc_aeb_Step_sys/Subsystem Reference/AEB Function/Run_AsyEvlrCritEve_Step_Func/Run_AsyEvlrCritEve_Step_Func/TAWrapper/PreProcessor/ObjectPreProcessor/ObjectPreProcessorLoop/ValidObject/SafetyMarginFrontObjects/InPathCalculationWithPredictedObjPositions/CreateInPathDataTTR/CheckBrakingAndSteering/CheckIfObjectTriesToManoeuver" /begin REF_CHARACTERISTIC CLTS_AgDirForSteerMinInAsyEvlrCritEve_Ca /end REF_CHARACTERISTIC /end GROUP
/begin RECORD_LAYOUT Record_FLOAT32_IEEE FNC_VALUES 1 FLOAT32_IEEE COLUMN_DIR DIRECT /end RECORD_LAYOUT
/begin RECORD_LAYOUT Axis_FLOAT32_IEEE AXIS_PTS_X 1 FLOAT32_IEEE INDEX_INCR DIRECT /end RECORD_LAYOUT
/begin RECORD_LAYOUT Record_FLOAT32_IEEE FNC_VALUES 1 FLOAT32_IEEE COLUMN_DIR DIRECT /end RECORD_LAYOUT
/begin RECORD_LAYOUT Record_FLOAT32_IEEE FNC_VALUES 1 FLOAT32_IEEE COLUMN_DIR DIRECT /end RECORD_LAYOUT
/begin RECORD_LAYOUT Axis_FLOAT32_IEEE AXIS_PTS_X 1 FLOAT32_IEEE INDEX_INCR DIRECT /end RECORD_LAYOUT
/begin RECORD_LAYOUT Record_FLOAT32_IEEE FNC_VALUES 1 FLOAT32_IEEE COLUMN_DIR DIRECT /end RECORD_LAYOUT
/begin RECORD_LAYOUT Axis_FLOAT32_IEEE AXIS_PTS_X 1 FLOAT32_IEEE INDEX_INCR DIRECT /end RECORD_LAYOUT
/begin RECORD_LAYOUT Record_FLOAT32_IEEE FNC_VALUES 1 FLOAT32_IEEE COLUMN_DIR DIRECT /end RECORD_LAYOUT
/begin RECORD_LAYOUT Axis_FLOAT32_IEEE AXIS_PTS_X 1 FLOAT32_IEEE INDEX_INCR DIRECT /end RECORD_LAYOUT
/begin RECORD_LAYOUT Record_FLOAT32_IEEE FNC_VALUES 1 FLOAT32_IEEE COLUMN_DIR DIRECT /end RECORD_LAYOUT
/begin RECORD_LAYOUT Record_FLOAT32_IEEE FNC_VALUES 1 FLOAT32_IEEE COLUMN_DIR DIRECT /end RECORD_LAYOUT
/begin RECORD_LAYOUT Axis_FLOAT32_IEEE AXIS_PTS_X 1 FLOAT32_IEEE INDEX_INCR DIRECT /end RECORD_LAYOUT
/begin RECORD_LAYOUT Record_FLOAT32_IEEE FNC_VALUES 1 FLOAT32_IEEE COLUMN_DIR DIRECT /end RECORD_LAYOUT
/begin RECORD_LAYOUT Axis_FLOAT32_IEEE AXIS_PTS_X 1 FLOAT32_IEEE INDEX_INCR DIRECT /end RECORD_LAYOUT
/begin RECORD_LAYOUT Record_FLOAT32_IEEE FNC_VALUES 1 FLOAT32_IEEE COLUMN_DIR DIRECT /end RECORD_LAYOUT
/begin RECORD_LAYOUT Axis_FLOAT32_IEEE AXIS_PTS_X 1 FLOAT32_IEEE INDEX_INCR DIRECT /end RECORD_LAYOUT
/begin RECORD_LAYOUT Record_FLOAT32_IEEE FNC_VALUES 1 FLOAT32_IEEE COLUMN_DIR DIRECT /end RECORD_LAYOUT
/begin RECORD_LAYOUT Axis_FLOAT32_IEEE AXIS_PTS_X 1 FLOAT32_IEEE INDEX_INCR DIRECT /end RECORD_LAYOUT
/end MODULE
/end PROJECT
