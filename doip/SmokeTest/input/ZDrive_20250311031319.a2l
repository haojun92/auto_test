ASAP2_VERSION 1 71
/begin PROJECT ProjectName ""
/begin MODULE ModuleName ""
/begin MOD_COMMON "" BYTE_ORDER MSB_LAST ALIGNMENT_BYTE 1 ALIGNMENT_WORD 1 ALIGNMENT_LONG 1 ALIGNMENT_INT64 1 ALIGNMENT_FLOAT16_IEEE 1 ALIGNMENT_FLOAT32_IEEE 1 ALIGNMENT_FLOAT64_IEEE 1 /end MOD_COMMON
/begin RECORD_LAYOUT SSV__UWORD_S AXIS_PTS_X 1 UWORD INDEX_INCR DIRECT /end RECORD_LAYOUT
/begin RECORD_LAYOUT SSV__ULONG_S AXIS_PTS_X 1 ULONG INDEX_INCR DIRECT /end RECORD_LAYOUT
/begin RECORD_LAYOUT Record_BOOLEAN FNC_VALUES 1 UBYTE COLUMN_DIR DIRECT /end RECORD_LAYOUT
/begin RECORD_LAYOUT Record_FLOAT32_IEEE FNC_VALUES 1 FLOAT32_IEEE COLUMN_DIR DIRECT /end RECORD_LAYOUT
/begin RECORD_LAYOUT Record_FLOAT64_IEEE FNC_VALUES 1 FLOAT64_IEEE COLUMN_DIR DIRECT /end RECORD_LAYOUT
/begin RECORD_LAYOUT Record_UBYTE FNC_VALUES 1 UBYTE COLUMN_DIR DIRECT /end RECORD_LAYOUT
/begin RECORD_LAYOUT Record_UWORD FNC_VALUES 1 UWORD COLUMN_DIR DIRECT /end RECORD_LAYOUT
/begin RECORD_LAYOUT Axis_FLOAT32_IEEE AXIS_PTS_X 1 FLOAT32_IEEE INDEX_INCR DIRECT /end RECORD_LAYOUT
/begin RECORD_LAYOUT Record_BOOLEAN FNC_VALUES 1 UBYTE COLUMN_DIR DIRECT /end RECORD_LAYOUT
/begin RECORD_LAYOUT Record_FLOAT32_IEEE FNC_VALUES 1 FLOAT32_IEEE COLUMN_DIR DIRECT /end RECORD_LAYOUT
/begin RECORD_LAYOUT Record_UBYTE FNC_VALUES 1 UBYTE COLUMN_DIR DIRECT /end RECORD_LAYOUT
/begin RECORD_LAYOUT Record_UWORD FNC_VALUES 1 UWORD COLUMN_DIR DIRECT /end RECORD_LAYOUT
/begin RECORD_LAYOUT Axis_FLOAT32_IEEE AXIS_PTS_X 1 FLOAT32_IEEE INDEX_INCR DIRECT /end RECORD_LAYOUT
/begin RECORD_LAYOUT Record_BOOLEAN FNC_VALUES 1 UBYTE COLUMN_DIR DIRECT /end RECORD_LAYOUT
/begin RECORD_LAYOUT Record_FLOAT32_IEEE FNC_VALUES 1 FLOAT32_IEEE COLUMN_DIR DIRECT /end RECORD_LAYOUT
/begin RECORD_LAYOUT Record_FLOAT64_IEEE FNC_VALUES 1 FLOAT64_IEEE COLUMN_DIR DIRECT /end RECORD_LAYOUT
/begin RECORD_LAYOUT Record_UBYTE FNC_VALUES 1 UBYTE COLUMN_DIR DIRECT /end RECORD_LAYOUT
/begin RECORD_LAYOUT Record_BOOLEAN FNC_VALUES 1 UBYTE COLUMN_DIR DIRECT /end RECORD_LAYOUT
/begin RECORD_LAYOUT Record_FLOAT32_IEEE FNC_VALUES 1 FLOAT32_IEEE COLUMN_DIR DIRECT /end RECORD_LAYOUT
/begin RECORD_LAYOUT Record_UBYTE FNC_VALUES 1 UBYTE COLUMN_DIR DIRECT /end RECORD_LAYOUT
/begin RECORD_LAYOUT Record_UWORD FNC_VALUES 1 UWORD COLUMN_DIR DIRECT /end RECORD_LAYOUT
/begin RECORD_LAYOUT Axis_FLOAT32_IEEE AXIS_PTS_X 1 FLOAT32_IEEE INDEX_INCR DIRECT /end RECORD_LAYOUT
/begin CHARACTERISTIC P_LSS_ELK_ConditionSw_b "" VALUE 0xfe821450 /* @ECU_Address@P_LSS_ELK_ConditionSw_b@ */ Record_BOOLEAN 0 autosar_swc_las_CM_boolean 0 1 /end CHARACTERISTIC
/begin CHARACTERISTIC P_LSS_ELK_CurveFactor "" VALUE 0xfe8210ac /* @ECU_Address@P_LSS_ELK_CurveFactor@ */ Record_FLOAT32_IEEE 0 autosar_swc_las_CM_single -3.4E+38 3.4E+38 /end CHARACTERISTIC
/begin CHARACTERISTIC P_LSS_ELK_DisEge2Line "" VALUE 0xfe8210b0 /* @ECU_Address@P_LSS_ELK_DisEge2Line@ */ Record_FLOAT32_IEEE 0 autosar_swc_las_CM_single -3.4E+38 3.4E+38 /end CHARACTERISTIC
/begin CHARACTERISTIC P_LSS_ELK_EndSwitch "" VALUE 0xfe821453 /* @ECU_Address@P_LSS_ELK_EndSwitch@ */ Record_BOOLEAN 0 autosar_swc_las_CM_boolean 0 1 /end CHARACTERISTIC
/begin CHARACTERISTIC P_LSS_ELK_FL2LeftEgeDisOffset_m "" VALUE 0xfe8210c8 /* @ECU_Address@P_LSS_ELK_FL2LeftEgeDisOffset_m@ */ Record_FLOAT32_IEEE 0 autosar_swc_las_CM_single -3.4E+38 3.4E+38 /end CHARACTERISTIC
/begin CHARACTERISTIC P_LSS_ELK_FR2RightEgeDisOffset_m "" VALUE 0xfe8210cc /* @ECU_Address@P_LSS_ELK_FR2RightEgeDisOffset_m@ */ Record_FLOAT32_IEEE 0 autosar_swc_las_CM_single -3.4E+38 3.4E+38 /end CHARACTERISTIC
/begin CHARACTERISTIC P_LSS_ELK_LaneEgeScene_Compensate "" VALUE 0xfe8210d8 /* @ECU_Address@P_LSS_ELK_LaneEgeScene_Compensate@ */ Record_FLOAT32_IEEE 0 autosar_swc_las_CM_single -3.4E+38 3.4E+38 /end CHARACTERISTIC
/begin CHARACTERISTIC P_LSS_ELK_LaneWidthInTime "" VALUE 0xfe8210dc /* @ECU_Address@P_LSS_ELK_LaneWidthInTime@ */ Record_FLOAT32_IEEE 0 autosar_swc_las_CM_single -3.4E+38 3.4E+38 /end CHARACTERISTIC
/begin CHARACTERISTIC P_LSS_ELK_Lane_Width_Table_Calibration "" CURVE 0xfe8217b4 /* @ECU_Address@P_LSS_ELK_Lane_Width_Table_Calibration@ */ Record_FLOAT32_IEEE 0 autosar_swc_las_CM_single -3.4E+38 3.4E+38
 /begin AXIS_DESCR COM_AXIS NO_INPUT_QUANTITY autosar_swc_las_CM_single 7 -3.4E+38 3.4E+38 AXIS_PTS_REF P_LSS_ELK_Lane_Width_Table /end AXIS_DESCR
/end CHARACTERISTIC
/begin CHARACTERISTIC P_LSS_ELK_LatDisOffsetTime_s "" VALUE 0xfe8210e0 /* @ECU_Address@P_LSS_ELK_LatDisOffsetTime_s@ */ Record_FLOAT32_IEEE 0 autosar_swc_las_CM_single -3.4E+38 3.4E+38 /end CHARACTERISTIC
/begin CHARACTERISTIC P_LSS_ELK_LeftEgeDisOffset_TableY "" CURVE 0xfe821478 /* @ECU_Address@P_LSS_ELK_LeftEgeDisOffset_TableY@ */ Record_FLOAT32_IEEE 0 autosar_swc_las_CM_single -3.4E+38 3.4E+38
 /begin AXIS_DESCR COM_AXIS NO_INPUT_QUANTITY autosar_swc_las_CM_single 10 -3.4E+38 3.4E+38 AXIS_PTS_REF P_LSS_ELK_VehSpdRoadEge_TableX /end AXIS_DESCR
/end CHARACTERISTIC
/begin CHARACTERISTIC P_LSS_ELK_LeftLaneProb "" VALUE 0xfe8210e4 /* @ECU_Address@P_LSS_ELK_LeftLaneProb@ */ Record_FLOAT32_IEEE 0 autosar_swc_las_CM_single -3.4E+38 3.4E+38 /end CHARACTERISTIC
/begin CHARACTERISTIC P_LSS_ELK_LeftLatDisOffset_m "" VALUE 0xfe8210e8 /* @ECU_Address@P_LSS_ELK_LeftLatDisOffset_m@ */ Record_FLOAT32_IEEE 0 autosar_swc_las_CM_single -3.4E+38 3.4E+38 /end CHARACTERISTIC
/begin CHARACTERISTIC P_LSS_ELK_LeftMinLatDis_m "" VALUE 0xfe8210ec /* @ECU_Address@P_LSS_ELK_LeftMinLatDis_m@ */ Record_FLOAT32_IEEE 0 autosar_swc_las_CM_single -3.4E+38 3.4E+38 /end CHARACTERISTIC
/begin CHARACTERISTIC P_LSS_ELK_LeftObjMinLatDis_m "" VALUE 0xfe8210f0 /* @ECU_Address@P_LSS_ELK_LeftObjMinLatDis_m@ */ Record_FLOAT32_IEEE 0 autosar_swc_las_CM_single -3.4E+38 3.4E+38 /end CHARACTERISTIC
/begin CHARACTERISTIC P_LSS_ELK_LeftOnComingInAreaHiDis_m "" VALUE 0xfe8210f4 /* @ECU_Address@P_LSS_ELK_LeftOnComingInAreaHiDis_m@ */ Record_FLOAT32_IEEE 0 autosar_swc_las_CM_single -3.4E+38 3.4E+38 /end CHARACTERISTIC
/begin CHARACTERISTIC P_LSS_ELK_LeftOnComingInAreaLowDis_m "" VALUE 0xfe8210f8 /* @ECU_Address@P_LSS_ELK_LeftOnComingInAreaLowDis_m@ */ Record_FLOAT32_IEEE 0 autosar_swc_las_CM_single -3.4E+38 3.4E+38 /end CHARACTERISTIC
/begin CHARACTERISTIC P_LSS_ELK_LeftOnComingOutAreaHiDis_m "" VALUE 0xfe8210fc /* @ECU_Address@P_LSS_ELK_LeftOnComingOutAreaHiDis_m@ */ Record_FLOAT32_IEEE 0 autosar_swc_las_CM_single -3.4E+38 3.4E+38 /end CHARACTERISTIC
/begin CHARACTERISTIC P_LSS_ELK_LeftOnComingOutAreaLowDis_m "" VALUE 0xfe821100 /* @ECU_Address@P_LSS_ELK_LeftOnComingOutAreaLowDis_m@ */ Record_FLOAT32_IEEE 0 autosar_swc_las_CM_single -3.4E+38 3.4E+38 /end CHARACTERISTIC
/begin CHARACTERISTIC P_LSS_ELK_LeftOnFLWhelDyMinDis "" VALUE 0xfe821104 /* @ECU_Address@P_LSS_ELK_LeftOnFLWhelDyMinDis@ */ Record_FLOAT32_IEEE 0 autosar_swc_las_CM_single -3.4E+38 3.4E+38 /end CHARACTERISTIC
/begin CHARACTERISTIC P_LSS_ELK_LeftOverFLWhelDyMinDis "" VALUE 0xfe821108 /* @ECU_Address@P_LSS_ELK_LeftOverFLWhelDyMinDis@ */ Record_FLOAT32_IEEE 0 autosar_swc_las_CM_single -3.4E+38 3.4E+38 /end CHARACTERISTIC
/begin CHARACTERISTIC P_LSS_ELK_LeftOvtakingInAreaHiDis_m "" VALUE 0xfe82110c /* @ECU_Address@P_LSS_ELK_LeftOvtakingInAreaHiDis_m@ */ Record_FLOAT32_IEEE 0 autosar_swc_las_CM_single -3.4E+38 3.4E+38 /end CHARACTERISTIC
/begin CHARACTERISTIC P_LSS_ELK_LeftOvtakingInAreaLowDis_m "" VALUE 0xfe821110 /* @ECU_Address@P_LSS_ELK_LeftOvtakingInAreaLowDis_m@ */ Record_FLOAT32_IEEE 0 autosar_swc_las_CM_single -3.4E+38 3.4E+38 /end CHARACTERISTIC
/begin CHARACTERISTIC P_LSS_ELK_LeftOvtakingOutAreaHiDis_m "" VALUE 0xfe821114 /* @ECU_Address@P_LSS_ELK_LeftOvtakingOutAreaHiDis_m@ */ Record_FLOAT32_IEEE 0 autosar_swc_las_CM_single -3.4E+38 3.4E+38 /end CHARACTERISTIC
/begin CHARACTERISTIC P_LSS_ELK_LeftOvtakingOutAreaLowDis_m "" VALUE 0xfe821118 /* @ECU_Address@P_LSS_ELK_LeftOvtakingOutAreaLowDis_m@ */ Record_FLOAT32_IEEE 0 autosar_swc_las_CM_single -3.4E+38 3.4E+38 /end CHARACTERISTIC
/begin CHARACTERISTIC P_LSS_ELK_LineIntervenSw "" VALUE 0xfe821454 /* @ECU_Address@P_LSS_ELK_LineIntervenSw@ */ Record_BOOLEAN 0 autosar_swc_las_CM_boolean 0 1 /end CHARACTERISTIC
/begin CHARACTERISTIC P_LSS_ELK_LineKapFilterCoef "" VALUE 0xfe82111c /* @ECU_Address@P_LSS_ELK_LineKapFilterCoef@ */ Record_FLOAT32_IEEE 0 autosar_swc_las_CM_single -3.4E+38 3.4E+38 /end CHARACTERISTIC
/begin CHARACTERISTIC P_LSS_ELK_LineKapFlagDefault "" VALUE 0xfe821455 /* @ECU_Address@P_LSS_ELK_LineKapFlagDefault@ */ Record_BOOLEAN 0 autosar_swc_las_CM_boolean 0 1 /end CHARACTERISTIC
/begin CHARACTERISTIC P_LSS_ELK_LineKapFlagShiledSw "" VALUE 0xfe821456 /* @ECU_Address@P_LSS_ELK_LineKapFlagShiledSw@ */ Record_BOOLEAN 0 autosar_swc_las_CM_boolean 0 1 /end CHARACTERISTIC
/begin CHARACTERISTIC P_LSS_ELK_MaxLaneWidthIn "" VALUE 0xfe821120 /* @ECU_Address@P_LSS_ELK_MaxLaneWidthIn@ */ Record_FLOAT32_IEEE 0 autosar_swc_las_CM_single -3.4E+38 3.4E+38 /end CHARACTERISTIC
/begin CHARACTERISTIC P_LSS_ELK_MaxLaneWidthOut "" VALUE 0xfe821124 /* @ECU_Address@P_LSS_ELK_MaxLaneWidthOut@ */ Record_FLOAT32_IEEE 0 autosar_swc_las_CM_single -3.4E+38 3.4E+38 /end CHARACTERISTIC
/begin CHARACTERISTIC P_LSS_ELK_MinLaneWidthIn "" VALUE 0xfe821128 /* @ECU_Address@P_LSS_ELK_MinLaneWidthIn@ */ Record_FLOAT32_IEEE 0 autosar_swc_las_CM_single -3.4E+38 3.4E+38 /end CHARACTERISTIC
/begin CHARACTERISTIC P_LSS_ELK_MinLaneWidthOut "" VALUE 0xfe82112c /* @ECU_Address@P_LSS_ELK_MinLaneWidthOut@ */ Record_FLOAT32_IEEE 0 autosar_swc_las_CM_single -3.4E+38 3.4E+38 /end CHARACTERISTIC
/begin CHARACTERISTIC P_LSS_ELK_MotorOrBicycleWidth_m "" VALUE 0xfe821130 /* @ECU_Address@P_LSS_ELK_MotorOrBicycleWidth_m@ */ Record_FLOAT32_IEEE 0 autosar_swc_las_CM_single -3.4E+38 3.4E+38 /end CHARACTERISTIC
/begin CHARACTERISTIC P_LSS_ELK_ObjectObj_MovType_MOVING "" VALUE 0xfe821457 /* @ECU_Address@P_LSS_ELK_ObjectObj_MovType_MOVING@ */ Record_UBYTE 0 autosar_swc_las_CM_uint8 0 255 /end CHARACTERISTIC
/begin CHARACTERISTIC P_LSS_ELK_ObsAgeTime "" VALUE 0xfe821138 /* @ECU_Address@P_LSS_ELK_ObsAgeTime@ */ Record_FLOAT32_IEEE 0 autosar_swc_las_CM_single -3.4E+38 3.4E+38 /end CHARACTERISTIC
/begin CHARACTERISTIC P_LSS_ELK_ObsFlagTime "" VALUE 0xfe82113c /* @ECU_Address@P_LSS_ELK_ObsFlagTime@ */ Record_FLOAT32_IEEE 0 autosar_swc_las_CM_single -3.4E+38 3.4E+38 /end CHARACTERISTIC
/begin CHARACTERISTIC P_LSS_ELK_ObsInLeftWidLaneProb_ratio "" VALUE 0xfe821140 /* @ECU_Address@P_LSS_ELK_ObsInLeftWidLaneProb_ratio@ */ Record_FLOAT32_IEEE 0 autosar_swc_las_CM_single -3.4E+38 3.4E+38 /end CHARACTERISTIC
/begin CHARACTERISTIC P_LSS_ELK_ObsInRightWidLaneProb_ratio "" VALUE 0xfe821144 /* @ECU_Address@P_LSS_ELK_ObsInRightWidLaneProb_ratio@ */ Record_FLOAT32_IEEE 0 autosar_swc_las_CM_single -3.4E+38 3.4E+38 /end CHARACTERISTIC
/begin CHARACTERISTIC P_LSS_ELK_OnComingLeftLineKap_TableY "" CURVE 0xfe8214a0 /* @ECU_Address@P_LSS_ELK_OnComingLeftLineKap_TableY@ */ Record_FLOAT32_IEEE 0 autosar_swc_las_CM_single -3.4E+38 3.4E+38
 /begin AXIS_DESCR COM_AXIS NO_INPUT_QUANTITY autosar_swc_las_CM_single 10 -3.4E+38 3.4E+38 AXIS_PTS_REF P_LSS_ELK_VehSpdKap_TableX /end AXIS_DESCR
/end CHARACTERISTIC
/begin CHARACTERISTIC P_LSS_ELK_OnComingObsDetectSw "" VALUE 0xfe821458 /* @ECU_Address@P_LSS_ELK_OnComingObsDetectSw@ */ Record_BOOLEAN 0 autosar_swc_las_CM_boolean 0 1 /end CHARACTERISTIC
/begin CHARACTERISTIC P_LSS_ELK_OnComingObsDetectSwDefaultVal "" VALUE 0xfe821459 /* @ECU_Address@P_LSS_ELK_OnComingObsDetectSwDefaultVal@ */ Record_BOOLEAN 0 autosar_swc_las_CM_boolean 0 1 /end CHARACTERISTIC
/begin CHARACTERISTIC P_LSS_ELK_OnComingRightLineKap_TableY "" CURVE 0xfe8214c8 /* @ECU_Address@P_LSS_ELK_OnComingRightLineKap_TableY@ */ Record_FLOAT32_IEEE 0 autosar_swc_las_CM_single -3.4E+38 3.4E+38
 /begin AXIS_DESCR COM_AXIS NO_INPUT_QUANTITY autosar_swc_las_CM_single 10 -3.4E+38 3.4E+38 AXIS_PTS_REF P_LSS_ELK_VehSpdKap_TableX /end AXIS_DESCR
/end CHARACTERISTIC
/begin CHARACTERISTIC P_LSS_ELK_OnComing_TTC "" VALUE 0xfe821148 /* @ECU_Address@P_LSS_ELK_OnComing_TTC@ */ Record_FLOAT32_IEEE 0 autosar_swc_las_CM_single -3.4E+38 3.4E+38 /end CHARACTERISTIC
/begin CHARACTERISTIC P_LSS_ELK_OverObjDxExitLength_m "" VALUE 0xfe82114c /* @ECU_Address@P_LSS_ELK_OverObjDxExitLength_m@ */ Record_FLOAT32_IEEE 0 autosar_swc_las_CM_single -3.4E+38 3.4E+38 /end CHARACTERISTIC
/begin CHARACTERISTIC P_LSS_ELK_OverObjectInAreaHi_m "" VALUE 0xfe821150 /* @ECU_Address@P_LSS_ELK_OverObjectInAreaHi_m@ */ Record_FLOAT32_IEEE 0 autosar_swc_las_CM_single -3.4E+38 3.4E+38 /end CHARACTERISTIC
/begin CHARACTERISTIC P_LSS_ELK_OverObjectInAreaLow_m "" VALUE 0xfe821154 /* @ECU_Address@P_LSS_ELK_OverObjectInAreaLow_m@ */ Record_FLOAT32_IEEE 0 autosar_swc_las_CM_single -3.4E+38 3.4E+38 /end CHARACTERISTIC
/begin CHARACTERISTIC P_LSS_ELK_OverObjectLength_m "" VALUE 0xfe821158 /* @ECU_Address@P_LSS_ELK_OverObjectLength_m@ */ Record_FLOAT32_IEEE 0 autosar_swc_las_CM_single -3.4E+38 3.4E+38 /end CHARACTERISTIC
/begin CHARACTERISTIC P_LSS_ELK_OverObjectVx_ms "" VALUE 0xfe82115c /* @ECU_Address@P_LSS_ELK_OverObjectVx_ms@ */ Record_FLOAT32_IEEE 0 autosar_swc_las_CM_single -3.4E+38 3.4E+38 /end CHARACTERISTIC
/begin CHARACTERISTIC P_LSS_ELK_OverTaking_TTC "" VALUE 0xfe821160 /* @ECU_Address@P_LSS_ELK_OverTaking_TTC@ */ Record_FLOAT32_IEEE 0 autosar_swc_las_CM_single -3.4E+38 3.4E+38 /end CHARACTERISTIC
/begin CHARACTERISTIC P_LSS_ELK_OvertakingDySw "" VALUE 0xfe82145a /* @ECU_Address@P_LSS_ELK_OvertakingDySw@ */ Record_BOOLEAN 0 autosar_swc_las_CM_boolean 0 1 /end CHARACTERISTIC
/begin CHARACTERISTIC P_LSS_ELK_OvertakingLeftLineKap_TableY "" CURVE 0xfe8214f0 /* @ECU_Address@P_LSS_ELK_OvertakingLeftLineKap_TableY@ */ Record_FLOAT32_IEEE 0 autosar_swc_las_CM_single -3.4E+38 3.4E+38
 /begin AXIS_DESCR COM_AXIS NO_INPUT_QUANTITY autosar_swc_las_CM_single 10 -3.4E+38 3.4E+38 AXIS_PTS_REF P_LSS_ELK_VehSpdKap_TableX /end AXIS_DESCR
/end CHARACTERISTIC
/begin CHARACTERISTIC P_LSS_ELK_OvertakingObjectMaxLatDis_m "" VALUE 0xfe821164 /* @ECU_Address@P_LSS_ELK_OvertakingObjectMaxLatDis_m@ */ Record_FLOAT32_IEEE 0 autosar_swc_las_CM_single -3.4E+38 3.4E+38 /end CHARACTERISTIC
/begin CHARACTERISTIC P_LSS_ELK_OvertakingObjectMinLatDis_m "" VALUE 0xfe821168 /* @ECU_Address@P_LSS_ELK_OvertakingObjectMinLatDis_m@ */ Record_FLOAT32_IEEE 0 autosar_swc_las_CM_single -3.4E+38 3.4E+38 /end CHARACTERISTIC
/begin CHARACTERISTIC P_LSS_ELK_OvertakingRightLineKap_TableY "" CURVE 0xfe821518 /* @ECU_Address@P_LSS_ELK_OvertakingRightLineKap_TableY@ */ Record_FLOAT32_IEEE 0 autosar_swc_las_CM_single -3.4E+38 3.4E+38
 /begin AXIS_DESCR COM_AXIS NO_INPUT_QUANTITY autosar_swc_las_CM_single 10 -3.4E+38 3.4E+38 AXIS_PTS_REF P_LSS_ELK_VehSpdKap_TableX /end AXIS_DESCR
/end CHARACTERISTIC
/begin CHARACTERISTIC P_LSS_ELK_OvertakingTTCSw "" VALUE 0xfe82145b /* @ECU_Address@P_LSS_ELK_OvertakingTTCSw@ */ Record_BOOLEAN 0 autosar_swc_las_CM_boolean 0 1 /end CHARACTERISTIC
/begin CHARACTERISTIC P_LSS_ELK_RiLatDisOffset_m "" VALUE 0xfe82116c /* @ECU_Address@P_LSS_ELK_RiLatDisOffset_m@ */ Record_FLOAT32_IEEE 0 autosar_swc_las_CM_single -3.4E+38 3.4E+38 /end CHARACTERISTIC
/begin CHARACTERISTIC P_LSS_ELK_RightEgeDisOffset_TableY "" CURVE 0xfe821540 /* @ECU_Address@P_LSS_ELK_RightEgeDisOffset_TableY@ */ Record_FLOAT32_IEEE 0 autosar_swc_las_CM_single -3.4E+38 3.4E+38
 /begin AXIS_DESCR COM_AXIS NO_INPUT_QUANTITY autosar_swc_las_CM_single 10 -3.4E+38 3.4E+38 AXIS_PTS_REF P_LSS_ELK_VehSpdRoadEge_TableX /end AXIS_DESCR
/end CHARACTERISTIC
/begin CHARACTERISTIC P_LSS_ELK_RightLaneProb "" VALUE 0xfe821170 /* @ECU_Address@P_LSS_ELK_RightLaneProb@ */ Record_FLOAT32_IEEE 0 autosar_swc_las_CM_single -3.4E+38 3.4E+38 /end CHARACTERISTIC
/begin CHARACTERISTIC P_LSS_ELK_RightMinLatDis_m "" VALUE 0xfe821174 /* @ECU_Address@P_LSS_ELK_RightMinLatDis_m@ */ Record_FLOAT32_IEEE 0 autosar_swc_las_CM_single -3.4E+38 3.4E+38 /end CHARACTERISTIC
/begin CHARACTERISTIC P_LSS_ELK_RightObjMinLatDis_m "" VALUE 0xfe821178 /* @ECU_Address@P_LSS_ELK_RightObjMinLatDis_m@ */ Record_FLOAT32_IEEE 0 autosar_swc_las_CM_single -3.4E+38 3.4E+38 /end CHARACTERISTIC
/begin CHARACTERISTIC P_LSS_ELK_RightOnComingInAreaHiDis_m "" VALUE 0xfe82117c /* @ECU_Address@P_LSS_ELK_RightOnComingInAreaHiDis_m@ */ Record_FLOAT32_IEEE 0 autosar_swc_las_CM_single -3.4E+38 3.4E+38 /end CHARACTERISTIC
/begin CHARACTERISTIC P_LSS_ELK_RightOnComingInAreaLowDis_m "" VALUE 0xfe821180 /* @ECU_Address@P_LSS_ELK_RightOnComingInAreaLowDis_m@ */ Record_FLOAT32_IEEE 0 autosar_swc_las_CM_single -3.4E+38 3.4E+38 /end CHARACTERISTIC
/begin CHARACTERISTIC P_LSS_ELK_RightOnComingOutAreaHiDis_m "" VALUE 0xfe821184 /* @ECU_Address@P_LSS_ELK_RightOnComingOutAreaHiDis_m@ */ Record_FLOAT32_IEEE 0 autosar_swc_las_CM_single -3.4E+38 3.4E+38 /end CHARACTERISTIC
/begin CHARACTERISTIC P_LSS_ELK_RightOnComingOutAreaLowDis_m "" VALUE 0xfe821188 /* @ECU_Address@P_LSS_ELK_RightOnComingOutAreaLowDis_m@ */ Record_FLOAT32_IEEE 0 autosar_swc_las_CM_single -3.4E+38 3.4E+38 /end CHARACTERISTIC
/begin CHARACTERISTIC P_LSS_ELK_RightOnFRWhelDyMinDis "" VALUE 0xfe82118c /* @ECU_Address@P_LSS_ELK_RightOnFRWhelDyMinDis@ */ Record_FLOAT32_IEEE 0 autosar_swc_las_CM_single -3.4E+38 3.4E+38 /end CHARACTERISTIC
/begin CHARACTERISTIC P_LSS_ELK_RightOverFRWhelDyMinDis "" VALUE 0xfe821190 /* @ECU_Address@P_LSS_ELK_RightOverFRWhelDyMinDis@ */ Record_FLOAT32_IEEE 0 autosar_swc_las_CM_single -3.4E+38 3.4E+38 /end CHARACTERISTIC
/begin CHARACTERISTIC P_LSS_ELK_RightOvtakingInAreaHiDis_m "" VALUE 0xfe821194 /* @ECU_Address@P_LSS_ELK_RightOvtakingInAreaHiDis_m@ */ Record_FLOAT32_IEEE 0 autosar_swc_las_CM_single -3.4E+38 3.4E+38 /end CHARACTERISTIC
/begin CHARACTERISTIC P_LSS_ELK_RightOvtakingInAreaLowDis_m "" VALUE 0xfe821198 /* @ECU_Address@P_LSS_ELK_RightOvtakingInAreaLowDis_m@ */ Record_FLOAT32_IEEE 0 autosar_swc_las_CM_single -3.4E+38 3.4E+38 /end CHARACTERISTIC
/begin CHARACTERISTIC P_LSS_ELK_RightOvtakingOutAreaHiDis_m "" VALUE 0xfe82119c /* @ECU_Address@P_LSS_ELK_RightOvtakingOutAreaHiDis_m@ */ Record_FLOAT32_IEEE 0 autosar_swc_las_CM_single -3.4E+38 3.4E+38 /end CHARACTERISTIC
/begin CHARACTERISTIC P_LSS_ELK_RightOvtakingOutAreaLowDis_m "" VALUE 0xfe8211a0 /* @ECU_Address@P_LSS_ELK_RightOvtakingOutAreaLowDis_m@ */ Record_FLOAT32_IEEE 0 autosar_swc_las_CM_single -3.4E+38 3.4E+38 /end CHARACTERISTIC
/begin CHARACTERISTIC P_LSS_ELK_RoadEgeInterSw "" VALUE 0xfe82145c /* @ECU_Address@P_LSS_ELK_RoadEgeInterSw@ */ Record_BOOLEAN 0 autosar_swc_las_CM_boolean 0 1 /end CHARACTERISTIC
/begin CHARACTERISTIC P_LSS_ELK_RoadEgeOffsetSw "" VALUE 0xfe82145d /* @ECU_Address@P_LSS_ELK_RoadEgeOffsetSw@ */ Record_BOOLEAN 0 autosar_swc_las_CM_boolean 0 1 /end CHARACTERISTIC
/begin CHARACTERISTIC P_LSS_ELK_RoadWidthThre_m "" VALUE 0xfe8211a4 /* @ECU_Address@P_LSS_ELK_RoadWidthThre_m@ */ Record_FLOAT32_IEEE 0 autosar_swc_las_CM_single -3.4E+38 3.4E+38 /end CHARACTERISTIC
/begin CHARACTERISTIC P_LSS_ELK_Sensitive_Switch "" VALUE 0xfe821000 /* @ECU_Address@P_LSS_ELK_Sensitive_Switch@ */ Record_FLOAT64_IEEE 0 autosar_swc_las_CM_double -1.7E+308 1.7E+308 /end CHARACTERISTIC
/begin CHARACTERISTIC P_LSS_ELK_Sensitive_Table_Calibration "" CURVE 0xfe8217dc /* @ECU_Address@P_LSS_ELK_Sensitive_Table_Calibration@ */ Record_FLOAT32_IEEE 0 autosar_swc_las_CM_single -3.4E+38 3.4E+38
 /begin AXIS_DESCR COM_AXIS NO_INPUT_QUANTITY autosar_swc_las_CM_single 3 -3.4E+38 3.4E+38 AXIS_PTS_REF P_LSS_ELK_Sensitive_Table /end AXIS_DESCR
/end CHARACTERISTIC
/begin CHARACTERISTIC P_LSS_ELK_ShildDashLineOnlyWarn "" VALUE 0xfe82145e /* @ECU_Address@P_LSS_ELK_ShildDashLineOnlyWarn@ */ Record_BOOLEAN 0 autosar_swc_las_CM_boolean 0 1 /end CHARACTERISTIC
/begin CHARACTERISTIC P_LSS_ELK_StandLaneWid "" VALUE 0xfe8211a8 /* @ECU_Address@P_LSS_ELK_StandLaneWid@ */ Record_FLOAT32_IEEE 0 autosar_swc_las_CM_single -3.4E+38 3.4E+38 /end CHARACTERISTIC
/begin CHARACTERISTIC P_LSS_ELK_State_LineInterventionSWSts "" VALUE 0xfe821465 /* @ECU_Address@P_LSS_ELK_State_LineInterventionSWSts@ */ Record_UBYTE 0 autosar_swc_las_CM_uint8 0 255 /end CHARACTERISTIC
/begin CHARACTERISTIC P_LSS_ELK_State_Param_A0Offset "" VALUE 0xfe8211d8 /* @ECU_Address@P_LSS_ELK_State_Param_A0Offset@ */ Record_FLOAT32_IEEE 0 autosar_swc_las_CM_single -3.4E+38 3.4E+38 /end CHARACTERISTIC
/begin CHARACTERISTIC P_LSS_ELK_State_Param_A1leOffset "" VALUE 0xfe8211dc /* @ECU_Address@P_LSS_ELK_State_Param_A1leOffset@ */ Record_FLOAT32_IEEE 0 autosar_swc_las_CM_single -3.4E+38 3.4E+38 /end CHARACTERISTIC
/begin CHARACTERISTIC P_LSS_ELK_State_Param_AngleOffset "" VALUE 0xfe8211e0 /* @ECU_Address@P_LSS_ELK_State_Param_AngleOffset@ */ Record_FLOAT32_IEEE 0 autosar_swc_las_CM_single -3.4E+38 3.4E+38 /end CHARACTERISTIC
/begin CHARACTERISTIC P_LSS_ELK_State_Param_InterventionZoneOut "" VALUE 0xfe8211e4 /* @ECU_Address@P_LSS_ELK_State_Param_InterventionZoneOut@ */ Record_FLOAT32_IEEE 0 autosar_swc_las_CM_single -3.4E+38 3.4E+38 /end CHARACTERISTIC
/begin CHARACTERISTIC P_LSS_ELK_State_Param_LaneCurve_Offset "" CURVE 0xfe821588 /* @ECU_Address@P_LSS_ELK_State_Param_LaneCurve_Offset@ */ Record_FLOAT32_IEEE 0 autosar_swc_las_CM_single -3.4E+38 3.4E+38
 /begin AXIS_DESCR COM_AXIS NO_INPUT_QUANTITY autosar_swc_las_CM_single 8 -3.4E+38 3.4E+38 AXIS_PTS_REF P_LSS_ELK_State_Param_LaneCurve /end AXIS_DESCR
/end CHARACTERISTIC
/begin CHARACTERISTIC P_LSS_ELK_State_Param_LeftInterventionZoneIn "" VALUE 0xfe8211e8 /* @ECU_Address@P_LSS_ELK_State_Param_LeftInterventionZoneIn@ */ Record_FLOAT32_IEEE 0 autosar_swc_las_CM_single -3.4E+38 3.4E+38 /end CHARACTERISTIC
/begin CHARACTERISTIC P_LSS_ELK_State_Param_OnTime "" CURVE 0xfe8215a8 /* @ECU_Address@P_LSS_ELK_State_Param_OnTime@ */ Record_FLOAT32_IEEE 0 autosar_swc_las_CM_single -3.4E+38 3.4E+38
 /begin AXIS_DESCR COM_AXIS NO_INPUT_QUANTITY autosar_swc_las_CM_single 16 -3.4E+38 3.4E+38 AXIS_PTS_REF P_LSS_ELK_State_Param_Speed /end AXIS_DESCR
/end CHARACTERISTIC
/begin CHARACTERISTIC P_LSS_ELK_State_Param_Oncoming "" VALUE 0xfe8211ec /* @ECU_Address@P_LSS_ELK_State_Param_Oncoming@ */ Record_FLOAT32_IEEE 0 autosar_swc_las_CM_single -3.4E+38 3.4E+38 /end CHARACTERISTIC
/begin CHARACTERISTIC P_LSS_ELK_State_Param_OutOffset "" VALUE 0xfe8211f0 /* @ECU_Address@P_LSS_ELK_State_Param_OutOffset@ */ Record_FLOAT32_IEEE 0 autosar_swc_las_CM_single -3.4E+38 3.4E+38 /end CHARACTERISTIC
/begin CHARACTERISTIC P_LSS_ELK_State_Param_OvTime "" CURVE 0xfe8215e8 /* @ECU_Address@P_LSS_ELK_State_Param_OvTime@ */ Record_FLOAT32_IEEE 0 autosar_swc_las_CM_single -3.4E+38 3.4E+38
 /begin AXIS_DESCR COM_AXIS NO_INPUT_QUANTITY autosar_swc_las_CM_single 16 -3.4E+38 3.4E+38 AXIS_PTS_REF P_LSS_ELK_State_Param_Speed /end AXIS_DESCR
/end CHARACTERISTIC
/begin CHARACTERISTIC P_LSS_ELK_State_Param_Over "" VALUE 0xfe8211f4 /* @ECU_Address@P_LSS_ELK_State_Param_Over@ */ Record_FLOAT32_IEEE 0 autosar_swc_las_CM_single -3.4E+38 3.4E+38 /end CHARACTERISTIC
/begin CHARACTERISTIC P_LSS_ELK_State_Param_RightInterventionZoneIn "" VALUE 0xfe8211f8 /* @ECU_Address@P_LSS_ELK_State_Param_RightInterventionZoneIn@ */ Record_FLOAT32_IEEE 0 autosar_swc_las_CM_single -3.4E+38 3.4E+38 /end CHARACTERISTIC
/begin CHARACTERISTIC P_LSS_ELK_State_Param_WarningZoneIn "" VALUE 0xfe8211fc /* @ECU_Address@P_LSS_ELK_State_Param_WarningZoneIn@ */ Record_FLOAT32_IEEE 0 autosar_swc_las_CM_single -3.4E+38 3.4E+38 /end CHARACTERISTIC
/begin CHARACTERISTIC P_LSS_ELK_State_Param_WarningZoneOut "" VALUE 0xfe821200 /* @ECU_Address@P_LSS_ELK_State_Param_WarningZoneOut@ */ Record_FLOAT32_IEEE 0 autosar_swc_las_CM_single -3.4E+38 3.4E+38 /end CHARACTERISTIC
/begin CHARACTERISTIC P_LSS_ELK_SwitchActive_LineEgeScene "" VALUE 0xfe821467 /* @ECU_Address@P_LSS_ELK_SwitchActive_LineEgeScene@ */ Record_BOOLEAN 0 autosar_swc_las_CM_boolean 0 1 /end CHARACTERISTIC
/begin CHARACTERISTIC P_LSS_ELK_TurnLightInTime "" VALUE 0xfe82122c /* @ECU_Address@P_LSS_ELK_TurnLightInTime@ */ Record_FLOAT32_IEEE 0 autosar_swc_las_CM_single -3.4E+38 3.4E+38 /end CHARACTERISTIC
/begin CHARACTERISTIC P_LSS_ELK_WarnInTime "" VALUE 0xfe821238 /* @ECU_Address@P_LSS_ELK_WarnInTime@ */ Record_FLOAT32_IEEE 0 autosar_swc_las_CM_single -3.4E+38 3.4E+38 /end CHARACTERISTIC
/begin CHARACTERISTIC P_LSS_ELK_Warnarea1 "" VALUE 0xfe82123c /* @ECU_Address@P_LSS_ELK_Warnarea1@ */ Record_FLOAT32_IEEE 0 autosar_swc_las_CM_single -3.4E+38 3.4E+38 /end CHARACTERISTIC
/begin CHARACTERISTIC P_LSS_ELK_Warnarea2 "" VALUE 0xfe821240 /* @ECU_Address@P_LSS_ELK_Warnarea2@ */ Record_FLOAT32_IEEE 0 autosar_swc_las_CM_single -3.4E+38 3.4E+38 /end CHARACTERISTIC
/begin CHARACTERISTIC P_LSS_ELK_WarningZoneOffset "" VALUE 0xfe821244 /* @ECU_Address@P_LSS_ELK_WarningZoneOffset@ */ Record_FLOAT32_IEEE 0 autosar_swc_las_CM_single -3.4E+38 3.4E+38 /end CHARACTERISTIC
/begin CHARACTERISTIC P_LSS_LDPOverrideRecoverTime "" VALUE 0xfe821258 /* @ECU_Address@P_LSS_LDPOverrideRecoverTime@ */ Record_FLOAT32_IEEE 0 autosar_swc_las_CM_single -3.4E+38 3.4E+38 /end CHARACTERISTIC
/begin CHARACTERISTIC P_LSS_LDP_EPSTqVerifyTimeDiff_s "" VALUE 0xfe821264 /* @ECU_Address@P_LSS_LDP_EPSTqVerifyTimeDiff_s@ */ Record_FLOAT32_IEEE 0 autosar_swc_las_CM_single -3.4E+38 3.4E+38 /end CHARACTERISTIC
/begin CHARACTERISTIC P_LSS_LDP_EPSTqVerifyTimeSame_s "" VALUE 0xfe821268 /* @ECU_Address@P_LSS_LDP_EPSTqVerifyTimeSame_s@ */ Record_FLOAT32_IEEE 0 autosar_swc_las_CM_single -3.4E+38 3.4E+38 /end CHARACTERISTIC
/begin CHARACTERISTIC P_LSS_LDP_LcEPSTqVerifyTimeSame_s "" VALUE 0xfe82126c /* @ECU_Address@P_LSS_LDP_LcEPSTqVerifyTimeSame_s@ */ Record_FLOAT32_IEEE 0 autosar_swc_las_CM_single -3.4E+38 3.4E+38 /end CHARACTERISTIC
/begin CHARACTERISTIC P_LSS_LDP_OverrideDiffTrq "" CURVE 0xfe82180c /* @ECU_Address@P_LSS_LDP_OverrideDiffTrq@ */ Record_FLOAT32_IEEE 0 autosar_swc_las_CM_single -3.4E+38 3.4E+38
 /begin AXIS_DESCR COM_AXIS NO_INPUT_QUANTITY autosar_swc_las_CM_single 9 -3.4E+38 3.4E+38 AXIS_PTS_REF P_LSS_LDP_OverideSPd_kmh /end AXIS_DESCR
/end CHARACTERISTIC
/begin CHARACTERISTIC P_LSS_LDP_OverrideSameTrq "" CURVE 0xfe821830 /* @ECU_Address@P_LSS_LDP_OverrideSameTrq@ */ Record_FLOAT32_IEEE 0 autosar_swc_las_CM_single -3.4E+38 3.4E+38
 /begin AXIS_DESCR COM_AXIS NO_INPUT_QUANTITY autosar_swc_las_CM_single 9 -3.4E+38 3.4E+38 AXIS_PTS_REF P_LSS_LDP_OverideSPd_kmh /end AXIS_DESCR
/end CHARACTERISTIC
/begin CHARACTERISTIC P_LSS_LDW_AccRateIn "" VALUE 0xfe821274 /* @ECU_Address@P_LSS_LDW_AccRateIn@ */ Record_FLOAT32_IEEE 0 autosar_swc_las_CM_single -3.4E+38 3.4E+38 /end CHARACTERISTIC
/begin CHARACTERISTIC P_LSS_LDW_AccRateInTime "" VALUE 0xfe821008 /* @ECU_Address@P_LSS_LDW_AccRateInTime@ */ Record_FLOAT64_IEEE 0 autosar_swc_las_CM_double -1.7E+308 1.7E+308 /end CHARACTERISTIC
/begin CHARACTERISTIC P_LSS_LDW_AccRateOut "" VALUE 0xfe821278 /* @ECU_Address@P_LSS_LDW_AccRateOut@ */ Record_FLOAT32_IEEE 0 autosar_swc_las_CM_single -3.4E+38 3.4E+38 /end CHARACTERISTIC
/begin CHARACTERISTIC P_LSS_LDW_AccRateOutTime "" VALUE 0xfe821010 /* @ECU_Address@P_LSS_LDW_AccRateOutTime@ */ Record_FLOAT64_IEEE 0 autosar_swc_las_CM_double -1.7E+308 1.7E+308 /end CHARACTERISTIC
/begin CHARACTERISTIC P_LSS_LDW_BrakePressIn "" VALUE 0xfe82127c /* @ECU_Address@P_LSS_LDW_BrakePressIn@ */ Record_FLOAT32_IEEE 0 autosar_swc_las_CM_single -3.4E+38 3.4E+38 /end CHARACTERISTIC
/begin CHARACTERISTIC P_LSS_LDW_BrakePressInTime "" VALUE 0xfe821018 /* @ECU_Address@P_LSS_LDW_BrakePressInTime@ */ Record_FLOAT64_IEEE 0 autosar_swc_las_CM_double -1.7E+308 1.7E+308 /end CHARACTERISTIC
/begin CHARACTERISTIC P_LSS_LDW_BrakePressOut "" VALUE 0xfe821280 /* @ECU_Address@P_LSS_LDW_BrakePressOut@ */ Record_FLOAT32_IEEE 0 autosar_swc_las_CM_single -3.4E+38 3.4E+38 /end CHARACTERISTIC
/begin CHARACTERISTIC P_LSS_LDW_CurveFactor "" VALUE 0xfe821284 /* @ECU_Address@P_LSS_LDW_CurveFactor@ */ Record_FLOAT32_IEEE 0 autosar_swc_las_CM_single -3.4E+38 3.4E+38 /end CHARACTERISTIC
/begin CHARACTERISTIC P_LSS_LDW_LDPStatecanActive "" VALUE 0xfe821288 /* @ECU_Address@P_LSS_LDW_LDPStatecanActive@ */ Record_FLOAT32_IEEE 0 autosar_swc_las_CM_single -3.4E+38 3.4E+38 /end CHARACTERISTIC
/begin CHARACTERISTIC P_LSS_LDW_LaneCurveIn "" VALUE 0xfe82128c /* @ECU_Address@P_LSS_LDW_LaneCurveIn@ */ Record_FLOAT32_IEEE 0 autosar_swc_las_CM_single -3.4E+38 3.4E+38 /end CHARACTERISTIC
/begin CHARACTERISTIC P_LSS_LDW_LaneCurveOffset_Switch "" VALUE 0xfe821020 /* @ECU_Address@P_LSS_LDW_LaneCurveOffset_Switch@ */ Record_FLOAT64_IEEE 0 autosar_swc_las_CM_double -1.7E+308 1.7E+308 /end CHARACTERISTIC
/begin CHARACTERISTIC P_LSS_LDW_LaneCurveOut "" VALUE 0xfe821290 /* @ECU_Address@P_LSS_LDW_LaneCurveOut@ */ Record_FLOAT32_IEEE 0 autosar_swc_las_CM_single -3.4E+38 3.4E+38 /end CHARACTERISTIC
/begin CHARACTERISTIC P_LSS_LDW_RoadWidthIn "" VALUE 0xfe821294 /* @ECU_Address@P_LSS_LDW_RoadWidthIn@ */ Record_FLOAT32_IEEE 0 autosar_swc_las_CM_single -3.4E+38 3.4E+38 /end CHARACTERISTIC
/begin CHARACTERISTIC P_LSS_LDW_RoadWidthOut "" VALUE 0xfe821298 /* @ECU_Address@P_LSS_LDW_RoadWidthOut@ */ Record_FLOAT32_IEEE 0 autosar_swc_las_CM_single -3.4E+38 3.4E+38 /end CHARACTERISTIC
/begin CHARACTERISTIC P_LSS_LDW_Sensitive_Switch "" VALUE 0xfe821028 /* @ECU_Address@P_LSS_LDW_Sensitive_Switch@ */ Record_FLOAT64_IEEE 0 autosar_swc_las_CM_double -1.7E+308 1.7E+308 /end CHARACTERISTIC
/begin CHARACTERISTIC P_LSS_LDW_SolidLineShildFlag "" VALUE 0xfe82146b /* @ECU_Address@P_LSS_LDW_SolidLineShildFlag@ */ Record_BOOLEAN 0 autosar_swc_las_CM_boolean 0 1 /end CHARACTERISTIC
/begin CHARACTERISTIC P_LSS_LDW_State_Absesp_enable "" VALUE 0xfe82129c /* @ECU_Address@P_LSS_LDW_State_Absesp_enable@ */ Record_FLOAT32_IEEE 0 autosar_swc_las_CM_single -3.4E+38 3.4E+38 /end CHARACTERISTIC
/begin CHARACTERISTIC P_LSS_LDW_State_Accpedalrate_enable "" VALUE 0xfe8212a0 /* @ECU_Address@P_LSS_LDW_State_Accpedalrate_enable@ */ Record_FLOAT32_IEEE 0 autosar_swc_las_CM_single -3.4E+38 3.4E+38 /end CHARACTERISTIC
/begin CHARACTERISTIC P_LSS_LDW_State_Breakpressure_enable "" VALUE 0xfe8212a4 /* @ECU_Address@P_LSS_LDW_State_Breakpressure_enable@ */ Record_FLOAT32_IEEE 0 autosar_swc_las_CM_single -3.4E+38 3.4E+38 /end CHARACTERISTIC
/begin CHARACTERISTIC P_LSS_LDW_State_HazardLmpSwtStsOutTime "" VALUE 0xfe8212a8 /* @ECU_Address@P_LSS_LDW_State_HazardLmpSwtStsOutTime@ */ Record_FLOAT32_IEEE 0 autosar_swc_las_CM_single -3.4E+38 3.4E+38 /end CHARACTERISTIC
/begin CHARACTERISTIC P_LSS_LDW_State_HazardLmpSwtSts_enable "" VALUE 0xfe8212ac /* @ECU_Address@P_LSS_LDW_State_HazardLmpSwtSts_enable@ */ Record_FLOAT32_IEEE 0 autosar_swc_las_CM_single -3.4E+38 3.4E+38 /end CHARACTERISTIC
/begin CHARACTERISTIC P_LSS_LDW_State_Headingangle_enable "" VALUE 0xfe8212b0 /* @ECU_Address@P_LSS_LDW_State_Headingangle_enable@ */ Record_FLOAT32_IEEE 0 autosar_swc_las_CM_single -3.4E+38 3.4E+38 /end CHARACTERISTIC
/begin CHARACTERISTIC P_LSS_LDW_State_Inhibit_enable "" VALUE 0xfe82146c /* @ECU_Address@P_LSS_LDW_State_Inhibit_enable@ */ Record_BOOLEAN 0 autosar_swc_las_CM_boolean 0 1 /end CHARACTERISTIC
/begin CHARACTERISTIC P_LSS_LDW_State_LaneChange_enable "" VALUE 0xfe8212b4 /* @ECU_Address@P_LSS_LDW_State_LaneChange_enable@ */ Record_FLOAT32_IEEE 0 autosar_swc_las_CM_single -3.4E+38 3.4E+38 /end CHARACTERISTIC
/begin CHARACTERISTIC P_LSS_LDW_State_Lane_enable "" VALUE 0xfe8212b8 /* @ECU_Address@P_LSS_LDW_State_Lane_enable@ */ Record_FLOAT32_IEEE 0 autosar_swc_las_CM_single -3.4E+38 3.4E+38 /end CHARACTERISTIC
/begin CHARACTERISTIC P_LSS_LDW_State_LanecurveInTime "" VALUE 0xfe8212bc /* @ECU_Address@P_LSS_LDW_State_LanecurveInTime@ */ Record_FLOAT32_IEEE 0 autosar_swc_las_CM_single -3.4E+38 3.4E+38 /end CHARACTERISTIC
/begin CHARACTERISTIC P_LSS_LDW_State_Lanecurve_enable "" VALUE 0xfe8212c0 /* @ECU_Address@P_LSS_LDW_State_Lanecurve_enable@ */ Record_FLOAT32_IEEE 0 autosar_swc_las_CM_single -3.4E+38 3.4E+38 /end CHARACTERISTIC
/begin CHARACTERISTIC P_LSS_LDW_State_MaxVehspeedInValue "" VALUE 0xfe8212c4 /* @ECU_Address@P_LSS_LDW_State_MaxVehspeedInValue@ */ Record_FLOAT32_IEEE 0 autosar_swc_las_CM_single -3.4E+38 3.4E+38 /end CHARACTERISTIC
/begin CHARACTERISTIC P_LSS_LDW_State_MaxVehspeedOutValue "" VALUE 0xfe8212c8 /* @ECU_Address@P_LSS_LDW_State_MaxVehspeedOutValue@ */ Record_FLOAT32_IEEE 0 autosar_swc_las_CM_single -3.4E+38 3.4E+38 /end CHARACTERISTIC
/begin CHARACTERISTIC P_LSS_LDW_State_MinVehspeedInValue "" VALUE 0xfe8212cc /* @ECU_Address@P_LSS_LDW_State_MinVehspeedInValue@ */ Record_FLOAT32_IEEE 0 autosar_swc_las_CM_single -3.4E+38 3.4E+38 /end CHARACTERISTIC
/begin CHARACTERISTIC P_LSS_LDW_State_MinVehspeedOutValue "" VALUE 0xfe8212d0 /* @ECU_Address@P_LSS_LDW_State_MinVehspeedOutValue@ */ Record_FLOAT32_IEEE 0 autosar_swc_las_CM_single -3.4E+38 3.4E+38 /end CHARACTERISTIC
/begin CHARACTERISTIC P_LSS_LDW_State_Param_CureLaneWidth_offsetfactor "" CURVE 0xfe8218d0 /* @ECU_Address@P_LSS_LDW_State_Param_CureLaneWidth_offsetfactor@ */ Record_FLOAT32_IEEE 0 autosar_swc_las_CM_single -3.4E+38 3.4E+38
 /begin AXIS_DESCR COM_AXIS NO_INPUT_QUANTITY autosar_swc_las_CM_single 7 -3.4E+38 3.4E+38 AXIS_PTS_REF P_LSS_LDW_State_Param_CureLaneWidth /end AXIS_DESCR
/end CHARACTERISTIC
/begin CHARACTERISTIC P_LSS_LDW_State_Param_LaneCurve_Offset "" CURVE 0xfe8216d8 /* @ECU_Address@P_LSS_LDW_State_Param_LaneCurve_Offset@ */ Record_FLOAT32_IEEE 0 autosar_swc_las_CM_single -3.4E+38 3.4E+38
 /begin AXIS_DESCR COM_AXIS NO_INPUT_QUANTITY autosar_swc_las_CM_single 8 -3.4E+38 3.4E+38 AXIS_PTS_REF P_LSS_LDW_State_Param_LaneCurve /end AXIS_DESCR
/end CHARACTERISTIC
/begin CHARACTERISTIC P_LSS_LDW_State_Param_LaneWidth_Offset "" CURVE 0xfe8218ec /* @ECU_Address@P_LSS_LDW_State_Param_LaneWidth_Offset@ */ Record_FLOAT32_IEEE 0 autosar_swc_las_CM_single -3.4E+38 3.4E+38
 /begin AXIS_DESCR COM_AXIS NO_INPUT_QUANTITY autosar_swc_las_CM_single 7 -3.4E+38 3.4E+38 AXIS_PTS_REF P_LSS_LDW_Lane_Width_Table_Calibration /end AXIS_DESCR
/end CHARACTERISTIC
/begin CHARACTERISTIC P_LSS_LDW_State_Param_Sensitive_Offset "" CURVE 0xfe821908 /* @ECU_Address@P_LSS_LDW_State_Param_Sensitive_Offset@ */ Record_FLOAT32_IEEE 0 autosar_swc_las_CM_single -3.4E+38 3.4E+38
 /begin AXIS_DESCR COM_AXIS NO_INPUT_QUANTITY autosar_swc_las_CM_single 3 -3.4E+38 3.4E+38 AXIS_PTS_REF P_LSS_LDW_Sensitive_Table_Calibration /end AXIS_DESCR
/end CHARACTERISTIC
/begin CHARACTERISTIC P_LSS_LDW_State_Param_WarningZoneIn "" VALUE 0xfe8212d4 /* @ECU_Address@P_LSS_LDW_State_Param_WarningZoneIn@ */ Record_FLOAT32_IEEE 0 autosar_swc_las_CM_single -3.4E+38 3.4E+38 /end CHARACTERISTIC
/begin CHARACTERISTIC P_LSS_LDW_State_Param_WarningZoneInNow "" VALUE 0xfe8212d8 /* @ECU_Address@P_LSS_LDW_State_Param_WarningZoneInNow@ */ Record_FLOAT32_IEEE 0 autosar_swc_las_CM_single -3.4E+38 3.4E+38 /end CHARACTERISTIC
/begin CHARACTERISTIC P_LSS_LDW_State_Param_WarningZoneOut "" VALUE 0xfe8212dc /* @ECU_Address@P_LSS_LDW_State_Param_WarningZoneOut@ */ Record_FLOAT32_IEEE 0 autosar_swc_las_CM_single -3.4E+38 3.4E+38 /end CHARACTERISTIC
/begin CHARACTERISTIC P_LSS_LDW_State_SteerWheelSpdOutTime "" VALUE 0xfe8212e0 /* @ECU_Address@P_LSS_LDW_State_SteerWheelSpdOutTime@ */ Record_FLOAT32_IEEE 0 autosar_swc_las_CM_single -3.4E+38 3.4E+38 /end CHARACTERISTIC
/begin CHARACTERISTIC P_LSS_LDW_State_SteerWheelSpd_enable "" VALUE 0xfe8212e4 /* @ECU_Address@P_LSS_LDW_State_SteerWheelSpd_enable@ */ Record_FLOAT32_IEEE 0 autosar_swc_las_CM_single -3.4E+38 3.4E+38 /end CHARACTERISTIC
/begin CHARACTERISTIC P_LSS_LDW_State_Vehspeed_enable "" VALUE 0xfe8212e8 /* @ECU_Address@P_LSS_LDW_State_Vehspeed_enable@ */ Record_FLOAT32_IEEE 0 autosar_swc_las_CM_single -3.4E+38 3.4E+38 /end CHARACTERISTIC
/begin CHARACTERISTIC P_LSS_LDW_State_Vehspeed_enableTime "" VALUE 0xfe8212ec /* @ECU_Address@P_LSS_LDW_State_Vehspeed_enableTime@ */ Record_FLOAT32_IEEE 0 autosar_swc_las_CM_single -3.4E+38 3.4E+38 /end CHARACTERISTIC
/begin CHARACTERISTIC P_LSS_LDW_State_YawsupOutTime "" VALUE 0xfe8212f0 /* @ECU_Address@P_LSS_LDW_State_YawsupOutTime@ */ Record_FLOAT32_IEEE 0 autosar_swc_las_CM_single -3.4E+38 3.4E+38 /end CHARACTERISTIC
/begin CHARACTERISTIC P_LSS_LDW_State_Yawsup_enable "" VALUE 0xfe8212f4 /* @ECU_Address@P_LSS_LDW_State_Yawsup_enable@ */ Record_FLOAT32_IEEE 0 autosar_swc_las_CM_single -3.4E+38 3.4E+38 /end CHARACTERISTIC
/begin CHARACTERISTIC P_LSS_LDW_SteerMinVehspeedOutValue "" VALUE 0xfe8212f8 /* @ECU_Address@P_LSS_LDW_SteerMinVehspeedOutValue@ */ Record_FLOAT32_IEEE 0 autosar_swc_las_CM_single -3.4E+38 3.4E+38 /end CHARACTERISTIC
/begin CHARACTERISTIC P_LSS_LDW_SteerSpd2IDEL_SteerSpdFactor "" VALUE 0xfe821444 /* @ECU_Address@P_LSS_LDW_SteerSpd2IDEL_SteerSpdFactor@ */ Record_UWORD 0 autosar_swc_las_CM_uint16 0 65535 /end CHARACTERISTIC
/begin CHARACTERISTIC P_LSS_LDW_SteerSpd2IEDL_VehicleSpdFactor "" VALUE 0xfe821446 /* @ECU_Address@P_LSS_LDW_SteerSpd2IEDL_VehicleSpdFactor@ */ Record_UWORD 0 autosar_swc_las_CM_uint16 0 65535 /end CHARACTERISTIC
/begin CHARACTERISTIC P_LSS_LDW_SteerSpd2Ready_SteerSpdFactor "" VALUE 0xfe821448 /* @ECU_Address@P_LSS_LDW_SteerSpd2Ready_SteerSpdFactor@ */ Record_UWORD 0 autosar_swc_las_CM_uint16 0 65535 /end CHARACTERISTIC
/begin CHARACTERISTIC P_LSS_LDW_SteerSpd2Ready_VehicleSpdFactor "" VALUE 0xfe82144a /* @ECU_Address@P_LSS_LDW_SteerSpd2Ready_VehicleSpdFactor@ */ Record_UWORD 0 autosar_swc_las_CM_uint16 0 65535 /end CHARACTERISTIC
/begin CHARACTERISTIC P_LSS_LDW_SteerWheelSpdIn "" VALUE 0xfe8212fc /* @ECU_Address@P_LSS_LDW_SteerWheelSpdIn@ */ Record_FLOAT32_IEEE 0 autosar_swc_las_CM_single -3.4E+38 3.4E+38 /end CHARACTERISTIC
/begin CHARACTERISTIC P_LSS_LDW_SteerWheelSpdInTime "" VALUE 0xfe821030 /* @ECU_Address@P_LSS_LDW_SteerWheelSpdInTime@ */ Record_FLOAT64_IEEE 0 autosar_swc_las_CM_double -1.7E+308 1.7E+308 /end CHARACTERISTIC
/begin CHARACTERISTIC P_LSS_LDW_SteerWheelSpdOut "" VALUE 0xfe821300 /* @ECU_Address@P_LSS_LDW_SteerWheelSpdOut@ */ Record_FLOAT32_IEEE 0 autosar_swc_las_CM_single -3.4E+38 3.4E+38 /end CHARACTERISTIC
/begin CHARACTERISTIC P_LSS_LDW_TimePredictedSwitch "" VALUE 0xfe821308 /* @ECU_Address@P_LSS_LDW_TimePredictedSwitch@ */ Record_FLOAT32_IEEE 0 autosar_swc_las_CM_single -3.4E+38 3.4E+38 /end CHARACTERISTIC
/begin CHARACTERISTIC P_LSS_LDW_YawRateIn "" VALUE 0xfe82130c /* @ECU_Address@P_LSS_LDW_YawRateIn@ */ Record_FLOAT32_IEEE 0 autosar_swc_las_CM_single -3.4E+38 3.4E+38 /end CHARACTERISTIC
/begin CHARACTERISTIC P_LSS_LDW_YawRateInTime "" VALUE 0xfe821040 /* @ECU_Address@P_LSS_LDW_YawRateInTime@ */ Record_FLOAT64_IEEE 0 autosar_swc_las_CM_double -1.7E+308 1.7E+308 /end CHARACTERISTIC
/begin CHARACTERISTIC P_LSS_LDW_YawRateOut "" VALUE 0xfe821310 /* @ECU_Address@P_LSS_LDW_YawRateOut@ */ Record_FLOAT32_IEEE 0 autosar_swc_las_CM_single -3.4E+38 3.4E+38 /end CHARACTERISTIC
/begin CHARACTERISTIC P_LSS_LcEPSTqVerifyTimeDiff_s "" VALUE 0xfe821404 /* @ECU_Address@P_LSS_LcEPSTqVerifyTimeDiff_s@ */ Record_FLOAT32_IEEE 0 autosar_swc_las_CM_single -3.4E+38 3.4E+38 /end CHARACTERISTIC
/begin CHARACTERISTIC P_LSS_LcOverrideTrqRatio "" VALUE 0xfe821408 /* @ECU_Address@P_LSS_LcOverrideTrqRatio@ */ Record_FLOAT32_IEEE 0 autosar_swc_las_CM_single -3.4E+38 3.4E+38 /end CHARACTERISTIC
/begin MEASUREMENT LAS_ELK_CenterStableFlag_b "" UBYTE autosar_swc_las_CM_boolean 0 0 0 1 ECU_ADDRESS 0xfe4ae658 /* @ECU_Address@LAS_ELK_CenterStableFlag_b@ */ /end MEASUREMENT
/begin MEASUREMENT LAS_ELK_DashLineInWarningFlag "" UBYTE autosar_swc_las_CM_uint8 0 0 0 255 ECU_ADDRESS 0xfe4ae659 /* @ECU_Address@LAS_ELK_DashLineInWarningFlag@ */ /end MEASUREMENT
/begin MEASUREMENT LAS_ELK_DashLineWarnCount "" FLOAT64_IEEE autosar_swc_las_CM_double 0 0 -1.7E+308 1.7E+308 ECU_ADDRESS 0xfe4adb80 /* @ECU_Address@LAS_ELK_DashLineWarnCount@ */ /end MEASUREMENT
/begin MEASUREMENT LAS_ELK_DashLineWarnwCount "" FLOAT64_IEEE autosar_swc_las_CM_double 0 0 -1.7E+308 1.7E+308 ECU_ADDRESS 0xfe4adb88 /* @ECU_Address@LAS_ELK_DashLineWarnwCount@ */ /end MEASUREMENT
/begin MEASUREMENT LAS_ELK_FiLeftIntervention "" UBYTE autosar_swc_las_CM_boolean 0 0 0 1 ECU_ADDRESS 0xfe4ae65d /* @ECU_Address@LAS_ELK_FiLeftIntervention@ */ /end MEASUREMENT
/begin MEASUREMENT LAS_ELK_FiLeftRoadEgeInter_b "" UBYTE autosar_swc_las_CM_boolean 0 0 0 1 ECU_ADDRESS 0xfe4ae65e /* @ECU_Address@LAS_ELK_FiLeftRoadEgeInter_b@ */ /end MEASUREMENT
/begin MEASUREMENT LAS_ELK_FiRightIntervention "" UBYTE autosar_swc_las_CM_boolean 0 0 0 1 ECU_ADDRESS 0xfe4ae65f /* @ECU_Address@LAS_ELK_FiRightIntervention@ */ /end MEASUREMENT
/begin MEASUREMENT LAS_ELK_FiRightRoadEgeInter_b "" UBYTE autosar_swc_las_CM_boolean 0 0 0 1 ECU_ADDRESS 0xfe4ae660 /* @ECU_Address@LAS_ELK_FiRightRoadEgeInter_b@ */ /end MEASUREMENT
/begin MEASUREMENT LAS_ELK_FinalReady2Active "" UBYTE autosar_swc_las_CM_boolean 0 0 0 1 MATRIX_DIM 1 1 ECU_ADDRESS 0xfe4ae661 /* @ECU_Address@LAS_ELK_FinalReady2Active@ */ /end MEASUREMENT
/begin MEASUREMENT LAS_ELK_LOnComingMinDyKap "" FLOAT32_IEEE autosar_swc_las_CM_single 0 0 -3.4E+38 3.4E+38 ECU_ADDRESS 0xfe4ae520 /* @ECU_Address@LAS_ELK_LOnComingMinDyKap@ */ /end MEASUREMENT
/begin MEASUREMENT LAS_ELK_LOvertakingMinDyKap "" FLOAT32_IEEE autosar_swc_las_CM_single 0 0 -3.4E+38 3.4E+38 ECU_ADDRESS 0xfe4ae524 /* @ECU_Address@LAS_ELK_LOvertakingMinDyKap@ */ /end MEASUREMENT
/begin MEASUREMENT LAS_ELK_Lane_valid "" UBYTE autosar_swc_las_CM_boolean 0 0 0 1 MATRIX_DIM 1 1 ECU_ADDRESS 0xfe4ae663 /* @ECU_Address@LAS_ELK_Lane_valid@ */ /end MEASUREMENT
/begin MEASUREMENT LAS_ELK_LeftDashLineInWarningFlag "" UBYTE autosar_swc_las_CM_boolean 0 0 0 1 ECU_ADDRESS 0xfe4ae665 /* @ECU_Address@LAS_ELK_LeftDashLineInWarningFlag@ */ /end MEASUREMENT
/begin MEASUREMENT LAS_ELK_LeftEgeInventionZone "" FLOAT32_IEEE autosar_swc_las_CM_single 0 0 -3.4E+38 3.4E+38 ECU_ADDRESS 0xfe4ae528 /* @ECU_Address@LAS_ELK_LeftEgeInventionZone@ */ /end MEASUREMENT
/begin MEASUREMENT LAS_ELK_LeftEnd "" UBYTE autosar_swc_las_CM_boolean 0 0 0 1 ECU_ADDRESS 0xfe4ae666 /* @ECU_Address@LAS_ELK_LeftEnd@ */ /end MEASUREMENT
/begin MEASUREMENT LAS_ELK_LeftIntervention "" UBYTE autosar_swc_las_CM_boolean 0 0 0 1 ECU_ADDRESS 0xfe4ae668 /* @ECU_Address@LAS_ELK_LeftIntervention@ */ /end MEASUREMENT
/begin MEASUREMENT LAS_ELK_LeftOnComing2LineMinDy "" FLOAT32_IEEE autosar_swc_las_CM_single 0 0 -3.4E+38 3.4E+38 ECU_ADDRESS 0xfe4ae52c /* @ECU_Address@LAS_ELK_LeftOnComing2LineMinDy@ */ /end MEASUREMENT
/begin MEASUREMENT LAS_ELK_LeftOnComingApproachFlag_b "" UBYTE autosar_swc_las_CM_boolean 0 0 0 1 MATRIX_DIM 1 1 ECU_ADDRESS 0xfe4ae66a /* @ECU_Address@LAS_ELK_LeftOnComingApproachFlag_b@ */ /end MEASUREMENT
/begin MEASUREMENT LAS_ELK_LeftOnComingDyFlag "" UBYTE autosar_swc_las_CM_boolean 0 0 0 1 ECU_ADDRESS 0xfe4ae66b /* @ECU_Address@LAS_ELK_LeftOnComingDyFlag@ */ /end MEASUREMENT
/begin MEASUREMENT LAS_ELK_LeftOnComingFlag_b "" UBYTE autosar_swc_las_CM_boolean 0 0 0 1 MATRIX_DIM 1 1 ECU_ADDRESS 0xfe4ae66c /* @ECU_Address@LAS_ELK_LeftOnComingFlag_b@ */ /end MEASUREMENT
/begin MEASUREMENT LAS_ELK_LeftOnComingKapFlag_b "" UBYTE autosar_swc_las_CM_boolean 0 0 0 1 ECU_ADDRESS 0xfe4ae66d /* @ECU_Address@LAS_ELK_LeftOnComingKapFlag_b@ */ /end MEASUREMENT
/begin MEASUREMENT LAS_ELK_LeftOnComingLatDis "" FLOAT32_IEEE autosar_swc_las_CM_single 0 0 -3.4E+38 3.4E+38 ECU_ADDRESS 0xfe4ae530 /* @ECU_Address@LAS_ELK_LeftOnComingLatDis@ */ /end MEASUREMENT
/begin MEASUREMENT LAS_ELK_LeftOnComingLatDisFlag "" UBYTE autosar_swc_las_CM_boolean 0 0 0 1 ECU_ADDRESS 0xfe4ae66e /* @ECU_Address@LAS_ELK_LeftOnComingLatDisFlag@ */ /end MEASUREMENT
/begin MEASUREMENT LAS_ELK_LeftOnComingLatDisOffsetFlag_b "" UBYTE autosar_swc_las_CM_boolean 0 0 0 1 ECU_ADDRESS 0xfe4ae66f /* @ECU_Address@LAS_ELK_LeftOnComingLatDisOffsetFlag_b@ */ /end MEASUREMENT
/begin MEASUREMENT LAS_ELK_LeftOnComingNoKapFlag_b "" UBYTE autosar_swc_las_CM_boolean 0 0 0 1 MATRIX_DIM 1 1 ECU_ADDRESS 0xfe4ae670 /* @ECU_Address@LAS_ELK_LeftOnComingNoKapFlag_b@ */ /end MEASUREMENT
/begin MEASUREMENT LAS_ELK_LeftOnComingObsFlag "" UBYTE autosar_swc_las_CM_boolean 0 0 0 1 ECU_ADDRESS 0xfe4ae671 /* @ECU_Address@LAS_ELK_LeftOnComingObsFlag@ */ /end MEASUREMENT
/begin MEASUREMENT LAS_ELK_LeftOnComingTTC "" FLOAT32_IEEE autosar_swc_las_CM_single 0 0 -3.4E+38 3.4E+38 ECU_ADDRESS 0xfe4ae534 /* @ECU_Address@LAS_ELK_LeftOnComingTTC@ */ /end MEASUREMENT
/begin MEASUREMENT LAS_ELK_LeftOnComingTTCFlag "" UBYTE autosar_swc_las_CM_boolean 0 0 0 1 ECU_ADDRESS 0xfe4ae672 /* @ECU_Address@LAS_ELK_LeftOnComingTTCFlag@ */ /end MEASUREMENT
/begin MEASUREMENT LAS_ELK_LeftOverObjInAreaFlag_b "" UBYTE autosar_swc_las_CM_boolean 0 0 0 1 ECU_ADDRESS 0xfe4ae674 /* @ECU_Address@LAS_ELK_LeftOverObjInAreaFlag_b@ */ /end MEASUREMENT
/begin MEASUREMENT LAS_ELK_LeftOvertaking2LineMinDy "" FLOAT32_IEEE autosar_swc_las_CM_single 0 0 -3.4E+38 3.4E+38 ECU_ADDRESS 0xfe4ae538 /* @ECU_Address@LAS_ELK_LeftOvertaking2LineMinDy@ */ /end MEASUREMENT
/begin MEASUREMENT LAS_ELK_LeftOvertakingApproachFlag_b "" UBYTE autosar_swc_las_CM_boolean 0 0 0 1 MATRIX_DIM 1 1 ECU_ADDRESS 0xfe4ae675 /* @ECU_Address@LAS_ELK_LeftOvertakingApproachFlag_b@ */ /end MEASUREMENT
/begin MEASUREMENT LAS_ELK_LeftOvertakingDyFlag "" UBYTE autosar_swc_las_CM_boolean 0 0 0 1 ECU_ADDRESS 0xfe4ae676 /* @ECU_Address@LAS_ELK_LeftOvertakingDyFlag@ */ /end MEASUREMENT
/begin MEASUREMENT LAS_ELK_LeftOvertakingFlag_b "" UBYTE autosar_swc_las_CM_boolean 0 0 0 1 MATRIX_DIM 1 1 ECU_ADDRESS 0xfe4ae677 /* @ECU_Address@LAS_ELK_LeftOvertakingFlag_b@ */ /end MEASUREMENT
/begin MEASUREMENT LAS_ELK_LeftOvertakingKapFlag_b "" UBYTE autosar_swc_las_CM_boolean 0 0 0 1 ECU_ADDRESS 0xfe4ae678 /* @ECU_Address@LAS_ELK_LeftOvertakingKapFlag_b@ */ /end MEASUREMENT
/begin MEASUREMENT LAS_ELK_LeftOvertakingLatDis "" FLOAT32_IEEE autosar_swc_las_CM_single 0 0 -3.4E+38 3.4E+38 ECU_ADDRESS 0xfe4ae53c /* @ECU_Address@LAS_ELK_LeftOvertakingLatDis@ */ /end MEASUREMENT
/begin MEASUREMENT LAS_ELK_LeftOvertakingLatDisOffsetFlag_b "" UBYTE autosar_swc_las_CM_boolean 0 0 0 1 ECU_ADDRESS 0xfe4ae679 /* @ECU_Address@LAS_ELK_LeftOvertakingLatDisOffsetFlag_b@ */ /end MEASUREMENT
/begin MEASUREMENT LAS_ELK_LeftOvertakingLatFlag "" UBYTE autosar_swc_las_CM_boolean 0 0 0 1 ECU_ADDRESS 0xfe4ae67a /* @ECU_Address@LAS_ELK_LeftOvertakingLatFlag@ */ /end MEASUREMENT
/begin MEASUREMENT LAS_ELK_LeftOvertakingNoKapFlag_b "" UBYTE autosar_swc_las_CM_boolean 0 0 0 1 MATRIX_DIM 1 1 ECU_ADDRESS 0xfe4ae67b /* @ECU_Address@LAS_ELK_LeftOvertakingNoKapFlag_b@ */ /end MEASUREMENT
/begin MEASUREMENT LAS_ELK_LeftOvertakingTTC "" FLOAT32_IEEE autosar_swc_las_CM_single 0 0 -3.4E+38 3.4E+38 ECU_ADDRESS 0xfe4ae540 /* @ECU_Address@LAS_ELK_LeftOvertakingTTC@ */ /end MEASUREMENT
/begin MEASUREMENT LAS_ELK_LeftOvertakingTTC1 "" FLOAT32_IEEE autosar_swc_las_CM_single 0 0 -3.4E+38 3.4E+38 ECU_ADDRESS 0xfe4ae544 /* @ECU_Address@LAS_ELK_LeftOvertakingTTC1@ */ /end MEASUREMENT
/begin MEASUREMENT LAS_ELK_LeftOvertakingTTCFlag "" UBYTE autosar_swc_las_CM_boolean 0 0 0 1 ECU_ADDRESS 0xfe4ae67c /* @ECU_Address@LAS_ELK_LeftOvertakingTTCFlag@ */ /end MEASUREMENT
/begin MEASUREMENT LAS_ELK_LeftRoadEgeInter_b "" UBYTE autosar_swc_las_CM_boolean 0 0 0 1 ECU_ADDRESS 0xfe4ae67d /* @ECU_Address@LAS_ELK_LeftRoadEgeInter_b@ */ /end MEASUREMENT
/begin MEASUREMENT LAS_ELK_LeftWarn "" UBYTE autosar_swc_las_CM_boolean 0 0 0 1 ECU_ADDRESS 0xfe4ae67e /* @ECU_Address@LAS_ELK_LeftWarn@ */ /end MEASUREMENT
/begin MEASUREMENT LAS_ELK_Leftout "" UBYTE autosar_swc_las_CM_boolean 0 0 0 1 ECU_ADDRESS 0xfe4ae67f /* @ECU_Address@LAS_ELK_Leftout@ */ /end MEASUREMENT
/begin MEASUREMENT LAS_ELK_LineInterState_st "" UBYTE autosar_swc_las_CM_uint8 0 0 0 255 ECU_ADDRESS 0xfe4ae680 /* @ECU_Address@LAS_ELK_LineInterState_st@ */ /end MEASUREMENT
/begin MEASUREMENT LAS_ELK_Lwidth_Valid "" UBYTE autosar_swc_las_CM_boolean 0 0 0 1 MATRIX_DIM 1 1 ECU_ADDRESS 0xfe4ae681 /* @ECU_Address@LAS_ELK_Lwidth_Valid@ */ /end MEASUREMENT
/begin MEASUREMENT LAS_ELK_OnComingFlag_b "" UBYTE autosar_swc_las_CM_uint8 0 0 0 255 ECU_ADDRESS 0xfe4ae682 /* @ECU_Address@LAS_ELK_OnComingFlag_b@ */ /end MEASUREMENT
/begin MEASUREMENT LAS_ELK_OnComing_LOut_b "" UBYTE autosar_swc_las_CM_boolean 0 0 0 1 ECU_ADDRESS 0xfe4ae683 /* @ECU_Address@LAS_ELK_OnComing_LOut_b@ */ /end MEASUREMENT
/begin MEASUREMENT LAS_ELK_OnComing_LetfCondition_b "" UBYTE autosar_swc_las_CM_boolean 0 0 0 1 ECU_ADDRESS 0xfe4ae684 /* @ECU_Address@LAS_ELK_OnComing_LetfCondition_b@ */ /end MEASUREMENT
/begin MEASUREMENT LAS_ELK_OnComing_ROut_b "" UBYTE autosar_swc_las_CM_boolean 0 0 0 1 ECU_ADDRESS 0xfe4ae685 /* @ECU_Address@LAS_ELK_OnComing_ROut_b@ */ /end MEASUREMENT
/begin MEASUREMENT LAS_ELK_OnComing_RightCondition_b "" UBYTE autosar_swc_las_CM_boolean 0 0 0 1 ECU_ADDRESS 0xfe4ae686 /* @ECU_Address@LAS_ELK_OnComing_RightCondition_b@ */ /end MEASUREMENT
/begin MEASUREMENT LAS_ELK_OverTaking_LOut_b "" UBYTE autosar_swc_las_CM_boolean 0 0 0 1 ECU_ADDRESS 0xfe4ae688 /* @ECU_Address@LAS_ELK_OverTaking_LOut_b@ */ /end MEASUREMENT
/begin MEASUREMENT LAS_ELK_OverTaking_LeftCondition_b "" UBYTE autosar_swc_las_CM_boolean 0 0 0 1 ECU_ADDRESS 0xfe4ae689 /* @ECU_Address@LAS_ELK_OverTaking_LeftCondition_b@ */ /end MEASUREMENT
/begin MEASUREMENT LAS_ELK_OverTaking_ROut_b "" UBYTE autosar_swc_las_CM_boolean 0 0 0 1 ECU_ADDRESS 0xfe4ae68a /* @ECU_Address@LAS_ELK_OverTaking_ROut_b@ */ /end MEASUREMENT
/begin MEASUREMENT LAS_ELK_OverTaking_RightCondition_b "" UBYTE autosar_swc_las_CM_boolean 0 0 0 1 ECU_ADDRESS 0xfe4ae68b /* @ECU_Address@LAS_ELK_OverTaking_RightCondition_b@ */ /end MEASUREMENT
/begin MEASUREMENT LAS_ELK_OvertakingFlag_b "" UBYTE autosar_swc_las_CM_uint8 0 0 0 255 ECU_ADDRESS 0xfe4ae68c /* @ECU_Address@LAS_ELK_OvertakingFlag_b@ */ /end MEASUREMENT
/begin MEASUREMENT LAS_ELK_ROnComingMinDyKap "" FLOAT32_IEEE autosar_swc_las_CM_single 0 0 -3.4E+38 3.4E+38 ECU_ADDRESS 0xfe4ae548 /* @ECU_Address@LAS_ELK_ROnComingMinDyKap@ */ /end MEASUREMENT
/begin MEASUREMENT LAS_ELK_RiOnComingApproachFlag_b "" UBYTE autosar_swc_las_CM_boolean 0 0 0 1 MATRIX_DIM 1 1 ECU_ADDRESS 0xfe4ae691 /* @ECU_Address@LAS_ELK_RiOnComingApproachFlag_b@ */ /end MEASUREMENT
/begin MEASUREMENT LAS_ELK_RiOnComingLatDisOffsetFlag_b "" UBYTE autosar_swc_las_CM_boolean 0 0 0 1 ECU_ADDRESS 0xfe4ae692 /* @ECU_Address@LAS_ELK_RiOnComingLatDisOffsetFlag_b@ */ /end MEASUREMENT
/begin MEASUREMENT LAS_ELK_RiOvertakingApproachFlag_b "" UBYTE autosar_swc_las_CM_boolean 0 0 0 1 MATRIX_DIM 1 1 ECU_ADDRESS 0xfe4ae694 /* @ECU_Address@LAS_ELK_RiOvertakingApproachFlag_b@ */ /end MEASUREMENT
/begin MEASUREMENT LAS_ELK_RiOvertakingLatDisOffsetFlag_b "" UBYTE autosar_swc_las_CM_boolean 0 0 0 1 ECU_ADDRESS 0xfe4ae695 /* @ECU_Address@LAS_ELK_RiOvertakingLatDisOffsetFlag_b@ */ /end MEASUREMENT
/begin MEASUREMENT LAS_ELK_RightDashLineInWarningFlag "" UBYTE autosar_swc_las_CM_boolean 0 0 0 1 ECU_ADDRESS 0xfe4ae696 /* @ECU_Address@LAS_ELK_RightDashLineInWarningFlag@ */ /end MEASUREMENT
/begin MEASUREMENT LAS_ELK_RightEgeInventionZone "" FLOAT32_IEEE autosar_swc_las_CM_single 0 0 -3.4E+38 3.4E+38 ECU_ADDRESS 0xfe4ae54c /* @ECU_Address@LAS_ELK_RightEgeInventionZone@ */ /end MEASUREMENT
/begin MEASUREMENT LAS_ELK_RightIntervention "" UBYTE autosar_swc_las_CM_boolean 0 0 0 1 ECU_ADDRESS 0xfe4ae697 /* @ECU_Address@LAS_ELK_RightIntervention@ */ /end MEASUREMENT
/begin MEASUREMENT LAS_ELK_RightInterventionEnd "" UBYTE autosar_swc_las_CM_boolean 0 0 0 1 ECU_ADDRESS 0xfe4ae698 /* @ECU_Address@LAS_ELK_RightInterventionEnd@ */ /end MEASUREMENT
/begin MEASUREMENT LAS_ELK_RightOnComing2LineMinDy "" FLOAT32_IEEE autosar_swc_las_CM_single 0 0 -3.4E+38 3.4E+38 ECU_ADDRESS 0xfe4ae550 /* @ECU_Address@LAS_ELK_RightOnComing2LineMinDy@ */ /end MEASUREMENT
/begin MEASUREMENT LAS_ELK_RightOnComingDyFlag "" UBYTE autosar_swc_las_CM_boolean 0 0 0 1 ECU_ADDRESS 0xfe4ae699 /* @ECU_Address@LAS_ELK_RightOnComingDyFlag@ */ /end MEASUREMENT
/begin MEASUREMENT LAS_ELK_RightOnComingFlag_b "" UBYTE autosar_swc_las_CM_boolean 0 0 0 1 MATRIX_DIM 1 1 ECU_ADDRESS 0xfe4ae69a /* @ECU_Address@LAS_ELK_RightOnComingFlag_b@ */ /end MEASUREMENT
/begin MEASUREMENT LAS_ELK_RightOnComingKapFlag_b "" UBYTE autosar_swc_las_CM_boolean 0 0 0 1 ECU_ADDRESS 0xfe4ae69b /* @ECU_Address@LAS_ELK_RightOnComingKapFlag_b@ */ /end MEASUREMENT
/begin MEASUREMENT LAS_ELK_RightOnComingLatDis "" FLOAT32_IEEE autosar_swc_las_CM_single 0 0 -3.4E+38 3.4E+38 ECU_ADDRESS 0xfe4ae554 /* @ECU_Address@LAS_ELK_RightOnComingLatDis@ */ /end MEASUREMENT
/begin MEASUREMENT LAS_ELK_RightOnComingLatDisFlag "" UBYTE autosar_swc_las_CM_boolean 0 0 0 1 ECU_ADDRESS 0xfe4ae69c /* @ECU_Address@LAS_ELK_RightOnComingLatDisFlag@ */ /end MEASUREMENT
/begin MEASUREMENT LAS_ELK_RightOnComingNoKapFlag_b "" UBYTE autosar_swc_las_CM_boolean 0 0 0 1 MATRIX_DIM 1 1 ECU_ADDRESS 0xfe4ae69d /* @ECU_Address@LAS_ELK_RightOnComingNoKapFlag_b@ */ /end MEASUREMENT
/begin MEASUREMENT LAS_ELK_RightOnComingObsFlag "" UBYTE autosar_swc_las_CM_boolean 0 0 0 1 ECU_ADDRESS 0xfe4ae69e /* @ECU_Address@LAS_ELK_RightOnComingObsFlag@ */ /end MEASUREMENT
/begin MEASUREMENT LAS_ELK_RightOnComingTTC "" FLOAT32_IEEE autosar_swc_las_CM_single 0 0 -3.4E+38 3.4E+38 ECU_ADDRESS 0xfe4ae558 /* @ECU_Address@LAS_ELK_RightOnComingTTC@ */ /end MEASUREMENT
/begin MEASUREMENT LAS_ELK_RightOnComingTTCFlag "" UBYTE autosar_swc_las_CM_boolean 0 0 0 1 ECU_ADDRESS 0xfe4ae69f /* @ECU_Address@LAS_ELK_RightOnComingTTCFlag@ */ /end MEASUREMENT
/begin MEASUREMENT LAS_ELK_RightOverObjInAreaFlag_b "" UBYTE autosar_swc_las_CM_boolean 0 0 0 1 ECU_ADDRESS 0xfe4ae6a0 /* @ECU_Address@LAS_ELK_RightOverObjInAreaFlag_b@ */ /end MEASUREMENT
/begin MEASUREMENT LAS_ELK_RightOvertaking2LineMinDy "" FLOAT32_IEEE autosar_swc_las_CM_single 0 0 -3.4E+38 3.4E+38 ECU_ADDRESS 0xfe4ae55c /* @ECU_Address@LAS_ELK_RightOvertaking2LineMinDy@ */ /end MEASUREMENT
/begin MEASUREMENT LAS_ELK_RightOvertakingDyFlag "" UBYTE autosar_swc_las_CM_boolean 0 0 0 1 ECU_ADDRESS 0xfe4ae6a1 /* @ECU_Address@LAS_ELK_RightOvertakingDyFlag@ */ /end MEASUREMENT
/begin MEASUREMENT LAS_ELK_RightOvertakingFlag_b "" UBYTE autosar_swc_las_CM_boolean 0 0 0 1 MATRIX_DIM 1 1 ECU_ADDRESS 0xfe4ae6a2 /* @ECU_Address@LAS_ELK_RightOvertakingFlag_b@ */ /end MEASUREMENT
/begin MEASUREMENT LAS_ELK_RightOvertakingKapFlag_b "" UBYTE autosar_swc_las_CM_boolean 0 0 0 1 ECU_ADDRESS 0xfe4ae6a3 /* @ECU_Address@LAS_ELK_RightOvertakingKapFlag_b@ */ /end MEASUREMENT
/begin MEASUREMENT LAS_ELK_RightOvertakingLatDis "" FLOAT32_IEEE autosar_swc_las_CM_single 0 0 -3.4E+38 3.4E+38 ECU_ADDRESS 0xfe4ae560 /* @ECU_Address@LAS_ELK_RightOvertakingLatDis@ */ /end MEASUREMENT
/begin MEASUREMENT LAS_ELK_RightOvertakingLatDisKap "" FLOAT32_IEEE autosar_swc_las_CM_single 0 0 -3.4E+38 3.4E+38 ECU_ADDRESS 0xfe4ae564 /* @ECU_Address@LAS_ELK_RightOvertakingLatDisKap@ */ /end MEASUREMENT
/begin MEASUREMENT LAS_ELK_RightOvertakingLatFlag "" UBYTE autosar_swc_las_CM_boolean 0 0 0 1 ECU_ADDRESS 0xfe4ae6a4 /* @ECU_Address@LAS_ELK_RightOvertakingLatFlag@ */ /end MEASUREMENT
/begin MEASUREMENT LAS_ELK_RightOvertakingNoKapFlag_b "" UBYTE autosar_swc_las_CM_boolean 0 0 0 1 MATRIX_DIM 1 1 ECU_ADDRESS 0xfe4ae6a5 /* @ECU_Address@LAS_ELK_RightOvertakingNoKapFlag_b@ */ /end MEASUREMENT
/begin MEASUREMENT LAS_ELK_RightOvertakingTTC "" FLOAT32_IEEE autosar_swc_las_CM_single 0 0 -3.4E+38 3.4E+38 ECU_ADDRESS 0xfe4ae568 /* @ECU_Address@LAS_ELK_RightOvertakingTTC@ */ /end MEASUREMENT
/begin MEASUREMENT LAS_ELK_RightOvertakingTTC1 "" FLOAT32_IEEE autosar_swc_las_CM_single 0 0 -3.4E+38 3.4E+38 ECU_ADDRESS 0xfe4ae56c /* @ECU_Address@LAS_ELK_RightOvertakingTTC1@ */ /end MEASUREMENT
/begin MEASUREMENT LAS_ELK_RightOvertakingTTCFlag "" UBYTE autosar_swc_las_CM_boolean 0 0 0 1 ECU_ADDRESS 0xfe4ae6a6 /* @ECU_Address@LAS_ELK_RightOvertakingTTCFlag@ */ /end MEASUREMENT
/begin MEASUREMENT LAS_ELK_RightRoadEgeInter_b "" UBYTE autosar_swc_las_CM_boolean 0 0 0 1 ECU_ADDRESS 0xfe4ae6a7 /* @ECU_Address@LAS_ELK_RightRoadEgeInter_b@ */ /end MEASUREMENT
/begin MEASUREMENT LAS_ELK_RightWarn "" UBYTE autosar_swc_las_CM_boolean 0 0 0 1 ECU_ADDRESS 0xfe4ae6a8 /* @ECU_Address@LAS_ELK_RightWarn@ */ /end MEASUREMENT
/begin MEASUREMENT LAS_ELK_Rightout "" UBYTE autosar_swc_las_CM_boolean 0 0 0 1 ECU_ADDRESS 0xfe4ae6a9 /* @ECU_Address@LAS_ELK_Rightout@ */ /end MEASUREMENT
/begin MEASUREMENT LAS_ELK_RoadEgeInterState_st "" UBYTE autosar_swc_las_CM_uint8 0 0 0 255 ECU_ADDRESS 0xfe4ae6aa /* @ECU_Address@LAS_ELK_RoadEgeInterState_st@ */ /end MEASUREMENT
/begin MEASUREMENT LAS_ELK_RoadWidth "" FLOAT32_IEEE autosar_swc_las_CM_single 0 0 -3.4E+38 3.4E+38 MATRIX_DIM 1 1 ECU_ADDRESS 0xfe4ae570 /* @ECU_Address@LAS_ELK_RoadWidth@ */ /end MEASUREMENT
/begin MEASUREMENT LAS_ELK_Warning "" UBYTE autosar_swc_las_CM_uint8 0 0 0 255 MATRIX_DIM 1 1 ECU_ADDRESS 0xfe4ae6ac /* @ECU_Address@LAS_ELK_Warning@ */ /end MEASUREMENT
/begin MEASUREMENT LAS_ELK_incount "" FLOAT64_IEEE autosar_swc_las_CM_double 0 0 -1.7E+308 1.7E+308 ECU_ADDRESS 0xfe4adb90 /* @ECU_Address@LAS_ELK_incount@ */ /end MEASUREMENT
/begin MEASUREMENT LAS_ELK_wcount "" FLOAT64_IEEE autosar_swc_las_CM_double 0 0 -1.7E+308 1.7E+308 ECU_ADDRESS 0xfe4adb98 /* @ECU_Address@LAS_ELK_wcount@ */ /end MEASUREMENT
/begin MEASUREMENT LAS_FLEgeDy "" FLOAT32_IEEE autosar_swc_las_CM_single 0 0 -3.4E+38 3.4E+38 ECU_ADDRESS 0xfe4ae578 /* @ECU_Address@LAS_FLEgeDy@ */ /end MEASUREMENT
/begin MEASUREMENT LAS_FLWhelDy "" FLOAT32_IEEE autosar_swc_las_CM_single 0 0 -3.4E+38 3.4E+38 MATRIX_DIM 1 1 ECU_ADDRESS 0xfe4ae57c /* @ECU_Address@LAS_FLWhelDy@ */ /end MEASUREMENT
/begin MEASUREMENT LAS_FREgeDy "" FLOAT32_IEEE autosar_swc_las_CM_single 0 0 -3.4E+38 3.4E+38 ECU_ADDRESS 0xfe4ae580 /* @ECU_Address@LAS_FREgeDy@ */ /end MEASUREMENT
/begin MEASUREMENT LAS_FRWhelDy "" FLOAT32_IEEE autosar_swc_las_CM_single 0 0 -3.4E+38 3.4E+38 MATRIX_DIM 1 1 ECU_ADDRESS 0xfe4ae584 /* @ECU_Address@LAS_FRWhelDy@ */ /end MEASUREMENT
/begin MEASUREMENT LAS_LDWSts "" UBYTE autosar_swc_las_CM_uint8 0 0 0 255 ECU_ADDRESS 0xfe4ae6ad /* @ECU_Address@LAS_LDWSts@ */ /end MEASUREMENT
/begin MEASUREMENT LAS_LDW_Counter "" UBYTE autosar_swc_las_CM_uint8 0 0 0 255 ECU_ADDRESS 0xfe4ae6af /* @ECU_Address@LAS_LDW_Counter@ */ /end MEASUREMENT
/begin MEASUREMENT LAS_LDW_Error "" UBYTE autosar_swc_las_CM_uint8 0 0 0 255 MATRIX_DIM 1 1 ECU_ADDRESS 0xfe4ae6b0 /* @ECU_Address@LAS_LDW_Error@ */ /end MEASUREMENT
/begin MEASUREMENT LAS_LDW_Idle2Ready "" UBYTE autosar_swc_las_CM_boolean 0 0 0 1 MATRIX_DIM 1 1 ECU_ADDRESS 0xfe4ae6b1 /* @ECU_Address@LAS_LDW_Idle2Ready@ */ /end MEASUREMENT
/begin MEASUREMENT LAS_LDW_LeftShiledSolidWarnFlag "" UBYTE autosar_swc_las_CM_boolean 0 0 0 1 ECU_ADDRESS 0xfe4ae6b6 /* @ECU_Address@LAS_LDW_LeftShiledSolidWarnFlag@ */ /end MEASUREMENT
/begin MEASUREMENT LAS_LDW_Leftwarnflag "" UBYTE autosar_swc_las_CM_boolean 0 0 0 1 ECU_ADDRESS 0xfe4ae6b7 /* @ECU_Address@LAS_LDW_Leftwarnflag@ */ /end MEASUREMENT
/begin MEASUREMENT LAS_LDW_Number "" UWORD autosar_swc_las_CM_uint16 0 0 0 65535 ECU_ADDRESS 0xfe4ae652 /* @ECU_Address@LAS_LDW_Number@ */ /end MEASUREMENT
/begin MEASUREMENT LAS_LDW_Other2Idle "" UBYTE autosar_swc_las_CM_boolean 0 0 0 1 MATRIX_DIM 1 1 ECU_ADDRESS 0xfe4ae6b8 /* @ECU_Address@LAS_LDW_Other2Idle@ */ /end MEASUREMENT
/begin MEASUREMENT LAS_LDW_RightShiledSolidWarnFlag "" UBYTE autosar_swc_las_CM_boolean 0 0 0 1 ECU_ADDRESS 0xfe4ae6be /* @ECU_Address@LAS_LDW_RightShiledSolidWarnFlag@ */ /end MEASUREMENT
/begin MEASUREMENT LAS_LDW_Rightwarnflag "" UBYTE autosar_swc_las_CM_boolean 0 0 0 1 ECU_ADDRESS 0xfe4ae6bf /* @ECU_Address@LAS_LDW_Rightwarnflag@ */ /end MEASUREMENT
/begin MEASUREMENT LAS_LDW_VERSION "" ULONG autosar_swc_las_CM_uint32 0 0 0 4294967295 ECU_ADDRESS 0xfe4ae58c /* @ECU_Address@LAS_LDW_VERSION@ */ /end MEASUREMENT
/begin MEASUREMENT LAS_Reserve5 "" FLOAT32_IEEE autosar_swc_las_CM_single 0 0 -3.4E+38 3.4E+38 ECU_ADDRESS 0xfe4ae5ac /* @ECU_Address@LAS_Reserve5@ */ /end MEASUREMENT
/begin MEASUREMENT LAS_Reserve6 "" FLOAT32_IEEE autosar_swc_las_CM_single 0 0 -3.4E+38 3.4E+38 ECU_ADDRESS 0xfe4ae5b0 /* @ECU_Address@LAS_Reserve6@ */ /end MEASUREMENT
/begin MEASUREMENT LAS_SCM_HeadingAngIn_b "" UBYTE autosar_swc_las_CM_boolean 0 0 0 1 MATRIX_DIM 1 1 ECU_ADDRESS 0xfe4ae6dc /* @ECU_Address@LAS_SCM_HeadingAngIn_b@ */ /end MEASUREMENT
/begin MEASUREMENT LAS_SCM_HeadingAngOut_b "" UBYTE autosar_swc_las_CM_boolean 0 0 0 1 MATRIX_DIM 1 1 ECU_ADDRESS 0xfe4ae6dd /* @ECU_Address@LAS_SCM_HeadingAngOut_b@ */ /end MEASUREMENT
/begin MEASUREMENT LAS_SCM_LeftChange_b "" UBYTE autosar_swc_las_CM_boolean 0 0 0 1 ECU_ADDRESS 0xfe4ae6de /* @ECU_Address@LAS_SCM_LeftChange_b@ */ /end MEASUREMENT
/begin MEASUREMENT LAS_SCM_LeftEdgLineNear_b "" UBYTE autosar_swc_las_CM_boolean 0 0 0 1 MATRIX_DIM 1 1 ECU_ADDRESS 0xfe4ae6df /* @ECU_Address@LAS_SCM_LeftEdgLineNear_b@ */ /end MEASUREMENT
/begin MEASUREMENT LAS_SCM_LeftLaneNear_b "" UBYTE autosar_swc_las_CM_boolean 0 0 0 1 MATRIX_DIM 1 1 ECU_ADDRESS 0xfe4ae6e1 /* @ECU_Address@LAS_SCM_LeftLaneNear_b@ */ /end MEASUREMENT
/begin MEASUREMENT LAS_SCM_RightChange_b "" UBYTE autosar_swc_las_CM_boolean 0 0 0 1 ECU_ADDRESS 0xfe4ae6e3 /* @ECU_Address@LAS_SCM_RightChange_b@ */ /end MEASUREMENT
/begin MEASUREMENT LAS_SCM_RightEdgLineNear_b "" UBYTE autosar_swc_las_CM_boolean 0 0 0 1 MATRIX_DIM 1 1 ECU_ADDRESS 0xfe4ae6e4 /* @ECU_Address@LAS_SCM_RightEdgLineNear_b@ */ /end MEASUREMENT
/begin MEASUREMENT LAS_SCM_RightLaneNear_b "" UBYTE autosar_swc_las_CM_boolean 0 0 0 1 MATRIX_DIM 1 1 ECU_ADDRESS 0xfe4ae6e6 /* @ECU_Address@LAS_SCM_RightLaneNear_b@ */ /end MEASUREMENT
/begin MEASUREMENT LAS_SCM_VehNearLOrRLine_st "" UBYTE autosar_swc_las_CM_uint8 0 0 0 255 ECU_ADDRESS 0xfe4ae6e8 /* @ECU_Address@LAS_SCM_VehNearLOrRLine_st@ */ /end MEASUREMENT
/begin MEASUREMENT LAS_preFLWhelDy "" FLOAT32_IEEE autosar_swc_las_CM_single 0 0 -3.4E+38 3.4E+38 ECU_ADDRESS 0xfe4ae600 /* @ECU_Address@LAS_preFLWhelDy@ */ /end MEASUREMENT
/begin MEASUREMENT LAS_preFRWhelDy "" FLOAT32_IEEE autosar_swc_las_CM_single 0 0 -3.4E+38 3.4E+38 ECU_ADDRESS 0xfe4ae604 /* @ECU_Address@LAS_preFRWhelDy@ */ /end MEASUREMENT
/begin MEASUREMENT autosar_swc_las_rtARID_DEF.Delay_DSTATE_c "" FLOAT32_IEEE autosar_swc_las_CM_single 0 0 -3.4E+38 3.4E+38 LAYOUT COLUMN_DIR MATRIX_DIM 5 ECU_ADDRESS 0xfe4ae348 /* @ECU_Address@autosar_swc_las_rtARID_DEF.Delay_DSTATE_c@ */ /end MEASUREMENT
/begin MEASUREMENT autosar_swc_las_rtARID_DEF.L "" FLOAT64_IEEE autosar_swc_las_CM_double 0 0 -1.7E+308 1.7E+308 ECU_ADDRESS 0xfe4ae2d0 /* @ECU_Address@autosar_swc_las_rtARID_DEF.L@ */ /end MEASUREMENT
/begin MEASUREMENT autosar_swc_las_rtARID_DEF.Output_DSTATE_i "" UBYTE autosar_swc_las_CM_uint8 0 0 0 255 ECU_ADDRESS 0xfe4ae4c5 /* @ECU_Address@autosar_swc_las_rtARID_DEF.Output_DSTATE_i@ */ /end MEASUREMENT
/begin MEASUREMENT autosar_swc_las_rtARID_DEF.R "" FLOAT64_IEEE autosar_swc_las_CM_double 0 0 -1.7E+308 1.7E+308 ECU_ADDRESS 0xfe4ae2d8 /* @ECU_Address@autosar_swc_las_rtARID_DEF.R@ */ /end MEASUREMENT
/begin MEASUREMENT autosar_swc_las_rtARID_DEF.UnitDelay1_DSTATE "" FLOAT64_IEEE autosar_swc_las_CM_double 0 0 -1.7E+308 1.7E+308 ECU_ADDRESS 0xfe4ae2b8 /* @ECU_Address@autosar_swc_las_rtARID_DEF.UnitDelay1_DSTATE@ */ /end MEASUREMENT
/begin MEASUREMENT autosar_swc_las_rtARID_DEF.UnitDelay1_DSTATE_ae "" FLOAT32_IEEE autosar_swc_las_CM_single 0 0 -3.4E+38 3.4E+38 ECU_ADDRESS 0xfe4ae448 /* @ECU_Address@autosar_swc_las_rtARID_DEF.UnitDelay1_DSTATE_ae@ */ /end MEASUREMENT
/begin MEASUREMENT autosar_swc_las_rtARID_DEF.UnitDelay1_DSTATE_cs "" UBYTE autosar_swc_las_CM_uint8 0 0 0 255 LAYOUT COLUMN_DIR MATRIX_DIM 4 ECU_ADDRESS 0xfe4ae4a0 /* @ECU_Address@autosar_swc_las_rtARID_DEF.UnitDelay1_DSTATE_cs@ */ /end MEASUREMENT
/begin MEASUREMENT autosar_swc_las_rtARID_DEF.UnitDelay1_DSTATE_d "" UBYTE autosar_swc_las_CM_logical 0 0 0 1 ECU_ADDRESS 0xfe4ae50e /* @ECU_Address@autosar_swc_las_rtARID_DEF.UnitDelay1_DSTATE_d@ */ /end MEASUREMENT
/begin MEASUREMENT autosar_swc_las_rtARID_DEF.UnitDelay1_DSTATE_f1 "" UBYTE autosar_swc_las_CM_logical 0 0 0 1 ECU_ADDRESS 0xfe4ae51b /* @ECU_Address@autosar_swc_las_rtARID_DEF.UnitDelay1_DSTATE_f1@ */ /end MEASUREMENT
/begin MEASUREMENT autosar_swc_las_rtARID_DEF.UnitDelay1_DSTATE_j "" UBYTE autosar_swc_las_CM_logical 0 0 0 1 ECU_ADDRESS 0xfe4ae517 /* @ECU_Address@autosar_swc_las_rtARID_DEF.UnitDelay1_DSTATE_j@ */ /end MEASUREMENT
/begin MEASUREMENT autosar_swc_las_rtARID_DEF.UnitDelay1_DSTATE_l "" UBYTE autosar_swc_las_CM_logical 0 0 0 1 ECU_ADDRESS 0xfe4ae513 /* @ECU_Address@autosar_swc_las_rtARID_DEF.UnitDelay1_DSTATE_l@ */ /end MEASUREMENT
/begin MEASUREMENT autosar_swc_las_rtARID_DEF.UnitDelay2_DSTATE_ba "" FLOAT32_IEEE autosar_swc_las_CM_single 0 0 -3.4E+38 3.4E+38 ECU_ADDRESS 0xfe4ae43c /* @ECU_Address@autosar_swc_las_rtARID_DEF.UnitDelay2_DSTATE_ba@ */ /end MEASUREMENT
/begin MEASUREMENT autosar_swc_las_rtARID_DEF.UnitDelay2_DSTATE_bl "" UBYTE autosar_swc_las_CM_logical 0 0 0 1 ECU_ADDRESS 0xfe4ae514 /* @ECU_Address@autosar_swc_las_rtARID_DEF.UnitDelay2_DSTATE_bl@ */ /end MEASUREMENT
/begin MEASUREMENT autosar_swc_las_rtARID_DEF.UnitDelay2_DSTATE_k "" UBYTE autosar_swc_las_CM_logical 0 0 0 1 ECU_ADDRESS 0xfe4ae518 /* @ECU_Address@autosar_swc_las_rtARID_DEF.UnitDelay2_DSTATE_k@ */ /end MEASUREMENT
/begin MEASUREMENT autosar_swc_las_rtARID_DEF.UnitDelay2_DSTATE_mz "" UBYTE autosar_swc_las_CM_logical 0 0 0 1 ECU_ADDRESS 0xfe4ae50f /* @ECU_Address@autosar_swc_las_rtARID_DEF.UnitDelay2_DSTATE_mz@ */ /end MEASUREMENT
/begin MEASUREMENT autosar_swc_las_rtARID_DEF.UnitDelay2_DSTATE_o "" UBYTE autosar_swc_las_CM_logical 0 0 0 1 ECU_ADDRESS 0xfe4ae51c /* @ECU_Address@autosar_swc_las_rtARID_DEF.UnitDelay2_DSTATE_o@ */ /end MEASUREMENT
/begin MEASUREMENT autosar_swc_las_rtARID_DEF.UnitDelay3_DSTATE_hr "" UBYTE autosar_swc_las_CM_logical 0 0 0 1 ECU_ADDRESS 0xfe4ae515 /* @ECU_Address@autosar_swc_las_rtARID_DEF.UnitDelay3_DSTATE_hr@ */ /end MEASUREMENT
/begin MEASUREMENT autosar_swc_las_rtARID_DEF.UnitDelay3_DSTATE_m "" UBYTE autosar_swc_las_CM_logical 0 0 0 1 ECU_ADDRESS 0xfe4ae519 /* @ECU_Address@autosar_swc_las_rtARID_DEF.UnitDelay3_DSTATE_m@ */ /end MEASUREMENT
/begin MEASUREMENT autosar_swc_las_rtARID_DEF.UnitDelay3_DSTATE_n "" UBYTE autosar_swc_las_CM_uint8 0 0 0 255 ECU_ADDRESS 0xfe4ae4bb /* @ECU_Address@autosar_swc_las_rtARID_DEF.UnitDelay3_DSTATE_n@ */ /end MEASUREMENT
/begin MEASUREMENT autosar_swc_las_rtARID_DEF.UnitDelay3_DSTATE_nf "" UBYTE autosar_swc_las_CM_logical 0 0 0 1 ECU_ADDRESS 0xfe4ae51d /* @ECU_Address@autosar_swc_las_rtARID_DEF.UnitDelay3_DSTATE_nf@ */ /end MEASUREMENT
/begin MEASUREMENT autosar_swc_las_rtARID_DEF.UnitDelay4_DSTATE_a "" UBYTE autosar_swc_las_CM_logical 0 0 0 1 ECU_ADDRESS 0xfe4ae50d /* @ECU_Address@autosar_swc_las_rtARID_DEF.UnitDelay4_DSTATE_a@ */ /end MEASUREMENT
/begin MEASUREMENT autosar_swc_las_rtARID_DEF.UnitDelay4_DSTATE_c "" UBYTE autosar_swc_las_CM_uint8 0 0 0 255 LAYOUT COLUMN_DIR MATRIX_DIM 4 ECU_ADDRESS 0xfe4ae4a8 /* @ECU_Address@autosar_swc_las_rtARID_DEF.UnitDelay4_DSTATE_c@ */ /end MEASUREMENT
/begin MEASUREMENT autosar_swc_las_rtARID_DEF.UnitDelay5_DSTATE_ny "" UBYTE autosar_swc_las_CM_logical 0 0 0 1 ECU_ADDRESS 0xfe4ae50c /* @ECU_Address@autosar_swc_las_rtARID_DEF.UnitDelay5_DSTATE_ny@ */ /end MEASUREMENT
/begin MEASUREMENT autosar_swc_las_rtARID_DEF.UnitDelay6_DSTATE "" FLOAT64_IEEE autosar_swc_las_CM_double 0 0 -1.7E+308 1.7E+308 ECU_ADDRESS 0xfe4ae2b0 /* @ECU_Address@autosar_swc_las_rtARID_DEF.UnitDelay6_DSTATE@ */ /end MEASUREMENT
/begin MEASUREMENT autosar_swc_las_rtARID_DEF.UnitDelay8_DSTATE_i "" UBYTE autosar_swc_las_CM_logical 0 0 0 1 ECU_ADDRESS 0xfe4ae51e /* @ECU_Address@autosar_swc_las_rtARID_DEF.UnitDelay8_DSTATE_i@ */ /end MEASUREMENT
/begin MEASUREMENT autosar_swc_las_rtARID_DEF.UnitDelay8_DSTATE_j "" UBYTE autosar_swc_las_CM_logical 0 0 0 1 ECU_ADDRESS 0xfe4ae51a /* @ECU_Address@autosar_swc_las_rtARID_DEF.UnitDelay8_DSTATE_j@ */ /end MEASUREMENT
/begin MEASUREMENT autosar_swc_las_rtARID_DEF.UnitDelay_DSTATE_a0 "" UBYTE autosar_swc_las_CM_logical 0 0 0 1 ECU_ADDRESS 0xfe4ae512 /* @ECU_Address@autosar_swc_las_rtARID_DEF.UnitDelay_DSTATE_a0@ */ /end MEASUREMENT
/begin MEASUREMENT autosar_swc_las_rtARID_DEF.UnitDelay_DSTATE_bc "" FLOAT32_IEEE autosar_swc_las_CM_single 0 0 -3.4E+38 3.4E+38 ECU_ADDRESS 0xfe4ae470 /* @ECU_Address@autosar_swc_las_rtARID_DEF.UnitDelay_DSTATE_bc@ */ /end MEASUREMENT
/begin MEASUREMENT autosar_swc_las_rtARID_DEF.UnitDelay_DSTATE_bi "" FLOAT64_IEEE autosar_swc_las_CM_double 0 0 -1.7E+308 1.7E+308 ECU_ADDRESS 0xfe4ae218 /* @ECU_Address@autosar_swc_las_rtARID_DEF.UnitDelay_DSTATE_bi@ */ /end MEASUREMENT
/begin MEASUREMENT autosar_swc_las_rtARID_DEF.UnitDelay_DSTATE_bq "" FLOAT32_IEEE autosar_swc_las_CM_single 0 0 -3.4E+38 3.4E+38 ECU_ADDRESS 0xfe4ae440 /* @ECU_Address@autosar_swc_las_rtARID_DEF.UnitDelay_DSTATE_bq@ */ /end MEASUREMENT
/begin MEASUREMENT autosar_swc_las_rtARID_DEF.UnitDelay_DSTATE_cm "" FLOAT64_IEEE autosar_swc_las_CM_double 0 0 -1.7E+308 1.7E+308 ECU_ADDRESS 0xfe4ae0b8 /* @ECU_Address@autosar_swc_las_rtARID_DEF.UnitDelay_DSTATE_cm@ */ /end MEASUREMENT
/begin MEASUREMENT autosar_swc_las_rtARID_DEF.UnitDelay_DSTATE_ct "" FLOAT64_IEEE autosar_swc_las_CM_double 0 0 -1.7E+308 1.7E+308 ECU_ADDRESS 0xfe4ae280 /* @ECU_Address@autosar_swc_las_rtARID_DEF.UnitDelay_DSTATE_ct@ */ /end MEASUREMENT
/begin MEASUREMENT autosar_swc_las_rtARID_DEF.UnitDelay_DSTATE_da "" FLOAT64_IEEE autosar_swc_las_CM_double 0 0 -1.7E+308 1.7E+308 ECU_ADDRESS 0xfe4ae2a8 /* @ECU_Address@autosar_swc_las_rtARID_DEF.UnitDelay_DSTATE_da@ */ /end MEASUREMENT
/begin MEASUREMENT autosar_swc_las_rtARID_DEF.UnitDelay_DSTATE_db "" FLOAT32_IEEE autosar_swc_las_CM_single 0 0 -3.4E+38 3.4E+38 ECU_ADDRESS 0xfe4ae474 /* @ECU_Address@autosar_swc_las_rtARID_DEF.UnitDelay_DSTATE_db@ */ /end MEASUREMENT
/begin MEASUREMENT autosar_swc_las_rtARID_DEF.UnitDelay_DSTATE_dbu "" UBYTE autosar_swc_las_CM_uint8 0 0 0 255 ECU_ADDRESS 0xfe4ae4bc /* @ECU_Address@autosar_swc_las_rtARID_DEF.UnitDelay_DSTATE_dbu@ */ /end MEASUREMENT
/begin MEASUREMENT autosar_swc_las_rtARID_DEF.UnitDelay_DSTATE_dk "" FLOAT32_IEEE autosar_swc_las_CM_single 0 0 -3.4E+38 3.4E+38 ECU_ADDRESS 0xfe4ae424 /* @ECU_Address@autosar_swc_las_rtARID_DEF.UnitDelay_DSTATE_dk@ */ /end MEASUREMENT
/begin MEASUREMENT autosar_swc_las_rtARID_DEF.UnitDelay_DSTATE_dn "" FLOAT64_IEEE autosar_swc_las_CM_double 0 0 -1.7E+308 1.7E+308 ECU_ADDRESS 0xfe4ae290 /* @ECU_Address@autosar_swc_las_rtARID_DEF.UnitDelay_DSTATE_dn@ */ /end MEASUREMENT
/begin MEASUREMENT autosar_swc_las_rtARID_DEF.UnitDelay_DSTATE_edh "" FLOAT32_IEEE autosar_swc_las_CM_single 0 0 -3.4E+38 3.4E+38 ECU_ADDRESS 0xfe4ae47c /* @ECU_Address@autosar_swc_las_rtARID_DEF.UnitDelay_DSTATE_edh@ */ /end MEASUREMENT
/begin MEASUREMENT autosar_swc_las_rtARID_DEF.UnitDelay_DSTATE_f2 "" FLOAT64_IEEE autosar_swc_las_CM_double 0 0 -1.7E+308 1.7E+308 ECU_ADDRESS 0xfe4ae0c0 /* @ECU_Address@autosar_swc_las_rtARID_DEF.UnitDelay_DSTATE_f2@ */ /end MEASUREMENT
/begin MEASUREMENT autosar_swc_las_rtARID_DEF.UnitDelay_DSTATE_fk "" UBYTE autosar_swc_las_CM_logical 0 0 0 1 ECU_ADDRESS 0xfe4ae511 /* @ECU_Address@autosar_swc_las_rtARID_DEF.UnitDelay_DSTATE_fk@ */ /end MEASUREMENT
/begin MEASUREMENT autosar_swc_las_rtARID_DEF.UnitDelay_DSTATE_fq "" UBYTE autosar_swc_las_CM_uint8 0 0 0 255 ECU_ADDRESS 0xfe4ae4ba /* @ECU_Address@autosar_swc_las_rtARID_DEF.UnitDelay_DSTATE_fq@ */ /end MEASUREMENT
/begin MEASUREMENT autosar_swc_las_rtARID_DEF.UnitDelay_DSTATE_fse "" FLOAT32_IEEE autosar_swc_las_CM_single 0 0 -3.4E+38 3.4E+38 ECU_ADDRESS 0xfe4ae444 /* @ECU_Address@autosar_swc_las_rtARID_DEF.UnitDelay_DSTATE_fse@ */ /end MEASUREMENT
/begin MEASUREMENT autosar_swc_las_rtARID_DEF.UnitDelay_DSTATE_fx "" FLOAT64_IEEE autosar_swc_las_CM_double 0 0 -1.7E+308 1.7E+308 ECU_ADDRESS 0xfe4ae0f8 /* @ECU_Address@autosar_swc_las_rtARID_DEF.UnitDelay_DSTATE_fx@ */ /end MEASUREMENT
/begin MEASUREMENT autosar_swc_las_rtARID_DEF.UnitDelay_DSTATE_g3 "" FLOAT64_IEEE autosar_swc_las_CM_double 0 0 -1.7E+308 1.7E+308 ECU_ADDRESS 0xfe4ae0c8 /* @ECU_Address@autosar_swc_las_rtARID_DEF.UnitDelay_DSTATE_g3@ */ /end MEASUREMENT
/begin MEASUREMENT autosar_swc_las_rtARID_DEF.UnitDelay_DSTATE_gh "" FLOAT64_IEEE autosar_swc_las_CM_double 0 0 -1.7E+308 1.7E+308 ECU_ADDRESS 0xfe4ae138 /* @ECU_Address@autosar_swc_las_rtARID_DEF.UnitDelay_DSTATE_gh@ */ /end MEASUREMENT
/begin MEASUREMENT autosar_swc_las_rtARID_DEF.UnitDelay_DSTATE_gi "" FLOAT64_IEEE autosar_swc_las_CM_double 0 0 -1.7E+308 1.7E+308 ECU_ADDRESS 0xfe4ae260 /* @ECU_Address@autosar_swc_las_rtARID_DEF.UnitDelay_DSTATE_gi@ */ /end MEASUREMENT
/begin MEASUREMENT autosar_swc_las_rtARID_DEF.UnitDelay_DSTATE_gn "" FLOAT32_IEEE autosar_swc_las_CM_single 0 0 -3.4E+38 3.4E+38 ECU_ADDRESS 0xfe4ae46c /* @ECU_Address@autosar_swc_las_rtARID_DEF.UnitDelay_DSTATE_gn@ */ /end MEASUREMENT
/begin MEASUREMENT autosar_swc_las_rtARID_DEF.UnitDelay_DSTATE_gv "" FLOAT32_IEEE autosar_swc_las_CM_single 0 0 -3.4E+38 3.4E+38 ECU_ADDRESS 0xfe4ae438 /* @ECU_Address@autosar_swc_las_rtARID_DEF.UnitDelay_DSTATE_gv@ */ /end MEASUREMENT
/begin MEASUREMENT autosar_swc_las_rtARID_DEF.UnitDelay_DSTATE_h1 "" FLOAT32_IEEE autosar_swc_las_CM_single 0 0 -3.4E+38 3.4E+38 ECU_ADDRESS 0xfe4ae44c /* @ECU_Address@autosar_swc_las_rtARID_DEF.UnitDelay_DSTATE_h1@ */ /end MEASUREMENT
/begin MEASUREMENT autosar_swc_las_rtARID_DEF.UnitDelay_DSTATE_h3 "" FLOAT64_IEEE autosar_swc_las_CM_double 0 0 -1.7E+308 1.7E+308 ECU_ADDRESS 0xfe4ae278 /* @ECU_Address@autosar_swc_las_rtARID_DEF.UnitDelay_DSTATE_h3@ */ /end MEASUREMENT
/begin MEASUREMENT autosar_swc_las_rtARID_DEF.UnitDelay_DSTATE_hb "" UBYTE autosar_swc_las_CM_uint8 0 0 0 255 ECU_ADDRESS 0xfe4ae4bd /* @ECU_Address@autosar_swc_las_rtARID_DEF.UnitDelay_DSTATE_hb@ */ /end MEASUREMENT
/begin MEASUREMENT autosar_swc_las_rtARID_DEF.UnitDelay_DSTATE_id "" FLOAT64_IEEE autosar_swc_las_CM_double 0 0 -1.7E+308 1.7E+308 ECU_ADDRESS 0xfe4ae270 /* @ECU_Address@autosar_swc_las_rtARID_DEF.UnitDelay_DSTATE_id@ */ /end MEASUREMENT
/begin MEASUREMENT autosar_swc_las_rtARID_DEF.UnitDelay_DSTATE_ik "" FLOAT32_IEEE autosar_swc_las_CM_single 0 0 -3.4E+38 3.4E+38 ECU_ADDRESS 0xfe4ae414 /* @ECU_Address@autosar_swc_las_rtARID_DEF.UnitDelay_DSTATE_ik@ */ /end MEASUREMENT
/begin MEASUREMENT autosar_swc_las_rtARID_DEF.UnitDelay_DSTATE_iy "" FLOAT64_IEEE autosar_swc_las_CM_double 0 0 -1.7E+308 1.7E+308 ECU_ADDRESS 0xfe4ae1d0 /* @ECU_Address@autosar_swc_las_rtARID_DEF.UnitDelay_DSTATE_iy@ */ /end MEASUREMENT
/begin MEASUREMENT autosar_swc_las_rtARID_DEF.UnitDelay_DSTATE_je "" UBYTE autosar_swc_las_CM_uint8 0 0 0 255 LAYOUT COLUMN_DIR MATRIX_DIM 4 ECU_ADDRESS 0xfe4ae4a4 /* @ECU_Address@autosar_swc_las_rtARID_DEF.UnitDelay_DSTATE_je@ */ /end MEASUREMENT
/begin MEASUREMENT autosar_swc_las_rtARID_DEF.UnitDelay_DSTATE_jk "" FLOAT64_IEEE autosar_swc_las_CM_double 0 0 -1.7E+308 1.7E+308 ECU_ADDRESS 0xfe4ae118 /* @ECU_Address@autosar_swc_las_rtARID_DEF.UnitDelay_DSTATE_jk@ */ /end MEASUREMENT
/begin MEASUREMENT autosar_swc_las_rtARID_DEF.UnitDelay_DSTATE_jl "" FLOAT64_IEEE autosar_swc_las_CM_double 0 0 -1.7E+308 1.7E+308 ECU_ADDRESS 0xfe4ae108 /* @ECU_Address@autosar_swc_las_rtARID_DEF.UnitDelay_DSTATE_jl@ */ /end MEASUREMENT
/begin MEASUREMENT autosar_swc_las_rtARID_DEF.UnitDelay_DSTATE_k "" FLOAT64_IEEE autosar_swc_las_CM_double 0 0 -1.7E+308 1.7E+308 ECU_ADDRESS 0xfe4ae0b0 /* @ECU_Address@autosar_swc_las_rtARID_DEF.UnitDelay_DSTATE_k@ */ /end MEASUREMENT
/begin MEASUREMENT autosar_swc_las_rtARID_DEF.UnitDelay_DSTATE_kh "" FLOAT64_IEEE autosar_swc_las_CM_double 0 0 -1.7E+308 1.7E+308 ECU_ADDRESS 0xfe4ae190 /* @ECU_Address@autosar_swc_las_rtARID_DEF.UnitDelay_DSTATE_kh@ */ /end MEASUREMENT
/begin MEASUREMENT autosar_swc_las_rtARID_DEF.UnitDelay_DSTATE_ks "" UBYTE autosar_swc_las_CM_logical 0 0 0 1 ECU_ADDRESS 0xfe4ae510 /* @ECU_Address@autosar_swc_las_rtARID_DEF.UnitDelay_DSTATE_ks@ */ /end MEASUREMENT
/begin MEASUREMENT autosar_swc_las_rtARID_DEF.UnitDelay_DSTATE_ku "" FLOAT64_IEEE autosar_swc_las_CM_double 0 0 -1.7E+308 1.7E+308 ECU_ADDRESS 0xfe4ae1b8 /* @ECU_Address@autosar_swc_las_rtARID_DEF.UnitDelay_DSTATE_ku@ */ /end MEASUREMENT
/begin MEASUREMENT autosar_swc_las_rtARID_DEF.UnitDelay_DSTATE_kv "" FLOAT64_IEEE autosar_swc_las_CM_double 0 0 -1.7E+308 1.7E+308 ECU_ADDRESS 0xfe4ae210 /* @ECU_Address@autosar_swc_las_rtARID_DEF.UnitDelay_DSTATE_kv@ */ /end MEASUREMENT
/begin MEASUREMENT autosar_swc_las_rtARID_DEF.UnitDelay_DSTATE_kvs "" FLOAT32_IEEE autosar_swc_las_CM_single 0 0 -3.4E+38 3.4E+38 ECU_ADDRESS 0xfe4ae420 /* @ECU_Address@autosar_swc_las_rtARID_DEF.UnitDelay_DSTATE_kvs@ */ /end MEASUREMENT
/begin MEASUREMENT autosar_swc_las_rtARID_DEF.UnitDelay_DSTATE_ls "" FLOAT32_IEEE autosar_swc_las_CM_single 0 0 -3.4E+38 3.4E+38 ECU_ADDRESS 0xfe4ae428 /* @ECU_Address@autosar_swc_las_rtARID_DEF.UnitDelay_DSTATE_ls@ */ /end MEASUREMENT
/begin MEASUREMENT autosar_swc_las_rtARID_DEF.UnitDelay_DSTATE_m1 "" FLOAT64_IEEE autosar_swc_las_CM_double 0 0 -1.7E+308 1.7E+308 ECU_ADDRESS 0xfe4ae268 /* @ECU_Address@autosar_swc_las_rtARID_DEF.UnitDelay_DSTATE_m1@ */ /end MEASUREMENT
/begin MEASUREMENT autosar_swc_las_rtARID_DEF.UnitDelay_DSTATE_mb "" FLOAT64_IEEE autosar_swc_las_CM_double 0 0 -1.7E+308 1.7E+308 ECU_ADDRESS 0xfe4ae0a0 /* @ECU_Address@autosar_swc_las_rtARID_DEF.UnitDelay_DSTATE_mb@ */ /end MEASUREMENT
/begin MEASUREMENT autosar_swc_las_rtARID_DEF.UnitDelay_DSTATE_mi "" FLOAT64_IEEE autosar_swc_las_CM_double 0 0 -1.7E+308 1.7E+308 ECU_ADDRESS 0xfe4ae0e0 /* @ECU_Address@autosar_swc_las_rtARID_DEF.UnitDelay_DSTATE_mi@ */ /end MEASUREMENT
/begin MEASUREMENT autosar_swc_las_rtARID_DEF.UnitDelay_DSTATE_mp "" FLOAT64_IEEE autosar_swc_las_CM_double 0 0 -1.7E+308 1.7E+308 ECU_ADDRESS 0xfe4ae0f0 /* @ECU_Address@autosar_swc_las_rtARID_DEF.UnitDelay_DSTATE_mp@ */ /end MEASUREMENT
/begin MEASUREMENT autosar_swc_las_rtARID_DEF.UnitDelay_DSTATE_mr "" FLOAT32_IEEE autosar_swc_las_CM_single 0 0 -3.4E+38 3.4E+38 ECU_ADDRESS 0xfe4ae468 /* @ECU_Address@autosar_swc_las_rtARID_DEF.UnitDelay_DSTATE_mr@ */ /end MEASUREMENT
/begin MEASUREMENT autosar_swc_las_rtARID_DEF.UnitDelay_DSTATE_mu "" FLOAT64_IEEE autosar_swc_las_CM_double 0 0 -1.7E+308 1.7E+308 ECU_ADDRESS 0xfe4ae198 /* @ECU_Address@autosar_swc_las_rtARID_DEF.UnitDelay_DSTATE_mu@ */ /end MEASUREMENT
/begin MEASUREMENT autosar_swc_las_rtARID_DEF.UnitDelay_DSTATE_mx "" FLOAT32_IEEE autosar_swc_las_CM_single 0 0 -3.4E+38 3.4E+38 ECU_ADDRESS 0xfe4ae42c /* @ECU_Address@autosar_swc_las_rtARID_DEF.UnitDelay_DSTATE_mx@ */ /end MEASUREMENT
/begin MEASUREMENT autosar_swc_las_rtARID_DEF.UnitDelay_DSTATE_n2 "" FLOAT64_IEEE autosar_swc_las_CM_double 0 0 -1.7E+308 1.7E+308 ECU_ADDRESS 0xfe4ae298 /* @ECU_Address@autosar_swc_las_rtARID_DEF.UnitDelay_DSTATE_n2@ */ /end MEASUREMENT
/begin MEASUREMENT autosar_swc_las_rtARID_DEF.UnitDelay_DSTATE_nb "" FLOAT64_IEEE autosar_swc_las_CM_double 0 0 -1.7E+308 1.7E+308 ECU_ADDRESS 0xfe4ae238 /* @ECU_Address@autosar_swc_las_rtARID_DEF.UnitDelay_DSTATE_nb@ */ /end MEASUREMENT
/begin MEASUREMENT autosar_swc_las_rtARID_DEF.UnitDelay_DSTATE_nq "" FLOAT32_IEEE autosar_swc_las_CM_single 0 0 -3.4E+38 3.4E+38 ECU_ADDRESS 0xfe4ae410 /* @ECU_Address@autosar_swc_las_rtARID_DEF.UnitDelay_DSTATE_nq@ */ /end MEASUREMENT
/begin MEASUREMENT autosar_swc_las_rtARID_DEF.UnitDelay_DSTATE_nv "" FLOAT64_IEEE autosar_swc_las_CM_double 0 0 -1.7E+308 1.7E+308 ECU_ADDRESS 0xfe4ae0a8 /* @ECU_Address@autosar_swc_las_rtARID_DEF.UnitDelay_DSTATE_nv@ */ /end MEASUREMENT
/begin MEASUREMENT autosar_swc_las_rtARID_DEF.UnitDelay_DSTATE_o3 "" FLOAT64_IEEE autosar_swc_las_CM_double 0 0 -1.7E+308 1.7E+308 ECU_ADDRESS 0xfe4ae0d0 /* @ECU_Address@autosar_swc_las_rtARID_DEF.UnitDelay_DSTATE_o3@ */ /end MEASUREMENT
/begin MEASUREMENT autosar_swc_las_rtARID_DEF.UnitDelay_DSTATE_o4 "" FLOAT64_IEEE autosar_swc_las_CM_double 0 0 -1.7E+308 1.7E+308 ECU_ADDRESS 0xfe4ae2a0 /* @ECU_Address@autosar_swc_las_rtARID_DEF.UnitDelay_DSTATE_o4@ */ /end MEASUREMENT
/begin MEASUREMENT autosar_swc_las_rtARID_DEF.UnitDelay_DSTATE_oo "" FLOAT64_IEEE autosar_swc_las_CM_double 0 0 -1.7E+308 1.7E+308 ECU_ADDRESS 0xfe4ae288 /* @ECU_Address@autosar_swc_las_rtARID_DEF.UnitDelay_DSTATE_oo@ */ /end MEASUREMENT
/begin MEASUREMENT autosar_swc_las_rtARID_DEF.UnitDelay_DSTATE_op "" FLOAT64_IEEE autosar_swc_las_CM_double 0 0 -1.7E+308 1.7E+308 ECU_ADDRESS 0xfe4ae110 /* @ECU_Address@autosar_swc_las_rtARID_DEF.UnitDelay_DSTATE_op@ */ /end MEASUREMENT
/begin MEASUREMENT autosar_swc_las_rtARID_DEF.UnitDelay_DSTATE_or "" FLOAT64_IEEE autosar_swc_las_CM_double 0 0 -1.7E+308 1.7E+308 ECU_ADDRESS 0xfe4ae130 /* @ECU_Address@autosar_swc_las_rtARID_DEF.UnitDelay_DSTATE_or@ */ /end MEASUREMENT
/begin MEASUREMENT autosar_swc_las_rtARID_DEF.UnitDelay_DSTATE_ot "" FLOAT64_IEEE autosar_swc_las_CM_double 0 0 -1.7E+308 1.7E+308 ECU_ADDRESS 0xfe4ae0e8 /* @ECU_Address@autosar_swc_las_rtARID_DEF.UnitDelay_DSTATE_ot@ */ /end MEASUREMENT
/begin MEASUREMENT autosar_swc_las_rtARID_DEF.UnitDelay_DSTATE_otd "" FLOAT64_IEEE autosar_swc_las_CM_double 0 0 -1.7E+308 1.7E+308 ECU_ADDRESS 0xfe4ae1d8 /* @ECU_Address@autosar_swc_las_rtARID_DEF.UnitDelay_DSTATE_otd@ */ /end MEASUREMENT
/begin MEASUREMENT autosar_swc_las_rtARID_DEF.UnitDelay_DSTATE_p3 "" FLOAT32_IEEE autosar_swc_las_CM_single 0 0 -3.4E+38 3.4E+38 ECU_ADDRESS 0xfe4ae478 /* @ECU_Address@autosar_swc_las_rtARID_DEF.UnitDelay_DSTATE_p3@ */ /end MEASUREMENT
/begin MEASUREMENT autosar_swc_las_rtARID_DEF.UnitDelay_DSTATE_pr "" FLOAT64_IEEE autosar_swc_las_CM_double 0 0 -1.7E+308 1.7E+308 ECU_ADDRESS 0xfe4ae0d8 /* @ECU_Address@autosar_swc_las_rtARID_DEF.UnitDelay_DSTATE_pr@ */ /end MEASUREMENT
/begin MEASUREMENT autosar_swc_las_rtARID_DEF.UnitDelay_DSTATE_pu "" FLOAT64_IEEE autosar_swc_las_CM_double 0 0 -1.7E+308 1.7E+308 ECU_ADDRESS 0xfe4ae100 /* @ECU_Address@autosar_swc_las_rtARID_DEF.UnitDelay_DSTATE_pu@ */ /end MEASUREMENT
/begin MEASUREMENT autosar_swc_las_rtARID_DEF.UnitDelay_DSTATE_pz "" UBYTE autosar_swc_las_CM_uint8 0 0 0 255 LAYOUT COLUMN_DIR MATRIX_DIM 4 ECU_ADDRESS 0xfe4ae49c /* @ECU_Address@autosar_swc_las_rtARID_DEF.UnitDelay_DSTATE_pz@ */ /end MEASUREMENT
/begin MEASUREMENT autosar_swc_las_rtARID_DEF.actcount_c "" FLOAT64_IEEE autosar_swc_las_CM_double 0 0 -1.7E+308 1.7E+308 ECU_ADDRESS 0xfe4ae2e8 /* @ECU_Address@autosar_swc_las_rtARID_DEF.actcount_c@ */ /end MEASUREMENT
/begin MEASUREMENT autosar_swc_las_rtARID_DEF.incount_j "" FLOAT64_IEEE autosar_swc_las_CM_double 0 0 -1.7E+308 1.7E+308 ECU_ADDRESS 0xfe4adfc0 /* @ECU_Address@autosar_swc_las_rtARID_DEF.incount_j@ */ /end MEASUREMENT
/begin MEASUREMENT autosar_swc_las_rtARID_DEF.is_Left_Active "" UBYTE autosar_swc_las_CM_uint8 0 0 0 255 ECU_ADDRESS 0xfe4ae4e0 /* @ECU_Address@autosar_swc_las_rtARID_DEF.is_Left_Active@ */ /end MEASUREMENT
/begin MEASUREMENT autosar_swc_las_rtARID_DEF.is_Left_d "" UBYTE autosar_swc_las_CM_uint8 0 0 0 255 ECU_ADDRESS 0xfe4ae4ed /* @ECU_Address@autosar_swc_las_rtARID_DEF.is_Left_d@ */ /end MEASUREMENT
/begin MEASUREMENT autosar_swc_las_rtARID_DEF.is_Line_Active "" UBYTE autosar_swc_las_CM_uint8 0 0 0 255 ECU_ADDRESS 0xfe4ae4df /* @ECU_Address@autosar_swc_las_rtARID_DEF.is_Line_Active@ */ /end MEASUREMENT
/begin MEASUREMENT autosar_swc_las_rtARID_DEF.is_MAINST_ON_j "" UBYTE autosar_swc_las_CM_uint8 0 0 0 255 ECU_ADDRESS 0xfe4ae4de /* @ECU_Address@autosar_swc_las_rtARID_DEF.is_MAINST_ON_j@ */ /end MEASUREMENT
/begin MEASUREMENT autosar_swc_las_rtARID_DEF.is_Right_Active "" UBYTE autosar_swc_las_CM_uint8 0 0 0 255 ECU_ADDRESS 0xfe4ae4e1 /* @ECU_Address@autosar_swc_las_rtARID_DEF.is_Right_Active@ */ /end MEASUREMENT
/begin MEASUREMENT autosar_swc_las_rtARID_DEF.is_Right_f "" UBYTE autosar_swc_las_CM_uint8 0 0 0 255 ECU_ADDRESS 0xfe4ae4ee /* @ECU_Address@autosar_swc_las_rtARID_DEF.is_Right_f@ */ /end MEASUREMENT
/begin MEASUREMENT autosar_swc_las_rtARID_DEF.is_SUBST_ACTIVE_h "" UBYTE autosar_swc_las_CM_uint8 0 0 0 255 ECU_ADDRESS 0xfe4ae4e2 /* @ECU_Address@autosar_swc_las_rtARID_DEF.is_SUBST_ACTIVE_h@ */ /end MEASUREMENT
/begin MEASUREMENT autosar_swc_las_rtARID_DEF.is_active_c18_autosar_swc_las "" UBYTE autosar_swc_las_CM_uint8 0 0 0 255 ECU_ADDRESS 0xfe4ae4eb /* @ECU_Address@autosar_swc_las_rtARID_DEF.is_active_c18_autosar_swc_las@ */ /end MEASUREMENT
/begin MEASUREMENT autosar_swc_las_rtARID_DEF.is_active_c23_autosar_swc_las "" UBYTE autosar_swc_las_CM_uint8 0 0 0 255 ECU_ADDRESS 0xfe4ae4e9 /* @ECU_Address@autosar_swc_las_rtARID_DEF.is_active_c23_autosar_swc_las@ */ /end MEASUREMENT
/begin MEASUREMENT autosar_swc_las_rtARID_DEF.is_active_c32_autosar_swc_las "" UBYTE autosar_swc_las_CM_uint8 0 0 0 255 ECU_ADDRESS 0xfe4ae4e7 /* @ECU_Address@autosar_swc_las_rtARID_DEF.is_active_c32_autosar_swc_las@ */ /end MEASUREMENT
/begin MEASUREMENT autosar_swc_las_rtARID_DEF.is_active_c48_autosar_swc_las "" UBYTE autosar_swc_las_CM_uint8 0 0 0 255 ECU_ADDRESS 0xfe4ae4e5 /* @ECU_Address@autosar_swc_las_rtARID_DEF.is_active_c48_autosar_swc_las@ */ /end MEASUREMENT
/begin MEASUREMENT autosar_swc_las_rtARID_DEF.is_active_c59_autosar_swc_las "" UBYTE autosar_swc_las_CM_uint8 0 0 0 255 ECU_ADDRESS 0xfe4ae4e3 /* @ECU_Address@autosar_swc_las_rtARID_DEF.is_active_c59_autosar_swc_las@ */ /end MEASUREMENT
/begin MEASUREMENT autosar_swc_las_rtARID_DEF.is_active_c66_autosar_swc_las "" UBYTE autosar_swc_las_CM_uint8 0 0 0 255 ECU_ADDRESS 0xfe4ae4dc /* @ECU_Address@autosar_swc_las_rtARID_DEF.is_active_c66_autosar_swc_las@ */ /end MEASUREMENT
/begin MEASUREMENT autosar_swc_las_rtARID_DEF.is_c18_autosar_swc_las "" UBYTE autosar_swc_las_CM_uint8 0 0 0 255 ECU_ADDRESS 0xfe4ae4ec /* @ECU_Address@autosar_swc_las_rtARID_DEF.is_c18_autosar_swc_las@ */ /end MEASUREMENT
/begin MEASUREMENT autosar_swc_las_rtARID_DEF.is_c23_autosar_swc_las "" UBYTE autosar_swc_las_CM_uint8 0 0 0 255 ECU_ADDRESS 0xfe4ae4ea /* @ECU_Address@autosar_swc_las_rtARID_DEF.is_c23_autosar_swc_las@ */ /end MEASUREMENT
/begin MEASUREMENT autosar_swc_las_rtARID_DEF.is_c32_autosar_swc_las "" UBYTE autosar_swc_las_CM_uint8 0 0 0 255 ECU_ADDRESS 0xfe4ae4e8 /* @ECU_Address@autosar_swc_las_rtARID_DEF.is_c32_autosar_swc_las@ */ /end MEASUREMENT
/begin MEASUREMENT autosar_swc_las_rtARID_DEF.is_c48_autosar_swc_las "" UBYTE autosar_swc_las_CM_uint8 0 0 0 255 ECU_ADDRESS 0xfe4ae4e6 /* @ECU_Address@autosar_swc_las_rtARID_DEF.is_c48_autosar_swc_las@ */ /end MEASUREMENT
/begin MEASUREMENT autosar_swc_las_rtARID_DEF.is_c59_autosar_swc_las "" UBYTE autosar_swc_las_CM_uint8 0 0 0 255 ECU_ADDRESS 0xfe4ae4e4 /* @ECU_Address@autosar_swc_las_rtARID_DEF.is_c59_autosar_swc_las@ */ /end MEASUREMENT
/begin MEASUREMENT autosar_swc_las_rtARID_DEF.is_c66_autosar_swc_las "" UBYTE autosar_swc_las_CM_uint8 0 0 0 255 ECU_ADDRESS 0xfe4ae4dd /* @ECU_Address@autosar_swc_las_rtARID_DEF.is_c66_autosar_swc_las@ */ /end MEASUREMENT
/begin MEASUREMENT autosar_swc_las_rtARID_DEF.left_count "" FLOAT64_IEEE autosar_swc_las_CM_double 0 0 -1.7E+308 1.7E+308 ECU_ADDRESS 0xfe4ae2f0 /* @ECU_Address@autosar_swc_las_rtARID_DEF.left_count@ */ /end MEASUREMENT
/begin MEASUREMENT autosar_swc_las_rtARID_DEF.left_count_j "" FLOAT64_IEEE autosar_swc_las_CM_double 0 0 -1.7E+308 1.7E+308 ECU_ADDRESS 0xfe4ae300 /* @ECU_Address@autosar_swc_las_rtARID_DEF.left_count_j@ */ /end MEASUREMENT
/begin MEASUREMENT autosar_swc_las_rtARID_DEF.left_count_m "" FLOAT64_IEEE autosar_swc_las_CM_double 0 0 -1.7E+308 1.7E+308 ECU_ADDRESS 0xfe4ae310 /* @ECU_Address@autosar_swc_las_rtARID_DEF.left_count_m@ */ /end MEASUREMENT
/begin MEASUREMENT autosar_swc_las_rtARID_DEF.out_count_m "" FLOAT64_IEEE autosar_swc_las_CM_double 0 0 -1.7E+308 1.7E+308 ECU_ADDRESS 0xfe4ae2e0 /* @ECU_Address@autosar_swc_las_rtARID_DEF.out_count_m@ */ /end MEASUREMENT
/begin MEASUREMENT autosar_swc_las_rtARID_DEF.right_count "" FLOAT64_IEEE autosar_swc_las_CM_double 0 0 -1.7E+308 1.7E+308 ECU_ADDRESS 0xfe4ae2f8 /* @ECU_Address@autosar_swc_las_rtARID_DEF.right_count@ */ /end MEASUREMENT
/begin MEASUREMENT autosar_swc_las_rtARID_DEF.right_count_k "" FLOAT64_IEEE autosar_swc_las_CM_double 0 0 -1.7E+308 1.7E+308 ECU_ADDRESS 0xfe4ae308 /* @ECU_Address@autosar_swc_las_rtARID_DEF.right_count_k@ */ /end MEASUREMENT
/begin MEASUREMENT autosar_swc_las_rtARID_DEF.right_count_n "" FLOAT64_IEEE autosar_swc_las_CM_double 0 0 -1.7E+308 1.7E+308 ECU_ADDRESS 0xfe4ae318 /* @ECU_Address@autosar_swc_las_rtARID_DEF.right_count_n@ */ /end MEASUREMENT
/begin MEASUREMENT autosar_swc_las_rtARID_DEF.warn "" UBYTE autosar_swc_las_CM_uint8 0 0 0 255 ECU_ADDRESS 0xfe4ae4af /* @ECU_Address@autosar_swc_las_rtARID_DEF.warn@ */ /end MEASUREMENT
/begin MEASUREMENT autosar_swc_las_rtARID_DEF.wcount_m "" FLOAT64_IEEE autosar_swc_las_CM_double 0 0 -1.7E+308 1.7E+308 ECU_ADDRESS 0xfe4adfc8 /* @ECU_Address@autosar_swc_las_rtARID_DEF.wcount_m@ */ /end MEASUREMENT
/begin AXIS_PTS P_LSS_ELK_Lane_Width_Table "" 0xfe821798 /* @ECU_Address@P_LSS_ELK_Lane_Width_Table@ */ NO_INPUT_QUANTITY Axis_FLOAT32_IEEE 0 autosar_swc_las_CM_single 7 -3.4E+38 3.4E+38 /end AXIS_PTS
/begin AXIS_PTS P_LSS_ELK_Sensitive_Table "" 0xfe8217d0 /* @ECU_Address@P_LSS_ELK_Sensitive_Table@ */ NO_INPUT_QUANTITY Axis_FLOAT32_IEEE 0 autosar_swc_las_CM_single 3 -3.4E+38 3.4E+38 /end AXIS_PTS
/begin AXIS_PTS P_LSS_ELK_State_Param_LaneCurve "" 0xfe821568 /* @ECU_Address@P_LSS_ELK_State_Param_LaneCurve@ */ NO_INPUT_QUANTITY Axis_FLOAT32_IEEE 0 autosar_swc_las_CM_single 8 -3.4E+38 3.4E+38 /end AXIS_PTS
/begin AXIS_PTS P_LSS_ELK_State_Param_Speed "" 0xfe821628 /* @ECU_Address@P_LSS_ELK_State_Param_Speed@ */ NO_INPUT_QUANTITY Axis_FLOAT32_IEEE 0 autosar_swc_las_CM_single 16 -3.4E+38 3.4E+38 /end AXIS_PTS
/begin AXIS_PTS P_LSS_ELK_VehSpdKap_TableX "" 0xfe821668 /* @ECU_Address@P_LSS_ELK_VehSpdKap_TableX@ */ NO_INPUT_QUANTITY Axis_FLOAT32_IEEE 0 autosar_swc_las_CM_single 10 -3.4E+38 3.4E+38 /end AXIS_PTS
/begin AXIS_PTS P_LSS_ELK_VehSpdRoadEge_TableX "" 0xfe821690 /* @ECU_Address@P_LSS_ELK_VehSpdRoadEge_TableX@ */ NO_INPUT_QUANTITY Axis_FLOAT32_IEEE 0 autosar_swc_las_CM_single 10 -3.4E+38 3.4E+38 /end AXIS_PTS
/begin AXIS_PTS P_LSS_LDP_OverideSPd_kmh "" 0xfe8217e8 /* @ECU_Address@P_LSS_LDP_OverideSPd_kmh@ */ NO_INPUT_QUANTITY Axis_FLOAT32_IEEE 0 autosar_swc_las_CM_single 9 -3.4E+38 3.4E+38 /end AXIS_PTS
/begin AXIS_PTS P_LSS_LDW_Lane_Width_Table_Calibration "" 0xfe82188c /* @ECU_Address@P_LSS_LDW_Lane_Width_Table_Calibration@ */ NO_INPUT_QUANTITY Axis_FLOAT32_IEEE 0 autosar_swc_las_CM_single 7 -3.4E+38 3.4E+38 /end AXIS_PTS
/begin AXIS_PTS P_LSS_LDW_Sensitive_Table_Calibration "" 0xfe8218a8 /* @ECU_Address@P_LSS_LDW_Sensitive_Table_Calibration@ */ NO_INPUT_QUANTITY Axis_FLOAT32_IEEE 0 autosar_swc_las_CM_single 3 -3.4E+38 3.4E+38 /end AXIS_PTS
/begin AXIS_PTS P_LSS_LDW_State_Param_CureLaneWidth "" 0xfe8218b4 /* @ECU_Address@P_LSS_LDW_State_Param_CureLaneWidth@ */ NO_INPUT_QUANTITY Axis_FLOAT32_IEEE 0 autosar_swc_las_CM_single 7 -3.4E+38 3.4E+38 /end AXIS_PTS
/begin AXIS_PTS P_LSS_LDW_State_Param_LaneCurve "" 0xfe8216b8 /* @ECU_Address@P_LSS_LDW_State_Param_LaneCurve@ */ NO_INPUT_QUANTITY Axis_FLOAT32_IEEE 0 autosar_swc_las_CM_single 8 -3.4E+38 3.4E+38 /end AXIS_PTS
/begin COMPU_METHOD autosar_swc_las_CM_boolean "Q = V" IDENTICAL "%1.0" "" /end COMPU_METHOD
/begin COMPU_METHOD autosar_swc_las_CM_double "Q = V" IDENTICAL "%15.10" "" /end COMPU_METHOD
/begin COMPU_METHOD autosar_swc_las_CM_logical "Q = V" IDENTICAL "%1.0" "" /end COMPU_METHOD
/begin COMPU_METHOD autosar_swc_las_CM_single "Q = V" IDENTICAL "%8.6" "" /end COMPU_METHOD
/begin COMPU_METHOD autosar_swc_las_CM_uint16 "Q = V" IDENTICAL "%5.0" "" /end COMPU_METHOD
/begin COMPU_METHOD autosar_swc_las_CM_uint32 "Q = V" IDENTICAL "%10.0" "" /end COMPU_METHOD
/begin COMPU_METHOD autosar_swc_las_CM_uint8 "Q = V" IDENTICAL "%3.0" "" /end COMPU_METHOD
/begin RECORD_LAYOUT Record_BOOLEAN FNC_VALUES 1 UBYTE COLUMN_DIR DIRECT /end RECORD_LAYOUT
/begin RECORD_LAYOUT Record_FLOAT32_IEEE FNC_VALUES 1 FLOAT32_IEEE COLUMN_DIR DIRECT /end RECORD_LAYOUT
/begin RECORD_LAYOUT Record_FLOAT64_IEEE FNC_VALUES 1 FLOAT64_IEEE COLUMN_DIR DIRECT /end RECORD_LAYOUT
/begin RECORD_LAYOUT Record_UBYTE FNC_VALUES 1 UBYTE COLUMN_DIR DIRECT /end RECORD_LAYOUT
/begin RECORD_LAYOUT Record_UWORD FNC_VALUES 1 UWORD COLUMN_DIR DIRECT /end RECORD_LAYOUT
/begin RECORD_LAYOUT Axis_FLOAT32_IEEE AXIS_PTS_X 1 FLOAT32_IEEE INDEX_INCR DIRECT /end RECORD_LAYOUT
/begin GROUP autosar_swc_las_autosar_swc_las_Step_sys_las_ELKState_Machine_ELK_Scene "autosar_swc_las/autosar_swc_las_Step_sys/las/ELKState_Machine/ELK_Scene"
 /begin SUB_GROUP autosar_swc_las_autosar_swc_las_Step_sys_las_ELKState_Machine_ELK_Scene_Compare_To_Constant10 autosar_swc_las_autosar_swc_las_Step_sys_las_ELKState_Machine_ELK_Scene_Compare_To_Constant2 autosar_swc_las_autosar_swc_las_Step_sys_las_ELKState_Machine_ELK_Scene_Compare_To_Constant3 autosar_swc_las_autosar_swc_las_Step_sys_las_ELKState_Machine_ELK_Scene_Compare_To_Constant4 autosar_swc_las_autosar_swc_las_Step_sys_las_ELKState_Machine_ELK_Scene_Compare_To_Constant5 autosar_swc_las_autosar_swc_las_Step_sys_las_ELKState_Machine_ELK_Scene_Compare_To_Constant6 autosar_swc_las_autosar_swc_las_Step_sys_las_ELKState_Machine_ELK_Scene_Compare_To_Constant7 autosar_swc_las_autosar_swc_las_Step_sys_las_ELKState_Machine_ELK_Scene_Compare_To_Constant8 autosar_swc_las_autosar_swc_las_Step_sys_las_ELKState_Machine_ELK_Scene_Compare_To_Constant9 autosar_swc_las_autosar_swc_las_Step_sys_las_ELKState_Machine_ELK_Scene_DashLine autosar_swc_las_autosar_swc_las_Step_sys_las_ELKState_Machine_ELK_Scene_Line autosar_swc_las_autosar_swc_las_Step_sys_las_ELKState_Machine_ELK_Scene_OnComingCal autosar_swc_las_autosar_swc_las_Step_sys_las_ELKState_Machine_ELK_Scene_OvertakingCal autosar_swc_las_autosar_swc_las_Step_sys_las_ELKState_Machine_ELK_Scene_RoadEge autosar_swc_las_autosar_swc_las_Step_sys_las_ELKState_Machine_ELK_Scene_Subsystem autosar_swc_las_autosar_swc_las_Step_sys_las_ELKState_Machine_ELK_Scene_Subsystem1 autosar_swc_las_autosar_swc_las_Step_sys_las_ELKState_Machine_ELK_Scene_Subsystem2 autosar_swc_las_autosar_swc_las_Step_sys_las_ELKState_Machine_ELK_Scene_Subsystem3 autosar_swc_las_autosar_swc_las_Step_sys_las_ELKState_Machine_ELK_Scene_Subsystem5 /end SUB_GROUP
 /begin REF_CHARACTERISTIC P_LSS_ELK_CurveFactor P_LSS_ELK_Lane_Width_Table P_LSS_ELK_Lane_Width_Table_Calibration P_LSS_ELK_Sensitive_Switch P_LSS_ELK_Sensitive_Table P_LSS_ELK_Sensitive_Table_Calibration P_LSS_ELK_State_LineInterventionSWSts P_LSS_ELK_State_Param_AngleOffset P_LSS_ELK_State_Param_LaneCurve P_LSS_ELK_State_Param_LaneCurve_Offset P_LSS_ELK_State_Param_OnTime P_LSS_ELK_State_Param_Oncoming P_LSS_ELK_State_Param_OutOffset P_LSS_ELK_State_Param_OvTime P_LSS_ELK_State_Param_Over P_LSS_ELK_State_Param_Speed /end REF_CHARACTERISTIC
 /begin REF_MEASUREMENT LAS_ELK_LeftWarn LAS_ELK_OnComingFlag_b LAS_ELK_OvertakingFlag_b LAS_ELK_RightWarn autosar_swc_las_rtARID_DEF.UnitDelay1_DSTATE_l autosar_swc_las_rtARID_DEF.UnitDelay2_DSTATE_bl autosar_swc_las_rtARID_DEF.UnitDelay3_DSTATE_hr autosar_swc_las_rtARID_DEF.UnitDelay_DSTATE_a0 /end REF_MEASUREMENT
/end GROUP
/begin GROUP autosar_swc_las_autosar_swc_las_Step_sys_las_ELKState_Machine_ELK_Scene_Compare_To_Constant10 "autosar_swc_las/autosar_swc_las_Step_sys/las/ELKState_Machine/ELK_Scene/Compare\nTo Constant10" /begin REF_CHARACTERISTIC P_LSS_ELK_WarnInTime /end REF_CHARACTERISTIC /end GROUP
/begin GROUP autosar_swc_las_autosar_swc_las_Step_sys_las_ELKState_Machine_ELK_Scene_Compare_To_Constant2 "autosar_swc_las/autosar_swc_las_Step_sys/las/ELKState_Machine/ELK_Scene/Compare\nTo Constant2" /begin REF_CHARACTERISTIC P_LSS_ELK_Warnarea2 /end REF_CHARACTERISTIC /begin REF_MEASUREMENT LAS_FLWhelDy /end REF_MEASUREMENT /end GROUP
/begin GROUP autosar_swc_las_autosar_swc_las_Step_sys_las_ELKState_Machine_ELK_Scene_Compare_To_Constant3 "autosar_swc_las/autosar_swc_las_Step_sys/las/ELKState_Machine/ELK_Scene/Compare\nTo Constant3" /begin REF_CHARACTERISTIC P_LSS_ELK_Warnarea1 /end REF_CHARACTERISTIC /begin REF_MEASUREMENT LAS_FLWhelDy /end REF_MEASUREMENT /end GROUP
/begin GROUP autosar_swc_las_autosar_swc_las_Step_sys_las_ELKState_Machine_ELK_Scene_Compare_To_Constant4 "autosar_swc_las/autosar_swc_las_Step_sys/las/ELKState_Machine/ELK_Scene/Compare\nTo Constant4" /begin REF_CHARACTERISTIC P_LSS_ELK_Warnarea1 /end REF_CHARACTERISTIC /begin REF_MEASUREMENT LAS_FLWhelDy /end REF_MEASUREMENT /end GROUP
/begin GROUP autosar_swc_las_autosar_swc_las_Step_sys_las_ELKState_Machine_ELK_Scene_Compare_To_Constant5 "autosar_swc_las/autosar_swc_las_Step_sys/las/ELKState_Machine/ELK_Scene/Compare\nTo Constant5" /begin REF_CHARACTERISTIC P_LSS_ELK_Warnarea2 /end REF_CHARACTERISTIC /begin REF_MEASUREMENT LAS_FRWhelDy /end REF_MEASUREMENT /end GROUP
/begin GROUP autosar_swc_las_autosar_swc_las_Step_sys_las_ELKState_Machine_ELK_Scene_Compare_To_Constant6 "autosar_swc_las/autosar_swc_las_Step_sys/las/ELKState_Machine/ELK_Scene/Compare\nTo Constant6" /begin REF_CHARACTERISTIC P_LSS_ELK_Warnarea1 /end REF_CHARACTERISTIC /begin REF_MEASUREMENT LAS_FRWhelDy /end REF_MEASUREMENT /end GROUP
/begin GROUP autosar_swc_las_autosar_swc_las_Step_sys_las_ELKState_Machine_ELK_Scene_Compare_To_Constant7 "autosar_swc_las/autosar_swc_las_Step_sys/las/ELKState_Machine/ELK_Scene/Compare\nTo Constant7" /begin REF_CHARACTERISTIC P_LSS_ELK_Warnarea1 /end REF_CHARACTERISTIC /begin REF_MEASUREMENT LAS_FRWhelDy /end REF_MEASUREMENT /end GROUP
/begin GROUP autosar_swc_las_autosar_swc_las_Step_sys_las_ELKState_Machine_ELK_Scene_Compare_To_Constant8 "autosar_swc_las/autosar_swc_las_Step_sys/las/ELKState_Machine/ELK_Scene/Compare\nTo Constant8" /begin REF_CHARACTERISTIC P_LSS_ELK_WarnInTime /end REF_CHARACTERISTIC /end GROUP
/begin GROUP autosar_swc_las_autosar_swc_las_Step_sys_las_ELKState_Machine_ELK_Scene_DashLine "autosar_swc_las/autosar_swc_las_Step_sys/las/ELKState_Machine/ELK_Scene/DashLine"
 /begin SUB_GROUP autosar_swc_las_autosar_swc_las_Step_sys_las_ELKState_Machine_ELK_Scene_DashLine_Subsystem autosar_swc_las_autosar_swc_las_Step_sys_las_ELKState_Machine_ELK_Scene_DashLine_Subsystem1 autosar_swc_las_autosar_swc_las_Step_sys_las_ELKState_Machine_ELK_Scene_DashLine_TurnLightAffirm autosar_swc_las_autosar_swc_las_Step_sys_las_ELKState_Machine_ELK_Scene_DashLine_TurnLightAffirm1 /end SUB_GROUP
 /begin REF_CHARACTERISTIC P_LSS_ELK_State_Param_WarningZoneIn P_LSS_ELK_State_Param_WarningZoneOut P_LSS_ELK_WarningZoneOffset /end REF_CHARACTERISTIC
 /begin REF_MEASUREMENT LAS_ELK_DashLineInWarningFlag LAS_ELK_DashLineWarnCount LAS_ELK_DashLineWarnwCount LAS_ELK_LeftDashLineInWarningFlag LAS_ELK_RightDashLineInWarningFlag LAS_FLWhelDy LAS_FRWhelDy autosar_swc_las_rtARID_DEF.UnitDelay1_DSTATE_f1 autosar_swc_las_rtARID_DEF.UnitDelay2_DSTATE_o autosar_swc_las_rtARID_DEF.UnitDelay3_DSTATE_nf autosar_swc_las_rtARID_DEF.UnitDelay8_DSTATE_i autosar_swc_las_rtARID_DEF.is_Left_d autosar_swc_las_rtARID_DEF.is_Right_f autosar_swc_las_rtARID_DEF.is_active_c18_autosar_swc_las autosar_swc_las_rtARID_DEF.is_c18_autosar_swc_las /end REF_MEASUREMENT
/end GROUP
/begin GROUP autosar_swc_las_autosar_swc_las_Step_sys_las_ELKState_Machine_ELK_Scene_DashLine_Subsystem "autosar_swc_las/autosar_swc_las_Step_sys/las/ELKState_Machine/ELK_Scene/DashLine/Subsystem"
 /begin SUB_GROUP autosar_swc_las_autosar_swc_las_Step_sys_las_ELKState_Machine_ELK_Scene_DashLine_Subsystem_Subsystem2 /end SUB_GROUP
 /begin REF_MEASUREMENT LAS_FLWhelDy autosar_swc_las_rtARID_DEF.UnitDelay_DSTATE_mr /end REF_MEASUREMENT
/end GROUP
/begin GROUP autosar_swc_las_autosar_swc_las_Step_sys_las_ELKState_Machine_ELK_Scene_DashLine_Subsystem1 "autosar_swc_las/autosar_swc_las_Step_sys/las/ELKState_Machine/ELK_Scene/DashLine/Subsystem1"
 /begin SUB_GROUP autosar_swc_las_autosar_swc_las_Step_sys_las_ELKState_Machine_ELK_Scene_DashLine_Subsystem1_Subsystem2 /end SUB_GROUP
 /begin REF_MEASUREMENT LAS_FRWhelDy autosar_swc_las_rtARID_DEF.UnitDelay_DSTATE_gn /end REF_MEASUREMENT
/end GROUP
/begin GROUP autosar_swc_las_autosar_swc_las_Step_sys_las_ELKState_Machine_ELK_Scene_DashLine_Subsystem1_Subsystem2 "autosar_swc_las/autosar_swc_las_Step_sys/las/ELKState_Machine/ELK_Scene/DashLine/Subsystem1/Subsystem2" /begin REF_MEASUREMENT autosar_swc_las_rtARID_DEF.UnitDelay_DSTATE_h3 /end REF_MEASUREMENT /end GROUP
/begin GROUP autosar_swc_las_autosar_swc_las_Step_sys_las_ELKState_Machine_ELK_Scene_DashLine_Subsystem_Subsystem2 "autosar_swc_las/autosar_swc_las_Step_sys/las/ELKState_Machine/ELK_Scene/DashLine/Subsystem/Subsystem2" /begin REF_MEASUREMENT autosar_swc_las_rtARID_DEF.UnitDelay_DSTATE_id /end REF_MEASUREMENT /end GROUP
/begin GROUP autosar_swc_las_autosar_swc_las_Step_sys_las_ELKState_Machine_ELK_Scene_DashLine_TurnLightAffirm "autosar_swc_las/autosar_swc_las_Step_sys/las/ELKState_Machine/ELK_Scene/DashLine/TurnLightAffirm"
 /begin SUB_GROUP autosar_swc_las_autosar_swc_las_Step_sys_las_ELKState_Machine_ELK_Scene_DashLine_TurnLightAffirm_Compare_To_Constant212 autosar_swc_las_autosar_swc_las_Step_sys_las_ELKState_Machine_ELK_Scene_DashLine_TurnLightAffirm_Subsystem9 /end SUB_GROUP
/end GROUP
/begin GROUP autosar_swc_las_autosar_swc_las_Step_sys_las_ELKState_Machine_ELK_Scene_DashLine_TurnLightAffirm1 "autosar_swc_las/autosar_swc_las_Step_sys/las/ELKState_Machine/ELK_Scene/DashLine/TurnLightAffirm1"
 /begin SUB_GROUP autosar_swc_las_autosar_swc_las_Step_sys_las_ELKState_Machine_ELK_Scene_DashLine_TurnLightAffirm1_Compare_To_Constant212 autosar_swc_las_autosar_swc_las_Step_sys_las_ELKState_Machine_ELK_Scene_DashLine_TurnLightAffirm1_Subsystem9 /end SUB_GROUP
/end GROUP
/begin GROUP autosar_swc_las_autosar_swc_las_Step_sys_las_ELKState_Machine_ELK_Scene_DashLine_TurnLightAffirm1_Compare_To_Constant212 "autosar_swc_las/autosar_swc_las_Step_sys/las/ELKState_Machine/ELK_Scene/DashLine/TurnLightAffirm1/Compare\nTo Constant212" /begin REF_CHARACTERISTIC P_LSS_ELK_TurnLightInTime /end REF_CHARACTERISTIC /end GROUP
/begin GROUP autosar_swc_las_autosar_swc_las_Step_sys_las_ELKState_Machine_ELK_Scene_DashLine_TurnLightAffirm1_Subsystem9 "autosar_swc_las/autosar_swc_las_Step_sys/las/ELKState_Machine/ELK_Scene/DashLine/TurnLightAffirm1/Subsystem9" /begin REF_MEASUREMENT autosar_swc_las_rtARID_DEF.UnitDelay_DSTATE_m1 /end REF_MEASUREMENT /end GROUP
/begin GROUP autosar_swc_las_autosar_swc_las_Step_sys_las_ELKState_Machine_ELK_Scene_DashLine_TurnLightAffirm_Compare_To_Constant212 "autosar_swc_las/autosar_swc_las_Step_sys/las/ELKState_Machine/ELK_Scene/DashLine/TurnLightAffirm/Compare\nTo Constant212" /begin REF_CHARACTERISTIC P_LSS_ELK_TurnLightInTime /end REF_CHARACTERISTIC /end GROUP
/begin GROUP autosar_swc_las_autosar_swc_las_Step_sys_las_ELKState_Machine_ELK_Scene_DashLine_TurnLightAffirm_Subsystem9 "autosar_swc_las/autosar_swc_las_Step_sys/las/ELKState_Machine/ELK_Scene/DashLine/TurnLightAffirm/Subsystem9" /begin REF_MEASUREMENT autosar_swc_las_rtARID_DEF.UnitDelay_DSTATE_gi /end REF_MEASUREMENT /end GROUP
/begin GROUP autosar_swc_las_autosar_swc_las_Step_sys_las_ELKState_Machine_ELK_Scene_Line "autosar_swc_las/autosar_swc_las_Step_sys/las/ELKState_Machine/ELK_Scene/Line"
 /begin SUB_GROUP autosar_swc_las_autosar_swc_las_Step_sys_las_ELKState_Machine_ELK_Scene_Line_Compare_To_Constant1 autosar_swc_las_autosar_swc_las_Step_sys_las_ELKState_Machine_ELK_Scene_Line_Compare_To_Constant2 autosar_swc_las_autosar_swc_las_Step_sys_las_ELKState_Machine_ELK_Scene_Line_Compare_To_Constant3 autosar_swc_las_autosar_swc_las_Step_sys_las_ELKState_Machine_ELK_Scene_Line_Compare_To_Constant4 autosar_swc_las_autosar_swc_las_Step_sys_las_ELKState_Machine_ELK_Scene_Line_Compare_To_Constant5 autosar_swc_las_autosar_swc_las_Step_sys_las_ELKState_Machine_ELK_Scene_Line_Compare_To_Constant6 autosar_swc_las_autosar_swc_las_Step_sys_las_ELKState_Machine_ELK_Scene_Line_Compare_To_Constant7 autosar_swc_las_autosar_swc_las_Step_sys_las_ELKState_Machine_ELK_Scene_Line_Compare_To_Constant8 autosar_swc_las_autosar_swc_las_Step_sys_las_ELKState_Machine_ELK_Scene_Line_Compare_To_Zero autosar_swc_las_autosar_swc_las_Step_sys_las_ELKState_Machine_ELK_Scene_Line_Compare_To_Zero1 autosar_swc_las_autosar_swc_las_Step_sys_las_ELKState_Machine_ELK_Scene_Line_ObsAffirm autosar_swc_las_autosar_swc_las_Step_sys_las_ELKState_Machine_ELK_Scene_Line_ObsAffirm1 autosar_swc_las_autosar_swc_las_Step_sys_las_ELKState_Machine_ELK_Scene_Line_Subsystem autosar_swc_las_autosar_swc_las_Step_sys_las_ELKState_Machine_ELK_Scene_Line_Subsystem1 autosar_swc_las_autosar_swc_las_Step_sys_las_ELKState_Machine_ELK_Scene_Line_TurnLightAffirm autosar_swc_las_autosar_swc_las_Step_sys_las_ELKState_Machine_ELK_Scene_Line_TurnLightAffirm1 /end SUB_GROUP
 /begin REF_CHARACTERISTIC P_LSS_ELK_EndSwitch P_LSS_ELK_LineIntervenSw P_LSS_ELK_ShildDashLineOnlyWarn P_LSS_ELK_State_Param_A0Offset P_LSS_ELK_State_Param_A1leOffset P_LSS_ELK_State_Param_AngleOffset P_LSS_ELK_State_Param_InterventionZoneOut P_LSS_ELK_State_Param_LeftInterventionZoneIn P_LSS_ELK_State_Param_OutOffset P_LSS_ELK_State_Param_RightInterventionZoneIn /end REF_CHARACTERISTIC
 /begin REF_MEASUREMENT LAS_ELK_FiLeftIntervention LAS_ELK_FiRightIntervention LAS_ELK_LeftEnd LAS_ELK_LeftIntervention LAS_ELK_Leftout LAS_ELK_LineInterState_st LAS_ELK_RightIntervention LAS_ELK_RightInterventionEnd LAS_ELK_Rightout LAS_FLWhelDy LAS_FRWhelDy autosar_swc_las_rtARID_DEF.UnitDelay1_DSTATE_d autosar_swc_las_rtARID_DEF.UnitDelay2_DSTATE_mz autosar_swc_las_rtARID_DEF.UnitDelay3_DSTATE_n autosar_swc_las_rtARID_DEF.UnitDelay4_DSTATE_a autosar_swc_las_rtARID_DEF.UnitDelay5_DSTATE_ny autosar_swc_las_rtARID_DEF.UnitDelay_DSTATE_fq autosar_swc_las_rtARID_DEF.is_active_c23_autosar_swc_las autosar_swc_las_rtARID_DEF.is_c23_autosar_swc_las /end REF_MEASUREMENT
/end GROUP
/begin GROUP autosar_swc_las_autosar_swc_las_Step_sys_las_ELKState_Machine_ELK_Scene_Line_Compare_To_Zero "autosar_swc_las/autosar_swc_las_Step_sys/las/ELKState_Machine/ELK_Scene/Line/Compare\nTo Zero" /begin REF_MEASUREMENT LAS_FLWhelDy /end REF_MEASUREMENT /end GROUP
/begin GROUP autosar_swc_las_autosar_swc_las_Step_sys_las_ELKState_Machine_ELK_Scene_Line_Compare_To_Zero1 "autosar_swc_las/autosar_swc_las_Step_sys/las/ELKState_Machine/ELK_Scene/Line/Compare\nTo Zero1" /begin REF_MEASUREMENT LAS_FRWhelDy /end REF_MEASUREMENT /end GROUP
/begin GROUP autosar_swc_las_autosar_swc_las_Step_sys_las_ELKState_Machine_ELK_Scene_Line_ObsAffirm "autosar_swc_las/autosar_swc_las_Step_sys/las/ELKState_Machine/ELK_Scene/Line/ObsAffirm"
 /begin SUB_GROUP autosar_swc_las_autosar_swc_las_Step_sys_las_ELKState_Machine_ELK_Scene_Line_ObsAffirm_Compare_To_Constant212 autosar_swc_las_autosar_swc_las_Step_sys_las_ELKState_Machine_ELK_Scene_Line_ObsAffirm_Subsystem9 /end SUB_GROUP
/end GROUP
/begin GROUP autosar_swc_las_autosar_swc_las_Step_sys_las_ELKState_Machine_ELK_Scene_Line_ObsAffirm1 "autosar_swc_las/autosar_swc_las_Step_sys/las/ELKState_Machine/ELK_Scene/Line/ObsAffirm1"
 /begin SUB_GROUP autosar_swc_las_autosar_swc_las_Step_sys_las_ELKState_Machine_ELK_Scene_Line_ObsAffirm1_Compare_To_Constant212 autosar_swc_las_autosar_swc_las_Step_sys_las_ELKState_Machine_ELK_Scene_Line_ObsAffirm1_Subsystem9 /end SUB_GROUP
/end GROUP
/begin GROUP autosar_swc_las_autosar_swc_las_Step_sys_las_ELKState_Machine_ELK_Scene_Line_ObsAffirm1_Compare_To_Constant212 "autosar_swc_las/autosar_swc_las_Step_sys/las/ELKState_Machine/ELK_Scene/Line/ObsAffirm1/Compare\nTo Constant212" /begin REF_CHARACTERISTIC P_LSS_ELK_ObsFlagTime /end REF_CHARACTERISTIC /end GROUP
/begin GROUP autosar_swc_las_autosar_swc_las_Step_sys_las_ELKState_Machine_ELK_Scene_Line_ObsAffirm1_Subsystem9 "autosar_swc_las/autosar_swc_las_Step_sys/las/ELKState_Machine/ELK_Scene/Line/ObsAffirm1/Subsystem9" /begin REF_MEASUREMENT autosar_swc_las_rtARID_DEF.UnitDelay_DSTATE_g3 /end REF_MEASUREMENT /end GROUP
/begin GROUP autosar_swc_las_autosar_swc_las_Step_sys_las_ELKState_Machine_ELK_Scene_Line_ObsAffirm_Compare_To_Constant212 "autosar_swc_las/autosar_swc_las_Step_sys/las/ELKState_Machine/ELK_Scene/Line/ObsAffirm/Compare\nTo Constant212" /begin REF_CHARACTERISTIC P_LSS_ELK_ObsFlagTime /end REF_CHARACTERISTIC /end GROUP
/begin GROUP autosar_swc_las_autosar_swc_las_Step_sys_las_ELKState_Machine_ELK_Scene_Line_ObsAffirm_Subsystem9 "autosar_swc_las/autosar_swc_las_Step_sys/las/ELKState_Machine/ELK_Scene/Line/ObsAffirm/Subsystem9" /begin REF_MEASUREMENT autosar_swc_las_rtARID_DEF.UnitDelay_DSTATE_f2 /end REF_MEASUREMENT /end GROUP
/begin GROUP autosar_swc_las_autosar_swc_las_Step_sys_las_ELKState_Machine_ELK_Scene_Line_Subsystem "autosar_swc_las/autosar_swc_las_Step_sys/las/ELKState_Machine/ELK_Scene/Line/Subsystem"
 /begin SUB_GROUP autosar_swc_las_autosar_swc_las_Step_sys_las_ELKState_Machine_ELK_Scene_Line_Subsystem_Subsystem2 /end SUB_GROUP
 /begin REF_MEASUREMENT LAS_FLWhelDy autosar_swc_las_rtARID_DEF.UnitDelay_DSTATE_nq /end REF_MEASUREMENT
/end GROUP
/begin GROUP autosar_swc_las_autosar_swc_las_Step_sys_las_ELKState_Machine_ELK_Scene_Line_Subsystem1 "autosar_swc_las/autosar_swc_las_Step_sys/las/ELKState_Machine/ELK_Scene/Line/Subsystem1"
 /begin SUB_GROUP autosar_swc_las_autosar_swc_las_Step_sys_las_ELKState_Machine_ELK_Scene_Line_Subsystem1_Subsystem2 /end SUB_GROUP
 /begin REF_MEASUREMENT LAS_FRWhelDy autosar_swc_las_rtARID_DEF.UnitDelay_DSTATE_ik /end REF_MEASUREMENT
/end GROUP
/begin GROUP autosar_swc_las_autosar_swc_las_Step_sys_las_ELKState_Machine_ELK_Scene_Line_Subsystem1_Subsystem2 "autosar_swc_las/autosar_swc_las_Step_sys/las/ELKState_Machine/ELK_Scene/Line/Subsystem1/Subsystem2" /begin REF_MEASUREMENT autosar_swc_las_rtARID_DEF.UnitDelay_DSTATE_cm /end REF_MEASUREMENT /end GROUP
/begin GROUP autosar_swc_las_autosar_swc_las_Step_sys_las_ELKState_Machine_ELK_Scene_Line_Subsystem_Subsystem2 "autosar_swc_las/autosar_swc_las_Step_sys/las/ELKState_Machine/ELK_Scene/Line/Subsystem/Subsystem2" /begin REF_MEASUREMENT autosar_swc_las_rtARID_DEF.UnitDelay_DSTATE_k /end REF_MEASUREMENT /end GROUP
/begin GROUP autosar_swc_las_autosar_swc_las_Step_sys_las_ELKState_Machine_ELK_Scene_Line_TurnLightAffirm "autosar_swc_las/autosar_swc_las_Step_sys/las/ELKState_Machine/ELK_Scene/Line/TurnLightAffirm"
 /begin SUB_GROUP autosar_swc_las_autosar_swc_las_Step_sys_las_ELKState_Machine_ELK_Scene_Line_TurnLightAffirm_Compare_To_Constant212 autosar_swc_las_autosar_swc_las_Step_sys_las_ELKState_Machine_ELK_Scene_Line_TurnLightAffirm_Subsystem9 /end SUB_GROUP
/end GROUP
/begin GROUP autosar_swc_las_autosar_swc_las_Step_sys_las_ELKState_Machine_ELK_Scene_Line_TurnLightAffirm1 "autosar_swc_las/autosar_swc_las_Step_sys/las/ELKState_Machine/ELK_Scene/Line/TurnLightAffirm1"
 /begin SUB_GROUP autosar_swc_las_autosar_swc_las_Step_sys_las_ELKState_Machine_ELK_Scene_Line_TurnLightAffirm1_Compare_To_Constant212 autosar_swc_las_autosar_swc_las_Step_sys_las_ELKState_Machine_ELK_Scene_Line_TurnLightAffirm1_Subsystem9 /end SUB_GROUP
/end GROUP
/begin GROUP autosar_swc_las_autosar_swc_las_Step_sys_las_ELKState_Machine_ELK_Scene_Line_TurnLightAffirm1_Compare_To_Constant212 "autosar_swc_las/autosar_swc_las_Step_sys/las/ELKState_Machine/ELK_Scene/Line/TurnLightAffirm1/Compare\nTo Constant212" /begin REF_CHARACTERISTIC P_LSS_ELK_TurnLightInTime /end REF_CHARACTERISTIC /end GROUP
/begin GROUP autosar_swc_las_autosar_swc_las_Step_sys_las_ELKState_Machine_ELK_Scene_Line_TurnLightAffirm1_Subsystem9 "autosar_swc_las/autosar_swc_las_Step_sys/las/ELKState_Machine/ELK_Scene/Line/TurnLightAffirm1/Subsystem9" /begin REF_MEASUREMENT autosar_swc_las_rtARID_DEF.UnitDelay_DSTATE_nv /end REF_MEASUREMENT /end GROUP
/begin GROUP autosar_swc_las_autosar_swc_las_Step_sys_las_ELKState_Machine_ELK_Scene_Line_TurnLightAffirm_Compare_To_Constant212 "autosar_swc_las/autosar_swc_las_Step_sys/las/ELKState_Machine/ELK_Scene/Line/TurnLightAffirm/Compare\nTo Constant212" /begin REF_CHARACTERISTIC P_LSS_ELK_TurnLightInTime /end REF_CHARACTERISTIC /end GROUP
/begin GROUP autosar_swc_las_autosar_swc_las_Step_sys_las_ELKState_Machine_ELK_Scene_Line_TurnLightAffirm_Subsystem9 "autosar_swc_las/autosar_swc_las_Step_sys/las/ELKState_Machine/ELK_Scene/Line/TurnLightAffirm/Subsystem9" /begin REF_MEASUREMENT autosar_swc_las_rtARID_DEF.UnitDelay_DSTATE_mb /end REF_MEASUREMENT /end GROUP
/begin GROUP autosar_swc_las_autosar_swc_las_Step_sys_las_ELKState_Machine_ELK_Scene_OnComingCal "autosar_swc_las/autosar_swc_las_Step_sys/las/ELKState_Machine/ELK_Scene/OnComingCal"
 /begin SUB_GROUP autosar_swc_las_autosar_swc_las_Step_sys_las_ELKState_Machine_ELK_Scene_OnComingCal_LeftOnComingFlag autosar_swc_las_autosar_swc_las_Step_sys_las_ELKState_Machine_ELK_Scene_OnComingCal_ObjectSelect1 autosar_swc_las_autosar_swc_las_Step_sys_las_ELKState_Machine_ELK_Scene_OnComingCal_RightOnComingFlag /end SUB_GROUP
 /begin REF_CHARACTERISTIC P_LSS_ELK_ConditionSw_b /end REF_CHARACTERISTIC
 /begin REF_MEASUREMENT LAS_ELK_LeftOnComingFlag_b LAS_ELK_OnComingFlag_b LAS_ELK_OnComing_LOut_b LAS_ELK_OnComing_LetfCondition_b LAS_ELK_OnComing_ROut_b LAS_ELK_OnComing_RightCondition_b LAS_ELK_RightOnComingFlag_b autosar_swc_las_rtARID_DEF.is_active_c32_autosar_swc_las autosar_swc_las_rtARID_DEF.is_c32_autosar_swc_las autosar_swc_las_rtARID_DEF.left_count_m autosar_swc_las_rtARID_DEF.right_count_n /end REF_MEASUREMENT
/end GROUP
/begin GROUP autosar_swc_las_autosar_swc_las_Step_sys_las_ELKState_Machine_ELK_Scene_OnComingCal_LeftOnComingFlag "autosar_swc_las/autosar_swc_las_Step_sys/las/ELKState_Machine/ELK_Scene/OnComingCal/LeftOnComingFlag"
 /begin SUB_GROUP autosar_swc_las_autosar_swc_las_Step_sys_las_ELKState_Machine_ELK_Scene_OnComingCal_LeftOnComingFlag_Compare_To_Constant autosar_swc_las_autosar_swc_las_Step_sys_las_ELKState_Machine_ELK_Scene_OnComingCal_LeftOnComingFlag_Subsystem autosar_swc_las_autosar_swc_las_Step_sys_las_ELKState_Machine_ELK_Scene_OnComingCal_LeftOnComingFlag_Subsystem10 autosar_swc_las_autosar_swc_las_Step_sys_las_ELKState_Machine_ELK_Scene_OnComingCal_LeftOnComingFlag_Subsystem3 /end SUB_GROUP
 /begin REF_CHARACTERISTIC P_LSS_ELK_LeftLaneProb P_LSS_ELK_LeftLatDisOffset_m P_LSS_ELK_LeftOnFLWhelDyMinDis P_LSS_ELK_LineKapFilterCoef P_LSS_ELK_LineKapFlagDefault P_LSS_ELK_LineKapFlagShiledSw P_LSS_ELK_MotorOrBicycleWidth_m P_LSS_ELK_OnComingLeftLineKap_TableY P_LSS_ELK_OnComing_TTC P_LSS_ELK_OvertakingObjectMaxLatDis_m P_LSS_ELK_OvertakingObjectMinLatDis_m P_LSS_ELK_VehSpdKap_TableX /end REF_CHARACTERISTIC
 /begin REF_MEASUREMENT LAS_ELK_LOnComingMinDyKap LAS_ELK_LeftOnComing2LineMinDy LAS_ELK_LeftOnComingApproachFlag_b LAS_ELK_LeftOnComingDyFlag LAS_ELK_LeftOnComingFlag_b LAS_ELK_LeftOnComingKapFlag_b LAS_ELK_LeftOnComingLatDis LAS_ELK_LeftOnComingLatDisFlag LAS_ELK_LeftOnComingLatDisOffsetFlag_b LAS_ELK_LeftOnComingNoKapFlag_b LAS_ELK_LeftOnComingTTC LAS_ELK_LeftOnComingTTCFlag LAS_FLWhelDy autosar_swc_las_rtARID_DEF.UnitDelay_DSTATE_kvs /end REF_MEASUREMENT
/end GROUP
/begin GROUP autosar_swc_las_autosar_swc_las_Step_sys_las_ELKState_Machine_ELK_Scene_OnComingCal_LeftOnComingFlag_Compare_To_Constant "autosar_swc_las/autosar_swc_las_Step_sys/las/ELKState_Machine/ELK_Scene/OnComingCal/LeftOnComingFlag/Compare\nTo Constant" /begin REF_CHARACTERISTIC P_LSS_ELK_LatDisOffsetTime_s /end REF_CHARACTERISTIC /begin REF_MEASUREMENT LAS_ELK_LeftOnComingLatDisOffsetFlag_b /end REF_MEASUREMENT /end GROUP
/begin GROUP autosar_swc_las_autosar_swc_las_Step_sys_las_ELKState_Machine_ELK_Scene_OnComingCal_LeftOnComingFlag_Subsystem "autosar_swc_las/autosar_swc_las_Step_sys/las/ELKState_Machine/ELK_Scene/OnComingCal/LeftOnComingFlag/Subsystem" /begin REF_CHARACTERISTIC P_LSS_ELK_ObjectObj_MovType_MOVING /end REF_CHARACTERISTIC /end GROUP
/begin GROUP autosar_swc_las_autosar_swc_las_Step_sys_las_ELKState_Machine_ELK_Scene_OnComingCal_LeftOnComingFlag_Subsystem10 "autosar_swc_las/autosar_swc_las_Step_sys/las/ELKState_Machine/ELK_Scene/OnComingCal/LeftOnComingFlag/Subsystem10" /begin REF_MEASUREMENT autosar_swc_las_rtARID_DEF.UnitDelay_DSTATE_mp /end REF_MEASUREMENT /end GROUP
/begin GROUP autosar_swc_las_autosar_swc_las_Step_sys_las_ELKState_Machine_ELK_Scene_OnComingCal_LeftOnComingFlag_Subsystem3 "autosar_swc_las/autosar_swc_las_Step_sys/las/ELKState_Machine/ELK_Scene/OnComingCal/LeftOnComingFlag/Subsystem3"
 /begin SUB_GROUP autosar_swc_las_autosar_swc_las_Step_sys_las_ELKState_Machine_ELK_Scene_OnComingCal_LeftOnComingFlag_Subsystem3_Subsystem2 /end SUB_GROUP
 /begin REF_MEASUREMENT LAS_FLWhelDy autosar_swc_las_rtARID_DEF.UnitDelay_DSTATE_bc /end REF_MEASUREMENT
/end GROUP
/begin GROUP autosar_swc_las_autosar_swc_las_Step_sys_las_ELKState_Machine_ELK_Scene_OnComingCal_LeftOnComingFlag_Subsystem3_Subsystem2 "autosar_swc_las/autosar_swc_las_Step_sys/las/ELKState_Machine/ELK_Scene/OnComingCal/LeftOnComingFlag/Subsystem3/Subsystem2" /begin REF_MEASUREMENT autosar_swc_las_rtARID_DEF.UnitDelay_DSTATE_ct /end REF_MEASUREMENT /end GROUP
/begin GROUP autosar_swc_las_autosar_swc_las_Step_sys_las_ELKState_Machine_ELK_Scene_OnComingCal_ObjectSelect1 "autosar_swc_las/autosar_swc_las_Step_sys/las/ELKState_Machine/ELK_Scene/OnComingCal/ObjectSelect1"
 /begin SUB_GROUP autosar_swc_las_autosar_swc_las_Step_sys_las_ELKState_Machine_ELK_Scene_OnComingCal_ObjectSelect1_Compare_To_Constant autosar_swc_las_autosar_swc_las_Step_sys_las_ELKState_Machine_ELK_Scene_OnComingCal_ObjectSelect1_Compare_To_Constant1 autosar_swc_las_autosar_swc_las_Step_sys_las_ELKState_Machine_ELK_Scene_OnComingCal_ObjectSelect1_Compare_To_Constant2 autosar_swc_las_autosar_swc_las_Step_sys_las_ELKState_Machine_ELK_Scene_OnComingCal_ObjectSelect1_Compare_To_Constant3 autosar_swc_las_autosar_swc_las_Step_sys_las_ELKState_Machine_ELK_Scene_OnComingCal_ObjectSelect1_Compare_To_Constant4 autosar_swc_las_autosar_swc_las_Step_sys_las_ELKState_Machine_ELK_Scene_OnComingCal_ObjectSelect1_Compare_To_Constant5 autosar_swc_las_autosar_swc_las_Step_sys_las_ELKState_Machine_ELK_Scene_OnComingCal_ObjectSelect1_Compare_To_Constant6 autosar_swc_las_autosar_swc_las_Step_sys_las_ELKState_Machine_ELK_Scene_OnComingCal_ObjectSelect1_Compare_To_Constant7 /end SUB_GROUP
 /begin REF_MEASUREMENT autosar_swc_las_rtARID_DEF.UnitDelay1_DSTATE_cs autosar_swc_las_rtARID_DEF.UnitDelay_DSTATE_pz /end REF_MEASUREMENT
/end GROUP
/begin GROUP autosar_swc_las_autosar_swc_las_Step_sys_las_ELKState_Machine_ELK_Scene_OnComingCal_ObjectSelect1_Compare_To_Constant "autosar_swc_las/autosar_swc_las_Step_sys/las/ELKState_Machine/ELK_Scene/OnComingCal/ObjectSelect1/Compare\nTo Constant" /begin REF_CHARACTERISTIC P_LSS_ELK_LeftOnComingInAreaLowDis_m /end REF_CHARACTERISTIC /end GROUP
/begin GROUP autosar_swc_las_autosar_swc_las_Step_sys_las_ELKState_Machine_ELK_Scene_OnComingCal_ObjectSelect1_Compare_To_Constant1 "autosar_swc_las/autosar_swc_las_Step_sys/las/ELKState_Machine/ELK_Scene/OnComingCal/ObjectSelect1/Compare\nTo Constant1" /begin REF_CHARACTERISTIC P_LSS_ELK_LeftOnComingInAreaHiDis_m /end REF_CHARACTERISTIC /end GROUP
/begin GROUP autosar_swc_las_autosar_swc_las_Step_sys_las_ELKState_Machine_ELK_Scene_OnComingCal_ObjectSelect1_Compare_To_Constant2 "autosar_swc_las/autosar_swc_las_Step_sys/las/ELKState_Machine/ELK_Scene/OnComingCal/ObjectSelect1/Compare\nTo Constant2" /begin REF_CHARACTERISTIC P_LSS_ELK_LeftOnComingOutAreaLowDis_m /end REF_CHARACTERISTIC /end GROUP
/begin GROUP autosar_swc_las_autosar_swc_las_Step_sys_las_ELKState_Machine_ELK_Scene_OnComingCal_ObjectSelect1_Compare_To_Constant3 "autosar_swc_las/autosar_swc_las_Step_sys/las/ELKState_Machine/ELK_Scene/OnComingCal/ObjectSelect1/Compare\nTo Constant3" /begin REF_CHARACTERISTIC P_LSS_ELK_LeftOnComingOutAreaHiDis_m /end REF_CHARACTERISTIC /end GROUP
/begin GROUP autosar_swc_las_autosar_swc_las_Step_sys_las_ELKState_Machine_ELK_Scene_OnComingCal_ObjectSelect1_Compare_To_Constant4 "autosar_swc_las/autosar_swc_las_Step_sys/las/ELKState_Machine/ELK_Scene/OnComingCal/ObjectSelect1/Compare\nTo Constant4" /begin REF_CHARACTERISTIC P_LSS_ELK_RightOnComingInAreaHiDis_m /end REF_CHARACTERISTIC /end GROUP
/begin GROUP autosar_swc_las_autosar_swc_las_Step_sys_las_ELKState_Machine_ELK_Scene_OnComingCal_ObjectSelect1_Compare_To_Constant5 "autosar_swc_las/autosar_swc_las_Step_sys/las/ELKState_Machine/ELK_Scene/OnComingCal/ObjectSelect1/Compare\nTo Constant5" /begin REF_CHARACTERISTIC P_LSS_ELK_RightOnComingInAreaLowDis_m /end REF_CHARACTERISTIC /end GROUP
/begin GROUP autosar_swc_las_autosar_swc_las_Step_sys_las_ELKState_Machine_ELK_Scene_OnComingCal_ObjectSelect1_Compare_To_Constant6 "autosar_swc_las/autosar_swc_las_Step_sys/las/ELKState_Machine/ELK_Scene/OnComingCal/ObjectSelect1/Compare\nTo Constant6" /begin REF_CHARACTERISTIC P_LSS_ELK_RightOnComingOutAreaHiDis_m /end REF_CHARACTERISTIC /end GROUP
/begin GROUP autosar_swc_las_autosar_swc_las_Step_sys_las_ELKState_Machine_ELK_Scene_OnComingCal_ObjectSelect1_Compare_To_Constant7 "autosar_swc_las/autosar_swc_las_Step_sys/las/ELKState_Machine/ELK_Scene/OnComingCal/ObjectSelect1/Compare\nTo Constant7" /begin REF_CHARACTERISTIC P_LSS_ELK_RightOnComingOutAreaLowDis_m /end REF_CHARACTERISTIC /end GROUP
/begin GROUP autosar_swc_las_autosar_swc_las_Step_sys_las_ELKState_Machine_ELK_Scene_OnComingCal_RightOnComingFlag "autosar_swc_las/autosar_swc_las_Step_sys/las/ELKState_Machine/ELK_Scene/OnComingCal/RightOnComingFlag"
 /begin SUB_GROUP autosar_swc_las_autosar_swc_las_Step_sys_las_ELKState_Machine_ELK_Scene_OnComingCal_RightOnComingFlag_Compare_To_Constant1 autosar_swc_las_autosar_swc_las_Step_sys_las_ELKState_Machine_ELK_Scene_OnComingCal_RightOnComingFlag_Subsystem autosar_swc_las_autosar_swc_las_Step_sys_las_ELKState_Machine_ELK_Scene_OnComingCal_RightOnComingFlag_Subsystem10 autosar_swc_las_autosar_swc_las_Step_sys_las_ELKState_Machine_ELK_Scene_OnComingCal_RightOnComingFlag_Subsystem4 /end SUB_GROUP
 /begin REF_CHARACTERISTIC P_LSS_ELK_LineKapFilterCoef P_LSS_ELK_LineKapFlagDefault P_LSS_ELK_LineKapFlagShiledSw P_LSS_ELK_MotorOrBicycleWidth_m P_LSS_ELK_OnComingRightLineKap_TableY P_LSS_ELK_OnComing_TTC P_LSS_ELK_OvertakingObjectMaxLatDis_m P_LSS_ELK_OvertakingObjectMinLatDis_m P_LSS_ELK_RiLatDisOffset_m P_LSS_ELK_RightLaneProb P_LSS_ELK_RightOnFRWhelDyMinDis P_LSS_ELK_VehSpdKap_TableX /end REF_CHARACTERISTIC
 /begin REF_MEASUREMENT LAS_ELK_ROnComingMinDyKap LAS_ELK_RiOnComingApproachFlag_b LAS_ELK_RiOnComingLatDisOffsetFlag_b LAS_ELK_RightOnComing2LineMinDy LAS_ELK_RightOnComingDyFlag LAS_ELK_RightOnComingFlag_b LAS_ELK_RightOnComingKapFlag_b LAS_ELK_RightOnComingLatDis LAS_ELK_RightOnComingLatDisFlag LAS_ELK_RightOnComingNoKapFlag_b LAS_ELK_RightOnComingTTC LAS_ELK_RightOnComingTTCFlag LAS_FRWhelDy autosar_swc_las_rtARID_DEF.UnitDelay_DSTATE_dk /end REF_MEASUREMENT
/end GROUP
/begin GROUP autosar_swc_las_autosar_swc_las_Step_sys_las_ELKState_Machine_ELK_Scene_OnComingCal_RightOnComingFlag_Compare_To_Constant1 "autosar_swc_las/autosar_swc_las_Step_sys/las/ELKState_Machine/ELK_Scene/OnComingCal/RightOnComingFlag/Compare\nTo Constant1" /begin REF_CHARACTERISTIC P_LSS_ELK_LatDisOffsetTime_s /end REF_CHARACTERISTIC /begin REF_MEASUREMENT LAS_ELK_RiOnComingLatDisOffsetFlag_b /end REF_MEASUREMENT /end GROUP
/begin GROUP autosar_swc_las_autosar_swc_las_Step_sys_las_ELKState_Machine_ELK_Scene_OnComingCal_RightOnComingFlag_Subsystem "autosar_swc_las/autosar_swc_las_Step_sys/las/ELKState_Machine/ELK_Scene/OnComingCal/RightOnComingFlag/Subsystem" /begin REF_CHARACTERISTIC P_LSS_ELK_ObjectObj_MovType_MOVING /end REF_CHARACTERISTIC /end GROUP
/begin GROUP autosar_swc_las_autosar_swc_las_Step_sys_las_ELKState_Machine_ELK_Scene_OnComingCal_RightOnComingFlag_Subsystem10 "autosar_swc_las/autosar_swc_las_Step_sys/las/ELKState_Machine/ELK_Scene/OnComingCal/RightOnComingFlag/Subsystem10" /begin REF_MEASUREMENT autosar_swc_las_rtARID_DEF.UnitDelay_DSTATE_fx /end REF_MEASUREMENT /end GROUP
/begin GROUP autosar_swc_las_autosar_swc_las_Step_sys_las_ELKState_Machine_ELK_Scene_OnComingCal_RightOnComingFlag_Subsystem4 "autosar_swc_las/autosar_swc_las_Step_sys/las/ELKState_Machine/ELK_Scene/OnComingCal/RightOnComingFlag/Subsystem4"
 /begin SUB_GROUP autosar_swc_las_autosar_swc_las_Step_sys_las_ELKState_Machine_ELK_Scene_OnComingCal_RightOnComingFlag_Subsystem4_Subsystem2 /end SUB_GROUP
 /begin REF_MEASUREMENT LAS_FRWhelDy autosar_swc_las_rtARID_DEF.UnitDelay_DSTATE_db /end REF_MEASUREMENT
/end GROUP
/begin GROUP autosar_swc_las_autosar_swc_las_Step_sys_las_ELKState_Machine_ELK_Scene_OnComingCal_RightOnComingFlag_Subsystem4_Subsystem2 "autosar_swc_las/autosar_swc_las_Step_sys/las/ELKState_Machine/ELK_Scene/OnComingCal/RightOnComingFlag/Subsystem4/Subsystem2" /begin REF_MEASUREMENT autosar_swc_las_rtARID_DEF.UnitDelay_DSTATE_oo /end REF_MEASUREMENT /end GROUP
/begin GROUP autosar_swc_las_autosar_swc_las_Step_sys_las_ELKState_Machine_ELK_Scene_OvertakingCal "autosar_swc_las/autosar_swc_las_Step_sys/las/ELKState_Machine/ELK_Scene/OvertakingCal"
 /begin SUB_GROUP autosar_swc_las_autosar_swc_las_Step_sys_las_ELKState_Machine_ELK_Scene_OvertakingCal_LeftOvertakingFlag autosar_swc_las_autosar_swc_las_Step_sys_las_ELKState_Machine_ELK_Scene_OvertakingCal_ObjectSelect autosar_swc_las_autosar_swc_las_Step_sys_las_ELKState_Machine_ELK_Scene_OvertakingCal_RightOvertakingFlag /end SUB_GROUP
 /begin REF_CHARACTERISTIC P_LSS_ELK_ConditionSw_b /end REF_CHARACTERISTIC
 /begin REF_MEASUREMENT LAS_ELK_LeftOvertakingFlag_b LAS_ELK_OverTaking_LOut_b LAS_ELK_OverTaking_LeftCondition_b LAS_ELK_OverTaking_ROut_b LAS_ELK_OverTaking_RightCondition_b LAS_ELK_OvertakingFlag_b LAS_ELK_RightOvertakingFlag_b autosar_swc_las_rtARID_DEF.is_active_c48_autosar_swc_las autosar_swc_las_rtARID_DEF.is_c48_autosar_swc_las autosar_swc_las_rtARID_DEF.left_count_j autosar_swc_las_rtARID_DEF.right_count_k /end REF_MEASUREMENT
/end GROUP
/begin GROUP autosar_swc_las_autosar_swc_las_Step_sys_las_ELKState_Machine_ELK_Scene_OvertakingCal_LeftOvertakingFlag "autosar_swc_las/autosar_swc_las_Step_sys/las/ELKState_Machine/ELK_Scene/OvertakingCal/LeftOvertakingFlag"
 /begin SUB_GROUP autosar_swc_las_autosar_swc_las_Step_sys_las_ELKState_Machine_ELK_Scene_OvertakingCal_LeftOvertakingFlag_Compare_To_Constant autosar_swc_las_autosar_swc_las_Step_sys_las_ELKState_Machine_ELK_Scene_OvertakingCal_LeftOvertakingFlag_Compare_To_Constant1 autosar_swc_las_autosar_swc_las_Step_sys_las_ELKState_Machine_ELK_Scene_OvertakingCal_LeftOvertakingFlag_Subsystem autosar_swc_las_autosar_swc_las_Step_sys_las_ELKState_Machine_ELK_Scene_OvertakingCal_LeftOvertakingFlag_Subsystem1 autosar_swc_las_autosar_swc_las_Step_sys_las_ELKState_Machine_ELK_Scene_OvertakingCal_LeftOvertakingFlag_Subsystem10 autosar_swc_las_autosar_swc_las_Step_sys_las_ELKState_Machine_ELK_Scene_OvertakingCal_LeftOvertakingFlag_Subsystem3 /end SUB_GROUP
 /begin REF_CHARACTERISTIC P_LSS_ELK_LeftLatDisOffset_m P_LSS_ELK_LeftOverFLWhelDyMinDis P_LSS_ELK_LineKapFilterCoef P_LSS_ELK_LineKapFlagDefault P_LSS_ELK_LineKapFlagShiledSw P_LSS_ELK_MotorOrBicycleWidth_m P_LSS_ELK_OverObjectLength_m P_LSS_ELK_OverObjectVx_ms P_LSS_ELK_OverTaking_TTC P_LSS_ELK_OvertakingDySw P_LSS_ELK_OvertakingLeftLineKap_TableY P_LSS_ELK_OvertakingObjectMaxLatDis_m P_LSS_ELK_OvertakingObjectMinLatDis_m P_LSS_ELK_OvertakingTTCSw P_LSS_ELK_VehSpdKap_TableX /end REF_CHARACTERISTIC
 /begin REF_MEASUREMENT LAS_ELK_LOvertakingMinDyKap LAS_ELK_LeftOverObjInAreaFlag_b LAS_ELK_LeftOvertaking2LineMinDy LAS_ELK_LeftOvertakingApproachFlag_b LAS_ELK_LeftOvertakingDyFlag LAS_ELK_LeftOvertakingFlag_b LAS_ELK_LeftOvertakingKapFlag_b LAS_ELK_LeftOvertakingLatDis LAS_ELK_LeftOvertakingLatDisOffsetFlag_b LAS_ELK_LeftOvertakingLatFlag LAS_ELK_LeftOvertakingNoKapFlag_b LAS_ELK_LeftOvertakingTTC LAS_ELK_LeftOvertakingTTC1 LAS_ELK_LeftOvertakingTTCFlag LAS_FLWhelDy autosar_swc_las_rtARID_DEF.UnitDelay_DSTATE_ls /end REF_MEASUREMENT
/end GROUP
/begin GROUP autosar_swc_las_autosar_swc_las_Step_sys_las_ELKState_Machine_ELK_Scene_OvertakingCal_LeftOvertakingFlag_Compare_To_Constant "autosar_swc_las/autosar_swc_las_Step_sys/las/ELKState_Machine/ELK_Scene/OvertakingCal/LeftOvertakingFlag/Compare\nTo Constant" /begin REF_CHARACTERISTIC P_LSS_ELK_OverObjDxExitLength_m /end REF_CHARACTERISTIC /end GROUP
/begin GROUP autosar_swc_las_autosar_swc_las_Step_sys_las_ELKState_Machine_ELK_Scene_OvertakingCal_LeftOvertakingFlag_Compare_To_Constant1 "autosar_swc_las/autosar_swc_las_Step_sys/las/ELKState_Machine/ELK_Scene/OvertakingCal/LeftOvertakingFlag/Compare\nTo Constant1" /begin REF_CHARACTERISTIC P_LSS_ELK_LatDisOffsetTime_s /end REF_CHARACTERISTIC /begin REF_MEASUREMENT LAS_ELK_LeftOvertakingLatDisOffsetFlag_b /end REF_MEASUREMENT /end GROUP
/begin GROUP autosar_swc_las_autosar_swc_las_Step_sys_las_ELKState_Machine_ELK_Scene_OvertakingCal_LeftOvertakingFlag_Subsystem "autosar_swc_las/autosar_swc_las_Step_sys/las/ELKState_Machine/ELK_Scene/OvertakingCal/LeftOvertakingFlag/Subsystem" /begin REF_CHARACTERISTIC P_LSS_ELK_ObjectObj_MovType_MOVING /end REF_CHARACTERISTIC /end GROUP
/begin GROUP autosar_swc_las_autosar_swc_las_Step_sys_las_ELKState_Machine_ELK_Scene_OvertakingCal_LeftOvertakingFlag_Subsystem1 "autosar_swc_las/autosar_swc_las_Step_sys/las/ELKState_Machine/ELK_Scene/OvertakingCal/LeftOvertakingFlag/Subsystem1"
 /begin REF_CHARACTERISTIC P_LSS_ELK_OverObjectInAreaHi_m P_LSS_ELK_OverObjectInAreaLow_m /end REF_CHARACTERISTIC
 /begin REF_MEASUREMENT autosar_swc_las_rtARID_DEF.UnitDelay_DSTATE_ks /end REF_MEASUREMENT
/end GROUP
/begin GROUP autosar_swc_las_autosar_swc_las_Step_sys_las_ELKState_Machine_ELK_Scene_OvertakingCal_LeftOvertakingFlag_Subsystem10 "autosar_swc_las/autosar_swc_las_Step_sys/las/ELKState_Machine/ELK_Scene/OvertakingCal/LeftOvertakingFlag/Subsystem10" /begin REF_MEASUREMENT autosar_swc_las_rtARID_DEF.UnitDelay_DSTATE_pu /end REF_MEASUREMENT /end GROUP
/begin GROUP autosar_swc_las_autosar_swc_las_Step_sys_las_ELKState_Machine_ELK_Scene_OvertakingCal_LeftOvertakingFlag_Subsystem3 "autosar_swc_las/autosar_swc_las_Step_sys/las/ELKState_Machine/ELK_Scene/OvertakingCal/LeftOvertakingFlag/Subsystem3"
 /begin SUB_GROUP autosar_swc_las_autosar_swc_las_Step_sys_las_ELKState_Machine_ELK_Scene_OvertakingCal_LeftOvertakingFlag_Subsystem3_Subsystem1 autosar_swc_las_autosar_swc_las_Step_sys_las_ELKState_Machine_ELK_Scene_OvertakingCal_LeftOvertakingFlag_Subsystem3_Subsystem2 /end SUB_GROUP
 /begin REF_MEASUREMENT LAS_FLWhelDy autosar_swc_las_rtARID_DEF.UnitDelay_DSTATE_p3 /end REF_MEASUREMENT
/end GROUP
/begin GROUP autosar_swc_las_autosar_swc_las_Step_sys_las_ELKState_Machine_ELK_Scene_OvertakingCal_LeftOvertakingFlag_Subsystem3_Subsystem1 "autosar_swc_las/autosar_swc_las_Step_sys/las/ELKState_Machine/ELK_Scene/OvertakingCal/LeftOvertakingFlag/Subsystem3/Subsystem1" /begin REF_MEASUREMENT autosar_swc_las_rtARID_DEF.UnitDelay_DSTATE_n2 /end REF_MEASUREMENT /end GROUP
/begin GROUP autosar_swc_las_autosar_swc_las_Step_sys_las_ELKState_Machine_ELK_Scene_OvertakingCal_LeftOvertakingFlag_Subsystem3_Subsystem2 "autosar_swc_las/autosar_swc_las_Step_sys/las/ELKState_Machine/ELK_Scene/OvertakingCal/LeftOvertakingFlag/Subsystem3/Subsystem2" /begin REF_MEASUREMENT autosar_swc_las_rtARID_DEF.UnitDelay_DSTATE_dn /end REF_MEASUREMENT /end GROUP
/begin GROUP autosar_swc_las_autosar_swc_las_Step_sys_las_ELKState_Machine_ELK_Scene_OvertakingCal_ObjectSelect "autosar_swc_las/autosar_swc_las_Step_sys/las/ELKState_Machine/ELK_Scene/OvertakingCal/ObjectSelect"
 /begin SUB_GROUP autosar_swc_las_autosar_swc_las_Step_sys_las_ELKState_Machine_ELK_Scene_OvertakingCal_ObjectSelect_Compare_To_Constant autosar_swc_las_autosar_swc_las_Step_sys_las_ELKState_Machine_ELK_Scene_OvertakingCal_ObjectSelect_Compare_To_Constant1 autosar_swc_las_autosar_swc_las_Step_sys_las_ELKState_Machine_ELK_Scene_OvertakingCal_ObjectSelect_Compare_To_Constant2 autosar_swc_las_autosar_swc_las_Step_sys_las_ELKState_Machine_ELK_Scene_OvertakingCal_ObjectSelect_Compare_To_Constant3 autosar_swc_las_autosar_swc_las_Step_sys_las_ELKState_Machine_ELK_Scene_OvertakingCal_ObjectSelect_Compare_To_Constant6 autosar_swc_las_autosar_swc_las_Step_sys_las_ELKState_Machine_ELK_Scene_OvertakingCal_ObjectSelect_Compare_To_Constant7 autosar_swc_las_autosar_swc_las_Step_sys_las_ELKState_Machine_ELK_Scene_OvertakingCal_ObjectSelect_Compare_To_Constant8 autosar_swc_las_autosar_swc_las_Step_sys_las_ELKState_Machine_ELK_Scene_OvertakingCal_ObjectSelect_Compare_To_Constant9 /end SUB_GROUP
 /begin REF_MEASUREMENT autosar_swc_las_rtARID_DEF.UnitDelay4_DSTATE_c autosar_swc_las_rtARID_DEF.UnitDelay_DSTATE_je /end REF_MEASUREMENT
/end GROUP
/begin GROUP autosar_swc_las_autosar_swc_las_Step_sys_las_ELKState_Machine_ELK_Scene_OvertakingCal_ObjectSelect_Compare_To_Constant "autosar_swc_las/autosar_swc_las_Step_sys/las/ELKState_Machine/ELK_Scene/OvertakingCal/ObjectSelect/Compare\nTo Constant" /begin REF_CHARACTERISTIC P_LSS_ELK_LeftOvtakingInAreaLowDis_m /end REF_CHARACTERISTIC /end GROUP
/begin GROUP autosar_swc_las_autosar_swc_las_Step_sys_las_ELKState_Machine_ELK_Scene_OvertakingCal_ObjectSelect_Compare_To_Constant1 "autosar_swc_las/autosar_swc_las_Step_sys/las/ELKState_Machine/ELK_Scene/OvertakingCal/ObjectSelect/Compare\nTo Constant1" /begin REF_CHARACTERISTIC P_LSS_ELK_LeftOvtakingInAreaHiDis_m /end REF_CHARACTERISTIC /end GROUP
/begin GROUP autosar_swc_las_autosar_swc_las_Step_sys_las_ELKState_Machine_ELK_Scene_OvertakingCal_ObjectSelect_Compare_To_Constant2 "autosar_swc_las/autosar_swc_las_Step_sys/las/ELKState_Machine/ELK_Scene/OvertakingCal/ObjectSelect/Compare\nTo Constant2" /begin REF_CHARACTERISTIC P_LSS_ELK_LeftOvtakingOutAreaLowDis_m /end REF_CHARACTERISTIC /end GROUP
/begin GROUP autosar_swc_las_autosar_swc_las_Step_sys_las_ELKState_Machine_ELK_Scene_OvertakingCal_ObjectSelect_Compare_To_Constant3 "autosar_swc_las/autosar_swc_las_Step_sys/las/ELKState_Machine/ELK_Scene/OvertakingCal/ObjectSelect/Compare\nTo Constant3" /begin REF_CHARACTERISTIC P_LSS_ELK_LeftOvtakingOutAreaHiDis_m /end REF_CHARACTERISTIC /end GROUP
/begin GROUP autosar_swc_las_autosar_swc_las_Step_sys_las_ELKState_Machine_ELK_Scene_OvertakingCal_ObjectSelect_Compare_To_Constant6 "autosar_swc_las/autosar_swc_las_Step_sys/las/ELKState_Machine/ELK_Scene/OvertakingCal/ObjectSelect/Compare\nTo Constant6" /begin REF_CHARACTERISTIC P_LSS_ELK_RightOvtakingInAreaHiDis_m /end REF_CHARACTERISTIC /end GROUP
/begin GROUP autosar_swc_las_autosar_swc_las_Step_sys_las_ELKState_Machine_ELK_Scene_OvertakingCal_ObjectSelect_Compare_To_Constant7 "autosar_swc_las/autosar_swc_las_Step_sys/las/ELKState_Machine/ELK_Scene/OvertakingCal/ObjectSelect/Compare\nTo Constant7" /begin REF_CHARACTERISTIC P_LSS_ELK_RightOvtakingInAreaLowDis_m /end REF_CHARACTERISTIC /end GROUP
/begin GROUP autosar_swc_las_autosar_swc_las_Step_sys_las_ELKState_Machine_ELK_Scene_OvertakingCal_ObjectSelect_Compare_To_Constant8 "autosar_swc_las/autosar_swc_las_Step_sys/las/ELKState_Machine/ELK_Scene/OvertakingCal/ObjectSelect/Compare\nTo Constant8" /begin REF_CHARACTERISTIC P_LSS_ELK_RightOvtakingOutAreaHiDis_m /end REF_CHARACTERISTIC /end GROUP
/begin GROUP autosar_swc_las_autosar_swc_las_Step_sys_las_ELKState_Machine_ELK_Scene_OvertakingCal_ObjectSelect_Compare_To_Constant9 "autosar_swc_las/autosar_swc_las_Step_sys/las/ELKState_Machine/ELK_Scene/OvertakingCal/ObjectSelect/Compare\nTo Constant9" /begin REF_CHARACTERISTIC P_LSS_ELK_RightOvtakingOutAreaLowDis_m /end REF_CHARACTERISTIC /end GROUP
/begin GROUP autosar_swc_las_autosar_swc_las_Step_sys_las_ELKState_Machine_ELK_Scene_OvertakingCal_RightOvertakingFlag "autosar_swc_las/autosar_swc_las_Step_sys/las/ELKState_Machine/ELK_Scene/OvertakingCal/RightOvertakingFlag"
 /begin SUB_GROUP autosar_swc_las_autosar_swc_las_Step_sys_las_ELKState_Machine_ELK_Scene_OvertakingCal_RightOvertakingFlag_Compare_To_Constant1 autosar_swc_las_autosar_swc_las_Step_sys_las_ELKState_Machine_ELK_Scene_OvertakingCal_RightOvertakingFlag_Compare_To_Constant2 autosar_swc_las_autosar_swc_las_Step_sys_las_ELKState_Machine_ELK_Scene_OvertakingCal_RightOvertakingFlag_Subsystem autosar_swc_las_autosar_swc_las_Step_sys_las_ELKState_Machine_ELK_Scene_OvertakingCal_RightOvertakingFlag_Subsystem10 autosar_swc_las_autosar_swc_las_Step_sys_las_ELKState_Machine_ELK_Scene_OvertakingCal_RightOvertakingFlag_Subsystem2 autosar_swc_las_autosar_swc_las_Step_sys_las_ELKState_Machine_ELK_Scene_OvertakingCal_RightOvertakingFlag_Subsystem4 /end SUB_GROUP
 /begin REF_CHARACTERISTIC P_LSS_ELK_LineKapFilterCoef P_LSS_ELK_LineKapFlagDefault P_LSS_ELK_LineKapFlagShiledSw P_LSS_ELK_MotorOrBicycleWidth_m P_LSS_ELK_OverObjectLength_m P_LSS_ELK_OverObjectVx_ms P_LSS_ELK_OverTaking_TTC P_LSS_ELK_OvertakingDySw P_LSS_ELK_OvertakingObjectMaxLatDis_m P_LSS_ELK_OvertakingObjectMinLatDis_m P_LSS_ELK_OvertakingRightLineKap_TableY P_LSS_ELK_OvertakingTTCSw P_LSS_ELK_RiLatDisOffset_m P_LSS_ELK_RightOverFRWhelDyMinDis P_LSS_ELK_VehSpdKap_TableX /end REF_CHARACTERISTIC
 /begin REF_MEASUREMENT LAS_ELK_RiOvertakingApproachFlag_b LAS_ELK_RiOvertakingLatDisOffsetFlag_b LAS_ELK_RightOverObjInAreaFlag_b LAS_ELK_RightOvertaking2LineMinDy LAS_ELK_RightOvertakingDyFlag LAS_ELK_RightOvertakingFlag_b LAS_ELK_RightOvertakingKapFlag_b LAS_ELK_RightOvertakingLatDis LAS_ELK_RightOvertakingLatDisKap LAS_ELK_RightOvertakingLatFlag LAS_ELK_RightOvertakingNoKapFlag_b LAS_ELK_RightOvertakingTTC LAS_ELK_RightOvertakingTTC1 LAS_ELK_RightOvertakingTTCFlag LAS_FRWhelDy autosar_swc_las_rtARID_DEF.UnitDelay_DSTATE_mx /end REF_MEASUREMENT
/end GROUP
/begin GROUP autosar_swc_las_autosar_swc_las_Step_sys_las_ELKState_Machine_ELK_Scene_OvertakingCal_RightOvertakingFlag_Compare_To_Constant1 "autosar_swc_las/autosar_swc_las_Step_sys/las/ELKState_Machine/ELK_Scene/OvertakingCal/RightOvertakingFlag/Compare\nTo Constant1" /begin REF_CHARACTERISTIC P_LSS_ELK_LatDisOffsetTime_s /end REF_CHARACTERISTIC /begin REF_MEASUREMENT LAS_ELK_RiOvertakingLatDisOffsetFlag_b /end REF_MEASUREMENT /end GROUP
/begin GROUP autosar_swc_las_autosar_swc_las_Step_sys_las_ELKState_Machine_ELK_Scene_OvertakingCal_RightOvertakingFlag_Compare_To_Constant2 "autosar_swc_las/autosar_swc_las_Step_sys/las/ELKState_Machine/ELK_Scene/OvertakingCal/RightOvertakingFlag/Compare\nTo Constant2" /begin REF_CHARACTERISTIC P_LSS_ELK_OverObjDxExitLength_m /end REF_CHARACTERISTIC /end GROUP
/begin GROUP autosar_swc_las_autosar_swc_las_Step_sys_las_ELKState_Machine_ELK_Scene_OvertakingCal_RightOvertakingFlag_Subsystem "autosar_swc_las/autosar_swc_las_Step_sys/las/ELKState_Machine/ELK_Scene/OvertakingCal/RightOvertakingFlag/Subsystem" /begin REF_CHARACTERISTIC P_LSS_ELK_ObjectObj_MovType_MOVING /end REF_CHARACTERISTIC /end GROUP
/begin GROUP autosar_swc_las_autosar_swc_las_Step_sys_las_ELKState_Machine_ELK_Scene_OvertakingCal_RightOvertakingFlag_Subsystem10 "autosar_swc_las/autosar_swc_las_Step_sys/las/ELKState_Machine/ELK_Scene/OvertakingCal/RightOvertakingFlag/Subsystem10" /begin REF_MEASUREMENT autosar_swc_las_rtARID_DEF.UnitDelay_DSTATE_jl /end REF_MEASUREMENT /end GROUP
/begin GROUP autosar_swc_las_autosar_swc_las_Step_sys_las_ELKState_Machine_ELK_Scene_OvertakingCal_RightOvertakingFlag_Subsystem2 "autosar_swc_las/autosar_swc_las_Step_sys/las/ELKState_Machine/ELK_Scene/OvertakingCal/RightOvertakingFlag/Subsystem2"
 /begin REF_CHARACTERISTIC P_LSS_ELK_OverObjectInAreaHi_m P_LSS_ELK_OverObjectInAreaLow_m /end REF_CHARACTERISTIC
 /begin REF_MEASUREMENT autosar_swc_las_rtARID_DEF.UnitDelay_DSTATE_fk /end REF_MEASUREMENT
/end GROUP
/begin GROUP autosar_swc_las_autosar_swc_las_Step_sys_las_ELKState_Machine_ELK_Scene_OvertakingCal_RightOvertakingFlag_Subsystem4 "autosar_swc_las/autosar_swc_las_Step_sys/las/ELKState_Machine/ELK_Scene/OvertakingCal/RightOvertakingFlag/Subsystem4"
 /begin SUB_GROUP autosar_swc_las_autosar_swc_las_Step_sys_las_ELKState_Machine_ELK_Scene_OvertakingCal_RightOvertakingFlag_Subsystem4_Subsystem1 autosar_swc_las_autosar_swc_las_Step_sys_las_ELKState_Machine_ELK_Scene_OvertakingCal_RightOvertakingFlag_Subsystem4_Subsystem2 /end SUB_GROUP
 /begin REF_MEASUREMENT LAS_FRWhelDy autosar_swc_las_rtARID_DEF.UnitDelay_DSTATE_edh /end REF_MEASUREMENT
/end GROUP
/begin GROUP autosar_swc_las_autosar_swc_las_Step_sys_las_ELKState_Machine_ELK_Scene_OvertakingCal_RightOvertakingFlag_Subsystem4_Subsystem1 "autosar_swc_las/autosar_swc_las_Step_sys/las/ELKState_Machine/ELK_Scene/OvertakingCal/RightOvertakingFlag/Subsystem4/Subsystem1" /begin REF_MEASUREMENT autosar_swc_las_rtARID_DEF.UnitDelay_DSTATE_da /end REF_MEASUREMENT /end GROUP
/begin GROUP autosar_swc_las_autosar_swc_las_Step_sys_las_ELKState_Machine_ELK_Scene_OvertakingCal_RightOvertakingFlag_Subsystem4_Subsystem2 "autosar_swc_las/autosar_swc_las_Step_sys/las/ELKState_Machine/ELK_Scene/OvertakingCal/RightOvertakingFlag/Subsystem4/Subsystem2" /begin REF_MEASUREMENT autosar_swc_las_rtARID_DEF.UnitDelay_DSTATE_o4 /end REF_MEASUREMENT /end GROUP
/begin GROUP autosar_swc_las_autosar_swc_las_Step_sys_las_ELKState_Machine_ELK_Scene_RoadEge "autosar_swc_las/autosar_swc_las_Step_sys/las/ELKState_Machine/ELK_Scene/RoadEge"
 /begin SUB_GROUP autosar_swc_las_autosar_swc_las_Step_sys_las_ELKState_Machine_ELK_Scene_RoadEge_LeftRoadEgeInterJudge autosar_swc_las_autosar_swc_las_Step_sys_las_ELKState_Machine_ELK_Scene_RoadEge_ObsAffirm autosar_swc_las_autosar_swc_las_Step_sys_las_ELKState_Machine_ELK_Scene_RoadEge_ObsAffirm1 autosar_swc_las_autosar_swc_las_Step_sys_las_ELKState_Machine_ELK_Scene_RoadEge_RightRoadEgeInterJudge /end SUB_GROUP
 /begin REF_MEASUREMENT LAS_ELK_CenterStableFlag_b LAS_ELK_RoadEgeInterState_st autosar_swc_las_rtARID_DEF.is_active_c59_autosar_swc_las autosar_swc_las_rtARID_DEF.is_c59_autosar_swc_las autosar_swc_las_rtARID_DEF.left_count autosar_swc_las_rtARID_DEF.right_count /end REF_MEASUREMENT
/end GROUP
/begin GROUP autosar_swc_las_autosar_swc_las_Step_sys_las_ELKState_Machine_ELK_Scene_RoadEge_LeftRoadEgeInterJudge "autosar_swc_las/autosar_swc_las_Step_sys/las/ELKState_Machine/ELK_Scene/RoadEge/LeftRoadEgeInterJudge"
 /begin SUB_GROUP autosar_swc_las_autosar_swc_las_Step_sys_las_ELKState_Machine_ELK_Scene_RoadEge_LeftRoadEgeInterJudge_Subsystem autosar_swc_las_autosar_swc_las_Step_sys_las_ELKState_Machine_ELK_Scene_RoadEge_LeftRoadEgeInterJudge_Subsystem1 /end SUB_GROUP
 /begin REF_CHARACTERISTIC P_LSS_ELK_RoadEgeInterSw P_LSS_ELK_State_Param_A0Offset P_LSS_ELK_State_Param_A1leOffset /end REF_CHARACTERISTIC
 /begin REF_MEASUREMENT LAS_ELK_CenterStableFlag_b LAS_ELK_FiLeftRoadEgeInter_b LAS_ELK_LeftEgeInventionZone LAS_ELK_LeftRoadEgeInter_b LAS_FLEgeDy LAS_Reserve5 LAS_SCM_LeftEdgLineNear_b LAS_SCM_LeftLaneNear_b autosar_swc_las_rtARID_DEF.UnitDelay_DSTATE_dbu /end REF_MEASUREMENT
/end GROUP
/begin GROUP autosar_swc_las_autosar_swc_las_Step_sys_las_ELKState_Machine_ELK_Scene_RoadEge_LeftRoadEgeInterJudge_Subsystem "autosar_swc_las/autosar_swc_las_Step_sys/las/ELKState_Machine/ELK_Scene/RoadEge/LeftRoadEgeInterJudge/Subsystem"
 /begin REF_CHARACTERISTIC P_LSS_ELK_FL2LeftEgeDisOffset_m P_LSS_ELK_LeftEgeDisOffset_TableY P_LSS_ELK_RoadEgeOffsetSw P_LSS_ELK_StandLaneWid P_LSS_ELK_VehSpdRoadEge_TableX /end REF_CHARACTERISTIC
 /begin REF_MEASUREMENT LAS_ELK_LeftEgeInventionZone /end REF_MEASUREMENT
/end GROUP
/begin GROUP autosar_swc_las_autosar_swc_las_Step_sys_las_ELKState_Machine_ELK_Scene_RoadEge_LeftRoadEgeInterJudge_Subsystem1 "autosar_swc_las/autosar_swc_las_Step_sys/las/ELKState_Machine/ELK_Scene/RoadEge/LeftRoadEgeInterJudge/Subsystem1"
 /begin SUB_GROUP autosar_swc_las_autosar_swc_las_Step_sys_las_ELKState_Machine_ELK_Scene_RoadEge_LeftRoadEgeInterJudge_Subsystem1_Compare_To_Constant1 autosar_swc_las_autosar_swc_las_Step_sys_las_ELKState_Machine_ELK_Scene_RoadEge_LeftRoadEgeInterJudge_Subsystem1_Subsystem8 /end SUB_GROUP
 /begin REF_CHARACTERISTIC P_LSS_ELK_DisEge2Line P_LSS_ELK_LaneEgeScene_Compensate P_LSS_ELK_SwitchActive_LineEgeScene /end REF_CHARACTERISTIC
/end GROUP
/begin GROUP autosar_swc_las_autosar_swc_las_Step_sys_las_ELKState_Machine_ELK_Scene_RoadEge_LeftRoadEgeInterJudge_Subsystem1_Compare_To_Constant1 "autosar_swc_las/autosar_swc_las_Step_sys/las/ELKState_Machine/ELK_Scene/RoadEge/LeftRoadEgeInterJudge/Subsystem1/Compare\nTo Constant1" /begin REF_MEASUREMENT LAS_SCM_LeftLaneNear_b /end REF_MEASUREMENT /end GROUP
/begin GROUP autosar_swc_las_autosar_swc_las_Step_sys_las_ELKState_Machine_ELK_Scene_RoadEge_LeftRoadEgeInterJudge_Subsystem1_Subsystem8 "autosar_swc_las/autosar_swc_las_Step_sys/las/ELKState_Machine/ELK_Scene/RoadEge/LeftRoadEgeInterJudge/Subsystem1/Subsystem8" /begin REF_MEASUREMENT autosar_swc_las_rtARID_DEF.UnitDelay_DSTATE_o3 /end REF_MEASUREMENT /end GROUP
/begin GROUP autosar_swc_las_autosar_swc_las_Step_sys_las_ELKState_Machine_ELK_Scene_RoadEge_ObsAffirm "autosar_swc_las/autosar_swc_las_Step_sys/las/ELKState_Machine/ELK_Scene/RoadEge/ObsAffirm"
 /begin SUB_GROUP autosar_swc_las_autosar_swc_las_Step_sys_las_ELKState_Machine_ELK_Scene_RoadEge_ObsAffirm_Compare_To_Constant212 autosar_swc_las_autosar_swc_las_Step_sys_las_ELKState_Machine_ELK_Scene_RoadEge_ObsAffirm_Subsystem9 /end SUB_GROUP
/end GROUP
/begin GROUP autosar_swc_las_autosar_swc_las_Step_sys_las_ELKState_Machine_ELK_Scene_RoadEge_ObsAffirm1 "autosar_swc_las/autosar_swc_las_Step_sys/las/ELKState_Machine/ELK_Scene/RoadEge/ObsAffirm1"
 /begin SUB_GROUP autosar_swc_las_autosar_swc_las_Step_sys_las_ELKState_Machine_ELK_Scene_RoadEge_ObsAffirm1_Compare_To_Constant212 autosar_swc_las_autosar_swc_las_Step_sys_las_ELKState_Machine_ELK_Scene_RoadEge_ObsAffirm1_Subsystem9 /end SUB_GROUP
/end GROUP
/begin GROUP autosar_swc_las_autosar_swc_las_Step_sys_las_ELKState_Machine_ELK_Scene_RoadEge_ObsAffirm1_Compare_To_Constant212 "autosar_swc_las/autosar_swc_las_Step_sys/las/ELKState_Machine/ELK_Scene/RoadEge/ObsAffirm1/Compare\nTo Constant212" /begin REF_CHARACTERISTIC P_LSS_ELK_ObsFlagTime /end REF_CHARACTERISTIC /end GROUP
/begin GROUP autosar_swc_las_autosar_swc_las_Step_sys_las_ELKState_Machine_ELK_Scene_RoadEge_ObsAffirm1_Subsystem9 "autosar_swc_las/autosar_swc_las_Step_sys/las/ELKState_Machine/ELK_Scene/RoadEge/ObsAffirm1/Subsystem9" /begin REF_MEASUREMENT autosar_swc_las_rtARID_DEF.UnitDelay_DSTATE_ot /end REF_MEASUREMENT /end GROUP
/begin GROUP autosar_swc_las_autosar_swc_las_Step_sys_las_ELKState_Machine_ELK_Scene_RoadEge_ObsAffirm_Compare_To_Constant212 "autosar_swc_las/autosar_swc_las_Step_sys/las/ELKState_Machine/ELK_Scene/RoadEge/ObsAffirm/Compare\nTo Constant212" /begin REF_CHARACTERISTIC P_LSS_ELK_ObsFlagTime /end REF_CHARACTERISTIC /end GROUP
/begin GROUP autosar_swc_las_autosar_swc_las_Step_sys_las_ELKState_Machine_ELK_Scene_RoadEge_ObsAffirm_Subsystem9 "autosar_swc_las/autosar_swc_las_Step_sys/las/ELKState_Machine/ELK_Scene/RoadEge/ObsAffirm/Subsystem9" /begin REF_MEASUREMENT autosar_swc_las_rtARID_DEF.UnitDelay_DSTATE_mi /end REF_MEASUREMENT /end GROUP
/begin GROUP autosar_swc_las_autosar_swc_las_Step_sys_las_ELKState_Machine_ELK_Scene_RoadEge_RightRoadEgeInterJudge "autosar_swc_las/autosar_swc_las_Step_sys/las/ELKState_Machine/ELK_Scene/RoadEge/RightRoadEgeInterJudge"
 /begin SUB_GROUP autosar_swc_las_autosar_swc_las_Step_sys_las_ELKState_Machine_ELK_Scene_RoadEge_RightRoadEgeInterJudge_Subsystem autosar_swc_las_autosar_swc_las_Step_sys_las_ELKState_Machine_ELK_Scene_RoadEge_RightRoadEgeInterJudge_Subsystem1 /end SUB_GROUP
 /begin REF_CHARACTERISTIC P_LSS_ELK_RoadEgeInterSw P_LSS_ELK_State_Param_A0Offset P_LSS_ELK_State_Param_A1leOffset /end REF_CHARACTERISTIC
 /begin REF_MEASUREMENT LAS_ELK_FiRightRoadEgeInter_b LAS_ELK_RightEgeInventionZone LAS_ELK_RightRoadEgeInter_b LAS_FREgeDy LAS_Reserve6 LAS_SCM_RightEdgLineNear_b LAS_SCM_RightLaneNear_b autosar_swc_las_rtARID_DEF.UnitDelay_DSTATE_hb /end REF_MEASUREMENT
/end GROUP
/begin GROUP autosar_swc_las_autosar_swc_las_Step_sys_las_ELKState_Machine_ELK_Scene_RoadEge_RightRoadEgeInterJudge_Subsystem "autosar_swc_las/autosar_swc_las_Step_sys/las/ELKState_Machine/ELK_Scene/RoadEge/RightRoadEgeInterJudge/Subsystem"
 /begin REF_CHARACTERISTIC P_LSS_ELK_FR2RightEgeDisOffset_m P_LSS_ELK_RightEgeDisOffset_TableY P_LSS_ELK_RoadEgeOffsetSw P_LSS_ELK_StandLaneWid P_LSS_ELK_VehSpdRoadEge_TableX /end REF_CHARACTERISTIC
 /begin REF_MEASUREMENT LAS_ELK_RightEgeInventionZone /end REF_MEASUREMENT
/end GROUP
/begin GROUP autosar_swc_las_autosar_swc_las_Step_sys_las_ELKState_Machine_ELK_Scene_RoadEge_RightRoadEgeInterJudge_Subsystem1 "autosar_swc_las/autosar_swc_las_Step_sys/las/ELKState_Machine/ELK_Scene/RoadEge/RightRoadEgeInterJudge/Subsystem1"
 /begin SUB_GROUP autosar_swc_las_autosar_swc_las_Step_sys_las_ELKState_Machine_ELK_Scene_RoadEge_RightRoadEgeInterJudge_Subsystem1_Compare_To_Constant2 autosar_swc_las_autosar_swc_las_Step_sys_las_ELKState_Machine_ELK_Scene_RoadEge_RightRoadEgeInterJudge_Subsystem1_Subsystem8 /end SUB_GROUP
 /begin REF_CHARACTERISTIC P_LSS_ELK_DisEge2Line P_LSS_ELK_LaneEgeScene_Compensate P_LSS_ELK_SwitchActive_LineEgeScene /end REF_CHARACTERISTIC
/end GROUP
/begin GROUP autosar_swc_las_autosar_swc_las_Step_sys_las_ELKState_Machine_ELK_Scene_RoadEge_RightRoadEgeInterJudge_Subsystem1_Compare_To_Constant2 "autosar_swc_las/autosar_swc_las_Step_sys/las/ELKState_Machine/ELK_Scene/RoadEge/RightRoadEgeInterJudge/Subsystem1/Compare\nTo Constant2" /begin REF_MEASUREMENT LAS_SCM_RightLaneNear_b /end REF_MEASUREMENT /end GROUP
/begin GROUP autosar_swc_las_autosar_swc_las_Step_sys_las_ELKState_Machine_ELK_Scene_RoadEge_RightRoadEgeInterJudge_Subsystem1_Subsystem8 "autosar_swc_las/autosar_swc_las_Step_sys/las/ELKState_Machine/ELK_Scene/RoadEge/RightRoadEgeInterJudge/Subsystem1/Subsystem8" /begin REF_MEASUREMENT autosar_swc_las_rtARID_DEF.UnitDelay_DSTATE_pr /end REF_MEASUREMENT /end GROUP
/begin GROUP autosar_swc_las_autosar_swc_las_Step_sys_las_ELKState_Machine_ELK_Scene_Subsystem "autosar_swc_las/autosar_swc_las_Step_sys/las/ELKState_Machine/ELK_Scene/Subsystem"
 /begin REF_CHARACTERISTIC P_LSS_ELK_OnComingObsDetectSw P_LSS_ELK_OnComingObsDetectSwDefaultVal /end REF_CHARACTERISTIC
 /begin REF_MEASUREMENT LAS_ELK_LeftOnComingObsFlag LAS_ELK_RightOnComingObsFlag /end REF_MEASUREMENT
/end GROUP
/begin GROUP autosar_swc_las_autosar_swc_las_Step_sys_las_ELKState_Machine_ELK_Scene_Subsystem1 "autosar_swc_las/autosar_swc_las_Step_sys/las/ELKState_Machine/ELK_Scene/Subsystem1"
 /begin SUB_GROUP autosar_swc_las_autosar_swc_las_Step_sys_las_ELKState_Machine_ELK_Scene_Subsystem1_Compare_To_Constant1 autosar_swc_las_autosar_swc_las_Step_sys_las_ELKState_Machine_ELK_Scene_Subsystem1_Compare_To_Constant10 autosar_swc_las_autosar_swc_las_Step_sys_las_ELKState_Machine_ELK_Scene_Subsystem1_Compare_To_Constant11 autosar_swc_las_autosar_swc_las_Step_sys_las_ELKState_Machine_ELK_Scene_Subsystem1_Compare_To_Constant2 autosar_swc_las_autosar_swc_las_Step_sys_las_ELKState_Machine_ELK_Scene_Subsystem1_Compare_To_Constant9 autosar_swc_las_autosar_swc_las_Step_sys_las_ELKState_Machine_ELK_Scene_Subsystem1_Subsystem1 autosar_swc_las_autosar_swc_las_Step_sys_las_ELKState_Machine_ELK_Scene_Subsystem1_Subsystem2 autosar_swc_las_autosar_swc_las_Step_sys_las_ELKState_Machine_ELK_Scene_Subsystem1_Subsystem4 autosar_swc_las_autosar_swc_las_Step_sys_las_ELKState_Machine_ELK_Scene_Subsystem1_Subsystem7 /end SUB_GROUP
 /begin REF_MEASUREMENT LAS_ELK_Lane_valid LAS_ELK_Lwidth_Valid LAS_ELK_RoadWidth LAS_SCM_VehNearLOrRLine_st /end REF_MEASUREMENT
/end GROUP
/begin GROUP autosar_swc_las_autosar_swc_las_Step_sys_las_ELKState_Machine_ELK_Scene_Subsystem1_Compare_To_Constant1 "autosar_swc_las/autosar_swc_las_Step_sys/las/ELKState_Machine/ELK_Scene/Subsystem1/Compare\nTo Constant1" /begin REF_CHARACTERISTIC P_LSS_ELK_MaxLaneWidthIn /end REF_CHARACTERISTIC /end GROUP
/begin GROUP autosar_swc_las_autosar_swc_las_Step_sys_las_ELKState_Machine_ELK_Scene_Subsystem1_Compare_To_Constant10 "autosar_swc_las/autosar_swc_las_Step_sys/las/ELKState_Machine/ELK_Scene/Subsystem1/Compare\nTo Constant10" /begin REF_CHARACTERISTIC P_LSS_ELK_MaxLaneWidthOut /end REF_CHARACTERISTIC /end GROUP
/begin GROUP autosar_swc_las_autosar_swc_las_Step_sys_las_ELKState_Machine_ELK_Scene_Subsystem1_Compare_To_Constant11 "autosar_swc_las/autosar_swc_las_Step_sys/las/ELKState_Machine/ELK_Scene/Subsystem1/Compare\nTo Constant11" /begin REF_CHARACTERISTIC P_LSS_ELK_MinLaneWidthOut /end REF_CHARACTERISTIC /end GROUP
/begin GROUP autosar_swc_las_autosar_swc_las_Step_sys_las_ELKState_Machine_ELK_Scene_Subsystem1_Compare_To_Constant2 "autosar_swc_las/autosar_swc_las_Step_sys/las/ELKState_Machine/ELK_Scene/Subsystem1/Compare\nTo Constant2" /begin REF_CHARACTERISTIC P_LSS_ELK_MinLaneWidthIn /end REF_CHARACTERISTIC /end GROUP
/begin GROUP autosar_swc_las_autosar_swc_las_Step_sys_las_ELKState_Machine_ELK_Scene_Subsystem1_Compare_To_Constant9 "autosar_swc_las/autosar_swc_las_Step_sys/las/ELKState_Machine/ELK_Scene/Subsystem1/Compare\nTo Constant9" /begin REF_CHARACTERISTIC P_LSS_ELK_LaneWidthInTime /end REF_CHARACTERISTIC /begin REF_MEASUREMENT LAS_ELK_Lwidth_Valid /end REF_MEASUREMENT /end GROUP
/begin GROUP autosar_swc_las_autosar_swc_las_Step_sys_las_ELKState_Machine_ELK_Scene_Subsystem1_Subsystem1 "autosar_swc_las/autosar_swc_las_Step_sys/las/ELKState_Machine/ELK_Scene/Subsystem1/Subsystem1" /begin REF_MEASUREMENT autosar_swc_las_rtARID_DEF.UnitDelay_DSTATE_kh /end REF_MEASUREMENT /end GROUP
/begin GROUP autosar_swc_las_autosar_swc_las_Step_sys_las_ELKState_Machine_ELK_Scene_Subsystem1_Subsystem2 "autosar_swc_las/autosar_swc_las_Step_sys/las/ELKState_Machine/ELK_Scene/Subsystem1/Subsystem2" /begin REF_MEASUREMENT autosar_swc_las_rtARID_DEF.UnitDelay_DSTATE_gh /end REF_MEASUREMENT /end GROUP
/begin GROUP autosar_swc_las_autosar_swc_las_Step_sys_las_ELKState_Machine_ELK_Scene_Subsystem1_Subsystem4 "autosar_swc_las/autosar_swc_las_Step_sys/las/ELKState_Machine/ELK_Scene/Subsystem1/Subsystem4" /begin REF_MEASUREMENT autosar_swc_las_rtARID_DEF.UnitDelay_DSTATE_mu /end REF_MEASUREMENT /end GROUP
/begin GROUP autosar_swc_las_autosar_swc_las_Step_sys_las_ELKState_Machine_ELK_Scene_Subsystem1_Subsystem7 "autosar_swc_las/autosar_swc_las_Step_sys/las/ELKState_Machine/ELK_Scene/Subsystem1/Subsystem7" /begin REF_MEASUREMENT autosar_swc_las_rtARID_DEF.UnitDelay_DSTATE_or /end REF_MEASUREMENT /end GROUP
/begin GROUP autosar_swc_las_autosar_swc_las_Step_sys_las_ELKState_Machine_ELK_Scene_Subsystem2 "autosar_swc_las/autosar_swc_las_Step_sys/las/ELKState_Machine/ELK_Scene/Subsystem2" /begin REF_MEASUREMENT autosar_swc_las_rtARID_DEF.UnitDelay_DSTATE_op /end REF_MEASUREMENT /end GROUP
/begin GROUP autosar_swc_las_autosar_swc_las_Step_sys_las_ELKState_Machine_ELK_Scene_Subsystem3 "autosar_swc_las/autosar_swc_las_Step_sys/las/ELKState_Machine/ELK_Scene/Subsystem3" /begin REF_MEASUREMENT autosar_swc_las_rtARID_DEF.UnitDelay_DSTATE_jk /end REF_MEASUREMENT /end GROUP
/begin GROUP autosar_swc_las_autosar_swc_las_Step_sys_las_ELKState_Machine_ELK_Scene_Subsystem5 "autosar_swc_las/autosar_swc_las_Step_sys/las/ELKState_Machine/ELK_Scene/Subsystem5"
 /begin REF_CHARACTERISTIC P_LSS_ELK_LeftMinLatDis_m P_LSS_ELK_LeftObjMinLatDis_m P_LSS_ELK_MotorOrBicycleWidth_m P_LSS_ELK_ObsAgeTime P_LSS_ELK_ObsInLeftWidLaneProb_ratio P_LSS_ELK_ObsInRightWidLaneProb_ratio P_LSS_ELK_RightMinLatDis_m P_LSS_ELK_RightObjMinLatDis_m P_LSS_ELK_RoadWidthThre_m /end REF_CHARACTERISTIC
 /begin REF_MEASUREMENT LAS_ELK_LeftOnComingObsFlag LAS_ELK_RightOnComingObsFlag /end REF_MEASUREMENT
/end GROUP
/begin GROUP autosar_swc_las_autosar_swc_las_Step_sys_las_ELKState_Machine_StateMachine1 "autosar_swc_las/autosar_swc_las_Step_sys/las/ELKState_Machine/StateMachine1"
 /begin SUB_GROUP autosar_swc_las_autosar_swc_las_Step_sys_las_ELKState_Machine_StateMachine1_Subsystem9 /end SUB_GROUP
 /begin REF_CHARACTERISTIC P_LSS_ELK_ShildDashLineOnlyWarn /end REF_CHARACTERISTIC
 /begin REF_MEASUREMENT LAS_ELK_FinalReady2Active LAS_ELK_LeftEnd LAS_ELK_LeftWarn LAS_ELK_Leftout LAS_ELK_RightInterventionEnd LAS_ELK_RightWarn LAS_ELK_Rightout LAS_ELK_Warning LAS_ELK_incount LAS_ELK_wcount autosar_swc_las_rtARID_DEF.L autosar_swc_las_rtARID_DEF.R autosar_swc_las_rtARID_DEF.UnitDelay1_DSTATE autosar_swc_las_rtARID_DEF.UnitDelay6_DSTATE autosar_swc_las_rtARID_DEF.actcount_c autosar_swc_las_rtARID_DEF.incount_j autosar_swc_las_rtARID_DEF.is_Left_Active autosar_swc_las_rtARID_DEF.is_Line_Active autosar_swc_las_rtARID_DEF.is_MAINST_ON_j autosar_swc_las_rtARID_DEF.is_Right_Active autosar_swc_las_rtARID_DEF.is_SUBST_ACTIVE_h autosar_swc_las_rtARID_DEF.is_active_c66_autosar_swc_las autosar_swc_las_rtARID_DEF.is_c66_autosar_swc_las autosar_swc_las_rtARID_DEF.out_count_m autosar_swc_las_rtARID_DEF.warn autosar_swc_las_rtARID_DEF.wcount_m /end REF_MEASUREMENT
/end GROUP
/begin GROUP autosar_swc_las_autosar_swc_las_Step_sys_las_ELKState_Machine_StateMachine1_Subsystem9 "autosar_swc_las/autosar_swc_las_Step_sys/las/ELKState_Machine/StateMachine1/Subsystem9" /begin REF_MEASUREMENT autosar_swc_las_rtARID_DEF.UnitDelay_DSTATE_ku /end REF_MEASUREMENT /end GROUP
/begin GROUP autosar_swc_las_autosar_swc_las_Step_sys_las_LDW "autosar_swc_las/autosar_swc_las_Step_sys/las/LDW"
 /begin SUB_GROUP autosar_swc_las_autosar_swc_las_Step_sys_las_LDW_Counter_Limited autosar_swc_las_autosar_swc_las_Step_sys_las_LDW_LDWSignal_calculate autosar_swc_las_autosar_swc_las_Step_sys_las_LDW_LDW_Condition autosar_swc_las_autosar_swc_las_Step_sys_las_LDW_LDW_StateMachine autosar_swc_las_autosar_swc_las_Step_sys_las_LDW_Subsystem3 /end SUB_GROUP
 /begin REF_MEASUREMENT LAS_LDWSts LAS_LDW_Error LAS_LDW_Number LAS_LDW_VERSION /end REF_MEASUREMENT
/end GROUP
/begin GROUP autosar_swc_las_autosar_swc_las_Step_sys_las_LDW_Counter_Limited "autosar_swc_las/autosar_swc_las_Step_sys/las/LDW/Counter\nLimited"
 /begin SUB_GROUP autosar_swc_las_autosar_swc_las_Step_sys_las_LDW_Counter_Limited_Increment_Real_World /end SUB_GROUP
 /begin REF_MEASUREMENT LAS_LDW_Counter autosar_swc_las_rtARID_DEF.Output_DSTATE_i /end REF_MEASUREMENT
/end GROUP
/begin GROUP autosar_swc_las_autosar_swc_las_Step_sys_las_LDW_Counter_Limited_Increment_Real_World "autosar_swc_las/autosar_swc_las_Step_sys/las/LDW/Counter\nLimited/Increment\nReal World" /begin REF_MEASUREMENT LAS_LDW_Counter /end REF_MEASUREMENT /end GROUP
/begin GROUP autosar_swc_las_autosar_swc_las_Step_sys_las_LDW_LDWSignal_calculate "autosar_swc_las/autosar_swc_las_Step_sys/las/LDW/LDWSignal_calculate"
 /begin SUB_GROUP autosar_swc_las_autosar_swc_las_Step_sys_las_LDW_LDWSignal_calculate_Compare_To_Constant11 autosar_swc_las_autosar_swc_las_Step_sys_las_LDW_LDWSignal_calculate_Compare_To_Constant2 autosar_swc_las_autosar_swc_las_Step_sys_las_LDW_LDWSignal_calculate_Subsystem1 autosar_swc_las_autosar_swc_las_Step_sys_las_LDW_LDWSignal_calculate_Subsystem2 autosar_swc_las_autosar_swc_las_Step_sys_las_LDW_LDWSignal_calculate_Subsystem3 autosar_swc_las_autosar_swc_las_Step_sys_las_LDW_LDWSignal_calculate_Subsystem4 autosar_swc_las_autosar_swc_las_Step_sys_las_LDW_LDWSignal_calculate_Subsystem5 /end SUB_GROUP
 /begin REF_CHARACTERISTIC P_LSS_LDW_CurveFactor P_LSS_LDW_LDPStatecanActive P_LSS_LDW_LaneCurveOffset_Switch P_LSS_LDW_Lane_Width_Table_Calibration P_LSS_LDW_Sensitive_Switch P_LSS_LDW_Sensitive_Table_Calibration P_LSS_LDW_SolidLineShildFlag P_LSS_LDW_State_Param_CureLaneWidth P_LSS_LDW_State_Param_CureLaneWidth_offsetfactor P_LSS_LDW_State_Param_LaneCurve P_LSS_LDW_State_Param_LaneCurve_Offset P_LSS_LDW_State_Param_LaneWidth_Offset P_LSS_LDW_State_Param_Sensitive_Offset P_LSS_LDW_State_Param_WarningZoneIn P_LSS_LDW_State_Param_WarningZoneInNow P_LSS_LDW_State_Param_WarningZoneOut P_LSS_LDW_TimePredictedSwitch /end REF_CHARACTERISTIC
 /begin REF_MEASUREMENT LAS_FLWhelDy LAS_FRWhelDy LAS_LDW_LeftShiledSolidWarnFlag LAS_LDW_Leftwarnflag LAS_LDW_RightShiledSolidWarnFlag LAS_LDW_Rightwarnflag LAS_preFLWhelDy LAS_preFRWhelDy autosar_swc_las_rtARID_DEF.UnitDelay1_DSTATE_j autosar_swc_las_rtARID_DEF.UnitDelay2_DSTATE_k autosar_swc_las_rtARID_DEF.UnitDelay3_DSTATE_m autosar_swc_las_rtARID_DEF.UnitDelay8_DSTATE_j /end REF_MEASUREMENT
/end GROUP
/begin GROUP autosar_swc_las_autosar_swc_las_Step_sys_las_LDW_LDWSignal_calculate_Compare_To_Constant11 "autosar_swc_las/autosar_swc_las_Step_sys/las/LDW/LDWSignal_calculate/Compare\nTo Constant11" /begin REF_CHARACTERISTIC P_LSS_LDW_RoadWidthOut /end REF_CHARACTERISTIC /end GROUP
/begin GROUP autosar_swc_las_autosar_swc_las_Step_sys_las_LDW_LDWSignal_calculate_Compare_To_Constant2 "autosar_swc_las/autosar_swc_las_Step_sys/las/LDW/LDWSignal_calculate/Compare\nTo Constant2" /begin REF_CHARACTERISTIC P_LSS_LDW_RoadWidthIn /end REF_CHARACTERISTIC /end GROUP
/begin GROUP autosar_swc_las_autosar_swc_las_Step_sys_las_LDW_LDWSignal_calculate_Subsystem1 "autosar_swc_las/autosar_swc_las_Step_sys/las/LDW/LDWSignal_calculate/Subsystem1" /begin REF_MEASUREMENT autosar_swc_las_rtARID_DEF.UnitDelay_DSTATE_bi /end REF_MEASUREMENT /end GROUP
/begin GROUP autosar_swc_las_autosar_swc_las_Step_sys_las_LDW_LDWSignal_calculate_Subsystem2 "autosar_swc_las/autosar_swc_las_Step_sys/las/LDW/LDWSignal_calculate/Subsystem2" /begin REF_MEASUREMENT autosar_swc_las_rtARID_DEF.UnitDelay_DSTATE_iy /end REF_MEASUREMENT /end GROUP
/begin GROUP autosar_swc_las_autosar_swc_las_Step_sys_las_LDW_LDWSignal_calculate_Subsystem3 "autosar_swc_las/autosar_swc_las_Step_sys/las/LDW/LDWSignal_calculate/Subsystem3" /begin REF_MEASUREMENT autosar_swc_las_rtARID_DEF.UnitDelay_DSTATE_otd /end REF_MEASUREMENT /end GROUP
/begin GROUP autosar_swc_las_autosar_swc_las_Step_sys_las_LDW_LDWSignal_calculate_Subsystem4 "autosar_swc_las/autosar_swc_las_Step_sys/las/LDW/LDWSignal_calculate/Subsystem4" /begin REF_MEASUREMENT autosar_swc_las_rtARID_DEF.UnitDelay_DSTATE_kv /end REF_MEASUREMENT /end GROUP
/begin GROUP autosar_swc_las_autosar_swc_las_Step_sys_las_LDW_LDWSignal_calculate_Subsystem5 "autosar_swc_las/autosar_swc_las_Step_sys/las/LDW/LDWSignal_calculate/Subsystem5" /begin REF_MEASUREMENT autosar_swc_las_rtARID_DEF.UnitDelay_DSTATE_nb /end REF_MEASUREMENT /end GROUP
/begin GROUP autosar_swc_las_autosar_swc_las_Step_sys_las_LDW_LDW_Condition "autosar_swc_las/autosar_swc_las_Step_sys/las/LDW/LDW_Condition"
 /begin SUB_GROUP autosar_swc_las_autosar_swc_las_Step_sys_las_LDW_LDW_Condition_Compare_To_Constant14 autosar_swc_las_autosar_swc_las_Step_sys_las_LDW_LDW_Condition_Compare_To_Constant20 autosar_swc_las_autosar_swc_las_Step_sys_las_LDW_LDW_Condition_Compare_To_Constant22 autosar_swc_las_autosar_swc_las_Step_sys_las_LDW_LDW_Condition_Compare_To_Constant23 autosar_swc_las_autosar_swc_las_Step_sys_las_LDW_LDW_Condition_Compare_To_Constant31 autosar_swc_las_autosar_swc_las_Step_sys_las_LDW_LDW_Condition_Compare_To_Constant35 autosar_swc_las_autosar_swc_las_Step_sys_las_LDW_LDW_Condition_Compare_To_Constant37 autosar_swc_las_autosar_swc_las_Step_sys_las_LDW_LDW_Condition_Compare_To_Constant39 autosar_swc_las_autosar_swc_las_Step_sys_las_LDW_LDW_Condition_Compare_To_Constant4 autosar_swc_las_autosar_swc_las_Step_sys_las_LDW_LDW_Condition_Compare_To_Constant40 autosar_swc_las_autosar_swc_las_Step_sys_las_LDW_LDW_Condition_Compare_To_Constant63 autosar_swc_las_autosar_swc_las_Step_sys_las_LDW_LDW_Condition_Compare_To_Constant68 autosar_swc_las_autosar_swc_las_Step_sys_las_LDW_LDW_Condition_Compare_To_Constant70 autosar_swc_las_autosar_swc_las_Step_sys_las_LDW_LDW_Condition_Compare_To_Constant71 autosar_swc_las_autosar_swc_las_Step_sys_las_LDW_LDW_Condition_Compare_To_Constant72 autosar_swc_las_autosar_swc_las_Step_sys_las_LDW_LDW_Condition_Compare_To_Constant73 autosar_swc_las_autosar_swc_las_Step_sys_las_LDW_LDW_Condition_Compare_To_Constant74 autosar_swc_las_autosar_swc_las_Step_sys_las_LDW_LDW_Condition_Compare_To_Constant80 autosar_swc_las_autosar_swc_las_Step_sys_las_LDW_LDW_Condition_Compare_To_Constant83 autosar_swc_las_autosar_swc_las_Step_sys_las_LDW_LDW_Condition_Compare_To_Constant84 autosar_swc_las_autosar_swc_las_Step_sys_las_LDW_LDW_Condition_Compare_To_Constant85 autosar_swc_las_autosar_swc_las_Step_sys_las_LDW_LDW_Condition_Compare_To_Constant86 autosar_swc_las_autosar_swc_las_Step_sys_las_LDW_LDW_Condition_Compare_To_Constant87 autosar_swc_las_autosar_swc_las_Step_sys_las_LDW_LDW_Condition_Compare_To_Constant91 autosar_swc_las_autosar_swc_las_Step_sys_las_LDW_LDW_Condition_Compare_To_Constant92 autosar_swc_las_autosar_swc_las_Step_sys_las_LDW_LDW_Condition_Compare_To_Constant99 autosar_swc_las_autosar_swc_las_Step_sys_las_LDW_LDW_Condition_SASDegOverride1 autosar_swc_las_autosar_swc_las_Step_sys_las_LDW_LDW_Condition_Subsystem autosar_swc_las_autosar_swc_las_Step_sys_las_LDW_LDW_Condition_Subsystem10 autosar_swc_las_autosar_swc_las_Step_sys_las_LDW_LDW_Condition_Subsystem11 autosar_swc_las_autosar_swc_las_Step_sys_las_LDW_LDW_Condition_Subsystem12 autosar_swc_las_autosar_swc_las_Step_sys_las_LDW_LDW_Condition_Subsystem14 autosar_swc_las_autosar_swc_las_Step_sys_las_LDW_LDW_Condition_Subsystem2 autosar_swc_las_autosar_swc_las_Step_sys_las_LDW_LDW_Condition_Subsystem3 autosar_swc_las_autosar_swc_las_Step_sys_las_LDW_LDW_Condition_Subsystem4 autosar_swc_las_autosar_swc_las_Step_sys_las_LDW_LDW_Condition_Subsystem5 autosar_swc_las_autosar_swc_las_Step_sys_las_LDW_LDW_Condition_Subsystem6 autosar_swc_las_autosar_swc_las_Step_sys_las_LDW_LDW_Condition_Subsystem9 /end SUB_GROUP
 /begin REF_CHARACTERISTIC P_LSS_LDW_State_Absesp_enable P_LSS_LDW_State_Accpedalrate_enable P_LSS_LDW_State_Breakpressure_enable P_LSS_LDW_State_HazardLmpSwtSts_enable P_LSS_LDW_State_Headingangle_enable P_LSS_LDW_State_Inhibit_enable P_LSS_LDW_State_LaneChange_enable P_LSS_LDW_State_Lane_enable P_LSS_LDW_State_Lanecurve_enable P_LSS_LDW_State_SteerWheelSpd_enable P_LSS_LDW_State_Vehspeed_enable P_LSS_LDW_State_Yawsup_enable P_LSS_LDW_SteerSpd2IDEL_SteerSpdFactor P_LSS_LDW_SteerSpd2IEDL_VehicleSpdFactor P_LSS_LDW_SteerSpd2Ready_SteerSpdFactor P_LSS_LDW_SteerSpd2Ready_VehicleSpdFactor /end REF_CHARACTERISTIC
 /begin REF_MEASUREMENT LAS_FLWhelDy LAS_FRWhelDy LAS_LDW_Idle2Ready LAS_LDW_Other2Idle LAS_SCM_HeadingAngIn_b LAS_SCM_HeadingAngOut_b LAS_SCM_LeftChange_b LAS_SCM_RightChange_b autosar_swc_las_rtARID_DEF.Delay_DSTATE_c /end REF_MEASUREMENT
/end GROUP
/begin GROUP autosar_swc_las_autosar_swc_las_Step_sys_las_LDW_LDW_Condition_Compare_To_Constant14 "autosar_swc_las/autosar_swc_las_Step_sys/las/LDW/LDW_Condition/Compare\nTo Constant14" /begin REF_CHARACTERISTIC P_LSS_LDW_AccRateInTime /end REF_CHARACTERISTIC /end GROUP
/begin GROUP autosar_swc_las_autosar_swc_las_Step_sys_las_LDW_LDW_Condition_Compare_To_Constant20 "autosar_swc_las/autosar_swc_las_Step_sys/las/LDW/LDW_Condition/Compare\nTo Constant20" /begin REF_CHARACTERISTIC P_LSS_LDW_BrakePressIn /end REF_CHARACTERISTIC /end GROUP
/begin GROUP autosar_swc_las_autosar_swc_las_Step_sys_las_LDW_LDW_Condition_Compare_To_Constant22 "autosar_swc_las/autosar_swc_las_Step_sys/las/LDW/LDW_Condition/Compare\nTo Constant22" /begin REF_CHARACTERISTIC P_LSS_LDW_YawRateIn /end REF_CHARACTERISTIC /end GROUP
/begin GROUP autosar_swc_las_autosar_swc_las_Step_sys_las_LDW_LDW_Condition_Compare_To_Constant23 "autosar_swc_las/autosar_swc_las_Step_sys/las/LDW/LDW_Condition/Compare\nTo Constant23" /begin REF_CHARACTERISTIC P_LSS_LDW_YawRateInTime /end REF_CHARACTERISTIC /end GROUP
/begin GROUP autosar_swc_las_autosar_swc_las_Step_sys_las_LDW_LDW_Condition_Compare_To_Constant31 "autosar_swc_las/autosar_swc_las_Step_sys/las/LDW/LDW_Condition/Compare\nTo Constant31" /begin REF_CHARACTERISTIC P_LSS_LDW_SteerWheelSpdIn /end REF_CHARACTERISTIC /end GROUP
/begin GROUP autosar_swc_las_autosar_swc_las_Step_sys_las_LDW_LDW_Condition_Compare_To_Constant35 "autosar_swc_las/autosar_swc_las_Step_sys/las/LDW/LDW_Condition/Compare\nTo Constant35" /begin REF_CHARACTERISTIC P_LSS_LDW_State_MinVehspeedInValue /end REF_CHARACTERISTIC /end GROUP
/begin GROUP autosar_swc_las_autosar_swc_las_Step_sys_las_LDW_LDW_Condition_Compare_To_Constant37 "autosar_swc_las/autosar_swc_las_Step_sys/las/LDW/LDW_Condition/Compare\nTo Constant37" /begin REF_CHARACTERISTIC P_LSS_LDW_State_MaxVehspeedInValue /end REF_CHARACTERISTIC /end GROUP
/begin GROUP autosar_swc_las_autosar_swc_las_Step_sys_las_LDW_LDW_Condition_Compare_To_Constant39 "autosar_swc_las/autosar_swc_las_Step_sys/las/LDW/LDW_Condition/Compare\nTo Constant39" /begin REF_CHARACTERISTIC P_LSS_LDW_State_MinVehspeedOutValue /end REF_CHARACTERISTIC /end GROUP
/begin GROUP autosar_swc_las_autosar_swc_las_Step_sys_las_LDW_LDW_Condition_Compare_To_Constant4 "autosar_swc_las/autosar_swc_las_Step_sys/las/LDW/LDW_Condition/Compare\nTo Constant4" /begin REF_CHARACTERISTIC P_LSS_LDW_AccRateOutTime /end REF_CHARACTERISTIC /end GROUP
/begin GROUP autosar_swc_las_autosar_swc_las_Step_sys_las_LDW_LDW_Condition_Compare_To_Constant40 "autosar_swc_las/autosar_swc_las_Step_sys/las/LDW/LDW_Condition/Compare\nTo Constant40" /begin REF_CHARACTERISTIC P_LSS_LDW_State_MaxVehspeedOutValue /end REF_CHARACTERISTIC /end GROUP
/begin GROUP autosar_swc_las_autosar_swc_las_Step_sys_las_LDW_LDW_Condition_Compare_To_Constant63 "autosar_swc_las/autosar_swc_las_Step_sys/las/LDW/LDW_Condition/Compare\nTo Constant63" /begin REF_CHARACTERISTIC P_LSS_LDW_LaneCurveIn /end REF_CHARACTERISTIC /end GROUP
/begin GROUP autosar_swc_las_autosar_swc_las_Step_sys_las_LDW_LDW_Condition_Compare_To_Constant68 "autosar_swc_las/autosar_swc_las_Step_sys/las/LDW/LDW_Condition/Compare\nTo Constant68" /begin REF_CHARACTERISTIC P_LSS_LDW_State_LanecurveInTime /end REF_CHARACTERISTIC /end GROUP
/begin GROUP autosar_swc_las_autosar_swc_las_Step_sys_las_LDW_LDW_Condition_Compare_To_Constant70 "autosar_swc_las/autosar_swc_las_Step_sys/las/LDW/LDW_Condition/Compare\nTo Constant70" /begin REF_CHARACTERISTIC P_LSS_LDW_YawRateOut /end REF_CHARACTERISTIC /end GROUP
/begin GROUP autosar_swc_las_autosar_swc_las_Step_sys_las_LDW_LDW_Condition_Compare_To_Constant71 "autosar_swc_las/autosar_swc_las_Step_sys/las/LDW/LDW_Condition/Compare\nTo Constant71" /begin REF_CHARACTERISTIC P_LSS_LDW_State_Vehspeed_enableTime /end REF_CHARACTERISTIC /end GROUP
/begin GROUP autosar_swc_las_autosar_swc_las_Step_sys_las_LDW_LDW_Condition_Compare_To_Constant72 "autosar_swc_las/autosar_swc_las_Step_sys/las/LDW/LDW_Condition/Compare\nTo Constant72" /begin REF_CHARACTERISTIC P_LSS_LDW_State_YawsupOutTime /end REF_CHARACTERISTIC /end GROUP
/begin GROUP autosar_swc_las_autosar_swc_las_Step_sys_las_LDW_LDW_Condition_Compare_To_Constant73 "autosar_swc_las/autosar_swc_las_Step_sys/las/LDW/LDW_Condition/Compare\nTo Constant73" /begin REF_CHARACTERISTIC P_LSS_LDW_SteerWheelSpdOut /end REF_CHARACTERISTIC /end GROUP
/begin GROUP autosar_swc_las_autosar_swc_las_Step_sys_las_LDW_LDW_Condition_Compare_To_Constant74 "autosar_swc_las/autosar_swc_las_Step_sys/las/LDW/LDW_Condition/Compare\nTo Constant74" /begin REF_CHARACTERISTIC P_LSS_LDW_SteerWheelSpdInTime /end REF_CHARACTERISTIC /end GROUP
/begin GROUP autosar_swc_las_autosar_swc_las_Step_sys_las_LDW_LDW_Condition_Compare_To_Constant80 "autosar_swc_las/autosar_swc_las_Step_sys/las/LDW/LDW_Condition/Compare\nTo Constant80" /begin REF_CHARACTERISTIC P_LSS_LDW_BrakePressOut /end REF_CHARACTERISTIC /end GROUP
/begin GROUP autosar_swc_las_autosar_swc_las_Step_sys_las_LDW_LDW_Condition_Compare_To_Constant83 "autosar_swc_las/autosar_swc_las_Step_sys/las/LDW/LDW_Condition/Compare\nTo Constant83" /begin REF_CHARACTERISTIC P_LSS_LDW_AccRateOut /end REF_CHARACTERISTIC /end GROUP
/begin GROUP autosar_swc_las_autosar_swc_las_Step_sys_las_LDW_LDW_Condition_Compare_To_Constant84 "autosar_swc_las/autosar_swc_las_Step_sys/las/LDW/LDW_Condition/Compare\nTo Constant84" /begin REF_CHARACTERISTIC P_LSS_LDW_SteerMinVehspeedOutValue /end REF_CHARACTERISTIC /end GROUP
/begin GROUP autosar_swc_las_autosar_swc_las_Step_sys_las_LDW_LDW_Condition_Compare_To_Constant85 "autosar_swc_las/autosar_swc_las_Step_sys/las/LDW/LDW_Condition/Compare\nTo Constant85" /begin REF_CHARACTERISTIC P_LSS_LDW_LaneCurveOut /end REF_CHARACTERISTIC /end GROUP
/begin GROUP autosar_swc_las_autosar_swc_las_Step_sys_las_LDW_LDW_Condition_Compare_To_Constant86 "autosar_swc_las/autosar_swc_las_Step_sys/las/LDW/LDW_Condition/Compare\nTo Constant86" /begin REF_CHARACTERISTIC P_LSS_LDW_SteerMinVehspeedOutValue /end REF_CHARACTERISTIC /end GROUP
/begin GROUP autosar_swc_las_autosar_swc_las_Step_sys_las_LDW_LDW_Condition_Compare_To_Constant87 "autosar_swc_las/autosar_swc_las_Step_sys/las/LDW/LDW_Condition/Compare\nTo Constant87" /begin REF_CHARACTERISTIC P_LSS_LDW_State_SteerWheelSpdOutTime /end REF_CHARACTERISTIC /end GROUP
/begin GROUP autosar_swc_las_autosar_swc_las_Step_sys_las_LDW_LDW_Condition_Compare_To_Constant91 "autosar_swc_las/autosar_swc_las_Step_sys/las/LDW/LDW_Condition/Compare\nTo Constant91" /begin REF_CHARACTERISTIC P_LSS_LDW_AccRateIn /end REF_CHARACTERISTIC /end GROUP
/begin GROUP autosar_swc_las_autosar_swc_las_Step_sys_las_LDW_LDW_Condition_Compare_To_Constant92 "autosar_swc_las/autosar_swc_las_Step_sys/las/LDW/LDW_Condition/Compare\nTo Constant92" /begin REF_CHARACTERISTIC P_LSS_LDW_BrakePressInTime /end REF_CHARACTERISTIC /end GROUP
/begin GROUP autosar_swc_las_autosar_swc_las_Step_sys_las_LDW_LDW_Condition_Compare_To_Constant99 "autosar_swc_las/autosar_swc_las_Step_sys/las/LDW/LDW_Condition/Compare\nTo Constant99" /begin REF_CHARACTERISTIC P_LSS_LDW_State_HazardLmpSwtStsOutTime /end REF_CHARACTERISTIC /end GROUP
/begin GROUP autosar_swc_las_autosar_swc_las_Step_sys_las_LDW_LDW_Condition_SASDegOverride1 "autosar_swc_las/autosar_swc_las_Step_sys/las/LDW/LDW_Condition/SASDegOverride1"
 /begin SUB_GROUP autosar_swc_las_autosar_swc_las_Step_sys_las_LDW_LDW_Condition_SASDegOverride1_Compare_To_Constant3 autosar_swc_las_autosar_swc_las_Step_sys_las_LDW_LDW_Condition_SASDegOverride1_Subsystem1 autosar_swc_las_autosar_swc_las_Step_sys_las_LDW_LDW_Condition_SASDegOverride1_Subsystem2 autosar_swc_las_autosar_swc_las_Step_sys_las_LDW_LDW_Condition_SASDegOverride1_Subsystem3 autosar_swc_las_autosar_swc_las_Step_sys_las_LDW_LDW_Condition_SASDegOverride1_Subsystem4 autosar_swc_las_autosar_swc_las_Step_sys_las_LDW_LDW_Condition_SASDegOverride1_TrueDurationTime3 /end SUB_GROUP
 /begin REF_CHARACTERISTIC P_LSS_LDP_EPSTqVerifyTimeDiff_s P_LSS_LDP_EPSTqVerifyTimeSame_s P_LSS_LDP_LcEPSTqVerifyTimeSame_s P_LSS_LDP_OverideSPd_kmh P_LSS_LDP_OverrideDiffTrq P_LSS_LDP_OverrideSameTrq P_LSS_LcEPSTqVerifyTimeDiff_s P_LSS_LcOverrideTrqRatio /end REF_CHARACTERISTIC
 /begin REF_MEASUREMENT autosar_swc_las_rtARID_DEF.UnitDelay1_DSTATE_ae autosar_swc_las_rtARID_DEF.UnitDelay2_DSTATE_ba /end REF_MEASUREMENT
/end GROUP
/begin GROUP autosar_swc_las_autosar_swc_las_Step_sys_las_LDW_LDW_Condition_SASDegOverride1_Compare_To_Constant3 "autosar_swc_las/autosar_swc_las_Step_sys/las/LDW/LDW_Condition/SASDegOverride1/Compare\nTo Constant3" /begin REF_CHARACTERISTIC P_LSS_LDPOverrideRecoverTime /end REF_CHARACTERISTIC /end GROUP
/begin GROUP autosar_swc_las_autosar_swc_las_Step_sys_las_LDW_LDW_Condition_SASDegOverride1_Subsystem1 "autosar_swc_las/autosar_swc_las_Step_sys/las/LDW/LDW_Condition/SASDegOverride1/Subsystem1" /begin REF_MEASUREMENT autosar_swc_las_rtARID_DEF.UnitDelay_DSTATE_gv /end REF_MEASUREMENT /end GROUP
/begin GROUP autosar_swc_las_autosar_swc_las_Step_sys_las_LDW_LDW_Condition_SASDegOverride1_Subsystem2 "autosar_swc_las/autosar_swc_las_Step_sys/las/LDW/LDW_Condition/SASDegOverride1/Subsystem2" /begin REF_MEASUREMENT autosar_swc_las_rtARID_DEF.UnitDelay_DSTATE_fse /end REF_MEASUREMENT /end GROUP
/begin GROUP autosar_swc_las_autosar_swc_las_Step_sys_las_LDW_LDW_Condition_SASDegOverride1_Subsystem3 "autosar_swc_las/autosar_swc_las_Step_sys/las/LDW/LDW_Condition/SASDegOverride1/Subsystem3" /begin REF_MEASUREMENT autosar_swc_las_rtARID_DEF.UnitDelay_DSTATE_h1 /end REF_MEASUREMENT /end GROUP
/begin GROUP autosar_swc_las_autosar_swc_las_Step_sys_las_LDW_LDW_Condition_SASDegOverride1_Subsystem4 "autosar_swc_las/autosar_swc_las_Step_sys/las/LDW/LDW_Condition/SASDegOverride1/Subsystem4" /begin REF_MEASUREMENT autosar_swc_las_rtARID_DEF.UnitDelay_DSTATE_bq /end REF_MEASUREMENT /end GROUP
/begin GROUP autosar_swc_las_autosar_swc_las_Step_sys_las_LDW_LDW_StateMachine "autosar_swc_las/autosar_swc_las_Step_sys/las/LDW/LDW_StateMachine"
 /begin REF_MEASUREMENT LAS_LDW_Idle2Ready LAS_LDW_Leftwarnflag LAS_LDW_Other2Idle LAS_LDW_Rightwarnflag /end REF_MEASUREMENT
/end GROUP
/begin GROUP autosar_swc_las_autosar_swc_las_Step_sys_las_LDW_LDW_StateMachine_Subsystem "autosar_swc_las/autosar_swc_las_Step_sys/las/LDW/LDW_StateMachine/Subsystem" /begin REF_MEASUREMENT LAS_FLWhelDy /end REF_MEASUREMENT /end GROUP
/begin GROUP autosar_swc_las_autosar_swc_las_Step_sys_las_LDW_LDW_StateMachine_Subsystem1 "autosar_swc_las/autosar_swc_las_Step_sys/las/LDW/LDW_StateMachine/Subsystem1" /begin REF_MEASUREMENT LAS_FRWhelDy /end REF_MEASUREMENT /end GROUP
/begin GROUP autosar_swc_las_autosar_swc_las_Step_sys_las_LKA_LKA2 "autosar_swc_las/autosar_swc_las_Step_sys/las/LKA/LKA2"
 /begin REF_CHARACTERISTIC P_LSS_ELK_State_Param_LaneCurve P_LSS_ELK_State_Param_LaneCurve_Offset /end REF_CHARACTERISTIC
 /begin REF_MEASUREMENT LAS_FLWhelDy LAS_FRWhelDy /end REF_MEASUREMENT
/end GROUP
/begin GROUP autosar_swc_las_autosar_swc_las_Step_sys_las_LKA_LKA_Condition "autosar_swc_las/autosar_swc_las_Step_sys/las/LKA/LKA_Condition"
 /begin REF_MEASUREMENT LAS_FLWhelDy LAS_FRWhelDy LAS_SCM_LeftChange_b LAS_SCM_RightChange_b /end REF_MEASUREMENT
/end GROUP
/begin GROUP autosar_swc_las_autosar_swc_las_Step_sys_las_LKA_LKA_Condition_SASDegOverride1 "autosar_swc_las/autosar_swc_las_Step_sys/las/LKA/LKA_Condition/SASDegOverride1"
 /begin REF_CHARACTERISTIC P_LSS_LDP_EPSTqVerifyTimeDiff_s P_LSS_LDP_EPSTqVerifyTimeSame_s P_LSS_LDP_LcEPSTqVerifyTimeSame_s P_LSS_LDP_OverideSPd_kmh P_LSS_LDP_OverrideDiffTrq P_LSS_LDP_OverrideSameTrq P_LSS_LcEPSTqVerifyTimeDiff_s P_LSS_LcOverrideTrqRatio /end REF_CHARACTERISTIC
/end GROUP
/begin GROUP autosar_swc_las_autosar_swc_las_Step_sys_las_LKA_LKA_Condition_SASDegOverride1_Compare_To_Constant3 "autosar_swc_las/autosar_swc_las_Step_sys/las/LKA/LKA_Condition/SASDegOverride1/Compare\nTo Constant3" /begin REF_CHARACTERISTIC P_LSS_LDPOverrideRecoverTime /end REF_CHARACTERISTIC /end GROUP
/begin GROUP autosar_swc_las_autosar_swc_las_Step_sys_las_LKA_LKA_StateMachine_Subsystem "autosar_swc_las/autosar_swc_las_Step_sys/las/LKA/LKA_StateMachine/Subsystem" /begin REF_MEASUREMENT LAS_FLWhelDy /end REF_MEASUREMENT /end GROUP
/begin GROUP autosar_swc_las_autosar_swc_las_Step_sys_las_LKA_LKA_StateMachine_Subsystem1 "autosar_swc_las/autosar_swc_las_Step_sys/las/LKA/LKA_StateMachine/Subsystem1" /begin REF_MEASUREMENT LAS_FRWhelDy /end REF_MEASUREMENT /end GROUP
/begin GROUP autosar_swc_las_autosar_swc_las_Step_sys_las_OutPort "autosar_swc_las/autosar_swc_las_Step_sys/las/OutPort" /begin REF_MEASUREMENT LAS_FLWhelDy LAS_FRWhelDy /end REF_MEASUREMENT /end GROUP
/begin GROUP autosar_swc_las_autosar_swc_las_Step_sys_las_SCM1_LaneAndRe_SignalProcess "autosar_swc_las/autosar_swc_las_Step_sys/las/SCM1/LaneAndRe_SignalProcess"
 /begin REF_MEASUREMENT LAS_SCM_LeftEdgLineNear_b LAS_SCM_LeftLaneNear_b LAS_SCM_RightEdgLineNear_b LAS_SCM_RightLaneNear_b LAS_SCM_VehNearLOrRLine_st /end REF_MEASUREMENT
/end GROUP
/begin GROUP autosar_swc_las_autosar_swc_las_Step_sys_las_SCM1_LaneAndRe_SignalProcess_CalNearestLine "autosar_swc_las/autosar_swc_las_Step_sys/las/SCM1/LaneAndRe_SignalProcess/CalNearestLine"
 /begin REF_MEASUREMENT LAS_SCM_LeftEdgLineNear_b LAS_SCM_LeftLaneNear_b LAS_SCM_RightEdgLineNear_b LAS_SCM_RightLaneNear_b /end REF_MEASUREMENT
/end GROUP
/begin GROUP autosar_swc_las_autosar_swc_las_Step_sys_las_SCM1_LaneAndRe_SignalProcess_Cal_LaneHeadingAng "autosar_swc_las/autosar_swc_las_Step_sys/las/SCM1/LaneAndRe_SignalProcess/Cal_LaneHeadingAng"
 /begin REF_MEASUREMENT LAS_SCM_HeadingAngOut_b LAS_SCM_LeftEdgLineNear_b LAS_SCM_LeftLaneNear_b LAS_SCM_RightEdgLineNear_b LAS_SCM_RightLaneNear_b /end REF_MEASUREMENT
/end GROUP
/begin GROUP autosar_swc_las_autosar_swc_las_Step_sys_las_SCM1_LaneAndRe_SignalProcess_Cal_LaneHeadingAng_Compare_To_Constant "autosar_swc_las/autosar_swc_las_Step_sys/las/SCM1/LaneAndRe_SignalProcess/Cal_LaneHeadingAng/Compare\nTo Constant" /begin REF_MEASUREMENT LAS_SCM_HeadingAngIn_b /end REF_MEASUREMENT /end GROUP
/begin GROUP autosar_swc_las_autosar_swc_las_Step_sys_las_SCM1_LaneAndRe_SignalProcess_JudgeFinalLaneOfLR "autosar_swc_las/autosar_swc_las_Step_sys/las/SCM1/LaneAndRe_SignalProcess/JudgeFinalLaneOfLR"
 /begin REF_MEASUREMENT LAS_SCM_LeftEdgLineNear_b LAS_SCM_LeftLaneNear_b LAS_SCM_RightEdgLineNear_b LAS_SCM_RightLaneNear_b /end REF_MEASUREMENT
/end GROUP
/begin GROUP autosar_swc_las_autosar_swc_las_Step_sys_las_SCM1_LaneAndRe_SignalProcess_LKA_LDW_SignalProcess_Subsystem "autosar_swc_las/autosar_swc_las_Step_sys/las/SCM1/LaneAndRe_SignalProcess/LKA_LDW_SignalProcess/Subsystem" /begin REF_MEASUREMENT LAS_FLEgeDy /end REF_MEASUREMENT /end GROUP
/begin GROUP autosar_swc_las_autosar_swc_las_Step_sys_las_SCM1_LaneAndRe_SignalProcess_LKA_LDW_SignalProcess_Subsystem1 "autosar_swc_las/autosar_swc_las_Step_sys/las/SCM1/LaneAndRe_SignalProcess/LKA_LDW_SignalProcess/Subsystem1" /begin REF_MEASUREMENT LAS_FREgeDy /end REF_MEASUREMENT /end GROUP
/begin GROUP autosar_swc_las_autosar_swc_las_Step_sys_las_SCM1_LaneAndRe_SignalProcess_LKA_LDW_SignalProcess_Subsystem2 "autosar_swc_las/autosar_swc_las_Step_sys/las/SCM1/LaneAndRe_SignalProcess/LKA_LDW_SignalProcess/Subsystem2" /begin REF_MEASUREMENT LAS_FLWhelDy /end REF_MEASUREMENT /end GROUP
/begin GROUP autosar_swc_las_autosar_swc_las_Step_sys_las_SCM1_LaneAndRe_SignalProcess_LKA_LDW_SignalProcess_Subsystem3 "autosar_swc_las/autosar_swc_las_Step_sys/las/SCM1/LaneAndRe_SignalProcess/LKA_LDW_SignalProcess/Subsystem3" /begin REF_MEASUREMENT LAS_FRWhelDy /end REF_MEASUREMENT /end GROUP
/begin GROUP autosar_swc_las_autosar_swc_las_Step_sys_las_SCM1_LaneAndRe_SignalProcess_LKA_LDW_SignalProcess_Subsystem7 "autosar_swc_las/autosar_swc_las_Step_sys/las/SCM1/LaneAndRe_SignalProcess/LKA_LDW_SignalProcess/Subsystem7" /begin REF_MEASUREMENT LAS_preFLWhelDy /end REF_MEASUREMENT /end GROUP
/begin GROUP autosar_swc_las_autosar_swc_las_Step_sys_las_SCM1_LaneAndRe_SignalProcess_LKA_LDW_SignalProcess_Subsystem8 "autosar_swc_las/autosar_swc_las_Step_sys/las/SCM1/LaneAndRe_SignalProcess/LKA_LDW_SignalProcess/Subsystem8" /begin REF_MEASUREMENT LAS_preFRWhelDy /end REF_MEASUREMENT /end GROUP
/begin GROUP autosar_swc_las_autosar_swc_las_Step_sys_las_SCM1_LaneAndRe_SignalProcess_LaneChangeValidJud "autosar_swc_las/autosar_swc_las_Step_sys/las/SCM1/LaneAndRe_SignalProcess/LaneChangeValidJud" /begin REF_MEASUREMENT LAS_SCM_LeftChange_b LAS_SCM_RightChange_b /end REF_MEASUREMENT /end GROUP
/begin RECORD_LAYOUT Record_BOOLEAN FNC_VALUES 1 UBYTE COLUMN_DIR DIRECT /end RECORD_LAYOUT
/begin RECORD_LAYOUT Record_FLOAT32_IEEE FNC_VALUES 1 FLOAT32_IEEE COLUMN_DIR DIRECT /end RECORD_LAYOUT
/begin RECORD_LAYOUT Record_FLOAT64_IEEE FNC_VALUES 1 FLOAT64_IEEE COLUMN_DIR DIRECT /end RECORD_LAYOUT
/begin RECORD_LAYOUT Record_UBYTE FNC_VALUES 1 UBYTE COLUMN_DIR DIRECT /end RECORD_LAYOUT
/begin RECORD_LAYOUT Record_UWORD FNC_VALUES 1 UWORD COLUMN_DIR DIRECT /end RECORD_LAYOUT
/begin RECORD_LAYOUT Axis_FLOAT32_IEEE AXIS_PTS_X 1 FLOAT32_IEEE INDEX_INCR DIRECT /end RECORD_LAYOUT
/begin RECORD_LAYOUT Record_BOOLEAN FNC_VALUES 1 UBYTE COLUMN_DIR DIRECT /end RECORD_LAYOUT
/begin RECORD_LAYOUT Record_FLOAT32_IEEE FNC_VALUES 1 FLOAT32_IEEE COLUMN_DIR DIRECT /end RECORD_LAYOUT
/begin RECORD_LAYOUT Record_FLOAT64_IEEE FNC_VALUES 1 FLOAT64_IEEE COLUMN_DIR DIRECT /end RECORD_LAYOUT
/begin RECORD_LAYOUT Record_UBYTE FNC_VALUES 1 UBYTE COLUMN_DIR DIRECT /end RECORD_LAYOUT
/begin RECORD_LAYOUT Record_UWORD FNC_VALUES 1 UWORD COLUMN_DIR DIRECT /end RECORD_LAYOUT
/begin RECORD_LAYOUT Record_BOOLEAN FNC_VALUES 1 UBYTE COLUMN_DIR DIRECT /end RECORD_LAYOUT
/begin RECORD_LAYOUT Record_FLOAT32_IEEE FNC_VALUES 1 FLOAT32_IEEE COLUMN_DIR DIRECT /end RECORD_LAYOUT
/begin RECORD_LAYOUT Record_FLOAT64_IEEE FNC_VALUES 1 FLOAT64_IEEE COLUMN_DIR DIRECT /end RECORD_LAYOUT
/begin RECORD_LAYOUT Record_UBYTE FNC_VALUES 1 UBYTE COLUMN_DIR DIRECT /end RECORD_LAYOUT
/begin RECORD_LAYOUT Record_UWORD FNC_VALUES 1 UWORD COLUMN_DIR DIRECT /end RECORD_LAYOUT
/begin RECORD_LAYOUT Axis_FLOAT32_IEEE AXIS_PTS_X 1 FLOAT32_IEEE INDEX_INCR DIRECT /end RECORD_LAYOUT
/begin RECORD_LAYOUT Record_BOOLEAN FNC_VALUES 1 UBYTE COLUMN_DIR DIRECT /end RECORD_LAYOUT
/begin RECORD_LAYOUT Record_FLOAT32_IEEE FNC_VALUES 1 FLOAT32_IEEE COLUMN_DIR DIRECT /end RECORD_LAYOUT
/begin RECORD_LAYOUT Record_FLOAT64_IEEE FNC_VALUES 1 FLOAT64_IEEE COLUMN_DIR DIRECT /end RECORD_LAYOUT
/begin RECORD_LAYOUT Record_UBYTE FNC_VALUES 1 UBYTE COLUMN_DIR DIRECT /end RECORD_LAYOUT
/begin RECORD_LAYOUT Record_UWORD FNC_VALUES 1 UWORD COLUMN_DIR DIRECT /end RECORD_LAYOUT
/begin RECORD_LAYOUT Axis_FLOAT32_IEEE AXIS_PTS_X 1 FLOAT32_IEEE INDEX_INCR DIRECT /end RECORD_LAYOUT
/begin RECORD_LAYOUT Record_BOOLEAN FNC_VALUES 1 UBYTE COLUMN_DIR DIRECT /end RECORD_LAYOUT
/begin RECORD_LAYOUT Record_FLOAT32_IEEE FNC_VALUES 1 FLOAT32_IEEE COLUMN_DIR DIRECT /end RECORD_LAYOUT
/begin RECORD_LAYOUT Record_FLOAT64_IEEE FNC_VALUES 1 FLOAT64_IEEE COLUMN_DIR DIRECT /end RECORD_LAYOUT
/begin RECORD_LAYOUT Record_UBYTE FNC_VALUES 1 UBYTE COLUMN_DIR DIRECT /end RECORD_LAYOUT
/begin RECORD_LAYOUT Record_UWORD FNC_VALUES 1 UWORD COLUMN_DIR DIRECT /end RECORD_LAYOUT
/begin RECORD_LAYOUT Axis_FLOAT32_IEEE AXIS_PTS_X 1 FLOAT32_IEEE INDEX_INCR DIRECT /end RECORD_LAYOUT
/begin RECORD_LAYOUT Record_BOOLEAN FNC_VALUES 1 UBYTE COLUMN_DIR DIRECT /end RECORD_LAYOUT
/begin RECORD_LAYOUT Record_FLOAT32_IEEE FNC_VALUES 1 FLOAT32_IEEE COLUMN_DIR DIRECT /end RECORD_LAYOUT
/begin RECORD_LAYOUT Record_FLOAT64_IEEE FNC_VALUES 1 FLOAT64_IEEE COLUMN_DIR DIRECT /end RECORD_LAYOUT
/begin RECORD_LAYOUT Record_UBYTE FNC_VALUES 1 UBYTE COLUMN_DIR DIRECT /end RECORD_LAYOUT
/begin RECORD_LAYOUT Record_UWORD FNC_VALUES 1 UWORD COLUMN_DIR DIRECT /end RECORD_LAYOUT
/begin RECORD_LAYOUT Axis_FLOAT32_IEEE AXIS_PTS_X 1 FLOAT32_IEEE INDEX_INCR DIRECT /end RECORD_LAYOUT
/end MODULE
/end PROJECT
