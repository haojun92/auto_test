ASAP2_VERSION 1 71
/begin PROJECT ProjectName ""
/begin MODULE ModuleName ""
/begin MOD_COMMON "" BYTE_ORDER MSB_LAST ALIGNMENT_BYTE 1 ALIGNMENT_WORD 1 ALIGNMENT_LONG 1 ALIGNMENT_INT64 1 ALIGNMENT_FLOAT16_IEEE 1 ALIGNMENT_FLOAT32_IEEE 1 ALIGNMENT_FLOAT64_IEEE 1 /end MOD_COMMON
/begin RECORD_LAYOUT __FLOAT32_IEEE_Z FNC_VALUES 1 FLOAT32_IEEE ROW_DIR DIRECT /end RECORD_LAYOUT
/begin RECORD_LAYOUT __FLOAT64_IEEE_Z FNC_VALUES 1 FLOAT64_IEEE ROW_DIR DIRECT /end RECORD_LAYOUT
/begin CHARACTERISTIC CMBB_ALatDiffThdForAutoBrake_Ca "" VALUE 0xfe5073d0 /* @ECU_Address@CMBB_ALatDiffThdForAutoBrake_Ca@ */ Record_FLOAT32_IEEE 0 autosar_swc_aeb_CM_single 0.000000 10.000000 /end CHARACTERISTIC
/begin CHARACTERISTIC CMBB_ALatSafeThdForAutoBrakeCllsnRedByBrkg_Ca "Minimum required lateral acceleration required for starting a CMbB intervention" VALUE 0xfe5073d4 /* @ECU_Address@CMBB_ALatSafeThdForAutoBrakeCllsnRedByBrkg_Ca@ */ Record_FLOAT32_IEEE 0 autosar_swc_aeb_CM_single 0.000000 10.000000 /end CHARACTERISTIC
/begin CHARACTERISTIC CMBB_ALgtThdForCPTAPreBrakeCllsnRedByBrkg_Ca "" CURVE 0xfe507c30 /* @ECU_Address@CMBB_ALgtThdForCPTAPreBrakeCllsnRedByBrkg_Ca@ */ Record_FLOAT32_IEEE 0 autosar_swc_aeb_CM_single -12.000000 1.000000
 /begin AXIS_DESCR COM_AXIS NO_INPUT_QUANTITY autosar_swc_aeb_CM_single_m 12 0.000000 150.000000 AXIS_PTS_REF CMBB_ObjPosLgtForALgtThdForCPTAPreBrakeCllsnRedByBrkg_Ca /end AXIS_DESCR
/end CHARACTERISTIC
/begin CHARACTERISTIC CMBB_ALgtThdForFullBrakeCllsnRedByBrkg_Ca "The required longitudinal acceleration threshold for triggering full brake" CURVE 0xfe507c60 /* @ECU_Address@CMBB_ALgtThdForFullBrakeCllsnRedByBrkg_Ca@ */ Record_FLOAT32_IEEE 0 autosar_swc_aeb_CM_single -20.000000 0.000000
 /begin AXIS_DESCR COM_AXIS NO_INPUT_QUANTITY autosar_swc_aeb_CM_single_m 10 0.000000 50.000000 AXIS_PTS_REF CMBB_ObjPosLgtForALgtThdForFullBrakeCllsnRedByBrkg_Ca /end AXIS_DESCR
/end CHARACTERISTIC
/begin CHARACTERISTIC CMBB_ALgtThdForPreBrakeCllsnRedByBrkg_Ca "" CURVE 0xfe507c88 /* @ECU_Address@CMBB_ALgtThdForPreBrakeCllsnRedByBrkg_Ca@ */ Record_FLOAT32_IEEE 0 autosar_swc_aeb_CM_single -12.000000 1.000000
 /begin AXIS_DESCR COM_AXIS NO_INPUT_QUANTITY autosar_swc_aeb_CM_single_m 12 0.000000 150.000000 AXIS_PTS_REF CMBB_ObjPosLgtForALgtThdForPreBrakeCllsnRedByBrkg_Ca /end AXIS_DESCR
/end CHARACTERISTIC
/begin CHARACTERISTIC CMBB_AMaxReqFullBrkInCllsnRednByBrkg_Co "The maximum acceleration (equivalent to minimum deceleration) that we can request" VALUE 0xfe5073d8 /* @ECU_Address@CMBB_AMaxReqFullBrkInCllsnRednByBrkg_Co@ */ Record_FLOAT32_IEEE 0 autosar_swc_aeb_CM_single -12.000000 0.250000 /end CHARACTERISTIC
/begin CHARACTERISTIC CMBB_AMaxReqPreBrkInCllsnRednByBrkg_Ca "" VALUE 0xfe5073dc /* @ECU_Address@CMBB_AMaxReqPreBrkInCllsnRednByBrkg_Ca@ */ Record_FLOAT32_IEEE 0 autosar_swc_aeb_CM_single_m_per_s_ -12.000000 1.000000 /end CHARACTERISTIC
/begin CHARACTERISTIC CMBB_AMinReqFullBrkInCllsnRednByBrkg_Ca "Minimum Negative Acceleration " VALUE 0xfe5073e0 /* @ECU_Address@CMBB_AMinReqFullBrkInCllsnRednByBrkg_Ca@ */ Record_FLOAT32_IEEE 0 autosar_swc_aeb_CM_single_m_per_s_ -13.000000 0.000000 /end CHARACTERISTIC
/begin CHARACTERISTIC CMBB_AMinReqPreBrkInCllsnRednByBrkg_Ca "Minimum Negative Acceleration during pre-braking" VALUE 0xfe5073e4 /* @ECU_Address@CMBB_AMinReqPreBrkInCllsnRednByBrkg_Ca@ */ Record_FLOAT32_IEEE 0 autosar_swc_aeb_CM_single_m_per_s_ -12.000000 1.000000 /end CHARACTERISTIC
/begin CHARACTERISTIC CMBB_ANegLgtRatThdForCllsnRednByBrkg_Ca "If host acceleration is lower than this ratio of ANegLgtRqrd, then interventions will be inhibited" VALUE 0xfe5073e8 /* @ECU_Address@CMBB_ANegLgtRatThdForCllsnRednByBrkg_Ca@ */ Record_FLOAT32_IEEE 0 autosar_swc_aeb_CM_single 0.500000 1.100000 /end CHARACTERISTIC
/begin CHARACTERISTIC CMBB_AReqVisnOnlyInCllsnRednByBrkg_Ca "Acceleration request for CMbB Vision Only VRU" VALUE 0xfe5073ec /* @ECU_Address@CMBB_AReqVisnOnlyInCllsnRednByBrkg_Ca@ */ Record_FLOAT32_IEEE 0 autosar_swc_aeb_CM_single_m_per_s_ -12.000000 1.000000 /end CHARACTERISTIC
/begin CHARACTERISTIC CMBB_AThdForNoBrkgRqrdInCllsnRednByBrkg_Ca "The target acceleration threshold for deactivating CMbB when range rate is positive" VALUE 0xfe5073f0 /* @ECU_Address@CMBB_AThdForNoBrkgRqrdInCllsnRednByBrkg_Ca@ */ Record_FLOAT32_IEEE 0 autosar_swc_aeb_CM_single_m_per_s_ -1.000000 5.000000 /end CHARACTERISTIC
/begin CHARACTERISTIC CMBB_AccrPedlThdForOvrdInSpdLoInCllsnRednByBrkg_Ca "The accelerator pedal position required to override interventions in queue situations" VALUE 0xfe5073f4 /* @ECU_Address@CMBB_AccrPedlThdForOvrdInSpdLoInCllsnRednByBrkg_Ca@ */ Record_FLOAT32_IEEE 0 autosar_swc_aeb_CM_single_percent_ 0.000000 100.000000 /end CHARACTERISTIC
/begin CHARACTERISTIC CMBB_ActvnTiThdForBltReqInCllsnRednByBrkg_Ca "The maximum time for a belt activation request from CMbB autobrake" VALUE 0xfe5073f8 /* @ECU_Address@CMBB_ActvnTiThdForBltReqInCllsnRednByBrkg_Ca@ */ Record_FLOAT32_IEEE 0 autosar_swc_aeb_CM_single_s 0.000000 10.000000 /end CHARACTERISTIC
/begin CHARACTERISTIC CMBB_AgDirThdForOldPosnForVehDrvgToSelfInCllsnRednByBrkg_Ca "Minimum heading angle needed for oncoming which is compensated with recent host turn" VALUE 0xfe5073fc /* @ECU_Address@CMBB_AgDirThdForOldPosnForVehDrvgToSelfInCllsnRednByBrkg_Ca@ */ Record_FLOAT32_IEEE 0 autosar_swc_aeb_CM_single_rad 1.500000 3.150000 /end CHARACTERISTIC
/begin CHARACTERISTIC CMBB_AgDirThdForVehDrvgToSelfInCllsnRednByBrkg_Ca "The minimum heading angle needed to classify target as oncoming." VALUE 0xfe507400 /* @ECU_Address@CMBB_AgDirThdForVehDrvgToSelfInCllsnRednByBrkg_Ca@ */ Record_FLOAT32_IEEE 0 autosar_swc_aeb_CM_single_1 1.570000 3.150000 /end CHARACTERISTIC
/begin CHARACTERISTIC CMBB_BltTiDlyToActvtInCllsnRednByBrkg_Ca "Time delay before belt activation" VALUE 0xfe507404 /* @ECU_Address@CMBB_BltTiDlyToActvtInCllsnRednByBrkg_Ca@ */ Record_FLOAT32_IEEE 0 autosar_swc_aeb_CM_single_s 0.000000 2.000000 /end CHARACTERISTIC
/begin CHARACTERISTIC CMBB_BrkPedlPsdCfmDlyForOvrdInSpdLoInCllsnRednByBrkg_Ca "Confirmation time for allowing brake pedal pressed to enable driver override in queue situations" VALUE 0xfe507408 /* @ECU_Address@CMBB_BrkPedlPsdCfmDlyForOvrdInSpdLoInCllsnRednByBrkg_Ca@ */ Record_FLOAT32_IEEE 0 autosar_swc_aeb_CM_single_s 0.000000 1.000000 /end CHARACTERISTIC
/begin CHARACTERISTIC CMBB_ChgPosnLatThdInCllsnRednByBrkg_Ca "Threshold for lateral position changes for an object that is tracked continuously " VALUE 0xfe50740c /* @ECU_Address@CMBB_ChgPosnLatThdInCllsnRednByBrkg_Ca@ */ Record_FLOAT32_IEEE 0 autosar_swc_aeb_CM_single_m 0.000000 10.000000 /end CHARACTERISTIC
/begin CHARACTERISTIC CMBB_ChgPosnLgtThdInCllsnRednByBrkg_Ca "Threshold for longitudinal position changes for an object that is tracked continuously " VALUE 0xfe507410 /* @ECU_Address@CMBB_ChgPosnLgtThdInCllsnRednByBrkg_Ca@ */ Record_FLOAT32_IEEE 0 autosar_swc_aeb_CM_single_m 0.000000 20.000000 /end CHARACTERISTIC
/begin CHARACTERISTIC CMBB_ChgTiToCllsnThdInCllsnRednByBrkg_Ca "Threshold for Time-To-Collison changes for an object that is tracked continuously " VALUE 0xfe507414 /* @ECU_Address@CMBB_ChgTiToCllsnThdInCllsnRednByBrkg_Ca@ */ Record_FLOAT32_IEEE 0 autosar_swc_aeb_CM_single_s 0.000000 5.000000 /end CHARACTERISTIC
/begin CHARACTERISTIC CMBB_CrvtSelfHystForTurnDetnForVehMovgToSelf_Ca "Hysteresis for detecting S-curves" VALUE 0xfe507418 /* @ECU_Address@CMBB_CrvtSelfHystForTurnDetnForVehMovgToSelf_Ca@ */ Record_FLOAT32_IEEE 0 autosar_swc_aeb_CM_single_1_per_m 0.000000 0.010000 /end CHARACTERISTIC
/begin CHARACTERISTIC CMBB_CrvtSelfRqrdToStrtIntvForVehMovgToSelfInCllsnRednByBrkg_Ca "The minimum host curvature required to start an intervention against an oncoming vehicle." CURVE 0xfe507cb8 /* @ECU_Address@CMBB_CrvtSelfRqrdToStrtIntvForVehMovgToSelfInCllsnRednByBrkg_Ca@ */ Record_FLOAT32_IEEE 0 autosar_swc_aeb_CM_single_1_per_m 0.000000 1.000000
 /begin AXIS_DESCR COM_AXIS NO_INPUT_QUANTITY autosar_swc_aeb_CM_single_m_per_s 8 0.000000 50.000000 AXIS_PTS_REF CMBB_VLgtValCrvtSelfRqrdToStrtIntvForVehMovgToSelf_Ca /end AXIS_DESCR
/end CHARACTERISTIC
/begin CHARACTERISTIC CMBB_CrvtSelfThdForTurnDetnForVehMovgToSelfInCllsnRednByBrkg_Ca "Curvature threshold for detecting S-curves" VALUE 0xfe50741c /* @ECU_Address@CMBB_CrvtSelfThdForTurnDetnForVehMovgToSelfInCllsnRednByBrkg_Ca@ */ Record_FLOAT32_IEEE 0 autosar_swc_aeb_CM_single_1_per_m 0.000000 1.000000 /end CHARACTERISTIC
/begin CHARACTERISTIC CMBB_CrvtThdForVehDrvgToSelfInCllsnRednByBrkg_Ca "The maximum absolute curvature for oncoming vehicles below which interventions are allowed" VALUE 0xfe507420 /* @ECU_Address@CMBB_CrvtThdForVehDrvgToSelfInCllsnRednByBrkg_Ca@ */ Record_FLOAT32_IEEE 0 autosar_swc_aeb_CM_single_1_per_m 0.000000 1.000000 /end CHARACTERISTIC
/begin CHARACTERISTIC CMBB_DecelLvlForHiFBltReqInCllsnRednByBrkg_Ca "Threshold in required longitudinal acceleration for high force belt request." VALUE 0xfe507424 /* @ECU_Address@CMBB_DecelLvlForHiFBltReqInCllsnRednByBrkg_Ca@ */ Record_FLOAT32_IEEE 0 autosar_swc_aeb_CM_single_m_per_s_ -15.000000 0.000000 /end CHARACTERISTIC
/begin CHARACTERISTIC CMBB_DecelReqFiltParam1InCllsnInCllsnRednByBrkg_Ca "Parameter in low pass filter for DecelReq " VALUE 0xfe507428 /* @ECU_Address@CMBB_DecelReqFiltParam1InCllsnInCllsnRednByBrkg_Ca@ */ Record_FLOAT32_IEEE 0 autosar_swc_aeb_CM_single_1 -1.000000 1.000000 /end CHARACTERISTIC
/begin CHARACTERISTIC CMBB_DecelReqFiltParam2InCllsnInCllsnRednByBrkg_Ca "Parameter in low pass filter for DecelReq " VALUE 0xfe50742c /* @ECU_Address@CMBB_DecelReqFiltParam2InCllsnInCllsnRednByBrkg_Ca@ */ Record_FLOAT32_IEEE 0 autosar_swc_aeb_CM_single_1 -1.000000 1.000000 /end CHARACTERISTIC
/begin CHARACTERISTIC CMBB_DecelReqFiltParam3InCllsnInCllsnRednByBrkg_Ca "Parameter in low pass filter for DecelReq " VALUE 0xfe507430 /* @ECU_Address@CMBB_DecelReqFiltParam3InCllsnInCllsnRednByBrkg_Ca@ */ Record_FLOAT32_IEEE 0 autosar_swc_aeb_CM_single_1 -1.000000 1.000000 /end CHARACTERISTIC
/begin CHARACTERISTIC CMBB_DrvrDecelFiltParam1InCllsnInCllsnRednByBrkg_Ca "Parameter in high pass filter for DrvrDecelReq " VALUE 0xfe507434 /* @ECU_Address@CMBB_DrvrDecelFiltParam1InCllsnInCllsnRednByBrkg_Ca@ */ Record_FLOAT32_IEEE 0 autosar_swc_aeb_CM_single_1 -5.000000 5.000000 /end CHARACTERISTIC
/begin CHARACTERISTIC CMBB_DrvrDecelFiltParam2InCllsnInCllsnRednByBrkg_Ca "Parameter in high pass filter for DrvrDecelReq " VALUE 0xfe507438 /* @ECU_Address@CMBB_DrvrDecelFiltParam2InCllsnInCllsnRednByBrkg_Ca@ */ Record_FLOAT32_IEEE 0 autosar_swc_aeb_CM_single_1 -5.000000 5.000000 /end CHARACTERISTIC
/begin CHARACTERISTIC CMBB_DrvrDecelFiltParam3InCllsnInCllsnRednByBrkg_Ca "Parameter in high pass filter for DrvrDecelReq " VALUE 0xfe50743c /* @ECU_Address@CMBB_DrvrDecelFiltParam3InCllsnInCllsnRednByBrkg_Ca@ */ Record_FLOAT32_IEEE 0 autosar_swc_aeb_CM_single_1 -5.000000 5.000000 /end CHARACTERISTIC
/begin CHARACTERISTIC CMBB_DrvrDecelFiltParam4InCllsnInCllsnRednByBrkg_Ca "Parameter in high pass filter for DrvrDecelReq " VALUE 0xfe507440 /* @ECU_Address@CMBB_DrvrDecelFiltParam4InCllsnInCllsnRednByBrkg_Ca@ */ Record_FLOAT32_IEEE 0 autosar_swc_aeb_CM_single_1 -5.000000 5.000000 /end CHARACTERISTIC
/begin CHARACTERISTIC CMBB_DrvrDecelFiltParam5InCllsnInCllsnRednByBrkg_Ca "Parameter in high pass filter for DrvrDecelReq " VALUE 0xfe507444 /* @ECU_Address@CMBB_DrvrDecelFiltParam5InCllsnInCllsnRednByBrkg_Ca@ */ Record_FLOAT32_IEEE 0 autosar_swc_aeb_CM_single_1 -5.000000 5.000000 /end CHARACTERISTIC
/begin CHARACTERISTIC CMBB_DrvrDecelReqMinBrkPedPsdInCllsnRednByBrkg_Ca "Minimum Driver Decel Request when brake pedal is pressed" VALUE 0xfe507448 /* @ECU_Address@CMBB_DrvrDecelReqMinBrkPedPsdInCllsnRednByBrkg_Ca@ */ Record_FLOAT32_IEEE 0 autosar_swc_aeb_CM_single_m_per_s 0.000000 10.000000 /end CHARACTERISTIC
/begin CHARACTERISTIC CMBB_DurnOfCllsnRednActvAllwdWoCrsCnclInCllsnRednByBrkg_Ca "Duration that cmbb is active before we cancel cruise control" VALUE 0xfe50744c /* @ECU_Address@CMBB_DurnOfCllsnRednActvAllwdWoCrsCnclInCllsnRednByBrkg_Ca@ */ Record_FLOAT32_IEEE 0 autosar_swc_aeb_CM_single_s 0.000000 0.400000 /end CHARACTERISTIC
/begin CHARACTERISTIC CMBB_DurnOfCllsnRednActvAllwdWoHmiMsgInCllsnRednByBrkg_Ca "Duration that cmbb is active before me send a HMI message. " VALUE 0xfe507450 /* @ECU_Address@CMBB_DurnOfCllsnRednActvAllwdWoHmiMsgInCllsnRednByBrkg_Ca@ */ Record_FLOAT32_IEEE 0 autosar_swc_aeb_CM_single_s 0.000000 1.000000 /end CHARACTERISTIC
/begin CHARACTERISTIC CMBB_DynCalPrmForAxleDstReToVehFrntMinValInCllsnRednByBrkg_Ca "Minimum value used for the distance between rear axle and front bumper." VALUE 0xfe507454 /* @ECU_Address@CMBB_DynCalPrmForAxleDstReToVehFrntMinValInCllsnRednByBrkg_Ca@ */ Record_FLOAT32_IEEE 0 autosar_swc_aeb_CM_single_m 0.500000 1.500000 /end CHARACTERISTIC
/begin CHARACTERISTIC CMBB_DynCalPrmForBicycleMdlAxleDstFrntMinVal_Ca "Minimum value used for the distance from center of gravity to the front axle." VALUE 0xfe507458 /* @ECU_Address@CMBB_DynCalPrmForBicycleMdlAxleDstFrntMinVal_Ca@ */ Record_FLOAT32_IEEE 0 autosar_swc_aeb_CM_single_m 0.000000 1.000000 /end CHARACTERISTIC
/begin CHARACTERISTIC CMBB_DynCalPrmForBicycleMdlCornrgStfnFrntMinVal_Ca "Minimum value used for the cornering stiffness for the front." VALUE 0xfe50745c /* @ECU_Address@CMBB_DynCalPrmForBicycleMdlCornrgStfnFrntMinVal_Ca@ */ Record_FLOAT32_IEEE 0 autosar_swc_aeb_CM_single_N_per_rad 500.000000 1000.000000 /end CHARACTERISTIC
/begin CHARACTERISTIC CMBB_DynCalPrmForBicycleMdlCornrgStfnReMinVal_Ca "Minimum value used for the cornering stiffness for the rear." VALUE 0xfe507460 /* @ECU_Address@CMBB_DynCalPrmForBicycleMdlCornrgStfnReMinVal_Ca@ */ Record_FLOAT32_IEEE 0 autosar_swc_aeb_CM_single_N_per_rad 500.000000 1000.000000 /end CHARACTERISTIC
/begin CHARACTERISTIC CMBB_DynCalPrmForVehMMinValInCllsnRednByBrkg_Ca "Minimum value used for the vehicle mass." VALUE 0xfe507464 /* @ECU_Address@CMBB_DynCalPrmForVehMMinValInCllsnRednByBrkg_Ca@ */ Record_FLOAT32_IEEE 0 autosar_swc_aeb_CM_single_kg 100.000000 200.000000 /end CHARACTERISTIC
/begin CHARACTERISTIC CMBB_DynCalPrmForVehSteerWhlAgRatMinValInCllsnRednByBrkg_Ca "Minimum value used for the steer wheel angle ratio." VALUE 0xfe507468 /* @ECU_Address@CMBB_DynCalPrmForVehSteerWhlAgRatMinValInCllsnRednByBrkg_Ca@ */ Record_FLOAT32_IEEE 0 autosar_swc_aeb_CM_single_1 1.000000 2.000000 /end CHARACTERISTIC
/begin CHARACTERISTIC CMBB_DynCalPrmForVehWhlBasMinValInCllsnRednByBrkg_Ca "Minimum value used for the wheel base." VALUE 0xfe50746c /* @ECU_Address@CMBB_DynCalPrmForVehWhlBasMinValInCllsnRednByBrkg_Ca@ */ Record_FLOAT32_IEEE 0 autosar_swc_aeb_CM_single_m 0.500000 1.500000 /end CHARACTERISTIC
/begin CHARACTERISTIC CMBB_FacPreBrkANegLgtReqInCllsnRednByBrkg_Ca "Factor used to determine requested acceleration during pre-brake" VALUE 0xfe507470 /* @ECU_Address@CMBB_FacPreBrkANegLgtReqInCllsnRednByBrkg_Ca@ */ Record_FLOAT32_IEEE 0 autosar_swc_aeb_CM_single_1 0.000000 1.000000 /end CHARACTERISTIC
/begin CHARACTERISTIC CMBB_FctJerkInCllsnRednByBrkg_Ca "Tuning factor for CMbB Full Brake jerk limit" VALUE 0xfe507474 /* @ECU_Address@CMBB_FctJerkInCllsnRednByBrkg_Ca@ */ Record_FLOAT32_IEEE 0 autosar_swc_aeb_CM_single_1 0.000000 5.000000 /end CHARACTERISTIC
/begin CHARACTERISTIC CMBB_HiValThdForDeactvnByTiToCllsnInCllsnRednByBrkg_Ca "Threshold above which TTC may deactivate CMbB interventions. " VALUE 0xfe507478 /* @ECU_Address@CMBB_HiValThdForDeactvnByTiToCllsnInCllsnRednByBrkg_Ca@ */ Record_FLOAT32_IEEE 0 autosar_swc_aeb_CM_single_s 2.000000 20.000000 /end CHARACTERISTIC
/begin CHARACTERISTIC CMBB_JerkMaxFullBrkInCllsnRednByBrkg_Ca "Max jerk for Full Braking" VALUE 0xfe50747c /* @ECU_Address@CMBB_JerkMaxFullBrkInCllsnRednByBrkg_Ca@ */ Record_FLOAT32_IEEE 0 autosar_swc_aeb_CM_single_m_per_s_ -50.000000 0.000000 /end CHARACTERISTIC
/begin CHARACTERISTIC CMBB_JerkMinFullBrkInCllsnRednByBrkg_Ca "Max jerk for Full Braking" VALUE 0xfe507480 /* @ECU_Address@CMBB_JerkMinFullBrkInCllsnRednByBrkg_Ca@ */ Record_FLOAT32_IEEE 0 autosar_swc_aeb_CM_single_m_per_s_ -50.000000 0.000000 /end CHARACTERISTIC
/begin CHARACTERISTIC CMBB_JerkMinPreBrkInCllsnRednByBrkg_Ca "Min jerk for requested acceleration (max jerk deceleration) when CMbB is in PreBrake." VALUE 0xfe507484 /* @ECU_Address@CMBB_JerkMinPreBrkInCllsnRednByBrkg_Ca@ */ Record_FLOAT32_IEEE 0 autosar_swc_aeb_CM_single_m_per_s_ -30.000000 0.000000 /end CHARACTERISTIC
/begin CHARACTERISTIC CMBB_JerkMinPreBrkLowConfInCllsnRednByBrkg_Ca "Min jerk for requested acceleration (max jerk deceleration) when CMbB is in PreBrake and CMbB Primary confidence is less than three." VALUE 0xfe507488 /* @ECU_Address@CMBB_JerkMinPreBrkLowConfInCllsnRednByBrkg_Ca@ */ Record_FLOAT32_IEEE 0 autosar_swc_aeb_CM_single_m_per_s_ -30.000000 0.000000 /end CHARACTERISTIC
/begin CHARACTERISTIC CMBB_MaxSpeedInhibitInCllsnRednByBrkg_Ca "Max speed for inhibation mechanism \"speed at collision \"" VALUE 0xfe50748c /* @ECU_Address@CMBB_MaxSpeedInhibitInCllsnRednByBrkg_Ca@ */ Record_FLOAT32_IEEE 0 autosar_swc_aeb_CM_single_m_per_s -5.000000 20.000000 /end CHARACTERISTIC
/begin CHARACTERISTIC CMBB_MinVLgtObjDeActALgtReqInCllsnRednByBrkg_Ca "Minimum object longitudinell velocity for deactivating an ongoing cmbb intervention due to too low required longitudinell acceleration." VALUE 0xfe507490 /* @ECU_Address@CMBB_MinVLgtObjDeActALgtReqInCllsnRednByBrkg_Ca@ */ Record_FLOAT32_IEEE 0 autosar_swc_aeb_CM_single_m_per_s -5.000000 5.000000 /end CHARACTERISTIC
/begin CHARACTERISTIC CMBB_MplTarEnaInCllsnRednByBrkg_Ca "Enables multi target activation of pre brake and full brake." VALUE 0xfe507755 /* @ECU_Address@CMBB_MplTarEnaInCllsnRednByBrkg_Ca@ */ Record_BOOLEAN 0 autosar_swc_aeb_CM_logical 0 1 /end CHARACTERISTIC
/begin CHARACTERISTIC CMBB_NrOfObjThdForDrvgSideInCllsnRednByBrkg_Ca "Required confidence level for driving side" VALUE 0xfe507771 /* @ECU_Address@CMBB_NrOfObjThdForDrvgSideInCllsnRednByBrkg_Ca@ */ Record_SBYTE 0 autosar_swc_aeb_CM_int8_1 0.000000 10.000000 /end CHARACTERISTIC
/begin CHARACTERISTIC CMBB_PinionAgRateFilConInCllsnRednByBrkg_Ca "Low pass filter constant for pinion angle rate." VALUE 0xfe507494 /* @ECU_Address@CMBB_PinionAgRateFilConInCllsnRednByBrkg_Ca@ */ Record_FLOAT32_IEEE 0 autosar_swc_aeb_CM_single_1 0.000000 1.000000 /end CHARACTERISTIC
/begin CHARACTERISTIC CMBB_PinionSteerAgSpdRqrdToOvrdIntvForVehMovgToSelf_Ca "The absolute pinion steering angle speed that is needed to override LTAP interventions" VALUE 0xfe507498 /* @ECU_Address@CMBB_PinionSteerAgSpdRqrdToOvrdIntvForVehMovgToSelf_Ca@ */ Record_FLOAT32_IEEE 0 autosar_swc_aeb_CM_single_rad_per_s 2.000000 15.000000 /end CHARACTERISTIC
/begin CHARACTERISTIC CMBB_PinionSteerAgSpdRqrdToStrtIntvForVehMovgToSelf_Ca "The minimum host pinion angle speed required to start an intervention against an oncoming vehicle." VALUE 0xfe50749c /* @ECU_Address@CMBB_PinionSteerAgSpdRqrdToStrtIntvForVehMovgToSelf_Ca@ */ Record_FLOAT32_IEEE 0 autosar_swc_aeb_CM_single_rad_per_s 0.000000 1000.000000 /end CHARACTERISTIC
/begin CHARACTERISTIC CMBB_PosnLgtThdForNoBrkgRqrdInCllsnRednByBrkg_Ca "The distance threshold for deactivating CMbB when range rate is positive" VALUE 0xfe5074a0 /* @ECU_Address@CMBB_PosnLgtThdForNoBrkgRqrdInCllsnRednByBrkg_Ca@ */ Record_FLOAT32_IEEE 0 autosar_swc_aeb_CM_single_m 0.000000 3.000000 /end CHARACTERISTIC
/begin CHARACTERISTIC CMBB_PredTimeForSpeedImhibitCllsnRednByBrkg_Ca "" VALUE 0xfe5074a4 /* @ECU_Address@CMBB_PredTimeForSpeedImhibitCllsnRednByBrkg_Ca@ */ Record_FLOAT32_IEEE 0 autosar_swc_aeb_CM_single_s 0.000000 2.000000 /end CHARACTERISTIC
/begin CHARACTERISTIC CMBB_SpdMinOvrdAccrResetInCllsnRednByBrkg_Ca "Min speed for acceleration override reset due to released acceleration pedal" VALUE 0xfe5074a8 /* @ECU_Address@CMBB_SpdMinOvrdAccrResetInCllsnRednByBrkg_Ca@ */ Record_FLOAT32_IEEE 0 autosar_swc_aeb_CM_single_m_per_s 0.000000 100.000000 /end CHARACTERISTIC
/begin CHARACTERISTIC CMBB_SpdPredMinAtCllsnInCllsnRednByBrkg_Ca "Minimum predicted speed at collision allowed before inhibit of intervention." VALUE 0xfe5074ac /* @ECU_Address@CMBB_SpdPredMinAtCllsnInCllsnRednByBrkg_Ca@ */ Record_FLOAT32_IEEE 0 autosar_swc_aeb_CM_single_m_per_s 0.000000 10.000000 /end CHARACTERISTIC
/begin CHARACTERISTIC CMBB_SpdTarForOncomingBltActvnInCllsnRednByBrkg_Ca "Required target vehicle speed to allow LTAP belt retraction" VALUE 0xfe5074b0 /* @ECU_Address@CMBB_SpdTarForOncomingBltActvnInCllsnRednByBrkg_Ca@ */ Record_FLOAT32_IEEE 0 autosar_swc_aeb_CM_single_m_per_s 0.000000 20.000000 /end CHARACTERISTIC
/begin CHARACTERISTIC CMBB_SpdThdDlyDeactvnInCllsnRednByBrkg_Ca "Speed threshold for delaying deactivation" VALUE 0xfe5074b4 /* @ECU_Address@CMBB_SpdThdDlyDeactvnInCllsnRednByBrkg_Ca@ */ Record_FLOAT32_IEEE 0 autosar_swc_aeb_CM_single_m_per_s 0.000000 10.000000 /end CHARACTERISTIC
/begin CHARACTERISTIC CMBB_SpdThdForOvrdInSpdLoInCllsnRednByBrkg_Ca "Speed threshold for enabling driver override in queue situations" VALUE 0xfe5074b8 /* @ECU_Address@CMBB_SpdThdForOvrdInSpdLoInCllsnRednByBrkg_Ca@ */ Record_FLOAT32_IEEE 0 autosar_swc_aeb_CM_single_m_per_s 0.000000 3.000000 /end CHARACTERISTIC
/begin CHARACTERISTIC CMBB_SpdThdForVehDrvgToSelfInCllsnRednByBrkg_Ca "The minimum speed needed for target to be classified as oncoming." VALUE 0xfe5074bc /* @ECU_Address@CMBB_SpdThdForVehDrvgToSelfInCllsnRednByBrkg_Ca@ */ Record_FLOAT32_IEEE 0 autosar_swc_aeb_CM_single_m_per_s 0.500000 10.000000 /end CHARACTERISTIC
/begin CHARACTERISTIC CMBB_SpdThdForYawRateCrvtInCllsnRednByBrkg_Ca "Speed threshold for using yaw rate based curvature in the LTAP inhibit conditions." VALUE 0xfe5074c0 /* @ECU_Address@CMBB_SpdThdForYawRateCrvtInCllsnRednByBrkg_Ca@ */ Record_FLOAT32_IEEE 0 autosar_swc_aeb_CM_single_m_per_s 0.000000 30.000000 /end CHARACTERISTIC
/begin CHARACTERISTIC CMBB_SteerAsEnaInCllsnRednByBrkg_Ca "Decides whether steer assist is enabled in LTAP interventions" VALUE 0xfe507756 /* @ECU_Address@CMBB_SteerAsEnaInCllsnRednByBrkg_Ca@ */ Record_BOOLEAN 0 autosar_swc_aeb_CM_logical 0 1 /end CHARACTERISTIC
/begin CHARACTERISTIC CMBB_StoreTiForNoTurnInCllsnRednByBrkg_Ca "The time duartion to store curvature used as threshold for inhibiting interventions against oncoming targets in S-curves" VALUE 0xfe5074c4 /* @ECU_Address@CMBB_StoreTiForNoTurnInCllsnRednByBrkg_Ca@ */ Record_FLOAT32_IEEE 0 autosar_swc_aeb_CM_single_s 0.000000 10.000000 /end CHARACTERISTIC
/begin CHARACTERISTIC CMBB_StoreTiForPinionSteerAgSpdInCllsnRednByBrkg_Ca "The time duration to store pinion angle speed used as threshold for inhibiting interventions against oncoming targets." VALUE 0xfe5074c8 /* @ECU_Address@CMBB_StoreTiForPinionSteerAgSpdInCllsnRednByBrkg_Ca@ */ Record_FLOAT32_IEEE 0 autosar_swc_aeb_CM_single_s 0.000000 8.000000 /end CHARACTERISTIC
/begin CHARACTERISTIC CMBB_TiDlyDeactvnInCllsnRednByBrkg_Ca "Duration of delayed deactivation" VALUE 0xfe5074cc /* @ECU_Address@CMBB_TiDlyDeactvnInCllsnRednByBrkg_Ca@ */ Record_FLOAT32_IEEE 0 autosar_swc_aeb_CM_single_s 0.000000 5.000000 /end CHARACTERISTIC
/begin CHARACTERISTIC CMBB_TiMaxForBypOfAPosThdInCllsnRednByBrkg_Ca "The time threshold below which ATN is bypassed." VALUE 0xfe5074d0 /* @ECU_Address@CMBB_TiMaxForBypOfAPosThdInCllsnRednByBrkg_Ca@ */ Record_FLOAT32_IEEE 0 autosar_swc_aeb_CM_single_s 0.000000 2.000000 /end CHARACTERISTIC
/begin CHARACTERISTIC CMBB_TiRstForVRednThdInCllsnRednByBrkg_Ca "When checking how much the vehicle has decelerated we use this time for resetting the speed." VALUE 0xfe5074d4 /* @ECU_Address@CMBB_TiRstForVRednThdInCllsnRednByBrkg_Ca@ */ Record_FLOAT32_IEEE 0 autosar_swc_aeb_CM_single_s 0.000000 50.000000 /end CHARACTERISTIC
/begin CHARACTERISTIC CMBB_TiRstForViOnMntInCllsnRednByBrkg_Ca "When checking the duration of a vision only intervention we use this time for resetting the monitor." VALUE 0xfe5074d8 /* @ECU_Address@CMBB_TiRstForViOnMntInCllsnRednByBrkg_Ca@ */ Record_FLOAT32_IEEE 0 autosar_swc_aeb_CM_single_s 0.000000 10.000000 /end CHARACTERISTIC
/begin CHARACTERISTIC CMBB_TiToActvtConfInCllsnRednByBrkg_Ca "Time threshold for enabling set-reset mechanism for CMbB." VALUE 0xfe5074dc /* @ECU_Address@CMBB_TiToActvtConfInCllsnRednByBrkg_Ca@ */ Record_FLOAT32_IEEE 0 autosar_swc_aeb_CM_single_s 0.000000 1.000000 /end CHARACTERISTIC
/begin CHARACTERISTIC CMBB_TiToActvtConfLongInCllsnRednByBrkg_Ca "Confimration time for threats based on vision" VALUE 0xfe5074e0 /* @ECU_Address@CMBB_TiToActvtConfLongInCllsnRednByBrkg_Ca@ */ Record_FLOAT32_IEEE 0 autosar_swc_aeb_CM_single_s 0.000000 1.000000 /end CHARACTERISTIC
/begin CHARACTERISTIC CMBB_TiToDeactvtBrkgAftNoCritCtaInCllsnRednByBrkg_Ca "Time to deactivate braking after no critical condition" VALUE 0xfe5074e4 /* @ECU_Address@CMBB_TiToDeactvtBrkgAftNoCritCtaInCllsnRednByBrkg_Ca@ */ Record_FLOAT32_IEEE 0 autosar_swc_aeb_CM_single_s 0.000000 0.300000 /end CHARACTERISTIC
/begin CHARACTERISTIC CMBB_TiToDeactvtBrkgAftNoTiToCllsnCtaInCllsnRednByBrkg_Ca "Time after which braking should be disabled when TTC has been large." VALUE 0xfe5074e8 /* @ECU_Address@CMBB_TiToDeactvtBrkgAftNoTiToCllsnCtaInCllsnRednByBrkg_Ca@ */ Record_FLOAT32_IEEE 0 autosar_swc_aeb_CM_single_s 0.000000 3.000000 /end CHARACTERISTIC
/begin CHARACTERISTIC CMBB_TiToDeactvtBrkgAftVehStatyInCllsnRednByBrkg_Ca "Time To Deactivate Braking after vehicle stationary" VALUE 0xfe5074ec /* @ECU_Address@CMBB_TiToDeactvtBrkgAftVehStatyInCllsnRednByBrkg_Ca@ */ Record_FLOAT32_IEEE 0 autosar_swc_aeb_CM_single_s 0.000000 3.000000 /end CHARACTERISTIC
/begin CHARACTERISTIC CMBB_TimeDelayDeactivationInCllsnRednByBrkg_Ca "Parameter for time delay of deactivation due to changed TargetId or low confidence at low host speed" VALUE 0xfe5074f0 /* @ECU_Address@CMBB_TimeDelayDeactivationInCllsnRednByBrkg_Ca@ */ Record_FLOAT32_IEEE 0 autosar_swc_aeb_CM_single_s 0.000000 5.000000 /end CHARACTERISTIC
/begin CHARACTERISTIC CMBB_VLgtRelThdForBltReqWithActvnFHiInCllsnRednByBrkg_Ca "If relative speed is greater than this threshold the high speed retractable pretensior should be activated. Otherwise low speed." VALUE 0xfe5074f4 /* @ECU_Address@CMBB_VLgtRelThdForBltReqWithActvnFHiInCllsnRednByBrkg_Ca@ */ Record_FLOAT32_IEEE 0 autosar_swc_aeb_CM_single_m_per_s -20.000000 20.000000 /end CHARACTERISTIC
/begin CHARACTERISTIC CMBB_VLgtRelThdForNoBrkgRqrdInCllsnRednByBrkg_Ca "The range rate threshold for deactivating CMbB when range rate is positive" VALUE 0xfe5074f8 /* @ECU_Address@CMBB_VLgtRelThdForNoBrkgRqrdInCllsnRednByBrkg_Ca@ */ Record_FLOAT32_IEEE 0 autosar_swc_aeb_CM_single_m_per_s 0.000000 5.000000 /end CHARACTERISTIC
/begin CHARACTERISTIC CMBB_VLgtRelThdForOvrdInSpdLoInCllsnRednByBrkg_Ca "The range rate required for allowing driver override in queue situations" VALUE 0xfe5074fc /* @ECU_Address@CMBB_VLgtRelThdForOvrdInSpdLoInCllsnRednByBrkg_Ca@ */ Record_FLOAT32_IEEE 0 autosar_swc_aeb_CM_single_m_per_s -10.000000 2.000000 /end CHARACTERISTIC
/begin CHARACTERISTIC CMBB_VRednThdASILAInCllsnRednByBrkg_Ca "Threshold for ASIL A Hazard (if the speed is reduced more than 15 km/h but less than 75km/h, the hazard is considered as ASIL A)" VALUE 0xfe507500 /* @ECU_Address@CMBB_VRednThdASILAInCllsnRednByBrkg_Ca@ */ Record_FLOAT32_IEEE 0 autosar_swc_aeb_CM_single_m_per_s 2.000000 4.100000 /end CHARACTERISTIC
/begin CHARACTERISTIC CMBB_VehSpdForOncomingBltActvnInCllsnRednByBrkg_Ca "Required host vehicle speed to allow LTAP belt retraction" VALUE 0xfe507504 /* @ECU_Address@CMBB_VehSpdForOncomingBltActvnInCllsnRednByBrkg_Ca@ */ Record_FLOAT32_IEEE 0 autosar_swc_aeb_CM_single_m_per_s 0.000000 10.000000 /end CHARACTERISTIC
/begin CHARACTERISTIC CMBB_VehSpdMaxWoOccpSftPosnInCllsnRednByBrkg_Ca "Max speed for cmbb when OSP (ERR) is not available and primary target is either an animal, general object or unknown class" VALUE 0xfe507508 /* @ECU_Address@CMBB_VehSpdMaxWoOccpSftPosnInCllsnRednByBrkg_Ca@ */ Record_FLOAT32_IEEE 0 autosar_swc_aeb_CM_single_m_per_s 0.000000 100.000000 /end CHARACTERISTIC
/begin CHARACTERISTIC CMBB_VehSpdThdForBltReqWithActvnFHiInCllsnRednByBrkg_Ca "If host vehicle speed is greater than this threshold the high speed retractable pretensior should be activated. Otherwise low speed." VALUE 0xfe50750c /* @ECU_Address@CMBB_VehSpdThdForBltReqWithActvnFHiInCllsnRednByBrkg_Ca@ */ Record_FLOAT32_IEEE 0 autosar_swc_aeb_CM_single_m_per_s -30.000000 30.000000 /end CHARACTERISTIC
/begin CHARACTERISTIC CMBB_ViOnIntvTiMaxInCllsnRednByBrkg_Ca "Max time for vision only intervention" VALUE 0xfe507510 /* @ECU_Address@CMBB_ViOnIntvTiMaxInCllsnRednByBrkg_Ca@ */ Record_FLOAT32_IEEE 0 autosar_swc_aeb_CM_single_s 0.000000 5.000000 /end CHARACTERISTIC
/begin CHARACTERISTIC CMBB_VisnOnlyBrkgForPedOnlyEnadInCllsnRednByBrkg_Ca "Vision Only Braking For VRUs enabled" VALUE 0xfe507757 /* @ECU_Address@CMBB_VisnOnlyBrkgForPedOnlyEnadInCllsnRednByBrkg_Ca@ */ Record_BOOLEAN 0 autosar_swc_aeb_CM_logical 0 1 /end CHARACTERISTIC
/begin CHARACTERISTIC DSE_CrvtTypTblInDrvrStEstimr_Ca "Weight factor when mixing yaw rate based and pinion angle based curvature." CURVE 0xfe50726c /* @ECU_Address@DSE_CrvtTypTblInDrvrStEstimr_Ca@ */ Record_FLOAT32_IEEE 0 autosar_swc_aeb_CM_single 0.000000 1.000000
 /begin AXIS_DESCR COM_AXIS NO_INPUT_QUANTITY autosar_swc_aeb_CM_single_m_per_s 2 0.000000 100.000000 AXIS_PTS_REF DSE_VLgtValForCrvtTypTblInDrvrStEstimr_Ca /end AXIS_DESCR
/end CHARACTERISTIC
/begin CHARACTERISTIC DSE_ReactnTiDftHiSnvtyInDrvrStEstimr_Ca "Default Reaction time for FCW sensitivity level 3 (High Sensitivity)" VALUE 0xfe507590 /* @ECU_Address@DSE_ReactnTiDftHiSnvtyInDrvrStEstimr_Ca@ */ Record_FLOAT32_IEEE 0 autosar_swc_aeb_CM_single_s 0.000000 2.000000 /end CHARACTERISTIC
/begin CHARACTERISTIC DSE_ReactnTiDftLoSnvtyInDrvrStEstimr_Ca "Default Reaction time for FCW sensitivity level 1 (Low Sensitivity)" VALUE 0xfe507594 /* @ECU_Address@DSE_ReactnTiDftLoSnvtyInDrvrStEstimr_Ca@ */ Record_FLOAT32_IEEE 0 autosar_swc_aeb_CM_single_s 0.000000 2.000000 /end CHARACTERISTIC
/begin CHARACTERISTIC DSE_ReactnTiDftNormSnvtyInDrvrStEstimr_Ca "Default Reaction time for FCW sensitivity level 2 (Nomal Sensitivity)" VALUE 0xfe507598 /* @ECU_Address@DSE_ReactnTiDftNormSnvtyInDrvrStEstimr_Ca@ */ Record_FLOAT32_IEEE 0 autosar_swc_aeb_CM_single_s 0.000000 2.000000 /end CHARACTERISTIC
/begin CHARACTERISTIC DSE_ReactnTiMaxInDrvrStEstimr_Ca "Maximum allowed value for reaction time." VALUE 0xfe50759c /* @ECU_Address@DSE_ReactnTiMaxInDrvrStEstimr_Ca@ */ Record_FLOAT32_IEEE 0 autosar_swc_aeb_CM_single_s 0.000000 5.000000 /end CHARACTERISTIC
/begin CHARACTERISTIC DSE_ReactnTiMinInDrvrStEstimr_Ca "Minimum value of the estimated reaction time." VALUE 0xfe5075a0 /* @ECU_Address@DSE_ReactnTiMinInDrvrStEstimr_Ca@ */ Record_FLOAT32_IEEE 0 autosar_swc_aeb_CM_single_s 0.000000 1.000000 /end CHARACTERISTIC
/begin CHARACTERISTIC FCW_CllsnThreatHldTiInCllsnFwdWarn_Ca "The time to hold the CllsnThreat signal after a falling edge." VALUE 0xfe50761c /* @ECU_Address@FCW_CllsnThreatHldTiInCllsnFwdWarn_Ca@ */ Record_FLOAT32_IEEE 0 autosar_swc_aeb_CM_single_s 0.000000 5.000000 /end CHARACTERISTIC
/begin CHARACTERISTIC P_AEB_ALatForFullbrake "" CURVE 0xfe8200f0 /* @ECU_Address@P_AEB_ALatForFullbrake@ */ Record_FLOAT32_IEEE 0 autosar_swc_aeb_CM_single -20.000000 20.000000
 /begin AXIS_DESCR COM_AXIS NO_INPUT_QUANTITY autosar_swc_aeb_CM_single_m_per_s 5 0.000000 200.000000 AXIS_PTS_REF P_AEB_FullThreatSpeed /end AXIS_DESCR
/end CHARACTERISTIC
/begin CHARACTERISTIC P_AEB_ALatForPrebrake "" CURVE 0xfe820104 /* @ECU_Address@P_AEB_ALatForPrebrake@ */ Record_FLOAT32_IEEE 0 autosar_swc_aeb_CM_single -20.000000 20.000000
 /begin AXIS_DESCR COM_AXIS NO_INPUT_QUANTITY autosar_swc_aeb_CM_single_m_per_s 5 0.000000 200.000000 AXIS_PTS_REF P_AEB_PreThreatSpeed /end AXIS_DESCR
/end CHARACTERISTIC
/begin CHARACTERISTIC P_AEB_FullBrakeSpeedComp "Host velocity values in lookup table for determine safety margin in inpath calculation for pedestrians, animals and general objects." CURVE 0xfe820190 /* @ECU_Address@P_AEB_FullBrakeSpeedComp@ */ Record_FLOAT32_IEEE 0 autosar_swc_aeb_CM_single 0.000000 100.000000
 /begin AXIS_DESCR COM_AXIS NO_INPUT_QUANTITY autosar_swc_aeb_CM_single_m_per_s 5 0.000000 200.000000 AXIS_PTS_REF P_AEB_FullThreatSpeed /end AXIS_DESCR
/end CHARACTERISTIC
/begin CHARACTERISTIC P_AEB_NotUseSteerThreat "" VALUE 0xfe8200ea /* @ECU_Address@P_AEB_NotUseSteerThreat@ */ Record_BOOLEAN 0 autosar_swc_aeb_CM_boolean 0 1 /end CHARACTERISTIC
/begin CHARACTERISTIC P_AEB_PreBrakeSpeedComp "Host velocity values in lookup table for determine safety margin in inpath calculation for pedestrians, animals and general objects." CURVE 0xfe8201b8 /* @ECU_Address@P_AEB_PreBrakeSpeedComp@ */ Record_FLOAT32_IEEE 0 autosar_swc_aeb_CM_single 0.000000 100.000000
 /begin AXIS_DESCR COM_AXIS NO_INPUT_QUANTITY autosar_swc_aeb_CM_single_m_per_s 5 0.000000 200.000000 AXIS_PTS_REF P_AEB_PreThreatSpeed /end AXIS_DESCR
/end CHARACTERISTIC
/begin MEASUREMENT AEB_AccelerationThreat "" UBYTE autosar_swc_aeb_CM_boolean 0 0 0 1 ECU_ADDRESS 0xfe4a4d4d /* @ECU_Address@AEB_AccelerationThreat@ */ /end MEASUREMENT
/begin MEASUREMENT AEB_CommonInhibit "" UBYTE autosar_swc_aeb_CM_boolean 0 0 0 1 ECU_ADDRESS 0xfe4a4d50 /* @ECU_Address@AEB_CommonInhibit@ */ /end MEASUREMENT
/begin MEASUREMENT AEB_ObjConfOK "" UBYTE autosar_swc_aeb_CM_boolean 0 0 0 1 ECU_ADDRESS 0xfe4a4d53 /* @ECU_Address@AEB_ObjConfOK@ */ /end MEASUREMENT
/begin MEASUREMENT AEB_SteeringThreat "" UBYTE autosar_swc_aeb_CM_boolean 0 0 0 1 ECU_ADDRESS 0xfe4a4d56 /* @ECU_Address@AEB_SteeringThreat@ */ /end MEASUREMENT
/begin MEASUREMENT autosar_swc_aeb_rtARID_DEF.A "" FLOAT32_IEEE autosar_swc_aeb_CM_single 0 0 -3.4E+38 3.4E+38 ECU_ADDRESS 0xfe4ab600 /* @ECU_Address@autosar_swc_aeb_rtARID_DEF.A@ */ /end MEASUREMENT
/begin MEASUREMENT autosar_swc_aeb_rtARID_DEF.CurvatureRate "" FLOAT32_IEEE autosar_swc_aeb_CM_single 0 0 -3.4E+38 3.4E+38 ECU_ADDRESS 0xfe4ab610 /* @ECU_Address@autosar_swc_aeb_rtARID_DEF.CurvatureRate@ */ /end MEASUREMENT
/begin MEASUREMENT autosar_swc_aeb_rtARID_DEF.Curvature_j "" FLOAT32_IEEE autosar_swc_aeb_CM_single 0 0 -3.4E+38 3.4E+38 ECU_ADDRESS 0xfe4ab60c /* @ECU_Address@autosar_swc_aeb_rtARID_DEF.Curvature_j@ */ /end MEASUREMENT
/begin MEASUREMENT autosar_swc_aeb_rtARID_DEF.Curvature_m "" FLOAT32_IEEE autosar_swc_aeb_CM_single 0 0 -3.4E+38 3.4E+38 LAYOUT COLUMN_DIR MATRIX_DIM 4 ECU_ADDRESS 0xfe4aa560 /* @ECU_Address@autosar_swc_aeb_rtARID_DEF.Curvature_m@ */ /end MEASUREMENT
/begin MEASUREMENT autosar_swc_aeb_rtARID_DEF.Deactivation "" UBYTE autosar_swc_aeb_CM_logical 0 0 0 1 ECU_ADDRESS 0xfe4abab9 /* @ECU_Address@autosar_swc_aeb_rtARID_DEF.Deactivation@ */ /end MEASUREMENT
/begin MEASUREMENT autosar_swc_aeb_rtARID_DEF.Delay1_DSTATE_b "" FLOAT32_IEEE autosar_swc_aeb_CM_single 0 0 -3.4E+38 3.4E+38 LAYOUT COLUMN_DIR MATRIX_DIM 2 ECU_ADDRESS 0xfe4aa620 /* @ECU_Address@autosar_swc_aeb_rtARID_DEF.Delay1_DSTATE_b@ */ /end MEASUREMENT
/begin MEASUREMENT autosar_swc_aeb_rtARID_DEF.Delay1_DSTATE_d "" FLOAT32_IEEE autosar_swc_aeb_CM_single 0 0 -3.4E+38 3.4E+38 ECU_ADDRESS 0xfe4ab848 /* @ECU_Address@autosar_swc_aeb_rtARID_DEF.Delay1_DSTATE_d@ */ /end MEASUREMENT
/begin MEASUREMENT autosar_swc_aeb_rtARID_DEF.Delay1_DSTATE_l "" FLOAT32_IEEE autosar_swc_aeb_CM_single 0 0 -3.4E+38 3.4E+38 LAYOUT COLUMN_DIR MATRIX_DIM 2 ECU_ADDRESS 0xfe4aa610 /* @ECU_Address@autosar_swc_aeb_rtARID_DEF.Delay1_DSTATE_l@ */ /end MEASUREMENT
/begin MEASUREMENT autosar_swc_aeb_rtARID_DEF.Delay3_DSTATE_g "" FLOAT32_IEEE autosar_swc_aeb_CM_single 0 0 -3.4E+38 3.4E+38 ECU_ADDRESS 0xfe4ab814 /* @ECU_Address@autosar_swc_aeb_rtARID_DEF.Delay3_DSTATE_g@ */ /end MEASUREMENT
/begin MEASUREMENT autosar_swc_aeb_rtARID_DEF.Delay3_DSTATE_j "" FLOAT32_IEEE autosar_swc_aeb_CM_single 0 0 -3.4E+38 3.4E+38 ECU_ADDRESS 0xfe4ab878 /* @ECU_Address@autosar_swc_aeb_rtARID_DEF.Delay3_DSTATE_j@ */ /end MEASUREMENT
/begin MEASUREMENT autosar_swc_aeb_rtARID_DEF.Delay5_DSTATE_c "" FLOAT32_IEEE autosar_swc_aeb_CM_single 0 0 -3.4E+38 3.4E+38 LAYOUT COLUMN_DIR MATRIX_DIM 2 ECU_ADDRESS 0xfe4aa618 /* @ECU_Address@autosar_swc_aeb_rtARID_DEF.Delay5_DSTATE_c@ */ /end MEASUREMENT
/begin MEASUREMENT autosar_swc_aeb_rtARID_DEF.Delay5_DSTATE_n "" FLOAT32_IEEE autosar_swc_aeb_CM_single 0 0 -3.4E+38 3.4E+38 LAYOUT COLUMN_DIR MATRIX_DIM 2 ECU_ADDRESS 0xfe4aa628 /* @ECU_Address@autosar_swc_aeb_rtARID_DEF.Delay5_DSTATE_n@ */ /end MEASUREMENT
/begin MEASUREMENT autosar_swc_aeb_rtARID_DEF.DelayInput1_DSTATE "" UBYTE autosar_swc_aeb_CM_logical 0 0 0 1 ECU_ADDRESS 0xfe4abac3 /* @ECU_Address@autosar_swc_aeb_rtARID_DEF.DelayInput1_DSTATE@ */ /end MEASUREMENT
/begin MEASUREMENT autosar_swc_aeb_rtARID_DEF.DelayInput1_DSTATE_b "" UBYTE autosar_swc_aeb_CM_logical 0 0 0 1 ECU_ADDRESS 0xfe4abacb /* @ECU_Address@autosar_swc_aeb_rtARID_DEF.DelayInput1_DSTATE_b@ */ /end MEASUREMENT
/begin MEASUREMENT autosar_swc_aeb_rtARID_DEF.DelayInput1_DSTATE_c "" UBYTE autosar_swc_aeb_CM_logical 0 0 0 1 ECU_ADDRESS 0xfe4abaca /* @ECU_Address@autosar_swc_aeb_rtARID_DEF.DelayInput1_DSTATE_c@ */ /end MEASUREMENT
/begin MEASUREMENT autosar_swc_aeb_rtARID_DEF.DelayInput1_DSTATE_g "" UBYTE autosar_swc_aeb_CM_logical 0 0 0 1 ECU_ADDRESS 0xfe4abac8 /* @ECU_Address@autosar_swc_aeb_rtARID_DEF.DelayInput1_DSTATE_g@ */ /end MEASUREMENT
/begin MEASUREMENT autosar_swc_aeb_rtARID_DEF.DelayInput1_DSTATE_k "" UBYTE autosar_swc_aeb_CM_logical 0 0 0 1 ECU_ADDRESS 0xfe4abad0 /* @ECU_Address@autosar_swc_aeb_rtARID_DEF.DelayInput1_DSTATE_k@ */ /end MEASUREMENT
/begin MEASUREMENT autosar_swc_aeb_rtARID_DEF.DelayInput1_DSTATE_n "" UBYTE autosar_swc_aeb_CM_logical 0 0 0 1 ECU_ADDRESS 0xfe4abac5 /* @ECU_Address@autosar_swc_aeb_rtARID_DEF.DelayInput1_DSTATE_n@ */ /end MEASUREMENT
/begin MEASUREMENT autosar_swc_aeb_rtARID_DEF.Delay_DSTATE_f "" FLOAT32_IEEE autosar_swc_aeb_CM_single 0 0 -3.4E+38 3.4E+38 ECU_ADDRESS 0xfe4ab810 /* @ECU_Address@autosar_swc_aeb_rtARID_DEF.Delay_DSTATE_f@ */ /end MEASUREMENT
/begin MEASUREMENT autosar_swc_aeb_rtARID_DEF.Delay_DSTATE_g "" FLOAT32_IEEE autosar_swc_aeb_CM_single 0 0 -3.4E+38 3.4E+38 ECU_ADDRESS 0xfe4ab844 /* @ECU_Address@autosar_swc_aeb_rtARID_DEF.Delay_DSTATE_g@ */ /end MEASUREMENT
/begin MEASUREMENT autosar_swc_aeb_rtARID_DEF.Delay_DSTATE_id "" FLOAT32_IEEE autosar_swc_aeb_CM_single 0 0 -3.4E+38 3.4E+38 ECU_ADDRESS 0xfe4ab874 /* @ECU_Address@autosar_swc_aeb_rtARID_DEF.Delay_DSTATE_id@ */ /end MEASUREMENT
/begin MEASUREMENT autosar_swc_aeb_rtARID_DEF.HeadingAngle_a "" FLOAT32_IEEE autosar_swc_aeb_CM_single 0 0 -3.4E+38 3.4E+38 ECU_ADDRESS 0xfe4ab61c /* @ECU_Address@autosar_swc_aeb_rtARID_DEF.HeadingAngle_a@ */ /end MEASUREMENT
/begin MEASUREMENT autosar_swc_aeb_rtARID_DEF.HeadingAngle_b "" FLOAT32_IEEE autosar_swc_aeb_CM_single 0 0 -3.4E+38 3.4E+38 LAYOUT COLUMN_DIR MATRIX_DIM 4 ECU_ADDRESS 0xfe4aa550 /* @ECU_Address@autosar_swc_aeb_rtARID_DEF.HeadingAngle_b@ */ /end MEASUREMENT
/begin MEASUREMENT autosar_swc_aeb_rtARID_DEF.IntvDur "" FLOAT32_IEEE autosar_swc_aeb_CM_single 0 0 -3.4E+38 3.4E+38 ECU_ADDRESS 0xfe4ab638 /* @ECU_Address@autosar_swc_aeb_rtARID_DEF.IntvDur@ */ /end MEASUREMENT
/begin MEASUREMENT autosar_swc_aeb_rtARID_DEF.IntvDurPrevious "" FLOAT32_IEEE autosar_swc_aeb_CM_single 0 0 -3.4E+38 3.4E+38 ECU_ADDRESS 0xfe4ab93c /* @ECU_Address@autosar_swc_aeb_rtARID_DEF.IntvDurPrevious@ */ /end MEASUREMENT
/begin MEASUREMENT autosar_swc_aeb_rtARID_DEF.LateralStoppingDistance "" FLOAT32_IEEE autosar_swc_aeb_CM_single 0 0 -3.4E+38 3.4E+38 ECU_ADDRESS 0xfe4ab604 /* @ECU_Address@autosar_swc_aeb_rtARID_DEF.LateralStoppingDistance@ */ /end MEASUREMENT
/begin MEASUREMENT autosar_swc_aeb_rtARID_DEF.LongitudinalStoppingDistance "" FLOAT32_IEEE autosar_swc_aeb_CM_single 0 0 -3.4E+38 3.4E+38 ECU_ADDRESS 0xfe4ab608 /* @ECU_Address@autosar_swc_aeb_rtARID_DEF.LongitudinalStoppingDistance@ */ /end MEASUREMENT
/begin MEASUREMENT autosar_swc_aeb_rtARID_DEF.Memory_PreviousInput_b "" UBYTE autosar_swc_aeb_CM_logical 0 0 0 1 ECU_ADDRESS 0xfe4abad9 /* @ECU_Address@autosar_swc_aeb_rtARID_DEF.Memory_PreviousInput_b@ */ /end MEASUREMENT
/begin MEASUREMENT autosar_swc_aeb_rtARID_DEF.Memory_PreviousInput_c "" UBYTE autosar_swc_aeb_CM_logical 0 0 0 1 ECU_ADDRESS 0xfe4abad6 /* @ECU_Address@autosar_swc_aeb_rtARID_DEF.Memory_PreviousInput_c@ */ /end MEASUREMENT
/begin MEASUREMENT autosar_swc_aeb_rtARID_DEF.Memory_PreviousInput_d "" UBYTE autosar_swc_aeb_CM_logical 0 0 0 1 ECU_ADDRESS 0xfe4abad7 /* @ECU_Address@autosar_swc_aeb_rtARID_DEF.Memory_PreviousInput_d@ */ /end MEASUREMENT
/begin MEASUREMENT autosar_swc_aeb_rtARID_DEF.Memory_PreviousInput_h "" UBYTE autosar_swc_aeb_CM_logical 0 0 0 1 ECU_ADDRESS 0xfe4abad4 /* @ECU_Address@autosar_swc_aeb_rtARID_DEF.Memory_PreviousInput_h@ */ /end MEASUREMENT
/begin MEASUREMENT autosar_swc_aeb_rtARID_DEF.Memory_PreviousInput_hz "" UBYTE autosar_swc_aeb_CM_logical 0 0 0 1 ECU_ADDRESS 0xfe4abad5 /* @ECU_Address@autosar_swc_aeb_rtARID_DEF.Memory_PreviousInput_hz@ */ /end MEASUREMENT
/begin MEASUREMENT autosar_swc_aeb_rtARID_DEF.Memory_PreviousInput_ph "" UBYTE autosar_swc_aeb_CM_logical 0 0 0 1 ECU_ADDRESS 0xfe4abad8 /* @ECU_Address@autosar_swc_aeb_rtARID_DEF.Memory_PreviousInput_ph@ */ /end MEASUREMENT
/begin MEASUREMENT autosar_swc_aeb_rtARID_DEF.NotTAP "" UBYTE autosar_swc_aeb_CM_logical 0 0 0 1 ECU_ADDRESS 0xfe4abab6 /* @ECU_Address@autosar_swc_aeb_rtARID_DEF.NotTAP@ */ /end MEASUREMENT
/begin MEASUREMENT autosar_swc_aeb_rtARID_DEF.P3Lateral "" FLOAT32_IEEE autosar_swc_aeb_CM_single 0 0 -3.4E+38 3.4E+38 ECU_ADDRESS 0xfe4ab624 /* @ECU_Address@autosar_swc_aeb_rtARID_DEF.P3Lateral@ */ /end MEASUREMENT
/begin MEASUREMENT autosar_swc_aeb_rtARID_DEF.P3Longitudinal "" FLOAT32_IEEE autosar_swc_aeb_CM_single 0 0 -3.4E+38 3.4E+38 ECU_ADDRESS 0xfe4ab620 /* @ECU_Address@autosar_swc_aeb_rtARID_DEF.P3Longitudinal@ */ /end MEASUREMENT
/begin MEASUREMENT autosar_swc_aeb_rtARID_DEF.PositionLateral "" FLOAT32_IEEE autosar_swc_aeb_CM_single 0 0 -3.4E+38 3.4E+38 ECU_ADDRESS 0xfe4ab614 /* @ECU_Address@autosar_swc_aeb_rtARID_DEF.PositionLateral@ */ /end MEASUREMENT
/begin MEASUREMENT autosar_swc_aeb_rtARID_DEF.PositionLongitudinal "" FLOAT32_IEEE autosar_swc_aeb_CM_single 0 0 -3.4E+38 3.4E+38 ECU_ADDRESS 0xfe4ab618 /* @ECU_Address@autosar_swc_aeb_rtARID_DEF.PositionLongitudinal@ */ /end MEASUREMENT
/begin MEASUREMENT autosar_swc_aeb_rtARID_DEF.SpeedAtIntervention_j "" FLOAT32_IEEE autosar_swc_aeb_CM_single 0 0 -3.4E+38 3.4E+38 ECU_ADDRESS 0xfe4ab944 /* @ECU_Address@autosar_swc_aeb_rtARID_DEF.SpeedAtIntervention_j@ */ /end MEASUREMENT
/begin MEASUREMENT autosar_swc_aeb_rtARID_DEF.SpeedRedPrevious_pd "" FLOAT32_IEEE autosar_swc_aeb_CM_single 0 0 -3.4E+38 3.4E+38 ECU_ADDRESS 0xfe4ab948 /* @ECU_Address@autosar_swc_aeb_rtARID_DEF.SpeedRedPrevious_pd@ */ /end MEASUREMENT
/begin MEASUREMENT autosar_swc_aeb_rtARID_DEF.SpeedReduction_m "" FLOAT32_IEEE autosar_swc_aeb_CM_single 0 0 -3.4E+38 3.4E+38 ECU_ADDRESS 0xfe4ab63c /* @ECU_Address@autosar_swc_aeb_rtARID_DEF.SpeedReduction_m@ */ /end MEASUREMENT
/begin MEASUREMENT autosar_swc_aeb_rtARID_DEF.Speed_k "" FLOAT32_IEEE autosar_swc_aeb_CM_single 0 0 -3.4E+38 3.4E+38 ECU_ADDRESS 0xfe4ab5fc /* @ECU_Address@autosar_swc_aeb_rtARID_DEF.Speed_k@ */ /end MEASUREMENT
/begin MEASUREMENT autosar_swc_aeb_rtARID_DEF.Speed_p "" FLOAT32_IEEE autosar_swc_aeb_CM_single 0 0 -3.4E+38 3.4E+38 LAYOUT COLUMN_DIR MATRIX_DIM 4 ECU_ADDRESS 0xfe4aa540 /* @ECU_Address@autosar_swc_aeb_rtARID_DEF.Speed_p@ */ /end MEASUREMENT
/begin MEASUREMENT autosar_swc_aeb_rtARID_DEF.StopsWithinSegment "" UBYTE autosar_swc_aeb_CM_logical 0 0 0 1 ECU_ADDRESS 0xfe4abab8 /* @ECU_Address@autosar_swc_aeb_rtARID_DEF.StopsWithinSegment@ */ /end MEASUREMENT
/begin MEASUREMENT autosar_swc_aeb_rtARID_DEF.Threat "" UBYTE autosar_swc_aeb_CM_uint8 0 0 0 255 ECU_ADDRESS 0xfe4aba48 /* @ECU_Address@autosar_swc_aeb_rtARID_DEF.Threat@ */ /end MEASUREMENT
/begin MEASUREMENT autosar_swc_aeb_rtARID_DEF.TimeConfidence "" FLOAT32_IEEE autosar_swc_aeb_CM_single 0 0 -3.4E+38 3.4E+38 ECU_ADDRESS 0xfe4ab930 /* @ECU_Address@autosar_swc_aeb_rtARID_DEF.TimeConfidence@ */ /end MEASUREMENT
/begin MEASUREMENT autosar_swc_aeb_rtARID_DEF.TimeNoIntervention_i "" FLOAT32_IEEE autosar_swc_aeb_CM_single 0 0 -3.4E+38 3.4E+38 ECU_ADDRESS 0xfe4ab940 /* @ECU_Address@autosar_swc_aeb_rtARID_DEF.TimeNoIntervention_i@ */ /end MEASUREMENT
/begin MEASUREMENT autosar_swc_aeb_rtARID_DEF.TimeNoIntervention_l "" FLOAT32_IEEE autosar_swc_aeb_CM_single 0 0 -3.4E+38 3.4E+38 ECU_ADDRESS 0xfe4ab938 /* @ECU_Address@autosar_swc_aeb_rtARID_DEF.TimeNoIntervention_l@ */ /end MEASUREMENT
/begin MEASUREMENT autosar_swc_aeb_rtARID_DEF.TimePendingDeactivation "" FLOAT32_IEEE autosar_swc_aeb_CM_single 0 0 -3.4E+38 3.4E+38 ECU_ADDRESS 0xfe4ab934 /* @ECU_Address@autosar_swc_aeb_rtARID_DEF.TimePendingDeactivation@ */ /end MEASUREMENT
/begin MEASUREMENT autosar_swc_aeb_rtARID_DEF.TimeThreat "" FLOAT32_IEEE autosar_swc_aeb_CM_single 0 0 -3.4E+38 3.4E+38 ECU_ADDRESS 0xfe4ab92c /* @ECU_Address@autosar_swc_aeb_rtARID_DEF.TimeThreat@ */ /end MEASUREMENT
/begin MEASUREMENT autosar_swc_aeb_rtARID_DEF.UD_1_DSTATE_a "" FLOAT32_IEEE autosar_swc_aeb_CM_single 0 0 -3.4E+38 3.4E+38 ECU_ADDRESS 0xfe4ab7f0 /* @ECU_Address@autosar_swc_aeb_rtARID_DEF.UD_1_DSTATE_a@ */ /end MEASUREMENT
/begin MEASUREMENT autosar_swc_aeb_rtARID_DEF.UD_1_DSTATE_c "" UWORD autosar_swc_aeb_CM_uint16 0 0 0 65535 ECU_ADDRESS 0xfe4ab9f8 /* @ECU_Address@autosar_swc_aeb_rtARID_DEF.UD_1_DSTATE_c@ */ /end MEASUREMENT
/begin MEASUREMENT autosar_swc_aeb_rtARID_DEF.UD_1_DSTATE_e "" UWORD autosar_swc_aeb_CM_uint16 0 0 0 65535 ECU_ADDRESS 0xfe4aba04 /* @ECU_Address@autosar_swc_aeb_rtARID_DEF.UD_1_DSTATE_e@ */ /end MEASUREMENT
/begin MEASUREMENT autosar_swc_aeb_rtARID_DEF.UD_1_DSTATE_f "" UWORD autosar_swc_aeb_CM_uint16 0 0 0 65535 ECU_ADDRESS 0xfe4aba00 /* @ECU_Address@autosar_swc_aeb_rtARID_DEF.UD_1_DSTATE_f@ */ /end MEASUREMENT
/begin MEASUREMENT autosar_swc_aeb_rtARID_DEF.UD_1_DSTATE_g3 "" UWORD autosar_swc_aeb_CM_uint16 0 0 0 65535 ECU_ADDRESS 0xfe4aba02 /* @ECU_Address@autosar_swc_aeb_rtARID_DEF.UD_1_DSTATE_g3@ */ /end MEASUREMENT
/begin MEASUREMENT autosar_swc_aeb_rtARID_DEF.UD_1_DSTATE_j "" UWORD autosar_swc_aeb_CM_uint16 0 0 0 65535 ECU_ADDRESS 0xfe4ab9f6 /* @ECU_Address@autosar_swc_aeb_rtARID_DEF.UD_1_DSTATE_j@ */ /end MEASUREMENT
/begin MEASUREMENT autosar_swc_aeb_rtARID_DEF.UD_1_DSTATE_l "" UWORD autosar_swc_aeb_CM_uint16 0 0 0 65535 ECU_ADDRESS 0xfe4ab9fa /* @ECU_Address@autosar_swc_aeb_rtARID_DEF.UD_1_DSTATE_l@ */ /end MEASUREMENT
/begin MEASUREMENT autosar_swc_aeb_rtARID_DEF.UD_1_DSTATE_l1 "" UWORD autosar_swc_aeb_CM_uint16 0 0 0 65535 ECU_ADDRESS 0xfe4ab9fc /* @ECU_Address@autosar_swc_aeb_rtARID_DEF.UD_1_DSTATE_l1@ */ /end MEASUREMENT
/begin MEASUREMENT autosar_swc_aeb_rtARID_DEF.UD_1_DSTATE_p "" UWORD autosar_swc_aeb_CM_uint16 0 0 0 65535 ECU_ADDRESS 0xfe4ab9fe /* @ECU_Address@autosar_swc_aeb_rtARID_DEF.UD_1_DSTATE_p@ */ /end MEASUREMENT
/begin MEASUREMENT autosar_swc_aeb_rtARID_DEF.UnitDelay1_DSTATE_e "" UBYTE autosar_swc_aeb_CM_logical 0 0 0 1 ECU_ADDRESS 0xfe4abad2 /* @ECU_Address@autosar_swc_aeb_rtARID_DEF.UnitDelay1_DSTATE_e@ */ /end MEASUREMENT
/begin MEASUREMENT autosar_swc_aeb_rtARID_DEF.UnitDelay1_DSTATE_g "" FLOAT32_IEEE autosar_swc_aeb_CM_single 0 0 -3.4E+38 3.4E+38 ECU_ADDRESS 0xfe4ab8d8 /* @ECU_Address@autosar_swc_aeb_rtARID_DEF.UnitDelay1_DSTATE_g@ */ /end MEASUREMENT
/begin MEASUREMENT autosar_swc_aeb_rtARID_DEF.UnitDelay1_DSTATE_gl "" ULONG autosar_swc_aeb_CM_uint32 0 0 0 4294967295 ECU_ADDRESS 0xfe4ab9e8 /* @ECU_Address@autosar_swc_aeb_rtARID_DEF.UnitDelay1_DSTATE_gl@ */ /end MEASUREMENT
/begin MEASUREMENT autosar_swc_aeb_rtARID_DEF.UnitDelay1_DSTATE_m "" FLOAT32_IEEE autosar_swc_aeb_CM_single 0 0 -3.4E+38 3.4E+38 ECU_ADDRESS 0xfe4ab830 /* @ECU_Address@autosar_swc_aeb_rtARID_DEF.UnitDelay1_DSTATE_m@ */ /end MEASUREMENT
/begin MEASUREMENT autosar_swc_aeb_rtARID_DEF.UnitDelay2_DSTATE_j "" FLOAT32_IEEE autosar_swc_aeb_CM_single 0 0 -3.4E+38 3.4E+38 ECU_ADDRESS 0xfe4ab834 /* @ECU_Address@autosar_swc_aeb_rtARID_DEF.UnitDelay2_DSTATE_j@ */ /end MEASUREMENT
/begin MEASUREMENT autosar_swc_aeb_rtARID_DEF.UnitDelay2_DSTATE_nj "" UBYTE autosar_swc_aeb_CM_logical 0 0 0 1 ECU_ADDRESS 0xfe4abacc /* @ECU_Address@autosar_swc_aeb_rtARID_DEF.UnitDelay2_DSTATE_nj@ */ /end MEASUREMENT
/begin MEASUREMENT autosar_swc_aeb_rtARID_DEF.UnitDelay_DSTATE_b "" FLOAT32_IEEE autosar_swc_aeb_CM_single 0 0 -3.4E+38 3.4E+38 ECU_ADDRESS 0xfe4ab820 /* @ECU_Address@autosar_swc_aeb_rtARID_DEF.UnitDelay_DSTATE_b@ */ /end MEASUREMENT
/begin MEASUREMENT autosar_swc_aeb_rtARID_DEF.UnitDelay_DSTATE_b2 "" FLOAT32_IEEE autosar_swc_aeb_CM_single 0 0 -3.4E+38 3.4E+38 ECU_ADDRESS 0xfe4ab838 /* @ECU_Address@autosar_swc_aeb_rtARID_DEF.UnitDelay_DSTATE_b2@ */ /end MEASUREMENT
/begin MEASUREMENT autosar_swc_aeb_rtARID_DEF.UnitDelay_DSTATE_bh "" UBYTE autosar_swc_aeb_CM_logical 0 0 0 1 ECU_ADDRESS 0xfe4abac9 /* @ECU_Address@autosar_swc_aeb_rtARID_DEF.UnitDelay_DSTATE_bh@ */ /end MEASUREMENT
/begin MEASUREMENT autosar_swc_aeb_rtARID_DEF.UnitDelay_DSTATE_c "" UBYTE autosar_swc_aeb_CM_logical 0 0 0 1 ECU_ADDRESS 0xfe4abac4 /* @ECU_Address@autosar_swc_aeb_rtARID_DEF.UnitDelay_DSTATE_c@ */ /end MEASUREMENT
/begin MEASUREMENT autosar_swc_aeb_rtARID_DEF.UnitDelay_DSTATE_e "" FLOAT32_IEEE autosar_swc_aeb_CM_single 0 0 -3.4E+38 3.4E+38 ECU_ADDRESS 0xfe4ab840 /* @ECU_Address@autosar_swc_aeb_rtARID_DEF.UnitDelay_DSTATE_e@ */ /end MEASUREMENT
/begin MEASUREMENT autosar_swc_aeb_rtARID_DEF.UnitDelay_DSTATE_ga "" UBYTE autosar_swc_aeb_CM_logical 0 0 0 1 ECU_ADDRESS 0xfe4abac6 /* @ECU_Address@autosar_swc_aeb_rtARID_DEF.UnitDelay_DSTATE_ga@ */ /end MEASUREMENT
/begin MEASUREMENT autosar_swc_aeb_rtARID_DEF.UnitDelay_DSTATE_gz "" UBYTE autosar_swc_aeb_CM_logical 0 0 0 1 ECU_ADDRESS 0xfe4abac2 /* @ECU_Address@autosar_swc_aeb_rtARID_DEF.UnitDelay_DSTATE_gz@ */ /end MEASUREMENT
/begin MEASUREMENT autosar_swc_aeb_rtARID_DEF.UnitDelay_DSTATE_h "" FLOAT32_IEEE autosar_swc_aeb_CM_single 0 0 -3.4E+38 3.4E+38 ECU_ADDRESS 0xfe4ab88c /* @ECU_Address@autosar_swc_aeb_rtARID_DEF.UnitDelay_DSTATE_h@ */ /end MEASUREMENT
/begin MEASUREMENT autosar_swc_aeb_rtARID_DEF.UnitDelay_DSTATE_j "" FLOAT32_IEEE autosar_swc_aeb_CM_single 0 0 -3.4E+38 3.4E+38 ECU_ADDRESS 0xfe4ab81c /* @ECU_Address@autosar_swc_aeb_rtARID_DEF.UnitDelay_DSTATE_j@ */ /end MEASUREMENT
/begin MEASUREMENT autosar_swc_aeb_rtARID_DEF.UnitDelay_DSTATE_js "" FLOAT32_IEEE autosar_swc_aeb_CM_single 0 0 -3.4E+38 3.4E+38 ECU_ADDRESS 0xfe4ab888 /* @ECU_Address@autosar_swc_aeb_rtARID_DEF.UnitDelay_DSTATE_js@ */ /end MEASUREMENT
/begin MEASUREMENT autosar_swc_aeb_rtARID_DEF.UnitDelay_DSTATE_k "" FLOAT32_IEEE autosar_swc_aeb_CM_single 0 0 -3.4E+38 3.4E+38 ECU_ADDRESS 0xfe4ab884 /* @ECU_Address@autosar_swc_aeb_rtARID_DEF.UnitDelay_DSTATE_k@ */ /end MEASUREMENT
/begin MEASUREMENT autosar_swc_aeb_rtARID_DEF.UnitDelay_DSTATE_l "" FLOAT32_IEEE autosar_swc_aeb_CM_single 0 0 -3.4E+38 3.4E+38 ECU_ADDRESS 0xfe4ab83c /* @ECU_Address@autosar_swc_aeb_rtARID_DEF.UnitDelay_DSTATE_l@ */ /end MEASUREMENT
/begin MEASUREMENT autosar_swc_aeb_rtARID_DEF.UnitDelay_DSTATE_m3 "" UBYTE autosar_swc_aeb_CM_logical 0 0 0 1 ECU_ADDRESS 0xfe4abad1 /* @ECU_Address@autosar_swc_aeb_rtARID_DEF.UnitDelay_DSTATE_m3@ */ /end MEASUREMENT
/begin MEASUREMENT autosar_swc_aeb_rtARID_DEF.UnitDelay_DSTATE_my "" FLOAT32_IEEE autosar_swc_aeb_CM_single 0 0 -3.4E+38 3.4E+38 ECU_ADDRESS 0xfe4ab828 /* @ECU_Address@autosar_swc_aeb_rtARID_DEF.UnitDelay_DSTATE_my@ */ /end MEASUREMENT
/begin MEASUREMENT autosar_swc_aeb_rtARID_DEF.UnitDelay_DSTATE_n "" FLOAT32_IEEE autosar_swc_aeb_CM_single 0 0 -3.4E+38 3.4E+38 ECU_ADDRESS 0xfe4ab818 /* @ECU_Address@autosar_swc_aeb_rtARID_DEF.UnitDelay_DSTATE_n@ */ /end MEASUREMENT
/begin MEASUREMENT autosar_swc_aeb_rtARID_DEF.UnitDelay_DSTATE_p "" FLOAT32_IEEE autosar_swc_aeb_CM_single 0 0 -3.4E+38 3.4E+38 ECU_ADDRESS 0xfe4ab82c /* @ECU_Address@autosar_swc_aeb_rtARID_DEF.UnitDelay_DSTATE_p@ */ /end MEASUREMENT
/begin MEASUREMENT autosar_swc_aeb_rtARID_DEF.YawRateSum "" FLOAT32_IEEE autosar_swc_aeb_CM_single 0 0 -3.4E+38 3.4E+38 ECU_ADDRESS 0xfe4ab908 /* @ECU_Address@autosar_swc_aeb_rtARID_DEF.YawRateSum@ */ /end MEASUREMENT
/begin MEASUREMENT autosar_swc_aeb_rtARID_DEF.YawRateVector "" FLOAT32_IEEE autosar_swc_aeb_CM_single 0 0 -3.4E+38 3.4E+38 LAYOUT COLUMN_DIR MATRIX_DIM 160 ECU_ADDRESS 0xfe4aa640 /* @ECU_Address@autosar_swc_aeb_rtARID_DEF.YawRateVector@ */ /end MEASUREMENT
/begin MEASUREMENT autosar_swc_aeb_rtARID_DEF.YawRateVectorIndex "" UWORD autosar_swc_aeb_CM_uint16 0 0 0 65535 ECU_ADDRESS 0xfe4aba0a /* @ECU_Address@autosar_swc_aeb_rtARID_DEF.YawRateVectorIndex@ */ /end MEASUREMENT
/begin MEASUREMENT autosar_swc_aeb_rtARID_DEF.is_IntvDurEval "" UBYTE autosar_swc_aeb_CM_uint8 0 0 0 255 ECU_ADDRESS 0xfe4aba76 /* @ECU_Address@autosar_swc_aeb_rtARID_DEF.is_IntvDurEval@ */ /end MEASUREMENT
/begin MEASUREMENT autosar_swc_aeb_rtARID_DEF.is_SpeedReductionEval_j "" UBYTE autosar_swc_aeb_CM_uint8 0 0 0 255 ECU_ADDRESS 0xfe4aba79 /* @ECU_Address@autosar_swc_aeb_rtARID_DEF.is_SpeedReductionEval_j@ */ /end MEASUREMENT
/begin MEASUREMENT autosar_swc_aeb_rtARID_DEF.is_Threat "" UBYTE autosar_swc_aeb_CM_uint8 0 0 0 255 ECU_ADDRESS 0xfe4aba6f /* @ECU_Address@autosar_swc_aeb_rtARID_DEF.is_Threat@ */ /end MEASUREMENT
/begin MEASUREMENT autosar_swc_aeb_rtARID_DEF.is_ThreatConfirmed "" UBYTE autosar_swc_aeb_CM_uint8 0 0 0 255 ECU_ADDRESS 0xfe4aba70 /* @ECU_Address@autosar_swc_aeb_rtARID_DEF.is_ThreatConfirmed@ */ /end MEASUREMENT
/begin MEASUREMENT autosar_swc_aeb_rtARID_DEF.is_ThreatPreliminary "" UBYTE autosar_swc_aeb_CM_uint8 0 0 0 255 ECU_ADDRESS 0xfe4aba71 /* @ECU_Address@autosar_swc_aeb_rtARID_DEF.is_ThreatPreliminary@ */ /end MEASUREMENT
/begin MEASUREMENT autosar_swc_aeb_rtARID_DEF.is_active_c379_autosar_swc_aeb "" UBYTE autosar_swc_aeb_CM_uint8 0 0 0 255 ECU_ADDRESS 0xfe4aba77 /* @ECU_Address@autosar_swc_aeb_rtARID_DEF.is_active_c379_autosar_swc_aeb@ */ /end MEASUREMENT
/begin MEASUREMENT autosar_swc_aeb_rtARID_DEF.is_active_c380_autosar_swc_aeb "" UBYTE autosar_swc_aeb_CM_uint8 0 0 0 255 ECU_ADDRESS 0xfe4aba74 /* @ECU_Address@autosar_swc_aeb_rtARID_DEF.is_active_c380_autosar_swc_aeb@ */ /end MEASUREMENT
/begin MEASUREMENT autosar_swc_aeb_rtARID_DEF.is_active_c383_autosar_swc_aeb "" UBYTE autosar_swc_aeb_CM_uint8 0 0 0 255 ECU_ADDRESS 0xfe4aba72 /* @ECU_Address@autosar_swc_aeb_rtARID_DEF.is_active_c383_autosar_swc_aeb@ */ /end MEASUREMENT
/begin MEASUREMENT autosar_swc_aeb_rtARID_DEF.is_active_c384_autosar_swc_aeb "" UBYTE autosar_swc_aeb_CM_uint8 0 0 0 255 ECU_ADDRESS 0xfe4aba6d /* @ECU_Address@autosar_swc_aeb_rtARID_DEF.is_active_c384_autosar_swc_aeb@ */ /end MEASUREMENT
/begin MEASUREMENT autosar_swc_aeb_rtARID_DEF.is_c379_autosar_swc_aeb "" UBYTE autosar_swc_aeb_CM_uint8 0 0 0 255 ECU_ADDRESS 0xfe4aba78 /* @ECU_Address@autosar_swc_aeb_rtARID_DEF.is_c379_autosar_swc_aeb@ */ /end MEASUREMENT
/begin MEASUREMENT autosar_swc_aeb_rtARID_DEF.is_c380_autosar_swc_aeb "" UBYTE autosar_swc_aeb_CM_uint8 0 0 0 255 ECU_ADDRESS 0xfe4aba75 /* @ECU_Address@autosar_swc_aeb_rtARID_DEF.is_c380_autosar_swc_aeb@ */ /end MEASUREMENT
/begin MEASUREMENT autosar_swc_aeb_rtARID_DEF.is_c383_autosar_swc_aeb "" UBYTE autosar_swc_aeb_CM_uint8 0 0 0 255 ECU_ADDRESS 0xfe4aba73 /* @ECU_Address@autosar_swc_aeb_rtARID_DEF.is_c383_autosar_swc_aeb@ */ /end MEASUREMENT
/begin MEASUREMENT autosar_swc_aeb_rtARID_DEF.is_c384_autosar_swc_aeb "" UBYTE autosar_swc_aeb_CM_uint8 0 0 0 255 ECU_ADDRESS 0xfe4aba6e /* @ECU_Address@autosar_swc_aeb_rtARID_DEF.is_c384_autosar_swc_aeb@ */ /end MEASUREMENT
/begin AXIS_PTS CMBB_ObjPosLgtForALgtThdForCPTAPreBrakeCllsnRedByBrkg_Ca "" 0xfe507cd8 /* @ECU_Address@CMBB_ObjPosLgtForALgtThdForCPTAPreBrakeCllsnRedByBrkg_Ca@ */ NO_INPUT_QUANTITY Axis_FLOAT32_IEEE 0 autosar_swc_aeb_CM_single_m 12 0.000000 150.000000 /end AXIS_PTS
/begin AXIS_PTS CMBB_ObjPosLgtForALgtThdForFullBrakeCllsnRedByBrkg_Ca "" 0xfe507d08 /* @ECU_Address@CMBB_ObjPosLgtForALgtThdForFullBrakeCllsnRedByBrkg_Ca@ */ NO_INPUT_QUANTITY Axis_FLOAT32_IEEE 0 autosar_swc_aeb_CM_single_m 10 0.000000 50.000000 /end AXIS_PTS
/begin AXIS_PTS CMBB_ObjPosLgtForALgtThdForPreBrakeCllsnRedByBrkg_Ca "" 0xfe507d30 /* @ECU_Address@CMBB_ObjPosLgtForALgtThdForPreBrakeCllsnRedByBrkg_Ca@ */ NO_INPUT_QUANTITY Axis_FLOAT32_IEEE 0 autosar_swc_aeb_CM_single_m 12 0.000000 150.000000 /end AXIS_PTS
/begin AXIS_PTS CMBB_VLgtValCrvtSelfRqrdToStrtIntvForVehMovgToSelf_Ca "" 0xfe507d60 /* @ECU_Address@CMBB_VLgtValCrvtSelfRqrdToStrtIntvForVehMovgToSelf_Ca@ */ NO_INPUT_QUANTITY Axis_FLOAT32_IEEE 0 autosar_swc_aeb_CM_single_m_per_s 8 0.000000 50.000000 /end AXIS_PTS
/begin AXIS_PTS DSE_VLgtValForCrvtTypTblInDrvrStEstimr_Ca "" 0xfe507274 /* @ECU_Address@DSE_VLgtValForCrvtTypTblInDrvrStEstimr_Ca@ */ NO_INPUT_QUANTITY Axis_FLOAT32_IEEE 0 autosar_swc_aeb_CM_single_m_per_s 2 0.000000 100.000000 /end AXIS_PTS
/begin AXIS_PTS P_AEB_FullThreatSpeed "" 0xfe8201a4 /* @ECU_Address@P_AEB_FullThreatSpeed@ */ NO_INPUT_QUANTITY Axis_FLOAT32_IEEE 0 autosar_swc_aeb_CM_single_m_per_s 5 0.000000 200.000000 /end AXIS_PTS
/begin AXIS_PTS P_AEB_PreThreatSpeed "" 0xfe8201cc /* @ECU_Address@P_AEB_PreThreatSpeed@ */ NO_INPUT_QUANTITY Axis_FLOAT32_IEEE 0 autosar_swc_aeb_CM_single_m_per_s 5 0.000000 200.000000 /end AXIS_PTS
/begin COMPU_METHOD autosar_swc_aeb_CM_boolean "Q = V" IDENTICAL "%1.0" "" /end COMPU_METHOD
/begin COMPU_METHOD autosar_swc_aeb_CM_int8_1 "Q = V" IDENTICAL "%3.0" "1" /end COMPU_METHOD
/begin COMPU_METHOD autosar_swc_aeb_CM_logical "Q = V" IDENTICAL "%1.0" "" /end COMPU_METHOD
/begin COMPU_METHOD autosar_swc_aeb_CM_single "Q = V" IDENTICAL "%8.6" "" /end COMPU_METHOD
/begin COMPU_METHOD autosar_swc_aeb_CM_single_1 "Q = V" IDENTICAL "%8.6" "1" /end COMPU_METHOD
/begin COMPU_METHOD autosar_swc_aeb_CM_single_1_per_m "Q = V" IDENTICAL "%8.6" "1/m" /end COMPU_METHOD
/begin COMPU_METHOD autosar_swc_aeb_CM_single_N_per_rad "Q = V" IDENTICAL "%8.6" "N/rad" /end COMPU_METHOD
/begin COMPU_METHOD autosar_swc_aeb_CM_single_kg "Q = V" IDENTICAL "%8.6" "kg" /end COMPU_METHOD
/begin COMPU_METHOD autosar_swc_aeb_CM_single_m "Q = V" IDENTICAL "%8.6" "m" /end COMPU_METHOD
/begin COMPU_METHOD autosar_swc_aeb_CM_single_m_per_s "Q = V" IDENTICAL "%8.6" "m/s" /end COMPU_METHOD
/begin COMPU_METHOD autosar_swc_aeb_CM_single_m_per_s_ "Q = V" IDENTICAL "%8.6" "m/s?" /end COMPU_METHOD
/begin COMPU_METHOD autosar_swc_aeb_CM_single_percent_ "Q = V" IDENTICAL "%8.6" "%" /end COMPU_METHOD
/begin COMPU_METHOD autosar_swc_aeb_CM_single_rad "Q = V" IDENTICAL "%8.6" "rad" /end COMPU_METHOD
/begin COMPU_METHOD autosar_swc_aeb_CM_single_rad_per_s "Q = V" IDENTICAL "%8.6" "rad/s" /end COMPU_METHOD
/begin COMPU_METHOD autosar_swc_aeb_CM_single_s "Q = V" IDENTICAL "%8.6" "s" /end COMPU_METHOD
/begin COMPU_METHOD autosar_swc_aeb_CM_uint16 "Q = V" IDENTICAL "%5.0" "" /end COMPU_METHOD
/begin COMPU_METHOD autosar_swc_aeb_CM_uint32 "Q = V" IDENTICAL "%10.0" "" /end COMPU_METHOD
/begin COMPU_METHOD autosar_swc_aeb_CM_uint8 "Q = V" IDENTICAL "%3.0" "" /end COMPU_METHOD
/begin RECORD_LAYOUT Record_BOOLEAN FNC_VALUES 1 UBYTE COLUMN_DIR DIRECT /end RECORD_LAYOUT
/begin RECORD_LAYOUT Record_FLOAT32_IEEE FNC_VALUES 1 FLOAT32_IEEE COLUMN_DIR DIRECT /end RECORD_LAYOUT
/begin RECORD_LAYOUT Record_SBYTE FNC_VALUES 1 SBYTE COLUMN_DIR DIRECT /end RECORD_LAYOUT
/begin RECORD_LAYOUT Axis_FLOAT32_IEEE AXIS_PTS_X 1 FLOAT32_IEEE INDEX_INCR DIRECT /end RECORD_LAYOUT
/begin GROUP autosar_swc_aeb_autosar_swc_aeb_Step_sys_Subsystem_Reference_AEB_Function_Run_CllsnFwdWarnCtrl_Step_Func_Run_CllsnFwdWarn_Step_FCW_WarningAndBrakeGainManager_BrakePulseWarning_InhibitBrakePulse_LowPassFilterALgt "autosar_swc_aeb/autosar_swc_aeb_Step_sys/Subsystem Reference/AEB Function/Run_CllsnFwdWarnCtrl_Step_Func/Run_CllsnFwdWarn_Step/FCW/WarningAndBrakeGainManager/BrakePulseWarning/InhibitBrakePulse/LowPassFilterALgt"
 /begin REF_MEASUREMENT autosar_swc_aeb_rtARID_DEF.Delay1_DSTATE_b autosar_swc_aeb_rtARID_DEF.Delay3_DSTATE_j autosar_swc_aeb_rtARID_DEF.Delay5_DSTATE_n autosar_swc_aeb_rtARID_DEF.Delay_DSTATE_id /end REF_MEASUREMENT
/end GROUP
/begin GROUP autosar_swc_aeb_autosar_swc_aeb_Step_sys_Subsystem_Reference_AEB_Function_Run_CllsnFwdWarnCtrl_Step_Func_Run_CllsnFwdWarn_Step_ReadableSignalsToAutoSar_FCW "autosar_swc_aeb/autosar_swc_aeb_Step_sys/Subsystem Reference/AEB Function/Run_CllsnFwdWarnCtrl_Step_Func/Run_CllsnFwdWarn_Step/ReadableSignalsToAutoSar_FCW"
 /begin SUB_GROUP autosar_swc_aeb_autosar_swc_aeb_Step_sys_Subsystem_Reference_AEB_Function_Run_CllsnFwdWarnCtrl_Step_Func_Run_CllsnFwdWarn_Step_ReadableSignalsToAutoSar_FCW_BrakeGainOutputHandling autosar_swc_aeb_autosar_swc_aeb_Step_sys_Subsystem_Reference_AEB_Function_Run_CllsnFwdWarnCtrl_Step_Func_Run_CllsnFwdWarn_Step_ReadableSignalsToAutoSar_FCW_OffDelayBlock autosar_swc_aeb_autosar_swc_aeb_Step_sys_Subsystem_Reference_AEB_Function_Run_CllsnFwdWarnCtrl_Step_Func_Run_CllsnFwdWarn_Step_ReadableSignalsToAutoSar_FCW_Rename3 /end SUB_GROUP
 /begin REF_CHARACTERISTIC FCW_CllsnThreatHldTiInCllsnFwdWarn_Ca /end REF_CHARACTERISTIC
/end GROUP
/begin GROUP autosar_swc_aeb_autosar_swc_aeb_Step_sys_Subsystem_Reference_AEB_Function_Run_CllsnFwdWarnCtrl_Step_Func_Run_CllsnFwdWarn_Step_ReadableSignalsToAutoSar_FCW_OffDelayBlock "autosar_swc_aeb/autosar_swc_aeb_Step_sys/Subsystem Reference/AEB Function/Run_CllsnFwdWarnCtrl_Step_Func/Run_CllsnFwdWarn_Step/ReadableSignalsToAutoSar_FCW/OffDelayBlock" /begin REF_MEASUREMENT autosar_swc_aeb_rtARID_DEF.UnitDelay_DSTATE_k /end REF_MEASUREMENT /end GROUP
/begin GROUP autosar_swc_aeb_autosar_swc_aeb_Step_sys_Subsystem_Reference_AEB_Function_Run_CllsnRednByBrkgCtrl_Step_Func "autosar_swc_aeb/autosar_swc_aeb_Step_sys/Subsystem Reference/AEB Function/Run_CllsnRednByBrkgCtrl_Step_Func"
 /begin SUB_GROUP autosar_swc_aeb_autosar_swc_aeb_Step_sys_Subsystem_Reference_AEB_Function_Run_CllsnRednByBrkgCtrl_Step_Func_Run_CllsnRednByBrkg_Step /end SUB_GROUP
/end GROUP
/begin GROUP autosar_swc_aeb_autosar_swc_aeb_Step_sys_Subsystem_Reference_AEB_Function_Run_CllsnRednByBrkgCtrl_Step_Func_Run_CllsnRednByBrkg_Step "autosar_swc_aeb/autosar_swc_aeb_Step_sys/Subsystem Reference/AEB Function/Run_CllsnRednByBrkgCtrl_Step_Func/Run_CllsnRednByBrkg_Step"
 /begin SUB_GROUP autosar_swc_aeb_autosar_swc_aeb_Step_sys_Subsystem_Reference_AEB_Function_Run_CllsnRednByBrkgCtrl_Step_Func_Run_CllsnRednByBrkg_Step_AutoSarToReadableSignalsHostVehicle autosar_swc_aeb_autosar_swc_aeb_Step_sys_Subsystem_Reference_AEB_Function_Run_CllsnRednByBrkgCtrl_Step_Func_Run_CllsnRednByBrkg_Step_CollisionMitigationSystem autosar_swc_aeb_autosar_swc_aeb_Step_sys_Subsystem_Reference_AEB_Function_Run_CllsnRednByBrkgCtrl_Step_Func_Run_CllsnRednByBrkg_Step_CreatePrmBus /end SUB_GROUP
/end GROUP
/begin GROUP autosar_swc_aeb_autosar_swc_aeb_Step_sys_Subsystem_Reference_AEB_Function_Run_CllsnRednByBrkgCtrl_Step_Func_Run_CllsnRednByBrkg_Step_AutoSarToReadableSignalsHostVehicle "autosar_swc_aeb/autosar_swc_aeb_Step_sys/Subsystem Reference/AEB Function/Run_CllsnRednByBrkgCtrl_Step_Func/Run_CllsnRednByBrkg_Step/AutoSarToReadableSignalsHostVehicle"
 /begin SUB_GROUP autosar_swc_aeb_autosar_swc_aeb_Step_sys_Subsystem_Reference_AEB_Function_Run_CllsnRednByBrkgCtrl_Step_Func_Run_CllsnRednByBrkg_Step_AutoSarToReadableSignalsHostVehicle_LowPassFilter /end SUB_GROUP
/end GROUP
/begin GROUP autosar_swc_aeb_autosar_swc_aeb_Step_sys_Subsystem_Reference_AEB_Function_Run_CllsnRednByBrkgCtrl_Step_Func_Run_CllsnRednByBrkg_Step_AutoSarToReadableSignalsHostVehicle_LowPassFilter "autosar_swc_aeb/autosar_swc_aeb_Step_sys/Subsystem Reference/AEB Function/Run_CllsnRednByBrkgCtrl_Step_Func/Run_CllsnRednByBrkg_Step/AutoSarToReadableSignalsHostVehicle/LowPassFilter"
 /begin SUB_GROUP autosar_swc_aeb_autosar_swc_aeb_Step_sys_Subsystem_Reference_AEB_Function_Run_CllsnRednByBrkgCtrl_Step_Func_Run_CllsnRednByBrkg_Step_AutoSarToReadableSignalsHostVehicle_LowPassFilter_LP1_1 /end SUB_GROUP
 /begin REF_CHARACTERISTIC CMBB_PinionAgRateFilConInCllsnRednByBrkg_Ca /end REF_CHARACTERISTIC
/end GROUP
/begin GROUP autosar_swc_aeb_autosar_swc_aeb_Step_sys_Subsystem_Reference_AEB_Function_Run_CllsnRednByBrkgCtrl_Step_Func_Run_CllsnRednByBrkg_Step_AutoSarToReadableSignalsHostVehicle_LowPassFilter_LP1_1 "autosar_swc_aeb/autosar_swc_aeb_Step_sys/Subsystem Reference/AEB Function/Run_CllsnRednByBrkgCtrl_Step_Func/Run_CllsnRednByBrkg_Step/AutoSarToReadableSignalsHostVehicle/LowPassFilter/LP1_1" /begin REF_MEASUREMENT autosar_swc_aeb_rtARID_DEF.UD_1_DSTATE_a /end REF_MEASUREMENT /end GROUP
/begin GROUP autosar_swc_aeb_autosar_swc_aeb_Step_sys_Subsystem_Reference_AEB_Function_Run_CllsnRednByBrkgCtrl_Step_Func_Run_CllsnRednByBrkg_Step_CollisionMitigationSystem "autosar_swc_aeb/autosar_swc_aeb_Step_sys/Subsystem Reference/AEB Function/Run_CllsnRednByBrkgCtrl_Step_Func/Run_CllsnRednByBrkg_Step/CollisionMitigationSystem"
 /begin SUB_GROUP autosar_swc_aeb_autosar_swc_aeb_Step_sys_Subsystem_Reference_AEB_Function_Run_CllsnRednByBrkgCtrl_Step_Func_Run_CllsnRednByBrkg_Step_CollisionMitigationSystem_DetermineCMbBOutput autosar_swc_aeb_autosar_swc_aeb_Step_sys_Subsystem_Reference_AEB_Function_Run_CllsnRednByBrkgCtrl_Step_Func_Run_CllsnRednByBrkg_Step_CollisionMitigationSystem_DetermineCMbBStatus autosar_swc_aeb_autosar_swc_aeb_Step_sys_Subsystem_Reference_AEB_Function_Run_CllsnRednByBrkgCtrl_Step_Func_Run_CllsnRednByBrkg_Step_CollisionMitigationSystem_DetermineQueueOverride autosar_swc_aeb_autosar_swc_aeb_Step_sys_Subsystem_Reference_AEB_Function_Run_CllsnRednByBrkgCtrl_Step_Func_Run_CllsnRednByBrkg_Step_CollisionMitigationSystem_DetermineSteeringOverride autosar_swc_aeb_autosar_swc_aeb_Step_sys_Subsystem_Reference_AEB_Function_Run_CllsnRednByBrkgCtrl_Step_Func_Run_CllsnRednByBrkg_Step_CollisionMitigationSystem_EvaluationCMbBInput autosar_swc_aeb_autosar_swc_aeb_Step_sys_Subsystem_Reference_AEB_Function_Run_CllsnRednByBrkgCtrl_Step_Func_Run_CllsnRednByBrkg_Step_CollisionMitigationSystem_PreProcessor /end SUB_GROUP
 /begin REF_MEASUREMENT autosar_swc_aeb_rtARID_DEF.UnitDelay_DSTATE_h /end REF_MEASUREMENT
/end GROUP
/begin GROUP autosar_swc_aeb_autosar_swc_aeb_Step_sys_Subsystem_Reference_AEB_Function_Run_CllsnRednByBrkgCtrl_Step_Func_Run_CllsnRednByBrkg_Step_CollisionMitigationSystem_DetermineCMbBOutput "autosar_swc_aeb/autosar_swc_aeb_Step_sys/Subsystem Reference/AEB Function/Run_CllsnRednByBrkgCtrl_Step_Func/Run_CllsnRednByBrkg_Step/CollisionMitigationSystem/DetermineCMbBOutput"
 /begin SUB_GROUP autosar_swc_aeb_autosar_swc_aeb_Step_sys_Subsystem_Reference_AEB_Function_Run_CllsnRednByBrkgCtrl_Step_Func_Run_CllsnRednByBrkg_Step_CollisionMitigationSystem_DetermineCMbBOutput_DetermineCMbBRequest autosar_swc_aeb_autosar_swc_aeb_Step_sys_Subsystem_Reference_AEB_Function_Run_CllsnRednByBrkgCtrl_Step_Func_Run_CllsnRednByBrkg_Step_CollisionMitigationSystem_DetermineCMbBOutput_SetMessages /end SUB_GROUP
/end GROUP
/begin GROUP autosar_swc_aeb_autosar_swc_aeb_Step_sys_Subsystem_Reference_AEB_Function_Run_CllsnRednByBrkgCtrl_Step_Func_Run_CllsnRednByBrkg_Step_CollisionMitigationSystem_DetermineCMbBOutput_DetermineCMbBRequest "autosar_swc_aeb/autosar_swc_aeb_Step_sys/Subsystem Reference/AEB Function/Run_CllsnRednByBrkgCtrl_Step_Func/Run_CllsnRednByBrkg_Step/CollisionMitigationSystem/DetermineCMbBOutput/DetermineCMbBRequest"
 /begin SUB_GROUP autosar_swc_aeb_autosar_swc_aeb_Step_sys_Subsystem_Reference_AEB_Function_Run_CllsnRednByBrkgCtrl_Step_Func_Run_CllsnRednByBrkg_Step_CollisionMitigationSystem_DetermineCMbBOutput_DetermineCMbBRequest_DetermineAccelerationRequest autosar_swc_aeb_autosar_swc_aeb_Step_sys_Subsystem_Reference_AEB_Function_Run_CllsnRednByBrkgCtrl_Step_Func_Run_CllsnRednByBrkg_Step_CollisionMitigationSystem_DetermineCMbBOutput_DetermineCMbBRequest_DetermineBeltRequest autosar_swc_aeb_autosar_swc_aeb_Step_sys_Subsystem_Reference_AEB_Function_Run_CllsnRednByBrkgCtrl_Step_Func_Run_CllsnRednByBrkg_Step_CollisionMitigationSystem_DetermineCMbBOutput_DetermineCMbBRequest_DetermineSteeringAssistance /end SUB_GROUP
/end GROUP
/begin GROUP autosar_swc_aeb_autosar_swc_aeb_Step_sys_Subsystem_Reference_AEB_Function_Run_CllsnRednByBrkgCtrl_Step_Func_Run_CllsnRednByBrkg_Step_CollisionMitigationSystem_DetermineCMbBOutput_DetermineCMbBRequest_DetermineAccelerationRequest "autosar_swc_aeb/autosar_swc_aeb_Step_sys/Subsystem Reference/AEB Function/Run_CllsnRednByBrkgCtrl_Step_Func/Run_CllsnRednByBrkg_Step/CollisionMitigationSystem/DetermineCMbBOutput/DetermineCMbBRequest/DetermineAccelerationRequest"
 /begin SUB_GROUP autosar_swc_aeb_autosar_swc_aeb_Step_sys_Subsystem_Reference_AEB_Function_Run_CllsnRednByBrkgCtrl_Step_Func_Run_CllsnRednByBrkg_Step_CollisionMitigationSystem_DetermineCMbBOutput_DetermineCMbBRequest_DetermineAccelerationRequest_DetermineFullBrakeRequest autosar_swc_aeb_autosar_swc_aeb_Step_sys_Subsystem_Reference_AEB_Function_Run_CllsnRednByBrkgCtrl_Step_Func_Run_CllsnRednByBrkg_Step_CollisionMitigationSystem_DetermineCMbBOutput_DetermineCMbBRequest_DetermineAccelerationRequest_DeterminePreBrakeRequest /end SUB_GROUP
 /begin REF_CHARACTERISTIC CMBB_AReqVisnOnlyInCllsnRednByBrkg_Ca /end REF_CHARACTERISTIC
 /begin REF_MEASUREMENT autosar_swc_aeb_rtARID_DEF.Delay1_DSTATE_d /end REF_MEASUREMENT
/end GROUP
/begin GROUP autosar_swc_aeb_autosar_swc_aeb_Step_sys_Subsystem_Reference_AEB_Function_Run_CllsnRednByBrkgCtrl_Step_Func_Run_CllsnRednByBrkg_Step_CollisionMitigationSystem_DetermineCMbBOutput_DetermineCMbBRequest_DetermineAccelerationRequest_DetermineFullBrakeRequest "autosar_swc_aeb/autosar_swc_aeb_Step_sys/Subsystem Reference/AEB Function/Run_CllsnRednByBrkgCtrl_Step_Func/Run_CllsnRednByBrkg_Step/CollisionMitigationSystem/DetermineCMbBOutput/DetermineCMbBRequest/DetermineAccelerationRequest/DetermineFullBrakeRequest"
 /begin SUB_GROUP autosar_swc_aeb_autosar_swc_aeb_Step_sys_Subsystem_Reference_AEB_Function_Run_CllsnRednByBrkgCtrl_Step_Func_Run_CllsnRednByBrkg_Step_CollisionMitigationSystem_DetermineCMbBOutput_DetermineCMbBRequest_DetermineAccelerationRequest_DetermineFullBrakeRequest_AccelReqFilter /end SUB_GROUP
 /begin REF_CHARACTERISTIC CMBB_AMaxReqFullBrkInCllsnRednByBrkg_Co CMBB_AMinReqFullBrkInCllsnRednByBrkg_Ca CMBB_FctJerkInCllsnRednByBrkg_Ca CMBB_JerkMaxFullBrkInCllsnRednByBrkg_Ca CMBB_JerkMinFullBrkInCllsnRednByBrkg_Ca /end REF_CHARACTERISTIC
/end GROUP
/begin GROUP autosar_swc_aeb_autosar_swc_aeb_Step_sys_Subsystem_Reference_AEB_Function_Run_CllsnRednByBrkgCtrl_Step_Func_Run_CllsnRednByBrkg_Step_CollisionMitigationSystem_DetermineCMbBOutput_DetermineCMbBRequest_DetermineAccelerationRequest_DetermineFullBrakeRequest_AccelReqFilter "autosar_swc_aeb/autosar_swc_aeb_Step_sys/Subsystem Reference/AEB Function/Run_CllsnRednByBrkgCtrl_Step_Func/Run_CllsnRednByBrkg_Step/CollisionMitigationSystem/DetermineCMbBOutput/DetermineCMbBRequest/DetermineAccelerationRequest/DetermineFullBrakeRequest/AccelReqFilter"
 /begin REF_CHARACTERISTIC CMBB_DecelReqFiltParam1InCllsnInCllsnRednByBrkg_Ca CMBB_DecelReqFiltParam2InCllsnInCllsnRednByBrkg_Ca CMBB_DecelReqFiltParam3InCllsnInCllsnRednByBrkg_Ca /end REF_CHARACTERISTIC
 /begin REF_MEASUREMENT autosar_swc_aeb_rtARID_DEF.Delay_DSTATE_g /end REF_MEASUREMENT
/end GROUP
/begin GROUP autosar_swc_aeb_autosar_swc_aeb_Step_sys_Subsystem_Reference_AEB_Function_Run_CllsnRednByBrkgCtrl_Step_Func_Run_CllsnRednByBrkg_Step_CollisionMitigationSystem_DetermineCMbBOutput_DetermineCMbBRequest_DetermineAccelerationRequest_DeterminePreBrakeRequest "autosar_swc_aeb/autosar_swc_aeb_Step_sys/Subsystem Reference/AEB Function/Run_CllsnRednByBrkgCtrl_Step_Func/Run_CllsnRednByBrkg_Step/CollisionMitigationSystem/DetermineCMbBOutput/DetermineCMbBRequest/DetermineAccelerationRequest/DeterminePreBrakeRequest"
 /begin SUB_GROUP autosar_swc_aeb_autosar_swc_aeb_Step_sys_Subsystem_Reference_AEB_Function_Run_CllsnRednByBrkgCtrl_Step_Func_Run_CllsnRednByBrkg_Step_CollisionMitigationSystem_DetermineCMbBOutput_DetermineCMbBRequest_DetermineAccelerationRequest_DeterminePreBrakeRequest_SimplePreChargeRequest /end SUB_GROUP
/end GROUP
/begin GROUP autosar_swc_aeb_autosar_swc_aeb_Step_sys_Subsystem_Reference_AEB_Function_Run_CllsnRednByBrkgCtrl_Step_Func_Run_CllsnRednByBrkg_Step_CollisionMitigationSystem_DetermineCMbBOutput_DetermineCMbBRequest_DetermineAccelerationRequest_DeterminePreBrakeRequest_SimplePreChargeRequest "autosar_swc_aeb/autosar_swc_aeb_Step_sys/Subsystem Reference/AEB Function/Run_CllsnRednByBrkgCtrl_Step_Func/Run_CllsnRednByBrkg_Step/CollisionMitigationSystem/DetermineCMbBOutput/DetermineCMbBRequest/DetermineAccelerationRequest/DeterminePreBrakeRequest/SimplePreChargeRequest"
 /begin SUB_GROUP autosar_swc_aeb_autosar_swc_aeb_Step_sys_Subsystem_Reference_AEB_Function_Run_CllsnRednByBrkgCtrl_Step_Func_Run_CllsnRednByBrkg_Step_CollisionMitigationSystem_DetermineCMbBOutput_DetermineCMbBRequest_DetermineAccelerationRequest_DeterminePreBrakeRequest_SimplePreChargeRequest_PreBrakingAccelerationRequest autosar_swc_aeb_autosar_swc_aeb_Step_sys_Subsystem_Reference_AEB_Function_Run_CllsnRednByBrkgCtrl_Step_Func_Run_CllsnRednByBrkg_Step_CollisionMitigationSystem_DetermineCMbBOutput_DetermineCMbBRequest_DetermineAccelerationRequest_DeterminePreBrakeRequest_SimplePreChargeRequest_PreBrkRateLimiter_ /end SUB_GROUP
/end GROUP
/begin GROUP autosar_swc_aeb_autosar_swc_aeb_Step_sys_Subsystem_Reference_AEB_Function_Run_CllsnRednByBrkgCtrl_Step_Func_Run_CllsnRednByBrkg_Step_CollisionMitigationSystem_DetermineCMbBOutput_DetermineCMbBRequest_DetermineAccelerationRequest_DeterminePreBrakeRequest_SimplePreChargeRequest_PreBrakingAccelerationRequest "autosar_swc_aeb/autosar_swc_aeb_Step_sys/Subsystem Reference/AEB Function/Run_CllsnRednByBrkgCtrl_Step_Func/Run_CllsnRednByBrkg_Step/CollisionMitigationSystem/DetermineCMbBOutput/DetermineCMbBRequest/DetermineAccelerationRequest/DeterminePreBrakeRequest/SimplePreChargeRequest/PreBrakingAccelerationRequest"
 /begin REF_CHARACTERISTIC CMBB_AMaxReqPreBrkInCllsnRednByBrkg_Ca CMBB_AMinReqPreBrkInCllsnRednByBrkg_Ca CMBB_FacPreBrkANegLgtReqInCllsnRednByBrkg_Ca /end REF_CHARACTERISTIC
/end GROUP
/begin GROUP autosar_swc_aeb_autosar_swc_aeb_Step_sys_Subsystem_Reference_AEB_Function_Run_CllsnRednByBrkgCtrl_Step_Func_Run_CllsnRednByBrkg_Step_CollisionMitigationSystem_DetermineCMbBOutput_DetermineCMbBRequest_DetermineAccelerationRequest_DeterminePreBrakeRequest_SimplePreChargeRequest_PreBrkRateLimiter_ "autosar_swc_aeb/autosar_swc_aeb_Step_sys/Subsystem Reference/AEB Function/Run_CllsnRednByBrkgCtrl_Step_Func/Run_CllsnRednByBrkg_Step/CollisionMitigationSystem/DetermineCMbBOutput/DetermineCMbBRequest/DetermineAccelerationRequest/DeterminePreBrakeRequest/SimplePreChargeRequest/PreBrkRateLimiter "
 /begin SUB_GROUP autosar_swc_aeb_autosar_swc_aeb_Step_sys_Subsystem_Reference_AEB_Function_Run_CllsnRednByBrkgCtrl_Step_Func_Run_CllsnRednByBrkg_Step_CollisionMitigationSystem_DetermineCMbBOutput_DetermineCMbBRequest_DetermineAccelerationRequest_DeterminePreBrakeRequest_SimplePreChargeRequest_PreBrkRateLimiter__RateLimiter /end SUB_GROUP
 /begin REF_CHARACTERISTIC CMBB_AReqVisnOnlyInCllsnRednByBrkg_Ca CMBB_JerkMinPreBrkInCllsnRednByBrkg_Ca CMBB_JerkMinPreBrkLowConfInCllsnRednByBrkg_Ca /end REF_CHARACTERISTIC
/end GROUP
/begin GROUP autosar_swc_aeb_autosar_swc_aeb_Step_sys_Subsystem_Reference_AEB_Function_Run_CllsnRednByBrkgCtrl_Step_Func_Run_CllsnRednByBrkg_Step_CollisionMitigationSystem_DetermineCMbBOutput_DetermineCMbBRequest_DetermineAccelerationRequest_DeterminePreBrakeRequest_SimplePreChargeRequest_PreBrkRateLimiter__RateLimiter "autosar_swc_aeb/autosar_swc_aeb_Step_sys/Subsystem Reference/AEB Function/Run_CllsnRednByBrkgCtrl_Step_Func/Run_CllsnRednByBrkg_Step/CollisionMitigationSystem/DetermineCMbBOutput/DetermineCMbBRequest/DetermineAccelerationRequest/DeterminePreBrakeRequest/SimplePreChargeRequest/PreBrkRateLimiter /RateLimiter" /begin REF_MEASUREMENT autosar_swc_aeb_rtARID_DEF.UnitDelay_DSTATE_e /end REF_MEASUREMENT /end GROUP
/begin GROUP autosar_swc_aeb_autosar_swc_aeb_Step_sys_Subsystem_Reference_AEB_Function_Run_CllsnRednByBrkgCtrl_Step_Func_Run_CllsnRednByBrkg_Step_CollisionMitigationSystem_DetermineCMbBOutput_DetermineCMbBRequest_DetermineBeltRequest "autosar_swc_aeb/autosar_swc_aeb_Step_sys/Subsystem Reference/AEB Function/Run_CllsnRednByBrkgCtrl_Step_Func/Run_CllsnRednByBrkg_Step/CollisionMitigationSystem/DetermineCMbBOutput/DetermineCMbBRequest/DetermineBeltRequest"
 /begin SUB_GROUP autosar_swc_aeb_autosar_swc_aeb_Step_sys_Subsystem_Reference_AEB_Function_Run_CllsnRednByBrkgCtrl_Step_Func_Run_CllsnRednByBrkg_Step_CollisionMitigationSystem_DetermineCMbBOutput_DetermineCMbBRequest_DetermineBeltRequest_DetermineBeltRequestActivation /end SUB_GROUP
/end GROUP
/begin GROUP autosar_swc_aeb_autosar_swc_aeb_Step_sys_Subsystem_Reference_AEB_Function_Run_CllsnRednByBrkgCtrl_Step_Func_Run_CllsnRednByBrkg_Step_CollisionMitigationSystem_DetermineCMbBOutput_DetermineCMbBRequest_DetermineBeltRequest_DetermineBeltRequestActivation "autosar_swc_aeb/autosar_swc_aeb_Step_sys/Subsystem Reference/AEB Function/Run_CllsnRednByBrkgCtrl_Step_Func/Run_CllsnRednByBrkg_Step/CollisionMitigationSystem/DetermineCMbBOutput/DetermineCMbBRequest/DetermineBeltRequest/DetermineBeltRequestActivation"
 /begin SUB_GROUP autosar_swc_aeb_autosar_swc_aeb_Step_sys_Subsystem_Reference_AEB_Function_Run_CllsnRednByBrkgCtrl_Step_Func_Run_CllsnRednByBrkg_Step_CollisionMitigationSystem_DetermineCMbBOutput_DetermineCMbBRequest_DetermineBeltRequest_DetermineBeltRequestActivation_CheckSpeedsLTAP autosar_swc_aeb_autosar_swc_aeb_Step_sys_Subsystem_Reference_AEB_Function_Run_CllsnRednByBrkgCtrl_Step_Func_Run_CllsnRednByBrkg_Step_CollisionMitigationSystem_DetermineCMbBOutput_DetermineCMbBRequest_DetermineBeltRequest_DetermineBeltRequestActivation_CheckSpeedsRearEnd autosar_swc_aeb_autosar_swc_aeb_Step_sys_Subsystem_Reference_AEB_Function_Run_CllsnRednByBrkgCtrl_Step_Func_Run_CllsnRednByBrkg_Step_CollisionMitigationSystem_DetermineCMbBOutput_DetermineCMbBRequest_DetermineBeltRequest_DetermineBeltRequestActivation_ConfirmationTime autosar_swc_aeb_autosar_swc_aeb_Step_sys_Subsystem_Reference_AEB_Function_Run_CllsnRednByBrkgCtrl_Step_Func_Run_CllsnRednByBrkg_Step_CollisionMitigationSystem_DetermineCMbBOutput_DetermineCMbBRequest_DetermineBeltRequest_DetermineBeltRequestActivation_ForceLevelSelection autosar_swc_aeb_autosar_swc_aeb_Step_sys_Subsystem_Reference_AEB_Function_Run_CllsnRednByBrkgCtrl_Step_Func_Run_CllsnRednByBrkg_Step_CollisionMitigationSystem_DetermineCMbBOutput_DetermineCMbBRequest_DetermineBeltRequest_DetermineBeltRequestActivation_S_R_Flip_Flop autosar_swc_aeb_autosar_swc_aeb_Step_sys_Subsystem_Reference_AEB_Function_Run_CllsnRednByBrkgCtrl_Step_Func_Run_CllsnRednByBrkg_Step_CollisionMitigationSystem_DetermineCMbBOutput_DetermineCMbBRequest_DetermineBeltRequest_DetermineBeltRequestActivation_S_R_Flip_Flop1 autosar_swc_aeb_autosar_swc_aeb_Step_sys_Subsystem_Reference_AEB_Function_Run_CllsnRednByBrkgCtrl_Step_Func_Run_CllsnRednByBrkg_Step_CollisionMitigationSystem_DetermineCMbBOutput_DetermineCMbBRequest_DetermineBeltRequest_DetermineBeltRequestActivation_TimeActive /end SUB_GROUP
 /begin REF_CHARACTERISTIC CMBB_ActvnTiThdForBltReqInCllsnRednByBrkg_Ca /end REF_CHARACTERISTIC
/end GROUP
/begin GROUP autosar_swc_aeb_autosar_swc_aeb_Step_sys_Subsystem_Reference_AEB_Function_Run_CllsnRednByBrkgCtrl_Step_Func_Run_CllsnRednByBrkg_Step_CollisionMitigationSystem_DetermineCMbBOutput_DetermineCMbBRequest_DetermineBeltRequest_DetermineBeltRequestActivation_CheckSpeedsLTAP "autosar_swc_aeb/autosar_swc_aeb_Step_sys/Subsystem Reference/AEB Function/Run_CllsnRednByBrkgCtrl_Step_Func/Run_CllsnRednByBrkg_Step/CollisionMitigationSystem/DetermineCMbBOutput/DetermineCMbBRequest/DetermineBeltRequest/DetermineBeltRequestActivation/CheckSpeedsLTAP"
 /begin REF_CHARACTERISTIC CMBB_SpdTarForOncomingBltActvnInCllsnRednByBrkg_Ca CMBB_VehSpdForOncomingBltActvnInCllsnRednByBrkg_Ca /end REF_CHARACTERISTIC
/end GROUP
/begin GROUP autosar_swc_aeb_autosar_swc_aeb_Step_sys_Subsystem_Reference_AEB_Function_Run_CllsnRednByBrkgCtrl_Step_Func_Run_CllsnRednByBrkg_Step_CollisionMitigationSystem_DetermineCMbBOutput_DetermineCMbBRequest_DetermineBeltRequest_DetermineBeltRequestActivation_CheckSpeedsRearEnd "autosar_swc_aeb/autosar_swc_aeb_Step_sys/Subsystem Reference/AEB Function/Run_CllsnRednByBrkgCtrl_Step_Func/Run_CllsnRednByBrkg_Step/CollisionMitigationSystem/DetermineCMbBOutput/DetermineCMbBRequest/DetermineBeltRequest/DetermineBeltRequestActivation/CheckSpeedsRearEnd"
 /begin REF_CHARACTERISTIC CMBB_VLgtRelThdForBltReqWithActvnFHiInCllsnRednByBrkg_Ca CMBB_VehSpdThdForBltReqWithActvnFHiInCllsnRednByBrkg_Ca /end REF_CHARACTERISTIC
/end GROUP
/begin GROUP autosar_swc_aeb_autosar_swc_aeb_Step_sys_Subsystem_Reference_AEB_Function_Run_CllsnRednByBrkgCtrl_Step_Func_Run_CllsnRednByBrkg_Step_CollisionMitigationSystem_DetermineCMbBOutput_DetermineCMbBRequest_DetermineBeltRequest_DetermineBeltRequestActivation_ConfirmationTime "autosar_swc_aeb/autosar_swc_aeb_Step_sys/Subsystem Reference/AEB Function/Run_CllsnRednByBrkgCtrl_Step_Func/Run_CllsnRednByBrkg_Step/CollisionMitigationSystem/DetermineCMbBOutput/DetermineCMbBRequest/DetermineBeltRequest/DetermineBeltRequestActivation/ConfirmationTime"
 /begin SUB_GROUP autosar_swc_aeb_autosar_swc_aeb_Step_sys_Subsystem_Reference_AEB_Function_Run_CllsnRednByBrkgCtrl_Step_Func_Run_CllsnRednByBrkg_Step_CollisionMitigationSystem_DetermineCMbBOutput_DetermineCMbBRequest_DetermineBeltRequest_DetermineBeltRequestActivation_ConfirmationTime_TimeActive /end SUB_GROUP
 /begin REF_CHARACTERISTIC CMBB_BltTiDlyToActvtInCllsnRednByBrkg_Ca /end REF_CHARACTERISTIC
/end GROUP
/begin GROUP autosar_swc_aeb_autosar_swc_aeb_Step_sys_Subsystem_Reference_AEB_Function_Run_CllsnRednByBrkgCtrl_Step_Func_Run_CllsnRednByBrkg_Step_CollisionMitigationSystem_DetermineCMbBOutput_DetermineCMbBRequest_DetermineBeltRequest_DetermineBeltRequestActivation_ConfirmationTime_TimeActive "autosar_swc_aeb/autosar_swc_aeb_Step_sys/Subsystem Reference/AEB Function/Run_CllsnRednByBrkgCtrl_Step_Func/Run_CllsnRednByBrkg_Step/CollisionMitigationSystem/DetermineCMbBOutput/DetermineCMbBRequest/DetermineBeltRequest/DetermineBeltRequestActivation/ConfirmationTime/TimeActive"
 /begin SUB_GROUP autosar_swc_aeb_autosar_swc_aeb_Step_sys_Subsystem_Reference_AEB_Function_Run_CllsnRednByBrkgCtrl_Step_Func_Run_CllsnRednByBrkg_Step_CollisionMitigationSystem_DetermineCMbBOutput_DetermineCMbBRequest_DetermineBeltRequest_DetermineBeltRequestActivation_ConfirmationTime_TimeActive_HICNTR_1 /end SUB_GROUP
/end GROUP
/begin GROUP autosar_swc_aeb_autosar_swc_aeb_Step_sys_Subsystem_Reference_AEB_Function_Run_CllsnRednByBrkgCtrl_Step_Func_Run_CllsnRednByBrkg_Step_CollisionMitigationSystem_DetermineCMbBOutput_DetermineCMbBRequest_DetermineBeltRequest_DetermineBeltRequestActivation_ConfirmationTime_TimeActive_HICNTR_1 "autosar_swc_aeb/autosar_swc_aeb_Step_sys/Subsystem Reference/AEB Function/Run_CllsnRednByBrkgCtrl_Step_Func/Run_CllsnRednByBrkg_Step/CollisionMitigationSystem/DetermineCMbBOutput/DetermineCMbBRequest/DetermineBeltRequest/DetermineBeltRequestActivation/ConfirmationTime/TimeActive/HICNTR_1" /begin REF_MEASUREMENT autosar_swc_aeb_rtARID_DEF.UD_1_DSTATE_g3 /end REF_MEASUREMENT /end GROUP
/begin GROUP autosar_swc_aeb_autosar_swc_aeb_Step_sys_Subsystem_Reference_AEB_Function_Run_CllsnRednByBrkgCtrl_Step_Func_Run_CllsnRednByBrkg_Step_CollisionMitigationSystem_DetermineCMbBOutput_DetermineCMbBRequest_DetermineBeltRequest_DetermineBeltRequestActivation_ForceLevelSelection "autosar_swc_aeb/autosar_swc_aeb_Step_sys/Subsystem Reference/AEB Function/Run_CllsnRednByBrkgCtrl_Step_Func/Run_CllsnRednByBrkg_Step/CollisionMitigationSystem/DetermineCMbBOutput/DetermineCMbBRequest/DetermineBeltRequest/DetermineBeltRequestActivation/ForceLevelSelection" /begin REF_CHARACTERISTIC CMBB_DecelLvlForHiFBltReqInCllsnRednByBrkg_Ca /end REF_CHARACTERISTIC /end GROUP
/begin GROUP autosar_swc_aeb_autosar_swc_aeb_Step_sys_Subsystem_Reference_AEB_Function_Run_CllsnRednByBrkgCtrl_Step_Func_Run_CllsnRednByBrkg_Step_CollisionMitigationSystem_DetermineCMbBOutput_DetermineCMbBRequest_DetermineBeltRequest_DetermineBeltRequestActivation_S_R_Flip_Flop "autosar_swc_aeb/autosar_swc_aeb_Step_sys/Subsystem Reference/AEB Function/Run_CllsnRednByBrkgCtrl_Step_Func/Run_CllsnRednByBrkg_Step/CollisionMitigationSystem/DetermineCMbBOutput/DetermineCMbBRequest/DetermineBeltRequest/DetermineBeltRequestActivation/S-R\nFlip-Flop" /begin REF_MEASUREMENT autosar_swc_aeb_rtARID_DEF.Memory_PreviousInput_d /end REF_MEASUREMENT /end GROUP
/begin GROUP autosar_swc_aeb_autosar_swc_aeb_Step_sys_Subsystem_Reference_AEB_Function_Run_CllsnRednByBrkgCtrl_Step_Func_Run_CllsnRednByBrkg_Step_CollisionMitigationSystem_DetermineCMbBOutput_DetermineCMbBRequest_DetermineBeltRequest_DetermineBeltRequestActivation_S_R_Flip_Flop1 "autosar_swc_aeb/autosar_swc_aeb_Step_sys/Subsystem Reference/AEB Function/Run_CllsnRednByBrkgCtrl_Step_Func/Run_CllsnRednByBrkg_Step/CollisionMitigationSystem/DetermineCMbBOutput/DetermineCMbBRequest/DetermineBeltRequest/DetermineBeltRequestActivation/S-R\nFlip-Flop1" /begin REF_MEASUREMENT autosar_swc_aeb_rtARID_DEF.Memory_PreviousInput_ph /end REF_MEASUREMENT /end GROUP
/begin GROUP autosar_swc_aeb_autosar_swc_aeb_Step_sys_Subsystem_Reference_AEB_Function_Run_CllsnRednByBrkgCtrl_Step_Func_Run_CllsnRednByBrkg_Step_CollisionMitigationSystem_DetermineCMbBOutput_DetermineCMbBRequest_DetermineBeltRequest_DetermineBeltRequestActivation_TimeActive "autosar_swc_aeb/autosar_swc_aeb_Step_sys/Subsystem Reference/AEB Function/Run_CllsnRednByBrkgCtrl_Step_Func/Run_CllsnRednByBrkg_Step/CollisionMitigationSystem/DetermineCMbBOutput/DetermineCMbBRequest/DetermineBeltRequest/DetermineBeltRequestActivation/TimeActive"
 /begin SUB_GROUP autosar_swc_aeb_autosar_swc_aeb_Step_sys_Subsystem_Reference_AEB_Function_Run_CllsnRednByBrkgCtrl_Step_Func_Run_CllsnRednByBrkg_Step_CollisionMitigationSystem_DetermineCMbBOutput_DetermineCMbBRequest_DetermineBeltRequest_DetermineBeltRequestActivation_TimeActive_HICNTR_1 /end SUB_GROUP
/end GROUP
/begin GROUP autosar_swc_aeb_autosar_swc_aeb_Step_sys_Subsystem_Reference_AEB_Function_Run_CllsnRednByBrkgCtrl_Step_Func_Run_CllsnRednByBrkg_Step_CollisionMitigationSystem_DetermineCMbBOutput_DetermineCMbBRequest_DetermineBeltRequest_DetermineBeltRequestActivation_TimeActive_HICNTR_1 "autosar_swc_aeb/autosar_swc_aeb_Step_sys/Subsystem Reference/AEB Function/Run_CllsnRednByBrkgCtrl_Step_Func/Run_CllsnRednByBrkg_Step/CollisionMitigationSystem/DetermineCMbBOutput/DetermineCMbBRequest/DetermineBeltRequest/DetermineBeltRequestActivation/TimeActive/HICNTR_1" /begin REF_MEASUREMENT autosar_swc_aeb_rtARID_DEF.UD_1_DSTATE_e /end REF_MEASUREMENT /end GROUP
/begin GROUP autosar_swc_aeb_autosar_swc_aeb_Step_sys_Subsystem_Reference_AEB_Function_Run_CllsnRednByBrkgCtrl_Step_Func_Run_CllsnRednByBrkg_Step_CollisionMitigationSystem_DetermineCMbBOutput_DetermineCMbBRequest_DetermineSteeringAssistance "autosar_swc_aeb/autosar_swc_aeb_Step_sys/Subsystem Reference/AEB Function/Run_CllsnRednByBrkgCtrl_Step_Func/Run_CllsnRednByBrkg_Step/CollisionMitigationSystem/DetermineCMbBOutput/DetermineCMbBRequest/DetermineSteeringAssistance"
 /begin SUB_GROUP autosar_swc_aeb_autosar_swc_aeb_Step_sys_Subsystem_Reference_AEB_Function_Run_CllsnRednByBrkgCtrl_Step_Func_Run_CllsnRednByBrkg_Step_CollisionMitigationSystem_DetermineCMbBOutput_DetermineCMbBRequest_DetermineSteeringAssistance_Detect_Increase autosar_swc_aeb_autosar_swc_aeb_Step_sys_Subsystem_Reference_AEB_Function_Run_CllsnRednByBrkgCtrl_Step_Func_Run_CllsnRednByBrkg_Step_CollisionMitigationSystem_DetermineCMbBOutput_DetermineCMbBRequest_DetermineSteeringAssistance_SaveSignal autosar_swc_aeb_autosar_swc_aeb_Step_sys_Subsystem_Reference_AEB_Function_Run_CllsnRednByBrkgCtrl_Step_Func_Run_CllsnRednByBrkg_Step_CollisionMitigationSystem_DetermineCMbBOutput_DetermineCMbBRequest_DetermineSteeringAssistance_SaveSignal1 /end SUB_GROUP
 /begin REF_CHARACTERISTIC CMBB_SteerAsEnaInCllsnRednByBrkg_Ca /end REF_CHARACTERISTIC
/end GROUP
/begin GROUP autosar_swc_aeb_autosar_swc_aeb_Step_sys_Subsystem_Reference_AEB_Function_Run_CllsnRednByBrkgCtrl_Step_Func_Run_CllsnRednByBrkg_Step_CollisionMitigationSystem_DetermineCMbBOutput_DetermineCMbBRequest_DetermineSteeringAssistance_Detect_Increase "autosar_swc_aeb/autosar_swc_aeb_Step_sys/Subsystem Reference/AEB Function/Run_CllsnRednByBrkgCtrl_Step_Func/Run_CllsnRednByBrkg_Step/CollisionMitigationSystem/DetermineCMbBOutput/DetermineCMbBRequest/DetermineSteeringAssistance/Detect\nIncrease" /begin REF_MEASUREMENT autosar_swc_aeb_rtARID_DEF.DelayInput1_DSTATE_k /end REF_MEASUREMENT /end GROUP
/begin GROUP autosar_swc_aeb_autosar_swc_aeb_Step_sys_Subsystem_Reference_AEB_Function_Run_CllsnRednByBrkgCtrl_Step_Func_Run_CllsnRednByBrkg_Step_CollisionMitigationSystem_DetermineCMbBOutput_DetermineCMbBRequest_DetermineSteeringAssistance_SaveSignal "autosar_swc_aeb/autosar_swc_aeb_Step_sys/Subsystem Reference/AEB Function/Run_CllsnRednByBrkgCtrl_Step_Func/Run_CllsnRednByBrkg_Step/CollisionMitigationSystem/DetermineCMbBOutput/DetermineCMbBRequest/DetermineSteeringAssistance/SaveSignal" /begin REF_MEASUREMENT autosar_swc_aeb_rtARID_DEF.UnitDelay_DSTATE_js /end REF_MEASUREMENT /end GROUP
/begin GROUP autosar_swc_aeb_autosar_swc_aeb_Step_sys_Subsystem_Reference_AEB_Function_Run_CllsnRednByBrkgCtrl_Step_Func_Run_CllsnRednByBrkg_Step_CollisionMitigationSystem_DetermineCMbBOutput_DetermineCMbBRequest_DetermineSteeringAssistance_SaveSignal1 "autosar_swc_aeb/autosar_swc_aeb_Step_sys/Subsystem Reference/AEB Function/Run_CllsnRednByBrkgCtrl_Step_Func/Run_CllsnRednByBrkg_Step/CollisionMitigationSystem/DetermineCMbBOutput/DetermineCMbBRequest/DetermineSteeringAssistance/SaveSignal1" /begin REF_MEASUREMENT autosar_swc_aeb_rtARID_DEF.UnitDelay_DSTATE_m3 /end REF_MEASUREMENT /end GROUP
/begin GROUP autosar_swc_aeb_autosar_swc_aeb_Step_sys_Subsystem_Reference_AEB_Function_Run_CllsnRednByBrkgCtrl_Step_Func_Run_CllsnRednByBrkg_Step_CollisionMitigationSystem_DetermineCMbBOutput_SetMessages "autosar_swc_aeb/autosar_swc_aeb_Step_sys/Subsystem Reference/AEB Function/Run_CllsnRednByBrkgCtrl_Step_Func/Run_CllsnRednByBrkg_Step/CollisionMitigationSystem/DetermineCMbBOutput/SetMessages"
 /begin SUB_GROUP autosar_swc_aeb_autosar_swc_aeb_Step_sys_Subsystem_Reference_AEB_Function_Run_CllsnRednByBrkgCtrl_Step_Func_Run_CllsnRednByBrkg_Step_CollisionMitigationSystem_DetermineCMbBOutput_SetMessages_TimeActive autosar_swc_aeb_autosar_swc_aeb_Step_sys_Subsystem_Reference_AEB_Function_Run_CllsnRednByBrkgCtrl_Step_Func_Run_CllsnRednByBrkg_Step_CollisionMitigationSystem_DetermineCMbBOutput_SetMessages_TimeActive1 /end SUB_GROUP
 /begin REF_CHARACTERISTIC CMBB_DurnOfCllsnRednActvAllwdWoCrsCnclInCllsnRednByBrkg_Ca CMBB_DurnOfCllsnRednActvAllwdWoHmiMsgInCllsnRednByBrkg_Ca /end REF_CHARACTERISTIC
/end GROUP
/begin GROUP autosar_swc_aeb_autosar_swc_aeb_Step_sys_Subsystem_Reference_AEB_Function_Run_CllsnRednByBrkgCtrl_Step_Func_Run_CllsnRednByBrkg_Step_CollisionMitigationSystem_DetermineCMbBOutput_SetMessages_TimeActive "autosar_swc_aeb/autosar_swc_aeb_Step_sys/Subsystem Reference/AEB Function/Run_CllsnRednByBrkgCtrl_Step_Func/Run_CllsnRednByBrkg_Step/CollisionMitigationSystem/DetermineCMbBOutput/SetMessages/TimeActive"
 /begin SUB_GROUP autosar_swc_aeb_autosar_swc_aeb_Step_sys_Subsystem_Reference_AEB_Function_Run_CllsnRednByBrkgCtrl_Step_Func_Run_CllsnRednByBrkg_Step_CollisionMitigationSystem_DetermineCMbBOutput_SetMessages_TimeActive_HICNTR_1 /end SUB_GROUP
/end GROUP
/begin GROUP autosar_swc_aeb_autosar_swc_aeb_Step_sys_Subsystem_Reference_AEB_Function_Run_CllsnRednByBrkgCtrl_Step_Func_Run_CllsnRednByBrkg_Step_CollisionMitigationSystem_DetermineCMbBOutput_SetMessages_TimeActive1 "autosar_swc_aeb/autosar_swc_aeb_Step_sys/Subsystem Reference/AEB Function/Run_CllsnRednByBrkgCtrl_Step_Func/Run_CllsnRednByBrkg_Step/CollisionMitigationSystem/DetermineCMbBOutput/SetMessages/TimeActive1"
 /begin SUB_GROUP autosar_swc_aeb_autosar_swc_aeb_Step_sys_Subsystem_Reference_AEB_Function_Run_CllsnRednByBrkgCtrl_Step_Func_Run_CllsnRednByBrkg_Step_CollisionMitigationSystem_DetermineCMbBOutput_SetMessages_TimeActive1_HICNTR_1 /end SUB_GROUP
/end GROUP
/begin GROUP autosar_swc_aeb_autosar_swc_aeb_Step_sys_Subsystem_Reference_AEB_Function_Run_CllsnRednByBrkgCtrl_Step_Func_Run_CllsnRednByBrkg_Step_CollisionMitigationSystem_DetermineCMbBOutput_SetMessages_TimeActive1_HICNTR_1 "autosar_swc_aeb/autosar_swc_aeb_Step_sys/Subsystem Reference/AEB Function/Run_CllsnRednByBrkgCtrl_Step_Func/Run_CllsnRednByBrkg_Step/CollisionMitigationSystem/DetermineCMbBOutput/SetMessages/TimeActive1/HICNTR_1" /begin REF_MEASUREMENT autosar_swc_aeb_rtARID_DEF.UD_1_DSTATE_f /end REF_MEASUREMENT /end GROUP
/begin GROUP autosar_swc_aeb_autosar_swc_aeb_Step_sys_Subsystem_Reference_AEB_Function_Run_CllsnRednByBrkgCtrl_Step_Func_Run_CllsnRednByBrkg_Step_CollisionMitigationSystem_DetermineCMbBOutput_SetMessages_TimeActive_HICNTR_1 "autosar_swc_aeb/autosar_swc_aeb_Step_sys/Subsystem Reference/AEB Function/Run_CllsnRednByBrkgCtrl_Step_Func/Run_CllsnRednByBrkg_Step/CollisionMitigationSystem/DetermineCMbBOutput/SetMessages/TimeActive/HICNTR_1" /begin REF_MEASUREMENT autosar_swc_aeb_rtARID_DEF.UD_1_DSTATE_j /end REF_MEASUREMENT /end GROUP
/begin GROUP autosar_swc_aeb_autosar_swc_aeb_Step_sys_Subsystem_Reference_AEB_Function_Run_CllsnRednByBrkgCtrl_Step_Func_Run_CllsnRednByBrkg_Step_CollisionMitigationSystem_DetermineCMbBStatus "autosar_swc_aeb/autosar_swc_aeb_Step_sys/Subsystem Reference/AEB Function/Run_CllsnRednByBrkgCtrl_Step_Func/Run_CllsnRednByBrkg_Step/CollisionMitigationSystem/DetermineCMbBStatus"
 /begin SUB_GROUP autosar_swc_aeb_autosar_swc_aeb_Step_sys_Subsystem_Reference_AEB_Function_Run_CllsnRednByBrkgCtrl_Step_Func_Run_CllsnRednByBrkg_Step_CollisionMitigationSystem_DetermineCMbBStatus_SetCMbBStatus autosar_swc_aeb_autosar_swc_aeb_Step_sys_Subsystem_Reference_AEB_Function_Run_CllsnRednByBrkgCtrl_Step_Func_Run_CllsnRednByBrkg_Step_CollisionMitigationSystem_DetermineCMbBStatus_SpeedReductionMonitoring autosar_swc_aeb_autosar_swc_aeb_Step_sys_Subsystem_Reference_AEB_Function_Run_CllsnRednByBrkgCtrl_Step_Func_Run_CllsnRednByBrkg_Step_CollisionMitigationSystem_DetermineCMbBStatus_SystemOverride autosar_swc_aeb_autosar_swc_aeb_Step_sys_Subsystem_Reference_AEB_Function_Run_CllsnRednByBrkgCtrl_Step_Func_Run_CllsnRednByBrkg_Step_CollisionMitigationSystem_DetermineCMbBStatus_VisionOnlyInterventionMonitoring /end SUB_GROUP
 /begin REF_MEASUREMENT autosar_swc_aeb_rtARID_DEF.UnitDelay1_DSTATE_e autosar_swc_aeb_rtARID_DEF.UnitDelay2_DSTATE_nj /end REF_MEASUREMENT
/end GROUP
/begin GROUP autosar_swc_aeb_autosar_swc_aeb_Step_sys_Subsystem_Reference_AEB_Function_Run_CllsnRednByBrkgCtrl_Step_Func_Run_CllsnRednByBrkg_Step_CollisionMitigationSystem_DetermineCMbBStatus_SetCMbBStatus "autosar_swc_aeb/autosar_swc_aeb_Step_sys/Subsystem Reference/AEB Function/Run_CllsnRednByBrkgCtrl_Step_Func/Run_CllsnRednByBrkg_Step/CollisionMitigationSystem/DetermineCMbBStatus/SetCMbBStatus"
 /begin SUB_GROUP autosar_swc_aeb_autosar_swc_aeb_Step_sys_Subsystem_Reference_AEB_Function_Run_CllsnRednByBrkgCtrl_Step_Func_Run_CllsnRednByBrkg_Step_CollisionMitigationSystem_DetermineCMbBStatus_SetCMbBStatus_Subsystem /end SUB_GROUP
/end GROUP
/begin GROUP autosar_swc_aeb_autosar_swc_aeb_Step_sys_Subsystem_Reference_AEB_Function_Run_CllsnRednByBrkgCtrl_Step_Func_Run_CllsnRednByBrkg_Step_CollisionMitigationSystem_DetermineCMbBStatus_SetCMbBStatus_Subsystem "autosar_swc_aeb/autosar_swc_aeb_Step_sys/Subsystem Reference/AEB Function/Run_CllsnRednByBrkgCtrl_Step_Func/Run_CllsnRednByBrkg_Step/CollisionMitigationSystem/DetermineCMbBStatus/SetCMbBStatus/Subsystem" /begin REF_MEASUREMENT autosar_swc_aeb_rtARID_DEF.Threat /end REF_MEASUREMENT /end GROUP
/begin GROUP autosar_swc_aeb_autosar_swc_aeb_Step_sys_Subsystem_Reference_AEB_Function_Run_CllsnRednByBrkgCtrl_Step_Func_Run_CllsnRednByBrkg_Step_CollisionMitigationSystem_DetermineCMbBStatus_SpeedReductionMonitoring "autosar_swc_aeb/autosar_swc_aeb_Step_sys/Subsystem Reference/AEB Function/Run_CllsnRednByBrkgCtrl_Step_Func/Run_CllsnRednByBrkg_Step/CollisionMitigationSystem/DetermineCMbBStatus/SpeedReductionMonitoring"
 /begin SUB_GROUP autosar_swc_aeb_autosar_swc_aeb_Step_sys_Subsystem_Reference_AEB_Function_Run_CllsnRednByBrkgCtrl_Step_Func_Run_CllsnRednByBrkg_Step_CollisionMitigationSystem_DetermineCMbBStatus_SpeedReductionMonitoring_SpeedReductionASILACheck /end SUB_GROUP
 /begin REF_CHARACTERISTIC CMBB_VRednThdASILAInCllsnRednByBrkg_Ca /end REF_CHARACTERISTIC
 /begin REF_MEASUREMENT autosar_swc_aeb_rtARID_DEF.SpeedReduction_m /end REF_MEASUREMENT
/end GROUP
/begin GROUP autosar_swc_aeb_autosar_swc_aeb_Step_sys_Subsystem_Reference_AEB_Function_Run_CllsnRednByBrkgCtrl_Step_Func_Run_CllsnRednByBrkg_Step_CollisionMitigationSystem_DetermineCMbBStatus_SpeedReductionMonitoring_SpeedReductionASILACheck "autosar_swc_aeb/autosar_swc_aeb_Step_sys/Subsystem Reference/AEB Function/Run_CllsnRednByBrkgCtrl_Step_Func/Run_CllsnRednByBrkg_Step/CollisionMitigationSystem/DetermineCMbBStatus/SpeedReductionMonitoring/SpeedReductionASILACheck"
 /begin SUB_GROUP autosar_swc_aeb_autosar_swc_aeb_Step_sys_Subsystem_Reference_AEB_Function_Run_CllsnRednByBrkgCtrl_Step_Func_Run_CllsnRednByBrkg_Step_CollisionMitigationSystem_DetermineCMbBStatus_SpeedReductionMonitoring_SpeedReductionASILACheck_IntvBasedOnQmInfo /end SUB_GROUP
 /begin REF_CHARACTERISTIC CMBB_TiRstForVRednThdInCllsnRednByBrkg_Ca /end REF_CHARACTERISTIC
 /begin REF_MEASUREMENT autosar_swc_aeb_rtARID_DEF.SpeedAtIntervention_j autosar_swc_aeb_rtARID_DEF.SpeedRedPrevious_pd autosar_swc_aeb_rtARID_DEF.SpeedReduction_m autosar_swc_aeb_rtARID_DEF.TimeNoIntervention_i autosar_swc_aeb_rtARID_DEF.is_SpeedReductionEval_j autosar_swc_aeb_rtARID_DEF.is_active_c379_autosar_swc_aeb autosar_swc_aeb_rtARID_DEF.is_c379_autosar_swc_aeb /end REF_MEASUREMENT
/end GROUP
/begin GROUP autosar_swc_aeb_autosar_swc_aeb_Step_sys_Subsystem_Reference_AEB_Function_Run_CllsnRednByBrkgCtrl_Step_Func_Run_CllsnRednByBrkg_Step_CollisionMitigationSystem_DetermineCMbBStatus_SpeedReductionMonitoring_SpeedReductionASILACheck_IntvBasedOnQmInfo "autosar_swc_aeb/autosar_swc_aeb_Step_sys/Subsystem Reference/AEB Function/Run_CllsnRednByBrkgCtrl_Step_Func/Run_CllsnRednByBrkg_Step/CollisionMitigationSystem/DetermineCMbBStatus/SpeedReductionMonitoring/SpeedReductionASILACheck/IntvBasedOnQmInfo"
 /begin SUB_GROUP autosar_swc_aeb_autosar_swc_aeb_Step_sys_Subsystem_Reference_AEB_Function_Run_CllsnRednByBrkgCtrl_Step_Func_Run_CllsnRednByBrkg_Step_CollisionMitigationSystem_DetermineCMbBStatus_SpeedReductionMonitoring_SpeedReductionASILACheck_IntvBasedOnQmInfo_SRFlipFlop /end SUB_GROUP
/end GROUP
/begin GROUP autosar_swc_aeb_autosar_swc_aeb_Step_sys_Subsystem_Reference_AEB_Function_Run_CllsnRednByBrkgCtrl_Step_Func_Run_CllsnRednByBrkg_Step_CollisionMitigationSystem_DetermineCMbBStatus_SpeedReductionMonitoring_SpeedReductionASILACheck_IntvBasedOnQmInfo_SRFlipFlop "autosar_swc_aeb/autosar_swc_aeb_Step_sys/Subsystem Reference/AEB Function/Run_CllsnRednByBrkgCtrl_Step_Func/Run_CllsnRednByBrkg_Step/CollisionMitigationSystem/DetermineCMbBStatus/SpeedReductionMonitoring/SpeedReductionASILACheck/IntvBasedOnQmInfo/SRFlipFlop" /begin REF_MEASUREMENT autosar_swc_aeb_rtARID_DEF.Memory_PreviousInput_b /end REF_MEASUREMENT /end GROUP
/begin GROUP autosar_swc_aeb_autosar_swc_aeb_Step_sys_Subsystem_Reference_AEB_Function_Run_CllsnRednByBrkgCtrl_Step_Func_Run_CllsnRednByBrkg_Step_CollisionMitigationSystem_DetermineCMbBStatus_SystemOverride "autosar_swc_aeb/autosar_swc_aeb_Step_sys/Subsystem Reference/AEB Function/Run_CllsnRednByBrkgCtrl_Step_Func/Run_CllsnRednByBrkg_Step/CollisionMitigationSystem/DetermineCMbBStatus/SystemOverride"
 /begin SUB_GROUP autosar_swc_aeb_autosar_swc_aeb_Step_sys_Subsystem_Reference_AEB_Function_Run_CllsnRednByBrkgCtrl_Step_Func_Run_CllsnRednByBrkg_Step_CollisionMitigationSystem_DetermineCMbBStatus_SystemOverride_SetResetFlipFlop /end SUB_GROUP
 /begin REF_CHARACTERISTIC CMBB_SpdMinOvrdAccrResetInCllsnRednByBrkg_Ca /end REF_CHARACTERISTIC
 /begin REF_MEASUREMENT autosar_swc_aeb_rtARID_DEF.Threat /end REF_MEASUREMENT
/end GROUP
/begin GROUP autosar_swc_aeb_autosar_swc_aeb_Step_sys_Subsystem_Reference_AEB_Function_Run_CllsnRednByBrkgCtrl_Step_Func_Run_CllsnRednByBrkg_Step_CollisionMitigationSystem_DetermineCMbBStatus_SystemOverride_SetResetFlipFlop "autosar_swc_aeb/autosar_swc_aeb_Step_sys/Subsystem Reference/AEB Function/Run_CllsnRednByBrkgCtrl_Step_Func/Run_CllsnRednByBrkg_Step/CollisionMitigationSystem/DetermineCMbBStatus/SystemOverride/SetResetFlipFlop" /begin REF_MEASUREMENT autosar_swc_aeb_rtARID_DEF.Memory_PreviousInput_c /end REF_MEASUREMENT /end GROUP
/begin GROUP autosar_swc_aeb_autosar_swc_aeb_Step_sys_Subsystem_Reference_AEB_Function_Run_CllsnRednByBrkgCtrl_Step_Func_Run_CllsnRednByBrkg_Step_CollisionMitigationSystem_DetermineCMbBStatus_VisionOnlyInterventionMonitoring "autosar_swc_aeb/autosar_swc_aeb_Step_sys/Subsystem Reference/AEB Function/Run_CllsnRednByBrkgCtrl_Step_Func/Run_CllsnRednByBrkg_Step/CollisionMitigationSystem/DetermineCMbBStatus/VisionOnlyInterventionMonitoring"
 /begin REF_CHARACTERISTIC CMBB_TiRstForViOnMntInCllsnRednByBrkg_Ca CMBB_ViOnIntvTiMaxInCllsnRednByBrkg_Ca /end REF_CHARACTERISTIC
 /begin REF_MEASUREMENT autosar_swc_aeb_rtARID_DEF.IntvDur autosar_swc_aeb_rtARID_DEF.IntvDurPrevious autosar_swc_aeb_rtARID_DEF.TimeNoIntervention_l autosar_swc_aeb_rtARID_DEF.is_IntvDurEval autosar_swc_aeb_rtARID_DEF.is_active_c380_autosar_swc_aeb autosar_swc_aeb_rtARID_DEF.is_c380_autosar_swc_aeb /end REF_MEASUREMENT
/end GROUP
/begin GROUP autosar_swc_aeb_autosar_swc_aeb_Step_sys_Subsystem_Reference_AEB_Function_Run_CllsnRednByBrkgCtrl_Step_Func_Run_CllsnRednByBrkg_Step_CollisionMitigationSystem_DetermineQueueOverride "autosar_swc_aeb/autosar_swc_aeb_Step_sys/Subsystem Reference/AEB Function/Run_CllsnRednByBrkgCtrl_Step_Func/Run_CllsnRednByBrkg_Step/CollisionMitigationSystem/DetermineQueueOverride"
 /begin SUB_GROUP autosar_swc_aeb_autosar_swc_aeb_Step_sys_Subsystem_Reference_AEB_Function_Run_CllsnRednByBrkgCtrl_Step_Func_Run_CllsnRednByBrkg_Step_CollisionMitigationSystem_DetermineQueueOverride_ConfirmBrakePedlPsd autosar_swc_aeb_autosar_swc_aeb_Step_sys_Subsystem_Reference_AEB_Function_Run_CllsnRednByBrkgCtrl_Step_Func_Run_CllsnRednByBrkg_Step_CollisionMitigationSystem_DetermineQueueOverride_Detect_Decrease autosar_swc_aeb_autosar_swc_aeb_Step_sys_Subsystem_Reference_AEB_Function_Run_CllsnRednByBrkgCtrl_Step_Func_Run_CllsnRednByBrkg_Step_CollisionMitigationSystem_DetermineQueueOverride_Detect_Increase autosar_swc_aeb_autosar_swc_aeb_Step_sys_Subsystem_Reference_AEB_Function_Run_CllsnRednByBrkgCtrl_Step_Func_Run_CllsnRednByBrkg_Step_CollisionMitigationSystem_DetermineQueueOverride_S_R_Flip_Flop /end SUB_GROUP
 /begin REF_CHARACTERISTIC CMBB_AccrPedlThdForOvrdInSpdLoInCllsnRednByBrkg_Ca CMBB_SpdThdForOvrdInSpdLoInCllsnRednByBrkg_Ca CMBB_VLgtRelThdForOvrdInSpdLoInCllsnRednByBrkg_Ca /end REF_CHARACTERISTIC
 /begin REF_MEASUREMENT autosar_swc_aeb_rtARID_DEF.Threat /end REF_MEASUREMENT
/end GROUP
/begin GROUP autosar_swc_aeb_autosar_swc_aeb_Step_sys_Subsystem_Reference_AEB_Function_Run_CllsnRednByBrkgCtrl_Step_Func_Run_CllsnRednByBrkg_Step_CollisionMitigationSystem_DetermineQueueOverride_ConfirmBrakePedlPsd "autosar_swc_aeb/autosar_swc_aeb_Step_sys/Subsystem Reference/AEB Function/Run_CllsnRednByBrkgCtrl_Step_Func/Run_CllsnRednByBrkg_Step/CollisionMitigationSystem/DetermineQueueOverride/ConfirmBrakePedlPsd"
 /begin SUB_GROUP autosar_swc_aeb_autosar_swc_aeb_Step_sys_Subsystem_Reference_AEB_Function_Run_CllsnRednByBrkgCtrl_Step_Func_Run_CllsnRednByBrkg_Step_CollisionMitigationSystem_DetermineQueueOverride_ConfirmBrakePedlPsd_OnDelayBlock /end SUB_GROUP
 /begin REF_CHARACTERISTIC CMBB_BrkPedlPsdCfmDlyForOvrdInSpdLoInCllsnRednByBrkg_Ca /end REF_CHARACTERISTIC
/end GROUP
/begin GROUP autosar_swc_aeb_autosar_swc_aeb_Step_sys_Subsystem_Reference_AEB_Function_Run_CllsnRednByBrkgCtrl_Step_Func_Run_CllsnRednByBrkg_Step_CollisionMitigationSystem_DetermineQueueOverride_ConfirmBrakePedlPsd_OnDelayBlock "autosar_swc_aeb/autosar_swc_aeb_Step_sys/Subsystem Reference/AEB Function/Run_CllsnRednByBrkgCtrl_Step_Func/Run_CllsnRednByBrkg_Step/CollisionMitigationSystem/DetermineQueueOverride/ConfirmBrakePedlPsd/OnDelayBlock" /begin REF_MEASUREMENT autosar_swc_aeb_rtARID_DEF.UnitDelay_DSTATE_l /end REF_MEASUREMENT /end GROUP
/begin GROUP autosar_swc_aeb_autosar_swc_aeb_Step_sys_Subsystem_Reference_AEB_Function_Run_CllsnRednByBrkgCtrl_Step_Func_Run_CllsnRednByBrkg_Step_CollisionMitigationSystem_DetermineQueueOverride_Detect_Decrease "autosar_swc_aeb/autosar_swc_aeb_Step_sys/Subsystem Reference/AEB Function/Run_CllsnRednByBrkgCtrl_Step_Func/Run_CllsnRednByBrkg_Step/CollisionMitigationSystem/DetermineQueueOverride/Detect\nDecrease" /begin REF_MEASUREMENT autosar_swc_aeb_rtARID_DEF.DelayInput1_DSTATE_b /end REF_MEASUREMENT /end GROUP
/begin GROUP autosar_swc_aeb_autosar_swc_aeb_Step_sys_Subsystem_Reference_AEB_Function_Run_CllsnRednByBrkgCtrl_Step_Func_Run_CllsnRednByBrkg_Step_CollisionMitigationSystem_DetermineQueueOverride_Detect_Increase "autosar_swc_aeb/autosar_swc_aeb_Step_sys/Subsystem Reference/AEB Function/Run_CllsnRednByBrkgCtrl_Step_Func/Run_CllsnRednByBrkg_Step/CollisionMitigationSystem/DetermineQueueOverride/Detect\nIncrease" /begin REF_MEASUREMENT autosar_swc_aeb_rtARID_DEF.DelayInput1_DSTATE_c /end REF_MEASUREMENT /end GROUP
/begin GROUP autosar_swc_aeb_autosar_swc_aeb_Step_sys_Subsystem_Reference_AEB_Function_Run_CllsnRednByBrkgCtrl_Step_Func_Run_CllsnRednByBrkg_Step_CollisionMitigationSystem_DetermineQueueOverride_S_R_Flip_Flop "autosar_swc_aeb/autosar_swc_aeb_Step_sys/Subsystem Reference/AEB Function/Run_CllsnRednByBrkgCtrl_Step_Func/Run_CllsnRednByBrkg_Step/CollisionMitigationSystem/DetermineQueueOverride/S-R\nFlip-Flop" /begin REF_MEASUREMENT autosar_swc_aeb_rtARID_DEF.Memory_PreviousInput_hz /end REF_MEASUREMENT /end GROUP
/begin GROUP autosar_swc_aeb_autosar_swc_aeb_Step_sys_Subsystem_Reference_AEB_Function_Run_CllsnRednByBrkgCtrl_Step_Func_Run_CllsnRednByBrkg_Step_CollisionMitigationSystem_DetermineSteeringOverride "autosar_swc_aeb/autosar_swc_aeb_Step_sys/Subsystem Reference/AEB Function/Run_CllsnRednByBrkgCtrl_Step_Func/Run_CllsnRednByBrkg_Step/CollisionMitigationSystem/DetermineSteeringOverride"
 /begin SUB_GROUP autosar_swc_aeb_autosar_swc_aeb_Step_sys_Subsystem_Reference_AEB_Function_Run_CllsnRednByBrkgCtrl_Step_Func_Run_CllsnRednByBrkg_Step_CollisionMitigationSystem_DetermineSteeringOverride_Detect_Increase autosar_swc_aeb_autosar_swc_aeb_Step_sys_Subsystem_Reference_AEB_Function_Run_CllsnRednByBrkgCtrl_Step_Func_Run_CllsnRednByBrkg_Step_CollisionMitigationSystem_DetermineSteeringOverride_SaveSignal autosar_swc_aeb_autosar_swc_aeb_Step_sys_Subsystem_Reference_AEB_Function_Run_CllsnRednByBrkgCtrl_Step_Func_Run_CllsnRednByBrkg_Step_CollisionMitigationSystem_DetermineSteeringOverride_SaveSignal1 /end SUB_GROUP
 /begin REF_CHARACTERISTIC CMBB_PinionSteerAgSpdRqrdToOvrdIntvForVehMovgToSelf_Ca /end REF_CHARACTERISTIC
 /begin REF_MEASUREMENT autosar_swc_aeb_rtARID_DEF.Threat /end REF_MEASUREMENT
/end GROUP
/begin GROUP autosar_swc_aeb_autosar_swc_aeb_Step_sys_Subsystem_Reference_AEB_Function_Run_CllsnRednByBrkgCtrl_Step_Func_Run_CllsnRednByBrkg_Step_CollisionMitigationSystem_DetermineSteeringOverride_Detect_Increase "autosar_swc_aeb/autosar_swc_aeb_Step_sys/Subsystem Reference/AEB Function/Run_CllsnRednByBrkgCtrl_Step_Func/Run_CllsnRednByBrkg_Step/CollisionMitigationSystem/DetermineSteeringOverride/Detect\nIncrease" /begin REF_MEASUREMENT autosar_swc_aeb_rtARID_DEF.DelayInput1_DSTATE_g /end REF_MEASUREMENT /end GROUP
/begin GROUP autosar_swc_aeb_autosar_swc_aeb_Step_sys_Subsystem_Reference_AEB_Function_Run_CllsnRednByBrkgCtrl_Step_Func_Run_CllsnRednByBrkg_Step_CollisionMitigationSystem_DetermineSteeringOverride_SaveSignal "autosar_swc_aeb/autosar_swc_aeb_Step_sys/Subsystem Reference/AEB Function/Run_CllsnRednByBrkgCtrl_Step_Func/Run_CllsnRednByBrkg_Step/CollisionMitigationSystem/DetermineSteeringOverride/SaveSignal" /begin REF_MEASUREMENT autosar_swc_aeb_rtARID_DEF.UnitDelay_DSTATE_b2 /end REF_MEASUREMENT /end GROUP
/begin GROUP autosar_swc_aeb_autosar_swc_aeb_Step_sys_Subsystem_Reference_AEB_Function_Run_CllsnRednByBrkgCtrl_Step_Func_Run_CllsnRednByBrkg_Step_CollisionMitigationSystem_DetermineSteeringOverride_SaveSignal1 "autosar_swc_aeb/autosar_swc_aeb_Step_sys/Subsystem Reference/AEB Function/Run_CllsnRednByBrkgCtrl_Step_Func/Run_CllsnRednByBrkg_Step/CollisionMitigationSystem/DetermineSteeringOverride/SaveSignal1" /begin REF_MEASUREMENT autosar_swc_aeb_rtARID_DEF.UnitDelay_DSTATE_bh /end REF_MEASUREMENT /end GROUP
/begin GROUP autosar_swc_aeb_autosar_swc_aeb_Step_sys_Subsystem_Reference_AEB_Function_Run_CllsnRednByBrkgCtrl_Step_Func_Run_CllsnRednByBrkg_Step_CollisionMitigationSystem_EvaluationCMbBInput "autosar_swc_aeb/autosar_swc_aeb_Step_sys/Subsystem Reference/AEB Function/Run_CllsnRednByBrkgCtrl_Step_Func/Run_CllsnRednByBrkg_Step/CollisionMitigationSystem/EvaluationCMbBInput"
 /begin SUB_GROUP autosar_swc_aeb_autosar_swc_aeb_Step_sys_Subsystem_Reference_AEB_Function_Run_CllsnRednByBrkgCtrl_Step_Func_Run_CllsnRednByBrkg_Step_CollisionMitigationSystem_EvaluationCMbBInput_CritLgtEvaluation autosar_swc_aeb_autosar_swc_aeb_Step_sys_Subsystem_Reference_AEB_Function_Run_CllsnRednByBrkgCtrl_Step_Func_Run_CllsnRednByBrkg_Step_CollisionMitigationSystem_EvaluationCMbBInput_DenyDueToOccupentSafety autosar_swc_aeb_autosar_swc_aeb_Step_sys_Subsystem_Reference_AEB_Function_Run_CllsnRednByBrkgCtrl_Step_Func_Run_CllsnRednByBrkg_Step_CollisionMitigationSystem_EvaluationCMbBInput_VisionOnlyEvaluation /end SUB_GROUP
/end GROUP
/begin GROUP autosar_swc_aeb_autosar_swc_aeb_Step_sys_Subsystem_Reference_AEB_Function_Run_CllsnRednByBrkgCtrl_Step_Func_Run_CllsnRednByBrkg_Step_CollisionMitigationSystem_EvaluationCMbBInput_CritLgtEvaluation "autosar_swc_aeb/autosar_swc_aeb_Step_sys/Subsystem Reference/AEB Function/Run_CllsnRednByBrkgCtrl_Step_Func/Run_CllsnRednByBrkg_Step/CollisionMitigationSystem/EvaluationCMbBInput/CritLgtEvaluation"
 /begin SUB_GROUP autosar_swc_aeb_autosar_swc_aeb_Step_sys_Subsystem_Reference_AEB_Function_Run_CllsnRednByBrkgCtrl_Step_Func_Run_CllsnRednByBrkg_Step_CollisionMitigationSystem_EvaluationCMbBInput_CritLgtEvaluation_Deactivate autosar_swc_aeb_autosar_swc_aeb_Step_sys_Subsystem_Reference_AEB_Function_Run_CllsnRednByBrkgCtrl_Step_Func_Run_CllsnRednByBrkg_Step_CollisionMitigationSystem_EvaluationCMbBInput_CritLgtEvaluation_DetermineBrakingThreat autosar_swc_aeb_autosar_swc_aeb_Step_sys_Subsystem_Reference_AEB_Function_Run_CllsnRednByBrkgCtrl_Step_Func_Run_CllsnRednByBrkg_Step_CollisionMitigationSystem_EvaluationCMbBInput_CritLgtEvaluation_EvaluateFullBrakingConditions autosar_swc_aeb_autosar_swc_aeb_Step_sys_Subsystem_Reference_AEB_Function_Run_CllsnRednByBrkgCtrl_Step_Func_Run_CllsnRednByBrkg_Step_CollisionMitigationSystem_EvaluationCMbBInput_CritLgtEvaluation_EvaluatePreBrakingConditions autosar_swc_aeb_autosar_swc_aeb_Step_sys_Subsystem_Reference_AEB_Function_Run_CllsnRednByBrkgCtrl_Step_Func_Run_CllsnRednByBrkg_Step_CollisionMitigationSystem_EvaluationCMbBInput_CritLgtEvaluation_Inhibit_Activation /end SUB_GROUP
/end GROUP
/begin GROUP autosar_swc_aeb_autosar_swc_aeb_Step_sys_Subsystem_Reference_AEB_Function_Run_CllsnRednByBrkgCtrl_Step_Func_Run_CllsnRednByBrkg_Step_CollisionMitigationSystem_EvaluationCMbBInput_CritLgtEvaluation_Deactivate "autosar_swc_aeb/autosar_swc_aeb_Step_sys/Subsystem Reference/AEB Function/Run_CllsnRednByBrkgCtrl_Step_Func/Run_CllsnRednByBrkg_Step/CollisionMitigationSystem/EvaluationCMbBInput/CritLgtEvaluation/Deactivate"
 /begin SUB_GROUP autosar_swc_aeb_autosar_swc_aeb_Step_sys_Subsystem_Reference_AEB_Function_Run_CllsnRednByBrkgCtrl_Step_Func_Run_CllsnRednByBrkg_Step_CollisionMitigationSystem_EvaluationCMbBInput_CritLgtEvaluation_Deactivate_DelayConfOrIdDeAct autosar_swc_aeb_autosar_swc_aeb_Step_sys_Subsystem_Reference_AEB_Function_Run_CllsnRednByBrkgCtrl_Step_Func_Run_CllsnRednByBrkg_Step_CollisionMitigationSystem_EvaluationCMbBInput_CritLgtEvaluation_Deactivate_HighTTCTime autosar_swc_aeb_autosar_swc_aeb_Step_sys_Subsystem_Reference_AEB_Function_Run_CllsnRednByBrkgCtrl_Step_Func_Run_CllsnRednByBrkg_Step_CollisionMitigationSystem_EvaluationCMbBInput_CritLgtEvaluation_Deactivate_NoBrakingRequiredTime autosar_swc_aeb_autosar_swc_aeb_Step_sys_Subsystem_Reference_AEB_Function_Run_CllsnRednByBrkgCtrl_Step_Func_Run_CllsnRednByBrkg_Step_CollisionMitigationSystem_EvaluationCMbBInput_CritLgtEvaluation_Deactivate_ObjDataChangeDetection autosar_swc_aeb_autosar_swc_aeb_Step_sys_Subsystem_Reference_AEB_Function_Run_CllsnRednByBrkgCtrl_Step_Func_Run_CllsnRednByBrkg_Step_CollisionMitigationSystem_EvaluationCMbBInput_CritLgtEvaluation_Deactivate_SetOffFlag autosar_swc_aeb_autosar_swc_aeb_Step_sys_Subsystem_Reference_AEB_Function_Run_CllsnRednByBrkgCtrl_Step_Func_Run_CllsnRednByBrkg_Step_CollisionMitigationSystem_EvaluationCMbBInput_CritLgtEvaluation_Deactivate_VehicleStationaryTime /end SUB_GROUP
/end GROUP
/begin GROUP autosar_swc_aeb_autosar_swc_aeb_Step_sys_Subsystem_Reference_AEB_Function_Run_CllsnRednByBrkgCtrl_Step_Func_Run_CllsnRednByBrkg_Step_CollisionMitigationSystem_EvaluationCMbBInput_CritLgtEvaluation_Deactivate_DelayConfOrIdDeAct "autosar_swc_aeb/autosar_swc_aeb_Step_sys/Subsystem Reference/AEB Function/Run_CllsnRednByBrkgCtrl_Step_Func/Run_CllsnRednByBrkg_Step/CollisionMitigationSystem/EvaluationCMbBInput/CritLgtEvaluation/Deactivate/DelayConfOrIdDeAct"
 /begin SUB_GROUP autosar_swc_aeb_autosar_swc_aeb_Step_sys_Subsystem_Reference_AEB_Function_Run_CllsnRednByBrkgCtrl_Step_Func_Run_CllsnRednByBrkg_Step_CollisionMitigationSystem_EvaluationCMbBInput_CritLgtEvaluation_Deactivate_DelayConfOrIdDeAct_OnDelayBlock /end SUB_GROUP
 /begin REF_CHARACTERISTIC CMBB_SpdThdDlyDeactvnInCllsnRednByBrkg_Ca CMBB_TiDlyDeactvnInCllsnRednByBrkg_Ca /end REF_CHARACTERISTIC
/end GROUP
/begin GROUP autosar_swc_aeb_autosar_swc_aeb_Step_sys_Subsystem_Reference_AEB_Function_Run_CllsnRednByBrkgCtrl_Step_Func_Run_CllsnRednByBrkg_Step_CollisionMitigationSystem_EvaluationCMbBInput_CritLgtEvaluation_Deactivate_DelayConfOrIdDeAct_OnDelayBlock "autosar_swc_aeb/autosar_swc_aeb_Step_sys/Subsystem Reference/AEB Function/Run_CllsnRednByBrkgCtrl_Step_Func/Run_CllsnRednByBrkg_Step/CollisionMitigationSystem/EvaluationCMbBInput/CritLgtEvaluation/Deactivate/DelayConfOrIdDeAct/OnDelayBlock" /begin REF_MEASUREMENT autosar_swc_aeb_rtARID_DEF.UnitDelay_DSTATE_my /end REF_MEASUREMENT /end GROUP
/begin GROUP autosar_swc_aeb_autosar_swc_aeb_Step_sys_Subsystem_Reference_AEB_Function_Run_CllsnRednByBrkgCtrl_Step_Func_Run_CllsnRednByBrkg_Step_CollisionMitigationSystem_EvaluationCMbBInput_CritLgtEvaluation_Deactivate_HighTTCTime "autosar_swc_aeb/autosar_swc_aeb_Step_sys/Subsystem Reference/AEB Function/Run_CllsnRednByBrkgCtrl_Step_Func/Run_CllsnRednByBrkg_Step/CollisionMitigationSystem/EvaluationCMbBInput/CritLgtEvaluation/Deactivate/HighTTCTime"
 /begin SUB_GROUP autosar_swc_aeb_autosar_swc_aeb_Step_sys_Subsystem_Reference_AEB_Function_Run_CllsnRednByBrkgCtrl_Step_Func_Run_CllsnRednByBrkg_Step_CollisionMitigationSystem_EvaluationCMbBInput_CritLgtEvaluation_Deactivate_HighTTCTime_TimeActive /end SUB_GROUP
 /begin REF_CHARACTERISTIC CMBB_HiValThdForDeactvnByTiToCllsnInCllsnRednByBrkg_Ca /end REF_CHARACTERISTIC
/end GROUP
/begin GROUP autosar_swc_aeb_autosar_swc_aeb_Step_sys_Subsystem_Reference_AEB_Function_Run_CllsnRednByBrkgCtrl_Step_Func_Run_CllsnRednByBrkg_Step_CollisionMitigationSystem_EvaluationCMbBInput_CritLgtEvaluation_Deactivate_HighTTCTime_TimeActive "autosar_swc_aeb/autosar_swc_aeb_Step_sys/Subsystem Reference/AEB Function/Run_CllsnRednByBrkgCtrl_Step_Func/Run_CllsnRednByBrkg_Step/CollisionMitigationSystem/EvaluationCMbBInput/CritLgtEvaluation/Deactivate/HighTTCTime/TimeActive"
 /begin SUB_GROUP autosar_swc_aeb_autosar_swc_aeb_Step_sys_Subsystem_Reference_AEB_Function_Run_CllsnRednByBrkgCtrl_Step_Func_Run_CllsnRednByBrkg_Step_CollisionMitigationSystem_EvaluationCMbBInput_CritLgtEvaluation_Deactivate_HighTTCTime_TimeActive_HICNTR_1 /end SUB_GROUP
/end GROUP
/begin GROUP autosar_swc_aeb_autosar_swc_aeb_Step_sys_Subsystem_Reference_AEB_Function_Run_CllsnRednByBrkgCtrl_Step_Func_Run_CllsnRednByBrkg_Step_CollisionMitigationSystem_EvaluationCMbBInput_CritLgtEvaluation_Deactivate_HighTTCTime_TimeActive_HICNTR_1 "autosar_swc_aeb/autosar_swc_aeb_Step_sys/Subsystem Reference/AEB Function/Run_CllsnRednByBrkgCtrl_Step_Func/Run_CllsnRednByBrkg_Step/CollisionMitigationSystem/EvaluationCMbBInput/CritLgtEvaluation/Deactivate/HighTTCTime/TimeActive/HICNTR_1" /begin REF_MEASUREMENT autosar_swc_aeb_rtARID_DEF.UD_1_DSTATE_l1 /end REF_MEASUREMENT /end GROUP
/begin GROUP autosar_swc_aeb_autosar_swc_aeb_Step_sys_Subsystem_Reference_AEB_Function_Run_CllsnRednByBrkgCtrl_Step_Func_Run_CllsnRednByBrkg_Step_CollisionMitigationSystem_EvaluationCMbBInput_CritLgtEvaluation_Deactivate_NoBrakingRequiredTime "autosar_swc_aeb/autosar_swc_aeb_Step_sys/Subsystem Reference/AEB Function/Run_CllsnRednByBrkgCtrl_Step_Func/Run_CllsnRednByBrkg_Step/CollisionMitigationSystem/EvaluationCMbBInput/CritLgtEvaluation/Deactivate/NoBrakingRequiredTime"
 /begin SUB_GROUP autosar_swc_aeb_autosar_swc_aeb_Step_sys_Subsystem_Reference_AEB_Function_Run_CllsnRednByBrkgCtrl_Step_Func_Run_CllsnRednByBrkg_Step_CollisionMitigationSystem_EvaluationCMbBInput_CritLgtEvaluation_Deactivate_NoBrakingRequiredTime_TimeActive /end SUB_GROUP
 /begin REF_CHARACTERISTIC CMBB_AThdForNoBrkgRqrdInCllsnRednByBrkg_Ca CMBB_PosnLgtThdForNoBrkgRqrdInCllsnRednByBrkg_Ca CMBB_VLgtRelThdForNoBrkgRqrdInCllsnRednByBrkg_Ca /end REF_CHARACTERISTIC
/end GROUP
/begin GROUP autosar_swc_aeb_autosar_swc_aeb_Step_sys_Subsystem_Reference_AEB_Function_Run_CllsnRednByBrkgCtrl_Step_Func_Run_CllsnRednByBrkg_Step_CollisionMitigationSystem_EvaluationCMbBInput_CritLgtEvaluation_Deactivate_NoBrakingRequiredTime_TimeActive "autosar_swc_aeb/autosar_swc_aeb_Step_sys/Subsystem Reference/AEB Function/Run_CllsnRednByBrkgCtrl_Step_Func/Run_CllsnRednByBrkg_Step/CollisionMitigationSystem/EvaluationCMbBInput/CritLgtEvaluation/Deactivate/NoBrakingRequiredTime/TimeActive"
 /begin SUB_GROUP autosar_swc_aeb_autosar_swc_aeb_Step_sys_Subsystem_Reference_AEB_Function_Run_CllsnRednByBrkgCtrl_Step_Func_Run_CllsnRednByBrkg_Step_CollisionMitigationSystem_EvaluationCMbBInput_CritLgtEvaluation_Deactivate_NoBrakingRequiredTime_TimeActive_HICNTR_1 /end SUB_GROUP
/end GROUP
/begin GROUP autosar_swc_aeb_autosar_swc_aeb_Step_sys_Subsystem_Reference_AEB_Function_Run_CllsnRednByBrkgCtrl_Step_Func_Run_CllsnRednByBrkg_Step_CollisionMitigationSystem_EvaluationCMbBInput_CritLgtEvaluation_Deactivate_NoBrakingRequiredTime_TimeActive_HICNTR_1 "autosar_swc_aeb/autosar_swc_aeb_Step_sys/Subsystem Reference/AEB Function/Run_CllsnRednByBrkgCtrl_Step_Func/Run_CllsnRednByBrkg_Step/CollisionMitigationSystem/EvaluationCMbBInput/CritLgtEvaluation/Deactivate/NoBrakingRequiredTime/TimeActive/HICNTR_1" /begin REF_MEASUREMENT autosar_swc_aeb_rtARID_DEF.UD_1_DSTATE_l /end REF_MEASUREMENT /end GROUP
/begin GROUP autosar_swc_aeb_autosar_swc_aeb_Step_sys_Subsystem_Reference_AEB_Function_Run_CllsnRednByBrkgCtrl_Step_Func_Run_CllsnRednByBrkg_Step_CollisionMitigationSystem_EvaluationCMbBInput_CritLgtEvaluation_Deactivate_ObjDataChangeDetection "autosar_swc_aeb/autosar_swc_aeb_Step_sys/Subsystem Reference/AEB Function/Run_CllsnRednByBrkgCtrl_Step_Func/Run_CllsnRednByBrkg_Step/CollisionMitigationSystem/EvaluationCMbBInput/CritLgtEvaluation/Deactivate/ObjDataChangeDetection"
 /begin REF_CHARACTERISTIC CMBB_ChgPosnLatThdInCllsnRednByBrkg_Ca CMBB_ChgPosnLgtThdInCllsnRednByBrkg_Ca CMBB_ChgTiToCllsnThdInCllsnRednByBrkg_Ca /end REF_CHARACTERISTIC
 /begin REF_MEASUREMENT autosar_swc_aeb_rtARID_DEF.UnitDelay1_DSTATE_m autosar_swc_aeb_rtARID_DEF.UnitDelay2_DSTATE_j autosar_swc_aeb_rtARID_DEF.UnitDelay_DSTATE_p /end REF_MEASUREMENT
/end GROUP
/begin GROUP autosar_swc_aeb_autosar_swc_aeb_Step_sys_Subsystem_Reference_AEB_Function_Run_CllsnRednByBrkgCtrl_Step_Func_Run_CllsnRednByBrkg_Step_CollisionMitigationSystem_EvaluationCMbBInput_CritLgtEvaluation_Deactivate_SetOffFlag "autosar_swc_aeb/autosar_swc_aeb_Step_sys/Subsystem Reference/AEB Function/Run_CllsnRednByBrkgCtrl_Step_Func/Run_CllsnRednByBrkg_Step/CollisionMitigationSystem/EvaluationCMbBInput/CritLgtEvaluation/Deactivate/SetOffFlag"
 /begin SUB_GROUP autosar_swc_aeb_autosar_swc_aeb_Step_sys_Subsystem_Reference_AEB_Function_Run_CllsnRednByBrkgCtrl_Step_Func_Run_CllsnRednByBrkg_Step_CollisionMitigationSystem_EvaluationCMbBInput_CritLgtEvaluation_Deactivate_SetOffFlag_ObjChangeDetection autosar_swc_aeb_autosar_swc_aeb_Step_sys_Subsystem_Reference_AEB_Function_Run_CllsnRednByBrkgCtrl_Step_Func_Run_CllsnRednByBrkg_Step_CollisionMitigationSystem_EvaluationCMbBInput_CritLgtEvaluation_Deactivate_SetOffFlag_ObjStateDeactivation /end SUB_GROUP
 /begin REF_CHARACTERISTIC CMBB_MinVLgtObjDeActALgtReqInCllsnRednByBrkg_Ca CMBB_TiToDeactvtBrkgAftNoCritCtaInCllsnRednByBrkg_Ca CMBB_TiToDeactvtBrkgAftNoTiToCllsnCtaInCllsnRednByBrkg_Ca CMBB_TiToDeactvtBrkgAftVehStatyInCllsnRednByBrkg_Ca /end REF_CHARACTERISTIC
/end GROUP
/begin GROUP autosar_swc_aeb_autosar_swc_aeb_Step_sys_Subsystem_Reference_AEB_Function_Run_CllsnRednByBrkgCtrl_Step_Func_Run_CllsnRednByBrkg_Step_CollisionMitigationSystem_EvaluationCMbBInput_CritLgtEvaluation_Deactivate_SetOffFlag_ObjChangeDetection "autosar_swc_aeb/autosar_swc_aeb_Step_sys/Subsystem Reference/AEB Function/Run_CllsnRednByBrkgCtrl_Step_Func/Run_CllsnRednByBrkg_Step/CollisionMitigationSystem/EvaluationCMbBInput/CritLgtEvaluation/Deactivate/SetOffFlag/ObjChangeDetection" /begin REF_MEASUREMENT autosar_swc_aeb_rtARID_DEF.UnitDelay1_DSTATE_gl /end REF_MEASUREMENT /end GROUP
/begin GROUP autosar_swc_aeb_autosar_swc_aeb_Step_sys_Subsystem_Reference_AEB_Function_Run_CllsnRednByBrkgCtrl_Step_Func_Run_CllsnRednByBrkg_Step_CollisionMitigationSystem_EvaluationCMbBInput_CritLgtEvaluation_Deactivate_SetOffFlag_ObjStateDeactivation "autosar_swc_aeb/autosar_swc_aeb_Step_sys/Subsystem Reference/AEB Function/Run_CllsnRednByBrkgCtrl_Step_Func/Run_CllsnRednByBrkg_Step/CollisionMitigationSystem/EvaluationCMbBInput/CritLgtEvaluation/Deactivate/SetOffFlag/ObjStateDeactivation" /begin REF_CHARACTERISTIC CMBB_TimeDelayDeactivationInCllsnRednByBrkg_Ca /end REF_CHARACTERISTIC
 /begin REF_MEASUREMENT autosar_swc_aeb_rtARID_DEF.Deactivation autosar_swc_aeb_rtARID_DEF.TimePendingDeactivation autosar_swc_aeb_rtARID_DEF.is_active_c383_autosar_swc_aeb autosar_swc_aeb_rtARID_DEF.is_c383_autosar_swc_aeb /end REF_MEASUREMENT
/end GROUP
/begin GROUP autosar_swc_aeb_autosar_swc_aeb_Step_sys_Subsystem_Reference_AEB_Function_Run_CllsnRednByBrkgCtrl_Step_Func_Run_CllsnRednByBrkg_Step_CollisionMitigationSystem_EvaluationCMbBInput_CritLgtEvaluation_Deactivate_VehicleStationaryTime "autosar_swc_aeb/autosar_swc_aeb_Step_sys/Subsystem Reference/AEB Function/Run_CllsnRednByBrkgCtrl_Step_Func/Run_CllsnRednByBrkg_Step/CollisionMitigationSystem/EvaluationCMbBInput/CritLgtEvaluation/Deactivate/VehicleStationaryTime"
 /begin SUB_GROUP autosar_swc_aeb_autosar_swc_aeb_Step_sys_Subsystem_Reference_AEB_Function_Run_CllsnRednByBrkgCtrl_Step_Func_Run_CllsnRednByBrkg_Step_CollisionMitigationSystem_EvaluationCMbBInput_CritLgtEvaluation_Deactivate_VehicleStationaryTime_TimeActive /end SUB_GROUP
/end GROUP
/begin GROUP autosar_swc_aeb_autosar_swc_aeb_Step_sys_Subsystem_Reference_AEB_Function_Run_CllsnRednByBrkgCtrl_Step_Func_Run_CllsnRednByBrkg_Step_CollisionMitigationSystem_EvaluationCMbBInput_CritLgtEvaluation_Deactivate_VehicleStationaryTime_TimeActive "autosar_swc_aeb/autosar_swc_aeb_Step_sys/Subsystem Reference/AEB Function/Run_CllsnRednByBrkgCtrl_Step_Func/Run_CllsnRednByBrkg_Step/CollisionMitigationSystem/EvaluationCMbBInput/CritLgtEvaluation/Deactivate/VehicleStationaryTime/TimeActive"
 /begin SUB_GROUP autosar_swc_aeb_autosar_swc_aeb_Step_sys_Subsystem_Reference_AEB_Function_Run_CllsnRednByBrkgCtrl_Step_Func_Run_CllsnRednByBrkg_Step_CollisionMitigationSystem_EvaluationCMbBInput_CritLgtEvaluation_Deactivate_VehicleStationaryTime_TimeActive_HICNTR_1 /end SUB_GROUP
/end GROUP
/begin GROUP autosar_swc_aeb_autosar_swc_aeb_Step_sys_Subsystem_Reference_AEB_Function_Run_CllsnRednByBrkgCtrl_Step_Func_Run_CllsnRednByBrkg_Step_CollisionMitigationSystem_EvaluationCMbBInput_CritLgtEvaluation_Deactivate_VehicleStationaryTime_TimeActive_HICNTR_1 "autosar_swc_aeb/autosar_swc_aeb_Step_sys/Subsystem Reference/AEB Function/Run_CllsnRednByBrkgCtrl_Step_Func/Run_CllsnRednByBrkg_Step/CollisionMitigationSystem/EvaluationCMbBInput/CritLgtEvaluation/Deactivate/VehicleStationaryTime/TimeActive/HICNTR_1" /begin REF_MEASUREMENT autosar_swc_aeb_rtARID_DEF.UD_1_DSTATE_c /end REF_MEASUREMENT /end GROUP
/begin GROUP autosar_swc_aeb_autosar_swc_aeb_Step_sys_Subsystem_Reference_AEB_Function_Run_CllsnRednByBrkgCtrl_Step_Func_Run_CllsnRednByBrkg_Step_CollisionMitigationSystem_EvaluationCMbBInput_CritLgtEvaluation_DetermineBrakingThreat "autosar_swc_aeb/autosar_swc_aeb_Step_sys/Subsystem Reference/AEB Function/Run_CllsnRednByBrkgCtrl_Step_Func/Run_CllsnRednByBrkg_Step/CollisionMitigationSystem/EvaluationCMbBInput/CritLgtEvaluation/DetermineBrakingThreat"
 /begin REF_CHARACTERISTIC CMBB_TiToActvtConfInCllsnRednByBrkg_Ca CMBB_TiToActvtConfLongInCllsnRednByBrkg_Ca /end REF_CHARACTERISTIC
 /begin REF_MEASUREMENT autosar_swc_aeb_rtARID_DEF.Threat autosar_swc_aeb_rtARID_DEF.TimeConfidence autosar_swc_aeb_rtARID_DEF.TimeThreat autosar_swc_aeb_rtARID_DEF.is_Threat autosar_swc_aeb_rtARID_DEF.is_ThreatConfirmed autosar_swc_aeb_rtARID_DEF.is_ThreatPreliminary autosar_swc_aeb_rtARID_DEF.is_active_c384_autosar_swc_aeb autosar_swc_aeb_rtARID_DEF.is_c384_autosar_swc_aeb /end REF_MEASUREMENT
/end GROUP
/begin GROUP autosar_swc_aeb_autosar_swc_aeb_Step_sys_Subsystem_Reference_AEB_Function_Run_CllsnRednByBrkgCtrl_Step_Func_Run_CllsnRednByBrkg_Step_CollisionMitigationSystem_EvaluationCMbBInput_CritLgtEvaluation_EvaluateFullBrakingConditions "autosar_swc_aeb/autosar_swc_aeb_Step_sys/Subsystem Reference/AEB Function/Run_CllsnRednByBrkgCtrl_Step_Func/Run_CllsnRednByBrkg_Step/CollisionMitigationSystem/EvaluationCMbBInput/CritLgtEvaluation/EvaluateFullBrakingConditions"
 /begin SUB_GROUP autosar_swc_aeb_autosar_swc_aeb_Step_sys_Subsystem_Reference_AEB_Function_Run_CllsnRednByBrkgCtrl_Step_Func_Run_CllsnRednByBrkg_Step_CollisionMitigationSystem_EvaluationCMbBInput_CritLgtEvaluation_EvaluateFullBrakingConditions_AccelerationThreat autosar_swc_aeb_autosar_swc_aeb_Step_sys_Subsystem_Reference_AEB_Function_Run_CllsnRednByBrkgCtrl_Step_Func_Run_CllsnRednByBrkg_Step_CollisionMitigationSystem_EvaluationCMbBInput_CritLgtEvaluation_EvaluateFullBrakingConditions_BrakingThreat autosar_swc_aeb_autosar_swc_aeb_Step_sys_Subsystem_Reference_AEB_Function_Run_CllsnRednByBrkgCtrl_Step_Func_Run_CllsnRednByBrkg_Step_CollisionMitigationSystem_EvaluationCMbBInput_CritLgtEvaluation_EvaluateFullBrakingConditions_SteeringThreat /end SUB_GROUP
/end GROUP
/begin GROUP autosar_swc_aeb_autosar_swc_aeb_Step_sys_Subsystem_Reference_AEB_Function_Run_CllsnRednByBrkgCtrl_Step_Func_Run_CllsnRednByBrkg_Step_CollisionMitigationSystem_EvaluationCMbBInput_CritLgtEvaluation_EvaluateFullBrakingConditions_AccelerationThreat "autosar_swc_aeb/autosar_swc_aeb_Step_sys/Subsystem Reference/AEB Function/Run_CllsnRednByBrkgCtrl_Step_Func/Run_CllsnRednByBrkg_Step/CollisionMitigationSystem/EvaluationCMbBInput/CritLgtEvaluation/EvaluateFullBrakingConditions/AccelerationThreat" /begin REF_CHARACTERISTIC CMBB_TiMaxForBypOfAPosThdInCllsnRednByBrkg_Ca /end REF_CHARACTERISTIC /end GROUP
/begin GROUP autosar_swc_aeb_autosar_swc_aeb_Step_sys_Subsystem_Reference_AEB_Function_Run_CllsnRednByBrkgCtrl_Step_Func_Run_CllsnRednByBrkg_Step_CollisionMitigationSystem_EvaluationCMbBInput_CritLgtEvaluation_EvaluateFullBrakingConditions_BrakingThreat "autosar_swc_aeb/autosar_swc_aeb_Step_sys/Subsystem Reference/AEB Function/Run_CllsnRednByBrkgCtrl_Step_Func/Run_CllsnRednByBrkg_Step/CollisionMitigationSystem/EvaluationCMbBInput/CritLgtEvaluation/EvaluateFullBrakingConditions/BrakingThreat"
 /begin REF_CHARACTERISTIC CMBB_ALgtThdForFullBrakeCllsnRedByBrkg_Ca CMBB_ObjPosLgtForALgtThdForFullBrakeCllsnRedByBrkg_Ca P_AEB_FullBrakeSpeedComp P_AEB_FullThreatSpeed /end REF_CHARACTERISTIC
/end GROUP
/begin GROUP autosar_swc_aeb_autosar_swc_aeb_Step_sys_Subsystem_Reference_AEB_Function_Run_CllsnRednByBrkgCtrl_Step_Func_Run_CllsnRednByBrkg_Step_CollisionMitigationSystem_EvaluationCMbBInput_CritLgtEvaluation_EvaluateFullBrakingConditions_SteeringThreat "autosar_swc_aeb/autosar_swc_aeb_Step_sys/Subsystem Reference/AEB Function/Run_CllsnRednByBrkgCtrl_Step_Func/Run_CllsnRednByBrkg_Step/CollisionMitigationSystem/EvaluationCMbBInput/CritLgtEvaluation/EvaluateFullBrakingConditions/SteeringThreat"
 /begin SUB_GROUP autosar_swc_aeb_autosar_swc_aeb_Step_sys_Subsystem_Reference_AEB_Function_Run_CllsnRednByBrkgCtrl_Step_Func_Run_CllsnRednByBrkg_Step_CollisionMitigationSystem_EvaluationCMbBInput_CritLgtEvaluation_EvaluateFullBrakingConditions_SteeringThreat_Determine_ALatThreat /end SUB_GROUP
 /begin REF_CHARACTERISTIC CMBB_MplTarEnaInCllsnRednByBrkg_Ca /end REF_CHARACTERISTIC
/end GROUP
/begin GROUP autosar_swc_aeb_autosar_swc_aeb_Step_sys_Subsystem_Reference_AEB_Function_Run_CllsnRednByBrkgCtrl_Step_Func_Run_CllsnRednByBrkg_Step_CollisionMitigationSystem_EvaluationCMbBInput_CritLgtEvaluation_EvaluateFullBrakingConditions_SteeringThreat_Determine_ALatThreat "autosar_swc_aeb/autosar_swc_aeb_Step_sys/Subsystem Reference/AEB Function/Run_CllsnRednByBrkgCtrl_Step_Func/Run_CllsnRednByBrkg_Step/CollisionMitigationSystem/EvaluationCMbBInput/CritLgtEvaluation/EvaluateFullBrakingConditions/SteeringThreat/Determine ALatThreat" /begin REF_CHARACTERISTIC P_AEB_ALatForFullbrake P_AEB_FullThreatSpeed /end REF_CHARACTERISTIC /end GROUP
/begin GROUP autosar_swc_aeb_autosar_swc_aeb_Step_sys_Subsystem_Reference_AEB_Function_Run_CllsnRednByBrkgCtrl_Step_Func_Run_CllsnRednByBrkg_Step_CollisionMitigationSystem_EvaluationCMbBInput_CritLgtEvaluation_EvaluatePreBrakingConditions "autosar_swc_aeb/autosar_swc_aeb_Step_sys/Subsystem Reference/AEB Function/Run_CllsnRednByBrkgCtrl_Step_Func/Run_CllsnRednByBrkg_Step/CollisionMitigationSystem/EvaluationCMbBInput/CritLgtEvaluation/EvaluatePreBrakingConditions"
 /begin SUB_GROUP autosar_swc_aeb_autosar_swc_aeb_Step_sys_Subsystem_Reference_AEB_Function_Run_CllsnRednByBrkgCtrl_Step_Func_Run_CllsnRednByBrkg_Step_CollisionMitigationSystem_EvaluationCMbBInput_CritLgtEvaluation_EvaluatePreBrakingConditions_AccelerationThreat autosar_swc_aeb_autosar_swc_aeb_Step_sys_Subsystem_Reference_AEB_Function_Run_CllsnRednByBrkgCtrl_Step_Func_Run_CllsnRednByBrkg_Step_CollisionMitigationSystem_EvaluationCMbBInput_CritLgtEvaluation_EvaluatePreBrakingConditions_BrakingThreat autosar_swc_aeb_autosar_swc_aeb_Step_sys_Subsystem_Reference_AEB_Function_Run_CllsnRednByBrkgCtrl_Step_Func_Run_CllsnRednByBrkg_Step_CollisionMitigationSystem_EvaluationCMbBInput_CritLgtEvaluation_EvaluatePreBrakingConditions_ObjConfOK autosar_swc_aeb_autosar_swc_aeb_Step_sys_Subsystem_Reference_AEB_Function_Run_CllsnRednByBrkgCtrl_Step_Func_Run_CllsnRednByBrkg_Step_CollisionMitigationSystem_EvaluationCMbBInput_CritLgtEvaluation_EvaluatePreBrakingConditions_SteeringThreat /end SUB_GROUP
 /begin REF_CHARACTERISTIC P_AEB_NotUseSteerThreat /end REF_CHARACTERISTIC
 /begin REF_MEASUREMENT AEB_AccelerationThreat AEB_CommonInhibit AEB_ObjConfOK AEB_SteeringThreat /end REF_MEASUREMENT
/end GROUP
/begin GROUP autosar_swc_aeb_autosar_swc_aeb_Step_sys_Subsystem_Reference_AEB_Function_Run_CllsnRednByBrkgCtrl_Step_Func_Run_CllsnRednByBrkg_Step_CollisionMitigationSystem_EvaluationCMbBInput_CritLgtEvaluation_EvaluatePreBrakingConditions_AccelerationThreat "autosar_swc_aeb/autosar_swc_aeb_Step_sys/Subsystem Reference/AEB Function/Run_CllsnRednByBrkgCtrl_Step_Func/Run_CllsnRednByBrkg_Step/CollisionMitigationSystem/EvaluationCMbBInput/CritLgtEvaluation/EvaluatePreBrakingConditions/AccelerationThreat" /begin REF_CHARACTERISTIC CMBB_TiMaxForBypOfAPosThdInCllsnRednByBrkg_Ca /end REF_CHARACTERISTIC /end GROUP
/begin GROUP autosar_swc_aeb_autosar_swc_aeb_Step_sys_Subsystem_Reference_AEB_Function_Run_CllsnRednByBrkgCtrl_Step_Func_Run_CllsnRednByBrkg_Step_CollisionMitigationSystem_EvaluationCMbBInput_CritLgtEvaluation_EvaluatePreBrakingConditions_BrakingThreat "autosar_swc_aeb/autosar_swc_aeb_Step_sys/Subsystem Reference/AEB Function/Run_CllsnRednByBrkgCtrl_Step_Func/Run_CllsnRednByBrkg_Step/CollisionMitigationSystem/EvaluationCMbBInput/CritLgtEvaluation/EvaluatePreBrakingConditions/BrakingThreat"
 /begin REF_CHARACTERISTIC CMBB_ALgtThdForCPTAPreBrakeCllsnRedByBrkg_Ca CMBB_ALgtThdForPreBrakeCllsnRedByBrkg_Ca CMBB_ObjPosLgtForALgtThdForCPTAPreBrakeCllsnRedByBrkg_Ca CMBB_ObjPosLgtForALgtThdForPreBrakeCllsnRedByBrkg_Ca P_AEB_PreBrakeSpeedComp P_AEB_PreThreatSpeed /end REF_CHARACTERISTIC
/end GROUP
/begin GROUP autosar_swc_aeb_autosar_swc_aeb_Step_sys_Subsystem_Reference_AEB_Function_Run_CllsnRednByBrkgCtrl_Step_Func_Run_CllsnRednByBrkg_Step_CollisionMitigationSystem_EvaluationCMbBInput_CritLgtEvaluation_EvaluatePreBrakingConditions_ObjConfOK "autosar_swc_aeb/autosar_swc_aeb_Step_sys/Subsystem Reference/AEB Function/Run_CllsnRednByBrkgCtrl_Step_Func/Run_CllsnRednByBrkg_Step/CollisionMitigationSystem/EvaluationCMbBInput/CritLgtEvaluation/EvaluatePreBrakingConditions/ObjConfOK" /begin REF_MEASUREMENT AEB_ObjConfOK /end REF_MEASUREMENT /end GROUP
/begin GROUP autosar_swc_aeb_autosar_swc_aeb_Step_sys_Subsystem_Reference_AEB_Function_Run_CllsnRednByBrkgCtrl_Step_Func_Run_CllsnRednByBrkg_Step_CollisionMitigationSystem_EvaluationCMbBInput_CritLgtEvaluation_EvaluatePreBrakingConditions_SteeringThreat "autosar_swc_aeb/autosar_swc_aeb_Step_sys/Subsystem Reference/AEB Function/Run_CllsnRednByBrkgCtrl_Step_Func/Run_CllsnRednByBrkg_Step/CollisionMitigationSystem/EvaluationCMbBInput/CritLgtEvaluation/EvaluatePreBrakingConditions/SteeringThreat"
 /begin SUB_GROUP autosar_swc_aeb_autosar_swc_aeb_Step_sys_Subsystem_Reference_AEB_Function_Run_CllsnRednByBrkgCtrl_Step_Func_Run_CllsnRednByBrkg_Step_CollisionMitigationSystem_EvaluationCMbBInput_CritLgtEvaluation_EvaluatePreBrakingConditions_SteeringThreat_Determine_ALatThreat /end SUB_GROUP
 /begin REF_CHARACTERISTIC CMBB_MplTarEnaInCllsnRednByBrkg_Ca /end REF_CHARACTERISTIC
/end GROUP
/begin GROUP autosar_swc_aeb_autosar_swc_aeb_Step_sys_Subsystem_Reference_AEB_Function_Run_CllsnRednByBrkgCtrl_Step_Func_Run_CllsnRednByBrkg_Step_CollisionMitigationSystem_EvaluationCMbBInput_CritLgtEvaluation_EvaluatePreBrakingConditions_SteeringThreat_Determine_ALatThreat "autosar_swc_aeb/autosar_swc_aeb_Step_sys/Subsystem Reference/AEB Function/Run_CllsnRednByBrkgCtrl_Step_Func/Run_CllsnRednByBrkg_Step/CollisionMitigationSystem/EvaluationCMbBInput/CritLgtEvaluation/EvaluatePreBrakingConditions/SteeringThreat/Determine ALatThreat" /begin REF_CHARACTERISTIC P_AEB_ALatForPrebrake P_AEB_PreThreatSpeed /end REF_CHARACTERISTIC /end GROUP
/begin GROUP autosar_swc_aeb_autosar_swc_aeb_Step_sys_Subsystem_Reference_AEB_Function_Run_CllsnRednByBrkgCtrl_Step_Func_Run_CllsnRednByBrkg_Step_CollisionMitigationSystem_EvaluationCMbBInput_CritLgtEvaluation_Inhibit_Activation "autosar_swc_aeb/autosar_swc_aeb_Step_sys/Subsystem Reference/AEB Function/Run_CllsnRednByBrkgCtrl_Step_Func/Run_CllsnRednByBrkg_Step/CollisionMitigationSystem/EvaluationCMbBInput/CritLgtEvaluation/Inhibit Activation"
 /begin SUB_GROUP autosar_swc_aeb_autosar_swc_aeb_Step_sys_Subsystem_Reference_AEB_Function_Run_CllsnRednByBrkgCtrl_Step_Func_Run_CllsnRednByBrkg_Step_CollisionMitigationSystem_EvaluationCMbBInput_CritLgtEvaluation_Inhibit_Activation_ALgtFilter autosar_swc_aeb_autosar_swc_aeb_Step_sys_Subsystem_Reference_AEB_Function_Run_CllsnRednByBrkgCtrl_Step_Func_Run_CllsnRednByBrkg_Step_CollisionMitigationSystem_EvaluationCMbBInput_CritLgtEvaluation_Inhibit_Activation_HostAvoidInhibit autosar_swc_aeb_autosar_swc_aeb_Step_sys_Subsystem_Reference_AEB_Function_Run_CllsnRednByBrkgCtrl_Step_Func_Run_CllsnRednByBrkg_Step_CollisionMitigationSystem_EvaluationCMbBInput_CritLgtEvaluation_Inhibit_Activation_OncomingInhibit autosar_swc_aeb_autosar_swc_aeb_Step_sys_Subsystem_Reference_AEB_Function_Run_CllsnRednByBrkgCtrl_Step_Func_Run_CllsnRednByBrkg_Step_CollisionMitigationSystem_EvaluationCMbBInput_CritLgtEvaluation_Inhibit_Activation_SpdInhibit /end SUB_GROUP
/end GROUP
/begin GROUP autosar_swc_aeb_autosar_swc_aeb_Step_sys_Subsystem_Reference_AEB_Function_Run_CllsnRednByBrkgCtrl_Step_Func_Run_CllsnRednByBrkg_Step_CollisionMitigationSystem_EvaluationCMbBInput_CritLgtEvaluation_Inhibit_Activation_ALgtFilter "autosar_swc_aeb/autosar_swc_aeb_Step_sys/Subsystem Reference/AEB Function/Run_CllsnRednByBrkgCtrl_Step_Func/Run_CllsnRednByBrkg_Step/CollisionMitigationSystem/EvaluationCMbBInput/CritLgtEvaluation/Inhibit Activation/ALgtFilter"
 /begin SUB_GROUP autosar_swc_aeb_autosar_swc_aeb_Step_sys_Subsystem_Reference_AEB_Function_Run_CllsnRednByBrkgCtrl_Step_Func_Run_CllsnRednByBrkg_Step_CollisionMitigationSystem_EvaluationCMbBInput_CritLgtEvaluation_Inhibit_Activation_ALgtFilter_ButterworthHighPassFilterDrvrDecelReq /end SUB_GROUP
 /begin REF_CHARACTERISTIC CMBB_DrvrDecelReqMinBrkPedPsdInCllsnRednByBrkg_Ca /end REF_CHARACTERISTIC
/end GROUP
/begin GROUP autosar_swc_aeb_autosar_swc_aeb_Step_sys_Subsystem_Reference_AEB_Function_Run_CllsnRednByBrkgCtrl_Step_Func_Run_CllsnRednByBrkg_Step_CollisionMitigationSystem_EvaluationCMbBInput_CritLgtEvaluation_Inhibit_Activation_ALgtFilter_ButterworthHighPassFilterDrvrDecelReq "autosar_swc_aeb/autosar_swc_aeb_Step_sys/Subsystem Reference/AEB Function/Run_CllsnRednByBrkgCtrl_Step_Func/Run_CllsnRednByBrkg_Step/CollisionMitigationSystem/EvaluationCMbBInput/CritLgtEvaluation/Inhibit Activation/ALgtFilter/ButterworthHighPassFilterDrvrDecelReq"
 /begin REF_CHARACTERISTIC CMBB_DrvrDecelFiltParam1InCllsnInCllsnRednByBrkg_Ca CMBB_DrvrDecelFiltParam2InCllsnInCllsnRednByBrkg_Ca CMBB_DrvrDecelFiltParam3InCllsnInCllsnRednByBrkg_Ca CMBB_DrvrDecelFiltParam4InCllsnInCllsnRednByBrkg_Ca CMBB_DrvrDecelFiltParam5InCllsnInCllsnRednByBrkg_Ca /end REF_CHARACTERISTIC
 /begin REF_MEASUREMENT autosar_swc_aeb_rtARID_DEF.Delay1_DSTATE_l autosar_swc_aeb_rtARID_DEF.Delay3_DSTATE_g autosar_swc_aeb_rtARID_DEF.Delay5_DSTATE_c autosar_swc_aeb_rtARID_DEF.Delay_DSTATE_f /end REF_MEASUREMENT
/end GROUP
/begin GROUP autosar_swc_aeb_autosar_swc_aeb_Step_sys_Subsystem_Reference_AEB_Function_Run_CllsnRednByBrkgCtrl_Step_Func_Run_CllsnRednByBrkg_Step_CollisionMitigationSystem_EvaluationCMbBInput_CritLgtEvaluation_Inhibit_Activation_HostAvoidInhibit "autosar_swc_aeb/autosar_swc_aeb_Step_sys/Subsystem Reference/AEB Function/Run_CllsnRednByBrkgCtrl_Step_Func/Run_CllsnRednByBrkg_Step/CollisionMitigationSystem/EvaluationCMbBInput/CritLgtEvaluation/Inhibit Activation/HostAvoidInhibit"
 /begin REF_CHARACTERISTIC CMBB_ALatDiffThdForAutoBrake_Ca CMBB_ANegLgtRatThdForCllsnRednByBrkg_Ca /end REF_CHARACTERISTIC
/end GROUP
/begin GROUP autosar_swc_aeb_autosar_swc_aeb_Step_sys_Subsystem_Reference_AEB_Function_Run_CllsnRednByBrkgCtrl_Step_Func_Run_CllsnRednByBrkg_Step_CollisionMitigationSystem_EvaluationCMbBInput_CritLgtEvaluation_Inhibit_Activation_OncomingInhibit "autosar_swc_aeb/autosar_swc_aeb_Step_sys/Subsystem Reference/AEB Function/Run_CllsnRednByBrkgCtrl_Step_Func/Run_CllsnRednByBrkg_Step/CollisionMitigationSystem/EvaluationCMbBInput/CritLgtEvaluation/Inhibit Activation/OncomingInhibit"
 /begin SUB_GROUP autosar_swc_aeb_autosar_swc_aeb_Step_sys_Subsystem_Reference_AEB_Function_Run_CllsnRednByBrkgCtrl_Step_Func_Run_CllsnRednByBrkg_Step_CollisionMitigationSystem_EvaluationCMbBInput_CritLgtEvaluation_Inhibit_Activation_OncomingInhibit_LTAPInhibit autosar_swc_aeb_autosar_swc_aeb_Step_sys_Subsystem_Reference_AEB_Function_Run_CllsnRednByBrkgCtrl_Step_Func_Run_CllsnRednByBrkg_Step_CollisionMitigationSystem_EvaluationCMbBInput_CritLgtEvaluation_Inhibit_Activation_OncomingInhibit_PreProcessor /end SUB_GROUP
/end GROUP
/begin GROUP autosar_swc_aeb_autosar_swc_aeb_Step_sys_Subsystem_Reference_AEB_Function_Run_CllsnRednByBrkgCtrl_Step_Func_Run_CllsnRednByBrkg_Step_CollisionMitigationSystem_EvaluationCMbBInput_CritLgtEvaluation_Inhibit_Activation_OncomingInhibit_LTAPInhibit "autosar_swc_aeb/autosar_swc_aeb_Step_sys/Subsystem Reference/AEB Function/Run_CllsnRednByBrkgCtrl_Step_Func/Run_CllsnRednByBrkg_Step/CollisionMitigationSystem/EvaluationCMbBInput/CritLgtEvaluation/Inhibit Activation/OncomingInhibit/LTAPInhibit"
 /begin SUB_GROUP autosar_swc_aeb_autosar_swc_aeb_Step_sys_Subsystem_Reference_AEB_Function_Run_CllsnRednByBrkgCtrl_Step_Func_Run_CllsnRednByBrkg_Step_CollisionMitigationSystem_EvaluationCMbBInput_CritLgtEvaluation_Inhibit_Activation_OncomingInhibit_LTAPInhibit_CheckDrivingSide autosar_swc_aeb_autosar_swc_aeb_Step_sys_Subsystem_Reference_AEB_Function_Run_CllsnRednByBrkgCtrl_Step_Func_Run_CllsnRednByBrkg_Step_CollisionMitigationSystem_EvaluationCMbBInput_CritLgtEvaluation_Inhibit_Activation_OncomingInhibit_LTAPInhibit_CheckTargetAngle autosar_swc_aeb_autosar_swc_aeb_Step_sys_Subsystem_Reference_AEB_Function_Run_CllsnRednByBrkgCtrl_Step_Func_Run_CllsnRednByBrkg_Step_CollisionMitigationSystem_EvaluationCMbBInput_CritLgtEvaluation_Inhibit_Activation_OncomingInhibit_LTAPInhibit_IntegrateAngle autosar_swc_aeb_autosar_swc_aeb_Step_sys_Subsystem_Reference_AEB_Function_Run_CllsnRednByBrkgCtrl_Step_Func_Run_CllsnRednByBrkg_Step_CollisionMitigationSystem_EvaluationCMbBInput_CritLgtEvaluation_Inhibit_Activation_OncomingInhibit_LTAPInhibit_TrackRecentStartDriving /end SUB_GROUP
/end GROUP
/begin GROUP autosar_swc_aeb_autosar_swc_aeb_Step_sys_Subsystem_Reference_AEB_Function_Run_CllsnRednByBrkgCtrl_Step_Func_Run_CllsnRednByBrkg_Step_CollisionMitigationSystem_EvaluationCMbBInput_CritLgtEvaluation_Inhibit_Activation_OncomingInhibit_LTAPInhibit_CheckDrivingSide "autosar_swc_aeb/autosar_swc_aeb_Step_sys/Subsystem Reference/AEB Function/Run_CllsnRednByBrkgCtrl_Step_Func/Run_CllsnRednByBrkg_Step/CollisionMitigationSystem/EvaluationCMbBInput/CritLgtEvaluation/Inhibit Activation/OncomingInhibit/LTAPInhibit/CheckDrivingSide" /begin REF_CHARACTERISTIC CMBB_NrOfObjThdForDrvgSideInCllsnRednByBrkg_Ca /end REF_CHARACTERISTIC /begin REF_MEASUREMENT autosar_swc_aeb_rtARID_DEF.NotTAP /end REF_MEASUREMENT /end GROUP
/begin GROUP autosar_swc_aeb_autosar_swc_aeb_Step_sys_Subsystem_Reference_AEB_Function_Run_CllsnRednByBrkgCtrl_Step_Func_Run_CllsnRednByBrkg_Step_CollisionMitigationSystem_EvaluationCMbBInput_CritLgtEvaluation_Inhibit_Activation_OncomingInhibit_LTAPInhibit_CheckTargetAngle "autosar_swc_aeb/autosar_swc_aeb_Step_sys/Subsystem Reference/AEB Function/Run_CllsnRednByBrkgCtrl_Step_Func/Run_CllsnRednByBrkg_Step/CollisionMitigationSystem/EvaluationCMbBInput/CritLgtEvaluation/Inhibit Activation/OncomingInhibit/LTAPInhibit/CheckTargetAngle"
 /begin REF_CHARACTERISTIC CMBB_AgDirThdForOldPosnForVehDrvgToSelfInCllsnRednByBrkg_Ca /end REF_CHARACTERISTIC
/end GROUP
/begin GROUP autosar_swc_aeb_autosar_swc_aeb_Step_sys_Subsystem_Reference_AEB_Function_Run_CllsnRednByBrkgCtrl_Step_Func_Run_CllsnRednByBrkg_Step_CollisionMitigationSystem_EvaluationCMbBInput_CritLgtEvaluation_Inhibit_Activation_OncomingInhibit_LTAPInhibit_IntegrateAngle "autosar_swc_aeb/autosar_swc_aeb_Step_sys/Subsystem Reference/AEB Function/Run_CllsnRednByBrkgCtrl_Step_Func/Run_CllsnRednByBrkg_Step/CollisionMitigationSystem/EvaluationCMbBInput/CritLgtEvaluation/Inhibit Activation/OncomingInhibit/LTAPInhibit/IntegrateAngle"
 /begin REF_MEASUREMENT autosar_swc_aeb_rtARID_DEF.YawRateSum autosar_swc_aeb_rtARID_DEF.YawRateVector autosar_swc_aeb_rtARID_DEF.YawRateVectorIndex /end REF_MEASUREMENT
/end GROUP
/begin GROUP autosar_swc_aeb_autosar_swc_aeb_Step_sys_Subsystem_Reference_AEB_Function_Run_CllsnRednByBrkgCtrl_Step_Func_Run_CllsnRednByBrkg_Step_CollisionMitigationSystem_EvaluationCMbBInput_CritLgtEvaluation_Inhibit_Activation_OncomingInhibit_LTAPInhibit_TrackRecentStartDriving "autosar_swc_aeb/autosar_swc_aeb_Step_sys/Subsystem Reference/AEB Function/Run_CllsnRednByBrkgCtrl_Step_Func/Run_CllsnRednByBrkg_Step/CollisionMitigationSystem/EvaluationCMbBInput/CritLgtEvaluation/Inhibit Activation/OncomingInhibit/LTAPInhibit/TrackRecentStartDriving"
 /begin SUB_GROUP autosar_swc_aeb_autosar_swc_aeb_Step_sys_Subsystem_Reference_AEB_Function_Run_CllsnRednByBrkgCtrl_Step_Func_Run_CllsnRednByBrkg_Step_CollisionMitigationSystem_EvaluationCMbBInput_CritLgtEvaluation_Inhibit_Activation_OncomingInhibit_LTAPInhibit_TrackRecentStartDriving_DetectTransitionToFalse autosar_swc_aeb_autosar_swc_aeb_Step_sys_Subsystem_Reference_AEB_Function_Run_CllsnRednByBrkgCtrl_Step_Func_Run_CllsnRednByBrkg_Step_CollisionMitigationSystem_EvaluationCMbBInput_CritLgtEvaluation_Inhibit_Activation_OncomingInhibit_LTAPInhibit_TrackRecentStartDriving_OffDelayBlock /end SUB_GROUP
 /begin REF_CHARACTERISTIC CMBB_StoreTiForPinionSteerAgSpdInCllsnRednByBrkg_Ca /end REF_CHARACTERISTIC
/end GROUP
/begin GROUP autosar_swc_aeb_autosar_swc_aeb_Step_sys_Subsystem_Reference_AEB_Function_Run_CllsnRednByBrkgCtrl_Step_Func_Run_CllsnRednByBrkg_Step_CollisionMitigationSystem_EvaluationCMbBInput_CritLgtEvaluation_Inhibit_Activation_OncomingInhibit_LTAPInhibit_TrackRecentStartDriving_DetectTransitionToFalse "autosar_swc_aeb/autosar_swc_aeb_Step_sys/Subsystem Reference/AEB Function/Run_CllsnRednByBrkgCtrl_Step_Func/Run_CllsnRednByBrkg_Step/CollisionMitigationSystem/EvaluationCMbBInput/CritLgtEvaluation/Inhibit Activation/OncomingInhibit/LTAPInhibit/TrackRecentStartDriving/DetectTransitionToFalse" /begin REF_MEASUREMENT autosar_swc_aeb_rtARID_DEF.UnitDelay_DSTATE_ga /end REF_MEASUREMENT /end GROUP
/begin GROUP autosar_swc_aeb_autosar_swc_aeb_Step_sys_Subsystem_Reference_AEB_Function_Run_CllsnRednByBrkgCtrl_Step_Func_Run_CllsnRednByBrkg_Step_CollisionMitigationSystem_EvaluationCMbBInput_CritLgtEvaluation_Inhibit_Activation_OncomingInhibit_LTAPInhibit_TrackRecentStartDriving_OffDelayBlock "autosar_swc_aeb/autosar_swc_aeb_Step_sys/Subsystem Reference/AEB Function/Run_CllsnRednByBrkgCtrl_Step_Func/Run_CllsnRednByBrkg_Step/CollisionMitigationSystem/EvaluationCMbBInput/CritLgtEvaluation/Inhibit Activation/OncomingInhibit/LTAPInhibit/TrackRecentStartDriving/OffDelayBlock" /begin REF_MEASUREMENT autosar_swc_aeb_rtARID_DEF.UnitDelay_DSTATE_b /end REF_MEASUREMENT /end GROUP
/begin GROUP autosar_swc_aeb_autosar_swc_aeb_Step_sys_Subsystem_Reference_AEB_Function_Run_CllsnRednByBrkgCtrl_Step_Func_Run_CllsnRednByBrkg_Step_CollisionMitigationSystem_EvaluationCMbBInput_CritLgtEvaluation_Inhibit_Activation_OncomingInhibit_PreProcessor "autosar_swc_aeb/autosar_swc_aeb_Step_sys/Subsystem Reference/AEB Function/Run_CllsnRednByBrkgCtrl_Step_Func/Run_CllsnRednByBrkg_Step/CollisionMitigationSystem/EvaluationCMbBInput/CritLgtEvaluation/Inhibit Activation/OncomingInhibit/PreProcessor"
 /begin SUB_GROUP autosar_swc_aeb_autosar_swc_aeb_Step_sys_Subsystem_Reference_AEB_Function_Run_CllsnRednByBrkgCtrl_Step_Func_Run_CllsnRednByBrkg_Step_CollisionMitigationSystem_EvaluationCMbBInput_CritLgtEvaluation_Inhibit_Activation_OncomingInhibit_PreProcessor_CalculateCurrentCurvature autosar_swc_aeb_autosar_swc_aeb_Step_sys_Subsystem_Reference_AEB_Function_Run_CllsnRednByBrkgCtrl_Step_Func_Run_CllsnRednByBrkg_Step_CollisionMitigationSystem_EvaluationCMbBInput_CritLgtEvaluation_Inhibit_Activation_OncomingInhibit_PreProcessor_CheckSCurve autosar_swc_aeb_autosar_swc_aeb_Step_sys_Subsystem_Reference_AEB_Function_Run_CllsnRednByBrkgCtrl_Step_Func_Run_CllsnRednByBrkg_Step_CollisionMitigationSystem_EvaluationCMbBInput_CritLgtEvaluation_Inhibit_Activation_OncomingInhibit_PreProcessor_CheckTargetCurvature autosar_swc_aeb_autosar_swc_aeb_Step_sys_Subsystem_Reference_AEB_Function_Run_CllsnRednByBrkgCtrl_Step_Func_Run_CllsnRednByBrkg_Step_CollisionMitigationSystem_EvaluationCMbBInput_CritLgtEvaluation_Inhibit_Activation_OncomingInhibit_PreProcessor_CheckTurning autosar_swc_aeb_autosar_swc_aeb_Step_sys_Subsystem_Reference_AEB_Function_Run_CllsnRednByBrkgCtrl_Step_Func_Run_CllsnRednByBrkg_Step_CollisionMitigationSystem_EvaluationCMbBInput_CritLgtEvaluation_Inhibit_Activation_OncomingInhibit_PreProcessor_TrackRecentChangeOfTurnChange /end SUB_GROUP
/end GROUP
/begin GROUP autosar_swc_aeb_autosar_swc_aeb_Step_sys_Subsystem_Reference_AEB_Function_Run_CllsnRednByBrkgCtrl_Step_Func_Run_CllsnRednByBrkg_Step_CollisionMitigationSystem_EvaluationCMbBInput_CritLgtEvaluation_Inhibit_Activation_OncomingInhibit_PreProcessor_CalculateCurrentCurvature "autosar_swc_aeb/autosar_swc_aeb_Step_sys/Subsystem Reference/AEB Function/Run_CllsnRednByBrkgCtrl_Step_Func/Run_CllsnRednByBrkg_Step/CollisionMitigationSystem/EvaluationCMbBInput/CritLgtEvaluation/Inhibit Activation/OncomingInhibit/PreProcessor/CalculateCurrentCurvature" /begin REF_CHARACTERISTIC CMBB_SpdThdForYawRateCrvtInCllsnRednByBrkg_Ca /end REF_CHARACTERISTIC /end GROUP
/begin GROUP autosar_swc_aeb_autosar_swc_aeb_Step_sys_Subsystem_Reference_AEB_Function_Run_CllsnRednByBrkgCtrl_Step_Func_Run_CllsnRednByBrkg_Step_CollisionMitigationSystem_EvaluationCMbBInput_CritLgtEvaluation_Inhibit_Activation_OncomingInhibit_PreProcessor_CheckSCurve "autosar_swc_aeb/autosar_swc_aeb_Step_sys/Subsystem Reference/AEB Function/Run_CllsnRednByBrkgCtrl_Step_Func/Run_CllsnRednByBrkg_Step/CollisionMitigationSystem/EvaluationCMbBInput/CritLgtEvaluation/Inhibit Activation/OncomingInhibit/PreProcessor/CheckSCurve"
 /begin SUB_GROUP autosar_swc_aeb_autosar_swc_aeb_Step_sys_Subsystem_Reference_AEB_Function_Run_CllsnRednByBrkgCtrl_Step_Func_Run_CllsnRednByBrkg_Step_CollisionMitigationSystem_EvaluationCMbBInput_CritLgtEvaluation_Inhibit_Activation_OncomingInhibit_PreProcessor_CheckSCurve_Detect_Decrease autosar_swc_aeb_autosar_swc_aeb_Step_sys_Subsystem_Reference_AEB_Function_Run_CllsnRednByBrkgCtrl_Step_Func_Run_CllsnRednByBrkg_Step_CollisionMitigationSystem_EvaluationCMbBInput_CritLgtEvaluation_Inhibit_Activation_OncomingInhibit_PreProcessor_CheckSCurve_Detect_Decrease1 autosar_swc_aeb_autosar_swc_aeb_Step_sys_Subsystem_Reference_AEB_Function_Run_CllsnRednByBrkgCtrl_Step_Func_Run_CllsnRednByBrkg_Step_CollisionMitigationSystem_EvaluationCMbBInput_CritLgtEvaluation_Inhibit_Activation_OncomingInhibit_PreProcessor_CheckSCurve_Hysteresis autosar_swc_aeb_autosar_swc_aeb_Step_sys_Subsystem_Reference_AEB_Function_Run_CllsnRednByBrkgCtrl_Step_Func_Run_CllsnRednByBrkg_Step_CollisionMitigationSystem_EvaluationCMbBInput_CritLgtEvaluation_Inhibit_Activation_OncomingInhibit_PreProcessor_CheckSCurve_Hysteresis1 autosar_swc_aeb_autosar_swc_aeb_Step_sys_Subsystem_Reference_AEB_Function_Run_CllsnRednByBrkgCtrl_Step_Func_Run_CllsnRednByBrkg_Step_CollisionMitigationSystem_EvaluationCMbBInput_CritLgtEvaluation_Inhibit_Activation_OncomingInhibit_PreProcessor_CheckSCurve_OffDelayBlock autosar_swc_aeb_autosar_swc_aeb_Step_sys_Subsystem_Reference_AEB_Function_Run_CllsnRednByBrkgCtrl_Step_Func_Run_CllsnRednByBrkg_Step_CollisionMitigationSystem_EvaluationCMbBInput_CritLgtEvaluation_Inhibit_Activation_OncomingInhibit_PreProcessor_CheckSCurve_SRFlipFlop /end SUB_GROUP
 /begin REF_CHARACTERISTIC CMBB_CrvtSelfHystForTurnDetnForVehMovgToSelf_Ca CMBB_CrvtSelfThdForTurnDetnForVehMovgToSelfInCllsnRednByBrkg_Ca CMBB_StoreTiForNoTurnInCllsnRednByBrkg_Ca /end REF_CHARACTERISTIC
/end GROUP
/begin GROUP autosar_swc_aeb_autosar_swc_aeb_Step_sys_Subsystem_Reference_AEB_Function_Run_CllsnRednByBrkgCtrl_Step_Func_Run_CllsnRednByBrkg_Step_CollisionMitigationSystem_EvaluationCMbBInput_CritLgtEvaluation_Inhibit_Activation_OncomingInhibit_PreProcessor_CheckSCurve_Detect_Decrease "autosar_swc_aeb/autosar_swc_aeb_Step_sys/Subsystem Reference/AEB Function/Run_CllsnRednByBrkgCtrl_Step_Func/Run_CllsnRednByBrkg_Step/CollisionMitigationSystem/EvaluationCMbBInput/CritLgtEvaluation/Inhibit Activation/OncomingInhibit/PreProcessor/CheckSCurve/Detect\nDecrease" /begin REF_MEASUREMENT autosar_swc_aeb_rtARID_DEF.DelayInput1_DSTATE /end REF_MEASUREMENT /end GROUP
/begin GROUP autosar_swc_aeb_autosar_swc_aeb_Step_sys_Subsystem_Reference_AEB_Function_Run_CllsnRednByBrkgCtrl_Step_Func_Run_CllsnRednByBrkg_Step_CollisionMitigationSystem_EvaluationCMbBInput_CritLgtEvaluation_Inhibit_Activation_OncomingInhibit_PreProcessor_CheckSCurve_Detect_Decrease1 "autosar_swc_aeb/autosar_swc_aeb_Step_sys/Subsystem Reference/AEB Function/Run_CllsnRednByBrkgCtrl_Step_Func/Run_CllsnRednByBrkg_Step/CollisionMitigationSystem/EvaluationCMbBInput/CritLgtEvaluation/Inhibit Activation/OncomingInhibit/PreProcessor/CheckSCurve/Detect\nDecrease1" /begin REF_MEASUREMENT autosar_swc_aeb_rtARID_DEF.DelayInput1_DSTATE_n /end REF_MEASUREMENT /end GROUP
/begin GROUP autosar_swc_aeb_autosar_swc_aeb_Step_sys_Subsystem_Reference_AEB_Function_Run_CllsnRednByBrkgCtrl_Step_Func_Run_CllsnRednByBrkg_Step_CollisionMitigationSystem_EvaluationCMbBInput_CritLgtEvaluation_Inhibit_Activation_OncomingInhibit_PreProcessor_CheckSCurve_Hysteresis "autosar_swc_aeb/autosar_swc_aeb_Step_sys/Subsystem Reference/AEB Function/Run_CllsnRednByBrkgCtrl_Step_Func/Run_CllsnRednByBrkg_Step/CollisionMitigationSystem/EvaluationCMbBInput/CritLgtEvaluation/Inhibit Activation/OncomingInhibit/PreProcessor/CheckSCurve/Hysteresis" /begin REF_MEASUREMENT autosar_swc_aeb_rtARID_DEF.UnitDelay_DSTATE_gz /end REF_MEASUREMENT /end GROUP
/begin GROUP autosar_swc_aeb_autosar_swc_aeb_Step_sys_Subsystem_Reference_AEB_Function_Run_CllsnRednByBrkgCtrl_Step_Func_Run_CllsnRednByBrkg_Step_CollisionMitigationSystem_EvaluationCMbBInput_CritLgtEvaluation_Inhibit_Activation_OncomingInhibit_PreProcessor_CheckSCurve_Hysteresis1 "autosar_swc_aeb/autosar_swc_aeb_Step_sys/Subsystem Reference/AEB Function/Run_CllsnRednByBrkgCtrl_Step_Func/Run_CllsnRednByBrkg_Step/CollisionMitigationSystem/EvaluationCMbBInput/CritLgtEvaluation/Inhibit Activation/OncomingInhibit/PreProcessor/CheckSCurve/Hysteresis1" /begin REF_MEASUREMENT autosar_swc_aeb_rtARID_DEF.UnitDelay_DSTATE_c /end REF_MEASUREMENT /end GROUP
/begin GROUP autosar_swc_aeb_autosar_swc_aeb_Step_sys_Subsystem_Reference_AEB_Function_Run_CllsnRednByBrkgCtrl_Step_Func_Run_CllsnRednByBrkg_Step_CollisionMitigationSystem_EvaluationCMbBInput_CritLgtEvaluation_Inhibit_Activation_OncomingInhibit_PreProcessor_CheckSCurve_OffDelayBlock "autosar_swc_aeb/autosar_swc_aeb_Step_sys/Subsystem Reference/AEB Function/Run_CllsnRednByBrkgCtrl_Step_Func/Run_CllsnRednByBrkg_Step/CollisionMitigationSystem/EvaluationCMbBInput/CritLgtEvaluation/Inhibit Activation/OncomingInhibit/PreProcessor/CheckSCurve/OffDelayBlock" /begin REF_MEASUREMENT autosar_swc_aeb_rtARID_DEF.UnitDelay_DSTATE_n /end REF_MEASUREMENT /end GROUP
/begin GROUP autosar_swc_aeb_autosar_swc_aeb_Step_sys_Subsystem_Reference_AEB_Function_Run_CllsnRednByBrkgCtrl_Step_Func_Run_CllsnRednByBrkg_Step_CollisionMitigationSystem_EvaluationCMbBInput_CritLgtEvaluation_Inhibit_Activation_OncomingInhibit_PreProcessor_CheckSCurve_SRFlipFlop "autosar_swc_aeb/autosar_swc_aeb_Step_sys/Subsystem Reference/AEB Function/Run_CllsnRednByBrkgCtrl_Step_Func/Run_CllsnRednByBrkg_Step/CollisionMitigationSystem/EvaluationCMbBInput/CritLgtEvaluation/Inhibit Activation/OncomingInhibit/PreProcessor/CheckSCurve/SRFlipFlop" /begin REF_MEASUREMENT autosar_swc_aeb_rtARID_DEF.Memory_PreviousInput_h /end REF_MEASUREMENT /end GROUP
/begin GROUP autosar_swc_aeb_autosar_swc_aeb_Step_sys_Subsystem_Reference_AEB_Function_Run_CllsnRednByBrkgCtrl_Step_Func_Run_CllsnRednByBrkg_Step_CollisionMitigationSystem_EvaluationCMbBInput_CritLgtEvaluation_Inhibit_Activation_OncomingInhibit_PreProcessor_CheckTargetCurvature "autosar_swc_aeb/autosar_swc_aeb_Step_sys/Subsystem Reference/AEB Function/Run_CllsnRednByBrkgCtrl_Step_Func/Run_CllsnRednByBrkg_Step/CollisionMitigationSystem/EvaluationCMbBInput/CritLgtEvaluation/Inhibit Activation/OncomingInhibit/PreProcessor/CheckTargetCurvature" /begin REF_CHARACTERISTIC CMBB_CrvtThdForVehDrvgToSelfInCllsnRednByBrkg_Ca /end REF_CHARACTERISTIC /end GROUP
/begin GROUP autosar_swc_aeb_autosar_swc_aeb_Step_sys_Subsystem_Reference_AEB_Function_Run_CllsnRednByBrkgCtrl_Step_Func_Run_CllsnRednByBrkg_Step_CollisionMitigationSystem_EvaluationCMbBInput_CritLgtEvaluation_Inhibit_Activation_OncomingInhibit_PreProcessor_CheckTurning "autosar_swc_aeb/autosar_swc_aeb_Step_sys/Subsystem Reference/AEB Function/Run_CllsnRednByBrkgCtrl_Step_Func/Run_CllsnRednByBrkg_Step/CollisionMitigationSystem/EvaluationCMbBInput/CritLgtEvaluation/Inhibit Activation/OncomingInhibit/PreProcessor/CheckTurning"
 /begin REF_CHARACTERISTIC CMBB_CrvtSelfRqrdToStrtIntvForVehMovgToSelfInCllsnRednByBrkg_Ca CMBB_VLgtValCrvtSelfRqrdToStrtIntvForVehMovgToSelf_Ca /end REF_CHARACTERISTIC
/end GROUP
/begin GROUP autosar_swc_aeb_autosar_swc_aeb_Step_sys_Subsystem_Reference_AEB_Function_Run_CllsnRednByBrkgCtrl_Step_Func_Run_CllsnRednByBrkg_Step_CollisionMitigationSystem_EvaluationCMbBInput_CritLgtEvaluation_Inhibit_Activation_OncomingInhibit_PreProcessor_TrackRecentChangeOfTurnChange "autosar_swc_aeb/autosar_swc_aeb_Step_sys/Subsystem Reference/AEB Function/Run_CllsnRednByBrkgCtrl_Step_Func/Run_CllsnRednByBrkg_Step/CollisionMitigationSystem/EvaluationCMbBInput/CritLgtEvaluation/Inhibit Activation/OncomingInhibit/PreProcessor/TrackRecentChangeOfTurnChange"
 /begin SUB_GROUP autosar_swc_aeb_autosar_swc_aeb_Step_sys_Subsystem_Reference_AEB_Function_Run_CllsnRednByBrkgCtrl_Step_Func_Run_CllsnRednByBrkg_Step_CollisionMitigationSystem_EvaluationCMbBInput_CritLgtEvaluation_Inhibit_Activation_OncomingInhibit_PreProcessor_TrackRecentChangeOfTurnChange_OffDelayBlock /end SUB_GROUP
 /begin REF_CHARACTERISTIC CMBB_PinionSteerAgSpdRqrdToStrtIntvForVehMovgToSelf_Ca CMBB_StoreTiForPinionSteerAgSpdInCllsnRednByBrkg_Ca /end REF_CHARACTERISTIC
/end GROUP
/begin GROUP autosar_swc_aeb_autosar_swc_aeb_Step_sys_Subsystem_Reference_AEB_Function_Run_CllsnRednByBrkgCtrl_Step_Func_Run_CllsnRednByBrkg_Step_CollisionMitigationSystem_EvaluationCMbBInput_CritLgtEvaluation_Inhibit_Activation_OncomingInhibit_PreProcessor_TrackRecentChangeOfTurnChange_OffDelayBlock "autosar_swc_aeb/autosar_swc_aeb_Step_sys/Subsystem Reference/AEB Function/Run_CllsnRednByBrkgCtrl_Step_Func/Run_CllsnRednByBrkg_Step/CollisionMitigationSystem/EvaluationCMbBInput/CritLgtEvaluation/Inhibit Activation/OncomingInhibit/PreProcessor/TrackRecentChangeOfTurnChange/OffDelayBlock" /begin REF_MEASUREMENT autosar_swc_aeb_rtARID_DEF.UnitDelay_DSTATE_j /end REF_MEASUREMENT /end GROUP
/begin GROUP autosar_swc_aeb_autosar_swc_aeb_Step_sys_Subsystem_Reference_AEB_Function_Run_CllsnRednByBrkgCtrl_Step_Func_Run_CllsnRednByBrkg_Step_CollisionMitigationSystem_EvaluationCMbBInput_CritLgtEvaluation_Inhibit_Activation_SpdInhibit "autosar_swc_aeb/autosar_swc_aeb_Step_sys/Subsystem Reference/AEB Function/Run_CllsnRednByBrkgCtrl_Step_Func/Run_CllsnRednByBrkg_Step/CollisionMitigationSystem/EvaluationCMbBInput/CritLgtEvaluation/Inhibit Activation/SpdInhibit"
 /begin REF_CHARACTERISTIC CMBB_MaxSpeedInhibitInCllsnRednByBrkg_Ca CMBB_PredTimeForSpeedImhibitCllsnRednByBrkg_Ca CMBB_SpdPredMinAtCllsnInCllsnRednByBrkg_Ca /end REF_CHARACTERISTIC
/end GROUP
/begin GROUP autosar_swc_aeb_autosar_swc_aeb_Step_sys_Subsystem_Reference_AEB_Function_Run_CllsnRednByBrkgCtrl_Step_Func_Run_CllsnRednByBrkg_Step_CollisionMitigationSystem_EvaluationCMbBInput_DenyDueToOccupentSafety "autosar_swc_aeb/autosar_swc_aeb_Step_sys/Subsystem Reference/AEB Function/Run_CllsnRednByBrkgCtrl_Step_Func/Run_CllsnRednByBrkg_Step/CollisionMitigationSystem/EvaluationCMbBInput/DenyDueToOccupentSafety" /begin REF_CHARACTERISTIC CMBB_VehSpdMaxWoOccpSftPosnInCllsnRednByBrkg_Ca /end REF_CHARACTERISTIC /end GROUP
/begin GROUP autosar_swc_aeb_autosar_swc_aeb_Step_sys_Subsystem_Reference_AEB_Function_Run_CllsnRednByBrkgCtrl_Step_Func_Run_CllsnRednByBrkg_Step_CollisionMitigationSystem_EvaluationCMbBInput_VisionOnlyEvaluation "autosar_swc_aeb/autosar_swc_aeb_Step_sys/Subsystem Reference/AEB Function/Run_CllsnRednByBrkgCtrl_Step_Func/Run_CllsnRednByBrkg_Step/CollisionMitigationSystem/EvaluationCMbBInput/VisionOnlyEvaluation"
 /begin SUB_GROUP autosar_swc_aeb_autosar_swc_aeb_Step_sys_Subsystem_Reference_AEB_Function_Run_CllsnRednByBrkgCtrl_Step_Func_Run_CllsnRednByBrkg_Step_CollisionMitigationSystem_EvaluationCMbBInput_VisionOnlyEvaluation_TimeActive /end SUB_GROUP
 /begin REF_CHARACTERISTIC CMBB_TiToActvtConfLongInCllsnRednByBrkg_Ca CMBB_VisnOnlyBrkgForPedOnlyEnadInCllsnRednByBrkg_Ca /end REF_CHARACTERISTIC
/end GROUP
/begin GROUP autosar_swc_aeb_autosar_swc_aeb_Step_sys_Subsystem_Reference_AEB_Function_Run_CllsnRednByBrkgCtrl_Step_Func_Run_CllsnRednByBrkg_Step_CollisionMitigationSystem_EvaluationCMbBInput_VisionOnlyEvaluation_TimeActive "autosar_swc_aeb/autosar_swc_aeb_Step_sys/Subsystem Reference/AEB Function/Run_CllsnRednByBrkgCtrl_Step_Func/Run_CllsnRednByBrkg_Step/CollisionMitigationSystem/EvaluationCMbBInput/VisionOnlyEvaluation/TimeActive"
 /begin SUB_GROUP autosar_swc_aeb_autosar_swc_aeb_Step_sys_Subsystem_Reference_AEB_Function_Run_CllsnRednByBrkgCtrl_Step_Func_Run_CllsnRednByBrkg_Step_CollisionMitigationSystem_EvaluationCMbBInput_VisionOnlyEvaluation_TimeActive_HICNTR_1 /end SUB_GROUP
/end GROUP
/begin GROUP autosar_swc_aeb_autosar_swc_aeb_Step_sys_Subsystem_Reference_AEB_Function_Run_CllsnRednByBrkgCtrl_Step_Func_Run_CllsnRednByBrkg_Step_CollisionMitigationSystem_EvaluationCMbBInput_VisionOnlyEvaluation_TimeActive_HICNTR_1 "autosar_swc_aeb/autosar_swc_aeb_Step_sys/Subsystem Reference/AEB Function/Run_CllsnRednByBrkgCtrl_Step_Func/Run_CllsnRednByBrkg_Step/CollisionMitigationSystem/EvaluationCMbBInput/VisionOnlyEvaluation/TimeActive/HICNTR_1" /begin REF_MEASUREMENT autosar_swc_aeb_rtARID_DEF.UD_1_DSTATE_p /end REF_MEASUREMENT /end GROUP
/begin GROUP autosar_swc_aeb_autosar_swc_aeb_Step_sys_Subsystem_Reference_AEB_Function_Run_CllsnRednByBrkgCtrl_Step_Func_Run_CllsnRednByBrkg_Step_CollisionMitigationSystem_PreProcessor "autosar_swc_aeb/autosar_swc_aeb_Step_sys/Subsystem Reference/AEB Function/Run_CllsnRednByBrkgCtrl_Step_Func/Run_CllsnRednByBrkg_Step/CollisionMitigationSystem/PreProcessor"
 /begin SUB_GROUP autosar_swc_aeb_autosar_swc_aeb_Step_sys_Subsystem_Reference_AEB_Function_Run_CllsnRednByBrkgCtrl_Step_Func_Run_CllsnRednByBrkg_Step_CollisionMitigationSystem_PreProcessor_CheckTargetMotion /end SUB_GROUP
/end GROUP
/begin GROUP autosar_swc_aeb_autosar_swc_aeb_Step_sys_Subsystem_Reference_AEB_Function_Run_CllsnRednByBrkgCtrl_Step_Func_Run_CllsnRednByBrkg_Step_CollisionMitigationSystem_PreProcessor_CheckTargetMotion "autosar_swc_aeb/autosar_swc_aeb_Step_sys/Subsystem Reference/AEB Function/Run_CllsnRednByBrkgCtrl_Step_Func/Run_CllsnRednByBrkg_Step/CollisionMitigationSystem/PreProcessor/CheckTargetMotion"
 /begin SUB_GROUP autosar_swc_aeb_autosar_swc_aeb_Step_sys_Subsystem_Reference_AEB_Function_Run_CllsnRednByBrkgCtrl_Step_Func_Run_CllsnRednByBrkg_Step_CollisionMitigationSystem_PreProcessor_CheckTargetMotion_CheckIfTargetIsOncoming /end SUB_GROUP
/end GROUP
/begin GROUP autosar_swc_aeb_autosar_swc_aeb_Step_sys_Subsystem_Reference_AEB_Function_Run_CllsnRednByBrkgCtrl_Step_Func_Run_CllsnRednByBrkg_Step_CollisionMitigationSystem_PreProcessor_CheckTargetMotion_CheckIfTargetIsOncoming "autosar_swc_aeb/autosar_swc_aeb_Step_sys/Subsystem Reference/AEB Function/Run_CllsnRednByBrkgCtrl_Step_Func/Run_CllsnRednByBrkg_Step/CollisionMitigationSystem/PreProcessor/CheckTargetMotion/CheckIfTargetIsOncoming"
 /begin REF_CHARACTERISTIC CMBB_AgDirThdForVehDrvgToSelfInCllsnRednByBrkg_Ca CMBB_SpdThdForVehDrvgToSelfInCllsnRednByBrkg_Ca /end REF_CHARACTERISTIC
/end GROUP
/begin GROUP autosar_swc_aeb_autosar_swc_aeb_Step_sys_Subsystem_Reference_AEB_Function_Run_CllsnRednByBrkgCtrl_Step_Func_Run_CllsnRednByBrkg_Step_CreatePrmBus "autosar_swc_aeb/autosar_swc_aeb_Step_sys/Subsystem Reference/AEB Function/Run_CllsnRednByBrkgCtrl_Step_Func/Run_CllsnRednByBrkg_Step/CreatePrmBus"
 /begin REF_CHARACTERISTIC CMBB_ALatSafeThdForAutoBrakeCllsnRedByBrkg_Ca CMBB_DynCalPrmForAxleDstReToVehFrntMinValInCllsnRednByBrkg_Ca CMBB_DynCalPrmForBicycleMdlAxleDstFrntMinVal_Ca CMBB_DynCalPrmForBicycleMdlCornrgStfnFrntMinVal_Ca CMBB_DynCalPrmForBicycleMdlCornrgStfnReMinVal_Ca CMBB_DynCalPrmForVehMMinValInCllsnRednByBrkg_Ca CMBB_DynCalPrmForVehSteerWhlAgRatMinValInCllsnRednByBrkg_Ca CMBB_DynCalPrmForVehWhlBasMinValInCllsnRednByBrkg_Ca /end REF_CHARACTERISTIC
/end GROUP
/begin GROUP autosar_swc_aeb_autosar_swc_aeb_Step_sys_Subsystem_Reference_AEB_Function_Run_DrvrStEstimr_Step_Func "autosar_swc_aeb/autosar_swc_aeb_Step_sys/Subsystem Reference/AEB Function/Run_DrvrStEstimr_Step_Func"
 /begin SUB_GROUP autosar_swc_aeb_autosar_swc_aeb_Step_sys_Subsystem_Reference_AEB_Function_Run_DrvrStEstimr_Step_Func_Run_DrvrStEstimr_Step_Func /end SUB_GROUP
/end GROUP
/begin GROUP autosar_swc_aeb_autosar_swc_aeb_Step_sys_Subsystem_Reference_AEB_Function_Run_DrvrStEstimr_Step_Func_Run_DrvrStEstimr_Step_Func "autosar_swc_aeb/autosar_swc_aeb_Step_sys/Subsystem Reference/AEB Function/Run_DrvrStEstimr_Step_Func/Run_DrvrStEstimr_Step_Func"
 /begin SUB_GROUP autosar_swc_aeb_autosar_swc_aeb_Step_sys_Subsystem_Reference_AEB_Function_Run_DrvrStEstimr_Step_Func_Run_DrvrStEstimr_Step_Func_DrvrStEstimrStep_Func /end SUB_GROUP
/end GROUP
/begin GROUP autosar_swc_aeb_autosar_swc_aeb_Step_sys_Subsystem_Reference_AEB_Function_Run_DrvrStEstimr_Step_Func_Run_DrvrStEstimr_Step_Func_DrvrStEstimrStep_Func "autosar_swc_aeb/autosar_swc_aeb_Step_sys/Subsystem Reference/AEB Function/Run_DrvrStEstimr_Step_Func/Run_DrvrStEstimr_Step_Func/DrvrStEstimrStep_Func"
 /begin SUB_GROUP autosar_swc_aeb_autosar_swc_aeb_Step_sys_Subsystem_Reference_AEB_Function_Run_DrvrStEstimr_Step_Func_Run_DrvrStEstimr_Step_Func_DrvrStEstimrStep_Func_ActnIntdByDrvr autosar_swc_aeb_autosar_swc_aeb_Step_sys_Subsystem_Reference_AEB_Function_Run_DrvrStEstimr_Step_Func_Run_DrvrStEstimr_Step_Func_DrvrStEstimrStep_Func_ForceSensitivityLevelForHostreSimPurposes autosar_swc_aeb_autosar_swc_aeb_Step_sys_Subsystem_Reference_AEB_Function_Run_DrvrStEstimr_Step_Func_Run_DrvrStEstimr_Step_Func_DrvrStEstimrStep_Func_MtnLimnEstimr /end SUB_GROUP
 /begin REF_CHARACTERISTIC DSE_ReactnTiDftHiSnvtyInDrvrStEstimr_Ca DSE_ReactnTiDftLoSnvtyInDrvrStEstimr_Ca DSE_ReactnTiDftNormSnvtyInDrvrStEstimr_Ca DSE_ReactnTiMaxInDrvrStEstimr_Ca DSE_ReactnTiMinInDrvrStEstimr_Ca /end REF_CHARACTERISTIC
/end GROUP
/begin GROUP autosar_swc_aeb_autosar_swc_aeb_Step_sys_Subsystem_Reference_AEB_Function_Run_DrvrStEstimr_Step_Func_Run_DrvrStEstimr_Step_Func_DrvrStEstimrStep_Func_ActnIntdByDrvr "autosar_swc_aeb/autosar_swc_aeb_Step_sys/Subsystem Reference/AEB Function/Run_DrvrStEstimr_Step_Func/Run_DrvrStEstimr_Step_Func/DrvrStEstimrStep_Func/ActnIntdByDrvr"
 /begin SUB_GROUP autosar_swc_aeb_autosar_swc_aeb_Step_sys_Subsystem_Reference_AEB_Function_Run_DrvrStEstimr_Step_Func_Run_DrvrStEstimr_Step_Func_DrvrStEstimrStep_Func_ActnIntdByDrvr_ActionIntendedByDriver /end SUB_GROUP
/end GROUP
/begin GROUP autosar_swc_aeb_autosar_swc_aeb_Step_sys_Subsystem_Reference_AEB_Function_Run_DrvrStEstimr_Step_Func_Run_DrvrStEstimr_Step_Func_DrvrStEstimrStep_Func_ActnIntdByDrvr_ActionIntendedByDriver "autosar_swc_aeb/autosar_swc_aeb_Step_sys/Subsystem Reference/AEB Function/Run_DrvrStEstimr_Step_Func/Run_DrvrStEstimr_Step_Func/DrvrStEstimrStep_Func/ActnIntdByDrvr/ActionIntendedByDriver"
 /begin SUB_GROUP autosar_swc_aeb_autosar_swc_aeb_Step_sys_Subsystem_Reference_AEB_Function_Run_DrvrStEstimr_Step_Func_Run_DrvrStEstimr_Step_Func_DrvrStEstimrStep_Func_ActnIntdByDrvr_ActionIntendedByDriver_PathEstimator /end SUB_GROUP
/end GROUP
/begin GROUP autosar_swc_aeb_autosar_swc_aeb_Step_sys_Subsystem_Reference_AEB_Function_Run_DrvrStEstimr_Step_Func_Run_DrvrStEstimr_Step_Func_DrvrStEstimrStep_Func_ActnIntdByDrvr_ActionIntendedByDriver_PathEstimator "autosar_swc_aeb/autosar_swc_aeb_Step_sys/Subsystem Reference/AEB Function/Run_DrvrStEstimr_Step_Func/Run_DrvrStEstimr_Step_Func/DrvrStEstimrStep_Func/ActnIntdByDrvr/ActionIntendedByDriver/PathEstimator"
 /begin SUB_GROUP autosar_swc_aeb_autosar_swc_aeb_Step_sys_Subsystem_Reference_AEB_Function_Run_DrvrStEstimr_Step_Func_Run_DrvrStEstimr_Step_Func_DrvrStEstimrStep_Func_ActnIntdByDrvr_ActionIntendedByDriver_PathEstimator_CalculateCurvature autosar_swc_aeb_autosar_swc_aeb_Step_sys_Subsystem_Reference_AEB_Function_Run_DrvrStEstimr_Step_Func_Run_DrvrStEstimr_Step_Func_DrvrStEstimrStep_Func_ActnIntdByDrvr_ActionIntendedByDriver_PathEstimator_CurvatureBasedPath autosar_swc_aeb_autosar_swc_aeb_Step_sys_Subsystem_Reference_AEB_Function_Run_DrvrStEstimr_Step_Func_Run_DrvrStEstimr_Step_Func_DrvrStEstimrStep_Func_ActnIntdByDrvr_ActionIntendedByDriver_PathEstimator_LowPassFilter autosar_swc_aeb_autosar_swc_aeb_Step_sys_Subsystem_Reference_AEB_Function_Run_DrvrStEstimr_Step_Func_Run_DrvrStEstimr_Step_Func_DrvrStEstimrStep_Func_ActnIntdByDrvr_ActionIntendedByDriver_PathEstimator_PathSelector autosar_swc_aeb_autosar_swc_aeb_Step_sys_Subsystem_Reference_AEB_Function_Run_DrvrStEstimr_Step_Func_Run_DrvrStEstimr_Step_Func_DrvrStEstimrStep_Func_ActnIntdByDrvr_ActionIntendedByDriver_PathEstimator_RoadBasedPath /end SUB_GROUP
/end GROUP
/begin GROUP autosar_swc_aeb_autosar_swc_aeb_Step_sys_Subsystem_Reference_AEB_Function_Run_DrvrStEstimr_Step_Func_Run_DrvrStEstimr_Step_Func_DrvrStEstimrStep_Func_ActnIntdByDrvr_ActionIntendedByDriver_PathEstimator_CalculateCurvature "autosar_swc_aeb/autosar_swc_aeb_Step_sys/Subsystem Reference/AEB Function/Run_DrvrStEstimr_Step_Func/Run_DrvrStEstimr_Step_Func/DrvrStEstimrStep_Func/ActnIntdByDrvr/ActionIntendedByDriver/PathEstimator/CalculateCurvature"
 /begin REF_CHARACTERISTIC DSE_CrvtTypTblInDrvrStEstimr_Ca DSE_VLgtValForCrvtTypTblInDrvrStEstimr_Ca /end REF_CHARACTERISTIC
/end GROUP
/begin GROUP autosar_swc_aeb_autosar_swc_aeb_Step_sys_Subsystem_Reference_AEB_Function_Run_DrvrStEstimr_Step_Func_Run_DrvrStEstimr_Step_Func_DrvrStEstimrStep_Func_ActnIntdByDrvr_ActionIntendedByDriver_PathEstimator_CurvatureBasedPath "autosar_swc_aeb/autosar_swc_aeb_Step_sys/Subsystem Reference/AEB Function/Run_DrvrStEstimr_Step_Func/Run_DrvrStEstimr_Step_Func/DrvrStEstimrStep_Func/ActnIntdByDrvr/ActionIntendedByDriver/PathEstimator/CurvatureBasedPath"
 /begin SUB_GROUP autosar_swc_aeb_autosar_swc_aeb_Step_sys_Subsystem_Reference_AEB_Function_Run_DrvrStEstimr_Step_Func_Run_DrvrStEstimr_Step_Func_DrvrStEstimrStep_Func_ActnIntdByDrvr_ActionIntendedByDriver_PathEstimator_CurvatureBasedPath_PredictControlPointsCurvatureBased /end SUB_GROUP
/end GROUP
/begin GROUP autosar_swc_aeb_autosar_swc_aeb_Step_sys_Subsystem_Reference_AEB_Function_Run_DrvrStEstimr_Step_Func_Run_DrvrStEstimr_Step_Func_DrvrStEstimrStep_Func_ActnIntdByDrvr_ActionIntendedByDriver_PathEstimator_CurvatureBasedPath_PredictControlPointsCurvatureBased "autosar_swc_aeb/autosar_swc_aeb_Step_sys/Subsystem Reference/AEB Function/Run_DrvrStEstimr_Step_Func/Run_DrvrStEstimr_Step_Func/DrvrStEstimrStep_Func/ActnIntdByDrvr/ActionIntendedByDriver/PathEstimator/CurvatureBasedPath/PredictControlPointsCurvatureBased"
 /begin SUB_GROUP autosar_swc_aeb_autosar_swc_aeb_Step_sys_Subsystem_Reference_AEB_Function_Run_DrvrStEstimr_Step_Func_Run_DrvrStEstimr_Step_Func_DrvrStEstimrStep_Func_ActnIntdByDrvr_ActionIntendedByDriver_PathEstimator_CurvatureBasedPath_PredictControlPointsCurvatureBased_CheckVehicleStopping autosar_swc_aeb_autosar_swc_aeb_Step_sys_Subsystem_Reference_AEB_Function_Run_DrvrStEstimr_Step_Func_Run_DrvrStEstimr_Step_Func_DrvrStEstimrStep_Func_ActnIntdByDrvr_ActionIntendedByDriver_PathEstimator_CurvatureBasedPath_PredictControlPointsCurvatureBased_ComputeVehicleStateAtT1 autosar_swc_aeb_autosar_swc_aeb_Step_sys_Subsystem_Reference_AEB_Function_Run_DrvrStEstimr_Step_Func_Run_DrvrStEstimr_Step_Func_DrvrStEstimrStep_Func_ActnIntdByDrvr_ActionIntendedByDriver_PathEstimator_CurvatureBasedPath_PredictControlPointsCurvatureBased_CreateOutput autosar_swc_aeb_autosar_swc_aeb_Step_sys_Subsystem_Reference_AEB_Function_Run_DrvrStEstimr_Step_Func_Run_DrvrStEstimr_Step_Func_DrvrStEstimrStep_Func_ActnIntdByDrvr_ActionIntendedByDriver_PathEstimator_CurvatureBasedPath_PredictControlPointsCurvatureBased_CreateSplineSegment autosar_swc_aeb_autosar_swc_aeb_Step_sys_Subsystem_Reference_AEB_Function_Run_DrvrStEstimr_Step_Func_Run_DrvrStEstimr_Step_Func_DrvrStEstimrStep_Func_ActnIntdByDrvr_ActionIntendedByDriver_PathEstimator_CurvatureBasedPath_PredictControlPointsCurvatureBased_DiagSignals autosar_swc_aeb_autosar_swc_aeb_Step_sys_Subsystem_Reference_AEB_Function_Run_DrvrStEstimr_Step_Func_Run_DrvrStEstimr_Step_Func_DrvrStEstimrStep_Func_ActnIntdByDrvr_ActionIntendedByDriver_PathEstimator_CurvatureBasedPath_PredictControlPointsCurvatureBased_SetVehicleStateAtT0 /end SUB_GROUP
/end GROUP
/begin GROUP autosar_swc_aeb_autosar_swc_aeb_Step_sys_Subsystem_Reference_AEB_Function_Run_DrvrStEstimr_Step_Func_Run_DrvrStEstimr_Step_Func_DrvrStEstimrStep_Func_ActnIntdByDrvr_ActionIntendedByDriver_PathEstimator_CurvatureBasedPath_PredictControlPointsCurvatureBased_CheckVehicleStopping "autosar_swc_aeb/autosar_swc_aeb_Step_sys/Subsystem Reference/AEB Function/Run_DrvrStEstimr_Step_Func/Run_DrvrStEstimr_Step_Func/DrvrStEstimrStep_Func/ActnIntdByDrvr/ActionIntendedByDriver/PathEstimator/CurvatureBasedPath/PredictControlPointsCurvatureBased/CheckVehicleStopping"
 /begin SUB_GROUP autosar_swc_aeb_autosar_swc_aeb_Step_sys_Subsystem_Reference_AEB_Function_Run_DrvrStEstimr_Step_Func_Run_DrvrStEstimr_Step_Func_DrvrStEstimrStep_Func_ActnIntdByDrvr_ActionIntendedByDriver_PathEstimator_CurvatureBasedPath_PredictControlPointsCurvatureBased_CheckVehicleStopping_SafeDivide /end SUB_GROUP
 /begin REF_MEASUREMENT autosar_swc_aeb_rtARID_DEF.A autosar_swc_aeb_rtARID_DEF.LateralStoppingDistance autosar_swc_aeb_rtARID_DEF.LongitudinalStoppingDistance autosar_swc_aeb_rtARID_DEF.Speed_k autosar_swc_aeb_rtARID_DEF.StopsWithinSegment /end REF_MEASUREMENT
/end GROUP
/begin GROUP autosar_swc_aeb_autosar_swc_aeb_Step_sys_Subsystem_Reference_AEB_Function_Run_DrvrStEstimr_Step_Func_Run_DrvrStEstimr_Step_Func_DrvrStEstimrStep_Func_ActnIntdByDrvr_ActionIntendedByDriver_PathEstimator_CurvatureBasedPath_PredictControlPointsCurvatureBased_CheckVehicleStopping_SafeDivide "autosar_swc_aeb/autosar_swc_aeb_Step_sys/Subsystem Reference/AEB Function/Run_DrvrStEstimr_Step_Func/Run_DrvrStEstimr_Step_Func/DrvrStEstimrStep_Func/ActnIntdByDrvr/ActionIntendedByDriver/PathEstimator/CurvatureBasedPath/PredictControlPointsCurvatureBased/CheckVehicleStopping/SafeDivide" /begin REF_MEASUREMENT autosar_swc_aeb_rtARID_DEF.Speed_k /end REF_MEASUREMENT /end GROUP
/begin GROUP autosar_swc_aeb_autosar_swc_aeb_Step_sys_Subsystem_Reference_AEB_Function_Run_DrvrStEstimr_Step_Func_Run_DrvrStEstimr_Step_Func_DrvrStEstimrStep_Func_ActnIntdByDrvr_ActionIntendedByDriver_PathEstimator_CurvatureBasedPath_PredictControlPointsCurvatureBased_ComputeVehicleStateAtT1 "autosar_swc_aeb/autosar_swc_aeb_Step_sys/Subsystem Reference/AEB Function/Run_DrvrStEstimr_Step_Func/Run_DrvrStEstimr_Step_Func/DrvrStEstimrStep_Func/ActnIntdByDrvr/ActionIntendedByDriver/PathEstimator/CurvatureBasedPath/PredictControlPointsCurvatureBased/ComputeVehicleStateAtT1"
 /begin SUB_GROUP autosar_swc_aeb_autosar_swc_aeb_Step_sys_Subsystem_Reference_AEB_Function_Run_DrvrStEstimr_Step_Func_Run_DrvrStEstimr_Step_Func_DrvrStEstimrStep_Func_ActnIntdByDrvr_ActionIntendedByDriver_PathEstimator_CurvatureBasedPath_PredictControlPointsCurvatureBased_ComputeVehicleStateAtT1_AccelerationAtT1 autosar_swc_aeb_autosar_swc_aeb_Step_sys_Subsystem_Reference_AEB_Function_Run_DrvrStEstimr_Step_Func_Run_DrvrStEstimr_Step_Func_DrvrStEstimrStep_Func_ActnIntdByDrvr_ActionIntendedByDriver_PathEstimator_CurvatureBasedPath_PredictControlPointsCurvatureBased_ComputeVehicleStateAtT1_ComputeHeadingAngle autosar_swc_aeb_autosar_swc_aeb_Step_sys_Subsystem_Reference_AEB_Function_Run_DrvrStEstimr_Step_Func_Run_DrvrStEstimr_Step_Func_DrvrStEstimrStep_Func_ActnIntdByDrvr_ActionIntendedByDriver_PathEstimator_CurvatureBasedPath_PredictControlPointsCurvatureBased_ComputeVehicleStateAtT1_ConvertSplineToCartesian /end SUB_GROUP
 /begin REF_MEASUREMENT autosar_swc_aeb_rtARID_DEF.A autosar_swc_aeb_rtARID_DEF.CurvatureRate autosar_swc_aeb_rtARID_DEF.Curvature_j autosar_swc_aeb_rtARID_DEF.Speed_k /end REF_MEASUREMENT
/end GROUP
/begin GROUP autosar_swc_aeb_autosar_swc_aeb_Step_sys_Subsystem_Reference_AEB_Function_Run_DrvrStEstimr_Step_Func_Run_DrvrStEstimr_Step_Func_DrvrStEstimrStep_Func_ActnIntdByDrvr_ActionIntendedByDriver_PathEstimator_CurvatureBasedPath_PredictControlPointsCurvatureBased_ComputeVehicleStateAtT1_AccelerationAtT1 "autosar_swc_aeb/autosar_swc_aeb_Step_sys/Subsystem Reference/AEB Function/Run_DrvrStEstimr_Step_Func/Run_DrvrStEstimr_Step_Func/DrvrStEstimrStep_Func/ActnIntdByDrvr/ActionIntendedByDriver/PathEstimator/CurvatureBasedPath/PredictControlPointsCurvatureBased/ComputeVehicleStateAtT1/AccelerationAtT1"
 /begin REF_MEASUREMENT autosar_swc_aeb_rtARID_DEF.A autosar_swc_aeb_rtARID_DEF.StopsWithinSegment /end REF_MEASUREMENT
/end GROUP
/begin GROUP autosar_swc_aeb_autosar_swc_aeb_Step_sys_Subsystem_Reference_AEB_Function_Run_DrvrStEstimr_Step_Func_Run_DrvrStEstimr_Step_Func_DrvrStEstimrStep_Func_ActnIntdByDrvr_ActionIntendedByDriver_PathEstimator_CurvatureBasedPath_PredictControlPointsCurvatureBased_ComputeVehicleStateAtT1_ComputeHeadingAngle "autosar_swc_aeb/autosar_swc_aeb_Step_sys/Subsystem Reference/AEB Function/Run_DrvrStEstimr_Step_Func/Run_DrvrStEstimr_Step_Func/DrvrStEstimrStep_Func/ActnIntdByDrvr/ActionIntendedByDriver/PathEstimator/CurvatureBasedPath/PredictControlPointsCurvatureBased/ComputeVehicleStateAtT1/ComputeHeadingAngle" /begin REF_MEASUREMENT autosar_swc_aeb_rtARID_DEF.HeadingAngle_a /end REF_MEASUREMENT /end GROUP
/begin GROUP autosar_swc_aeb_autosar_swc_aeb_Step_sys_Subsystem_Reference_AEB_Function_Run_DrvrStEstimr_Step_Func_Run_DrvrStEstimr_Step_Func_DrvrStEstimrStep_Func_ActnIntdByDrvr_ActionIntendedByDriver_PathEstimator_CurvatureBasedPath_PredictControlPointsCurvatureBased_ComputeVehicleStateAtT1_ConvertSplineToCartesian "autosar_swc_aeb/autosar_swc_aeb_Step_sys/Subsystem Reference/AEB Function/Run_DrvrStEstimr_Step_Func/Run_DrvrStEstimr_Step_Func/DrvrStEstimrStep_Func/ActnIntdByDrvr/ActionIntendedByDriver/PathEstimator/CurvatureBasedPath/PredictControlPointsCurvatureBased/ComputeVehicleStateAtT1/ConvertSplineToCartesian"
 /begin REF_MEASUREMENT autosar_swc_aeb_rtARID_DEF.P3Lateral autosar_swc_aeb_rtARID_DEF.P3Longitudinal /end REF_MEASUREMENT
/end GROUP
/begin GROUP autosar_swc_aeb_autosar_swc_aeb_Step_sys_Subsystem_Reference_AEB_Function_Run_DrvrStEstimr_Step_Func_Run_DrvrStEstimr_Step_Func_DrvrStEstimrStep_Func_ActnIntdByDrvr_ActionIntendedByDriver_PathEstimator_CurvatureBasedPath_PredictControlPointsCurvatureBased_CreateOutput "autosar_swc_aeb/autosar_swc_aeb_Step_sys/Subsystem Reference/AEB Function/Run_DrvrStEstimr_Step_Func/Run_DrvrStEstimr_Step_Func/DrvrStEstimrStep_Func/ActnIntdByDrvr/ActionIntendedByDriver/PathEstimator/CurvatureBasedPath/PredictControlPointsCurvatureBased/CreateOutput" /begin REF_MEASUREMENT autosar_swc_aeb_rtARID_DEF.UnitDelay1_DSTATE_g /end REF_MEASUREMENT /end GROUP
/begin GROUP autosar_swc_aeb_autosar_swc_aeb_Step_sys_Subsystem_Reference_AEB_Function_Run_DrvrStEstimr_Step_Func_Run_DrvrStEstimr_Step_Func_DrvrStEstimrStep_Func_ActnIntdByDrvr_ActionIntendedByDriver_PathEstimator_CurvatureBasedPath_PredictControlPointsCurvatureBased_CreateSplineSegment "autosar_swc_aeb/autosar_swc_aeb_Step_sys/Subsystem Reference/AEB Function/Run_DrvrStEstimr_Step_Func/Run_DrvrStEstimr_Step_Func/DrvrStEstimrStep_Func/ActnIntdByDrvr/ActionIntendedByDriver/PathEstimator/CurvatureBasedPath/PredictControlPointsCurvatureBased/CreateSplineSegment"
 /begin SUB_GROUP autosar_swc_aeb_autosar_swc_aeb_Step_sys_Subsystem_Reference_AEB_Function_Run_DrvrStEstimr_Step_Func_Run_DrvrStEstimr_Step_Func_DrvrStEstimrStep_Func_ActnIntdByDrvr_ActionIntendedByDriver_PathEstimator_CurvatureBasedPath_PredictControlPointsCurvatureBased_CreateSplineSegment_InitialControlPointsCalculation /end SUB_GROUP
 /begin REF_MEASUREMENT autosar_swc_aeb_rtARID_DEF.A autosar_swc_aeb_rtARID_DEF.CurvatureRate autosar_swc_aeb_rtARID_DEF.Curvature_j autosar_swc_aeb_rtARID_DEF.HeadingAngle_a autosar_swc_aeb_rtARID_DEF.LateralStoppingDistance autosar_swc_aeb_rtARID_DEF.LongitudinalStoppingDistance autosar_swc_aeb_rtARID_DEF.P3Lateral autosar_swc_aeb_rtARID_DEF.P3Longitudinal autosar_swc_aeb_rtARID_DEF.PositionLateral autosar_swc_aeb_rtARID_DEF.PositionLongitudinal autosar_swc_aeb_rtARID_DEF.Speed_k autosar_swc_aeb_rtARID_DEF.StopsWithinSegment /end REF_MEASUREMENT
/end GROUP
/begin GROUP autosar_swc_aeb_autosar_swc_aeb_Step_sys_Subsystem_Reference_AEB_Function_Run_DrvrStEstimr_Step_Func_Run_DrvrStEstimr_Step_Func_DrvrStEstimrStep_Func_ActnIntdByDrvr_ActionIntendedByDriver_PathEstimator_CurvatureBasedPath_PredictControlPointsCurvatureBased_CreateSplineSegment_InitialControlPointsCalculation "autosar_swc_aeb/autosar_swc_aeb_Step_sys/Subsystem Reference/AEB Function/Run_DrvrStEstimr_Step_Func/Run_DrvrStEstimr_Step_Func/DrvrStEstimrStep_Func/ActnIntdByDrvr/ActionIntendedByDriver/PathEstimator/CurvatureBasedPath/PredictControlPointsCurvatureBased/CreateSplineSegment/InitialControlPointsCalculation"
 /begin SUB_GROUP autosar_swc_aeb_autosar_swc_aeb_Step_sys_Subsystem_Reference_AEB_Function_Run_DrvrStEstimr_Step_Func_Run_DrvrStEstimr_Step_Func_DrvrStEstimrStep_Func_ActnIntdByDrvr_ActionIntendedByDriver_PathEstimator_CurvatureBasedPath_PredictControlPointsCurvatureBased_CreateSplineSegment_InitialControlPointsCalculation_NoOperation1 autosar_swc_aeb_autosar_swc_aeb_Step_sys_Subsystem_Reference_AEB_Function_Run_DrvrStEstimr_Step_Func_Run_DrvrStEstimr_Step_Func_DrvrStEstimrStep_Func_ActnIntdByDrvr_ActionIntendedByDriver_PathEstimator_CurvatureBasedPath_PredictControlPointsCurvatureBased_CreateSplineSegment_InitialControlPointsCalculation_NoOperation6 /end SUB_GROUP
 /begin REF_MEASUREMENT autosar_swc_aeb_rtARID_DEF.LateralStoppingDistance autosar_swc_aeb_rtARID_DEF.LongitudinalStoppingDistance autosar_swc_aeb_rtARID_DEF.PositionLateral autosar_swc_aeb_rtARID_DEF.PositionLongitudinal autosar_swc_aeb_rtARID_DEF.StopsWithinSegment /end REF_MEASUREMENT
/end GROUP
/begin GROUP autosar_swc_aeb_autosar_swc_aeb_Step_sys_Subsystem_Reference_AEB_Function_Run_DrvrStEstimr_Step_Func_Run_DrvrStEstimr_Step_Func_DrvrStEstimrStep_Func_ActnIntdByDrvr_ActionIntendedByDriver_PathEstimator_CurvatureBasedPath_PredictControlPointsCurvatureBased_CreateSplineSegment_InitialControlPointsCalculation_NoOperation1 "autosar_swc_aeb/autosar_swc_aeb_Step_sys/Subsystem Reference/AEB Function/Run_DrvrStEstimr_Step_Func/Run_DrvrStEstimr_Step_Func/DrvrStEstimrStep_Func/ActnIntdByDrvr/ActionIntendedByDriver/PathEstimator/CurvatureBasedPath/PredictControlPointsCurvatureBased/CreateSplineSegment/InitialControlPointsCalculation/NoOperation1" /begin REF_MEASUREMENT autosar_swc_aeb_rtARID_DEF.PositionLateral /end REF_MEASUREMENT /end GROUP
/begin GROUP autosar_swc_aeb_autosar_swc_aeb_Step_sys_Subsystem_Reference_AEB_Function_Run_DrvrStEstimr_Step_Func_Run_DrvrStEstimr_Step_Func_DrvrStEstimrStep_Func_ActnIntdByDrvr_ActionIntendedByDriver_PathEstimator_CurvatureBasedPath_PredictControlPointsCurvatureBased_CreateSplineSegment_InitialControlPointsCalculation_NoOperation6 "autosar_swc_aeb/autosar_swc_aeb_Step_sys/Subsystem Reference/AEB Function/Run_DrvrStEstimr_Step_Func/Run_DrvrStEstimr_Step_Func/DrvrStEstimrStep_Func/ActnIntdByDrvr/ActionIntendedByDriver/PathEstimator/CurvatureBasedPath/PredictControlPointsCurvatureBased/CreateSplineSegment/InitialControlPointsCalculation/NoOperation6" /begin REF_MEASUREMENT autosar_swc_aeb_rtARID_DEF.PositionLongitudinal /end REF_MEASUREMENT /end GROUP
/begin GROUP autosar_swc_aeb_autosar_swc_aeb_Step_sys_Subsystem_Reference_AEB_Function_Run_DrvrStEstimr_Step_Func_Run_DrvrStEstimr_Step_Func_DrvrStEstimrStep_Func_ActnIntdByDrvr_ActionIntendedByDriver_PathEstimator_CurvatureBasedPath_PredictControlPointsCurvatureBased_DiagSignals "autosar_swc_aeb/autosar_swc_aeb_Step_sys/Subsystem Reference/AEB Function/Run_DrvrStEstimr_Step_Func/Run_DrvrStEstimr_Step_Func/DrvrStEstimrStep_Func/ActnIntdByDrvr/ActionIntendedByDriver/PathEstimator/CurvatureBasedPath/PredictControlPointsCurvatureBased/DiagSignals"
 /begin REF_MEASUREMENT autosar_swc_aeb_rtARID_DEF.Curvature_m autosar_swc_aeb_rtARID_DEF.HeadingAngle_b autosar_swc_aeb_rtARID_DEF.Speed_p /end REF_MEASUREMENT
/end GROUP
/begin GROUP autosar_swc_aeb_autosar_swc_aeb_Step_sys_Subsystem_Reference_AEB_Function_Run_DrvrStEstimr_Step_Func_Run_DrvrStEstimr_Step_Func_DrvrStEstimrStep_Func_ActnIntdByDrvr_ActionIntendedByDriver_PathEstimator_CurvatureBasedPath_PredictControlPointsCurvatureBased_SetVehicleStateAtT0_SetInitialMotion "autosar_swc_aeb/autosar_swc_aeb_Step_sys/Subsystem Reference/AEB Function/Run_DrvrStEstimr_Step_Func/Run_DrvrStEstimr_Step_Func/DrvrStEstimrStep_Func/ActnIntdByDrvr/ActionIntendedByDriver/PathEstimator/CurvatureBasedPath/PredictControlPointsCurvatureBased/SetVehicleStateAtT0/SetInitialMotion"
 /begin REF_MEASUREMENT autosar_swc_aeb_rtARID_DEF.A autosar_swc_aeb_rtARID_DEF.CurvatureRate autosar_swc_aeb_rtARID_DEF.Curvature_j autosar_swc_aeb_rtARID_DEF.HeadingAngle_a autosar_swc_aeb_rtARID_DEF.P3Lateral autosar_swc_aeb_rtARID_DEF.P3Longitudinal autosar_swc_aeb_rtARID_DEF.PositionLateral autosar_swc_aeb_rtARID_DEF.PositionLongitudinal autosar_swc_aeb_rtARID_DEF.Speed_k /end REF_MEASUREMENT
/end GROUP
/begin RECORD_LAYOUT Record_BOOLEAN FNC_VALUES 1 UBYTE COLUMN_DIR DIRECT /end RECORD_LAYOUT
/begin RECORD_LAYOUT Record_FLOAT32_IEEE FNC_VALUES 1 FLOAT32_IEEE COLUMN_DIR DIRECT /end RECORD_LAYOUT
/begin RECORD_LAYOUT Axis_FLOAT32_IEEE AXIS_PTS_X 1 FLOAT32_IEEE INDEX_INCR DIRECT /end RECORD_LAYOUT
/begin RECORD_LAYOUT Record_BOOLEAN FNC_VALUES 1 UBYTE COLUMN_DIR DIRECT /end RECORD_LAYOUT
/begin RECORD_LAYOUT Record_FLOAT32_IEEE FNC_VALUES 1 FLOAT32_IEEE COLUMN_DIR DIRECT /end RECORD_LAYOUT
/begin RECORD_LAYOUT Record_BOOLEAN FNC_VALUES 1 UBYTE COLUMN_DIR DIRECT /end RECORD_LAYOUT
/begin RECORD_LAYOUT Record_FLOAT32_IEEE FNC_VALUES 1 FLOAT32_IEEE COLUMN_DIR DIRECT /end RECORD_LAYOUT
/begin RECORD_LAYOUT Record_SBYTE FNC_VALUES 1 SBYTE COLUMN_DIR DIRECT /end RECORD_LAYOUT
/begin RECORD_LAYOUT Axis_FLOAT32_IEEE AXIS_PTS_X 1 FLOAT32_IEEE INDEX_INCR DIRECT /end RECORD_LAYOUT
/begin RECORD_LAYOUT Record_BOOLEAN FNC_VALUES 1 UBYTE COLUMN_DIR DIRECT /end RECORD_LAYOUT
/begin RECORD_LAYOUT Record_FLOAT32_IEEE FNC_VALUES 1 FLOAT32_IEEE COLUMN_DIR DIRECT /end RECORD_LAYOUT
/begin RECORD_LAYOUT Record_SBYTE FNC_VALUES 1 SBYTE COLUMN_DIR DIRECT /end RECORD_LAYOUT
/begin RECORD_LAYOUT Axis_FLOAT32_IEEE AXIS_PTS_X 1 FLOAT32_IEEE INDEX_INCR DIRECT /end RECORD_LAYOUT
/begin RECORD_LAYOUT Record_BOOLEAN FNC_VALUES 1 UBYTE COLUMN_DIR DIRECT /end RECORD_LAYOUT
/begin RECORD_LAYOUT Record_FLOAT32_IEEE FNC_VALUES 1 FLOAT32_IEEE COLUMN_DIR DIRECT /end RECORD_LAYOUT
/begin RECORD_LAYOUT Record_SBYTE FNC_VALUES 1 SBYTE COLUMN_DIR DIRECT /end RECORD_LAYOUT
/begin RECORD_LAYOUT Axis_FLOAT32_IEEE AXIS_PTS_X 1 FLOAT32_IEEE INDEX_INCR DIRECT /end RECORD_LAYOUT
/begin RECORD_LAYOUT Record_BOOLEAN FNC_VALUES 1 UBYTE COLUMN_DIR DIRECT /end RECORD_LAYOUT
/begin RECORD_LAYOUT Record_FLOAT32_IEEE FNC_VALUES 1 FLOAT32_IEEE COLUMN_DIR DIRECT /end RECORD_LAYOUT
/begin RECORD_LAYOUT Record_SBYTE FNC_VALUES 1 SBYTE COLUMN_DIR DIRECT /end RECORD_LAYOUT
/begin RECORD_LAYOUT Record_BOOLEAN FNC_VALUES 1 UBYTE COLUMN_DIR DIRECT /end RECORD_LAYOUT
/begin RECORD_LAYOUT Record_FLOAT32_IEEE FNC_VALUES 1 FLOAT32_IEEE COLUMN_DIR DIRECT /end RECORD_LAYOUT
/begin RECORD_LAYOUT Record_SBYTE FNC_VALUES 1 SBYTE COLUMN_DIR DIRECT /end RECORD_LAYOUT
/begin RECORD_LAYOUT Axis_FLOAT32_IEEE AXIS_PTS_X 1 FLOAT32_IEEE INDEX_INCR DIRECT /end RECORD_LAYOUT
/begin RECORD_LAYOUT Record_BOOLEAN FNC_VALUES 1 UBYTE COLUMN_DIR DIRECT /end RECORD_LAYOUT
/begin RECORD_LAYOUT Record_FLOAT32_IEEE FNC_VALUES 1 FLOAT32_IEEE COLUMN_DIR DIRECT /end RECORD_LAYOUT
/begin RECORD_LAYOUT Record_SBYTE FNC_VALUES 1 SBYTE COLUMN_DIR DIRECT /end RECORD_LAYOUT
/begin RECORD_LAYOUT Axis_FLOAT32_IEEE AXIS_PTS_X 1 FLOAT32_IEEE INDEX_INCR DIRECT /end RECORD_LAYOUT
/begin RECORD_LAYOUT Record_BOOLEAN FNC_VALUES 1 UBYTE COLUMN_DIR DIRECT /end RECORD_LAYOUT
/begin RECORD_LAYOUT Record_FLOAT32_IEEE FNC_VALUES 1 FLOAT32_IEEE COLUMN_DIR DIRECT /end RECORD_LAYOUT
/begin RECORD_LAYOUT Record_SBYTE FNC_VALUES 1 SBYTE COLUMN_DIR DIRECT /end RECORD_LAYOUT
/begin RECORD_LAYOUT Axis_FLOAT32_IEEE AXIS_PTS_X 1 FLOAT32_IEEE INDEX_INCR DIRECT /end RECORD_LAYOUT
/begin RECORD_LAYOUT Record_BOOLEAN FNC_VALUES 1 UBYTE COLUMN_DIR DIRECT /end RECORD_LAYOUT
/begin RECORD_LAYOUT Record_FLOAT32_IEEE FNC_VALUES 1 FLOAT32_IEEE COLUMN_DIR DIRECT /end RECORD_LAYOUT
/begin RECORD_LAYOUT Record_SBYTE FNC_VALUES 1 SBYTE COLUMN_DIR DIRECT /end RECORD_LAYOUT
/begin RECORD_LAYOUT Axis_FLOAT32_IEEE AXIS_PTS_X 1 FLOAT32_IEEE INDEX_INCR DIRECT /end RECORD_LAYOUT
/end MODULE
/end PROJECT
