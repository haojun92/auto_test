ASAP2_VERSION 1 71
/begin PROJECT ProjectName ""
/begin MODULE ModuleName ""
/begin MOD_COMMON "" BYTE_ORDER MSB_LAST ALIGNMENT_BYTE 1 ALIGNMENT_WORD 1 ALIGNMENT_LONG 1 ALIGNMENT_INT64 1 ALIGNMENT_FLOAT16_IEEE 1 ALIGNMENT_FLOAT32_IEEE 1 ALIGNMENT_FLOAT64_IEEE 1 /end MOD_COMMON
/begin RECORD_LAYOUT SSV__SLONG_S AXIS_PTS_X 1 SLONG INDEX_INCR DIRECT /end RECORD_LAYOUT
/begin RECORD_LAYOUT Record_BOOLEAN FNC_VALUES 1 UBYTE COLUMN_DIR DIRECT /end RECORD_LAYOUT
/begin RECORD_LAYOUT Record_FLOAT32_IEEE FNC_VALUES 1 FLOAT32_IEEE COLUMN_DIR DIRECT /end RECORD_LAYOUT
/begin RECORD_LAYOUT Record_FLOAT64_IEEE FNC_VALUES 1 FLOAT64_IEEE COLUMN_DIR DIRECT /end RECORD_LAYOUT
/begin RECORD_LAYOUT Record_SLONG FNC_VALUES 1 SLONG COLUMN_DIR DIRECT /end RECORD_LAYOUT
/begin RECORD_LAYOUT Record_SWORD FNC_VALUES 1 SWORD COLUMN_DIR DIRECT /end RECORD_LAYOUT
/begin RECORD_LAYOUT Record_UBYTE FNC_VALUES 1 UBYTE COLUMN_DIR DIRECT /end RECORD_LAYOUT
/begin RECORD_LAYOUT Record_UWORD FNC_VALUES 1 UWORD COLUMN_DIR DIRECT /end RECORD_LAYOUT
/begin RECORD_LAYOUT Axis_FLOAT32_IEEE AXIS_PTS_X 1 FLOAT32_IEEE INDEX_INCR DIRECT /end RECORD_LAYOUT
/begin RECORD_LAYOUT Record_BOOLEAN FNC_VALUES 1 UBYTE COLUMN_DIR DIRECT /end RECORD_LAYOUT
/begin RECORD_LAYOUT Record_FLOAT32_IEEE FNC_VALUES 1 FLOAT32_IEEE COLUMN_DIR DIRECT /end RECORD_LAYOUT
/begin RECORD_LAYOUT Record_UBYTE FNC_VALUES 1 UBYTE COLUMN_DIR DIRECT /end RECORD_LAYOUT
/begin RECORD_LAYOUT Record_UWORD FNC_VALUES 1 UWORD COLUMN_DIR DIRECT /end RECORD_LAYOUT
/begin RECORD_LAYOUT Axis_FLOAT32_IEEE AXIS_PTS_X 1 FLOAT32_IEEE INDEX_INCR DIRECT /end RECORD_LAYOUT
/begin RECORD_LAYOUT Record_BOOLEAN FNC_VALUES 1 UBYTE COLUMN_DIR DIRECT /end RECORD_LAYOUT
/begin RECORD_LAYOUT Record_FLOAT32_IEEE FNC_VALUES 1 FLOAT32_IEEE COLUMN_DIR DIRECT /end RECORD_LAYOUT
/begin RECORD_LAYOUT Record_FLOAT64_IEEE FNC_VALUES 1 FLOAT64_IEEE COLUMN_DIR DIRECT /end RECORD_LAYOUT
/begin RECORD_LAYOUT Record_SWORD FNC_VALUES 1 SWORD COLUMN_DIR DIRECT /end RECORD_LAYOUT
/begin RECORD_LAYOUT Record_UBYTE FNC_VALUES 1 UBYTE COLUMN_DIR DIRECT /end RECORD_LAYOUT
/begin RECORD_LAYOUT Record_BOOLEAN FNC_VALUES 1 UBYTE COLUMN_DIR DIRECT /end RECORD_LAYOUT
/begin RECORD_LAYOUT Record_FLOAT32_IEEE FNC_VALUES 1 FLOAT32_IEEE COLUMN_DIR DIRECT /end RECORD_LAYOUT
/begin RECORD_LAYOUT Record_UBYTE FNC_VALUES 1 UBYTE COLUMN_DIR DIRECT /end RECORD_LAYOUT
/begin RECORD_LAYOUT Record_UWORD FNC_VALUES 1 UWORD COLUMN_DIR DIRECT /end RECORD_LAYOUT
/begin RECORD_LAYOUT Axis_FLOAT32_IEEE AXIS_PTS_X 1 FLOAT32_IEEE INDEX_INCR DIRECT /end RECORD_LAYOUT
/begin RECORD_LAYOUT Record_BOOLEAN FNC_VALUES 1 UBYTE COLUMN_DIR DIRECT /end RECORD_LAYOUT
/begin RECORD_LAYOUT Record_FLOAT32_IEEE FNC_VALUES 1 FLOAT32_IEEE COLUMN_DIR DIRECT /end RECORD_LAYOUT
/begin RECORD_LAYOUT Record_FLOAT64_IEEE FNC_VALUES 1 FLOAT64_IEEE COLUMN_DIR DIRECT /end RECORD_LAYOUT
/begin RECORD_LAYOUT Record_SLONG FNC_VALUES 1 SLONG COLUMN_DIR DIRECT /end RECORD_LAYOUT
/begin RECORD_LAYOUT Record_SWORD FNC_VALUES 1 SWORD COLUMN_DIR DIRECT /end RECORD_LAYOUT
/begin RECORD_LAYOUT Record_UBYTE FNC_VALUES 1 UBYTE COLUMN_DIR DIRECT /end RECORD_LAYOUT
/begin RECORD_LAYOUT Record_UWORD FNC_VALUES 1 UWORD COLUMN_DIR DIRECT /end RECORD_LAYOUT
/begin RECORD_LAYOUT Axis_FLOAT32_IEEE AXIS_PTS_X 1 FLOAT32_IEEE INDEX_INCR DIRECT /end RECORD_LAYOUT
/begin CHARACTERISTIC P_ALC_OutLinePolyfitSwitch "" VALUE 0xfe821d52 /* @ECU_Address@P_ALC_OutLinePolyfitSwitch@ */ Record_BOOLEAN 0 autosar_swc_rlgs_CM_boolean 0 1 /end CHARACTERISTIC
/begin CHARACTERISTIC P_PG_AbandonOnlyLeftEnable "" VALUE 0xfe821d5d /* @ECU_Address@P_PG_AbandonOnlyLeftEnable@ */ Record_BOOLEAN 0 autosar_swc_rlgs_CM_boolean 0 1 /end CHARACTERISTIC
/begin CHARACTERISTIC P_PG_CenterLine2LBThresValue "" VALUE 0xfe821b28 /* @ECU_Address@P_PG_CenterLine2LBThresValue@ */ Record_FLOAT32_IEEE 0 autosar_swc_rlgs_CM_single -3.4E+38 3.4E+38 /end CHARACTERISTIC
/begin CHARACTERISTIC P_PG_CenterLineLostCompenMinRange "" VALUE 0xfe821b2c /* @ECU_Address@P_PG_CenterLineLostCompenMinRange@ */ Record_FLOAT32_IEEE 0 autosar_swc_rlgs_CM_single -3.4E+38 3.4E+38 /end CHARACTERISTIC
/begin CHARACTERISTIC P_PG_CenterLineTFilter "" VALUE 0xfe821b30 /* @ECU_Address@P_PG_CenterLineTFilter@ */ Record_FLOAT32_IEEE 0 autosar_swc_rlgs_CM_single -3.4E+38 3.4E+38 /end CHARACTERISTIC
/begin CHARACTERISTIC P_PG_ControlLineCalAyWeight "" VALUE 0xfe821b34 /* @ECU_Address@P_PG_ControlLineCalAyWeight@ */ Record_FLOAT32_IEEE 0 autosar_swc_rlgs_CM_single -3.4E+38 3.4E+38 /end CHARACTERISTIC
/begin CHARACTERISTIC P_PG_ControlLineCalDyWeight "" VALUE 0xfe821b38 /* @ECU_Address@P_PG_ControlLineCalDyWeight@ */ Record_FLOAT32_IEEE 0 autosar_swc_rlgs_CM_single -3.4E+38 3.4E+38 /end CHARACTERISTIC
/begin CHARACTERISTIC P_PG_ControlLineCalRangeWeight "" VALUE 0xfe821b3c /* @ECU_Address@P_PG_ControlLineCalRangeWeight@ */ Record_FLOAT32_IEEE 0 autosar_swc_rlgs_CM_single -3.4E+38 3.4E+38 /end CHARACTERISTIC
/begin CHARACTERISTIC P_PG_DOPA0Limit "" VALUE 0xfe821b40 /* @ECU_Address@P_PG_DOPA0Limit@ */ Record_FLOAT32_IEEE 0 autosar_swc_rlgs_CM_single -3.4E+38 3.4E+38 /end CHARACTERISTIC
/begin CHARACTERISTIC P_PG_DOPCheckSwitch "" VALUE 0xfe821d5e /* @ECU_Address@P_PG_DOPCheckSwitch@ */ Record_BOOLEAN 0 autosar_swc_rlgs_CM_boolean 0 1 /end CHARACTERISTIC
/begin CHARACTERISTIC P_PG_DeathLaneWidthThresvalue "" VALUE 0xfe821b44 /* @ECU_Address@P_PG_DeathLaneWidthThresvalue@ */ Record_FLOAT32_IEEE 0 autosar_swc_rlgs_CM_single -3.4E+38 3.4E+38 /end CHARACTERISTIC
/begin CHARACTERISTIC P_PG_DieOutLaneLcDefaultValue "" VALUE 0xfe821d5f /* @ECU_Address@P_PG_DieOutLaneLcDefaultValue@ */ Record_UBYTE 0 autosar_swc_rlgs_CM_uint8 0 255 /end CHARACTERISTIC
/begin CHARACTERISTIC P_PG_DieOutLaneLcSw "" VALUE 0xfe821d60 /* @ECU_Address@P_PG_DieOutLaneLcSw@ */ Record_BOOLEAN 0 autosar_swc_rlgs_CM_boolean 0 1 /end CHARACTERISTIC
/begin CHARACTERISTIC P_PG_DirStsKeepDisValue "" VALUE 0xfe821b48 /* @ECU_Address@P_PG_DirStsKeepDisValue@ */ Record_FLOAT32_IEEE 0 autosar_swc_rlgs_CM_single -3.4E+38 3.4E+38 /end CHARACTERISTIC
/begin CHARACTERISTIC P_PG_Dis2StubThreshold "" VALUE 0xfe821d38 /* @ECU_Address@P_PG_Dis2StubThreshold@ */ Record_UWORD 0 autosar_swc_rlgs_CM_uint16 0 65535 /end CHARACTERISTIC
/begin CHARACTERISTIC P_PG_DopSelectLaneEndLimit "" VALUE 0xfe821b4c /* @ECU_Address@P_PG_DopSelectLaneEndLimit@ */ Record_FLOAT32_IEEE 0 autosar_swc_rlgs_CM_single -3.4E+38 3.4E+38 /end CHARACTERISTIC
/begin CHARACTERISTIC P_PG_DyThresthold "" VALUE 0xfe821b50 /* @ECU_Address@P_PG_DyThresthold@ */ Record_FLOAT32_IEEE 0 autosar_swc_rlgs_CM_single -3.4E+38 3.4E+38 /end CHARACTERISTIC
/begin CHARACTERISTIC P_PG_EdgeControlLineKeepTime "" VALUE 0xfe821b54 /* @ECU_Address@P_PG_EdgeControlLineKeepTime@ */ Record_FLOAT32_IEEE 0 autosar_swc_rlgs_CM_single -3.4E+38 3.4E+38 /end CHARACTERISTIC
/begin CHARACTERISTIC P_PG_EdgeMinLatDis2CalControlLine "" VALUE 0xfe821b58 /* @ECU_Address@P_PG_EdgeMinLatDis2CalControlLine@ */ Record_FLOAT32_IEEE 0 autosar_swc_rlgs_CM_single -3.4E+38 3.4E+38 /end CHARACTERISTIC
/begin CHARACTERISTIC P_PG_EdgeThresValue "" VALUE 0xfe821b5c /* @ECU_Address@P_PG_EdgeThresValue@ */ Record_FLOAT32_IEEE 0 autosar_swc_rlgs_CM_single -3.4E+38 3.4E+38 /end CHARACTERISTIC
/begin CHARACTERISTIC P_PG_EgeThresthold "" VALUE 0xfe821b60 /* @ECU_Address@P_PG_EgeThresthold@ */ Record_FLOAT32_IEEE 0 autosar_swc_rlgs_CM_single -3.4E+38 3.4E+38 /end CHARACTERISTIC
/begin CHARACTERISTIC P_PG_ExitLineLastSW "" VALUE 0xfe821d61 /* @ECU_Address@P_PG_ExitLineLastSW@ */ Record_BOOLEAN 0 autosar_swc_rlgs_CM_boolean 0 1 /end CHARACTERISTIC
/begin CHARACTERISTIC P_PG_HisWigh "" VALUE 0xfe821b64 /* @ECU_Address@P_PG_HisWigh@ */ Record_FLOAT32_IEEE 0 autosar_swc_rlgs_CM_single -3.4E+38 3.4E+38 /end CHARACTERISTIC
/begin CHARACTERISTIC P_PG_IhbibitCrossAvaiByConeFlag "" VALUE 0xfe821d62 /* @ECU_Address@P_PG_IhbibitCrossAvaiByConeFlag@ */ Record_BOOLEAN 0 autosar_swc_rlgs_CM_boolean 0 1 /end CHARACTERISTIC
/begin CHARACTERISTIC P_PG_JunctionLengthValue "" VALUE 0xfe821b68 /* @ECU_Address@P_PG_JunctionLengthValue@ */ Record_FLOAT32_IEEE 0 autosar_swc_rlgs_CM_single -3.4E+38 3.4E+38 /end CHARACTERISTIC
/begin CHARACTERISTIC P_PG_JunctiondistanceValue "" VALUE 0xfe821b6c /* @ECU_Address@P_PG_JunctiondistanceValue@ */ Record_FLOAT32_IEEE 0 autosar_swc_rlgs_CM_single -3.4E+38 3.4E+38 /end CHARACTERISTIC
/begin CHARACTERISTIC P_PG_L1ShadeLatDisThreshold "" VALUE 0xfe821b70 /* @ECU_Address@P_PG_L1ShadeLatDisThreshold@ */ Record_FLOAT32_IEEE 0 autosar_swc_rlgs_CM_single -3.4E+38 3.4E+38 /end CHARACTERISTIC
/begin CHARACTERISTIC P_PG_L1SwitchL2Sw "" VALUE 0xfe821d63 /* @ECU_Address@P_PG_L1SwitchL2Sw@ */ Record_BOOLEAN 0 autosar_swc_rlgs_CM_boolean 0 1 /end CHARACTERISTIC
/begin CHARACTERISTIC P_PG_L2LatDisThresHold "" VALUE 0xfe821b74 /* @ECU_Address@P_PG_L2LatDisThresHold@ */ Record_FLOAT32_IEEE 0 autosar_swc_rlgs_CM_single -3.4E+38 3.4E+38 /end CHARACTERISTIC
/begin CHARACTERISTIC P_PG_LAndRLineC0Err "" VALUE 0xfe821b78 /* @ECU_Address@P_PG_LAndRLineC0Err@ */ Record_FLOAT32_IEEE 0 autosar_swc_rlgs_CM_single -3.4E+38 3.4E+38 /end CHARACTERISTIC
/begin CHARACTERISTIC P_PG_LeRM2LineDyValueThres "" VALUE 0xfe821b7c /* @ECU_Address@P_PG_LeRM2LineDyValueThres@ */ Record_FLOAT32_IEEE 0 autosar_swc_rlgs_CM_single -3.4E+38 3.4E+38 /end CHARACTERISTIC
/begin CHARACTERISTIC P_PG_LeftCone2L2ThresValue "" VALUE 0xfe821b80 /* @ECU_Address@P_PG_LeftCone2L2ThresValue@ */ Record_FLOAT32_IEEE 0 autosar_swc_rlgs_CM_single -3.4E+38 3.4E+38 /end CHARACTERISTIC
/begin CHARACTERISTIC P_PG_LeftCone2LeftLineMinDisValue "" VALUE 0xfe821b84 /* @ECU_Address@P_PG_LeftCone2LeftLineMinDisValue@ */ Record_FLOAT32_IEEE 0 autosar_swc_rlgs_CM_single -3.4E+38 3.4E+38 /end CHARACTERISTIC
/begin CHARACTERISTIC P_PG_LeftConeInLeftPathThreshold "" VALUE 0xfe821b88 /* @ECU_Address@P_PG_LeftConeInLeftPathThreshold@ */ Record_FLOAT32_IEEE 0 autosar_swc_rlgs_CM_single -3.4E+38 3.4E+38 /end CHARACTERISTIC
/begin CHARACTERISTIC P_PG_LeftLineFalseByLeftEdgeDis "" VALUE 0xfe821b8c /* @ECU_Address@P_PG_LeftLineFalseByLeftEdgeDis@ */ Record_FLOAT32_IEEE 0 autosar_swc_rlgs_CM_single -3.4E+38 3.4E+38 /end CHARACTERISTIC
/begin CHARACTERISTIC P_PG_LeftLineFalseByRiEdgeDis "" VALUE 0xfe821b90 /* @ECU_Address@P_PG_LeftLineFalseByRiEdgeDis@ */ Record_FLOAT32_IEEE 0 autosar_swc_rlgs_CM_single -3.4E+38 3.4E+38 /end CHARACTERISTIC
/begin CHARACTERISTIC P_PG_LineLostComTime "" VALUE 0xfe821b94 /* @ECU_Address@P_PG_LineLostComTime@ */ Record_FLOAT32_IEEE 0 autosar_swc_rlgs_CM_single -3.4E+38 3.4E+38 /end CHARACTERISTIC
/begin CHARACTERISTIC P_PG_LineLowPassFilter "" VALUE 0xfe821b98 /* @ECU_Address@P_PG_LineLowPassFilter@ */ Record_FLOAT32_IEEE 0 autosar_swc_rlgs_CM_single -3.4E+38 3.4E+38 /end CHARACTERISTIC
/begin CHARACTERISTIC P_PG_LineRangeWeight "" MAP 0xfe821dc8 /* @ECU_Address@P_PG_LineRangeWeight@ */ Record_FLOAT32_IEEE 0 autosar_swc_rlgs_CM_single -3.4E+38 3.4E+38
 /begin AXIS_DESCR COM_AXIS autosar_swc_rlgs_rtARID_DEF.Switch2 autosar_swc_rlgs_CM_single 9 -3.4E+38 3.4E+38 AXIS_PTS_REF P_PG_LineRangeForWeight /end AXIS_DESCR
 /begin AXIS_DESCR COM_AXIS NO_INPUT_QUANTITY autosar_swc_rlgs_CM_single 4 -3.4E+38 3.4E+38 AXIS_PTS_REF P_PG_VehSpdForLineWeight /end AXIS_DESCR
/end CHARACTERISTIC
/begin CHARACTERISTIC P_PG_MaxRoadWidth "" VALUE 0xfe821b9c /* @ECU_Address@P_PG_MaxRoadWidth@ */ Record_FLOAT32_IEEE 0 autosar_swc_rlgs_CM_single -3.4E+38 3.4E+38 /end CHARACTERISTIC
/begin CHARACTERISTIC P_PG_MinLatDisLimitForL2SwL1 "" VALUE 0xfe821ba0 /* @ECU_Address@P_PG_MinLatDisLimitForL2SwL1@ */ Record_FLOAT32_IEEE 0 autosar_swc_rlgs_CM_single -3.4E+38 3.4E+38 /end CHARACTERISTIC
/begin CHARACTERISTIC P_PG_MinRoadWidth "" VALUE 0xfe821ba4 /* @ECU_Address@P_PG_MinRoadWidth@ */ Record_FLOAT32_IEEE 0 autosar_swc_rlgs_CM_single -3.4E+38 3.4E+38 /end CHARACTERISTIC
/begin CHARACTERISTIC P_PG_MinRoadWidthAllowLc "" VALUE 0xfe821ba8 /* @ECU_Address@P_PG_MinRoadWidthAllowLc@ */ Record_FLOAT32_IEEE 0 autosar_swc_rlgs_CM_single -3.4E+38 3.4E+38 /end CHARACTERISTIC
/begin CHARACTERISTIC P_PG_PreTimeUseforCalCurRoadwidth "" VALUE 0xfe821bac /* @ECU_Address@P_PG_PreTimeUseforCalCurRoadwidth@ */ Record_FLOAT32_IEEE 0 autosar_swc_rlgs_CM_single -3.4E+38 3.4E+38 /end CHARACTERISTIC
/begin CHARACTERISTIC P_PG_PreTimeUseforCalRoadwidth "" VALUE 0xfe821bb0 /* @ECU_Address@P_PG_PreTimeUseforCalRoadwidth@ */ Record_FLOAT32_IEEE 0 autosar_swc_rlgs_CM_single -3.4E+38 3.4E+38 /end CHARACTERISTIC
/begin CHARACTERISTIC P_PG_RM2LineDyValueThres "" VALUE 0xfe821bb4 /* @ECU_Address@P_PG_RM2LineDyValueThres@ */ Record_FLOAT32_IEEE 0 autosar_swc_rlgs_CM_single -3.4E+38 3.4E+38 /end CHARACTERISTIC
/begin CHARACTERISTIC P_PG_RiCone2R2ThresValue "" VALUE 0xfe821bb8 /* @ECU_Address@P_PG_RiCone2R2ThresValue@ */ Record_FLOAT32_IEEE 0 autosar_swc_rlgs_CM_single -3.4E+38 3.4E+38 /end CHARACTERISTIC
/begin CHARACTERISTIC P_PG_RiCone2RiLineMinDisValue "" VALUE 0xfe821bbc /* @ECU_Address@P_PG_RiCone2RiLineMinDisValue@ */ Record_FLOAT32_IEEE 0 autosar_swc_rlgs_CM_single -3.4E+38 3.4E+38 /end CHARACTERISTIC
/begin CHARACTERISTIC P_PG_RiConeInLeftPathThreshold "" VALUE 0xfe821bc0 /* @ECU_Address@P_PG_RiConeInLeftPathThreshold@ */ Record_FLOAT32_IEEE 0 autosar_swc_rlgs_CM_single -3.4E+38 3.4E+38 /end CHARACTERISTIC
/begin CHARACTERISTIC P_PG_RiLineFalseByRiEdgeDis "" VALUE 0xfe821bc4 /* @ECU_Address@P_PG_RiLineFalseByRiEdgeDis@ */ Record_FLOAT32_IEEE 0 autosar_swc_rlgs_CM_single -3.4E+38 3.4E+38 /end CHARACTERISTIC
/begin CHARACTERISTIC P_PG_RiRM2LineDyValueThres "" VALUE 0xfe821bc8 /* @ECU_Address@P_PG_RiRM2LineDyValueThres@ */ Record_FLOAT32_IEEE 0 autosar_swc_rlgs_CM_single -3.4E+38 3.4E+38 /end CHARACTERISTIC
/begin CHARACTERISTIC P_PG_RiSplitFRWhelDyThresValue "" VALUE 0xfe821bcc /* @ECU_Address@P_PG_RiSplitFRWhelDyThresValue@ */ Record_FLOAT32_IEEE 0 autosar_swc_rlgs_CM_single -3.4E+38 3.4E+38 /end CHARACTERISTIC
/begin CHARACTERISTIC P_PG_RoadSemanticsCalRangeWeight "" VALUE 0xfe821bd0 /* @ECU_Address@P_PG_RoadSemanticsCalRangeWeight@ */ Record_FLOAT32_IEEE 0 autosar_swc_rlgs_CM_single -3.4E+38 3.4E+38 /end CHARACTERISTIC
/begin CHARACTERISTIC P_PG_RoadSemanticsStsCalAyWeight "" VALUE 0xfe821bd4 /* @ECU_Address@P_PG_RoadSemanticsStsCalAyWeight@ */ Record_FLOAT32_IEEE 0 autosar_swc_rlgs_CM_single -3.4E+38 3.4E+38 /end CHARACTERISTIC
/begin CHARACTERISTIC P_PG_RoadSemanticsStsCalDyWeight "" VALUE 0xfe821bd8 /* @ECU_Address@P_PG_RoadSemanticsStsCalDyWeight@ */ Record_FLOAT32_IEEE 0 autosar_swc_rlgs_CM_single -3.4E+38 3.4E+38 /end CHARACTERISTIC
/begin CHARACTERISTIC P_PG_ShieldR1LineTypeStubDis "" VALUE 0xfe821d3a /* @ECU_Address@P_PG_ShieldR1LineTypeStubDis@ */ Record_UWORD 0 autosar_swc_rlgs_CM_uint16 0 65535 /end CHARACTERISTIC
/begin CHARACTERISTIC P_PG_SplitLineLineLostKeepTime "" VALUE 0xfe821be0 /* @ECU_Address@P_PG_SplitLineLineLostKeepTime@ */ Record_FLOAT32_IEEE 0 autosar_swc_rlgs_CM_single -3.4E+38 3.4E+38 /end CHARACTERISTIC
/begin CHARACTERISTIC P_PG_SplitLineSW "" VALUE 0xfe821d65 /* @ECU_Address@P_PG_SplitLineSW@ */ Record_BOOLEAN 0 autosar_swc_rlgs_CM_boolean 0 1 /end CHARACTERISTIC
/begin CHARACTERISTIC P_PG_StepTime "" VALUE 0xfe821be4 /* @ECU_Address@P_PG_StepTime@ */ Record_FLOAT32_IEEE 0 autosar_swc_rlgs_CM_single -3.4E+38 3.4E+38 /end CHARACTERISTIC
/begin CHARACTERISTIC P_PG_StopLineMaxValue "" VALUE 0xfe821d3c /* @ECU_Address@P_PG_StopLineMaxValue@ */ Record_SWORD 0 autosar_swc_rlgs_CM_int16 -32768 32767 /end CHARACTERISTIC
/begin CHARACTERISTIC P_PG_StopLineMinValue "" VALUE 0xfe821d3e /* @ECU_Address@P_PG_StopLineMinValue@ */ Record_SWORD 0 autosar_swc_rlgs_CM_int16 -32768 32767 /end CHARACTERISTIC
/begin CHARACTERISTIC P_PG_StubStartDisforSugg "" VALUE 0xfe821be8 /* @ECU_Address@P_PG_StubStartDisforSugg@ */ Record_SLONG 0 autosar_swc_rlgs_CM_int32 -2147483648 2147483647 /end CHARACTERISTIC
/begin CHARACTERISTIC P_PG_TFCDisComMaxThresValue "" VALUE 0xfe821bec /* @ECU_Address@P_PG_TFCDisComMaxThresValue@ */ Record_FLOAT32_IEEE 0 autosar_swc_rlgs_CM_single -3.4E+38 3.4E+38 /end CHARACTERISTIC
/begin CHARACTERISTIC P_PG_TFCDisComMinThresValue "" VALUE 0xfe821bf0 /* @ECU_Address@P_PG_TFCDisComMinThresValue@ */ Record_FLOAT32_IEEE 0 autosar_swc_rlgs_CM_single -3.4E+38 3.4E+38 /end CHARACTERISTIC
/begin CHARACTERISTIC P_PG_TFCDisMaxThresValue "" VALUE 0xfe821bf4 /* @ECU_Address@P_PG_TFCDisMaxThresValue@ */ Record_FLOAT32_IEEE 0 autosar_swc_rlgs_CM_single -3.4E+38 3.4E+38 /end CHARACTERISTIC
/begin CHARACTERISTIC P_PG_TFCDisMinThresValue "" VALUE 0xfe821bf8 /* @ECU_Address@P_PG_TFCDisMinThresValue@ */ Record_FLOAT32_IEEE 0 autosar_swc_rlgs_CM_single -3.4E+38 3.4E+38 /end CHARACTERISTIC
/begin CHARACTERISTIC P_PG_TFCMaxThresValue "" VALUE 0xfe821bfc /* @ECU_Address@P_PG_TFCMaxThresValue@ */ Record_FLOAT32_IEEE 0 autosar_swc_rlgs_CM_single -3.4E+38 3.4E+38 /end CHARACTERISTIC
/begin CHARACTERISTIC P_PG_TFCMinThresValue "" VALUE 0xfe821c00 /* @ECU_Address@P_PG_TFCMinThresValue@ */ Record_FLOAT32_IEEE 0 autosar_swc_rlgs_CM_single -3.4E+38 3.4E+38 /end CHARACTERISTIC
/begin CHARACTERISTIC P_PG_TFCRoadWidthMax "" VALUE 0xfe821c04 /* @ECU_Address@P_PG_TFCRoadWidthMax@ */ Record_FLOAT32_IEEE 0 autosar_swc_rlgs_CM_single -3.4E+38 3.4E+38 /end CHARACTERISTIC
/begin CHARACTERISTIC P_PG_TFCRoadWidthMin "" VALUE 0xfe821c08 /* @ECU_Address@P_PG_TFCRoadWidthMin@ */ Record_FLOAT32_IEEE 0 autosar_swc_rlgs_CM_single -3.4E+38 3.4E+38 /end CHARACTERISTIC
/begin CHARACTERISTIC P_PG_TJAPathSelectDisableMinSpd_ms "" VALUE 0xfe821c0c /* @ECU_Address@P_PG_TJAPathSelectDisableMinSpd_ms@ */ Record_FLOAT32_IEEE 0 autosar_swc_rlgs_CM_single -3.4E+38 3.4E+38 /end CHARACTERISTIC
/begin CHARACTERISTIC P_PG_TJAPathSelectEnableMinSpd_ms "" VALUE 0xfe821c10 /* @ECU_Address@P_PG_TJAPathSelectEnableMinSpd_ms@ */ Record_FLOAT32_IEEE 0 autosar_swc_rlgs_CM_single -3.4E+38 3.4E+38 /end CHARACTERISTIC
/begin CHARACTERISTIC P_PG_ThresholdLine "" VALUE 0xfe821c14 /* @ECU_Address@P_PG_ThresholdLine@ */ Record_FLOAT32_IEEE 0 autosar_swc_rlgs_CM_single -3.4E+38 3.4E+38 /end CHARACTERISTIC
/begin CHARACTERISTIC P_PG_centerLinePolyfitEnable "" VALUE 0xfe821d66 /* @ECU_Address@P_PG_centerLinePolyfitEnable@ */ Record_BOOLEAN 0 autosar_swc_rlgs_CM_boolean 0 1 /end CHARACTERISTIC
/begin CHARACTERISTIC P_PG_diffThreshold "" VALUE 0xfe821c18 /* @ECU_Address@P_PG_diffThreshold@ */ Record_FLOAT32_IEEE 0 autosar_swc_rlgs_CM_single -3.4E+38 3.4E+38 /end CHARACTERISTIC
/begin CHARACTERISTIC P_PG_doubleLineSelectEnable "" VALUE 0xfe821d67 /* @ECU_Address@P_PG_doubleLineSelectEnable@ */ Record_BOOLEAN 0 autosar_swc_rlgs_CM_boolean 0 1 /end CHARACTERISTIC
/begin CHARACTERISTIC P_PG_l2l_Limitation "" VALUE 0xfe821c1c /* @ECU_Address@P_PG_l2l_Limitation@ */ Record_FLOAT32_IEEE 0 autosar_swc_rlgs_CM_single -3.4E+38 3.4E+38 /end CHARACTERISTIC
/begin CHARACTERISTIC P_PG_maxHoldDist "" VALUE 0xfe821c20 /* @ECU_Address@P_PG_maxHoldDist@ */ Record_FLOAT32_IEEE 0 autosar_swc_rlgs_CM_single -3.4E+38 3.4E+38 /end CHARACTERISTIC
/begin CHARACTERISTIC P_PG_meanErrThresValue "" VALUE 0xfe821c24 /* @ECU_Address@P_PG_meanErrThresValue@ */ Record_FLOAT32_IEEE 0 autosar_swc_rlgs_CM_single -3.4E+38 3.4E+38 /end CHARACTERISTIC
/begin CHARACTERISTIC P_PP_EdgeOffset "" VALUE 0xfe821c28 /* @ECU_Address@P_PP_EdgeOffset@ */ Record_FLOAT32_IEEE 0 autosar_swc_rlgs_CM_single -3.4E+38 3.4E+38 /end CHARACTERISTIC
/begin CHARACTERISTIC P_PP_LineSTD_Limit "" VALUE 0xfe821ae8 /* @ECU_Address@P_PP_LineSTD_Limit@ */ Record_FLOAT64_IEEE 0 autosar_swc_rlgs_CM_double -1.7E+308 1.7E+308 /end CHARACTERISTIC
/begin CHARACTERISTIC P_PP_WaitingLineKapLim "" VALUE 0xfe821c2c /* @ECU_Address@P_PP_WaitingLineKapLim@ */ Record_FLOAT32_IEEE 0 autosar_swc_rlgs_CM_single -3.4E+38 3.4E+38 /end CHARACTERISTIC
/begin CHARACTERISTIC P_PSM_CenterDyThresValue "" VALUE 0xfe821af0 /* @ECU_Address@P_PSM_CenterDyThresValue@ */ Record_FLOAT64_IEEE 0 autosar_swc_rlgs_CM_double -1.7E+308 1.7E+308 /end CHARACTERISTIC
/begin CHARACTERISTIC P_PSM_CurrLaneDieOutJudgeSW "" VALUE 0xfe821d6c /* @ECU_Address@P_PSM_CurrLaneDieOutJudgeSW@ */ Record_BOOLEAN 0 autosar_swc_rlgs_CM_boolean 0 1 /end CHARACTERISTIC
/begin CHARACTERISTIC P_PSM_J3TFCSw "" VALUE 0xfe821d70 /* @ECU_Address@P_PSM_J3TFCSw@ */ Record_BOOLEAN 0 autosar_swc_rlgs_CM_boolean 0 1 /end CHARACTERISTIC
/begin MEASUREMENT PG_CenterLaneDirection "" UBYTE autosar_swc_rlgs_CM_uint8 0 0 0 255 ECU_ADDRESS 0xfe4b001c /* @ECU_Address@PG_CenterLaneDirection@ */ /end MEASUREMENT
/begin MEASUREMENT PG_ControlLineCalSource "" UBYTE autosar_swc_rlgs_CM_uint8 0 0 0 255 ECU_ADDRESS 0xfe4b001d /* @ECU_Address@PG_ControlLineCalSource@ */ /end MEASUREMENT
/begin MEASUREMENT PG_CurPathYbranchFlag "" UBYTE autosar_swc_rlgs_CM_boolean 0 0 0 1 ECU_ADDRESS 0xfe4b001e /* @ECU_Address@PG_CurPathYbranchFlag@ */ /end MEASUREMENT
/begin MEASUREMENT PG_HPPLineModel_First_C0 "" FLOAT32_IEEE autosar_swc_rlgs_CM_single 0 0 -3.4E+38 3.4E+38 MATRIX_DIM 1 1 ECU_ADDRESS 0xfe4afdd8 /* @ECU_Address@PG_HPPLineModel_First_C0@ */ /end MEASUREMENT
/begin MEASUREMENT PG_HPPLineModel_First_C1 "" FLOAT32_IEEE autosar_swc_rlgs_CM_single 0 0 -3.4E+38 3.4E+38 MATRIX_DIM 1 1 ECU_ADDRESS 0xfe4afddc /* @ECU_Address@PG_HPPLineModel_First_C1@ */ /end MEASUREMENT
/begin MEASUREMENT PG_HPPLineModel_First_C2 "" FLOAT32_IEEE autosar_swc_rlgs_CM_single 0 0 -3.4E+38 3.4E+38 MATRIX_DIM 1 1 ECU_ADDRESS 0xfe4afde0 /* @ECU_Address@PG_HPPLineModel_First_C2@ */ /end MEASUREMENT
/begin MEASUREMENT PG_HPPLineModel_First_C3 "" FLOAT32_IEEE autosar_swc_rlgs_CM_single 0 0 -3.4E+38 3.4E+38 MATRIX_DIM 1 1 ECU_ADDRESS 0xfe4afde4 /* @ECU_Address@PG_HPPLineModel_First_C3@ */ /end MEASUREMENT
/begin MEASUREMENT PG_HPPLineModel_Second_C0 "" FLOAT32_IEEE autosar_swc_rlgs_CM_single 0 0 -3.4E+38 3.4E+38 MATRIX_DIM 1 1 ECU_ADDRESS 0xfe4afde8 /* @ECU_Address@PG_HPPLineModel_Second_C0@ */ /end MEASUREMENT
/begin MEASUREMENT PG_HPPLineModel_Second_C1 "" FLOAT32_IEEE autosar_swc_rlgs_CM_single 0 0 -3.4E+38 3.4E+38 MATRIX_DIM 1 1 ECU_ADDRESS 0xfe4afdec /* @ECU_Address@PG_HPPLineModel_Second_C1@ */ /end MEASUREMENT
/begin MEASUREMENT PG_HPPLineModel_Second_C2 "" FLOAT32_IEEE autosar_swc_rlgs_CM_single 0 0 -3.4E+38 3.4E+38 MATRIX_DIM 1 1 ECU_ADDRESS 0xfe4afdf0 /* @ECU_Address@PG_HPPLineModel_Second_C2@ */ /end MEASUREMENT
/begin MEASUREMENT PG_HPPLineModel_Second_C3 "" FLOAT32_IEEE autosar_swc_rlgs_CM_single 0 0 -3.4E+38 3.4E+38 MATRIX_DIM 1 1 ECU_ADDRESS 0xfe4afdf4 /* @ECU_Address@PG_HPPLineModel_Second_C3@ */ /end MEASUREMENT
/begin MEASUREMENT PG_HPPLineModel_Third_C0 "" FLOAT32_IEEE autosar_swc_rlgs_CM_single 0 0 -3.4E+38 3.4E+38 MATRIX_DIM 1 1 ECU_ADDRESS 0xfe4afdf8 /* @ECU_Address@PG_HPPLineModel_Third_C0@ */ /end MEASUREMENT
/begin MEASUREMENT PG_HPPLineModel_Third_C1 "" FLOAT32_IEEE autosar_swc_rlgs_CM_single 0 0 -3.4E+38 3.4E+38 MATRIX_DIM 1 1 ECU_ADDRESS 0xfe4afdfc /* @ECU_Address@PG_HPPLineModel_Third_C1@ */ /end MEASUREMENT
/begin MEASUREMENT PG_HPPLineModel_Third_C2 "" FLOAT32_IEEE autosar_swc_rlgs_CM_single 0 0 -3.4E+38 3.4E+38 MATRIX_DIM 1 1 ECU_ADDRESS 0xfe4afe00 /* @ECU_Address@PG_HPPLineModel_Third_C2@ */ /end MEASUREMENT
/begin MEASUREMENT PG_HPPLineModel_Third_C3 "" FLOAT32_IEEE autosar_swc_rlgs_CM_single 0 0 -3.4E+38 3.4E+38 MATRIX_DIM 1 1 ECU_ADDRESS 0xfe4afe04 /* @ECU_Address@PG_HPPLineModel_Third_C3@ */ /end MEASUREMENT
/begin MEASUREMENT PG_HPPLine_Confidence "" UBYTE autosar_swc_rlgs_CM_uint8 0 0 0 255 MATRIX_DIM 1 1 ECU_ADDRESS 0xfe4b001f /* @ECU_Address@PG_HPPLine_Confidence@ */ /end MEASUREMENT
/begin MEASUREMENT PG_HPPLine_First_Valid "" UBYTE autosar_swc_rlgs_CM_uint8 0 0 0 255 MATRIX_DIM 1 1 ECU_ADDRESS 0xfe4b0020 /* @ECU_Address@PG_HPPLine_First_Valid@ */ /end MEASUREMENT
/begin MEASUREMENT PG_HPPLine_Half_Width "" FLOAT32_IEEE autosar_swc_rlgs_CM_single 0 0 -3.4E+38 3.4E+38 MATRIX_DIM 1 1 ECU_ADDRESS 0xfe4afe08 /* @ECU_Address@PG_HPPLine_Half_Width@ */ /end MEASUREMENT
/begin MEASUREMENT PG_HPPLine_MeasuringStatus "" UBYTE autosar_swc_rlgs_CM_uint8 0 0 0 255 MATRIX_DIM 1 1 ECU_ADDRESS 0xfe4b0021 /* @ECU_Address@PG_HPPLine_MeasuringStatus@ */ /end MEASUREMENT
/begin MEASUREMENT PG_HPPLine_Second_Valid "" UBYTE autosar_swc_rlgs_CM_uint8 0 0 0 255 MATRIX_DIM 1 1 ECU_ADDRESS 0xfe4b0022 /* @ECU_Address@PG_HPPLine_Second_Valid@ */ /end MEASUREMENT
/begin MEASUREMENT PG_HPPLine_Third_Valid "" UBYTE autosar_swc_rlgs_CM_uint8 0 0 0 255 MATRIX_DIM 1 1 ECU_ADDRESS 0xfe4b0023 /* @ECU_Address@PG_HPPLine_Third_Valid@ */ /end MEASUREMENT
/begin MEASUREMENT PG_HPPLine_TrackID "" UWORD autosar_swc_rlgs_CM_uint16 0 0 0 65535 MATRIX_DIM 1 1 ECU_ADDRESS 0xfe4afff8 /* @ECU_Address@PG_HPPLine_TrackID@ */ /end MEASUREMENT
/begin MEASUREMENT PG_HPPLine_ViewRange_End_First "" FLOAT32_IEEE autosar_swc_rlgs_CM_single 0 0 -3.4E+38 3.4E+38 MATRIX_DIM 1 1 ECU_ADDRESS 0xfe4afe0c /* @ECU_Address@PG_HPPLine_ViewRange_End_First@ */ /end MEASUREMENT
/begin MEASUREMENT PG_HPPLine_ViewRange_End_Second "" FLOAT32_IEEE autosar_swc_rlgs_CM_single 0 0 -3.4E+38 3.4E+38 MATRIX_DIM 1 1 ECU_ADDRESS 0xfe4afe10 /* @ECU_Address@PG_HPPLine_ViewRange_End_Second@ */ /end MEASUREMENT
/begin MEASUREMENT PG_HPPLine_ViewRange_End_Third "" FLOAT32_IEEE autosar_swc_rlgs_CM_single 0 0 -3.4E+38 3.4E+38 MATRIX_DIM 1 1 ECU_ADDRESS 0xfe4afe14 /* @ECU_Address@PG_HPPLine_ViewRange_End_Third@ */ /end MEASUREMENT
/begin MEASUREMENT PG_IsWaitingLine "" UBYTE autosar_swc_rlgs_CM_boolean 0 0 0 1 ECU_ADDRESS 0xfe4b0024 /* @ECU_Address@PG_IsWaitingLine@ */ /end MEASUREMENT
/begin MEASUREMENT PG_J3_Update "" UBYTE autosar_swc_rlgs_CM_boolean 0 0 0 1 MATRIX_DIM 1 1 ECU_ADDRESS 0xfe4b0025 /* @ECU_Address@PG_J3_Update@ */ /end MEASUREMENT
/begin MEASUREMENT PG_LeftLaneChangeFlag "" UBYTE autosar_swc_rlgs_CM_boolean 0 0 0 1 ECU_ADDRESS 0xfe4b0026 /* @ECU_Address@PG_LeftLaneChangeFlag@ */ /end MEASUREMENT
/begin MEASUREMENT PG_LeftLaneDirection "" UBYTE autosar_swc_rlgs_CM_uint8 0 0 0 255 ECU_ADDRESS 0xfe4b0027 /* @ECU_Address@PG_LeftLaneDirection@ */ /end MEASUREMENT
/begin MEASUREMENT PG_LeftLineC0 "" FLOAT32_IEEE autosar_swc_rlgs_CM_single 0 0 -3.4E+38 3.4E+38 MATRIX_DIM 1 1 ECU_ADDRESS 0xfe4afe18 /* @ECU_Address@PG_LeftLineC0@ */ /end MEASUREMENT
/begin MEASUREMENT PG_LeftLineSource "" UBYTE autosar_swc_rlgs_CM_uint8 0 0 0 255 ECU_ADDRESS 0xfe4b0028 /* @ECU_Address@PG_LeftLineSource@ */ /end MEASUREMENT
/begin MEASUREMENT PG_LeftLineValid "" UBYTE autosar_swc_rlgs_CM_boolean 0 0 0 1 MATRIX_DIM 1 1 ECU_ADDRESS 0xfe4b0029 /* @ECU_Address@PG_LeftLineValid@ */ /end MEASUREMENT
/begin MEASUREMENT PG_LeftPathYbranchFlag "" UBYTE autosar_swc_rlgs_CM_boolean 0 0 0 1 ECU_ADDRESS 0xfe4b002a /* @ECU_Address@PG_LeftPathYbranchFlag@ */ /end MEASUREMENT
/begin MEASUREMENT PG_Left_ConeRoadEdgeConfidence "" UBYTE autosar_swc_rlgs_CM_uint8 0 0 0 255 MATRIX_DIM 1 1 ECU_ADDRESS 0xfe4b002b /* @ECU_Address@PG_Left_ConeRoadEdgeConfidence@ */ /end MEASUREMENT
/begin MEASUREMENT PG_Left_ConeRoadEdgeMeasuringStatus "" UBYTE autosar_swc_rlgs_CM_uint8 0 0 0 255 MATRIX_DIM 1 1 ECU_ADDRESS 0xfe4b002c /* @ECU_Address@PG_Left_ConeRoadEdgeMeasuringStatus@ */ /end MEASUREMENT
/begin MEASUREMENT PG_Left_ConeRoadEdgeModelC0 "" FLOAT32_IEEE autosar_swc_rlgs_CM_single 0 0 -3.4E+38 3.4E+38 MATRIX_DIM 1 1 ECU_ADDRESS 0xfe4afe1c /* @ECU_Address@PG_Left_ConeRoadEdgeModelC0@ */ /end MEASUREMENT
/begin MEASUREMENT PG_Left_ConeRoadEdgeModelC1 "" FLOAT32_IEEE autosar_swc_rlgs_CM_single 0 0 -3.4E+38 3.4E+38 MATRIX_DIM 1 1 ECU_ADDRESS 0xfe4afe20 /* @ECU_Address@PG_Left_ConeRoadEdgeModelC1@ */ /end MEASUREMENT
/begin MEASUREMENT PG_Left_ConeRoadEdgeModelC2 "" FLOAT32_IEEE autosar_swc_rlgs_CM_single 0 0 -3.4E+38 3.4E+38 MATRIX_DIM 1 1 ECU_ADDRESS 0xfe4afe24 /* @ECU_Address@PG_Left_ConeRoadEdgeModelC2@ */ /end MEASUREMENT
/begin MEASUREMENT PG_Left_ConeRoadEdgeModelC3 "" FLOAT32_IEEE autosar_swc_rlgs_CM_single 0 0 -3.4E+38 3.4E+38 MATRIX_DIM 1 1 ECU_ADDRESS 0xfe4afe28 /* @ECU_Address@PG_Left_ConeRoadEdgeModelC3@ */ /end MEASUREMENT
/begin MEASUREMENT PG_Left_ConeRoadEdgeParsingConfidence "" UBYTE autosar_swc_rlgs_CM_uint8 0 0 0 255 MATRIX_DIM 1 1 ECU_ADDRESS 0xfe4b002d /* @ECU_Address@PG_Left_ConeRoadEdgeParsingConfidence@ */ /end MEASUREMENT
/begin MEASUREMENT PG_Left_ConeRoadEdgeQuality "" UBYTE autosar_swc_rlgs_CM_uint8 0 0 0 255 MATRIX_DIM 1 1 ECU_ADDRESS 0xfe4b002e /* @ECU_Address@PG_Left_ConeRoadEdgeQuality@ */ /end MEASUREMENT
/begin MEASUREMENT PG_Left_ConeRoadEdgeTLC "" FLOAT32_IEEE autosar_swc_rlgs_CM_single 0 0 -3.4E+38 3.4E+38 MATRIX_DIM 1 1 ECU_ADDRESS 0xfe4afe2c /* @ECU_Address@PG_Left_ConeRoadEdgeTLC@ */ /end MEASUREMENT
/begin MEASUREMENT PG_Left_ConeRoadEdgeTrackID "" UWORD autosar_swc_rlgs_CM_uint16 0 0 0 65535 MATRIX_DIM 1 1 ECU_ADDRESS 0xfe4afffa /* @ECU_Address@PG_Left_ConeRoadEdgeTrackID@ */ /end MEASUREMENT
/begin MEASUREMENT PG_Left_ConeRoadEdgeTypeClass "" UBYTE autosar_swc_rlgs_CM_uint8 0 0 0 255 MATRIX_DIM 1 1 ECU_ADDRESS 0xfe4b002f /* @ECU_Address@PG_Left_ConeRoadEdgeTypeClass@ */ /end MEASUREMENT
/begin MEASUREMENT PG_Left_ConeRoadEdgeViewRangeEnd "" FLOAT32_IEEE autosar_swc_rlgs_CM_single 0 0 -3.4E+38 3.4E+38 MATRIX_DIM 1 1 ECU_ADDRESS 0xfe4afe30 /* @ECU_Address@PG_Left_ConeRoadEdgeViewRangeEnd@ */ /end MEASUREMENT
/begin MEASUREMENT PG_Left_ConeRoadEdgeViewRangeStart "" FLOAT32_IEEE autosar_swc_rlgs_CM_single 0 0 -3.4E+38 3.4E+38 MATRIX_DIM 1 1 ECU_ADDRESS 0xfe4afe34 /* @ECU_Address@PG_Left_ConeRoadEdgeViewRangeStart@ */ /end MEASUREMENT
/begin MEASUREMENT PG_Left_LaneExtraFarPointPosX "" FLOAT32_IEEE autosar_swc_rlgs_CM_single 0 0 -3.4E+38 3.4E+38 MATRIX_DIM 1 1 ECU_ADDRESS 0xfe4afe38 /* @ECU_Address@PG_Left_LaneExtraFarPointPosX@ */ /end MEASUREMENT
/begin MEASUREMENT PG_Left_LaneExtraFarPointPosY "" FLOAT32_IEEE autosar_swc_rlgs_CM_single 0 0 -3.4E+38 3.4E+38 MATRIX_DIM 1 1 ECU_ADDRESS 0xfe4afe3c /* @ECU_Address@PG_Left_LaneExtraFarPointPosY@ */ /end MEASUREMENT
/begin MEASUREMENT PG_Left_LaneExtraFarPointType "" UBYTE autosar_swc_rlgs_CM_uint8 0 0 0 255 MATRIX_DIM 1 1 ECU_ADDRESS 0xfe4b0030 /* @ECU_Address@PG_Left_LaneExtraFarPointType@ */ /end MEASUREMENT
/begin MEASUREMENT PG_PG_LineNear2RB "" UBYTE autosar_swc_rlgs_CM_uint8 0 0 0 255 ECU_ADDRESS 0xfe4b0031 /* @ECU_Address@PG_PG_LineNear2RB@ */ /end MEASUREMENT
/begin MEASUREMENT PG_PG_SplitOperateState "" UBYTE autosar_swc_rlgs_CM_uint8 0 0 0 255 ECU_ADDRESS 0xfe4b0032 /* @ECU_Address@PG_PG_SplitOperateState@ */ /end MEASUREMENT
/begin MEASUREMENT PG_PG_SplitOperateStateKeep "" UBYTE autosar_swc_rlgs_CM_uint8 0 0 0 255 ECU_ADDRESS 0xfe4b0033 /* @ECU_Address@PG_PG_SplitOperateStateKeep@ */ /end MEASUREMENT
/begin MEASUREMENT PG_PG_diffStdR1RB "" FLOAT32_IEEE autosar_swc_rlgs_CM_single 0 0 -3.4E+38 3.4E+38 ECU_ADDRESS 0xfe4afe40 /* @ECU_Address@PG_PG_diffStdR1RB@ */ /end MEASUREMENT
/begin MEASUREMENT PG_PG_diffStdR2RB "" FLOAT32_IEEE autosar_swc_rlgs_CM_single 0 0 -3.4E+38 3.4E+38 ECU_ADDRESS 0xfe4afe44 /* @ECU_Address@PG_PG_diffStdR2RB@ */ /end MEASUREMENT
/begin MEASUREMENT PG_RMAllowLeftChangeSts "" UBYTE autosar_swc_rlgs_CM_uint8 0 0 0 255 MATRIX_DIM 1 1 ECU_ADDRESS 0xfe4b0034 /* @ECU_Address@PG_RMAllowLeftChangeSts@ */ /end MEASUREMENT
/begin MEASUREMENT PG_RMAllowMoveDirSts "" UBYTE autosar_swc_rlgs_CM_uint8 0 0 0 255 ECU_ADDRESS 0xfe4b0035 /* @ECU_Address@PG_RMAllowMoveDirSts@ */ /end MEASUREMENT
/begin MEASUREMENT PG_RMAllowRightChangeSts "" UBYTE autosar_swc_rlgs_CM_uint8 0 0 0 255 MATRIX_DIM 1 1 ECU_ADDRESS 0xfe4b0036 /* @ECU_Address@PG_RMAllowRightChangeSts@ */ /end MEASUREMENT
/begin MEASUREMENT PG_RiLaneChangeFlag "" UBYTE autosar_swc_rlgs_CM_boolean 0 0 0 1 ECU_ADDRESS 0xfe4b0037 /* @ECU_Address@PG_RiLaneChangeFlag@ */ /end MEASUREMENT
/begin MEASUREMENT PG_RiPathYbranchFlag "" UBYTE autosar_swc_rlgs_CM_boolean 0 0 0 1 ECU_ADDRESS 0xfe4b0038 /* @ECU_Address@PG_RiPathYbranchFlag@ */ /end MEASUREMENT
/begin MEASUREMENT PG_Ri_ConeRoadEdgeConfidence "" UBYTE autosar_swc_rlgs_CM_uint8 0 0 0 255 MATRIX_DIM 1 1 ECU_ADDRESS 0xfe4b0039 /* @ECU_Address@PG_Ri_ConeRoadEdgeConfidence@ */ /end MEASUREMENT
/begin MEASUREMENT PG_Ri_ConeRoadEdgeMeasuringStatus "" UBYTE autosar_swc_rlgs_CM_uint8 0 0 0 255 MATRIX_DIM 1 1 ECU_ADDRESS 0xfe4b003a /* @ECU_Address@PG_Ri_ConeRoadEdgeMeasuringStatus@ */ /end MEASUREMENT
/begin MEASUREMENT PG_Ri_ConeRoadEdgeModelC0 "" FLOAT32_IEEE autosar_swc_rlgs_CM_single 0 0 -3.4E+38 3.4E+38 MATRIX_DIM 1 1 ECU_ADDRESS 0xfe4afe48 /* @ECU_Address@PG_Ri_ConeRoadEdgeModelC0@ */ /end MEASUREMENT
/begin MEASUREMENT PG_Ri_ConeRoadEdgeModelC1 "" FLOAT32_IEEE autosar_swc_rlgs_CM_single 0 0 -3.4E+38 3.4E+38 MATRIX_DIM 1 1 ECU_ADDRESS 0xfe4afe4c /* @ECU_Address@PG_Ri_ConeRoadEdgeModelC1@ */ /end MEASUREMENT
/begin MEASUREMENT PG_Ri_ConeRoadEdgeModelC2 "" FLOAT32_IEEE autosar_swc_rlgs_CM_single 0 0 -3.4E+38 3.4E+38 MATRIX_DIM 1 1 ECU_ADDRESS 0xfe4afe50 /* @ECU_Address@PG_Ri_ConeRoadEdgeModelC2@ */ /end MEASUREMENT
/begin MEASUREMENT PG_Ri_ConeRoadEdgeModelC3 "" FLOAT32_IEEE autosar_swc_rlgs_CM_single 0 0 -3.4E+38 3.4E+38 MATRIX_DIM 1 1 ECU_ADDRESS 0xfe4afe54 /* @ECU_Address@PG_Ri_ConeRoadEdgeModelC3@ */ /end MEASUREMENT
/begin MEASUREMENT PG_Ri_ConeRoadEdgeParsingConfidence "" UBYTE autosar_swc_rlgs_CM_uint8 0 0 0 255 MATRIX_DIM 1 1 ECU_ADDRESS 0xfe4b003b /* @ECU_Address@PG_Ri_ConeRoadEdgeParsingConfidence@ */ /end MEASUREMENT
/begin MEASUREMENT PG_Ri_ConeRoadEdgeQuality "" UBYTE autosar_swc_rlgs_CM_uint8 0 0 0 255 MATRIX_DIM 1 1 ECU_ADDRESS 0xfe4b003c /* @ECU_Address@PG_Ri_ConeRoadEdgeQuality@ */ /end MEASUREMENT
/begin MEASUREMENT PG_Ri_ConeRoadEdgeTLC "" FLOAT32_IEEE autosar_swc_rlgs_CM_single 0 0 -3.4E+38 3.4E+38 MATRIX_DIM 1 1 ECU_ADDRESS 0xfe4afe58 /* @ECU_Address@PG_Ri_ConeRoadEdgeTLC@ */ /end MEASUREMENT
/begin MEASUREMENT PG_Ri_ConeRoadEdgeTrackID "" UWORD autosar_swc_rlgs_CM_uint16 0 0 0 65535 MATRIX_DIM 1 1 ECU_ADDRESS 0xfe4afffc /* @ECU_Address@PG_Ri_ConeRoadEdgeTrackID@ */ /end MEASUREMENT
/begin MEASUREMENT PG_Ri_ConeRoadEdgeTypeClass "" UBYTE autosar_swc_rlgs_CM_uint8 0 0 0 255 MATRIX_DIM 1 1 ECU_ADDRESS 0xfe4b003d /* @ECU_Address@PG_Ri_ConeRoadEdgeTypeClass@ */ /end MEASUREMENT
/begin MEASUREMENT PG_Ri_ConeRoadEdgeViewRangeEnd "" FLOAT32_IEEE autosar_swc_rlgs_CM_single 0 0 -3.4E+38 3.4E+38 MATRIX_DIM 1 1 ECU_ADDRESS 0xfe4afe5c /* @ECU_Address@PG_Ri_ConeRoadEdgeViewRangeEnd@ */ /end MEASUREMENT
/begin MEASUREMENT PG_Ri_ConeRoadEdgeViewRangeStart "" FLOAT32_IEEE autosar_swc_rlgs_CM_single 0 0 -3.4E+38 3.4E+38 MATRIX_DIM 1 1 ECU_ADDRESS 0xfe4afe60 /* @ECU_Address@PG_Ri_ConeRoadEdgeViewRangeStart@ */ /end MEASUREMENT
/begin MEASUREMENT PG_Ri_LaneExtraFarPointPosX "" FLOAT32_IEEE autosar_swc_rlgs_CM_single 0 0 -3.4E+38 3.4E+38 MATRIX_DIM 1 1 ECU_ADDRESS 0xfe4afe64 /* @ECU_Address@PG_Ri_LaneExtraFarPointPosX@ */ /end MEASUREMENT
/begin MEASUREMENT PG_Ri_LaneExtraFarPointPosY "" FLOAT32_IEEE autosar_swc_rlgs_CM_single 0 0 -3.4E+38 3.4E+38 MATRIX_DIM 1 1 ECU_ADDRESS 0xfe4afe68 /* @ECU_Address@PG_Ri_LaneExtraFarPointPosY@ */ /end MEASUREMENT
/begin MEASUREMENT PG_Ri_LaneExtraFarPointType "" UBYTE autosar_swc_rlgs_CM_uint8 0 0 0 255 MATRIX_DIM 1 1 ECU_ADDRESS 0xfe4b003e /* @ECU_Address@PG_Ri_LaneExtraFarPointType@ */ /end MEASUREMENT
/begin MEASUREMENT PG_RightLaneDirection "" UBYTE autosar_swc_rlgs_CM_uint8 0 0 0 255 ECU_ADDRESS 0xfe4b003f /* @ECU_Address@PG_RightLaneDirection@ */ /end MEASUREMENT
/begin MEASUREMENT PG_RightLineC0 "" FLOAT32_IEEE autosar_swc_rlgs_CM_single 0 0 -3.4E+38 3.4E+38 MATRIX_DIM 1 1 ECU_ADDRESS 0xfe4afe6c /* @ECU_Address@PG_RightLineC0@ */ /end MEASUREMENT
/begin MEASUREMENT PG_RightLineSource "" UBYTE autosar_swc_rlgs_CM_uint8 0 0 0 255 ECU_ADDRESS 0xfe4b0040 /* @ECU_Address@PG_RightLineSource@ */ /end MEASUREMENT
/begin MEASUREMENT PG_RightLineValid "" UBYTE autosar_swc_rlgs_CM_boolean 0 0 0 1 MATRIX_DIM 1 1 ECU_ADDRESS 0xfe4b0041 /* @ECU_Address@PG_RightLineValid@ */ /end MEASUREMENT
/begin MEASUREMENT PG_RoadSemanticsSts "" UBYTE autosar_swc_rlgs_CM_uint8 0 0 0 255 ECU_ADDRESS 0xfe4b0042 /* @ECU_Address@PG_RoadSemanticsSts@ */ /end MEASUREMENT
/begin MEASUREMENT PG_RoadWidth "" FLOAT32_IEEE autosar_swc_rlgs_CM_single 0 0 -3.4E+38 3.4E+38 ECU_ADDRESS 0xfe4afe70 /* @ECU_Address@PG_RoadWidth@ */ /end MEASUREMENT
/begin MEASUREMENT PG_RoadWidthL "" FLOAT32_IEEE autosar_swc_rlgs_CM_single 0 0 -3.4E+38 3.4E+38 MATRIX_DIM 1 1 ECU_ADDRESS 0xfe4afe74 /* @ECU_Address@PG_RoadWidthL@ */ /end MEASUREMENT
/begin MEASUREMENT PG_RoadWidthR "" FLOAT32_IEEE autosar_swc_rlgs_CM_single 0 0 -3.4E+38 3.4E+38 MATRIX_DIM 1 1 ECU_ADDRESS 0xfe4afe78 /* @ECU_Address@PG_RoadWidthR@ */ /end MEASUREMENT
/begin MEASUREMENT PG_WaitingLineDist "" FLOAT32_IEEE autosar_swc_rlgs_CM_single 0 0 -3.4E+38 3.4E+38 ECU_ADDRESS 0xfe4afe7c /* @ECU_Address@PG_WaitingLineDist@ */ /end MEASUREMENT
/begin MEASUREMENT RLGS_PG_L1NatureSts "" UBYTE autosar_swc_rlgs_CM_uint8 0 0 0 255 ECU_ADDRESS 0xfe4b0096 /* @ECU_Address@RLGS_PG_L1NatureSts@ */ /end MEASUREMENT
/begin MEASUREMENT RLGS_PG_LaneSplitSts "" UBYTE autosar_swc_rlgs_CM_uint8 0 0 0 255 ECU_ADDRESS 0xfe4b0097 /* @ECU_Address@RLGS_PG_LaneSplitSts@ */ /end MEASUREMENT
/begin MEASUREMENT RLGS_PG_LeLineLcAvailable "" UBYTE autosar_swc_rlgs_CM_uint8 0 0 0 255 ECU_ADDRESS 0xfe4b0098 /* @ECU_Address@RLGS_PG_LeLineLcAvailable@ */ /end MEASUREMENT
/begin MEASUREMENT RLGS_PG_LeftCrossAvai_ByCone "" UBYTE autosar_swc_rlgs_CM_boolean 0 0 0 1 ECU_ADDRESS 0xfe4b0099 /* @ECU_Address@RLGS_PG_LeftCrossAvai_ByCone@ */ /end MEASUREMENT
/begin MEASUREMENT RLGS_PG_R1NatureSts "" UBYTE autosar_swc_rlgs_CM_uint8 0 0 0 255 ECU_ADDRESS 0xfe4b009a /* @ECU_Address@RLGS_PG_R1NatureSts@ */ /end MEASUREMENT
/begin MEASUREMENT RLGS_PG_RiCrossAvai_ByCone "" UBYTE autosar_swc_rlgs_CM_boolean 0 0 0 1 ECU_ADDRESS 0xfe4b009b /* @ECU_Address@RLGS_PG_RiCrossAvai_ByCone@ */ /end MEASUREMENT
/begin MEASUREMENT RLGS_PG_RiLineLcAvailable "" UBYTE autosar_swc_rlgs_CM_uint8 0 0 0 255 ECU_ADDRESS 0xfe4b009c /* @ECU_Address@RLGS_PG_RiLineLcAvailable@ */ /end MEASUREMENT
/begin MEASUREMENT RLGS_Version "" ULONG autosar_swc_rlgs_CM_uint32 0 0 0 4294967295 ECU_ADDRESS 0xfe4afee4 /* @ECU_Address@RLGS_Version@ */ /end MEASUREMENT
/begin MEASUREMENT SwcOut_RLGS_EVM_HMI_Info "" UBYTE autosar_swc_rlgs_CM_uint8 0 0 0 255 ECU_ADDRESS 0xfe4b009d /* @ECU_Address@SwcOut_RLGS_EVM_HMI_Info@ */ /end MEASUREMENT
/begin MEASUREMENT SwcOut_RLGS_EVM_LANE[1].right_constraint.constraint_type "" UBYTE autosar_swc_rlgs_CM_uint8 0 0 0 255 ECU_ADDRESS 0xfe4ae808 /* @ECU_Address@SwcOut_RLGS_EVM_LANE[1].right_constraint.constraint_type@ */ /end MEASUREMENT
/begin MEASUREMENT SwcOut_RLGS_EVM_LANE[1].right_constraint.constraint_type_ahead "" UBYTE autosar_swc_rlgs_CM_uint8 0 0 0 255 ECU_ADDRESS 0xfe4ae809 /* @ECU_Address@SwcOut_RLGS_EVM_LANE[1].right_constraint.constraint_type_ahead@ */ /end MEASUREMENT
/begin MEASUREMENT SwcOut_RLGS_EVM_LANE[1].right_constraint.constraint_type_change_point_dx "" FLOAT32_IEEE autosar_swc_rlgs_CM_single 0 0 -3.4E+38 3.4E+38 ECU_ADDRESS 0xfe4ae80c /* @ECU_Address@SwcOut_RLGS_EVM_LANE[1].right_constraint.constraint_type_change_point_dx@ */ /end MEASUREMENT
/begin MEASUREMENT SwcOut_RLGS_EVM_LANE[1].right_constraint.curve.end "" FLOAT32_IEEE autosar_swc_rlgs_CM_single 0 0 -3.4E+38 3.4E+38 ECU_ADDRESS 0xfe4ae81c /* @ECU_Address@SwcOut_RLGS_EVM_LANE[1].right_constraint.curve.end@ */ /end MEASUREMENT
/begin MEASUREMENT SwcOut_RLGS_EVM_LANE[1].right_constraint.curve.poly_vec "" FLOAT32_IEEE autosar_swc_rlgs_CM_single 0 0 -3.4E+38 3.4E+38 LAYOUT COLUMN_DIR MATRIX_DIM 6 ECU_ADDRESS 0xfe4ae820 /* @ECU_Address@SwcOut_RLGS_EVM_LANE[1].right_constraint.curve.poly_vec@ */ /end MEASUREMENT
/begin MEASUREMENT SwcOut_RLGS_EVM_LANE[1].right_constraint.curve.start "" FLOAT32_IEEE autosar_swc_rlgs_CM_single 0 0 -3.4E+38 3.4E+38 ECU_ADDRESS 0xfe4ae818 /* @ECU_Address@SwcOut_RLGS_EVM_LANE[1].right_constraint.curve.start@ */ /end MEASUREMENT
/begin MEASUREMENT SwcOut_RLGS_EVM_LANE[1].right_constraint.id "" ULONG autosar_swc_rlgs_CM_uint32 0 0 0 4294967295 ECU_ADDRESS 0xfe4ae814 /* @ECU_Address@SwcOut_RLGS_EVM_LANE[1].right_constraint.id@ */ /end MEASUREMENT
/begin MEASUREMENT SwcOut_RLGS_EVM_LANE[1].right_constraint.meas_state "" UBYTE autosar_swc_rlgs_CM_uint8 0 0 0 255 ECU_ADDRESS 0xfe4ae80b /* @ECU_Address@SwcOut_RLGS_EVM_LANE[1].right_constraint.meas_state@ */ /end MEASUREMENT
/begin MEASUREMENT SwcOut_RLGS_EVM_LANE[1].right_constraint.source_type "" UBYTE autosar_swc_rlgs_CM_uint8 0 0 0 255 ECU_ADDRESS 0xfe4ae80a /* @ECU_Address@SwcOut_RLGS_EVM_LANE[1].right_constraint.source_type@ */ /end MEASUREMENT
/begin MEASUREMENT SwcOut_RLGS_EVM_LANE[1].right_constraint.visible_end "" FLOAT32_IEEE autosar_swc_rlgs_CM_single 0 0 -3.4E+38 3.4E+38 ECU_ADDRESS 0xfe4ae810 /* @ECU_Address@SwcOut_RLGS_EVM_LANE[1].right_constraint.visible_end@ */ /end MEASUREMENT
/begin MEASUREMENT SwcOut_RLGS_EVM_LANE[2].arrow_dir "" UBYTE autosar_swc_rlgs_CM_uint8 0 0 0 255 ECU_ADDRESS 0xfe4ae863 /* @ECU_Address@SwcOut_RLGS_EVM_LANE[2].arrow_dir@ */ /end MEASUREMENT
/begin MEASUREMENT SwcOut_RLGS_EVM_LANE[2].center_refline.calc_state "" UBYTE autosar_swc_rlgs_CM_uint8 0 0 0 255 ECU_ADDRESS 0xfe4ae8d1 /* @ECU_Address@SwcOut_RLGS_EVM_LANE[2].center_refline.calc_state@ */ /end MEASUREMENT
/begin MEASUREMENT SwcOut_RLGS_EVM_LANE[2].center_refline.curve.end "" FLOAT32_IEEE autosar_swc_rlgs_CM_single 0 0 -3.4E+38 3.4E+38 ECU_ADDRESS 0xfe4ae8dc /* @ECU_Address@SwcOut_RLGS_EVM_LANE[2].center_refline.curve.end@ */ /end MEASUREMENT
/begin MEASUREMENT SwcOut_RLGS_EVM_LANE[2].center_refline.curve.poly_vec "" FLOAT32_IEEE autosar_swc_rlgs_CM_single 0 0 -3.4E+38 3.4E+38 LAYOUT COLUMN_DIR MATRIX_DIM 6 ECU_ADDRESS 0xfe4ae8e0 /* @ECU_Address@SwcOut_RLGS_EVM_LANE[2].center_refline.curve.poly_vec@ */ /end MEASUREMENT
/begin MEASUREMENT SwcOut_RLGS_EVM_LANE[2].center_refline.curve.start "" FLOAT32_IEEE autosar_swc_rlgs_CM_single 0 0 -3.4E+38 3.4E+38 ECU_ADDRESS 0xfe4ae8d8 /* @ECU_Address@SwcOut_RLGS_EVM_LANE[2].center_refline.curve.start@ */ /end MEASUREMENT
/begin MEASUREMENT SwcOut_RLGS_EVM_LANE[2].center_refline.id "" ULONG autosar_swc_rlgs_CM_uint32 0 0 0 4294967295 ECU_ADDRESS 0xfe4ae8d4 /* @ECU_Address@SwcOut_RLGS_EVM_LANE[2].center_refline.id@ */ /end MEASUREMENT
/begin MEASUREMENT SwcOut_RLGS_EVM_LANE[2].center_refline.ref_source "" UBYTE autosar_swc_rlgs_CM_uint8 0 0 0 255 ECU_ADDRESS 0xfe4ae8d0 /* @ECU_Address@SwcOut_RLGS_EVM_LANE[2].center_refline.ref_source@ */ /end MEASUREMENT
/begin MEASUREMENT SwcOut_RLGS_EVM_LANE[2].current_width "" FLOAT32_IEEE autosar_swc_rlgs_CM_single 0 0 -3.4E+38 3.4E+38 ECU_ADDRESS 0xfe4ae864 /* @ECU_Address@SwcOut_RLGS_EVM_LANE[2].current_width@ */ /end MEASUREMENT
/begin MEASUREMENT SwcOut_RLGS_EVM_LANE[2].end_dist "" FLOAT32_IEEE autosar_swc_rlgs_CM_single 0 0 -3.4E+38 3.4E+38 ECU_ADDRESS 0xfe4ae868 /* @ECU_Address@SwcOut_RLGS_EVM_LANE[2].end_dist@ */ /end MEASUREMENT
/begin MEASUREMENT SwcOut_RLGS_EVM_LANE[2].id "" ULONG autosar_swc_rlgs_CM_uint32 0 0 0 4294967295 ECU_ADDRESS 0xfe4ae86c /* @ECU_Address@SwcOut_RLGS_EVM_LANE[2].id@ */ /end MEASUREMENT
/begin MEASUREMENT SwcOut_RLGS_EVM_LANE[2].lane_extension_type "" UBYTE autosar_swc_rlgs_CM_uint8 0 0 0 255 ECU_ADDRESS 0xfe4ae862 /* @ECU_Address@SwcOut_RLGS_EVM_LANE[2].lane_extension_type@ */ /end MEASUREMENT
/begin MEASUREMENT SwcOut_RLGS_EVM_LANE[2].lane_source "" UBYTE autosar_swc_rlgs_CM_uint8 0 0 0 255 ECU_ADDRESS 0xfe4ae861 /* @ECU_Address@SwcOut_RLGS_EVM_LANE[2].lane_source@ */ /end MEASUREMENT
/begin MEASUREMENT SwcOut_RLGS_EVM_LANE[2].left_constraint.constraint_type "" UBYTE autosar_swc_rlgs_CM_uint8 0 0 0 255 ECU_ADDRESS 0xfe4ae870 /* @ECU_Address@SwcOut_RLGS_EVM_LANE[2].left_constraint.constraint_type@ */ /end MEASUREMENT
/begin MEASUREMENT SwcOut_RLGS_EVM_LANE[2].left_constraint.constraint_type_ahead "" UBYTE autosar_swc_rlgs_CM_uint8 0 0 0 255 ECU_ADDRESS 0xfe4ae871 /* @ECU_Address@SwcOut_RLGS_EVM_LANE[2].left_constraint.constraint_type_ahead@ */ /end MEASUREMENT
/begin MEASUREMENT SwcOut_RLGS_EVM_LANE[2].left_constraint.constraint_type_change_point_dx "" FLOAT32_IEEE autosar_swc_rlgs_CM_single 0 0 -3.4E+38 3.4E+38 ECU_ADDRESS 0xfe4ae874 /* @ECU_Address@SwcOut_RLGS_EVM_LANE[2].left_constraint.constraint_type_change_point_dx@ */ /end MEASUREMENT
/begin MEASUREMENT SwcOut_RLGS_EVM_LANE[2].left_constraint.curve.end "" FLOAT32_IEEE autosar_swc_rlgs_CM_single 0 0 -3.4E+38 3.4E+38 ECU_ADDRESS 0xfe4ae884 /* @ECU_Address@SwcOut_RLGS_EVM_LANE[2].left_constraint.curve.end@ */ /end MEASUREMENT
/begin MEASUREMENT SwcOut_RLGS_EVM_LANE[2].left_constraint.curve.poly_vec "" FLOAT32_IEEE autosar_swc_rlgs_CM_single 0 0 -3.4E+38 3.4E+38 LAYOUT COLUMN_DIR MATRIX_DIM 6 ECU_ADDRESS 0xfe4ae888 /* @ECU_Address@SwcOut_RLGS_EVM_LANE[2].left_constraint.curve.poly_vec@ */ /end MEASUREMENT
/begin MEASUREMENT SwcOut_RLGS_EVM_LANE[2].left_constraint.curve.start "" FLOAT32_IEEE autosar_swc_rlgs_CM_single 0 0 -3.4E+38 3.4E+38 ECU_ADDRESS 0xfe4ae880 /* @ECU_Address@SwcOut_RLGS_EVM_LANE[2].left_constraint.curve.start@ */ /end MEASUREMENT
/begin MEASUREMENT SwcOut_RLGS_EVM_LANE[2].left_constraint.id "" ULONG autosar_swc_rlgs_CM_uint32 0 0 0 4294967295 ECU_ADDRESS 0xfe4ae87c /* @ECU_Address@SwcOut_RLGS_EVM_LANE[2].left_constraint.id@ */ /end MEASUREMENT
/begin MEASUREMENT SwcOut_RLGS_EVM_LANE[2].left_constraint.meas_state "" UBYTE autosar_swc_rlgs_CM_uint8 0 0 0 255 ECU_ADDRESS 0xfe4ae873 /* @ECU_Address@SwcOut_RLGS_EVM_LANE[2].left_constraint.meas_state@ */ /end MEASUREMENT
/begin MEASUREMENT SwcOut_RLGS_EVM_LANE[2].left_constraint.source_type "" UBYTE autosar_swc_rlgs_CM_uint8 0 0 0 255 ECU_ADDRESS 0xfe4ae872 /* @ECU_Address@SwcOut_RLGS_EVM_LANE[2].left_constraint.source_type@ */ /end MEASUREMENT
/begin MEASUREMENT SwcOut_RLGS_EVM_LANE[2].left_constraint.visible_end "" FLOAT32_IEEE autosar_swc_rlgs_CM_single 0 0 -3.4E+38 3.4E+38 ECU_ADDRESS 0xfe4ae878 /* @ECU_Address@SwcOut_RLGS_EVM_LANE[2].left_constraint.visible_end@ */ /end MEASUREMENT
/begin MEASUREMENT SwcOut_RLGS_EVM_LANE[2].right_constraint.constraint_type "" UBYTE autosar_swc_rlgs_CM_uint8 0 0 0 255 ECU_ADDRESS 0xfe4ae8a0 /* @ECU_Address@SwcOut_RLGS_EVM_LANE[2].right_constraint.constraint_type@ */ /end MEASUREMENT
/begin MEASUREMENT SwcOut_RLGS_EVM_LANE[2].right_constraint.constraint_type_ahead "" UBYTE autosar_swc_rlgs_CM_uint8 0 0 0 255 ECU_ADDRESS 0xfe4ae8a1 /* @ECU_Address@SwcOut_RLGS_EVM_LANE[2].right_constraint.constraint_type_ahead@ */ /end MEASUREMENT
/begin MEASUREMENT SwcOut_RLGS_EVM_LANE[2].right_constraint.constraint_type_change_point_dx "" FLOAT32_IEEE autosar_swc_rlgs_CM_single 0 0 -3.4E+38 3.4E+38 ECU_ADDRESS 0xfe4ae8a4 /* @ECU_Address@SwcOut_RLGS_EVM_LANE[2].right_constraint.constraint_type_change_point_dx@ */ /end MEASUREMENT
/begin MEASUREMENT SwcOut_RLGS_EVM_LANE[2].right_constraint.curve.end "" FLOAT32_IEEE autosar_swc_rlgs_CM_single 0 0 -3.4E+38 3.4E+38 ECU_ADDRESS 0xfe4ae8b4 /* @ECU_Address@SwcOut_RLGS_EVM_LANE[2].right_constraint.curve.end@ */ /end MEASUREMENT
/begin MEASUREMENT SwcOut_RLGS_EVM_LANE[2].right_constraint.curve.poly_vec "" FLOAT32_IEEE autosar_swc_rlgs_CM_single 0 0 -3.4E+38 3.4E+38 LAYOUT COLUMN_DIR MATRIX_DIM 6 ECU_ADDRESS 0xfe4ae8b8 /* @ECU_Address@SwcOut_RLGS_EVM_LANE[2].right_constraint.curve.poly_vec@ */ /end MEASUREMENT
/begin MEASUREMENT SwcOut_RLGS_EVM_LANE[2].right_constraint.curve.start "" FLOAT32_IEEE autosar_swc_rlgs_CM_single 0 0 -3.4E+38 3.4E+38 ECU_ADDRESS 0xfe4ae8b0 /* @ECU_Address@SwcOut_RLGS_EVM_LANE[2].right_constraint.curve.start@ */ /end MEASUREMENT
/begin MEASUREMENT SwcOut_RLGS_EVM_LANE[2].right_constraint.id "" ULONG autosar_swc_rlgs_CM_uint32 0 0 0 4294967295 ECU_ADDRESS 0xfe4ae8ac /* @ECU_Address@SwcOut_RLGS_EVM_LANE[2].right_constraint.id@ */ /end MEASUREMENT
/begin MEASUREMENT SwcOut_RLGS_EVM_LANE[2].right_constraint.meas_state "" UBYTE autosar_swc_rlgs_CM_uint8 0 0 0 255 ECU_ADDRESS 0xfe4ae8a3 /* @ECU_Address@SwcOut_RLGS_EVM_LANE[2].right_constraint.meas_state@ */ /end MEASUREMENT
/begin MEASUREMENT SwcOut_RLGS_EVM_LANE[2].right_constraint.source_type "" UBYTE autosar_swc_rlgs_CM_uint8 0 0 0 255 ECU_ADDRESS 0xfe4ae8a2 /* @ECU_Address@SwcOut_RLGS_EVM_LANE[2].right_constraint.source_type@ */ /end MEASUREMENT
/begin MEASUREMENT SwcOut_RLGS_EVM_LANE[2].right_constraint.visible_end "" FLOAT32_IEEE autosar_swc_rlgs_CM_single 0 0 -3.4E+38 3.4E+38 ECU_ADDRESS 0xfe4ae8a8 /* @ECU_Address@SwcOut_RLGS_EVM_LANE[2].right_constraint.visible_end@ */ /end MEASUREMENT
/begin MEASUREMENT SwcOut_RLGS_EVM_LANE[2].type "" UBYTE autosar_swc_rlgs_CM_uint8 0 0 0 255 ECU_ADDRESS 0xfe4ae860 /* @ECU_Address@SwcOut_RLGS_EVM_LANE[2].type@ */ /end MEASUREMENT
/begin MEASUREMENT SwcOut_RLGS_EVM_LANE[3].arrow_dir "" UBYTE autosar_swc_rlgs_CM_uint8 0 0 0 255 ECU_ADDRESS 0xfe4ae8fb /* @ECU_Address@SwcOut_RLGS_EVM_LANE[3].arrow_dir@ */ /end MEASUREMENT
/begin MEASUREMENT SwcOut_RLGS_EVM_LANE[3].center_refline.calc_state "" UBYTE autosar_swc_rlgs_CM_uint8 0 0 0 255 ECU_ADDRESS 0xfe4ae969 /* @ECU_Address@SwcOut_RLGS_EVM_LANE[3].center_refline.calc_state@ */ /end MEASUREMENT
/begin MEASUREMENT SwcOut_RLGS_EVM_LANE[3].center_refline.curve.end "" FLOAT32_IEEE autosar_swc_rlgs_CM_single 0 0 -3.4E+38 3.4E+38 ECU_ADDRESS 0xfe4ae974 /* @ECU_Address@SwcOut_RLGS_EVM_LANE[3].center_refline.curve.end@ */ /end MEASUREMENT
/begin MEASUREMENT SwcOut_RLGS_EVM_LANE[3].center_refline.curve.poly_vec "" FLOAT32_IEEE autosar_swc_rlgs_CM_single 0 0 -3.4E+38 3.4E+38 LAYOUT COLUMN_DIR MATRIX_DIM 6 ECU_ADDRESS 0xfe4ae978 /* @ECU_Address@SwcOut_RLGS_EVM_LANE[3].center_refline.curve.poly_vec@ */ /end MEASUREMENT
/begin MEASUREMENT SwcOut_RLGS_EVM_LANE[3].center_refline.curve.start "" FLOAT32_IEEE autosar_swc_rlgs_CM_single 0 0 -3.4E+38 3.4E+38 ECU_ADDRESS 0xfe4ae970 /* @ECU_Address@SwcOut_RLGS_EVM_LANE[3].center_refline.curve.start@ */ /end MEASUREMENT
/begin MEASUREMENT SwcOut_RLGS_EVM_LANE[3].center_refline.id "" ULONG autosar_swc_rlgs_CM_uint32 0 0 0 4294967295 ECU_ADDRESS 0xfe4ae96c /* @ECU_Address@SwcOut_RLGS_EVM_LANE[3].center_refline.id@ */ /end MEASUREMENT
/begin MEASUREMENT SwcOut_RLGS_EVM_LANE[3].center_refline.ref_source "" UBYTE autosar_swc_rlgs_CM_uint8 0 0 0 255 ECU_ADDRESS 0xfe4ae968 /* @ECU_Address@SwcOut_RLGS_EVM_LANE[3].center_refline.ref_source@ */ /end MEASUREMENT
/begin MEASUREMENT SwcOut_RLGS_EVM_LANE[3].current_width "" FLOAT32_IEEE autosar_swc_rlgs_CM_single 0 0 -3.4E+38 3.4E+38 ECU_ADDRESS 0xfe4ae8fc /* @ECU_Address@SwcOut_RLGS_EVM_LANE[3].current_width@ */ /end MEASUREMENT
/begin MEASUREMENT SwcOut_RLGS_EVM_LANE[3].end_dist "" FLOAT32_IEEE autosar_swc_rlgs_CM_single 0 0 -3.4E+38 3.4E+38 ECU_ADDRESS 0xfe4ae900 /* @ECU_Address@SwcOut_RLGS_EVM_LANE[3].end_dist@ */ /end MEASUREMENT
/begin MEASUREMENT SwcOut_RLGS_EVM_LANE[3].id "" ULONG autosar_swc_rlgs_CM_uint32 0 0 0 4294967295 ECU_ADDRESS 0xfe4ae904 /* @ECU_Address@SwcOut_RLGS_EVM_LANE[3].id@ */ /end MEASUREMENT
/begin MEASUREMENT SwcOut_RLGS_EVM_LANE[3].lane_extension_type "" UBYTE autosar_swc_rlgs_CM_uint8 0 0 0 255 ECU_ADDRESS 0xfe4ae8fa /* @ECU_Address@SwcOut_RLGS_EVM_LANE[3].lane_extension_type@ */ /end MEASUREMENT
/begin MEASUREMENT SwcOut_RLGS_EVM_LANE[3].lane_source "" UBYTE autosar_swc_rlgs_CM_uint8 0 0 0 255 ECU_ADDRESS 0xfe4ae8f9 /* @ECU_Address@SwcOut_RLGS_EVM_LANE[3].lane_source@ */ /end MEASUREMENT
/begin MEASUREMENT SwcOut_RLGS_EVM_LANE[3].left_constraint.constraint_type "" UBYTE autosar_swc_rlgs_CM_uint8 0 0 0 255 ECU_ADDRESS 0xfe4ae908 /* @ECU_Address@SwcOut_RLGS_EVM_LANE[3].left_constraint.constraint_type@ */ /end MEASUREMENT
/begin MEASUREMENT SwcOut_RLGS_EVM_LANE[3].left_constraint.constraint_type_ahead "" UBYTE autosar_swc_rlgs_CM_uint8 0 0 0 255 ECU_ADDRESS 0xfe4ae909 /* @ECU_Address@SwcOut_RLGS_EVM_LANE[3].left_constraint.constraint_type_ahead@ */ /end MEASUREMENT
/begin MEASUREMENT SwcOut_RLGS_EVM_LANE[3].left_constraint.constraint_type_change_point_dx "" FLOAT32_IEEE autosar_swc_rlgs_CM_single 0 0 -3.4E+38 3.4E+38 ECU_ADDRESS 0xfe4ae90c /* @ECU_Address@SwcOut_RLGS_EVM_LANE[3].left_constraint.constraint_type_change_point_dx@ */ /end MEASUREMENT
/begin MEASUREMENT SwcOut_RLGS_EVM_LANE[3].left_constraint.curve.end "" FLOAT32_IEEE autosar_swc_rlgs_CM_single 0 0 -3.4E+38 3.4E+38 ECU_ADDRESS 0xfe4ae91c /* @ECU_Address@SwcOut_RLGS_EVM_LANE[3].left_constraint.curve.end@ */ /end MEASUREMENT
/begin MEASUREMENT SwcOut_RLGS_EVM_LANE[3].left_constraint.curve.poly_vec "" FLOAT32_IEEE autosar_swc_rlgs_CM_single 0 0 -3.4E+38 3.4E+38 LAYOUT COLUMN_DIR MATRIX_DIM 6 ECU_ADDRESS 0xfe4ae920 /* @ECU_Address@SwcOut_RLGS_EVM_LANE[3].left_constraint.curve.poly_vec@ */ /end MEASUREMENT
/begin MEASUREMENT SwcOut_RLGS_EVM_LANE[3].left_constraint.curve.start "" FLOAT32_IEEE autosar_swc_rlgs_CM_single 0 0 -3.4E+38 3.4E+38 ECU_ADDRESS 0xfe4ae918 /* @ECU_Address@SwcOut_RLGS_EVM_LANE[3].left_constraint.curve.start@ */ /end MEASUREMENT
/begin MEASUREMENT SwcOut_RLGS_EVM_LANE[3].left_constraint.id "" ULONG autosar_swc_rlgs_CM_uint32 0 0 0 4294967295 ECU_ADDRESS 0xfe4ae914 /* @ECU_Address@SwcOut_RLGS_EVM_LANE[3].left_constraint.id@ */ /end MEASUREMENT
/begin MEASUREMENT SwcOut_RLGS_EVM_LANE[3].left_constraint.meas_state "" UBYTE autosar_swc_rlgs_CM_uint8 0 0 0 255 ECU_ADDRESS 0xfe4ae90b /* @ECU_Address@SwcOut_RLGS_EVM_LANE[3].left_constraint.meas_state@ */ /end MEASUREMENT
/begin MEASUREMENT SwcOut_RLGS_EVM_LANE[3].left_constraint.source_type "" UBYTE autosar_swc_rlgs_CM_uint8 0 0 0 255 ECU_ADDRESS 0xfe4ae90a /* @ECU_Address@SwcOut_RLGS_EVM_LANE[3].left_constraint.source_type@ */ /end MEASUREMENT
/begin MEASUREMENT SwcOut_RLGS_EVM_LANE[3].left_constraint.visible_end "" FLOAT32_IEEE autosar_swc_rlgs_CM_single 0 0 -3.4E+38 3.4E+38 ECU_ADDRESS 0xfe4ae910 /* @ECU_Address@SwcOut_RLGS_EVM_LANE[3].left_constraint.visible_end@ */ /end MEASUREMENT
/begin MEASUREMENT SwcOut_RLGS_EVM_LANE[3].right_constraint.constraint_type "" UBYTE autosar_swc_rlgs_CM_uint8 0 0 0 255 ECU_ADDRESS 0xfe4ae938 /* @ECU_Address@SwcOut_RLGS_EVM_LANE[3].right_constraint.constraint_type@ */ /end MEASUREMENT
/begin MEASUREMENT SwcOut_RLGS_EVM_LANE[3].right_constraint.constraint_type_ahead "" UBYTE autosar_swc_rlgs_CM_uint8 0 0 0 255 ECU_ADDRESS 0xfe4ae939 /* @ECU_Address@SwcOut_RLGS_EVM_LANE[3].right_constraint.constraint_type_ahead@ */ /end MEASUREMENT
/begin MEASUREMENT SwcOut_RLGS_EVM_LANE[3].right_constraint.constraint_type_change_point_dx "" FLOAT32_IEEE autosar_swc_rlgs_CM_single 0 0 -3.4E+38 3.4E+38 ECU_ADDRESS 0xfe4ae93c /* @ECU_Address@SwcOut_RLGS_EVM_LANE[3].right_constraint.constraint_type_change_point_dx@ */ /end MEASUREMENT
/begin MEASUREMENT SwcOut_RLGS_EVM_LANE[3].right_constraint.curve.end "" FLOAT32_IEEE autosar_swc_rlgs_CM_single 0 0 -3.4E+38 3.4E+38 ECU_ADDRESS 0xfe4ae94c /* @ECU_Address@SwcOut_RLGS_EVM_LANE[3].right_constraint.curve.end@ */ /end MEASUREMENT
/begin MEASUREMENT SwcOut_RLGS_EVM_LANE[3].right_constraint.curve.poly_vec "" FLOAT32_IEEE autosar_swc_rlgs_CM_single 0 0 -3.4E+38 3.4E+38 LAYOUT COLUMN_DIR MATRIX_DIM 6 ECU_ADDRESS 0xfe4ae950 /* @ECU_Address@SwcOut_RLGS_EVM_LANE[3].right_constraint.curve.poly_vec@ */ /end MEASUREMENT
/begin MEASUREMENT SwcOut_RLGS_EVM_LANE[3].right_constraint.curve.start "" FLOAT32_IEEE autosar_swc_rlgs_CM_single 0 0 -3.4E+38 3.4E+38 ECU_ADDRESS 0xfe4ae948 /* @ECU_Address@SwcOut_RLGS_EVM_LANE[3].right_constraint.curve.start@ */ /end MEASUREMENT
/begin MEASUREMENT SwcOut_RLGS_EVM_LANE[3].right_constraint.id "" ULONG autosar_swc_rlgs_CM_uint32 0 0 0 4294967295 ECU_ADDRESS 0xfe4ae944 /* @ECU_Address@SwcOut_RLGS_EVM_LANE[3].right_constraint.id@ */ /end MEASUREMENT
/begin MEASUREMENT SwcOut_RLGS_EVM_LANE[3].right_constraint.meas_state "" UBYTE autosar_swc_rlgs_CM_uint8 0 0 0 255 ECU_ADDRESS 0xfe4ae93b /* @ECU_Address@SwcOut_RLGS_EVM_LANE[3].right_constraint.meas_state@ */ /end MEASUREMENT
/begin MEASUREMENT SwcOut_RLGS_EVM_LANE[3].right_constraint.source_type "" UBYTE autosar_swc_rlgs_CM_uint8 0 0 0 255 ECU_ADDRESS 0xfe4ae93a /* @ECU_Address@SwcOut_RLGS_EVM_LANE[3].right_constraint.source_type@ */ /end MEASUREMENT
/begin MEASUREMENT SwcOut_RLGS_EVM_LANE[3].right_constraint.visible_end "" FLOAT32_IEEE autosar_swc_rlgs_CM_single 0 0 -3.4E+38 3.4E+38 ECU_ADDRESS 0xfe4ae940 /* @ECU_Address@SwcOut_RLGS_EVM_LANE[3].right_constraint.visible_end@ */ /end MEASUREMENT
/begin MEASUREMENT SwcOut_RLGS_EVM_LANE[3].type "" UBYTE autosar_swc_rlgs_CM_uint8 0 0 0 255 ECU_ADDRESS 0xfe4ae8f8 /* @ECU_Address@SwcOut_RLGS_EVM_LANE[3].type@ */ /end MEASUREMENT
/begin MEASUREMENT SwcOut_RLGS_EVM_LANE[4].arrow_dir "" UBYTE autosar_swc_rlgs_CM_uint8 0 0 0 255 ECU_ADDRESS 0xfe4ae993 /* @ECU_Address@SwcOut_RLGS_EVM_LANE[4].arrow_dir@ */ /end MEASUREMENT
/begin MEASUREMENT SwcOut_RLGS_EVM_LANE[4].center_refline.calc_state "" UBYTE autosar_swc_rlgs_CM_uint8 0 0 0 255 ECU_ADDRESS 0xfe4aea01 /* @ECU_Address@SwcOut_RLGS_EVM_LANE[4].center_refline.calc_state@ */ /end MEASUREMENT
/begin MEASUREMENT SwcOut_RLGS_EVM_LANE[4].center_refline.curve.end "" FLOAT32_IEEE autosar_swc_rlgs_CM_single 0 0 -3.4E+38 3.4E+38 ECU_ADDRESS 0xfe4aea0c /* @ECU_Address@SwcOut_RLGS_EVM_LANE[4].center_refline.curve.end@ */ /end MEASUREMENT
/begin MEASUREMENT SwcOut_RLGS_EVM_LANE[4].center_refline.curve.poly_vec "" FLOAT32_IEEE autosar_swc_rlgs_CM_single 0 0 -3.4E+38 3.4E+38 LAYOUT COLUMN_DIR MATRIX_DIM 6 ECU_ADDRESS 0xfe4aea10 /* @ECU_Address@SwcOut_RLGS_EVM_LANE[4].center_refline.curve.poly_vec@ */ /end MEASUREMENT
/begin MEASUREMENT SwcOut_RLGS_EVM_LANE[4].center_refline.curve.start "" FLOAT32_IEEE autosar_swc_rlgs_CM_single 0 0 -3.4E+38 3.4E+38 ECU_ADDRESS 0xfe4aea08 /* @ECU_Address@SwcOut_RLGS_EVM_LANE[4].center_refline.curve.start@ */ /end MEASUREMENT
/begin MEASUREMENT SwcOut_RLGS_EVM_LANE[4].center_refline.id "" ULONG autosar_swc_rlgs_CM_uint32 0 0 0 4294967295 ECU_ADDRESS 0xfe4aea04 /* @ECU_Address@SwcOut_RLGS_EVM_LANE[4].center_refline.id@ */ /end MEASUREMENT
/begin MEASUREMENT SwcOut_RLGS_EVM_LANE[4].center_refline.ref_source "" UBYTE autosar_swc_rlgs_CM_uint8 0 0 0 255 ECU_ADDRESS 0xfe4aea00 /* @ECU_Address@SwcOut_RLGS_EVM_LANE[4].center_refline.ref_source@ */ /end MEASUREMENT
/begin MEASUREMENT SwcOut_RLGS_EVM_LANE[4].current_width "" FLOAT32_IEEE autosar_swc_rlgs_CM_single 0 0 -3.4E+38 3.4E+38 ECU_ADDRESS 0xfe4ae994 /* @ECU_Address@SwcOut_RLGS_EVM_LANE[4].current_width@ */ /end MEASUREMENT
/begin MEASUREMENT SwcOut_RLGS_EVM_LANE[4].end_dist "" FLOAT32_IEEE autosar_swc_rlgs_CM_single 0 0 -3.4E+38 3.4E+38 ECU_ADDRESS 0xfe4ae998 /* @ECU_Address@SwcOut_RLGS_EVM_LANE[4].end_dist@ */ /end MEASUREMENT
/begin MEASUREMENT SwcOut_RLGS_EVM_LANE[4].id "" ULONG autosar_swc_rlgs_CM_uint32 0 0 0 4294967295 ECU_ADDRESS 0xfe4ae99c /* @ECU_Address@SwcOut_RLGS_EVM_LANE[4].id@ */ /end MEASUREMENT
/begin MEASUREMENT SwcOut_RLGS_EVM_LANE[4].lane_extension_type "" UBYTE autosar_swc_rlgs_CM_uint8 0 0 0 255 ECU_ADDRESS 0xfe4ae992 /* @ECU_Address@SwcOut_RLGS_EVM_LANE[4].lane_extension_type@ */ /end MEASUREMENT
/begin MEASUREMENT SwcOut_RLGS_EVM_LANE[4].lane_source "" UBYTE autosar_swc_rlgs_CM_uint8 0 0 0 255 ECU_ADDRESS 0xfe4ae991 /* @ECU_Address@SwcOut_RLGS_EVM_LANE[4].lane_source@ */ /end MEASUREMENT
/begin MEASUREMENT SwcOut_RLGS_EVM_LANE[4].left_constraint.constraint_type "" UBYTE autosar_swc_rlgs_CM_uint8 0 0 0 255 ECU_ADDRESS 0xfe4ae9a0 /* @ECU_Address@SwcOut_RLGS_EVM_LANE[4].left_constraint.constraint_type@ */ /end MEASUREMENT
/begin MEASUREMENT SwcOut_RLGS_EVM_LANE[4].left_constraint.constraint_type_ahead "" UBYTE autosar_swc_rlgs_CM_uint8 0 0 0 255 ECU_ADDRESS 0xfe4ae9a1 /* @ECU_Address@SwcOut_RLGS_EVM_LANE[4].left_constraint.constraint_type_ahead@ */ /end MEASUREMENT
/begin MEASUREMENT SwcOut_RLGS_EVM_LANE[4].left_constraint.constraint_type_change_point_dx "" FLOAT32_IEEE autosar_swc_rlgs_CM_single 0 0 -3.4E+38 3.4E+38 ECU_ADDRESS 0xfe4ae9a4 /* @ECU_Address@SwcOut_RLGS_EVM_LANE[4].left_constraint.constraint_type_change_point_dx@ */ /end MEASUREMENT
/begin MEASUREMENT SwcOut_RLGS_EVM_LANE[4].left_constraint.curve.end "" FLOAT32_IEEE autosar_swc_rlgs_CM_single 0 0 -3.4E+38 3.4E+38 ECU_ADDRESS 0xfe4ae9b4 /* @ECU_Address@SwcOut_RLGS_EVM_LANE[4].left_constraint.curve.end@ */ /end MEASUREMENT
/begin MEASUREMENT SwcOut_RLGS_EVM_LANE[4].left_constraint.curve.poly_vec "" FLOAT32_IEEE autosar_swc_rlgs_CM_single 0 0 -3.4E+38 3.4E+38 LAYOUT COLUMN_DIR MATRIX_DIM 6 ECU_ADDRESS 0xfe4ae9b8 /* @ECU_Address@SwcOut_RLGS_EVM_LANE[4].left_constraint.curve.poly_vec@ */ /end MEASUREMENT
/begin MEASUREMENT SwcOut_RLGS_EVM_LANE[4].left_constraint.curve.start "" FLOAT32_IEEE autosar_swc_rlgs_CM_single 0 0 -3.4E+38 3.4E+38 ECU_ADDRESS 0xfe4ae9b0 /* @ECU_Address@SwcOut_RLGS_EVM_LANE[4].left_constraint.curve.start@ */ /end MEASUREMENT
/begin MEASUREMENT SwcOut_RLGS_EVM_LANE[4].left_constraint.id "" ULONG autosar_swc_rlgs_CM_uint32 0 0 0 4294967295 ECU_ADDRESS 0xfe4ae9ac /* @ECU_Address@SwcOut_RLGS_EVM_LANE[4].left_constraint.id@ */ /end MEASUREMENT
/begin MEASUREMENT SwcOut_RLGS_EVM_LANE[4].left_constraint.meas_state "" UBYTE autosar_swc_rlgs_CM_uint8 0 0 0 255 ECU_ADDRESS 0xfe4ae9a3 /* @ECU_Address@SwcOut_RLGS_EVM_LANE[4].left_constraint.meas_state@ */ /end MEASUREMENT
/begin MEASUREMENT SwcOut_RLGS_EVM_LANE[4].left_constraint.source_type "" UBYTE autosar_swc_rlgs_CM_uint8 0 0 0 255 ECU_ADDRESS 0xfe4ae9a2 /* @ECU_Address@SwcOut_RLGS_EVM_LANE[4].left_constraint.source_type@ */ /end MEASUREMENT
/begin MEASUREMENT SwcOut_RLGS_EVM_LANE[4].left_constraint.visible_end "" FLOAT32_IEEE autosar_swc_rlgs_CM_single 0 0 -3.4E+38 3.4E+38 ECU_ADDRESS 0xfe4ae9a8 /* @ECU_Address@SwcOut_RLGS_EVM_LANE[4].left_constraint.visible_end@ */ /end MEASUREMENT
/begin MEASUREMENT SwcOut_RLGS_EVM_LANE[4].right_constraint.constraint_type "" UBYTE autosar_swc_rlgs_CM_uint8 0 0 0 255 ECU_ADDRESS 0xfe4ae9d0 /* @ECU_Address@SwcOut_RLGS_EVM_LANE[4].right_constraint.constraint_type@ */ /end MEASUREMENT
/begin MEASUREMENT SwcOut_RLGS_EVM_LANE[4].right_constraint.constraint_type_ahead "" UBYTE autosar_swc_rlgs_CM_uint8 0 0 0 255 ECU_ADDRESS 0xfe4ae9d1 /* @ECU_Address@SwcOut_RLGS_EVM_LANE[4].right_constraint.constraint_type_ahead@ */ /end MEASUREMENT
/begin MEASUREMENT SwcOut_RLGS_EVM_LANE[4].right_constraint.constraint_type_change_point_dx "" FLOAT32_IEEE autosar_swc_rlgs_CM_single 0 0 -3.4E+38 3.4E+38 ECU_ADDRESS 0xfe4ae9d4 /* @ECU_Address@SwcOut_RLGS_EVM_LANE[4].right_constraint.constraint_type_change_point_dx@ */ /end MEASUREMENT
/begin MEASUREMENT SwcOut_RLGS_EVM_LANE[4].right_constraint.curve.end "" FLOAT32_IEEE autosar_swc_rlgs_CM_single 0 0 -3.4E+38 3.4E+38 ECU_ADDRESS 0xfe4ae9e4 /* @ECU_Address@SwcOut_RLGS_EVM_LANE[4].right_constraint.curve.end@ */ /end MEASUREMENT
/begin MEASUREMENT SwcOut_RLGS_EVM_LANE[4].right_constraint.curve.poly_vec "" FLOAT32_IEEE autosar_swc_rlgs_CM_single 0 0 -3.4E+38 3.4E+38 LAYOUT COLUMN_DIR MATRIX_DIM 6 ECU_ADDRESS 0xfe4ae9e8 /* @ECU_Address@SwcOut_RLGS_EVM_LANE[4].right_constraint.curve.poly_vec@ */ /end MEASUREMENT
/begin MEASUREMENT SwcOut_RLGS_EVM_LANE[4].right_constraint.curve.start "" FLOAT32_IEEE autosar_swc_rlgs_CM_single 0 0 -3.4E+38 3.4E+38 ECU_ADDRESS 0xfe4ae9e0 /* @ECU_Address@SwcOut_RLGS_EVM_LANE[4].right_constraint.curve.start@ */ /end MEASUREMENT
/begin MEASUREMENT SwcOut_RLGS_EVM_LANE[4].right_constraint.id "" ULONG autosar_swc_rlgs_CM_uint32 0 0 0 4294967295 ECU_ADDRESS 0xfe4ae9dc /* @ECU_Address@SwcOut_RLGS_EVM_LANE[4].right_constraint.id@ */ /end MEASUREMENT
/begin MEASUREMENT SwcOut_RLGS_EVM_LANE[4].right_constraint.meas_state "" UBYTE autosar_swc_rlgs_CM_uint8 0 0 0 255 ECU_ADDRESS 0xfe4ae9d3 /* @ECU_Address@SwcOut_RLGS_EVM_LANE[4].right_constraint.meas_state@ */ /end MEASUREMENT
/begin MEASUREMENT SwcOut_RLGS_EVM_LANE[4].right_constraint.source_type "" UBYTE autosar_swc_rlgs_CM_uint8 0 0 0 255 ECU_ADDRESS 0xfe4ae9d2 /* @ECU_Address@SwcOut_RLGS_EVM_LANE[4].right_constraint.source_type@ */ /end MEASUREMENT
/begin MEASUREMENT SwcOut_RLGS_EVM_LANE[4].right_constraint.visible_end "" FLOAT32_IEEE autosar_swc_rlgs_CM_single 0 0 -3.4E+38 3.4E+38 ECU_ADDRESS 0xfe4ae9d8 /* @ECU_Address@SwcOut_RLGS_EVM_LANE[4].right_constraint.visible_end@ */ /end MEASUREMENT
/begin MEASUREMENT SwcOut_RLGS_EVM_LANE[4].type "" UBYTE autosar_swc_rlgs_CM_uint8 0 0 0 255 ECU_ADDRESS 0xfe4ae990 /* @ECU_Address@SwcOut_RLGS_EVM_LANE[4].type@ */ /end MEASUREMENT
/begin MEASUREMENT SwcOut_RLGS_EVM_LANE[5].arrow_dir "" UBYTE autosar_swc_rlgs_CM_uint8 0 0 0 255 ECU_ADDRESS 0xfe4aea2b /* @ECU_Address@SwcOut_RLGS_EVM_LANE[5].arrow_dir@ */ /end MEASUREMENT
/begin MEASUREMENT SwcOut_RLGS_EVM_LANE[5].center_refline.calc_state "" UBYTE autosar_swc_rlgs_CM_uint8 0 0 0 255 ECU_ADDRESS 0xfe4aea99 /* @ECU_Address@SwcOut_RLGS_EVM_LANE[5].center_refline.calc_state@ */ /end MEASUREMENT
/begin MEASUREMENT SwcOut_RLGS_EVM_LANE[5].center_refline.curve.end "" FLOAT32_IEEE autosar_swc_rlgs_CM_single 0 0 -3.4E+38 3.4E+38 ECU_ADDRESS 0xfe4aeaa4 /* @ECU_Address@SwcOut_RLGS_EVM_LANE[5].center_refline.curve.end@ */ /end MEASUREMENT
/begin MEASUREMENT SwcOut_RLGS_EVM_LANE[5].center_refline.curve.poly_vec "" FLOAT32_IEEE autosar_swc_rlgs_CM_single 0 0 -3.4E+38 3.4E+38 LAYOUT COLUMN_DIR MATRIX_DIM 6 ECU_ADDRESS 0xfe4aeaa8 /* @ECU_Address@SwcOut_RLGS_EVM_LANE[5].center_refline.curve.poly_vec@ */ /end MEASUREMENT
/begin MEASUREMENT SwcOut_RLGS_EVM_LANE[5].center_refline.curve.start "" FLOAT32_IEEE autosar_swc_rlgs_CM_single 0 0 -3.4E+38 3.4E+38 ECU_ADDRESS 0xfe4aeaa0 /* @ECU_Address@SwcOut_RLGS_EVM_LANE[5].center_refline.curve.start@ */ /end MEASUREMENT
/begin MEASUREMENT SwcOut_RLGS_EVM_LANE[5].center_refline.id "" ULONG autosar_swc_rlgs_CM_uint32 0 0 0 4294967295 ECU_ADDRESS 0xfe4aea9c /* @ECU_Address@SwcOut_RLGS_EVM_LANE[5].center_refline.id@ */ /end MEASUREMENT
/begin MEASUREMENT SwcOut_RLGS_EVM_LANE[5].center_refline.ref_source "" UBYTE autosar_swc_rlgs_CM_uint8 0 0 0 255 ECU_ADDRESS 0xfe4aea98 /* @ECU_Address@SwcOut_RLGS_EVM_LANE[5].center_refline.ref_source@ */ /end MEASUREMENT
/begin MEASUREMENT SwcOut_RLGS_EVM_LANE[5].current_width "" FLOAT32_IEEE autosar_swc_rlgs_CM_single 0 0 -3.4E+38 3.4E+38 ECU_ADDRESS 0xfe4aea2c /* @ECU_Address@SwcOut_RLGS_EVM_LANE[5].current_width@ */ /end MEASUREMENT
/begin MEASUREMENT SwcOut_RLGS_EVM_LANE[5].end_dist "" FLOAT32_IEEE autosar_swc_rlgs_CM_single 0 0 -3.4E+38 3.4E+38 ECU_ADDRESS 0xfe4aea30 /* @ECU_Address@SwcOut_RLGS_EVM_LANE[5].end_dist@ */ /end MEASUREMENT
/begin MEASUREMENT SwcOut_RLGS_EVM_LANE[5].id "" ULONG autosar_swc_rlgs_CM_uint32 0 0 0 4294967295 ECU_ADDRESS 0xfe4aea34 /* @ECU_Address@SwcOut_RLGS_EVM_LANE[5].id@ */ /end MEASUREMENT
/begin MEASUREMENT SwcOut_RLGS_EVM_LANE[5].lane_extension_type "" UBYTE autosar_swc_rlgs_CM_uint8 0 0 0 255 ECU_ADDRESS 0xfe4aea2a /* @ECU_Address@SwcOut_RLGS_EVM_LANE[5].lane_extension_type@ */ /end MEASUREMENT
/begin MEASUREMENT SwcOut_RLGS_EVM_LANE[5].lane_source "" UBYTE autosar_swc_rlgs_CM_uint8 0 0 0 255 ECU_ADDRESS 0xfe4aea29 /* @ECU_Address@SwcOut_RLGS_EVM_LANE[5].lane_source@ */ /end MEASUREMENT
/begin MEASUREMENT SwcOut_RLGS_EVM_LANE[5].left_constraint.constraint_type "" UBYTE autosar_swc_rlgs_CM_uint8 0 0 0 255 ECU_ADDRESS 0xfe4aea38 /* @ECU_Address@SwcOut_RLGS_EVM_LANE[5].left_constraint.constraint_type@ */ /end MEASUREMENT
/begin MEASUREMENT SwcOut_RLGS_EVM_LANE[5].left_constraint.constraint_type_ahead "" UBYTE autosar_swc_rlgs_CM_uint8 0 0 0 255 ECU_ADDRESS 0xfe4aea39 /* @ECU_Address@SwcOut_RLGS_EVM_LANE[5].left_constraint.constraint_type_ahead@ */ /end MEASUREMENT
/begin MEASUREMENT SwcOut_RLGS_EVM_LANE[5].left_constraint.constraint_type_change_point_dx "" FLOAT32_IEEE autosar_swc_rlgs_CM_single 0 0 -3.4E+38 3.4E+38 ECU_ADDRESS 0xfe4aea3c /* @ECU_Address@SwcOut_RLGS_EVM_LANE[5].left_constraint.constraint_type_change_point_dx@ */ /end MEASUREMENT
/begin MEASUREMENT SwcOut_RLGS_EVM_LANE[5].left_constraint.curve.end "" FLOAT32_IEEE autosar_swc_rlgs_CM_single 0 0 -3.4E+38 3.4E+38 ECU_ADDRESS 0xfe4aea4c /* @ECU_Address@SwcOut_RLGS_EVM_LANE[5].left_constraint.curve.end@ */ /end MEASUREMENT
/begin MEASUREMENT SwcOut_RLGS_EVM_LANE[5].left_constraint.curve.poly_vec "" FLOAT32_IEEE autosar_swc_rlgs_CM_single 0 0 -3.4E+38 3.4E+38 LAYOUT COLUMN_DIR MATRIX_DIM 6 ECU_ADDRESS 0xfe4aea50 /* @ECU_Address@SwcOut_RLGS_EVM_LANE[5].left_constraint.curve.poly_vec@ */ /end MEASUREMENT
/begin MEASUREMENT SwcOut_RLGS_EVM_LANE[5].left_constraint.curve.start "" FLOAT32_IEEE autosar_swc_rlgs_CM_single 0 0 -3.4E+38 3.4E+38 ECU_ADDRESS 0xfe4aea48 /* @ECU_Address@SwcOut_RLGS_EVM_LANE[5].left_constraint.curve.start@ */ /end MEASUREMENT
/begin MEASUREMENT SwcOut_RLGS_EVM_LANE[5].left_constraint.id "" ULONG autosar_swc_rlgs_CM_uint32 0 0 0 4294967295 ECU_ADDRESS 0xfe4aea44 /* @ECU_Address@SwcOut_RLGS_EVM_LANE[5].left_constraint.id@ */ /end MEASUREMENT
/begin MEASUREMENT SwcOut_RLGS_EVM_LANE[5].left_constraint.meas_state "" UBYTE autosar_swc_rlgs_CM_uint8 0 0 0 255 ECU_ADDRESS 0xfe4aea3b /* @ECU_Address@SwcOut_RLGS_EVM_LANE[5].left_constraint.meas_state@ */ /end MEASUREMENT
/begin MEASUREMENT SwcOut_RLGS_EVM_LANE[5].left_constraint.source_type "" UBYTE autosar_swc_rlgs_CM_uint8 0 0 0 255 ECU_ADDRESS 0xfe4aea3a /* @ECU_Address@SwcOut_RLGS_EVM_LANE[5].left_constraint.source_type@ */ /end MEASUREMENT
/begin MEASUREMENT SwcOut_RLGS_EVM_LANE[5].left_constraint.visible_end "" FLOAT32_IEEE autosar_swc_rlgs_CM_single 0 0 -3.4E+38 3.4E+38 ECU_ADDRESS 0xfe4aea40 /* @ECU_Address@SwcOut_RLGS_EVM_LANE[5].left_constraint.visible_end@ */ /end MEASUREMENT
/begin MEASUREMENT SwcOut_RLGS_EVM_LANE[5].right_constraint.constraint_type "" UBYTE autosar_swc_rlgs_CM_uint8 0 0 0 255 ECU_ADDRESS 0xfe4aea68 /* @ECU_Address@SwcOut_RLGS_EVM_LANE[5].right_constraint.constraint_type@ */ /end MEASUREMENT
/begin MEASUREMENT SwcOut_RLGS_EVM_LANE[5].right_constraint.constraint_type_ahead "" UBYTE autosar_swc_rlgs_CM_uint8 0 0 0 255 ECU_ADDRESS 0xfe4aea69 /* @ECU_Address@SwcOut_RLGS_EVM_LANE[5].right_constraint.constraint_type_ahead@ */ /end MEASUREMENT
/begin MEASUREMENT SwcOut_RLGS_EVM_LANE[5].right_constraint.constraint_type_change_point_dx "" FLOAT32_IEEE autosar_swc_rlgs_CM_single 0 0 -3.4E+38 3.4E+38 ECU_ADDRESS 0xfe4aea6c /* @ECU_Address@SwcOut_RLGS_EVM_LANE[5].right_constraint.constraint_type_change_point_dx@ */ /end MEASUREMENT
/begin MEASUREMENT SwcOut_RLGS_EVM_LANE[5].right_constraint.curve.end "" FLOAT32_IEEE autosar_swc_rlgs_CM_single 0 0 -3.4E+38 3.4E+38 ECU_ADDRESS 0xfe4aea7c /* @ECU_Address@SwcOut_RLGS_EVM_LANE[5].right_constraint.curve.end@ */ /end MEASUREMENT
/begin MEASUREMENT SwcOut_RLGS_EVM_LANE[5].right_constraint.curve.poly_vec "" FLOAT32_IEEE autosar_swc_rlgs_CM_single 0 0 -3.4E+38 3.4E+38 LAYOUT COLUMN_DIR MATRIX_DIM 6 ECU_ADDRESS 0xfe4aea80 /* @ECU_Address@SwcOut_RLGS_EVM_LANE[5].right_constraint.curve.poly_vec@ */ /end MEASUREMENT
/begin MEASUREMENT SwcOut_RLGS_EVM_LANE[5].right_constraint.curve.start "" FLOAT32_IEEE autosar_swc_rlgs_CM_single 0 0 -3.4E+38 3.4E+38 ECU_ADDRESS 0xfe4aea78 /* @ECU_Address@SwcOut_RLGS_EVM_LANE[5].right_constraint.curve.start@ */ /end MEASUREMENT
/begin MEASUREMENT SwcOut_RLGS_EVM_LANE[5].right_constraint.id "" ULONG autosar_swc_rlgs_CM_uint32 0 0 0 4294967295 ECU_ADDRESS 0xfe4aea74 /* @ECU_Address@SwcOut_RLGS_EVM_LANE[5].right_constraint.id@ */ /end MEASUREMENT
/begin MEASUREMENT SwcOut_RLGS_EVM_LANE[5].right_constraint.meas_state "" UBYTE autosar_swc_rlgs_CM_uint8 0 0 0 255 ECU_ADDRESS 0xfe4aea6b /* @ECU_Address@SwcOut_RLGS_EVM_LANE[5].right_constraint.meas_state@ */ /end MEASUREMENT
/begin MEASUREMENT SwcOut_RLGS_EVM_LANE[5].right_constraint.source_type "" UBYTE autosar_swc_rlgs_CM_uint8 0 0 0 255 ECU_ADDRESS 0xfe4aea6a /* @ECU_Address@SwcOut_RLGS_EVM_LANE[5].right_constraint.source_type@ */ /end MEASUREMENT
/begin MEASUREMENT SwcOut_RLGS_EVM_LANE[5].right_constraint.visible_end "" FLOAT32_IEEE autosar_swc_rlgs_CM_single 0 0 -3.4E+38 3.4E+38 ECU_ADDRESS 0xfe4aea70 /* @ECU_Address@SwcOut_RLGS_EVM_LANE[5].right_constraint.visible_end@ */ /end MEASUREMENT
/begin MEASUREMENT SwcOut_RLGS_EVM_LANE[5].type "" UBYTE autosar_swc_rlgs_CM_uint8 0 0 0 255 ECU_ADDRESS 0xfe4aea28 /* @ECU_Address@SwcOut_RLGS_EVM_LANE[5].type@ */ /end MEASUREMENT
/begin MEASUREMENT SwcOut_RLGS_EVM_PILOT_SCEN.cur_step_id "" ULONG autosar_swc_rlgs_CM_uint32 0 0 0 4294967295 ECU_ADDRESS 0xfe4aeacc /* @ECU_Address@SwcOut_RLGS_EVM_PILOT_SCEN.cur_step_id@ */ /end MEASUREMENT
/begin MEASUREMENT SwcOut_RLGS_EVM_PILOT_SCEN.noa_enter_dist "" FLOAT32_IEEE autosar_swc_rlgs_CM_single 0 0 -3.4E+38 3.4E+38 ECU_ADDRESS 0xfe4aeac8 /* @ECU_Address@SwcOut_RLGS_EVM_PILOT_SCEN.noa_enter_dist@ */ /end MEASUREMENT
/begin MEASUREMENT SwcOut_RLGS_EVM_PILOT_SCEN.noa_enter_dist_valid "" UBYTE autosar_swc_rlgs_CM_boolean 0 0 0 1 ECU_ADDRESS 0xfe4aeac0 /* @ECU_Address@SwcOut_RLGS_EVM_PILOT_SCEN.noa_enter_dist_valid@ */ /end MEASUREMENT
/begin MEASUREMENT SwcOut_RLGS_EVM_PILOT_SCEN.noa_remaining_dist "" FLOAT32_IEEE autosar_swc_rlgs_CM_single 0 0 -3.4E+38 3.4E+38 ECU_ADDRESS 0xfe4aeac4 /* @ECU_Address@SwcOut_RLGS_EVM_PILOT_SCEN.noa_remaining_dist@ */ /end MEASUREMENT
/begin MEASUREMENT SwcOut_RLGS_EVM_PILOT_SCEN.noa_remaining_dist_end_type "" UBYTE autosar_swc_rlgs_CM_uint8 0 0 0 255 ECU_ADDRESS 0xfe4aeac1 /* @ECU_Address@SwcOut_RLGS_EVM_PILOT_SCEN.noa_remaining_dist_end_type@ */ /end MEASUREMENT
/begin MEASUREMENT SwcOut_RLGS_EVM_PILOT_SCEN.scenario_vec[0].behavior_lane "" UBYTE autosar_swc_rlgs_CM_uint8 0 0 0 255 ECU_ADDRESS 0xfe4aead3 /* @ECU_Address@SwcOut_RLGS_EVM_PILOT_SCEN.scenario_vec[0].behavior_lane@ */ /end MEASUREMENT
/begin MEASUREMENT SwcOut_RLGS_EVM_PILOT_SCEN.scenario_vec[0].behavior_road "" UBYTE autosar_swc_rlgs_CM_uint8 0 0 0 255 ECU_ADDRESS 0xfe4aead2 /* @ECU_Address@SwcOut_RLGS_EVM_PILOT_SCEN.scenario_vec[0].behavior_road@ */ /end MEASUREMENT
/begin MEASUREMENT SwcOut_RLGS_EVM_PILOT_SCEN.scenario_vec[0].exec_start_dist "" FLOAT32_IEEE autosar_swc_rlgs_CM_single 0 0 -3.4E+38 3.4E+38 ECU_ADDRESS 0xfe4aead4 /* @ECU_Address@SwcOut_RLGS_EVM_PILOT_SCEN.scenario_vec[0].exec_start_dist@ */ /end MEASUREMENT
/begin MEASUREMENT SwcOut_RLGS_EVM_PILOT_SCEN.scenario_vec[0].main_road_type "" UBYTE autosar_swc_rlgs_CM_uint8 0 0 0 255 ECU_ADDRESS 0xfe4aead0 /* @ECU_Address@SwcOut_RLGS_EVM_PILOT_SCEN.scenario_vec[0].main_road_type@ */ /end MEASUREMENT
/begin MEASUREMENT SwcOut_RLGS_EVM_PILOT_SCEN.scenario_vec[0].sub_road_type "" UBYTE autosar_swc_rlgs_CM_uint8 0 0 0 255 ECU_ADDRESS 0xfe4aead1 /* @ECU_Address@SwcOut_RLGS_EVM_PILOT_SCEN.scenario_vec[0].sub_road_type@ */ /end MEASUREMENT
/begin MEASUREMENT SwcOut_RLGS_EVM_ROAD.left_boundary.constraint_type "" UBYTE autosar_swc_rlgs_CM_uint8 0 0 0 255 ECU_ADDRESS 0xfe4afee8 /* @ECU_Address@SwcOut_RLGS_EVM_ROAD.left_boundary.constraint_type@ */ /end MEASUREMENT
/begin MEASUREMENT SwcOut_RLGS_EVM_ROAD.left_boundary.constraint_type_ahead "" UBYTE autosar_swc_rlgs_CM_uint8 0 0 0 255 ECU_ADDRESS 0xfe4afee9 /* @ECU_Address@SwcOut_RLGS_EVM_ROAD.left_boundary.constraint_type_ahead@ */ /end MEASUREMENT
/begin MEASUREMENT SwcOut_RLGS_EVM_ROAD.left_boundary.constraint_type_change_point_dx "" FLOAT32_IEEE autosar_swc_rlgs_CM_single 0 0 -3.4E+38 3.4E+38 ECU_ADDRESS 0xfe4afeec /* @ECU_Address@SwcOut_RLGS_EVM_ROAD.left_boundary.constraint_type_change_point_dx@ */ /end MEASUREMENT
/begin MEASUREMENT SwcOut_RLGS_EVM_ROAD.left_boundary.curve.end "" FLOAT32_IEEE autosar_swc_rlgs_CM_single 0 0 -3.4E+38 3.4E+38 ECU_ADDRESS 0xfe4afefc /* @ECU_Address@SwcOut_RLGS_EVM_ROAD.left_boundary.curve.end@ */ /end MEASUREMENT
/begin MEASUREMENT SwcOut_RLGS_EVM_ROAD.left_boundary.curve.poly_vec "" FLOAT32_IEEE autosar_swc_rlgs_CM_single 0 0 -3.4E+38 3.4E+38 LAYOUT COLUMN_DIR MATRIX_DIM 6 ECU_ADDRESS 0xfe4aff00 /* @ECU_Address@SwcOut_RLGS_EVM_ROAD.left_boundary.curve.poly_vec@ */ /end MEASUREMENT
/begin MEASUREMENT SwcOut_RLGS_EVM_ROAD.left_boundary.curve.start "" FLOAT32_IEEE autosar_swc_rlgs_CM_single 0 0 -3.4E+38 3.4E+38 ECU_ADDRESS 0xfe4afef8 /* @ECU_Address@SwcOut_RLGS_EVM_ROAD.left_boundary.curve.start@ */ /end MEASUREMENT
/begin MEASUREMENT SwcOut_RLGS_EVM_ROAD.left_boundary.id "" ULONG autosar_swc_rlgs_CM_uint32 0 0 0 4294967295 ECU_ADDRESS 0xfe4afef4 /* @ECU_Address@SwcOut_RLGS_EVM_ROAD.left_boundary.id@ */ /end MEASUREMENT
/begin MEASUREMENT SwcOut_RLGS_EVM_ROAD.left_boundary.meas_state "" UBYTE autosar_swc_rlgs_CM_uint8 0 0 0 255 ECU_ADDRESS 0xfe4afeeb /* @ECU_Address@SwcOut_RLGS_EVM_ROAD.left_boundary.meas_state@ */ /end MEASUREMENT
/begin MEASUREMENT SwcOut_RLGS_EVM_ROAD.left_boundary.source_type "" UBYTE autosar_swc_rlgs_CM_uint8 0 0 0 255 ECU_ADDRESS 0xfe4afeea /* @ECU_Address@SwcOut_RLGS_EVM_ROAD.left_boundary.source_type@ */ /end MEASUREMENT
/begin MEASUREMENT SwcOut_RLGS_EVM_ROAD.left_boundary.visible_end "" FLOAT32_IEEE autosar_swc_rlgs_CM_single 0 0 -3.4E+38 3.4E+38 ECU_ADDRESS 0xfe4afef0 /* @ECU_Address@SwcOut_RLGS_EVM_ROAD.left_boundary.visible_end@ */ /end MEASUREMENT
/begin MEASUREMENT SwcOut_RLGS_EVM_ROAD.right_boundary.constraint_type "" UBYTE autosar_swc_rlgs_CM_uint8 0 0 0 255 ECU_ADDRESS 0xfe4aff18 /* @ECU_Address@SwcOut_RLGS_EVM_ROAD.right_boundary.constraint_type@ */ /end MEASUREMENT
/begin MEASUREMENT SwcOut_RLGS_EVM_ROAD.right_boundary.constraint_type_ahead "" UBYTE autosar_swc_rlgs_CM_uint8 0 0 0 255 ECU_ADDRESS 0xfe4aff19 /* @ECU_Address@SwcOut_RLGS_EVM_ROAD.right_boundary.constraint_type_ahead@ */ /end MEASUREMENT
/begin MEASUREMENT SwcOut_RLGS_EVM_ROAD.right_boundary.constraint_type_change_point_dx "" FLOAT32_IEEE autosar_swc_rlgs_CM_single 0 0 -3.4E+38 3.4E+38 ECU_ADDRESS 0xfe4aff1c /* @ECU_Address@SwcOut_RLGS_EVM_ROAD.right_boundary.constraint_type_change_point_dx@ */ /end MEASUREMENT
/begin MEASUREMENT SwcOut_RLGS_EVM_ROAD.right_boundary.curve.end "" FLOAT32_IEEE autosar_swc_rlgs_CM_single 0 0 -3.4E+38 3.4E+38 ECU_ADDRESS 0xfe4aff2c /* @ECU_Address@SwcOut_RLGS_EVM_ROAD.right_boundary.curve.end@ */ /end MEASUREMENT
/begin MEASUREMENT SwcOut_RLGS_EVM_ROAD.right_boundary.curve.poly_vec "" FLOAT32_IEEE autosar_swc_rlgs_CM_single 0 0 -3.4E+38 3.4E+38 LAYOUT COLUMN_DIR MATRIX_DIM 6 ECU_ADDRESS 0xfe4aff30 /* @ECU_Address@SwcOut_RLGS_EVM_ROAD.right_boundary.curve.poly_vec@ */ /end MEASUREMENT
/begin MEASUREMENT SwcOut_RLGS_EVM_ROAD.right_boundary.curve.start "" FLOAT32_IEEE autosar_swc_rlgs_CM_single 0 0 -3.4E+38 3.4E+38 ECU_ADDRESS 0xfe4aff28 /* @ECU_Address@SwcOut_RLGS_EVM_ROAD.right_boundary.curve.start@ */ /end MEASUREMENT
/begin MEASUREMENT SwcOut_RLGS_EVM_ROAD.right_boundary.id "" ULONG autosar_swc_rlgs_CM_uint32 0 0 0 4294967295 ECU_ADDRESS 0xfe4aff24 /* @ECU_Address@SwcOut_RLGS_EVM_ROAD.right_boundary.id@ */ /end MEASUREMENT
/begin MEASUREMENT SwcOut_RLGS_EVM_ROAD.right_boundary.meas_state "" UBYTE autosar_swc_rlgs_CM_uint8 0 0 0 255 ECU_ADDRESS 0xfe4aff1b /* @ECU_Address@SwcOut_RLGS_EVM_ROAD.right_boundary.meas_state@ */ /end MEASUREMENT
/begin MEASUREMENT SwcOut_RLGS_EVM_ROAD.right_boundary.source_type "" UBYTE autosar_swc_rlgs_CM_uint8 0 0 0 255 ECU_ADDRESS 0xfe4aff1a /* @ECU_Address@SwcOut_RLGS_EVM_ROAD.right_boundary.source_type@ */ /end MEASUREMENT
/begin MEASUREMENT SwcOut_RLGS_EVM_ROAD.right_boundary.visible_end "" FLOAT32_IEEE autosar_swc_rlgs_CM_single 0 0 -3.4E+38 3.4E+38 ECU_ADDRESS 0xfe4aff20 /* @ECU_Address@SwcOut_RLGS_EVM_ROAD.right_boundary.visible_end@ */ /end MEASUREMENT
/begin MEASUREMENT SwcOut_RLGS_EVM_ROAD.road_curve.curve_dis "" FLOAT32_IEEE autosar_swc_rlgs_CM_single 0 0 -3.4E+38 3.4E+38 LAYOUT COLUMN_DIR MATRIX_DIM 20 ECU_ADDRESS 0xfe4aff9c /* @ECU_Address@SwcOut_RLGS_EVM_ROAD.road_curve.curve_dis@ */ /end MEASUREMENT
/begin MEASUREMENT SwcOut_RLGS_EVM_ROAD.road_curve.curve_valid_num "" UBYTE autosar_swc_rlgs_CM_uint8 0 0 0 255 ECU_ADDRESS 0xfe4aff48 /* @ECU_Address@SwcOut_RLGS_EVM_ROAD.road_curve.curve_valid_num@ */ /end MEASUREMENT
/begin MEASUREMENT SwcOut_RLGS_EVM_ROAD.road_curve.curve_value "" FLOAT32_IEEE autosar_swc_rlgs_CM_single 0 0 -3.4E+38 3.4E+38 LAYOUT COLUMN_DIR MATRIX_DIM 20 ECU_ADDRESS 0xfe4aff4c /* @ECU_Address@SwcOut_RLGS_EVM_ROAD.road_curve.curve_value@ */ /end MEASUREMENT
/begin MEASUREMENT SwcOut_RLGS_EVM_TSR_SPL.ElecEye_SPL "" UBYTE autosar_swc_rlgs_CM_uint8 0 0 0 255 ECU_ADDRESS 0xfe4b0004 /* @ECU_Address@SwcOut_RLGS_EVM_TSR_SPL.ElecEye_SPL@ */ /end MEASUREMENT
/begin MEASUREMENT SwcOut_RLGS_EVM_TSR_SPL.ElecEye_SPL_Dis "" UBYTE autosar_swc_rlgs_CM_uint8 0 0 0 255 ECU_ADDRESS 0xfe4b0005 /* @ECU_Address@SwcOut_RLGS_EVM_TSR_SPL.ElecEye_SPL_Dis@ */ /end MEASUREMENT
/begin MEASUREMENT SwcOut_RLGS_EVM_TSR_SPL.Fusion_SPL "" UBYTE autosar_swc_rlgs_CM_uint8 0 0 0 255 ECU_ADDRESS 0xfe4b0003 /* @ECU_Address@SwcOut_RLGS_EVM_TSR_SPL.Fusion_SPL@ */ /end MEASUREMENT
/begin MEASUREMENT SwcOut_RLGS_EVM_TSR_SPL.Map_Ramp_Dis "" UWORD autosar_swc_rlgs_CM_uint16 0 0 0 65535 ECU_ADDRESS 0xfe4b0008 /* @ECU_Address@SwcOut_RLGS_EVM_TSR_SPL.Map_Ramp_Dis@ */ /end MEASUREMENT
/begin MEASUREMENT SwcOut_RLGS_EVM_TSR_SPL.Map_Ramp_SPL "" UWORD autosar_swc_rlgs_CM_uint16 0 0 0 65535 ECU_ADDRESS 0xfe4b0006 /* @ECU_Address@SwcOut_RLGS_EVM_TSR_SPL.Map_Ramp_SPL@ */ /end MEASUREMENT
/begin MEASUREMENT SwcOut_RLGS_EVM_TSR_SPL.Map_SPL "" UBYTE autosar_swc_rlgs_CM_uint8 0 0 0 255 LAYOUT COLUMN_DIR MATRIX_DIM 6 ECU_ADDRESS 0xfe4b000a /* @ECU_Address@SwcOut_RLGS_EVM_TSR_SPL.Map_SPL@ */ /end MEASUREMENT
/begin MEASUREMENT SwcOut_RLGS_EVM_TSR_SPL.Map_SPL_Dis "" UWORD autosar_swc_rlgs_CM_uint16 0 0 0 65535 LAYOUT COLUMN_DIR MATRIX_DIM 6 ECU_ADDRESS 0xfe4b0010 /* @ECU_Address@SwcOut_RLGS_EVM_TSR_SPL.Map_SPL_Dis@ */ /end MEASUREMENT
/begin MEASUREMENT SwcOut_RLGS_EVM_TSR_SPL.NavStatus "" UBYTE autosar_swc_rlgs_CM_uint8 0 0 0 255 ECU_ADDRESS 0xfe4b0002 /* @ECU_Address@SwcOut_RLGS_EVM_TSR_SPL.NavStatus@ */ /end MEASUREMENT
/begin MEASUREMENT SwcOut_RLGS_EVM_TSR_SPL.TSR_Forbidden "" UBYTE autosar_swc_rlgs_CM_uint8 0 0 0 255 ECU_ADDRESS 0xfe4b0000 /* @ECU_Address@SwcOut_RLGS_EVM_TSR_SPL.TSR_Forbidden@ */ /end MEASUREMENT
/begin MEASUREMENT SwcOut_RLGS_EVM_TSR_SPL.TSR_GiveWay "" UBYTE autosar_swc_rlgs_CM_uint8 0 0 0 255 ECU_ADDRESS 0xfe4afffe /* @ECU_Address@SwcOut_RLGS_EVM_TSR_SPL.TSR_GiveWay@ */ /end MEASUREMENT
/begin MEASUREMENT SwcOut_RLGS_EVM_TSR_SPL.TSR_LongTimeDisplay "" UBYTE autosar_swc_rlgs_CM_uint8 0 0 0 255 ECU_ADDRESS 0xfe4affff /* @ECU_Address@SwcOut_RLGS_EVM_TSR_SPL.TSR_LongTimeDisplay@ */ /end MEASUREMENT
/begin MEASUREMENT SwcOut_RLGS_EVM_TSR_SPL.TSR_SPL "" UBYTE autosar_swc_rlgs_CM_uint8 0 0 0 255 ECU_ADDRESS 0xfe4b0001 /* @ECU_Address@SwcOut_RLGS_EVM_TSR_SPL.TSR_SPL@ */ /end MEASUREMENT
/begin MEASUREMENT SwcOut_RLGS_Herbeat_Info.inner_error "" ULONG autosar_swc_rlgs_CM_uint32 0 0 0 4294967295 ECU_ADDRESS 0xfe4afff0 /* @ECU_Address@SwcOut_RLGS_Herbeat_Info.inner_error@ */ /end MEASUREMENT
/begin MEASUREMENT SwcOut_RLGS_Herbeat_Info.module_status "" UBYTE autosar_swc_rlgs_CM_SM_MODULE_STATUS 0 0 0 3 ECU_ADDRESS 0xfe4afff4 /* @ECU_Address@SwcOut_RLGS_Herbeat_Info.module_status@ */ /end MEASUREMENT
/begin MEASUREMENT SwcOut_RLGS_Herbeat_Info.sequence_num "" UBYTE autosar_swc_rlgs_CM_uint8 0 0 0 255 ECU_ADDRESS 0xfe4affed /* @ECU_Address@SwcOut_RLGS_Herbeat_Info.sequence_num@ */ /end MEASUREMENT
/begin MEASUREMENT SwcOut_RLGS_Herbeat_Info.swc_id "" UBYTE autosar_swc_rlgs_CM_uint8 0 0 0 255 ECU_ADDRESS 0xfe4affec /* @ECU_Address@SwcOut_RLGS_Herbeat_Info.swc_id@ */ /end MEASUREMENT
/begin MEASUREMENT autosar_swc_rlgs_rtARID_DEF.AllowMoveDirSts_keepDis "" FLOAT32_IEEE autosar_swc_rlgs_CM_single 0 0 -3.4E+38 3.4E+38 ECU_ADDRESS 0xfe4afb4c /* @ECU_Address@autosar_swc_rlgs_rtARID_DEF.AllowMoveDirSts_keepDis@ */ /end MEASUREMENT
/begin MEASUREMENT autosar_swc_rlgs_rtARID_DEF.AllowMoveDirSts_temp "" UBYTE autosar_swc_rlgs_CM_uint8 0 0 0 255 ECU_ADDRESS 0xfe4afd5d /* @ECU_Address@autosar_swc_rlgs_rtARID_DEF.AllowMoveDirSts_temp@ */ /end MEASUREMENT
/begin MEASUREMENT autosar_swc_rlgs_rtARID_DEF.CentLineC0_k1 "" FLOAT32_IEEE autosar_swc_rlgs_CM_single 0 0 -3.4E+38 3.4E+38 ECU_ADDRESS 0xfe4afb60 /* @ECU_Address@autosar_swc_rlgs_rtARID_DEF.CentLineC0_k1@ */ /end MEASUREMENT
/begin MEASUREMENT autosar_swc_rlgs_rtARID_DEF.CentLineC1_k1 "" FLOAT32_IEEE autosar_swc_rlgs_CM_single 0 0 -3.4E+38 3.4E+38 ECU_ADDRESS 0xfe4afb64 /* @ECU_Address@autosar_swc_rlgs_rtARID_DEF.CentLineC1_k1@ */ /end MEASUREMENT
/begin MEASUREMENT autosar_swc_rlgs_rtARID_DEF.CentLineC2_k2 "" FLOAT32_IEEE autosar_swc_rlgs_CM_single 0 0 -3.4E+38 3.4E+38 ECU_ADDRESS 0xfe4afb68 /* @ECU_Address@autosar_swc_rlgs_rtARID_DEF.CentLineC2_k2@ */ /end MEASUREMENT
/begin MEASUREMENT autosar_swc_rlgs_rtARID_DEF.CentLineC3_k1 "" FLOAT32_IEEE autosar_swc_rlgs_CM_single 0 0 -3.4E+38 3.4E+38 ECU_ADDRESS 0xfe4afb6c /* @ECU_Address@autosar_swc_rlgs_rtARID_DEF.CentLineC3_k1@ */ /end MEASUREMENT
/begin MEASUREMENT autosar_swc_rlgs_rtARID_DEF.CentLineRange_k1 "" FLOAT32_IEEE autosar_swc_rlgs_CM_single 0 0 -3.4E+38 3.4E+38 ECU_ADDRESS 0xfe4afb74 /* @ECU_Address@autosar_swc_rlgs_rtARID_DEF.CentLineRange_k1@ */ /end MEASUREMENT
/begin MEASUREMENT autosar_swc_rlgs_rtARID_DEF.CentLineReliable_k1 "" FLOAT32_IEEE autosar_swc_rlgs_CM_single 0 0 -3.4E+38 3.4E+38 ECU_ADDRESS 0xfe4afb78 /* @ECU_Address@autosar_swc_rlgs_rtARID_DEF.CentLineReliable_k1@ */ /end MEASUREMENT
/begin MEASUREMENT autosar_swc_rlgs_rtARID_DEF.CentLineStart_k1 "" FLOAT32_IEEE autosar_swc_rlgs_CM_single 0 0 -3.4E+38 3.4E+38 ECU_ADDRESS 0xfe4afb70 /* @ECU_Address@autosar_swc_rlgs_rtARID_DEF.CentLineStart_k1@ */ /end MEASUREMENT
/begin MEASUREMENT autosar_swc_rlgs_rtARID_DEF.CentLineValid_k1 "" UBYTE autosar_swc_rlgs_CM_logical 0 0 0 1 ECU_ADDRESS 0xfe4afdcd /* @ECU_Address@autosar_swc_rlgs_rtARID_DEF.CentLineValid_k1@ */ /end MEASUREMENT
/begin MEASUREMENT autosar_swc_rlgs_rtARID_DEF.Class_k1 "" UBYTE autosar_swc_rlgs_CM_uint8 0 0 0 255 ECU_ADDRESS 0xfe4afd6a /* @ECU_Address@autosar_swc_rlgs_rtARID_DEF.Class_k1@ */ /end MEASUREMENT
/begin MEASUREMENT autosar_swc_rlgs_rtARID_DEF.Cnt "" UBYTE autosar_swc_rlgs_CM_uint8 0 0 0 255 ECU_ADDRESS 0xfe4afd68 /* @ECU_Address@autosar_swc_rlgs_rtARID_DEF.Cnt@ */ /end MEASUREMENT
/begin MEASUREMENT autosar_swc_rlgs_rtARID_DEF.Cnt_K1 "" UBYTE autosar_swc_rlgs_CM_uint8 0 0 0 255 ECU_ADDRESS 0xfe4afd74 /* @ECU_Address@autosar_swc_rlgs_rtARID_DEF.Cnt_K1@ */ /end MEASUREMENT
/begin MEASUREMENT autosar_swc_rlgs_rtARID_DEF.ControLine2RB_k1 "" FLOAT32_IEEE autosar_swc_rlgs_CM_single 0 0 -3.4E+38 3.4E+38 ECU_ADDRESS 0xfe4afb8c /* @ECU_Address@autosar_swc_rlgs_rtARID_DEF.ControLine2RB_k1@ */ /end MEASUREMENT
/begin MEASUREMENT autosar_swc_rlgs_rtARID_DEF.ControlLineCalSource_k1 "" UBYTE autosar_swc_rlgs_CM_uint8 0 0 0 255 ECU_ADDRESS 0xfe4afd67 /* @ECU_Address@autosar_swc_rlgs_rtARID_DEF.ControlLineCalSource_k1@ */ /end MEASUREMENT
/begin MEASUREMENT autosar_swc_rlgs_rtARID_DEF.Controline2LB_k1 "" FLOAT32_IEEE autosar_swc_rlgs_CM_single 0 0 -3.4E+38 3.4E+38 ECU_ADDRESS 0xfe4afb88 /* @ECU_Address@autosar_swc_rlgs_rtARID_DEF.Controline2LB_k1@ */ /end MEASUREMENT
/begin MEASUREMENT autosar_swc_rlgs_rtARID_DEF.Controline2LB_k1_not_empty "" UBYTE autosar_swc_rlgs_CM_logical 0 0 0 1 ECU_ADDRESS 0xfe4afdce /* @ECU_Address@autosar_swc_rlgs_rtARID_DEF.Controline2LB_k1_not_empty@ */ /end MEASUREMENT
/begin MEASUREMENT autosar_swc_rlgs_rtARID_DEF.CrossWalkRM_dis "" FLOAT32_IEEE autosar_swc_rlgs_CM_single 0 0 -3.4E+38 3.4E+38 ECU_ADDRESS 0xfe4afb90 /* @ECU_Address@autosar_swc_rlgs_rtARID_DEF.CrossWalkRM_dis@ */ /end MEASUREMENT
/begin MEASUREMENT autosar_swc_rlgs_rtARID_DEF.DieOutFlagEndDis "" FLOAT32_IEEE autosar_swc_rlgs_CM_single 0 0 -3.4E+38 3.4E+38 ECU_ADDRESS 0xfe4afb9c /* @ECU_Address@autosar_swc_rlgs_rtARID_DEF.DieOutFlagEndDis@ */ /end MEASUREMENT
/begin MEASUREMENT autosar_swc_rlgs_rtARID_DEF.DieOutLaneEndDis "" FLOAT32_IEEE autosar_swc_rlgs_CM_single 0 0 -3.4E+38 3.4E+38 ECU_ADDRESS 0xfe4afb2c /* @ECU_Address@autosar_swc_rlgs_rtARID_DEF.DieOutLaneEndDis@ */ /end MEASUREMENT
/begin MEASUREMENT autosar_swc_rlgs_rtARID_DEF.DieOutLaneEndDis_j "" FLOAT32_IEEE autosar_swc_rlgs_CM_single 0 0 -3.4E+38 3.4E+38 ECU_ADDRESS 0xfe4afb48 /* @ECU_Address@autosar_swc_rlgs_rtARID_DEF.DieOutLaneEndDis_j@ */ /end MEASUREMENT
/begin MEASUREMENT autosar_swc_rlgs_rtARID_DEF.DieOutLaneFlag "" UBYTE autosar_swc_rlgs_CM_logical 0 0 0 1 ECU_ADDRESS 0xfe4afdca /* @ECU_Address@autosar_swc_rlgs_rtARID_DEF.DieOutLaneFlag@ */ /end MEASUREMENT
/begin MEASUREMENT autosar_swc_rlgs_rtARID_DEF.DieOutLaneFlag_b "" UBYTE autosar_swc_rlgs_CM_logical 0 0 0 1 ECU_ADDRESS 0xfe4afdcc /* @ECU_Address@autosar_swc_rlgs_rtARID_DEF.DieOutLaneFlag_b@ */ /end MEASUREMENT
/begin MEASUREMENT autosar_swc_rlgs_rtARID_DEF.DieOutLaneFlag_n "" UBYTE autosar_swc_rlgs_CM_logical 0 0 0 1 ECU_ADDRESS 0xfe4afdd0 /* @ECU_Address@autosar_swc_rlgs_rtARID_DEF.DieOutLaneFlag_n@ */ /end MEASUREMENT
/begin MEASUREMENT autosar_swc_rlgs_rtARID_DEF.DisCount_1 "" FLOAT32_IEEE autosar_swc_rlgs_CM_single 0 0 -3.4E+38 3.4E+38 ECU_ADDRESS 0xfe4afb58 /* @ECU_Address@autosar_swc_rlgs_rtARID_DEF.DisCount_1@ */ /end MEASUREMENT
/begin MEASUREMENT autosar_swc_rlgs_rtARID_DEF.DisCount_1_f "" FLOAT32_IEEE autosar_swc_rlgs_CM_single 0 0 -3.4E+38 3.4E+38 ECU_ADDRESS 0xfe4afc1c /* @ECU_Address@autosar_swc_rlgs_rtARID_DEF.DisCount_1_f@ */ /end MEASUREMENT
/begin MEASUREMENT autosar_swc_rlgs_rtARID_DEF.DisCount_2 "" FLOAT32_IEEE autosar_swc_rlgs_CM_single 0 0 -3.4E+38 3.4E+38 ECU_ADDRESS 0xfe4afb5c /* @ECU_Address@autosar_swc_rlgs_rtARID_DEF.DisCount_2@ */ /end MEASUREMENT
/begin MEASUREMENT autosar_swc_rlgs_rtARID_DEF.DisCount_2_c "" FLOAT32_IEEE autosar_swc_rlgs_CM_single 0 0 -3.4E+38 3.4E+38 ECU_ADDRESS 0xfe4afc20 /* @ECU_Address@autosar_swc_rlgs_rtARID_DEF.DisCount_2_c@ */ /end MEASUREMENT
/begin MEASUREMENT autosar_swc_rlgs_rtARID_DEF.Dist_CurPathBranch_k "" FLOAT32_IEEE autosar_swc_rlgs_CM_single 0 0 -3.4E+38 3.4E+38 ECU_ADDRESS 0xfe4afbb0 /* @ECU_Address@autosar_swc_rlgs_rtARID_DEF.Dist_CurPathBranch_k@ */ /end MEASUREMENT
/begin MEASUREMENT autosar_swc_rlgs_rtARID_DEF.Dist_LeftPathBranch_k "" FLOAT32_IEEE autosar_swc_rlgs_CM_single 0 0 -3.4E+38 3.4E+38 ECU_ADDRESS 0xfe4afba8 /* @ECU_Address@autosar_swc_rlgs_rtARID_DEF.Dist_LeftPathBranch_k@ */ /end MEASUREMENT
/begin MEASUREMENT autosar_swc_rlgs_rtARID_DEF.Dist_RiPathBranch_k "" FLOAT32_IEEE autosar_swc_rlgs_CM_single 0 0 -3.4E+38 3.4E+38 ECU_ADDRESS 0xfe4afbac /* @ECU_Address@autosar_swc_rlgs_rtARID_DEF.Dist_RiPathBranch_k@ */ /end MEASUREMENT
/begin MEASUREMENT autosar_swc_rlgs_rtARID_DEF.EdgeControlLineCntTime "" FLOAT32_IEEE autosar_swc_rlgs_CM_single 0 0 -3.4E+38 3.4E+38 ECU_ADDRESS 0xfe4afb7c /* @ECU_Address@autosar_swc_rlgs_rtARID_DEF.EdgeControlLineCntTime@ */ /end MEASUREMENT
/begin MEASUREMENT autosar_swc_rlgs_rtARID_DEF.EntryDOPByStopLineFlag "" UBYTE autosar_swc_rlgs_CM_logical 0 0 0 1 ECU_ADDRESS 0xfe4afdc8 /* @ECU_Address@autosar_swc_rlgs_rtARID_DEF.EntryDOPByStopLineFlag@ */ /end MEASUREMENT
/begin MEASUREMENT autosar_swc_rlgs_rtARID_DEF.FRWhelDy_k1 "" FLOAT32_IEEE autosar_swc_rlgs_CM_single 0 0 -3.4E+38 3.4E+38 ECU_ADDRESS 0xfe4afbdc /* @ECU_Address@autosar_swc_rlgs_rtARID_DEF.FRWhelDy_k1@ */ /end MEASUREMENT
/begin MEASUREMENT autosar_swc_rlgs_rtARID_DEF.FirstEnterYbranchCostError "" FLOAT32_IEEE autosar_swc_rlgs_CM_single 0 0 -3.4E+38 3.4E+38 ECU_ADDRESS 0xfe4afb80 /* @ECU_Address@autosar_swc_rlgs_rtARID_DEF.FirstEnterYbranchCostError@ */ /end MEASUREMENT
/begin MEASUREMENT autosar_swc_rlgs_rtARID_DEF.ForwardJunctionflag "" UBYTE autosar_swc_rlgs_CM_logical 0 0 0 1 ECU_ADDRESS 0xfe4afdcb /* @ECU_Address@autosar_swc_rlgs_rtARID_DEF.ForwardJunctionflag@ */ /end MEASUREMENT
/begin MEASUREMENT autosar_swc_rlgs_rtARID_DEF.GuideLineCalSource "" UBYTE autosar_swc_rlgs_CM_uint8 0 0 0 255 ECU_ADDRESS 0xfe4afce6 /* @ECU_Address@autosar_swc_rlgs_rtARID_DEF.GuideLineCalSource@ */ /end MEASUREMENT
/begin MEASUREMENT autosar_swc_rlgs_rtARID_DEF.GuideLineCalSource_f "" UBYTE autosar_swc_rlgs_CM_uint8 0 0 0 255 ECU_ADDRESS 0xfe4afce7 /* @ECU_Address@autosar_swc_rlgs_rtARID_DEF.GuideLineCalSource_f@ */ /end MEASUREMENT
/begin MEASUREMENT autosar_swc_rlgs_rtARID_DEF.GuideLineCalSource_k1 "" UBYTE autosar_swc_rlgs_CM_uint8 0 0 0 255 ECU_ADDRESS 0xfe4afd78 /* @ECU_Address@autosar_swc_rlgs_rtARID_DEF.GuideLineCalSource_k1@ */ /end MEASUREMENT
/begin MEASUREMENT autosar_swc_rlgs_rtARID_DEF.GuideLineTrackID "" UWORD autosar_swc_rlgs_CM_uint16 0 0 0 65535 ECU_ADDRESS 0xfe4afcb2 /* @ECU_Address@autosar_swc_rlgs_rtARID_DEF.GuideLineTrackID@ */ /end MEASUREMENT
/begin MEASUREMENT autosar_swc_rlgs_rtARID_DEF.H_ID "" UBYTE autosar_swc_rlgs_CM_uint8 0 0 0 255 ECU_ADDRESS 0xfe4afce3 /* @ECU_Address@autosar_swc_rlgs_rtARID_DEF.H_ID@ */ /end MEASUREMENT
/begin MEASUREMENT autosar_swc_rlgs_rtARID_DEF.ID_Count "" UBYTE autosar_swc_rlgs_CM_uint8 0 0 0 255 ECU_ADDRESS 0xfe4afd60 /* @ECU_Address@autosar_swc_rlgs_rtARID_DEF.ID_Count@ */ /end MEASUREMENT
/begin MEASUREMENT autosar_swc_rlgs_rtARID_DEF.JunctionDistance "" FLOAT32_IEEE autosar_swc_rlgs_CM_single 0 0 -3.4E+38 3.4E+38 ECU_ADDRESS 0xfe4afb1c /* @ECU_Address@autosar_swc_rlgs_rtARID_DEF.JunctionDistance@ */ /end MEASUREMENT
/begin MEASUREMENT autosar_swc_rlgs_rtARID_DEF.L1KeepDis "" FLOAT32_IEEE autosar_swc_rlgs_CM_single 0 0 -3.4E+38 3.4E+38 ECU_ADDRESS 0xfe4afbfc /* @ECU_Address@autosar_swc_rlgs_rtARID_DEF.L1KeepDis@ */ /end MEASUREMENT
/begin MEASUREMENT autosar_swc_rlgs_rtARID_DEF.L1_C0_K1 "" FLOAT32_IEEE autosar_swc_rlgs_CM_single 0 0 -3.4E+38 3.4E+38 ECU_ADDRESS 0xfe4afc24 /* @ECU_Address@autosar_swc_rlgs_rtARID_DEF.L1_C0_K1@ */ /end MEASUREMENT
/begin MEASUREMENT autosar_swc_rlgs_rtARID_DEF.L1_C1_K1 "" FLOAT32_IEEE autosar_swc_rlgs_CM_single 0 0 -3.4E+38 3.4E+38 ECU_ADDRESS 0xfe4afc28 /* @ECU_Address@autosar_swc_rlgs_rtARID_DEF.L1_C1_K1@ */ /end MEASUREMENT
/begin MEASUREMENT autosar_swc_rlgs_rtARID_DEF.L1_C2_K1 "" FLOAT32_IEEE autosar_swc_rlgs_CM_single 0 0 -3.4E+38 3.4E+38 ECU_ADDRESS 0xfe4afc2c /* @ECU_Address@autosar_swc_rlgs_rtARID_DEF.L1_C2_K1@ */ /end MEASUREMENT
/begin MEASUREMENT autosar_swc_rlgs_rtARID_DEF.L1_C3_K1 "" FLOAT32_IEEE autosar_swc_rlgs_CM_single 0 0 -3.4E+38 3.4E+38 ECU_ADDRESS 0xfe4afc30 /* @ECU_Address@autosar_swc_rlgs_rtARID_DEF.L1_C3_K1@ */ /end MEASUREMENT
/begin MEASUREMENT autosar_swc_rlgs_rtARID_DEF.L1_Range_K1 "" FLOAT32_IEEE autosar_swc_rlgs_CM_single 0 0 -3.4E+38 3.4E+38 ECU_ADDRESS 0xfe4afc34 /* @ECU_Address@autosar_swc_rlgs_rtARID_DEF.L1_Range_K1@ */ /end MEASUREMENT
/begin MEASUREMENT autosar_swc_rlgs_rtARID_DEF.L1_bIsExist_K1 "" UBYTE autosar_swc_rlgs_CM_uint8 0 0 0 255 ECU_ADDRESS 0xfe4afd86 /* @ECU_Address@autosar_swc_rlgs_rtARID_DEF.L1_bIsExist_K1@ */ /end MEASUREMENT
/begin MEASUREMENT autosar_swc_rlgs_rtARID_DEF.L1_bIsExist_k1 "" UBYTE autosar_swc_rlgs_CM_uint8 0 0 0 255 ECU_ADDRESS 0xfe4afd6e /* @ECU_Address@autosar_swc_rlgs_rtARID_DEF.L1_bIsExist_k1@ */ /end MEASUREMENT
/begin MEASUREMENT autosar_swc_rlgs_rtARID_DEF.L2_bIsExist_k1 "" UBYTE autosar_swc_rlgs_CM_uint8 0 0 0 255 ECU_ADDRESS 0xfe4afd6c /* @ECU_Address@autosar_swc_rlgs_rtARID_DEF.L2_bIsExist_k1@ */ /end MEASUREMENT
/begin MEASUREMENT autosar_swc_rlgs_rtARID_DEF.LH1TypeK1 "" UBYTE autosar_swc_rlgs_CM_uint8 0 0 0 255 ECU_ADDRESS 0xfe4afd5c /* @ECU_Address@autosar_swc_rlgs_rtARID_DEF.LH1TypeK1@ */ /end MEASUREMENT
/begin MEASUREMENT autosar_swc_rlgs_rtARID_DEF.L_ID "" UBYTE autosar_swc_rlgs_CM_uint8 0 0 0 255 ECU_ADDRESS 0xfe4afce4 /* @ECU_Address@autosar_swc_rlgs_rtARID_DEF.L_ID@ */ /end MEASUREMENT
/begin MEASUREMENT autosar_swc_rlgs_rtARID_DEF.LaneSplitStsL_KeepDis "" FLOAT32_IEEE autosar_swc_rlgs_CM_single 0 0 -3.4E+38 3.4E+38 ECU_ADDRESS 0xfe4afc50 /* @ECU_Address@autosar_swc_rlgs_rtARID_DEF.LaneSplitStsL_KeepDis@ */ /end MEASUREMENT
/begin MEASUREMENT autosar_swc_rlgs_rtARID_DEF.LaneSplitStsR_KeepDis "" FLOAT32_IEEE autosar_swc_rlgs_CM_single 0 0 -3.4E+38 3.4E+38 ECU_ADDRESS 0xfe4afc54 /* @ECU_Address@autosar_swc_rlgs_rtARID_DEF.LaneSplitStsR_KeepDis@ */ /end MEASUREMENT
/begin MEASUREMENT autosar_swc_rlgs_rtARID_DEF.Lane_arr_dir_sts "" UBYTE autosar_swc_rlgs_CM_uint8 0 0 0 255 ECU_ADDRESS 0xfe4afd5a /* @ECU_Address@autosar_swc_rlgs_rtARID_DEF.Lane_arr_dir_sts@ */ /end MEASUREMENT
/begin MEASUREMENT autosar_swc_rlgs_rtARID_DEF.LeftChangeDirSts_keepDis "" FLOAT32_IEEE autosar_swc_rlgs_CM_single 0 0 -3.4E+38 3.4E+38 ECU_ADDRESS 0xfe4afb50 /* @ECU_Address@autosar_swc_rlgs_rtARID_DEF.LeftChangeDirSts_keepDis@ */ /end MEASUREMENT
/begin MEASUREMENT autosar_swc_rlgs_rtARID_DEF.LeftChangeDirSts_temp "" UBYTE autosar_swc_rlgs_CM_uint8 0 0 0 255 ECU_ADDRESS 0xfe4afd5e /* @ECU_Address@autosar_swc_rlgs_rtARID_DEF.LeftChangeDirSts_temp@ */ /end MEASUREMENT
/begin MEASUREMENT autosar_swc_rlgs_rtARID_DEF.LeftLineTrackId "" UWORD autosar_swc_rlgs_CM_uint16 0 0 0 65535 ECU_ADDRESS 0xfe4afcae /* @ECU_Address@autosar_swc_rlgs_rtARID_DEF.LeftLineTrackId@ */ /end MEASUREMENT
/begin MEASUREMENT autosar_swc_rlgs_rtARID_DEF.LeftLineValid "" UBYTE autosar_swc_rlgs_CM_uint8 0 0 0 255 ECU_ADDRESS 0xfe4afd65 /* @ECU_Address@autosar_swc_rlgs_rtARID_DEF.LeftLineValid@ */ /end MEASUREMENT
/begin MEASUREMENT autosar_swc_rlgs_rtARID_DEF.LostTime_k1 "" FLOAT32_IEEE autosar_swc_rlgs_CM_single 0 0 -3.4E+38 3.4E+38 ECU_ADDRESS 0xfe4afb84 /* @ECU_Address@autosar_swc_rlgs_rtARID_DEF.LostTime_k1@ */ /end MEASUREMENT
/begin MEASUREMENT autosar_swc_rlgs_rtARID_DEF.NOAClass_K1 "" UBYTE autosar_swc_rlgs_CM_uint8 0 0 0 255 ECU_ADDRESS 0xfe4afd73 /* @ECU_Address@autosar_swc_rlgs_rtARID_DEF.NOAClass_K1@ */ /end MEASUREMENT
/begin MEASUREMENT autosar_swc_rlgs_rtARID_DEF.NOALineC0_K1 "" FLOAT32_IEEE autosar_swc_rlgs_CM_single 0 0 -3.4E+38 3.4E+38 ECU_ADDRESS 0xfe4afbc8 /* @ECU_Address@autosar_swc_rlgs_rtARID_DEF.NOALineC0_K1@ */ /end MEASUREMENT
/begin MEASUREMENT autosar_swc_rlgs_rtARID_DEF.NOALineC1_K1 "" FLOAT32_IEEE autosar_swc_rlgs_CM_single 0 0 -3.4E+38 3.4E+38 ECU_ADDRESS 0xfe4afbc4 /* @ECU_Address@autosar_swc_rlgs_rtARID_DEF.NOALineC1_K1@ */ /end MEASUREMENT
/begin MEASUREMENT autosar_swc_rlgs_rtARID_DEF.NOALineC2_K1 "" FLOAT32_IEEE autosar_swc_rlgs_CM_single 0 0 -3.4E+38 3.4E+38 ECU_ADDRESS 0xfe4afbc0 /* @ECU_Address@autosar_swc_rlgs_rtARID_DEF.NOALineC2_K1@ */ /end MEASUREMENT
/begin MEASUREMENT autosar_swc_rlgs_rtARID_DEF.NOALineC3_K1 "" FLOAT32_IEEE autosar_swc_rlgs_CM_single 0 0 -3.4E+38 3.4E+38 ECU_ADDRESS 0xfe4afbbc /* @ECU_Address@autosar_swc_rlgs_rtARID_DEF.NOALineC3_K1@ */ /end MEASUREMENT
/begin MEASUREMENT autosar_swc_rlgs_rtARID_DEF.NOALineRange_K1 "" FLOAT32_IEEE autosar_swc_rlgs_CM_single 0 0 -3.4E+38 3.4E+38 ECU_ADDRESS 0xfe4afbd0 /* @ECU_Address@autosar_swc_rlgs_rtARID_DEF.NOALineRange_K1@ */ /end MEASUREMENT
/begin MEASUREMENT autosar_swc_rlgs_rtARID_DEF.NOALineStart_K1 "" FLOAT32_IEEE autosar_swc_rlgs_CM_single 0 0 -3.4E+38 3.4E+38 ECU_ADDRESS 0xfe4afbcc /* @ECU_Address@autosar_swc_rlgs_rtARID_DEF.NOALineStart_K1@ */ /end MEASUREMENT
/begin MEASUREMENT autosar_swc_rlgs_rtARID_DEF.NOALineValid_K1 "" UBYTE autosar_swc_rlgs_CM_uint8 0 0 0 255 ECU_ADDRESS 0xfe4afd71 /* @ECU_Address@autosar_swc_rlgs_rtARID_DEF.NOALineValid_K1@ */ /end MEASUREMENT
/begin MEASUREMENT autosar_swc_rlgs_rtARID_DEF.NOAReliable_K1 "" FLOAT32_IEEE autosar_swc_rlgs_CM_single 0 0 -3.4E+38 3.4E+38 ECU_ADDRESS 0xfe4afbd4 /* @ECU_Address@autosar_swc_rlgs_rtARID_DEF.NOAReliable_K1@ */ /end MEASUREMENT
/begin MEASUREMENT autosar_swc_rlgs_rtARID_DEF.NOARoadWidth_K1 "" FLOAT32_IEEE autosar_swc_rlgs_CM_single 0 0 -3.4E+38 3.4E+38 ECU_ADDRESS 0xfe4afbd8 /* @ECU_Address@autosar_swc_rlgs_rtARID_DEF.NOARoadWidth_K1@ */ /end MEASUREMENT
/begin MEASUREMENT autosar_swc_rlgs_rtARID_DEF.NOASource_K1 "" UBYTE autosar_swc_rlgs_CM_uint8 0 0 0 255 ECU_ADDRESS 0xfe4afd72 /* @ECU_Address@autosar_swc_rlgs_rtARID_DEF.NOASource_K1@ */ /end MEASUREMENT
/begin MEASUREMENT autosar_swc_rlgs_rtARID_DEF.NarrowFlag "" UBYTE autosar_swc_rlgs_CM_logical 0 0 0 1 ECU_ADDRESS 0xfe4afdd2 /* @ECU_Address@autosar_swc_rlgs_rtARID_DEF.NarrowFlag@ */ /end MEASUREMENT
/begin MEASUREMENT autosar_swc_rlgs_rtARID_DEF.NextGuideLineSource_temp "" UBYTE autosar_swc_rlgs_CM_uint8 0 0 0 255 ECU_ADDRESS 0xfe4afd79 /* @ECU_Address@autosar_swc_rlgs_rtARID_DEF.NextGuideLineSource_temp@ */ /end MEASUREMENT
/begin MEASUREMENT autosar_swc_rlgs_rtARID_DEF.Output_DSTATE "" UBYTE autosar_swc_rlgs_CM_uint8 0 0 0 255 ECU_ADDRESS 0xfe4afce8 /* @ECU_Address@autosar_swc_rlgs_rtARID_DEF.Output_DSTATE@ */ /end MEASUREMENT
/begin MEASUREMENT autosar_swc_rlgs_rtARID_DEF.PP_Path_1_C0_K1 "" FLOAT32_IEEE autosar_swc_rlgs_CM_single 0 0 -3.4E+38 3.4E+38 ECU_ADDRESS 0xfe4afc38 /* @ECU_Address@autosar_swc_rlgs_rtARID_DEF.PP_Path_1_C0_K1@ */ /end MEASUREMENT
/begin MEASUREMENT autosar_swc_rlgs_rtARID_DEF.ParallelismTime "" FLOAT32_IEEE autosar_swc_rlgs_CM_single 0 0 -3.4E+38 3.4E+38 ECU_ADDRESS 0xfe4afba4 /* @ECU_Address@autosar_swc_rlgs_rtARID_DEF.ParallelismTime@ */ /end MEASUREMENT
/begin MEASUREMENT autosar_swc_rlgs_rtARID_DEF.R0RemberDis "" FLOAT32_IEEE autosar_swc_rlgs_CM_single 0 0 -3.4E+38 3.4E+38 ECU_ADDRESS 0xfe4afbf8 /* @ECU_Address@autosar_swc_rlgs_rtARID_DEF.R0RemberDis@ */ /end MEASUREMENT
/begin MEASUREMENT autosar_swc_rlgs_rtARID_DEF.R0line_C0_k1 "" FLOAT32_IEEE autosar_swc_rlgs_CM_single 0 0 -3.4E+38 3.4E+38 ECU_ADDRESS 0xfe4afc00 /* @ECU_Address@autosar_swc_rlgs_rtARID_DEF.R0line_C0_k1@ */ /end MEASUREMENT
/begin MEASUREMENT autosar_swc_rlgs_rtARID_DEF.R0line_C1_k1 "" FLOAT32_IEEE autosar_swc_rlgs_CM_single 0 0 -3.4E+38 3.4E+38 ECU_ADDRESS 0xfe4afc04 /* @ECU_Address@autosar_swc_rlgs_rtARID_DEF.R0line_C1_k1@ */ /end MEASUREMENT
/begin MEASUREMENT autosar_swc_rlgs_rtARID_DEF.R0line_C2_k1 "" FLOAT32_IEEE autosar_swc_rlgs_CM_single 0 0 -3.4E+38 3.4E+38 ECU_ADDRESS 0xfe4afc08 /* @ECU_Address@autosar_swc_rlgs_rtARID_DEF.R0line_C2_k1@ */ /end MEASUREMENT
/begin MEASUREMENT autosar_swc_rlgs_rtARID_DEF.R0line_C3_k1 "" FLOAT32_IEEE autosar_swc_rlgs_CM_single 0 0 -3.4E+38 3.4E+38 ECU_ADDRESS 0xfe4afc0c /* @ECU_Address@autosar_swc_rlgs_rtARID_DEF.R0line_C3_k1@ */ /end MEASUREMENT
/begin MEASUREMENT autosar_swc_rlgs_rtARID_DEF.R0line_Con_K1 "" UBYTE autosar_swc_rlgs_CM_uint8 0 0 0 255 ECU_ADDRESS 0xfe4afd77 /* @ECU_Address@autosar_swc_rlgs_rtARID_DEF.R0line_Con_K1@ */ /end MEASUREMENT
/begin MEASUREMENT autosar_swc_rlgs_rtARID_DEF.R0line_End_k1 "" FLOAT32_IEEE autosar_swc_rlgs_CM_single 0 0 -3.4E+38 3.4E+38 ECU_ADDRESS 0xfe4afc10 /* @ECU_Address@autosar_swc_rlgs_rtARID_DEF.R0line_End_k1@ */ /end MEASUREMENT
/begin MEASUREMENT autosar_swc_rlgs_rtARID_DEF.R1_C0_K1 "" FLOAT32_IEEE autosar_swc_rlgs_CM_single 0 0 -3.4E+38 3.4E+38 ECU_ADDRESS 0xfe4afc3c /* @ECU_Address@autosar_swc_rlgs_rtARID_DEF.R1_C0_K1@ */ /end MEASUREMENT
/begin MEASUREMENT autosar_swc_rlgs_rtARID_DEF.R1_C1_K1 "" FLOAT32_IEEE autosar_swc_rlgs_CM_single 0 0 -3.4E+38 3.4E+38 ECU_ADDRESS 0xfe4afc40 /* @ECU_Address@autosar_swc_rlgs_rtARID_DEF.R1_C1_K1@ */ /end MEASUREMENT
/begin MEASUREMENT autosar_swc_rlgs_rtARID_DEF.R1_C2_K1 "" FLOAT32_IEEE autosar_swc_rlgs_CM_single 0 0 -3.4E+38 3.4E+38 ECU_ADDRESS 0xfe4afc44 /* @ECU_Address@autosar_swc_rlgs_rtARID_DEF.R1_C2_K1@ */ /end MEASUREMENT
/begin MEASUREMENT autosar_swc_rlgs_rtARID_DEF.R1_C3_K1 "" FLOAT32_IEEE autosar_swc_rlgs_CM_single 0 0 -3.4E+38 3.4E+38 ECU_ADDRESS 0xfe4afc48 /* @ECU_Address@autosar_swc_rlgs_rtARID_DEF.R1_C3_K1@ */ /end MEASUREMENT
/begin MEASUREMENT autosar_swc_rlgs_rtARID_DEF.R1_Range_K1 "" FLOAT32_IEEE autosar_swc_rlgs_CM_single 0 0 -3.4E+38 3.4E+38 ECU_ADDRESS 0xfe4afc4c /* @ECU_Address@autosar_swc_rlgs_rtARID_DEF.R1_Range_K1@ */ /end MEASUREMENT
/begin MEASUREMENT autosar_swc_rlgs_rtARID_DEF.R1_ShadedTypeTime "" FLOAT32_IEEE autosar_swc_rlgs_CM_single 0 0 -3.4E+38 3.4E+38 ECU_ADDRESS 0xfe4afbb4 /* @ECU_Address@autosar_swc_rlgs_rtARID_DEF.R1_ShadedTypeTime@ */ /end MEASUREMENT
/begin MEASUREMENT autosar_swc_rlgs_rtARID_DEF.R1_TrackID "" UWORD autosar_swc_rlgs_CM_uint16 0 0 0 65535 ECU_ADDRESS 0xfe4afcb4 /* @ECU_Address@autosar_swc_rlgs_rtARID_DEF.R1_TrackID@ */ /end MEASUREMENT
/begin MEASUREMENT autosar_swc_rlgs_rtARID_DEF.R1_bIsExist_K1 "" UBYTE autosar_swc_rlgs_CM_uint8 0 0 0 255 ECU_ADDRESS 0xfe4afd87 /* @ECU_Address@autosar_swc_rlgs_rtARID_DEF.R1_bIsExist_K1@ */ /end MEASUREMENT
/begin MEASUREMENT autosar_swc_rlgs_rtARID_DEF.R1_bIsExist_k1 "" UBYTE autosar_swc_rlgs_CM_uint8 0 0 0 255 ECU_ADDRESS 0xfe4afd6f /* @ECU_Address@autosar_swc_rlgs_rtARID_DEF.R1_bIsExist_k1@ */ /end MEASUREMENT
/begin MEASUREMENT autosar_swc_rlgs_rtARID_DEF.R1_bIsLineExist "" UBYTE autosar_swc_rlgs_CM_uint8 0 0 0 255 ECU_ADDRESS 0xfe4afd88 /* @ECU_Address@autosar_swc_rlgs_rtARID_DEF.R1_bIsLineExist@ */ /end MEASUREMENT
/begin MEASUREMENT autosar_swc_rlgs_rtARID_DEF.R2_ShadedTypeTime "" FLOAT32_IEEE autosar_swc_rlgs_CM_single 0 0 -3.4E+38 3.4E+38 ECU_ADDRESS 0xfe4afbb8 /* @ECU_Address@autosar_swc_rlgs_rtARID_DEF.R2_ShadedTypeTime@ */ /end MEASUREMENT
/begin MEASUREMENT autosar_swc_rlgs_rtARID_DEF.R2_bIsExist_k1 "" UBYTE autosar_swc_rlgs_CM_uint8 0 0 0 255 ECU_ADDRESS 0xfe4afd6d /* @ECU_Address@autosar_swc_rlgs_rtARID_DEF.R2_bIsExist_k1@ */ /end MEASUREMENT
/begin MEASUREMENT autosar_swc_rlgs_rtARID_DEF.RO_OutStartPointDis "" FLOAT32_IEEE autosar_swc_rlgs_CM_single 0 0 -3.4E+38 3.4E+38 ECU_ADDRESS 0xfe4afc18 /* @ECU_Address@autosar_swc_rlgs_rtARID_DEF.RO_OutStartPointDis@ */ /end MEASUREMENT
/begin MEASUREMENT autosar_swc_rlgs_rtARID_DEF.R_ID "" UBYTE autosar_swc_rlgs_CM_uint8 0 0 0 255 ECU_ADDRESS 0xfe4afce5 /* @ECU_Address@autosar_swc_rlgs_rtARID_DEF.R_ID@ */ /end MEASUREMENT
/begin MEASUREMENT autosar_swc_rlgs_rtARID_DEF.Relay_Mode "" UBYTE autosar_swc_rlgs_CM_logical 0 0 0 1 ECU_ADDRESS 0xfe4afdb8 /* @ECU_Address@autosar_swc_rlgs_rtARID_DEF.Relay_Mode@ */ /end MEASUREMENT
/begin MEASUREMENT autosar_swc_rlgs_rtARID_DEF.RelevancyLaneID "" ULONG autosar_swc_rlgs_CM_uint32 0 0 0 4294967295 ECU_ADDRESS 0xfe4afc8c /* @ECU_Address@autosar_swc_rlgs_rtARID_DEF.RelevancyLaneID@ */ /end MEASUREMENT
/begin MEASUREMENT autosar_swc_rlgs_rtARID_DEF.RiLaneChangeFlagk1 "" UBYTE autosar_swc_rlgs_CM_logical 0 0 0 1 ECU_ADDRESS 0xfe4afdd3 /* @ECU_Address@autosar_swc_rlgs_rtARID_DEF.RiLaneChangeFlagk1@ */ /end MEASUREMENT
/begin MEASUREMENT autosar_swc_rlgs_rtARID_DEF.RightChangeDirSts_keepDis "" FLOAT32_IEEE autosar_swc_rlgs_CM_single 0 0 -3.4E+38 3.4E+38 ECU_ADDRESS 0xfe4afb54 /* @ECU_Address@autosar_swc_rlgs_rtARID_DEF.RightChangeDirSts_keepDis@ */ /end MEASUREMENT
/begin MEASUREMENT autosar_swc_rlgs_rtARID_DEF.RightChangeDirSts_temp "" UBYTE autosar_swc_rlgs_CM_uint8 0 0 0 255 ECU_ADDRESS 0xfe4afd5f /* @ECU_Address@autosar_swc_rlgs_rtARID_DEF.RightChangeDirSts_temp@ */ /end MEASUREMENT
/begin MEASUREMENT autosar_swc_rlgs_rtARID_DEF.RightLineTrackId "" UWORD autosar_swc_rlgs_CM_uint16 0 0 0 65535 ECU_ADDRESS 0xfe4afcb0 /* @ECU_Address@autosar_swc_rlgs_rtARID_DEF.RightLineTrackId@ */ /end MEASUREMENT
/begin MEASUREMENT autosar_swc_rlgs_rtARID_DEF.RightLineValid "" UBYTE autosar_swc_rlgs_CM_uint8 0 0 0 255 ECU_ADDRESS 0xfe4afd66 /* @ECU_Address@autosar_swc_rlgs_rtARID_DEF.RightLineValid@ */ /end MEASUREMENT
/begin MEASUREMENT autosar_swc_rlgs_rtARID_DEF.RoadSemanticsSts_k1 "" UBYTE autosar_swc_rlgs_CM_uint8 0 0 0 255 ECU_ADDRESS 0xfe4afd64 /* @ECU_Address@autosar_swc_rlgs_rtARID_DEF.RoadSemanticsSts_k1@ */ /end MEASUREMENT
/begin MEASUREMENT autosar_swc_rlgs_rtARID_DEF.RoadSemantics_k1 "" UBYTE autosar_swc_rlgs_CM_uint8 0 0 0 255 ECU_ADDRESS 0xfe4afd70 /* @ECU_Address@autosar_swc_rlgs_rtARID_DEF.RoadSemantics_k1@ */ /end MEASUREMENT
/begin MEASUREMENT autosar_swc_rlgs_rtARID_DEF.RoadWidthRemberFlag "" UBYTE autosar_swc_rlgs_CM_logical 0 0 0 1 ECU_ADDRESS 0xfe4afdcf /* @ECU_Address@autosar_swc_rlgs_rtARID_DEF.RoadWidthRemberFlag@ */ /end MEASUREMENT
/begin MEASUREMENT autosar_swc_rlgs_rtARID_DEF.RoadWidthRemberValue "" FLOAT32_IEEE autosar_swc_rlgs_CM_single 0 0 -3.4E+38 3.4E+38 ECU_ADDRESS 0xfe4afb94 /* @ECU_Address@autosar_swc_rlgs_rtARID_DEF.RoadWidthRemberValue@ */ /end MEASUREMENT
/begin MEASUREMENT autosar_swc_rlgs_rtARID_DEF.RoadWidth_k1 "" FLOAT32_IEEE autosar_swc_rlgs_CM_single 0 0 -3.4E+38 3.4E+38 ECU_ADDRESS 0xfe4afb98 /* @ECU_Address@autosar_swc_rlgs_rtARID_DEF.RoadWidth_k1@ */ /end MEASUREMENT
/begin MEASUREMENT autosar_swc_rlgs_rtARID_DEF.Source_k1 "" UBYTE autosar_swc_rlgs_CM_uint8 0 0 0 255 ECU_ADDRESS 0xfe4afd69 /* @ECU_Address@autosar_swc_rlgs_rtARID_DEF.Source_k1@ */ /end MEASUREMENT
/begin MEASUREMENT autosar_swc_rlgs_rtARID_DEF.SplitLineCalSource "" UBYTE autosar_swc_rlgs_CM_uint8 0 0 0 255 ECU_ADDRESS 0xfe4afd75 /* @ECU_Address@autosar_swc_rlgs_rtARID_DEF.SplitLineCalSource@ */ /end MEASUREMENT
/begin MEASUREMENT autosar_swc_rlgs_rtARID_DEF.StopLineDistance "" FLOAT32_IEEE autosar_swc_rlgs_CM_single 0 0 -3.4E+38 3.4E+38 ECU_ADDRESS 0xfe4afb20 /* @ECU_Address@autosar_swc_rlgs_rtARID_DEF.StopLineDistance@ */ /end MEASUREMENT
/begin MEASUREMENT autosar_swc_rlgs_rtARID_DEF.SwitchCont "" FLOAT32_IEEE autosar_swc_rlgs_CM_single 0 0 -3.4E+38 3.4E+38 LAYOUT COLUMN_DIR MATRIX_DIM 20 ECU_ADDRESS 0xfe4af80c /* @ECU_Address@autosar_swc_rlgs_rtARID_DEF.SwitchCont@ */ /end MEASUREMENT
/begin MEASUREMENT autosar_swc_rlgs_rtARID_DEF.SwitchReason "" UBYTE autosar_swc_rlgs_CM_uint8 0 0 0 255 ECU_ADDRESS 0xfe4afd59 /* @ECU_Address@autosar_swc_rlgs_rtARID_DEF.SwitchReason@ */ /end MEASUREMENT
/begin MEASUREMENT autosar_swc_rlgs_rtARID_DEF.TJASelectedPathIndex "" UBYTE autosar_swc_rlgs_CM_uint8 0 0 0 255 ECU_ADDRESS 0xfe4afd58 /* @ECU_Address@autosar_swc_rlgs_rtARID_DEF.TJASelectedPathIndex@ */ /end MEASUREMENT
/begin MEASUREMENT autosar_swc_rlgs_rtARID_DEF.TimeApproach "" FLOAT32_IEEE autosar_swc_rlgs_CM_single 0 0 -3.4E+38 3.4E+38 ECU_ADDRESS 0xfe4afbe0 /* @ECU_Address@autosar_swc_rlgs_rtARID_DEF.TimeApproach@ */ /end MEASUREMENT
/begin MEASUREMENT autosar_swc_rlgs_rtARID_DEF.TmpSignalConversionAtvxvRefMsOutport1 "" FLOAT32_IEEE autosar_swc_rlgs_CM_single 0 0 -3.4E+38 3.4E+38 ECU_ADDRESS 0xfe4af85c /* @ECU_Address@autosar_swc_rlgs_rtARID_DEF.TmpSignalConversionAtvxvRefMsOutport1@ */ /end MEASUREMENT
/begin MEASUREMENT autosar_swc_rlgs_rtARID_DEF.UnitDelay10_DSTATE "" ULONG autosar_swc_rlgs_CM_uint32 0 0 0 4294967295 ECU_ADDRESS 0xfe4afc7c /* @ECU_Address@autosar_swc_rlgs_rtARID_DEF.UnitDelay10_DSTATE@ */ /end MEASUREMENT
/begin MEASUREMENT autosar_swc_rlgs_rtARID_DEF.UnitDelay10_DSTATE_l "" UBYTE autosar_swc_rlgs_CM_uint8 0 0 0 255 ECU_ADDRESS 0xfe4afcec /* @ECU_Address@autosar_swc_rlgs_rtARID_DEF.UnitDelay10_DSTATE_l@ */ /end MEASUREMENT
/begin MEASUREMENT autosar_swc_rlgs_rtARID_DEF.UnitDelay11_DSTATE "" UBYTE autosar_swc_rlgs_CM_uint8 0 0 0 255 ECU_ADDRESS 0xfe4afced /* @ECU_Address@autosar_swc_rlgs_rtARID_DEF.UnitDelay11_DSTATE@ */ /end MEASUREMENT
/begin MEASUREMENT autosar_swc_rlgs_rtARID_DEF.UnitDelay11_DSTATE_a "" UBYTE autosar_swc_rlgs_CM_uint8 0 0 0 255 ECU_ADDRESS 0xfe4afcf2 /* @ECU_Address@autosar_swc_rlgs_rtARID_DEF.UnitDelay11_DSTATE_a@ */ /end MEASUREMENT
/begin MEASUREMENT autosar_swc_rlgs_rtARID_DEF.UnitDelay12_DSTATE "" UBYTE autosar_swc_rlgs_CM_uint8 0 0 0 255 ECU_ADDRESS 0xfe4afcee /* @ECU_Address@autosar_swc_rlgs_rtARID_DEF.UnitDelay12_DSTATE@ */ /end MEASUREMENT
/begin MEASUREMENT autosar_swc_rlgs_rtARID_DEF.UnitDelay12_DSTATE_b "" UBYTE autosar_swc_rlgs_CM_uint8 0 0 0 255 ECU_ADDRESS 0xfe4afcf3 /* @ECU_Address@autosar_swc_rlgs_rtARID_DEF.UnitDelay12_DSTATE_b@ */ /end MEASUREMENT
/begin MEASUREMENT autosar_swc_rlgs_rtARID_DEF.UnitDelay13_DSTATE "" UBYTE autosar_swc_rlgs_CM_uint8 0 0 0 255 ECU_ADDRESS 0xfe4afceb /* @ECU_Address@autosar_swc_rlgs_rtARID_DEF.UnitDelay13_DSTATE@ */ /end MEASUREMENT
/begin MEASUREMENT autosar_swc_rlgs_rtARID_DEF.UnitDelay1_DSTATE_be "" UBYTE autosar_swc_rlgs_CM_uint8 0 0 0 255 ECU_ADDRESS 0xfe4afcf1 /* @ECU_Address@autosar_swc_rlgs_rtARID_DEF.UnitDelay1_DSTATE_be@ */ /end MEASUREMENT
/begin MEASUREMENT autosar_swc_rlgs_rtARID_DEF.UnitDelay1_DSTATE_g "" UBYTE autosar_swc_rlgs_CM_logical 0 0 0 1 ECU_ADDRESS 0xfe4afdac /* @ECU_Address@autosar_swc_rlgs_rtARID_DEF.UnitDelay1_DSTATE_g@ */ /end MEASUREMENT
/begin MEASUREMENT autosar_swc_rlgs_rtARID_DEF.UnitDelay1_DSTATE_j "" UBYTE autosar_swc_rlgs_CM_uint8 0 0 0 255 ECU_ADDRESS 0xfe4afcf4 /* @ECU_Address@autosar_swc_rlgs_rtARID_DEF.UnitDelay1_DSTATE_j@ */ /end MEASUREMENT
/begin MEASUREMENT autosar_swc_rlgs_rtARID_DEF.UnitDelay1_DSTATE_l "" FLOAT32_IEEE autosar_swc_rlgs_CM_single 0 0 -3.4E+38 3.4E+38 ECU_ADDRESS 0xfe4af870 /* @ECU_Address@autosar_swc_rlgs_rtARID_DEF.UnitDelay1_DSTATE_l@ */ /end MEASUREMENT
/begin MEASUREMENT autosar_swc_rlgs_rtARID_DEF.UnitDelay1_DSTATE_lu "" UBYTE autosar_swc_rlgs_CM_logical 0 0 0 1 ECU_ADDRESS 0xfe4afdad /* @ECU_Address@autosar_swc_rlgs_rtARID_DEF.UnitDelay1_DSTATE_lu@ */ /end MEASUREMENT
/begin MEASUREMENT autosar_swc_rlgs_rtARID_DEF.UnitDelay1_DSTATE_n "" FLOAT32_IEEE autosar_swc_rlgs_CM_single 0 0 -3.4E+38 3.4E+38 ECU_ADDRESS 0xfe4af8cc /* @ECU_Address@autosar_swc_rlgs_rtARID_DEF.UnitDelay1_DSTATE_n@ */ /end MEASUREMENT
/begin MEASUREMENT autosar_swc_rlgs_rtARID_DEF.UnitDelay2_DSTATE_c "" FLOAT32_IEEE autosar_swc_rlgs_CM_single 0 0 -3.4E+38 3.4E+38 ECU_ADDRESS 0xfe4af8d0 /* @ECU_Address@autosar_swc_rlgs_rtARID_DEF.UnitDelay2_DSTATE_c@ */ /end MEASUREMENT
/begin MEASUREMENT autosar_swc_rlgs_rtARID_DEF.UnitDelay2_DSTATE_d "" FLOAT32_IEEE autosar_swc_rlgs_CM_single 0 0 -3.4E+38 3.4E+38 ECU_ADDRESS 0xfe4af8a8 /* @ECU_Address@autosar_swc_rlgs_rtARID_DEF.UnitDelay2_DSTATE_d@ */ /end MEASUREMENT
/begin MEASUREMENT autosar_swc_rlgs_rtARID_DEF.UnitDelay2_DSTATE_dx "" FLOAT32_IEEE autosar_swc_rlgs_CM_single 0 0 -3.4E+38 3.4E+38 ECU_ADDRESS 0xfe4af8f0 /* @ECU_Address@autosar_swc_rlgs_rtARID_DEF.UnitDelay2_DSTATE_dx@ */ /end MEASUREMENT
/begin MEASUREMENT autosar_swc_rlgs_rtARID_DEF.UnitDelay2_DSTATE_m "" FLOAT32_IEEE autosar_swc_rlgs_CM_single 0 0 -3.4E+38 3.4E+38 ECU_ADDRESS 0xfe4af874 /* @ECU_Address@autosar_swc_rlgs_rtARID_DEF.UnitDelay2_DSTATE_m@ */ /end MEASUREMENT
/begin MEASUREMENT autosar_swc_rlgs_rtARID_DEF.UnitDelay3_DSTATE "" FLOAT32_IEEE autosar_swc_rlgs_CM_single 0 0 -3.4E+38 3.4E+38 ECU_ADDRESS 0xfe4af878 /* @ECU_Address@autosar_swc_rlgs_rtARID_DEF.UnitDelay3_DSTATE@ */ /end MEASUREMENT
/begin MEASUREMENT autosar_swc_rlgs_rtARID_DEF.UnitDelay3_DSTATE_e "" FLOAT32_IEEE autosar_swc_rlgs_CM_single 0 0 -3.4E+38 3.4E+38 ECU_ADDRESS 0xfe4af8f4 /* @ECU_Address@autosar_swc_rlgs_rtARID_DEF.UnitDelay3_DSTATE_e@ */ /end MEASUREMENT
/begin MEASUREMENT autosar_swc_rlgs_rtARID_DEF.UnitDelay3_DSTATE_j "" FLOAT32_IEEE autosar_swc_rlgs_CM_single 0 0 -3.4E+38 3.4E+38 ECU_ADDRESS 0xfe4af8d4 /* @ECU_Address@autosar_swc_rlgs_rtARID_DEF.UnitDelay3_DSTATE_j@ */ /end MEASUREMENT
/begin MEASUREMENT autosar_swc_rlgs_rtARID_DEF.UnitDelay3_DSTATE_m "" FLOAT32_IEEE autosar_swc_rlgs_CM_single 0 0 -3.4E+38 3.4E+38 ECU_ADDRESS 0xfe4af8ec /* @ECU_Address@autosar_swc_rlgs_rtARID_DEF.UnitDelay3_DSTATE_m@ */ /end MEASUREMENT
/begin MEASUREMENT autosar_swc_rlgs_rtARID_DEF.UnitDelay3_DSTATE_p "" FLOAT32_IEEE autosar_swc_rlgs_CM_single 0 0 -3.4E+38 3.4E+38 ECU_ADDRESS 0xfe4af8ac /* @ECU_Address@autosar_swc_rlgs_rtARID_DEF.UnitDelay3_DSTATE_p@ */ /end MEASUREMENT
/begin MEASUREMENT autosar_swc_rlgs_rtARID_DEF.UnitDelay4_DSTATE_b "" FLOAT32_IEEE autosar_swc_rlgs_CM_single 0 0 -3.4E+38 3.4E+38 ECU_ADDRESS 0xfe4af894 /* @ECU_Address@autosar_swc_rlgs_rtARID_DEF.UnitDelay4_DSTATE_b@ */ /end MEASUREMENT
/begin MEASUREMENT autosar_swc_rlgs_rtARID_DEF.UnitDelay4_DSTATE_d "" FLOAT32_IEEE autosar_swc_rlgs_CM_single 0 0 -3.4E+38 3.4E+38 ECU_ADDRESS 0xfe4af8b0 /* @ECU_Address@autosar_swc_rlgs_rtARID_DEF.UnitDelay4_DSTATE_d@ */ /end MEASUREMENT
/begin MEASUREMENT autosar_swc_rlgs_rtARID_DEF.UnitDelay4_DSTATE_d0 "" FLOAT32_IEEE autosar_swc_rlgs_CM_single 0 0 -3.4E+38 3.4E+38 ECU_ADDRESS 0xfe4af8f8 /* @ECU_Address@autosar_swc_rlgs_rtARID_DEF.UnitDelay4_DSTATE_d0@ */ /end MEASUREMENT
/begin MEASUREMENT autosar_swc_rlgs_rtARID_DEF.UnitDelay4_DSTATE_h "" FLOAT32_IEEE autosar_swc_rlgs_CM_single 0 0 -3.4E+38 3.4E+38 ECU_ADDRESS 0xfe4af87c /* @ECU_Address@autosar_swc_rlgs_rtARID_DEF.UnitDelay4_DSTATE_h@ */ /end MEASUREMENT
/begin MEASUREMENT autosar_swc_rlgs_rtARID_DEF.UnitDelay4_DSTATE_k "" FLOAT32_IEEE autosar_swc_rlgs_CM_single 0 0 -3.4E+38 3.4E+38 ECU_ADDRESS 0xfe4af8d8 /* @ECU_Address@autosar_swc_rlgs_rtARID_DEF.UnitDelay4_DSTATE_k@ */ /end MEASUREMENT
/begin MEASUREMENT autosar_swc_rlgs_rtARID_DEF.UnitDelay5_DSTATE "" FLOAT32_IEEE autosar_swc_rlgs_CM_single 0 0 -3.4E+38 3.4E+38 ECU_ADDRESS 0xfe4af884 /* @ECU_Address@autosar_swc_rlgs_rtARID_DEF.UnitDelay5_DSTATE@ */ /end MEASUREMENT
/begin MEASUREMENT autosar_swc_rlgs_rtARID_DEF.UnitDelay5_DSTATE_d "" FLOAT32_IEEE autosar_swc_rlgs_CM_single 0 0 -3.4E+38 3.4E+38 ECU_ADDRESS 0xfe4af8fc /* @ECU_Address@autosar_swc_rlgs_rtARID_DEF.UnitDelay5_DSTATE_d@ */ /end MEASUREMENT
/begin MEASUREMENT autosar_swc_rlgs_rtARID_DEF.UnitDelay5_DSTATE_g "" FLOAT32_IEEE autosar_swc_rlgs_CM_single 0 0 -3.4E+38 3.4E+38 ECU_ADDRESS 0xfe4af8dc /* @ECU_Address@autosar_swc_rlgs_rtARID_DEF.UnitDelay5_DSTATE_g@ */ /end MEASUREMENT
/begin MEASUREMENT autosar_swc_rlgs_rtARID_DEF.UnitDelay5_DSTATE_n "" FLOAT32_IEEE autosar_swc_rlgs_CM_single 0 0 -3.4E+38 3.4E+38 ECU_ADDRESS 0xfe4af8b4 /* @ECU_Address@autosar_swc_rlgs_rtARID_DEF.UnitDelay5_DSTATE_n@ */ /end MEASUREMENT
/begin MEASUREMENT autosar_swc_rlgs_rtARID_DEF.UnitDelay5_DSTATE_p "" FLOAT32_IEEE autosar_swc_rlgs_CM_single 0 0 -3.4E+38 3.4E+38 ECU_ADDRESS 0xfe4af898 /* @ECU_Address@autosar_swc_rlgs_rtARID_DEF.UnitDelay5_DSTATE_p@ */ /end MEASUREMENT
/begin MEASUREMENT autosar_swc_rlgs_rtARID_DEF.UnitDelay68_DSTATE_n "" UBYTE autosar_swc_rlgs_CM_uint8 0 0 0 255 ECU_ADDRESS 0xfe4afcea /* @ECU_Address@autosar_swc_rlgs_rtARID_DEF.UnitDelay68_DSTATE_n@ */ /end MEASUREMENT
/begin MEASUREMENT autosar_swc_rlgs_rtARID_DEF.UnitDelay6_DSTATE "" FLOAT32_IEEE autosar_swc_rlgs_CM_single 0 0 -3.4E+38 3.4E+38 ECU_ADDRESS 0xfe4af888 /* @ECU_Address@autosar_swc_rlgs_rtARID_DEF.UnitDelay6_DSTATE@ */ /end MEASUREMENT
/begin MEASUREMENT autosar_swc_rlgs_rtARID_DEF.UnitDelay6_DSTATE_b "" FLOAT32_IEEE autosar_swc_rlgs_CM_single 0 0 -3.4E+38 3.4E+38 ECU_ADDRESS 0xfe4af8b8 /* @ECU_Address@autosar_swc_rlgs_rtARID_DEF.UnitDelay6_DSTATE_b@ */ /end MEASUREMENT
/begin MEASUREMENT autosar_swc_rlgs_rtARID_DEF.UnitDelay6_DSTATE_h "" FLOAT32_IEEE autosar_swc_rlgs_CM_single 0 0 -3.4E+38 3.4E+38 ECU_ADDRESS 0xfe4af8e0 /* @ECU_Address@autosar_swc_rlgs_rtARID_DEF.UnitDelay6_DSTATE_h@ */ /end MEASUREMENT
/begin MEASUREMENT autosar_swc_rlgs_rtARID_DEF.UnitDelay6_DSTATE_m "" FLOAT32_IEEE autosar_swc_rlgs_CM_single 0 0 -3.4E+38 3.4E+38 ECU_ADDRESS 0xfe4af89c /* @ECU_Address@autosar_swc_rlgs_rtARID_DEF.UnitDelay6_DSTATE_m@ */ /end MEASUREMENT
/begin MEASUREMENT autosar_swc_rlgs_rtARID_DEF.UnitDelay6_DSTATE_mp "" FLOAT32_IEEE autosar_swc_rlgs_CM_single 0 0 -3.4E+38 3.4E+38 ECU_ADDRESS 0xfe4af900 /* @ECU_Address@autosar_swc_rlgs_rtARID_DEF.UnitDelay6_DSTATE_mp@ */ /end MEASUREMENT
/begin MEASUREMENT autosar_swc_rlgs_rtARID_DEF.UnitDelay75_DSTATE "" FLOAT32_IEEE autosar_swc_rlgs_CM_single 0 0 -3.4E+38 3.4E+38 ECU_ADDRESS 0xfe4af868 /* @ECU_Address@autosar_swc_rlgs_rtARID_DEF.UnitDelay75_DSTATE@ */ /end MEASUREMENT
/begin MEASUREMENT autosar_swc_rlgs_rtARID_DEF.UnitDelay76_DSTATE "" FLOAT32_IEEE autosar_swc_rlgs_CM_single 0 0 -3.4E+38 3.4E+38 ECU_ADDRESS 0xfe4af86c /* @ECU_Address@autosar_swc_rlgs_rtARID_DEF.UnitDelay76_DSTATE@ */ /end MEASUREMENT
/begin MEASUREMENT autosar_swc_rlgs_rtARID_DEF.UnitDelay7_DSTATE_e "" UBYTE autosar_swc_rlgs_CM_logical 0 0 0 1 ECU_ADDRESS 0xfe4afdb1 /* @ECU_Address@autosar_swc_rlgs_rtARID_DEF.UnitDelay7_DSTATE_e@ */ /end MEASUREMENT
/begin MEASUREMENT autosar_swc_rlgs_rtARID_DEF.UnitDelay7_DSTATE_h "" FLOAT32_IEEE autosar_swc_rlgs_CM_single 0 0 -3.4E+38 3.4E+38 ECU_ADDRESS 0xfe4af8bc /* @ECU_Address@autosar_swc_rlgs_rtARID_DEF.UnitDelay7_DSTATE_h@ */ /end MEASUREMENT
/begin MEASUREMENT autosar_swc_rlgs_rtARID_DEF.UnitDelay7_DSTATE_j "" FLOAT32_IEEE autosar_swc_rlgs_CM_single 0 0 -3.4E+38 3.4E+38 ECU_ADDRESS 0xfe4af904 /* @ECU_Address@autosar_swc_rlgs_rtARID_DEF.UnitDelay7_DSTATE_j@ */ /end MEASUREMENT
/begin MEASUREMENT autosar_swc_rlgs_rtARID_DEF.UnitDelay7_DSTATE_m "" FLOAT32_IEEE autosar_swc_rlgs_CM_single 0 0 -3.4E+38 3.4E+38 ECU_ADDRESS 0xfe4af8a0 /* @ECU_Address@autosar_swc_rlgs_rtARID_DEF.UnitDelay7_DSTATE_m@ */ /end MEASUREMENT
/begin MEASUREMENT autosar_swc_rlgs_rtARID_DEF.UnitDelay8_DSTATE "" FLOAT32_IEEE autosar_swc_rlgs_CM_single 0 0 -3.4E+38 3.4E+38 ECU_ADDRESS 0xfe4af880 /* @ECU_Address@autosar_swc_rlgs_rtARID_DEF.UnitDelay8_DSTATE@ */ /end MEASUREMENT
/begin MEASUREMENT autosar_swc_rlgs_rtARID_DEF.UnitDelay91_DSTATE "" UBYTE autosar_swc_rlgs_CM_uint8 0 0 0 255 ECU_ADDRESS 0xfe4afcfe /* @ECU_Address@autosar_swc_rlgs_rtARID_DEF.UnitDelay91_DSTATE@ */ /end MEASUREMENT
/begin MEASUREMENT autosar_swc_rlgs_rtARID_DEF.UnitDelay9_DSTATE "" FLOAT32_IEEE autosar_swc_rlgs_CM_single 0 0 -3.4E+38 3.4E+38 ECU_ADDRESS 0xfe4af88c /* @ECU_Address@autosar_swc_rlgs_rtARID_DEF.UnitDelay9_DSTATE@ */ /end MEASUREMENT
/begin MEASUREMENT autosar_swc_rlgs_rtARID_DEF.UnitDelay9_DSTATE_d "" FLOAT32_IEEE autosar_swc_rlgs_CM_single 0 0 -3.4E+38 3.4E+38 ECU_ADDRESS 0xfe4af8c0 /* @ECU_Address@autosar_swc_rlgs_rtARID_DEF.UnitDelay9_DSTATE_d@ */ /end MEASUREMENT
/begin MEASUREMENT autosar_swc_rlgs_rtARID_DEF.UnitDelay_DSTATE_d "" FLOAT32_IEEE autosar_swc_rlgs_CM_single 0 0 -3.4E+38 3.4E+38 ECU_ADDRESS 0xfe4af8e8 /* @ECU_Address@autosar_swc_rlgs_rtARID_DEF.UnitDelay_DSTATE_d@ */ /end MEASUREMENT
/begin MEASUREMENT autosar_swc_rlgs_rtARID_DEF.UnitDelay_DSTATE_d4 "" UBYTE autosar_swc_rlgs_CM_uint8 0 0 0 255 ECU_ADDRESS 0xfe4afcef /* @ECU_Address@autosar_swc_rlgs_rtARID_DEF.UnitDelay_DSTATE_d4@ */ /end MEASUREMENT
/begin MEASUREMENT autosar_swc_rlgs_rtARID_DEF.UnitDelay_DSTATE_e "" FLOAT32_IEEE autosar_swc_rlgs_CM_single 0 0 -3.4E+38 3.4E+38 ECU_ADDRESS 0xfe4af890 /* @ECU_Address@autosar_swc_rlgs_rtARID_DEF.UnitDelay_DSTATE_e@ */ /end MEASUREMENT
/begin MEASUREMENT autosar_swc_rlgs_rtARID_DEF.UnitDelay_DSTATE_i "" FLOAT32_IEEE autosar_swc_rlgs_CM_single 0 0 -3.4E+38 3.4E+38 ECU_ADDRESS 0xfe4af8e4 /* @ECU_Address@autosar_swc_rlgs_rtARID_DEF.UnitDelay_DSTATE_i@ */ /end MEASUREMENT
/begin MEASUREMENT autosar_swc_rlgs_rtARID_DEF.UnitDelay_DSTATE_js "" FLOAT32_IEEE autosar_swc_rlgs_CM_single 0 0 -3.4E+38 3.4E+38 ECU_ADDRESS 0xfe4af8c8 /* @ECU_Address@autosar_swc_rlgs_rtARID_DEF.UnitDelay_DSTATE_js@ */ /end MEASUREMENT
/begin MEASUREMENT autosar_swc_rlgs_rtARID_DEF.UnitDelay_DSTATE_kn "" UBYTE autosar_swc_rlgs_CM_logical 0 0 0 1 ECU_ADDRESS 0xfe4afdae /* @ECU_Address@autosar_swc_rlgs_rtARID_DEF.UnitDelay_DSTATE_kn@ */ /end MEASUREMENT
/begin MEASUREMENT autosar_swc_rlgs_rtARID_DEF.UnitDelay_DSTATE_lz "" FLOAT32_IEEE autosar_swc_rlgs_CM_single 0 0 -3.4E+38 3.4E+38 ECU_ADDRESS 0xfe4af8c4 /* @ECU_Address@autosar_swc_rlgs_rtARID_DEF.UnitDelay_DSTATE_lz@ */ /end MEASUREMENT
/begin MEASUREMENT autosar_swc_rlgs_rtARID_DEF.Virtually_RightLine_C0 "" FLOAT32_IEEE autosar_swc_rlgs_CM_single 0 0 -3.4E+38 3.4E+38 ECU_ADDRESS 0xfe4afb34 /* @ECU_Address@autosar_swc_rlgs_rtARID_DEF.Virtually_RightLine_C0@ */ /end MEASUREMENT
/begin MEASUREMENT autosar_swc_rlgs_rtARID_DEF.Virtually_RightLine_C0_a "" FLOAT32_IEEE autosar_swc_rlgs_CM_single 0 0 -3.4E+38 3.4E+38 ECU_ADDRESS 0xfe4afbe4 /* @ECU_Address@autosar_swc_rlgs_rtARID_DEF.Virtually_RightLine_C0_a@ */ /end MEASUREMENT
/begin MEASUREMENT autosar_swc_rlgs_rtARID_DEF.Virtually_RightLine_C1 "" FLOAT32_IEEE autosar_swc_rlgs_CM_single 0 0 -3.4E+38 3.4E+38 ECU_ADDRESS 0xfe4afb38 /* @ECU_Address@autosar_swc_rlgs_rtARID_DEF.Virtually_RightLine_C1@ */ /end MEASUREMENT
/begin MEASUREMENT autosar_swc_rlgs_rtARID_DEF.Virtually_RightLine_C1_g "" FLOAT32_IEEE autosar_swc_rlgs_CM_single 0 0 -3.4E+38 3.4E+38 ECU_ADDRESS 0xfe4afbe8 /* @ECU_Address@autosar_swc_rlgs_rtARID_DEF.Virtually_RightLine_C1_g@ */ /end MEASUREMENT
/begin MEASUREMENT autosar_swc_rlgs_rtARID_DEF.Virtually_RightLine_C2 "" FLOAT32_IEEE autosar_swc_rlgs_CM_single 0 0 -3.4E+38 3.4E+38 ECU_ADDRESS 0xfe4afb3c /* @ECU_Address@autosar_swc_rlgs_rtARID_DEF.Virtually_RightLine_C2@ */ /end MEASUREMENT
/begin MEASUREMENT autosar_swc_rlgs_rtARID_DEF.Virtually_RightLine_C2_n "" FLOAT32_IEEE autosar_swc_rlgs_CM_single 0 0 -3.4E+38 3.4E+38 ECU_ADDRESS 0xfe4afbec /* @ECU_Address@autosar_swc_rlgs_rtARID_DEF.Virtually_RightLine_C2_n@ */ /end MEASUREMENT
/begin MEASUREMENT autosar_swc_rlgs_rtARID_DEF.Virtually_RightLine_C3 "" FLOAT32_IEEE autosar_swc_rlgs_CM_single 0 0 -3.4E+38 3.4E+38 ECU_ADDRESS 0xfe4afb40 /* @ECU_Address@autosar_swc_rlgs_rtARID_DEF.Virtually_RightLine_C3@ */ /end MEASUREMENT
/begin MEASUREMENT autosar_swc_rlgs_rtARID_DEF.Virtually_RightLine_C3_k "" FLOAT32_IEEE autosar_swc_rlgs_CM_single 0 0 -3.4E+38 3.4E+38 ECU_ADDRESS 0xfe4afbf0 /* @ECU_Address@autosar_swc_rlgs_rtARID_DEF.Virtually_RightLine_C3_k@ */ /end MEASUREMENT
/begin MEASUREMENT autosar_swc_rlgs_rtARID_DEF.Virtually_RightLine_Range "" FLOAT32_IEEE autosar_swc_rlgs_CM_single 0 0 -3.4E+38 3.4E+38 ECU_ADDRESS 0xfe4afb44 /* @ECU_Address@autosar_swc_rlgs_rtARID_DEF.Virtually_RightLine_Range@ */ /end MEASUREMENT
/begin MEASUREMENT autosar_swc_rlgs_rtARID_DEF.Virtually_RightLine_Range_h "" FLOAT32_IEEE autosar_swc_rlgs_CM_single 0 0 -3.4E+38 3.4E+38 ECU_ADDRESS 0xfe4afbf4 /* @ECU_Address@autosar_swc_rlgs_rtARID_DEF.Virtually_RightLine_Range_h@ */ /end MEASUREMENT
/begin MEASUREMENT autosar_swc_rlgs_rtARID_DEF.Virtually_RightLine_State "" UBYTE autosar_swc_rlgs_CM_uint8 0 0 0 255 ECU_ADDRESS 0xfe4afd5b /* @ECU_Address@autosar_swc_rlgs_rtARID_DEF.Virtually_RightLine_State@ */ /end MEASUREMENT
/begin MEASUREMENT autosar_swc_rlgs_rtARID_DEF.Virtually_RightLine_State_j "" UBYTE autosar_swc_rlgs_CM_uint8 0 0 0 255 ECU_ADDRESS 0xfe4afd76 /* @ECU_Address@autosar_swc_rlgs_rtARID_DEF.Virtually_RightLine_State_j@ */ /end MEASUREMENT
/begin MEASUREMENT autosar_swc_rlgs_rtARID_DEF.YBranchDis "" FLOAT32_IEEE autosar_swc_rlgs_CM_single 0 0 -3.4E+38 3.4E+38 ECU_ADDRESS 0xfe4afba0 /* @ECU_Address@autosar_swc_rlgs_rtARID_DEF.YBranchDis@ */ /end MEASUREMENT
/begin MEASUREMENT autosar_swc_rlgs_rtARID_DEF.YBranchFlag "" UBYTE autosar_swc_rlgs_CM_logical 0 0 0 1 ECU_ADDRESS 0xfe4afdd1 /* @ECU_Address@autosar_swc_rlgs_rtARID_DEF.YBranchFlag@ */ /end MEASUREMENT
/begin MEASUREMENT autosar_swc_rlgs_rtARID_DEF.abandonleft "" UBYTE autosar_swc_rlgs_CM_logical 0 0 0 1 ECU_ADDRESS 0xfe4afdd4 /* @ECU_Address@autosar_swc_rlgs_rtARID_DEF.abandonleft@ */ /end MEASUREMENT
/begin MEASUREMENT autosar_swc_rlgs_rtARID_DEF.abandonright "" UBYTE autosar_swc_rlgs_CM_logical 0 0 0 1 ECU_ADDRESS 0xfe4afdd5 /* @ECU_Address@autosar_swc_rlgs_rtARID_DEF.abandonright@ */ /end MEASUREMENT
/begin MEASUREMENT autosar_swc_rlgs_rtARID_DEF.dopstatusexitK1 "" UBYTE autosar_swc_rlgs_CM_logical 0 0 0 1 ECU_ADDRESS 0xfe4afdc9 /* @ECU_Address@autosar_swc_rlgs_rtARID_DEF.dopstatusexitK1@ */ /end MEASUREMENT
/begin MEASUREMENT autosar_swc_rlgs_rtARID_DEF.doubleLineSelectSts "" UBYTE autosar_swc_rlgs_CM_uint8 0 0 0 255 ECU_ADDRESS 0xfe4afd6b /* @ECU_Address@autosar_swc_rlgs_rtARID_DEF.doubleLineSelectSts@ */ /end MEASUREMENT
/begin MEASUREMENT autosar_swc_rlgs_rtARID_DEF.holddist "" FLOAT32_IEEE autosar_swc_rlgs_CM_single 0 0 -3.4E+38 3.4E+38 ECU_ADDRESS 0xfe4afb30 /* @ECU_Address@autosar_swc_rlgs_rtARID_DEF.holddist@ */ /end MEASUREMENT
/begin MEASUREMENT autosar_swc_rlgs_rtARID_DEF.is_Lcjudge "" UBYTE autosar_swc_rlgs_CM_uint8 0 0 0 255 ECU_ADDRESS 0xfe4afd7f /* @ECU_Address@autosar_swc_rlgs_rtARID_DEF.is_Lcjudge@ */ /end MEASUREMENT
/begin MEASUREMENT autosar_swc_rlgs_rtARID_DEF.is_LeftBranchLineSourceCal "" UBYTE autosar_swc_rlgs_CM_uint8 0 0 0 255 ECU_ADDRESS 0xfe4afd63 /* @ECU_Address@autosar_swc_rlgs_rtARID_DEF.is_LeftBranchLineSourceCal@ */ /end MEASUREMENT
/begin MEASUREMENT autosar_swc_rlgs_rtARID_DEF.is_SplitLineSourceCal "" UBYTE autosar_swc_rlgs_CM_uint8 0 0 0 255 ECU_ADDRESS 0xfe4afd82 /* @ECU_Address@autosar_swc_rlgs_rtARID_DEF.is_SplitLineSourceCal@ */ /end MEASUREMENT
/begin MEASUREMENT autosar_swc_rlgs_rtARID_DEF.is_WaitExitSplit "" UBYTE autosar_swc_rlgs_CM_uint8 0 0 0 255 ECU_ADDRESS 0xfe4afd85 /* @ECU_Address@autosar_swc_rlgs_rtARID_DEF.is_WaitExitSplit@ */ /end MEASUREMENT
/begin MEASUREMENT autosar_swc_rlgs_rtARID_DEF.is_WaitRout "" UBYTE autosar_swc_rlgs_CM_uint8 0 0 0 255 ECU_ADDRESS 0xfe4afd7c /* @ECU_Address@autosar_swc_rlgs_rtARID_DEF.is_WaitRout@ */ /end MEASUREMENT
/begin MEASUREMENT autosar_swc_rlgs_rtARID_DEF.is_active_c24_autosar_swc_rlgs "" UBYTE autosar_swc_rlgs_CM_uint8 0 0 0 255 ECU_ADDRESS 0xfe4afd83 /* @ECU_Address@autosar_swc_rlgs_rtARID_DEF.is_active_c24_autosar_swc_rlgs@ */ /end MEASUREMENT
/begin MEASUREMENT autosar_swc_rlgs_rtARID_DEF.is_active_c32_autosar_swc_rlgs "" UBYTE autosar_swc_rlgs_CM_uint8 0 0 0 255 ECU_ADDRESS 0xfe4afd80 /* @ECU_Address@autosar_swc_rlgs_rtARID_DEF.is_active_c32_autosar_swc_rlgs@ */ /end MEASUREMENT
/begin MEASUREMENT autosar_swc_rlgs_rtARID_DEF.is_active_c33_autosar_swc_rlgs "" UBYTE autosar_swc_rlgs_CM_uint8 0 0 0 255 ECU_ADDRESS 0xfe4afd7d /* @ECU_Address@autosar_swc_rlgs_rtARID_DEF.is_active_c33_autosar_swc_rlgs@ */ /end MEASUREMENT
/begin MEASUREMENT autosar_swc_rlgs_rtARID_DEF.is_active_c34_autosar_swc_rlgs "" UBYTE autosar_swc_rlgs_CM_uint8 0 0 0 255 ECU_ADDRESS 0xfe4afd7a /* @ECU_Address@autosar_swc_rlgs_rtARID_DEF.is_active_c34_autosar_swc_rlgs@ */ /end MEASUREMENT
/begin MEASUREMENT autosar_swc_rlgs_rtARID_DEF.is_active_c43_autosar_swc_rlgs "" UBYTE autosar_swc_rlgs_CM_uint8 0 0 0 255 ECU_ADDRESS 0xfe4afd61 /* @ECU_Address@autosar_swc_rlgs_rtARID_DEF.is_active_c43_autosar_swc_rlgs@ */ /end MEASUREMENT
/begin MEASUREMENT autosar_swc_rlgs_rtARID_DEF.is_c24_autosar_swc_rlgs "" UBYTE autosar_swc_rlgs_CM_uint8 0 0 0 255 ECU_ADDRESS 0xfe4afd84 /* @ECU_Address@autosar_swc_rlgs_rtARID_DEF.is_c24_autosar_swc_rlgs@ */ /end MEASUREMENT
/begin MEASUREMENT autosar_swc_rlgs_rtARID_DEF.is_c32_autosar_swc_rlgs "" UBYTE autosar_swc_rlgs_CM_uint8 0 0 0 255 ECU_ADDRESS 0xfe4afd81 /* @ECU_Address@autosar_swc_rlgs_rtARID_DEF.is_c32_autosar_swc_rlgs@ */ /end MEASUREMENT
/begin MEASUREMENT autosar_swc_rlgs_rtARID_DEF.is_c33_autosar_swc_rlgs "" UBYTE autosar_swc_rlgs_CM_uint8 0 0 0 255 ECU_ADDRESS 0xfe4afd7e /* @ECU_Address@autosar_swc_rlgs_rtARID_DEF.is_c33_autosar_swc_rlgs@ */ /end MEASUREMENT
/begin MEASUREMENT autosar_swc_rlgs_rtARID_DEF.is_c34_autosar_swc_rlgs "" UBYTE autosar_swc_rlgs_CM_uint8 0 0 0 255 ECU_ADDRESS 0xfe4afd7b /* @ECU_Address@autosar_swc_rlgs_rtARID_DEF.is_c34_autosar_swc_rlgs@ */ /end MEASUREMENT
/begin MEASUREMENT autosar_swc_rlgs_rtARID_DEF.is_c43_autosar_swc_rlgs "" UBYTE autosar_swc_rlgs_CM_uint8 0 0 0 255 ECU_ADDRESS 0xfe4afd62 /* @ECU_Address@autosar_swc_rlgs_rtARID_DEF.is_c43_autosar_swc_rlgs@ */ /end MEASUREMENT
/begin MEASUREMENT autosar_swc_rlgs_rtARID_DEF.prey "" FLOAT32_IEEE autosar_swc_rlgs_CM_single 0 0 -3.4E+38 3.4E+38 ECU_ADDRESS 0xfe4afb28 /* @ECU_Address@autosar_swc_rlgs_rtARID_DEF.prey@ */ /end MEASUREMENT
/begin MEASUREMENT autosar_swc_rlgs_rtARID_DEF.stub_end_dis_k1 "" SLONG autosar_swc_rlgs_CM_int32 0 0 -2147483648 2147483647 ECU_ADDRESS 0xfe4afc78 /* @ECU_Address@autosar_swc_rlgs_rtARID_DEF.stub_end_dis_k1@ */ /end MEASUREMENT
/begin MEASUREMENT autosar_swc_rlgs_rtARID_DEF.t_lost_k1 "" FLOAT32_IEEE autosar_swc_rlgs_CM_single 0 0 -3.4E+38 3.4E+38 ECU_ADDRESS 0xfe4afc14 /* @ECU_Address@autosar_swc_rlgs_rtARID_DEF.t_lost_k1@ */ /end MEASUREMENT
/begin MEASUREMENT autosar_swc_rlgs_rtARID_DEF.theta "" FLOAT32_IEEE autosar_swc_rlgs_CM_single 0 0 -3.4E+38 3.4E+38 ECU_ADDRESS 0xfe4afb24 /* @ECU_Address@autosar_swc_rlgs_rtARID_DEF.theta@ */ /end MEASUREMENT
/begin AXIS_PTS P_PG_LineRangeForWeight "" 0xfe821d8c /* @ECU_Address@P_PG_LineRangeForWeight@ */ NO_INPUT_QUANTITY Axis_FLOAT32_IEEE 0 autosar_swc_rlgs_CM_single 9 -3.4E+38 3.4E+38 /end AXIS_PTS
/begin AXIS_PTS P_PG_VehSpdForLineWeight "" 0xfe821d7c /* @ECU_Address@P_PG_VehSpdForLineWeight@ */ NO_INPUT_QUANTITY Axis_FLOAT32_IEEE 0 autosar_swc_rlgs_CM_single 4 -3.4E+38 3.4E+38 /end AXIS_PTS
/begin COMPU_METHOD autosar_swc_rlgs_CM_SM_MODULE_STATUS "Enumerated data type: SM_MODULE_STATUS" TAB_VERB "%0.6" "" COMPU_TAB_REF VTAB_FOR_autosar_swc_rlgs_CM_SM_MODULE_STATUS /end COMPU_METHOD
/begin COMPU_VTAB VTAB_FOR_autosar_swc_rlgs_CM_SM_MODULE_STATUS "Enumerated data type: SM_MODULE_STATUS" TAB_VERB 4 0 "STATUS_NORMAL" 1 "STATUS_NOT_CONNECTED" 2 "STATUS_HEARTBEAT_MISSED" 3 "STATUS_ABNORMAL" /end COMPU_VTAB
/begin COMPU_METHOD autosar_swc_rlgs_CM_boolean "Q = V" IDENTICAL "%1.0" "" /end COMPU_METHOD
/begin COMPU_METHOD autosar_swc_rlgs_CM_double "Q = V" IDENTICAL "%15.10" "" /end COMPU_METHOD
/begin COMPU_METHOD autosar_swc_rlgs_CM_int16 "Q = V" IDENTICAL "%5.0" "" /end COMPU_METHOD
/begin COMPU_METHOD autosar_swc_rlgs_CM_int32 "Q = V" IDENTICAL "%10.0" "" /end COMPU_METHOD
/begin COMPU_METHOD autosar_swc_rlgs_CM_logical "Q = V" IDENTICAL "%1.0" "" /end COMPU_METHOD
/begin COMPU_METHOD autosar_swc_rlgs_CM_single "Q = V" IDENTICAL "%8.6" "" /end COMPU_METHOD
/begin COMPU_METHOD autosar_swc_rlgs_CM_uint16 "Q = V" IDENTICAL "%5.0" "" /end COMPU_METHOD
/begin COMPU_METHOD autosar_swc_rlgs_CM_uint32 "Q = V" IDENTICAL "%10.0" "" /end COMPU_METHOD
/begin COMPU_METHOD autosar_swc_rlgs_CM_uint8 "Q = V" IDENTICAL "%3.0" "" /end COMPU_METHOD
/begin RECORD_LAYOUT Record_BOOLEAN FNC_VALUES 1 UBYTE COLUMN_DIR DIRECT /end RECORD_LAYOUT
/begin RECORD_LAYOUT Record_FLOAT32_IEEE FNC_VALUES 1 FLOAT32_IEEE COLUMN_DIR DIRECT /end RECORD_LAYOUT
/begin RECORD_LAYOUT Record_FLOAT64_IEEE FNC_VALUES 1 FLOAT64_IEEE COLUMN_DIR DIRECT /end RECORD_LAYOUT
/begin RECORD_LAYOUT Record_SLONG FNC_VALUES 1 SLONG COLUMN_DIR DIRECT /end RECORD_LAYOUT
/begin RECORD_LAYOUT Record_SWORD FNC_VALUES 1 SWORD COLUMN_DIR DIRECT /end RECORD_LAYOUT
/begin RECORD_LAYOUT Record_UBYTE FNC_VALUES 1 UBYTE COLUMN_DIR DIRECT /end RECORD_LAYOUT
/begin RECORD_LAYOUT Record_UWORD FNC_VALUES 1 UWORD COLUMN_DIR DIRECT /end RECORD_LAYOUT
/begin RECORD_LAYOUT Axis_FLOAT32_IEEE AXIS_PTS_X 1 FLOAT32_IEEE INDEX_INCR DIRECT /end RECORD_LAYOUT
/begin GROUP SwcOut_RLGS_EVM_LANE[1].right_constraint "" /begin SUB_GROUP SwcOut_RLGS_EVM_LANE[1].right_constraint.curve /end SUB_GROUP
 /begin REF_MEASUREMENT SwcOut_RLGS_EVM_LANE[1].right_constraint.constraint_type SwcOut_RLGS_EVM_LANE[1].right_constraint.constraint_type_ahead SwcOut_RLGS_EVM_LANE[1].right_constraint.source_type SwcOut_RLGS_EVM_LANE[1].right_constraint.meas_state SwcOut_RLGS_EVM_LANE[1].right_constraint.constraint_type_change_point_dx SwcOut_RLGS_EVM_LANE[1].right_constraint.visible_end SwcOut_RLGS_EVM_LANE[1].right_constraint.id /end REF_MEASUREMENT
/end GROUP
/begin GROUP SwcOut_RLGS_EVM_LANE[1].right_constraint.curve ""
 /begin REF_MEASUREMENT SwcOut_RLGS_EVM_LANE[1].right_constraint.curve.start SwcOut_RLGS_EVM_LANE[1].right_constraint.curve.end SwcOut_RLGS_EVM_LANE[1].right_constraint.curve.poly_vec /end REF_MEASUREMENT
/end GROUP
/begin GROUP SwcOut_RLGS_EVM_LANE[2] ""
 /begin SUB_GROUP SwcOut_RLGS_EVM_LANE[2].left_constraint SwcOut_RLGS_EVM_LANE[2].right_constraint SwcOut_RLGS_EVM_LANE[2].center_refline /end SUB_GROUP
 /begin REF_MEASUREMENT SwcOut_RLGS_EVM_LANE[2].type SwcOut_RLGS_EVM_LANE[2].lane_source SwcOut_RLGS_EVM_LANE[2].lane_extension_type SwcOut_RLGS_EVM_LANE[2].arrow_dir SwcOut_RLGS_EVM_LANE[2].current_width SwcOut_RLGS_EVM_LANE[2].end_dist SwcOut_RLGS_EVM_LANE[2].id /end REF_MEASUREMENT
/end GROUP
/begin GROUP SwcOut_RLGS_EVM_LANE[2].center_refline "" /begin SUB_GROUP SwcOut_RLGS_EVM_LANE[2].center_refline.curve /end SUB_GROUP
 /begin REF_MEASUREMENT SwcOut_RLGS_EVM_LANE[2].center_refline.ref_source SwcOut_RLGS_EVM_LANE[2].center_refline.calc_state SwcOut_RLGS_EVM_LANE[2].center_refline.id /end REF_MEASUREMENT
/end GROUP
/begin GROUP SwcOut_RLGS_EVM_LANE[2].center_refline.curve ""
 /begin REF_MEASUREMENT SwcOut_RLGS_EVM_LANE[2].center_refline.curve.start SwcOut_RLGS_EVM_LANE[2].center_refline.curve.end SwcOut_RLGS_EVM_LANE[2].center_refline.curve.poly_vec /end REF_MEASUREMENT
/end GROUP
/begin GROUP SwcOut_RLGS_EVM_LANE[2].left_constraint "" /begin SUB_GROUP SwcOut_RLGS_EVM_LANE[2].left_constraint.curve /end SUB_GROUP
 /begin REF_MEASUREMENT SwcOut_RLGS_EVM_LANE[2].left_constraint.constraint_type SwcOut_RLGS_EVM_LANE[2].left_constraint.constraint_type_ahead SwcOut_RLGS_EVM_LANE[2].left_constraint.source_type SwcOut_RLGS_EVM_LANE[2].left_constraint.meas_state SwcOut_RLGS_EVM_LANE[2].left_constraint.constraint_type_change_point_dx SwcOut_RLGS_EVM_LANE[2].left_constraint.visible_end SwcOut_RLGS_EVM_LANE[2].left_constraint.id /end REF_MEASUREMENT
/end GROUP
/begin GROUP SwcOut_RLGS_EVM_LANE[2].left_constraint.curve ""
 /begin REF_MEASUREMENT SwcOut_RLGS_EVM_LANE[2].left_constraint.curve.start SwcOut_RLGS_EVM_LANE[2].left_constraint.curve.end SwcOut_RLGS_EVM_LANE[2].left_constraint.curve.poly_vec /end REF_MEASUREMENT
/end GROUP
/begin GROUP SwcOut_RLGS_EVM_LANE[2].right_constraint "" /begin SUB_GROUP SwcOut_RLGS_EVM_LANE[2].right_constraint.curve /end SUB_GROUP
 /begin REF_MEASUREMENT SwcOut_RLGS_EVM_LANE[2].right_constraint.constraint_type SwcOut_RLGS_EVM_LANE[2].right_constraint.constraint_type_ahead SwcOut_RLGS_EVM_LANE[2].right_constraint.source_type SwcOut_RLGS_EVM_LANE[2].right_constraint.meas_state SwcOut_RLGS_EVM_LANE[2].right_constraint.constraint_type_change_point_dx SwcOut_RLGS_EVM_LANE[2].right_constraint.visible_end SwcOut_RLGS_EVM_LANE[2].right_constraint.id /end REF_MEASUREMENT
/end GROUP
/begin GROUP SwcOut_RLGS_EVM_LANE[2].right_constraint.curve ""
 /begin REF_MEASUREMENT SwcOut_RLGS_EVM_LANE[2].right_constraint.curve.start SwcOut_RLGS_EVM_LANE[2].right_constraint.curve.end SwcOut_RLGS_EVM_LANE[2].right_constraint.curve.poly_vec /end REF_MEASUREMENT
/end GROUP
/begin GROUP SwcOut_RLGS_EVM_LANE[3] ""
 /begin SUB_GROUP SwcOut_RLGS_EVM_LANE[3].left_constraint SwcOut_RLGS_EVM_LANE[3].right_constraint SwcOut_RLGS_EVM_LANE[3].center_refline /end SUB_GROUP
 /begin REF_MEASUREMENT SwcOut_RLGS_EVM_LANE[3].type SwcOut_RLGS_EVM_LANE[3].lane_source SwcOut_RLGS_EVM_LANE[3].lane_extension_type SwcOut_RLGS_EVM_LANE[3].arrow_dir SwcOut_RLGS_EVM_LANE[3].current_width SwcOut_RLGS_EVM_LANE[3].end_dist SwcOut_RLGS_EVM_LANE[3].id /end REF_MEASUREMENT
/end GROUP
/begin GROUP SwcOut_RLGS_EVM_LANE[3].center_refline "" /begin SUB_GROUP SwcOut_RLGS_EVM_LANE[3].center_refline.curve /end SUB_GROUP
 /begin REF_MEASUREMENT SwcOut_RLGS_EVM_LANE[3].center_refline.ref_source SwcOut_RLGS_EVM_LANE[3].center_refline.calc_state SwcOut_RLGS_EVM_LANE[3].center_refline.id /end REF_MEASUREMENT
/end GROUP
/begin GROUP SwcOut_RLGS_EVM_LANE[3].center_refline.curve ""
 /begin REF_MEASUREMENT SwcOut_RLGS_EVM_LANE[3].center_refline.curve.start SwcOut_RLGS_EVM_LANE[3].center_refline.curve.end SwcOut_RLGS_EVM_LANE[3].center_refline.curve.poly_vec /end REF_MEASUREMENT
/end GROUP
/begin GROUP SwcOut_RLGS_EVM_LANE[3].left_constraint "" /begin SUB_GROUP SwcOut_RLGS_EVM_LANE[3].left_constraint.curve /end SUB_GROUP
 /begin REF_MEASUREMENT SwcOut_RLGS_EVM_LANE[3].left_constraint.constraint_type SwcOut_RLGS_EVM_LANE[3].left_constraint.constraint_type_ahead SwcOut_RLGS_EVM_LANE[3].left_constraint.source_type SwcOut_RLGS_EVM_LANE[3].left_constraint.meas_state SwcOut_RLGS_EVM_LANE[3].left_constraint.constraint_type_change_point_dx SwcOut_RLGS_EVM_LANE[3].left_constraint.visible_end SwcOut_RLGS_EVM_LANE[3].left_constraint.id /end REF_MEASUREMENT
/end GROUP
/begin GROUP SwcOut_RLGS_EVM_LANE[3].left_constraint.curve ""
 /begin REF_MEASUREMENT SwcOut_RLGS_EVM_LANE[3].left_constraint.curve.start SwcOut_RLGS_EVM_LANE[3].left_constraint.curve.end SwcOut_RLGS_EVM_LANE[3].left_constraint.curve.poly_vec /end REF_MEASUREMENT
/end GROUP
/begin GROUP SwcOut_RLGS_EVM_LANE[3].right_constraint "" /begin SUB_GROUP SwcOut_RLGS_EVM_LANE[3].right_constraint.curve /end SUB_GROUP
 /begin REF_MEASUREMENT SwcOut_RLGS_EVM_LANE[3].right_constraint.constraint_type SwcOut_RLGS_EVM_LANE[3].right_constraint.constraint_type_ahead SwcOut_RLGS_EVM_LANE[3].right_constraint.source_type SwcOut_RLGS_EVM_LANE[3].right_constraint.meas_state SwcOut_RLGS_EVM_LANE[3].right_constraint.constraint_type_change_point_dx SwcOut_RLGS_EVM_LANE[3].right_constraint.visible_end SwcOut_RLGS_EVM_LANE[3].right_constraint.id /end REF_MEASUREMENT
/end GROUP
/begin GROUP SwcOut_RLGS_EVM_LANE[3].right_constraint.curve ""
 /begin REF_MEASUREMENT SwcOut_RLGS_EVM_LANE[3].right_constraint.curve.start SwcOut_RLGS_EVM_LANE[3].right_constraint.curve.end SwcOut_RLGS_EVM_LANE[3].right_constraint.curve.poly_vec /end REF_MEASUREMENT
/end GROUP
/begin GROUP SwcOut_RLGS_EVM_LANE[4] ""
 /begin SUB_GROUP SwcOut_RLGS_EVM_LANE[4].left_constraint SwcOut_RLGS_EVM_LANE[4].right_constraint SwcOut_RLGS_EVM_LANE[4].center_refline /end SUB_GROUP
 /begin REF_MEASUREMENT SwcOut_RLGS_EVM_LANE[4].type SwcOut_RLGS_EVM_LANE[4].lane_source SwcOut_RLGS_EVM_LANE[4].lane_extension_type SwcOut_RLGS_EVM_LANE[4].arrow_dir SwcOut_RLGS_EVM_LANE[4].current_width SwcOut_RLGS_EVM_LANE[4].end_dist SwcOut_RLGS_EVM_LANE[4].id /end REF_MEASUREMENT
/end GROUP
/begin GROUP SwcOut_RLGS_EVM_LANE[4].center_refline "" /begin SUB_GROUP SwcOut_RLGS_EVM_LANE[4].center_refline.curve /end SUB_GROUP
 /begin REF_MEASUREMENT SwcOut_RLGS_EVM_LANE[4].center_refline.ref_source SwcOut_RLGS_EVM_LANE[4].center_refline.calc_state SwcOut_RLGS_EVM_LANE[4].center_refline.id /end REF_MEASUREMENT
/end GROUP
/begin GROUP SwcOut_RLGS_EVM_LANE[4].center_refline.curve ""
 /begin REF_MEASUREMENT SwcOut_RLGS_EVM_LANE[4].center_refline.curve.start SwcOut_RLGS_EVM_LANE[4].center_refline.curve.end SwcOut_RLGS_EVM_LANE[4].center_refline.curve.poly_vec /end REF_MEASUREMENT
/end GROUP
/begin GROUP SwcOut_RLGS_EVM_LANE[4].left_constraint "" /begin SUB_GROUP SwcOut_RLGS_EVM_LANE[4].left_constraint.curve /end SUB_GROUP
 /begin REF_MEASUREMENT SwcOut_RLGS_EVM_LANE[4].left_constraint.constraint_type SwcOut_RLGS_EVM_LANE[4].left_constraint.constraint_type_ahead SwcOut_RLGS_EVM_LANE[4].left_constraint.source_type SwcOut_RLGS_EVM_LANE[4].left_constraint.meas_state SwcOut_RLGS_EVM_LANE[4].left_constraint.constraint_type_change_point_dx SwcOut_RLGS_EVM_LANE[4].left_constraint.visible_end SwcOut_RLGS_EVM_LANE[4].left_constraint.id /end REF_MEASUREMENT
/end GROUP
/begin GROUP SwcOut_RLGS_EVM_LANE[4].left_constraint.curve ""
 /begin REF_MEASUREMENT SwcOut_RLGS_EVM_LANE[4].left_constraint.curve.start SwcOut_RLGS_EVM_LANE[4].left_constraint.curve.end SwcOut_RLGS_EVM_LANE[4].left_constraint.curve.poly_vec /end REF_MEASUREMENT
/end GROUP
/begin GROUP SwcOut_RLGS_EVM_LANE[4].right_constraint "" /begin SUB_GROUP SwcOut_RLGS_EVM_LANE[4].right_constraint.curve /end SUB_GROUP
 /begin REF_MEASUREMENT SwcOut_RLGS_EVM_LANE[4].right_constraint.constraint_type SwcOut_RLGS_EVM_LANE[4].right_constraint.constraint_type_ahead SwcOut_RLGS_EVM_LANE[4].right_constraint.source_type SwcOut_RLGS_EVM_LANE[4].right_constraint.meas_state SwcOut_RLGS_EVM_LANE[4].right_constraint.constraint_type_change_point_dx SwcOut_RLGS_EVM_LANE[4].right_constraint.visible_end SwcOut_RLGS_EVM_LANE[4].right_constraint.id /end REF_MEASUREMENT
/end GROUP
/begin GROUP SwcOut_RLGS_EVM_LANE[4].right_constraint.curve ""
 /begin REF_MEASUREMENT SwcOut_RLGS_EVM_LANE[4].right_constraint.curve.start SwcOut_RLGS_EVM_LANE[4].right_constraint.curve.end SwcOut_RLGS_EVM_LANE[4].right_constraint.curve.poly_vec /end REF_MEASUREMENT
/end GROUP
/begin GROUP SwcOut_RLGS_EVM_LANE[5] ""
 /begin SUB_GROUP SwcOut_RLGS_EVM_LANE[5].left_constraint SwcOut_RLGS_EVM_LANE[5].right_constraint SwcOut_RLGS_EVM_LANE[5].center_refline /end SUB_GROUP
 /begin REF_MEASUREMENT SwcOut_RLGS_EVM_LANE[5].type SwcOut_RLGS_EVM_LANE[5].lane_source SwcOut_RLGS_EVM_LANE[5].lane_extension_type SwcOut_RLGS_EVM_LANE[5].arrow_dir SwcOut_RLGS_EVM_LANE[5].current_width SwcOut_RLGS_EVM_LANE[5].end_dist SwcOut_RLGS_EVM_LANE[5].id /end REF_MEASUREMENT
/end GROUP
/begin GROUP SwcOut_RLGS_EVM_LANE[5].center_refline "" /begin SUB_GROUP SwcOut_RLGS_EVM_LANE[5].center_refline.curve /end SUB_GROUP
 /begin REF_MEASUREMENT SwcOut_RLGS_EVM_LANE[5].center_refline.ref_source SwcOut_RLGS_EVM_LANE[5].center_refline.calc_state SwcOut_RLGS_EVM_LANE[5].center_refline.id /end REF_MEASUREMENT
/end GROUP
/begin GROUP SwcOut_RLGS_EVM_LANE[5].center_refline.curve ""
 /begin REF_MEASUREMENT SwcOut_RLGS_EVM_LANE[5].center_refline.curve.start SwcOut_RLGS_EVM_LANE[5].center_refline.curve.end SwcOut_RLGS_EVM_LANE[5].center_refline.curve.poly_vec /end REF_MEASUREMENT
/end GROUP
/begin GROUP SwcOut_RLGS_EVM_LANE[5].left_constraint "" /begin SUB_GROUP SwcOut_RLGS_EVM_LANE[5].left_constraint.curve /end SUB_GROUP
 /begin REF_MEASUREMENT SwcOut_RLGS_EVM_LANE[5].left_constraint.constraint_type SwcOut_RLGS_EVM_LANE[5].left_constraint.constraint_type_ahead SwcOut_RLGS_EVM_LANE[5].left_constraint.source_type SwcOut_RLGS_EVM_LANE[5].left_constraint.meas_state SwcOut_RLGS_EVM_LANE[5].left_constraint.constraint_type_change_point_dx SwcOut_RLGS_EVM_LANE[5].left_constraint.visible_end SwcOut_RLGS_EVM_LANE[5].left_constraint.id /end REF_MEASUREMENT
/end GROUP
/begin GROUP SwcOut_RLGS_EVM_LANE[5].left_constraint.curve ""
 /begin REF_MEASUREMENT SwcOut_RLGS_EVM_LANE[5].left_constraint.curve.start SwcOut_RLGS_EVM_LANE[5].left_constraint.curve.end SwcOut_RLGS_EVM_LANE[5].left_constraint.curve.poly_vec /end REF_MEASUREMENT
/end GROUP
/begin GROUP SwcOut_RLGS_EVM_LANE[5].right_constraint "" /begin SUB_GROUP SwcOut_RLGS_EVM_LANE[5].right_constraint.curve /end SUB_GROUP
 /begin REF_MEASUREMENT SwcOut_RLGS_EVM_LANE[5].right_constraint.constraint_type SwcOut_RLGS_EVM_LANE[5].right_constraint.constraint_type_ahead SwcOut_RLGS_EVM_LANE[5].right_constraint.source_type SwcOut_RLGS_EVM_LANE[5].right_constraint.meas_state SwcOut_RLGS_EVM_LANE[5].right_constraint.constraint_type_change_point_dx SwcOut_RLGS_EVM_LANE[5].right_constraint.visible_end SwcOut_RLGS_EVM_LANE[5].right_constraint.id /end REF_MEASUREMENT
/end GROUP
/begin GROUP SwcOut_RLGS_EVM_LANE[5].right_constraint.curve ""
 /begin REF_MEASUREMENT SwcOut_RLGS_EVM_LANE[5].right_constraint.curve.start SwcOut_RLGS_EVM_LANE[5].right_constraint.curve.end SwcOut_RLGS_EVM_LANE[5].right_constraint.curve.poly_vec /end REF_MEASUREMENT
/end GROUP
/begin GROUP SwcOut_RLGS_EVM_PILOT_SCEN ""
 /begin REF_MEASUREMENT SwcOut_RLGS_EVM_PILOT_SCEN.noa_enter_dist_valid SwcOut_RLGS_EVM_PILOT_SCEN.noa_remaining_dist_end_type SwcOut_RLGS_EVM_PILOT_SCEN.noa_remaining_dist SwcOut_RLGS_EVM_PILOT_SCEN.noa_enter_dist SwcOut_RLGS_EVM_PILOT_SCEN.cur_step_id /end REF_MEASUREMENT
/end GROUP
/begin GROUP SwcOut_RLGS_EVM_PILOT_SCEN.scenario_vec[0] ""
 /begin REF_MEASUREMENT SwcOut_RLGS_EVM_PILOT_SCEN.scenario_vec[0].main_road_type SwcOut_RLGS_EVM_PILOT_SCEN.scenario_vec[0].sub_road_type SwcOut_RLGS_EVM_PILOT_SCEN.scenario_vec[0].behavior_road SwcOut_RLGS_EVM_PILOT_SCEN.scenario_vec[0].behavior_lane SwcOut_RLGS_EVM_PILOT_SCEN.scenario_vec[0].exec_start_dist /end REF_MEASUREMENT
/end GROUP
/begin GROUP SwcOut_RLGS_EVM_ROAD ""
 /begin SUB_GROUP SwcOut_RLGS_EVM_ROAD.left_boundary SwcOut_RLGS_EVM_ROAD.right_boundary SwcOut_RLGS_EVM_ROAD.road_curve /end SUB_GROUP
/end GROUP
/begin GROUP SwcOut_RLGS_EVM_ROAD.left_boundary "" /begin SUB_GROUP SwcOut_RLGS_EVM_ROAD.left_boundary.curve /end SUB_GROUP
 /begin REF_MEASUREMENT SwcOut_RLGS_EVM_ROAD.left_boundary.constraint_type SwcOut_RLGS_EVM_ROAD.left_boundary.constraint_type_ahead SwcOut_RLGS_EVM_ROAD.left_boundary.source_type SwcOut_RLGS_EVM_ROAD.left_boundary.meas_state SwcOut_RLGS_EVM_ROAD.left_boundary.constraint_type_change_point_dx SwcOut_RLGS_EVM_ROAD.left_boundary.visible_end SwcOut_RLGS_EVM_ROAD.left_boundary.id /end REF_MEASUREMENT
/end GROUP
/begin GROUP SwcOut_RLGS_EVM_ROAD.left_boundary.curve ""
 /begin REF_MEASUREMENT SwcOut_RLGS_EVM_ROAD.left_boundary.curve.start SwcOut_RLGS_EVM_ROAD.left_boundary.curve.end SwcOut_RLGS_EVM_ROAD.left_boundary.curve.poly_vec /end REF_MEASUREMENT
/end GROUP
/begin GROUP SwcOut_RLGS_EVM_ROAD.right_boundary "" /begin SUB_GROUP SwcOut_RLGS_EVM_ROAD.right_boundary.curve /end SUB_GROUP
 /begin REF_MEASUREMENT SwcOut_RLGS_EVM_ROAD.right_boundary.constraint_type SwcOut_RLGS_EVM_ROAD.right_boundary.constraint_type_ahead SwcOut_RLGS_EVM_ROAD.right_boundary.source_type SwcOut_RLGS_EVM_ROAD.right_boundary.meas_state SwcOut_RLGS_EVM_ROAD.right_boundary.constraint_type_change_point_dx SwcOut_RLGS_EVM_ROAD.right_boundary.visible_end SwcOut_RLGS_EVM_ROAD.right_boundary.id /end REF_MEASUREMENT
/end GROUP
/begin GROUP SwcOut_RLGS_EVM_ROAD.right_boundary.curve ""
 /begin REF_MEASUREMENT SwcOut_RLGS_EVM_ROAD.right_boundary.curve.start SwcOut_RLGS_EVM_ROAD.right_boundary.curve.end SwcOut_RLGS_EVM_ROAD.right_boundary.curve.poly_vec /end REF_MEASUREMENT
/end GROUP
/begin GROUP SwcOut_RLGS_EVM_ROAD.road_curve ""
 /begin REF_MEASUREMENT SwcOut_RLGS_EVM_ROAD.road_curve.curve_valid_num SwcOut_RLGS_EVM_ROAD.road_curve.curve_value SwcOut_RLGS_EVM_ROAD.road_curve.curve_dis /end REF_MEASUREMENT
/end GROUP
/begin GROUP SwcOut_RLGS_EVM_TSR_SPL ""
 /begin REF_MEASUREMENT SwcOut_RLGS_EVM_TSR_SPL.TSR_GiveWay SwcOut_RLGS_EVM_TSR_SPL.TSR_LongTimeDisplay SwcOut_RLGS_EVM_TSR_SPL.TSR_Forbidden SwcOut_RLGS_EVM_TSR_SPL.TSR_SPL SwcOut_RLGS_EVM_TSR_SPL.NavStatus SwcOut_RLGS_EVM_TSR_SPL.Fusion_SPL SwcOut_RLGS_EVM_TSR_SPL.ElecEye_SPL SwcOut_RLGS_EVM_TSR_SPL.ElecEye_SPL_Dis SwcOut_RLGS_EVM_TSR_SPL.Map_Ramp_SPL SwcOut_RLGS_EVM_TSR_SPL.Map_Ramp_Dis SwcOut_RLGS_EVM_TSR_SPL.Map_SPL SwcOut_RLGS_EVM_TSR_SPL.Map_SPL_Dis /end REF_MEASUREMENT
/end GROUP
/begin GROUP SwcOut_RLGS_Herbeat_Info ""
 /begin REF_MEASUREMENT SwcOut_RLGS_Herbeat_Info.swc_id SwcOut_RLGS_Herbeat_Info.sequence_num SwcOut_RLGS_Herbeat_Info.inner_error SwcOut_RLGS_Herbeat_Info.module_status /end REF_MEASUREMENT
/end GROUP
/begin GROUP ZDrive_BSW_Cal_Cal "" /begin SUB_GROUP ZDrive_BSW_Cal_Cal.ZDrive_BSW_Cal_VehicleInfomationTable /end SUB_GROUP /end GROUP
/begin GROUP autosar_swc_rlgs "autosar_swc_rlgs" ROOT
 /begin SUB_GROUP RLGS_ExecTimestamp SwcOut_RLGS_EVM_DECS SwcOut_RLGS_EVM_LANE SwcOut_RLGS_EVM_PILOT_SCEN SwcOut_RLGS_EVM_ROAD SwcOut_RLGS_EVM_TSR_SPL SwcOut_RLGS_Herbeat_Info autosar_swc_rlgs_rtARID_DEF.UnitDelay1_DSTATE_o autosar_swc_rlgs_rtARID_DEF.UnitDelay2_DSTATE autosar_swc_rlgs_rtARID_DEF.UnitDelay4_DSTATE autosar_swc_rlgs_rtARID_DEF.UnitDelay_DSTATE_n autosar_swc_rlgs_autosar_swc_rlgs_Step_sys /end SUB_GROUP
/end GROUP
/begin GROUP autosar_swc_rlgs_autosar_swc_rlgs_Step_sys "autosar_swc_rlgs/autosar_swc_rlgs_Step_sys" /begin SUB_GROUP autosar_swc_rlgs_autosar_swc_rlgs_Step_sys_rlgs1 /end SUB_GROUP /begin REF_MEASUREMENT RLGS_Version SwcOut_RLGS_EVM_HMI_Info /end REF_MEASUREMENT /end GROUP
/begin GROUP autosar_swc_rlgs_autosar_swc_rlgs_Step_sys_rlgs1 "autosar_swc_rlgs/autosar_swc_rlgs_Step_sys/rlgs1"
 /begin SUB_GROUP autosar_swc_rlgs_autosar_swc_rlgs_Step_sys_rlgs1_Subsystem autosar_swc_rlgs_autosar_swc_rlgs_Step_sys_rlgs1_Subsystem1 autosar_swc_rlgs_autosar_swc_rlgs_Step_sys_rlgs1_Subsystem3 autosar_swc_rlgs_autosar_swc_rlgs_Step_sys_rlgs1_Subsystem5 autosar_swc_rlgs_autosar_swc_rlgs_Step_sys_rlgs1_Subsystem6 autosar_swc_rlgs_autosar_swc_rlgs_Step_sys_rlgs1_alc1 /end SUB_GROUP
/end GROUP
/begin GROUP autosar_swc_rlgs_autosar_swc_rlgs_Step_sys_rlgs1_Subsystem "autosar_swc_rlgs/autosar_swc_rlgs_Step_sys/rlgs1/Subsystem" /begin REF_CHARACTERISTIC P_PSM_J3TFCSw /end REF_CHARACTERISTIC /end GROUP
/begin GROUP autosar_swc_rlgs_autosar_swc_rlgs_Step_sys_rlgs1_Subsystem1 "autosar_swc_rlgs/autosar_swc_rlgs_Step_sys/rlgs1/Subsystem1"
 /begin SUB_GROUP autosar_swc_rlgs_autosar_swc_rlgs_Step_sys_rlgs1_Subsystem1_DetectChange1 autosar_swc_rlgs_autosar_swc_rlgs_Step_sys_rlgs1_Subsystem1_NearLineJudge1 autosar_swc_rlgs_autosar_swc_rlgs_Step_sys_rlgs1_Subsystem1_Subsystem1 autosar_swc_rlgs_autosar_swc_rlgs_Step_sys_rlgs1_Subsystem1_Subsystem17 /end SUB_GROUP
/end GROUP
/begin GROUP autosar_swc_rlgs_autosar_swc_rlgs_Step_sys_rlgs1_Subsystem1_DetectChange1 "autosar_swc_rlgs/autosar_swc_rlgs_Step_sys/rlgs1/Subsystem1/DetectChange1"
 /begin SUB_GROUP autosar_swc_rlgs_autosar_swc_rlgs_Step_sys_rlgs1_Subsystem1_DetectChange1_Compare_To_Constant /end SUB_GROUP
 /begin REF_MEASUREMENT PG_J3_Update autosar_swc_rlgs_rtARID_DEF.UnitDelay68_DSTATE_n /end REF_MEASUREMENT
/end GROUP
/begin GROUP autosar_swc_rlgs_autosar_swc_rlgs_Step_sys_rlgs1_Subsystem1_DetectChange1_Compare_To_Constant "autosar_swc_rlgs/autosar_swc_rlgs_Step_sys/rlgs1/Subsystem1/DetectChange1/Compare\nTo Constant" /begin REF_CHARACTERISTIC P_PG_LAndRLineC0Err /end REF_CHARACTERISTIC /end GROUP
/begin GROUP autosar_swc_rlgs_autosar_swc_rlgs_Step_sys_rlgs1_Subsystem1_NearLineJudge1 "autosar_swc_rlgs/autosar_swc_rlgs_Step_sys/rlgs1/Subsystem1/NearLineJudge1"
 /begin REF_CHARACTERISTIC P_ALC_OutLinePolyfitSwitch P_PG_L1SwitchL2Sw P_PG_L2LatDisThresHold P_PG_MinLatDisLimitForL2SwL1 P_PG_StepTime /end REF_CHARACTERISTIC
 /begin REF_MEASUREMENT RLGS_PG_L1NatureSts RLGS_PG_LaneSplitSts RLGS_PG_R1NatureSts autosar_swc_rlgs_rtARID_DEF.LaneSplitStsL_KeepDis autosar_swc_rlgs_rtARID_DEF.LaneSplitStsR_KeepDis autosar_swc_rlgs_rtARID_DEF.R1_TrackID autosar_swc_rlgs_rtARID_DEF.R1_bIsLineExist autosar_swc_rlgs_rtARID_DEF.TmpSignalConversionAtvxvRefMsOutport1 autosar_swc_rlgs_rtARID_DEF.abandonleft autosar_swc_rlgs_rtARID_DEF.abandonright /end REF_MEASUREMENT
/end GROUP
/begin GROUP autosar_swc_rlgs_autosar_swc_rlgs_Step_sys_rlgs1_Subsystem1_Subsystem1 "autosar_swc_rlgs/autosar_swc_rlgs_Step_sys/rlgs1/Subsystem1/Subsystem1"
 /begin REF_MEASUREMENT PG_HPPLineModel_First_C0 PG_HPPLineModel_First_C1 PG_HPPLineModel_First_C2 PG_HPPLineModel_First_C3 PG_HPPLineModel_Second_C0 PG_HPPLineModel_Second_C1 PG_HPPLineModel_Second_C2 PG_HPPLineModel_Second_C3 PG_HPPLineModel_Third_C0 PG_HPPLineModel_Third_C1 PG_HPPLineModel_Third_C2 PG_HPPLineModel_Third_C3 PG_HPPLine_Confidence PG_HPPLine_First_Valid PG_HPPLine_Half_Width PG_HPPLine_MeasuringStatus PG_HPPLine_Second_Valid PG_HPPLine_Third_Valid PG_HPPLine_TrackID PG_HPPLine_ViewRange_End_First PG_HPPLine_ViewRange_End_Second PG_HPPLine_ViewRange_End_Third PG_Left_ConeRoadEdgeConfidence PG_Left_ConeRoadEdgeMeasuringStatus PG_Left_ConeRoadEdgeModelC0 PG_Left_ConeRoadEdgeModelC1 PG_Left_ConeRoadEdgeModelC2 PG_Left_ConeRoadEdgeModelC3 PG_Left_ConeRoadEdgeParsingConfidence PG_Left_ConeRoadEdgeQuality PG_Left_ConeRoadEdgeTLC PG_Left_ConeRoadEdgeTrackID PG_Left_ConeRoadEdgeTypeClass PG_Left_ConeRoadEdgeViewRangeEnd PG_Left_ConeRoadEdgeViewRangeStart PG_Left_LaneExtraFarPointPosX PG_Left_LaneExtraFarPointPosY PG_Left_LaneExtraFarPointType PG_Ri_ConeRoadEdgeConfidence PG_Ri_ConeRoadEdgeMeasuringStatus PG_Ri_ConeRoadEdgeModelC0 PG_Ri_ConeRoadEdgeModelC1 PG_Ri_ConeRoadEdgeModelC2 PG_Ri_ConeRoadEdgeModelC3 PG_Ri_ConeRoadEdgeParsingConfidence PG_Ri_ConeRoadEdgeQuality PG_Ri_ConeRoadEdgeTLC PG_Ri_ConeRoadEdgeTrackID PG_Ri_ConeRoadEdgeTypeClass PG_Ri_ConeRoadEdgeViewRangeEnd PG_Ri_ConeRoadEdgeViewRangeStart PG_Ri_LaneExtraFarPointPosX PG_Ri_LaneExtraFarPointPosY PG_Ri_LaneExtraFarPointType /end REF_MEASUREMENT
/end GROUP
/begin GROUP autosar_swc_rlgs_autosar_swc_rlgs_Step_sys_rlgs1_Subsystem1_Subsystem17 "autosar_swc_rlgs/autosar_swc_rlgs_Step_sys/rlgs1/Subsystem1/Subsystem17"
 /begin SUB_GROUP autosar_swc_rlgs_autosar_swc_rlgs_Step_sys_rlgs1_Subsystem1_Subsystem17_ControlLineCal /end SUB_GROUP
/end GROUP
/begin GROUP autosar_swc_rlgs_autosar_swc_rlgs_Step_sys_rlgs1_Subsystem1_Subsystem17_ControlLineCal "autosar_swc_rlgs/autosar_swc_rlgs_Step_sys/rlgs1/Subsystem1/Subsystem17/ControlLineCal"
 /begin SUB_GROUP autosar_swc_rlgs_autosar_swc_rlgs_Step_sys_rlgs1_Subsystem1_Subsystem17_ControlLineCal_LaneChangeCal autosar_swc_rlgs_autosar_swc_rlgs_Step_sys_rlgs1_Subsystem1_Subsystem17_ControlLineCal_MRCLine autosar_swc_rlgs_autosar_swc_rlgs_Step_sys_rlgs1_Subsystem1_Subsystem17_ControlLineCal_NOAPathPlan autosar_swc_rlgs_autosar_swc_rlgs_Step_sys_rlgs1_Subsystem1_Subsystem17_ControlLineCal_PathYbranchCal autosar_swc_rlgs_autosar_swc_rlgs_Step_sys_rlgs1_Subsystem1_Subsystem17_ControlLineCal_RoadSemantics autosar_swc_rlgs_autosar_swc_rlgs_Step_sys_rlgs1_Subsystem1_Subsystem17_ControlLineCal_RoadWidthCal autosar_swc_rlgs_autosar_swc_rlgs_Step_sys_rlgs1_Subsystem1_Subsystem17_ControlLineCal_Subsystem5 autosar_swc_rlgs_autosar_swc_rlgs_Step_sys_rlgs1_Subsystem1_Subsystem17_ControlLineCal_TypeConf /end SUB_GROUP
 /begin REF_CHARACTERISTIC P_PG_StepTime /end REF_CHARACTERISTIC
 /begin REF_MEASUREMENT autosar_swc_rlgs_rtARID_DEF.TmpSignalConversionAtvxvRefMsOutport1 autosar_swc_rlgs_rtARID_DEF.UnitDelay11_DSTATE_a autosar_swc_rlgs_rtARID_DEF.UnitDelay12_DSTATE_b autosar_swc_rlgs_rtARID_DEF.UnitDelay13_DSTATE /end REF_MEASUREMENT
/end GROUP
/begin GROUP autosar_swc_rlgs_autosar_swc_rlgs_Step_sys_rlgs1_Subsystem1_Subsystem17_ControlLineCal_LaneChangeCal "autosar_swc_rlgs/autosar_swc_rlgs_Step_sys/rlgs1/Subsystem1/Subsystem17/ControlLineCal/LaneChangeCal"
 /begin REF_MEASUREMENT PG_LeftLaneChangeFlag PG_RiLaneChangeFlag autosar_swc_rlgs_rtARID_DEF.L1_C0_K1 autosar_swc_rlgs_rtARID_DEF.L1_C1_K1 autosar_swc_rlgs_rtARID_DEF.L1_C2_K1 autosar_swc_rlgs_rtARID_DEF.L1_C3_K1 autosar_swc_rlgs_rtARID_DEF.L1_Range_K1 autosar_swc_rlgs_rtARID_DEF.L1_bIsExist_K1 autosar_swc_rlgs_rtARID_DEF.PP_Path_1_C0_K1 autosar_swc_rlgs_rtARID_DEF.R1_C0_K1 autosar_swc_rlgs_rtARID_DEF.R1_C1_K1 autosar_swc_rlgs_rtARID_DEF.R1_C2_K1 autosar_swc_rlgs_rtARID_DEF.R1_C3_K1 autosar_swc_rlgs_rtARID_DEF.R1_Range_K1 autosar_swc_rlgs_rtARID_DEF.R1_bIsExist_K1 /end REF_MEASUREMENT
/end GROUP
/begin GROUP autosar_swc_rlgs_autosar_swc_rlgs_Step_sys_rlgs1_Subsystem1_Subsystem17_ControlLineCal_MRCLine "autosar_swc_rlgs/autosar_swc_rlgs_Step_sys/rlgs1/Subsystem1/Subsystem17/ControlLineCal/MRCLine" /begin REF_CHARACTERISTIC P_PP_EdgeOffset /end REF_CHARACTERISTIC /begin REF_MEASUREMENT autosar_swc_rlgs_rtARID_DEF.UnitDelay3_DSTATE_m /end REF_MEASUREMENT /end GROUP
/begin GROUP autosar_swc_rlgs_autosar_swc_rlgs_Step_sys_rlgs1_Subsystem1_Subsystem17_ControlLineCal_NOAPathPlan "autosar_swc_rlgs/autosar_swc_rlgs_Step_sys/rlgs1/Subsystem1/Subsystem17/ControlLineCal/NOAPathPlan"
 /begin SUB_GROUP autosar_swc_rlgs_autosar_swc_rlgs_Step_sys_rlgs1_Subsystem1_Subsystem17_ControlLineCal_NOAPathPlan_ExitSplitLinePlanFlagCal autosar_swc_rlgs_autosar_swc_rlgs_Step_sys_rlgs1_Subsystem1_Subsystem17_ControlLineCal_NOAPathPlan_GuideLineCal1 /end SUB_GROUP
 /begin REF_CHARACTERISTIC P_PG_Dis2StubThreshold P_PG_DyThresthold P_PG_EgeThresthold P_PG_ExitLineLastSW P_PG_RiSplitFRWhelDyThresValue P_PG_ShieldR1LineTypeStubDis P_PG_SplitLineLineLostKeepTime P_PG_SplitLineSW P_PG_StepTime P_PG_ThresholdLine P_PG_diffThreshold /end REF_CHARACTERISTIC
 /begin REF_MEASUREMENT PG_PG_LineNear2RB PG_PG_SplitOperateState PG_PG_SplitOperateStateKeep PG_PG_diffStdR1RB PG_PG_diffStdR2RB PG_RoadWidth autosar_swc_rlgs_rtARID_DEF.Cnt_K1 autosar_swc_rlgs_rtARID_DEF.FRWhelDy_k1 autosar_swc_rlgs_rtARID_DEF.GuideLineCalSource_k1 autosar_swc_rlgs_rtARID_DEF.L1KeepDis autosar_swc_rlgs_rtARID_DEF.NOAClass_K1 autosar_swc_rlgs_rtARID_DEF.NOALineC0_K1 autosar_swc_rlgs_rtARID_DEF.NOALineC1_K1 autosar_swc_rlgs_rtARID_DEF.NOALineC2_K1 autosar_swc_rlgs_rtARID_DEF.NOALineC3_K1 autosar_swc_rlgs_rtARID_DEF.NOALineRange_K1 autosar_swc_rlgs_rtARID_DEF.NOALineStart_K1 autosar_swc_rlgs_rtARID_DEF.NOALineValid_K1 autosar_swc_rlgs_rtARID_DEF.NOAReliable_K1 autosar_swc_rlgs_rtARID_DEF.NOARoadWidth_K1 autosar_swc_rlgs_rtARID_DEF.NOASource_K1 autosar_swc_rlgs_rtARID_DEF.R0RemberDis autosar_swc_rlgs_rtARID_DEF.R0line_Con_K1 autosar_swc_rlgs_rtARID_DEF.R1_ShadedTypeTime autosar_swc_rlgs_rtARID_DEF.R2_ShadedTypeTime autosar_swc_rlgs_rtARID_DEF.SplitLineCalSource autosar_swc_rlgs_rtARID_DEF.TimeApproach autosar_swc_rlgs_rtARID_DEF.TmpSignalConversionAtvxvRefMsOutport1 autosar_swc_rlgs_rtARID_DEF.UnitDelay1_DSTATE_be autosar_swc_rlgs_rtARID_DEF.UnitDelay2_DSTATE_d autosar_swc_rlgs_rtARID_DEF.UnitDelay3_DSTATE_p autosar_swc_rlgs_rtARID_DEF.UnitDelay4_DSTATE_d autosar_swc_rlgs_rtARID_DEF.UnitDelay5_DSTATE_n autosar_swc_rlgs_rtARID_DEF.UnitDelay6_DSTATE_b autosar_swc_rlgs_rtARID_DEF.UnitDelay7_DSTATE_h autosar_swc_rlgs_rtARID_DEF.UnitDelay9_DSTATE_d autosar_swc_rlgs_rtARID_DEF.UnitDelay_DSTATE_lz autosar_swc_rlgs_rtARID_DEF.Virtually_RightLine_C0_a autosar_swc_rlgs_rtARID_DEF.Virtually_RightLine_C1_g autosar_swc_rlgs_rtARID_DEF.Virtually_RightLine_C2_n autosar_swc_rlgs_rtARID_DEF.Virtually_RightLine_C3_k autosar_swc_rlgs_rtARID_DEF.Virtually_RightLine_Range_h autosar_swc_rlgs_rtARID_DEF.Virtually_RightLine_State_j /end REF_MEASUREMENT
/end GROUP
/begin GROUP autosar_swc_rlgs_autosar_swc_rlgs_Step_sys_rlgs1_Subsystem1_Subsystem17_ControlLineCal_NOAPathPlan_ExitSplitLinePlanFlagCal "autosar_swc_rlgs/autosar_swc_rlgs_Step_sys/rlgs1/Subsystem1/Subsystem17/ControlLineCal/NOAPathPlan/ExitSplitLinePlanFlagCal"
 /begin REF_MEASUREMENT autosar_swc_rlgs_rtARID_DEF.is_WaitExitSplit autosar_swc_rlgs_rtARID_DEF.is_active_c24_autosar_swc_rlgs autosar_swc_rlgs_rtARID_DEF.is_c24_autosar_swc_rlgs autosar_swc_rlgs_rtARID_DEF.stub_end_dis_k1 /end REF_MEASUREMENT
/end GROUP
/begin GROUP autosar_swc_rlgs_autosar_swc_rlgs_Step_sys_rlgs1_Subsystem1_Subsystem17_ControlLineCal_NOAPathPlan_GuideLineCal1 "autosar_swc_rlgs/autosar_swc_rlgs_Step_sys/rlgs1/Subsystem1/Subsystem17/ControlLineCal/NOAPathPlan/GuideLineCal1"
 /begin SUB_GROUP autosar_swc_rlgs_autosar_swc_rlgs_Step_sys_rlgs1_Subsystem1_Subsystem17_ControlLineCal_NOAPathPlan_GuideLineCal1_Subsystem1 autosar_swc_rlgs_autosar_swc_rlgs_Step_sys_rlgs1_Subsystem1_Subsystem17_ControlLineCal_NOAPathPlan_GuideLineCal1_Subsystem2 /end SUB_GROUP
 /begin REF_CHARACTERISTIC P_PG_DyThresthold P_PG_LineLostComTime P_PG_LineLowPassFilter P_PG_StepTime P_PG_ThresholdLine P_PG_diffThreshold /end REF_CHARACTERISTIC
 /begin REF_MEASUREMENT autosar_swc_rlgs_rtARID_DEF.DisCount_1_f autosar_swc_rlgs_rtARID_DEF.DisCount_2_c autosar_swc_rlgs_rtARID_DEF.GuideLineCalSource_f autosar_swc_rlgs_rtARID_DEF.GuideLineTrackID autosar_swc_rlgs_rtARID_DEF.NextGuideLineSource_temp autosar_swc_rlgs_rtARID_DEF.R0line_C0_k1 autosar_swc_rlgs_rtARID_DEF.R0line_C1_k1 autosar_swc_rlgs_rtARID_DEF.R0line_C2_k1 autosar_swc_rlgs_rtARID_DEF.R0line_C3_k1 autosar_swc_rlgs_rtARID_DEF.R0line_End_k1 autosar_swc_rlgs_rtARID_DEF.RO_OutStartPointDis autosar_swc_rlgs_rtARID_DEF.RiLaneChangeFlagk1 autosar_swc_rlgs_rtARID_DEF.TmpSignalConversionAtvxvRefMsOutport1 autosar_swc_rlgs_rtARID_DEF.UnitDelay1_DSTATE_n autosar_swc_rlgs_rtARID_DEF.UnitDelay2_DSTATE_c autosar_swc_rlgs_rtARID_DEF.UnitDelay3_DSTATE_j autosar_swc_rlgs_rtARID_DEF.UnitDelay4_DSTATE_k autosar_swc_rlgs_rtARID_DEF.UnitDelay5_DSTATE_g autosar_swc_rlgs_rtARID_DEF.UnitDelay6_DSTATE_h autosar_swc_rlgs_rtARID_DEF.UnitDelay7_DSTATE_e autosar_swc_rlgs_rtARID_DEF.UnitDelay_DSTATE_js autosar_swc_rlgs_rtARID_DEF.is_Lcjudge autosar_swc_rlgs_rtARID_DEF.is_SplitLineSourceCal autosar_swc_rlgs_rtARID_DEF.is_WaitRout autosar_swc_rlgs_rtARID_DEF.is_active_c32_autosar_swc_rlgs autosar_swc_rlgs_rtARID_DEF.is_active_c33_autosar_swc_rlgs autosar_swc_rlgs_rtARID_DEF.is_active_c34_autosar_swc_rlgs autosar_swc_rlgs_rtARID_DEF.is_c32_autosar_swc_rlgs autosar_swc_rlgs_rtARID_DEF.is_c33_autosar_swc_rlgs autosar_swc_rlgs_rtARID_DEF.is_c34_autosar_swc_rlgs autosar_swc_rlgs_rtARID_DEF.t_lost_k1 /end REF_MEASUREMENT
/end GROUP
/begin GROUP autosar_swc_rlgs_autosar_swc_rlgs_Step_sys_rlgs1_Subsystem1_Subsystem17_ControlLineCal_NOAPathPlan_GuideLineCal1_Subsystem1 "autosar_swc_rlgs/autosar_swc_rlgs_Step_sys/rlgs1/Subsystem1/Subsystem17/ControlLineCal/NOAPathPlan/GuideLineCal1/Subsystem1" /begin REF_CHARACTERISTIC P_PG_StepTime /end REF_CHARACTERISTIC /begin REF_MEASUREMENT autosar_swc_rlgs_rtARID_DEF.UnitDelay_DSTATE_i /end REF_MEASUREMENT /end GROUP
/begin GROUP autosar_swc_rlgs_autosar_swc_rlgs_Step_sys_rlgs1_Subsystem1_Subsystem17_ControlLineCal_NOAPathPlan_GuideLineCal1_Subsystem2 "autosar_swc_rlgs/autosar_swc_rlgs_Step_sys/rlgs1/Subsystem1/Subsystem17/ControlLineCal/NOAPathPlan/GuideLineCal1/Subsystem2" /begin REF_CHARACTERISTIC P_PG_StepTime /end REF_CHARACTERISTIC /begin REF_MEASUREMENT autosar_swc_rlgs_rtARID_DEF.UnitDelay_DSTATE_d /end REF_MEASUREMENT /end GROUP
/begin GROUP autosar_swc_rlgs_autosar_swc_rlgs_Step_sys_rlgs1_Subsystem1_Subsystem17_ControlLineCal_PathYbranchCal "autosar_swc_rlgs/autosar_swc_rlgs_Step_sys/rlgs1/Subsystem1/Subsystem17/ControlLineCal/PathYbranchCal" /begin REF_CHARACTERISTIC P_PG_StepTime /end REF_CHARACTERISTIC
 /begin REF_MEASUREMENT PG_CurPathYbranchFlag PG_LeftPathYbranchFlag PG_RiPathYbranchFlag autosar_swc_rlgs_rtARID_DEF.Dist_CurPathBranch_k autosar_swc_rlgs_rtARID_DEF.Dist_LeftPathBranch_k autosar_swc_rlgs_rtARID_DEF.Dist_RiPathBranch_k autosar_swc_rlgs_rtARID_DEF.TmpSignalConversionAtvxvRefMsOutport1 /end REF_MEASUREMENT
/end GROUP
/begin GROUP autosar_swc_rlgs_autosar_swc_rlgs_Step_sys_rlgs1_Subsystem1_Subsystem17_ControlLineCal_RoadSemantics "autosar_swc_rlgs/autosar_swc_rlgs_Step_sys/rlgs1/Subsystem1/Subsystem17/ControlLineCal/RoadSemantics"
 /begin REF_CHARACTERISTIC P_PG_DeathLaneWidthThresvalue P_PG_LineRangeForWeight P_PG_LineRangeWeight P_PG_MaxRoadWidth P_PG_MinRoadWidth P_PG_RoadSemanticsCalRangeWeight P_PG_RoadSemanticsStsCalAyWeight P_PG_RoadSemanticsStsCalDyWeight P_PG_StepTime P_PG_VehSpdForLineWeight P_PSM_CenterDyThresValue /end REF_CHARACTERISTIC
 /begin REF_MEASUREMENT PG_RoadSemanticsSts PG_RoadWidth autosar_swc_rlgs_rtARID_DEF.DieOutFlagEndDis autosar_swc_rlgs_rtARID_DEF.DieOutLaneFlag_n autosar_swc_rlgs_rtARID_DEF.LeftLineTrackId autosar_swc_rlgs_rtARID_DEF.NarrowFlag autosar_swc_rlgs_rtARID_DEF.ParallelismTime autosar_swc_rlgs_rtARID_DEF.RightLineTrackId autosar_swc_rlgs_rtARID_DEF.RoadSemantics_k1 autosar_swc_rlgs_rtARID_DEF.TmpSignalConversionAtvxvRefMsOutport1 autosar_swc_rlgs_rtARID_DEF.YBranchDis autosar_swc_rlgs_rtARID_DEF.YBranchFlag /end REF_MEASUREMENT
/end GROUP
/begin GROUP autosar_swc_rlgs_autosar_swc_rlgs_Step_sys_rlgs1_Subsystem1_Subsystem17_ControlLineCal_RoadWidthCal "autosar_swc_rlgs/autosar_swc_rlgs_Step_sys/rlgs1/Subsystem1/Subsystem17/ControlLineCal/RoadWidthCal"
 /begin REF_CHARACTERISTIC P_PG_MinRoadWidth P_PG_PreTimeUseforCalCurRoadwidth P_PG_PreTimeUseforCalRoadwidth /end REF_CHARACTERISTIC
 /begin REF_MEASUREMENT PG_J3_Update PG_RoadWidth PG_RoadWidthL PG_RoadWidthR autosar_swc_rlgs_rtARID_DEF.L1_bIsExist_k1 autosar_swc_rlgs_rtARID_DEF.L2_bIsExist_k1 autosar_swc_rlgs_rtARID_DEF.R1_bIsExist_k1 autosar_swc_rlgs_rtARID_DEF.R2_bIsExist_k1 autosar_swc_rlgs_rtARID_DEF.RoadWidthRemberFlag autosar_swc_rlgs_rtARID_DEF.RoadWidthRemberValue autosar_swc_rlgs_rtARID_DEF.RoadWidth_k1 autosar_swc_rlgs_rtARID_DEF.TmpSignalConversionAtvxvRefMsOutport1 autosar_swc_rlgs_rtARID_DEF.UnitDelay75_DSTATE autosar_swc_rlgs_rtARID_DEF.UnitDelay76_DSTATE /end REF_MEASUREMENT
/end GROUP
/begin GROUP autosar_swc_rlgs_autosar_swc_rlgs_Step_sys_rlgs1_Subsystem1_Subsystem17_ControlLineCal_Subsystem5 "autosar_swc_rlgs/autosar_swc_rlgs_Step_sys/rlgs1/Subsystem1/Subsystem17/ControlLineCal/Subsystem5"
 /begin SUB_GROUP autosar_swc_rlgs_autosar_swc_rlgs_Step_sys_rlgs1_Subsystem1_Subsystem17_ControlLineCal_Subsystem5_GuideLineCal1 autosar_swc_rlgs_autosar_swc_rlgs_Step_sys_rlgs1_Subsystem1_Subsystem17_ControlLineCal_Subsystem5_IDCal autosar_swc_rlgs_autosar_swc_rlgs_Step_sys_rlgs1_Subsystem1_Subsystem17_ControlLineCal_Subsystem5_LaneMoveDIrCal autosar_swc_rlgs_autosar_swc_rlgs_Step_sys_rlgs1_Subsystem1_Subsystem17_ControlLineCal_Subsystem5_LeftLaneDieOutCal autosar_swc_rlgs_autosar_swc_rlgs_Step_sys_rlgs1_Subsystem1_Subsystem17_ControlLineCal_Subsystem5_RiLaneDieOutCal autosar_swc_rlgs_autosar_swc_rlgs_Step_sys_rlgs1_Subsystem1_Subsystem17_ControlLineCal_Subsystem5_Subsystem autosar_swc_rlgs_autosar_swc_rlgs_Step_sys_rlgs1_Subsystem1_Subsystem17_ControlLineCal_Subsystem5_Subsystem2 autosar_swc_rlgs_autosar_swc_rlgs_Step_sys_rlgs1_Subsystem1_Subsystem17_ControlLineCal_Subsystem5_latcp_tarPathSelect /end SUB_GROUP
 /begin REF_CHARACTERISTIC P_PG_AbandonOnlyLeftEnable P_PG_CenterLine2LBThresValue P_PG_CenterLineLostCompenMinRange P_PG_CenterLineTFilter P_PG_ControlLineCalAyWeight P_PG_ControlLineCalDyWeight P_PG_ControlLineCalRangeWeight P_PG_EdgeControlLineKeepTime P_PG_EdgeMinLatDis2CalControlLine P_PG_EdgeThresValue P_PG_L1ShadeLatDisThreshold P_PG_LeftLineFalseByLeftEdgeDis P_PG_LeftLineFalseByRiEdgeDis P_PG_LineRangeForWeight P_PG_LineRangeWeight P_PG_MaxRoadWidth P_PG_MinRoadWidth P_PG_MinRoadWidthAllowLc P_PG_RiLineFalseByRiEdgeDis P_PG_StepTime P_PG_VehSpdForLineWeight P_PG_centerLinePolyfitEnable P_PG_doubleLineSelectEnable P_PG_maxHoldDist P_PG_meanErrThresValue P_PP_WaitingLineKapLim /end REF_CHARACTERISTIC
 /begin REF_MEASUREMENT PG_ControlLineCalSource PG_IsWaitingLine PG_LeftLineC0 PG_LeftLineSource PG_LeftLineValid PG_RightLineC0 PG_RightLineSource PG_RightLineValid PG_RoadWidth PG_RoadWidthL PG_RoadWidthR PG_WaitingLineDist autosar_swc_rlgs_rtARID_DEF.CentLineC0_k1 autosar_swc_rlgs_rtARID_DEF.CentLineC1_k1 autosar_swc_rlgs_rtARID_DEF.CentLineC2_k2 autosar_swc_rlgs_rtARID_DEF.CentLineC3_k1 autosar_swc_rlgs_rtARID_DEF.CentLineRange_k1 autosar_swc_rlgs_rtARID_DEF.CentLineReliable_k1 autosar_swc_rlgs_rtARID_DEF.CentLineStart_k1 autosar_swc_rlgs_rtARID_DEF.CentLineValid_k1 autosar_swc_rlgs_rtARID_DEF.Class_k1 autosar_swc_rlgs_rtARID_DEF.Cnt autosar_swc_rlgs_rtARID_DEF.ControLine2RB_k1 autosar_swc_rlgs_rtARID_DEF.ControlLineCalSource_k1 autosar_swc_rlgs_rtARID_DEF.Controline2LB_k1 autosar_swc_rlgs_rtARID_DEF.Controline2LB_k1_not_empty autosar_swc_rlgs_rtARID_DEF.CrossWalkRM_dis autosar_swc_rlgs_rtARID_DEF.EdgeControlLineCntTime autosar_swc_rlgs_rtARID_DEF.FirstEnterYbranchCostError autosar_swc_rlgs_rtARID_DEF.ForwardJunctionflag autosar_swc_rlgs_rtARID_DEF.LH1TypeK1 autosar_swc_rlgs_rtARID_DEF.Lane_arr_dir_sts autosar_swc_rlgs_rtARID_DEF.LeftLineValid autosar_swc_rlgs_rtARID_DEF.LostTime_k1 autosar_swc_rlgs_rtARID_DEF.RelevancyLaneID autosar_swc_rlgs_rtARID_DEF.RightLineValid autosar_swc_rlgs_rtARID_DEF.RoadSemanticsSts_k1 autosar_swc_rlgs_rtARID_DEF.Source_k1 autosar_swc_rlgs_rtARID_DEF.TmpSignalConversionAtvxvRefMsOutport1 autosar_swc_rlgs_rtARID_DEF.UnitDelay10_DSTATE autosar_swc_rlgs_rtARID_DEF.UnitDelay1_DSTATE_j autosar_swc_rlgs_rtARID_DEF.UnitDelay2_DSTATE_dx autosar_swc_rlgs_rtARID_DEF.UnitDelay3_DSTATE_e autosar_swc_rlgs_rtARID_DEF.UnitDelay4_DSTATE_d0 autosar_swc_rlgs_rtARID_DEF.UnitDelay5_DSTATE_d autosar_swc_rlgs_rtARID_DEF.UnitDelay6_DSTATE_mp autosar_swc_rlgs_rtARID_DEF.UnitDelay7_DSTATE_j autosar_swc_rlgs_rtARID_DEF.UnitDelay91_DSTATE autosar_swc_rlgs_rtARID_DEF.UnitDelay_DSTATE_d4 autosar_swc_rlgs_rtARID_DEF.Virtually_RightLine_C0 autosar_swc_rlgs_rtARID_DEF.Virtually_RightLine_C1 autosar_swc_rlgs_rtARID_DEF.Virtually_RightLine_C2 autosar_swc_rlgs_rtARID_DEF.Virtually_RightLine_C3 autosar_swc_rlgs_rtARID_DEF.Virtually_RightLine_Range autosar_swc_rlgs_rtARID_DEF.Virtually_RightLine_State autosar_swc_rlgs_rtARID_DEF.doubleLineSelectSts autosar_swc_rlgs_rtARID_DEF.holddist /end REF_MEASUREMENT
/end GROUP
/begin GROUP autosar_swc_rlgs_autosar_swc_rlgs_Step_sys_rlgs1_Subsystem1_Subsystem17_ControlLineCal_Subsystem5_GuideLineCal1 "autosar_swc_rlgs/autosar_swc_rlgs_Step_sys/rlgs1/Subsystem1/Subsystem17/ControlLineCal/Subsystem5/GuideLineCal1" /begin REF_CHARACTERISTIC P_PG_StepTime /end REF_CHARACTERISTIC
 /begin REF_MEASUREMENT autosar_swc_rlgs_rtARID_DEF.DisCount_1 autosar_swc_rlgs_rtARID_DEF.DisCount_2 autosar_swc_rlgs_rtARID_DEF.GuideLineCalSource autosar_swc_rlgs_rtARID_DEF.TmpSignalConversionAtvxvRefMsOutport1 autosar_swc_rlgs_rtARID_DEF.is_LeftBranchLineSourceCal autosar_swc_rlgs_rtARID_DEF.is_active_c43_autosar_swc_rlgs autosar_swc_rlgs_rtARID_DEF.is_c43_autosar_swc_rlgs /end REF_MEASUREMENT
/end GROUP
/begin GROUP autosar_swc_rlgs_autosar_swc_rlgs_Step_sys_rlgs1_Subsystem1_Subsystem17_ControlLineCal_Subsystem5_IDCal "autosar_swc_rlgs/autosar_swc_rlgs_Step_sys/rlgs1/Subsystem1/Subsystem17/ControlLineCal/Subsystem5/IDCal" /begin REF_CHARACTERISTIC P_PP_LineSTD_Limit /end REF_CHARACTERISTIC
 /begin REF_MEASUREMENT PG_LeftLineC0 PG_LeftLineValid PG_RightLineC0 PG_RightLineValid PG_RoadWidth PG_RoadWidthL PG_RoadWidthR autosar_swc_rlgs_rtARID_DEF.H_ID autosar_swc_rlgs_rtARID_DEF.ID_Count autosar_swc_rlgs_rtARID_DEF.L_ID autosar_swc_rlgs_rtARID_DEF.R_ID autosar_swc_rlgs_rtARID_DEF.UnitDelay1_DSTATE_lu autosar_swc_rlgs_rtARID_DEF.UnitDelay4_DSTATE_b autosar_swc_rlgs_rtARID_DEF.UnitDelay5_DSTATE_p autosar_swc_rlgs_rtARID_DEF.UnitDelay6_DSTATE_m autosar_swc_rlgs_rtARID_DEF.UnitDelay7_DSTATE_m autosar_swc_rlgs_rtARID_DEF.UnitDelay_DSTATE_e /end REF_MEASUREMENT
/end GROUP
/begin GROUP autosar_swc_rlgs_autosar_swc_rlgs_Step_sys_rlgs1_Subsystem1_Subsystem17_ControlLineCal_Subsystem5_LaneMoveDIrCal "autosar_swc_rlgs/autosar_swc_rlgs_Step_sys/rlgs1/Subsystem1/Subsystem17/ControlLineCal/Subsystem5/LaneMoveDIrCal"
 /begin REF_CHARACTERISTIC P_PG_DieOutLaneLcDefaultValue P_PG_DieOutLaneLcSw P_PG_DirStsKeepDisValue P_PG_LeRM2LineDyValueThres P_PG_RM2LineDyValueThres P_PG_RiRM2LineDyValueThres P_PG_StepTime /end REF_CHARACTERISTIC
 /begin REF_MEASUREMENT PG_CenterLaneDirection PG_LeftLaneDirection PG_LeftLineC0 PG_RMAllowLeftChangeSts PG_RMAllowMoveDirSts PG_RMAllowRightChangeSts PG_RightLaneDirection PG_RightLineC0 PG_RoadWidthL PG_RoadWidthR autosar_swc_rlgs_rtARID_DEF.AllowMoveDirSts_keepDis autosar_swc_rlgs_rtARID_DEF.AllowMoveDirSts_temp autosar_swc_rlgs_rtARID_DEF.LeftChangeDirSts_keepDis autosar_swc_rlgs_rtARID_DEF.LeftChangeDirSts_temp autosar_swc_rlgs_rtARID_DEF.RightChangeDirSts_keepDis autosar_swc_rlgs_rtARID_DEF.RightChangeDirSts_temp autosar_swc_rlgs_rtARID_DEF.TmpSignalConversionAtvxvRefMsOutport1 /end REF_MEASUREMENT
/end GROUP
/begin GROUP autosar_swc_rlgs_autosar_swc_rlgs_Step_sys_rlgs1_Subsystem1_Subsystem17_ControlLineCal_Subsystem5_LeftLaneDieOutCal "autosar_swc_rlgs/autosar_swc_rlgs_Step_sys/rlgs1/Subsystem1/Subsystem17/ControlLineCal/Subsystem5/LeftLaneDieOutCal" /begin REF_CHARACTERISTIC P_PG_StepTime P_PSM_CurrLaneDieOutJudgeSW /end REF_CHARACTERISTIC
 /begin REF_MEASUREMENT PG_RoadWidthL autosar_swc_rlgs_rtARID_DEF.DieOutLaneEndDis_j autosar_swc_rlgs_rtARID_DEF.DieOutLaneFlag_b autosar_swc_rlgs_rtARID_DEF.TmpSignalConversionAtvxvRefMsOutport1 /end REF_MEASUREMENT
/end GROUP
/begin GROUP autosar_swc_rlgs_autosar_swc_rlgs_Step_sys_rlgs1_Subsystem1_Subsystem17_ControlLineCal_Subsystem5_RiLaneDieOutCal "autosar_swc_rlgs/autosar_swc_rlgs_Step_sys/rlgs1/Subsystem1/Subsystem17/ControlLineCal/Subsystem5/RiLaneDieOutCal" /begin REF_CHARACTERISTIC P_PG_StepTime P_PSM_CurrLaneDieOutJudgeSW /end REF_CHARACTERISTIC
 /begin REF_MEASUREMENT PG_RoadWidthR autosar_swc_rlgs_rtARID_DEF.DieOutLaneEndDis autosar_swc_rlgs_rtARID_DEF.DieOutLaneFlag autosar_swc_rlgs_rtARID_DEF.TmpSignalConversionAtvxvRefMsOutport1 /end REF_MEASUREMENT
/end GROUP
/begin GROUP autosar_swc_rlgs_autosar_swc_rlgs_Step_sys_rlgs1_Subsystem1_Subsystem17_ControlLineCal_Subsystem5_Subsystem "autosar_swc_rlgs/autosar_swc_rlgs_Step_sys/rlgs1/Subsystem1/Subsystem17/ControlLineCal/Subsystem5/Subsystem" /begin REF_CHARACTERISTIC P_PG_StubStartDisforSugg /end REF_CHARACTERISTIC /end GROUP
/begin GROUP autosar_swc_rlgs_autosar_swc_rlgs_Step_sys_rlgs1_Subsystem1_Subsystem17_ControlLineCal_Subsystem5_Subsystem2 "autosar_swc_rlgs/autosar_swc_rlgs_Step_sys/rlgs1/Subsystem1/Subsystem17/ControlLineCal/Subsystem5/Subsystem2" /begin REF_MEASUREMENT PG_LeftLineSource /end REF_MEASUREMENT /end GROUP
/begin GROUP autosar_swc_rlgs_autosar_swc_rlgs_Step_sys_rlgs1_Subsystem1_Subsystem17_ControlLineCal_Subsystem5_latcp_tarPathSelect "autosar_swc_rlgs/autosar_swc_rlgs_Step_sys/rlgs1/Subsystem1/Subsystem17/ControlLineCal/Subsystem5/latcp_tarPathSelect"
 /begin SUB_GROUP autosar_swc_rlgs_autosar_swc_rlgs_Step_sys_rlgs1_Subsystem1_Subsystem17_ControlLineCal_Subsystem5_latcp_tarPathSelect_For_Each_Subsystem autosar_swc_rlgs_autosar_swc_rlgs_Step_sys_rlgs1_Subsystem1_Subsystem17_ControlLineCal_Subsystem5_latcp_tarPathSelect_MergePath autosar_swc_rlgs_autosar_swc_rlgs_Step_sys_rlgs1_Subsystem1_Subsystem17_ControlLineCal_Subsystem5_latcp_tarPathSelect_RefPointCalc autosar_swc_rlgs_autosar_swc_rlgs_Step_sys_rlgs1_Subsystem1_Subsystem17_ControlLineCal_Subsystem5_latcp_tarPathSelect_latcp_pathSelectRefPointReMix /end SUB_GROUP
 /begin REF_CHARACTERISTIC P_PG_DOPA0Limit P_PG_DOPCheckSwitch P_PG_DopSelectLaneEndLimit P_PG_JunctionLengthValue P_PG_JunctiondistanceValue P_PG_StepTime P_PG_TJAPathSelectDisableMinSpd_ms P_PG_TJAPathSelectEnableMinSpd_ms P_PG_l2l_Limitation /end REF_CHARACTERISTIC
 /begin REF_MEASUREMENT PG_RoadWidth autosar_swc_rlgs_rtARID_DEF.EntryDOPByStopLineFlag autosar_swc_rlgs_rtARID_DEF.JunctionDistance autosar_swc_rlgs_rtARID_DEF.Relay_Mode autosar_swc_rlgs_rtARID_DEF.StopLineDistance autosar_swc_rlgs_rtARID_DEF.SwitchCont autosar_swc_rlgs_rtARID_DEF.SwitchReason autosar_swc_rlgs_rtARID_DEF.TJASelectedPathIndex autosar_swc_rlgs_rtARID_DEF.TmpSignalConversionAtvxvRefMsOutport1 autosar_swc_rlgs_rtARID_DEF.UnitDelay1_DSTATE_g autosar_swc_rlgs_rtARID_DEF.UnitDelay_DSTATE_kn autosar_swc_rlgs_rtARID_DEF.dopstatusexitK1 autosar_swc_rlgs_rtARID_DEF.prey autosar_swc_rlgs_rtARID_DEF.theta /end REF_MEASUREMENT
/end GROUP
/begin GROUP autosar_swc_rlgs_autosar_swc_rlgs_Step_sys_rlgs1_Subsystem1_Subsystem17_ControlLineCal_Subsystem5_latcp_tarPathSelect_For_Each_Subsystem "autosar_swc_rlgs/autosar_swc_rlgs_Step_sys/rlgs1/Subsystem1/Subsystem17/ControlLineCal/Subsystem5/latcp_tarPathSelect/For Each\nSubsystem"
 /begin REF_MEASUREMENT autosar_swc_rlgs_rtARID_DEF.TmpSignalConversionAtvxvRefMsOutport1 /end REF_MEASUREMENT
/end GROUP
/begin GROUP autosar_swc_rlgs_autosar_swc_rlgs_Step_sys_rlgs1_Subsystem1_Subsystem17_ControlLineCal_Subsystem5_latcp_tarPathSelect_MergePath "autosar_swc_rlgs/autosar_swc_rlgs_Step_sys/rlgs1/Subsystem1/Subsystem17/ControlLineCal/Subsystem5/latcp_tarPathSelect/MergePath"
 /begin REF_MEASUREMENT PG_LeftLineC0 PG_LeftLineSource PG_RightLineC0 PG_RightLineSource PG_RoadWidth PG_RoadWidthL PG_RoadWidthR /end REF_MEASUREMENT
/end GROUP
/begin GROUP autosar_swc_rlgs_autosar_swc_rlgs_Step_sys_rlgs1_Subsystem1_Subsystem17_ControlLineCal_Subsystem5_latcp_tarPathSelect_RefPointCalc "autosar_swc_rlgs/autosar_swc_rlgs_Step_sys/rlgs1/Subsystem1/Subsystem17/ControlLineCal/Subsystem5/latcp_tarPathSelect/RefPointCalc"
 /begin REF_MEASUREMENT autosar_swc_rlgs_rtARID_DEF.TmpSignalConversionAtvxvRefMsOutport1 /end REF_MEASUREMENT
/end GROUP
/begin GROUP autosar_swc_rlgs_autosar_swc_rlgs_Step_sys_rlgs1_Subsystem1_Subsystem17_ControlLineCal_Subsystem5_latcp_tarPathSelect_latcp_pathSelectRefPointReMix "autosar_swc_rlgs/autosar_swc_rlgs_Step_sys/rlgs1/Subsystem1/Subsystem17/ControlLineCal/Subsystem5/latcp_tarPathSelect/latcp_pathSelectRefPointReMix" /begin REF_CHARACTERISTIC P_PG_HisWigh /end REF_CHARACTERISTIC /end GROUP
/begin GROUP autosar_swc_rlgs_autosar_swc_rlgs_Step_sys_rlgs1_Subsystem1_Subsystem17_ControlLineCal_TypeConf "autosar_swc_rlgs/autosar_swc_rlgs_Step_sys/rlgs1/Subsystem1/Subsystem17/ControlLineCal/TypeConf"
 /begin REF_CHARACTERISTIC P_PG_IhbibitCrossAvaiByConeFlag P_PG_LeftCone2L2ThresValue P_PG_LeftCone2LeftLineMinDisValue P_PG_LeftConeInLeftPathThreshold P_PG_RiCone2R2ThresValue P_PG_RiCone2RiLineMinDisValue P_PG_RiConeInLeftPathThreshold P_PG_TFCDisComMaxThresValue P_PG_TFCDisComMinThresValue P_PG_TFCDisMaxThresValue P_PG_TFCDisMinThresValue P_PG_TFCMaxThresValue P_PG_TFCMinThresValue P_PG_TFCRoadWidthMax P_PG_TFCRoadWidthMin /end REF_CHARACTERISTIC
 /begin REF_MEASUREMENT PG_LeftLineC0 PG_RightLineC0 PG_RoadWidthL PG_RoadWidthR RLGS_PG_LeLineLcAvailable RLGS_PG_LeftCrossAvai_ByCone RLGS_PG_RiCrossAvai_ByCone RLGS_PG_RiLineLcAvailable autosar_swc_rlgs_rtARID_DEF.UnitDelay10_DSTATE_l autosar_swc_rlgs_rtARID_DEF.UnitDelay11_DSTATE autosar_swc_rlgs_rtARID_DEF.UnitDelay12_DSTATE autosar_swc_rlgs_rtARID_DEF.UnitDelay1_DSTATE_l autosar_swc_rlgs_rtARID_DEF.UnitDelay2_DSTATE_m autosar_swc_rlgs_rtARID_DEF.UnitDelay3_DSTATE autosar_swc_rlgs_rtARID_DEF.UnitDelay4_DSTATE_h autosar_swc_rlgs_rtARID_DEF.UnitDelay5_DSTATE autosar_swc_rlgs_rtARID_DEF.UnitDelay6_DSTATE autosar_swc_rlgs_rtARID_DEF.UnitDelay8_DSTATE autosar_swc_rlgs_rtARID_DEF.UnitDelay9_DSTATE /end REF_MEASUREMENT
/end GROUP
/begin GROUP autosar_swc_rlgs_autosar_swc_rlgs_Step_sys_rlgs1_Subsystem3 "autosar_swc_rlgs/autosar_swc_rlgs_Step_sys/rlgs1/Subsystem3" /begin REF_CHARACTERISTIC P_PG_StopLineMaxValue P_PG_StopLineMinValue /end REF_CHARACTERISTIC /end GROUP
/begin GROUP autosar_swc_rlgs_autosar_swc_rlgs_Step_sys_rlgs1_Subsystem5 "autosar_swc_rlgs/autosar_swc_rlgs_Step_sys/rlgs1/Subsystem5"
 /begin SUB_GROUP autosar_swc_rlgs_autosar_swc_rlgs_Step_sys_rlgs1_Subsystem5_Counter_Limited /end SUB_GROUP
/end GROUP
/begin GROUP autosar_swc_rlgs_autosar_swc_rlgs_Step_sys_rlgs1_Subsystem5_Counter_Limited "autosar_swc_rlgs/autosar_swc_rlgs_Step_sys/rlgs1/Subsystem5/Counter\nLimited" /begin REF_MEASUREMENT autosar_swc_rlgs_rtARID_DEF.Output_DSTATE /end REF_MEASUREMENT /end GROUP
/begin GROUP autosar_swc_rlgs_autosar_swc_rlgs_Step_sys_rlgs1_Subsystem6 "autosar_swc_rlgs/autosar_swc_rlgs_Step_sys/rlgs1/Subsystem6" /begin REF_CHARACTERISTIC P_PG_LineLostComTime /end REF_CHARACTERISTIC /end GROUP
/begin GROUP autosar_swc_rlgs_autosar_swc_rlgs_Step_sys_rlgs1_Subsystem6_LineUpdate_Compare_To_Constant "autosar_swc_rlgs/autosar_swc_rlgs_Step_sys/rlgs1/Subsystem6/LineUpdate/Compare\nTo Constant" /begin REF_CHARACTERISTIC P_PG_LAndRLineC0Err /end REF_CHARACTERISTIC /end GROUP
/begin GROUP autosar_swc_rlgs_autosar_swc_rlgs_Step_sys_rlgs1_Subsystem6_Subsystem "autosar_swc_rlgs/autosar_swc_rlgs_Step_sys/rlgs1/Subsystem6/Subsystem" /begin REF_CHARACTERISTIC P_PG_LineLostComTime P_PG_LineLowPassFilter P_PG_StepTime /end REF_CHARACTERISTIC
 /begin REF_MEASUREMENT autosar_swc_rlgs_rtARID_DEF.TmpSignalConversionAtvxvRefMsOutport1 /end REF_MEASUREMENT
/end GROUP
/begin GROUP autosar_swc_rlgs_autosar_swc_rlgs_Step_sys_rlgs1_Subsystem6_Subsystem1 "autosar_swc_rlgs/autosar_swc_rlgs_Step_sys/rlgs1/Subsystem6/Subsystem1" /begin REF_CHARACTERISTIC P_PG_LineLowPassFilter P_PG_StepTime /end REF_CHARACTERISTIC
 /begin REF_MEASUREMENT autosar_swc_rlgs_rtARID_DEF.TmpSignalConversionAtvxvRefMsOutport1 /end REF_MEASUREMENT
/end GROUP
/begin GROUP autosar_swc_rlgs_autosar_swc_rlgs_Step_sys_rlgs1_Subsystem6_Subsystem2 "autosar_swc_rlgs/autosar_swc_rlgs_Step_sys/rlgs1/Subsystem6/Subsystem2" /begin REF_CHARACTERISTIC P_PG_LineLostComTime P_PG_LineLowPassFilter P_PG_StepTime /end REF_CHARACTERISTIC
 /begin REF_MEASUREMENT autosar_swc_rlgs_rtARID_DEF.TmpSignalConversionAtvxvRefMsOutport1 /end REF_MEASUREMENT
/end GROUP
/begin GROUP autosar_swc_rlgs_autosar_swc_rlgs_Step_sys_rlgs1_Subsystem6_Subsystem3 "autosar_swc_rlgs/autosar_swc_rlgs_Step_sys/rlgs1/Subsystem6/Subsystem3" /begin REF_CHARACTERISTIC P_PG_LineLostComTime P_PG_LineLowPassFilter P_PG_StepTime /end REF_CHARACTERISTIC
 /begin REF_MEASUREMENT autosar_swc_rlgs_rtARID_DEF.TmpSignalConversionAtvxvRefMsOutport1 /end REF_MEASUREMENT
/end GROUP
/begin GROUP autosar_swc_rlgs_autosar_swc_rlgs_Step_sys_rlgs1_Subsystem6_Subsystem4 "autosar_swc_rlgs/autosar_swc_rlgs_Step_sys/rlgs1/Subsystem6/Subsystem4" /begin REF_CHARACTERISTIC P_PG_LineLowPassFilter P_PG_StepTime /end REF_CHARACTERISTIC
 /begin REF_MEASUREMENT autosar_swc_rlgs_rtARID_DEF.TmpSignalConversionAtvxvRefMsOutport1 /end REF_MEASUREMENT
/end GROUP
/begin GROUP autosar_swc_rlgs_autosar_swc_rlgs_Step_sys_rlgs1_Subsystem6_Subsystem5 "autosar_swc_rlgs/autosar_swc_rlgs_Step_sys/rlgs1/Subsystem6/Subsystem5" /begin REF_CHARACTERISTIC P_PG_LineLostComTime P_PG_LineLowPassFilter P_PG_StepTime /end REF_CHARACTERISTIC
 /begin REF_MEASUREMENT autosar_swc_rlgs_rtARID_DEF.TmpSignalConversionAtvxvRefMsOutport1 /end REF_MEASUREMENT
/end GROUP
/begin GROUP autosar_swc_rlgs_autosar_swc_rlgs_Step_sys_rlgs1_Subsystem6_Subsystem6 "autosar_swc_rlgs/autosar_swc_rlgs_Step_sys/rlgs1/Subsystem6/Subsystem6" /begin REF_CHARACTERISTIC P_PG_LineLostComTime P_PG_LineLowPassFilter P_PG_StepTime /end REF_CHARACTERISTIC
 /begin REF_MEASUREMENT autosar_swc_rlgs_rtARID_DEF.TmpSignalConversionAtvxvRefMsOutport1 /end REF_MEASUREMENT
/end GROUP
/begin GROUP autosar_swc_rlgs_autosar_swc_rlgs_Step_sys_rlgs1_Subsystem6_Subsystem7 "autosar_swc_rlgs/autosar_swc_rlgs_Step_sys/rlgs1/Subsystem6/Subsystem7" /begin REF_CHARACTERISTIC P_PG_LineLostComTime P_PG_LineLowPassFilter P_PG_StepTime /end REF_CHARACTERISTIC
 /begin REF_MEASUREMENT autosar_swc_rlgs_rtARID_DEF.TmpSignalConversionAtvxvRefMsOutport1 /end REF_MEASUREMENT
/end GROUP
/begin GROUP autosar_swc_rlgs_autosar_swc_rlgs_Step_sys_rlgs1_alc1_NOADecision3_ExternalSignalReq "autosar_swc_rlgs/autosar_swc_rlgs_Step_sys/rlgs1/alc1/NOADecision3/ExternalSignalReq" /begin REF_MEASUREMENT PG_PG_SplitOperateState /end REF_MEASUREMENT /end GROUP
/begin GROUP autosar_swc_rlgs_autosar_swc_rlgs_Step_sys_rlgs1_alc1_NOADecision3_LaneChangeReqFlagCal "autosar_swc_rlgs/autosar_swc_rlgs_Step_sys/rlgs1/alc1/NOADecision3/LaneChangeReqFlagCal"
 /begin REF_MEASUREMENT autosar_swc_rlgs_rtARID_DEF.TmpSignalConversionAtvxvRefMsOutport1 /end REF_MEASUREMENT
/end GROUP
/begin GROUP autosar_swc_rlgs_autosar_swc_rlgs_Step_sys_rlgs1_alc1_NOADecision3_RoadClassCal_RiClassCal "autosar_swc_rlgs/autosar_swc_rlgs_Step_sys/rlgs1/alc1/NOADecision3/RoadClassCal/RiClassCal"
 /begin REF_MEASUREMENT autosar_swc_rlgs_rtARID_DEF.TmpSignalConversionAtvxvRefMsOutport1 /end REF_MEASUREMENT
/end GROUP
/begin GROUP autosar_swc_rlgs_autosar_swc_rlgs_Step_sys_rlgs1_alc1_NOADecision3_Subsystem4 "autosar_swc_rlgs/autosar_swc_rlgs_Step_sys/rlgs1/alc1/NOADecision3/Subsystem4"
 /begin REF_MEASUREMENT autosar_swc_rlgs_rtARID_DEF.TmpSignalConversionAtvxvRefMsOutport1 /end REF_MEASUREMENT
/end GROUP
/begin GROUP autosar_swc_rlgs_autosar_swc_rlgs_Step_sys_rlgs1_alc1_NOADecision3_np_roadElecFence "autosar_swc_rlgs/autosar_swc_rlgs_Step_sys/rlgs1/alc1/NOADecision3/np_roadElecFence"
 /begin REF_MEASUREMENT autosar_swc_rlgs_rtARID_DEF.TmpSignalConversionAtvxvRefMsOutport1 /end REF_MEASUREMENT
/end GROUP
/begin GROUP autosar_swc_rlgs_autosar_swc_rlgs_Step_sys_rlgs1_alc1_NOADecision3_np_roadElecFence_ElecFenceSignalCal_HighWayRightSplit_RampStsJudge_SplitMergeStubFlag_Compare_To_Constant "autosar_swc_rlgs/autosar_swc_rlgs_Step_sys/rlgs1/alc1/NOADecision3/np_roadElecFence/ElecFenceSignalCal/HighWayRightSplit/RampStsJudge/SplitMergeStubFlag/Compare\nTo Constant" /begin REF_MEASUREMENT PG_PG_SplitOperateState /end REF_MEASUREMENT /end GROUP
/begin GROUP autosar_swc_rlgs_autosar_swc_rlgs_Step_sys_rlgs1_alc1_NOADecision3_np_roadElecFence_ElecFenceSignalCal_LineDirCorrect "autosar_swc_rlgs/autosar_swc_rlgs_Step_sys/rlgs1/alc1/NOADecision3/np_roadElecFence/ElecFenceSignalCal/LineDirCorrect"
 /begin REF_MEASUREMENT autosar_swc_rlgs_rtARID_DEF.TmpSignalConversionAtvxvRefMsOutport1 /end REF_MEASUREMENT
/end GROUP
/begin GROUP autosar_swc_rlgs_autosar_swc_rlgs_Step_sys_rlgs1_alc1_NOADecision3_np_roadElecFence_ElecFenceSignalCal_NextStubJudge "autosar_swc_rlgs/autosar_swc_rlgs_Step_sys/rlgs1/alc1/NOADecision3/np_roadElecFence/ElecFenceSignalCal/NextStubJudge"
 /begin REF_MEASUREMENT autosar_swc_rlgs_rtARID_DEF.TmpSignalConversionAtvxvRefMsOutport1 /end REF_MEASUREMENT
/end GROUP
/begin GROUP autosar_swc_rlgs_autosar_swc_rlgs_Step_sys_rlgs1_alc1_alc_lcOverTk_lcOverTkDecs "autosar_swc_rlgs/autosar_swc_rlgs_Step_sys/rlgs1/alc1/alc_lcOverTk/lcOverTkDecs"
 /begin REF_MEASUREMENT autosar_swc_rlgs_rtARID_DEF.TmpSignalConversionAtvxvRefMsOutport1 /end REF_MEASUREMENT
/end GROUP
/begin GROUP autosar_swc_rlgs_autosar_swc_rlgs_Step_sys_rlgs1_alc1_alc_pathCalc "autosar_swc_rlgs/autosar_swc_rlgs_Step_sys/rlgs1/alc1/alc_pathCalc"
 /begin REF_MEASUREMENT autosar_swc_rlgs_rtARID_DEF.TmpSignalConversionAtvxvRefMsOutport1 /end REF_MEASUREMENT
/end GROUP
/begin GROUP autosar_swc_rlgs_autosar_swc_rlgs_Step_sys_rlgs1_alc1_alc_sm_alc_lcNoh "autosar_swc_rlgs/autosar_swc_rlgs_Step_sys/rlgs1/alc1/alc_sm/alc_lcNoh"
 /begin REF_MEASUREMENT autosar_swc_rlgs_rtARID_DEF.TmpSignalConversionAtvxvRefMsOutport1 /end REF_MEASUREMENT
/end GROUP
/begin RECORD_LAYOUT Record_BOOLEAN FNC_VALUES 1 UBYTE COLUMN_DIR DIRECT /end RECORD_LAYOUT
/begin RECORD_LAYOUT Record_FLOAT32_IEEE FNC_VALUES 1 FLOAT32_IEEE COLUMN_DIR DIRECT /end RECORD_LAYOUT
/begin RECORD_LAYOUT Record_FLOAT64_IEEE FNC_VALUES 1 FLOAT64_IEEE COLUMN_DIR DIRECT /end RECORD_LAYOUT
/begin RECORD_LAYOUT Record_SLONG FNC_VALUES 1 SLONG COLUMN_DIR DIRECT /end RECORD_LAYOUT
/begin RECORD_LAYOUT Record_SWORD FNC_VALUES 1 SWORD COLUMN_DIR DIRECT /end RECORD_LAYOUT
/begin RECORD_LAYOUT Record_UBYTE FNC_VALUES 1 UBYTE COLUMN_DIR DIRECT /end RECORD_LAYOUT
/begin RECORD_LAYOUT Record_UWORD FNC_VALUES 1 UWORD COLUMN_DIR DIRECT /end RECORD_LAYOUT
/begin RECORD_LAYOUT Record_BOOLEAN FNC_VALUES 1 UBYTE COLUMN_DIR DIRECT /end RECORD_LAYOUT
/begin RECORD_LAYOUT Record_FLOAT32_IEEE FNC_VALUES 1 FLOAT32_IEEE COLUMN_DIR DIRECT /end RECORD_LAYOUT
/begin RECORD_LAYOUT Record_FLOAT64_IEEE FNC_VALUES 1 FLOAT64_IEEE COLUMN_DIR DIRECT /end RECORD_LAYOUT
/begin RECORD_LAYOUT Record_SWORD FNC_VALUES 1 SWORD COLUMN_DIR DIRECT /end RECORD_LAYOUT
/begin RECORD_LAYOUT Record_UBYTE FNC_VALUES 1 UBYTE COLUMN_DIR DIRECT /end RECORD_LAYOUT
/begin RECORD_LAYOUT Record_UWORD FNC_VALUES 1 UWORD COLUMN_DIR DIRECT /end RECORD_LAYOUT
/begin RECORD_LAYOUT Axis_FLOAT32_IEEE AXIS_PTS_X 1 FLOAT32_IEEE INDEX_INCR DIRECT /end RECORD_LAYOUT
/begin RECORD_LAYOUT Record_BOOLEAN FNC_VALUES 1 UBYTE COLUMN_DIR DIRECT /end RECORD_LAYOUT
/begin RECORD_LAYOUT Record_FLOAT32_IEEE FNC_VALUES 1 FLOAT32_IEEE COLUMN_DIR DIRECT /end RECORD_LAYOUT
/begin RECORD_LAYOUT Record_FLOAT64_IEEE FNC_VALUES 1 FLOAT64_IEEE COLUMN_DIR DIRECT /end RECORD_LAYOUT
/begin RECORD_LAYOUT Record_SWORD FNC_VALUES 1 SWORD COLUMN_DIR DIRECT /end RECORD_LAYOUT
/begin RECORD_LAYOUT Record_UBYTE FNC_VALUES 1 UBYTE COLUMN_DIR DIRECT /end RECORD_LAYOUT
/begin RECORD_LAYOUT Record_UWORD FNC_VALUES 1 UWORD COLUMN_DIR DIRECT /end RECORD_LAYOUT
/begin RECORD_LAYOUT Axis_FLOAT32_IEEE AXIS_PTS_X 1 FLOAT32_IEEE INDEX_INCR DIRECT /end RECORD_LAYOUT
/begin RECORD_LAYOUT Record_BOOLEAN FNC_VALUES 1 UBYTE COLUMN_DIR DIRECT /end RECORD_LAYOUT
/begin RECORD_LAYOUT Record_FLOAT32_IEEE FNC_VALUES 1 FLOAT32_IEEE COLUMN_DIR DIRECT /end RECORD_LAYOUT
/begin RECORD_LAYOUT Record_FLOAT64_IEEE FNC_VALUES 1 FLOAT64_IEEE COLUMN_DIR DIRECT /end RECORD_LAYOUT
/begin RECORD_LAYOUT Record_SWORD FNC_VALUES 1 SWORD COLUMN_DIR DIRECT /end RECORD_LAYOUT
/begin RECORD_LAYOUT Record_UBYTE FNC_VALUES 1 UBYTE COLUMN_DIR DIRECT /end RECORD_LAYOUT
/begin RECORD_LAYOUT Record_UWORD FNC_VALUES 1 UWORD COLUMN_DIR DIRECT /end RECORD_LAYOUT
/begin RECORD_LAYOUT Axis_FLOAT32_IEEE AXIS_PTS_X 1 FLOAT32_IEEE INDEX_INCR DIRECT /end RECORD_LAYOUT
/begin RECORD_LAYOUT Record_BOOLEAN FNC_VALUES 1 UBYTE COLUMN_DIR DIRECT /end RECORD_LAYOUT
/begin RECORD_LAYOUT Record_FLOAT32_IEEE FNC_VALUES 1 FLOAT32_IEEE COLUMN_DIR DIRECT /end RECORD_LAYOUT
/begin RECORD_LAYOUT Record_FLOAT64_IEEE FNC_VALUES 1 FLOAT64_IEEE COLUMN_DIR DIRECT /end RECORD_LAYOUT
/begin RECORD_LAYOUT Record_SLONG FNC_VALUES 1 SLONG COLUMN_DIR DIRECT /end RECORD_LAYOUT
/begin RECORD_LAYOUT Record_SWORD FNC_VALUES 1 SWORD COLUMN_DIR DIRECT /end RECORD_LAYOUT
/begin RECORD_LAYOUT Record_UBYTE FNC_VALUES 1 UBYTE COLUMN_DIR DIRECT /end RECORD_LAYOUT
/begin RECORD_LAYOUT Record_UWORD FNC_VALUES 1 UWORD COLUMN_DIR DIRECT /end RECORD_LAYOUT
/begin RECORD_LAYOUT Axis_FLOAT32_IEEE AXIS_PTS_X 1 FLOAT32_IEEE INDEX_INCR DIRECT /end RECORD_LAYOUT
/end MODULE
/end PROJECT
