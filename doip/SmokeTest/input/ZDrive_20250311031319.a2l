ASAP2_VERSION 1 71
/begin PROJECT ProjectName ""
/begin MODULE ModuleName ""
/begin MOD_COMMON "" BYTE_ORDER MSB_LAST ALIGNMENT_BYTE 1 ALIGNMENT_WORD 1 ALIGNMENT_LONG 1 ALIGNMENT_INT64 1 ALIGNMENT_FLOAT16_IEEE 1 ALIGNMENT_FLOAT32_IEEE 1 ALIGNMENT_FLOAT64_IEEE 1 /end MOD_COMMON
/begin RECORD_LAYOUT __A_UINT64_S FNC_VALUES 1 A_UINT64 COLUMN_DIR DIRECT /end RECORD_LAYOUT
/begin RECORD_LAYOUT Record_BOOLEAN FNC_VALUES 1 UBYTE COLUMN_DIR DIRECT /end RECORD_LAYOUT
/begin RECORD_LAYOUT Record_FLOAT32_IEEE FNC_VALUES 1 FLOAT32_IEEE COLUMN_DIR DIRECT /end RECORD_LAYOUT
/begin RECORD_LAYOUT Axis_FLOAT32_IEEE AXIS_PTS_X 1 FLOAT32_IEEE INDEX_INCR DIRECT /end RECORD_LAYOUT
/begin RECORD_LAYOUT Record_BOOLEAN FNC_VALUES 1 UBYTE COLUMN_DIR DIRECT /end RECORD_LAYOUT
/begin RECORD_LAYOUT Record_FLOAT32_IEEE FNC_VALUES 1 FLOAT32_IEEE COLUMN_DIR DIRECT /end RECORD_LAYOUT
/begin RECORD_LAYOUT Axis_FLOAT32_IEEE AXIS_PTS_X 1 FLOAT32_IEEE INDEX_INCR DIRECT /end RECORD_LAYOUT
/begin RECORD_LAYOUT Record_BOOLEAN FNC_VALUES 1 UBYTE COLUMN_DIR DIRECT /end RECORD_LAYOUT
/begin RECORD_LAYOUT Record_FLOAT32_IEEE FNC_VALUES 1 FLOAT32_IEEE COLUMN_DIR DIRECT /end RECORD_LAYOUT
/begin RECORD_LAYOUT Record_BOOLEAN FNC_VALUES 1 UBYTE COLUMN_DIR DIRECT /end RECORD_LAYOUT
/begin RECORD_LAYOUT Record_FLOAT32_IEEE FNC_VALUES 1 FLOAT32_IEEE COLUMN_DIR DIRECT /end RECORD_LAYOUT
/begin RECORD_LAYOUT Axis_FLOAT32_IEEE AXIS_PTS_X 1 FLOAT32_IEEE INDEX_INCR DIRECT /end RECORD_LAYOUT
/begin RECORD_LAYOUT Record_BOOLEAN FNC_VALUES 1 UBYTE COLUMN_DIR DIRECT /end RECORD_LAYOUT
/begin RECORD_LAYOUT Record_FLOAT32_IEEE FNC_VALUES 1 FLOAT32_IEEE COLUMN_DIR DIRECT /end RECORD_LAYOUT
/begin RECORD_LAYOUT Axis_FLOAT32_IEEE AXIS_PTS_X 1 FLOAT32_IEEE INDEX_INCR DIRECT /end RECORD_LAYOUT
/begin RECORD_LAYOUT Record_BOOLEAN FNC_VALUES 1 UBYTE COLUMN_DIR DIRECT /end RECORD_LAYOUT
/begin RECORD_LAYOUT Record_FLOAT32_IEEE FNC_VALUES 1 FLOAT32_IEEE COLUMN_DIR DIRECT /end RECORD_LAYOUT
/begin RECORD_LAYOUT Axis_FLOAT32_IEEE AXIS_PTS_X 1 FLOAT32_IEEE INDEX_INCR DIRECT /end RECORD_LAYOUT
/begin CHARACTERISTIC P_TOS_ACC_CutInSwitch "" VALUE 0xfe821ee0 /* @ECU_Address@P_TOS_ACC_CutInSwitch@ */ Record_BOOLEAN 0 autosar_swc_tos_CM_boolean 0 1 /end CHARACTERISTIC
/begin CHARACTERISTIC P_TOS_DOP_DiffThre "" VALUE 0xfe821e58 /* @ECU_Address@P_TOS_DOP_DiffThre@ */ Record_FLOAT32_IEEE 0 autosar_swc_tos_CM_single -3.4E+38 3.4E+38 /end CHARACTERISTIC
/begin CHARACTERISTIC P_TOS_DOP_MeanCurvaLim "" VALUE 0xfe821e5c /* @ECU_Address@P_TOS_DOP_MeanCurvaLim@ */ Record_FLOAT32_IEEE 0 autosar_swc_tos_CM_single -3.4E+38 3.4E+38 /end CHARACTERISTIC
/begin CHARACTERISTIC P_TOS_ELK_MaxDis "" VALUE 0xfe821e60 /* @ECU_Address@P_TOS_ELK_MaxDis@ */ Record_FLOAT32_IEEE 0 autosar_swc_tos_CM_single -3.4E+38 3.4E+38 /end CHARACTERISTIC
/begin CHARACTERISTIC P_TOS_ELK_MinDis "" VALUE 0xfe821e64 /* @ECU_Address@P_TOS_ELK_MinDis@ */ Record_FLOAT32_IEEE 0 autosar_swc_tos_CM_single -3.4E+38 3.4E+38 /end CHARACTERISTIC
/begin CHARACTERISTIC P_TOS_EVM_VT_Switch "" VALUE 0xfe821ee1 /* @ECU_Address@P_TOS_EVM_VT_Switch@ */ Record_BOOLEAN 0 autosar_swc_tos_CM_boolean 0 1 /end CHARACTERISTIC
/begin CHARACTERISTIC P_TOS_EgoLC_FrontThre "" VALUE 0xfe821e68 /* @ECU_Address@P_TOS_EgoLC_FrontThre@ */ Record_FLOAT32_IEEE 0 autosar_swc_tos_CM_single -3.4E+38 3.4E+38 /end CHARACTERISTIC
/begin CHARACTERISTIC P_TOS_EgoLC_RearThre "" VALUE 0xfe821e6c /* @ECU_Address@P_TOS_EgoLC_RearThre@ */ Record_FLOAT32_IEEE 0 autosar_swc_tos_CM_single -3.4E+38 3.4E+38 /end CHARACTERISTIC
/begin CHARACTERISTIC P_TOS_EgoLowSpd_Lat_Thre "" VALUE 0xfe821e70 /* @ECU_Address@P_TOS_EgoLowSpd_Lat_Thre@ */ Record_FLOAT32_IEEE 0 autosar_swc_tos_CM_single -3.4E+38 3.4E+38 /end CHARACTERISTIC
/begin CHARACTERISTIC P_TOS_EgoLowSpd_ObjVx_Thre "" VALUE 0xfe821e74 /* @ECU_Address@P_TOS_EgoLowSpd_ObjVx_Thre@ */ Record_FLOAT32_IEEE 0 autosar_swc_tos_CM_single -3.4E+38 3.4E+38 /end CHARACTERISTIC
/begin CHARACTERISTIC P_TOS_EgoLowSpd_Range_Thre "" VALUE 0xfe821e78 /* @ECU_Address@P_TOS_EgoLowSpd_Range_Thre@ */ Record_FLOAT32_IEEE 0 autosar_swc_tos_CM_single -3.4E+38 3.4E+38 /end CHARACTERISTIC
/begin CHARACTERISTIC P_TOS_EgoLowSpd_Thre "" VALUE 0xfe821e7c /* @ECU_Address@P_TOS_EgoLowSpd_Thre@ */ Record_FLOAT32_IEEE 0 autosar_swc_tos_CM_single -3.4E+38 3.4E+38 /end CHARACTERISTIC
/begin CHARACTERISTIC P_TOS_IESActive_BreakingDis "" VALUE 0xfe821e80 /* @ECU_Address@P_TOS_IESActive_BreakingDis@ */ Record_FLOAT32_IEEE 0 autosar_swc_tos_CM_single -3.4E+38 3.4E+38 /end CHARACTERISTIC
/begin CHARACTERISTIC P_TOS_IESActive_IESSTTC "" VALUE 0xfe821e84 /* @ECU_Address@P_TOS_IESActive_IESSTTC@ */ Record_FLOAT32_IEEE 0 autosar_swc_tos_CM_single -3.4E+38 3.4E+38 /end CHARACTERISTIC
/begin CHARACTERISTIC P_TOS_IESActive_IESSafetyDis "" VALUE 0xfe821e88 /* @ECU_Address@P_TOS_IESActive_IESSafetyDis@ */ Record_FLOAT32_IEEE 0 autosar_swc_tos_CM_single -3.4E+38 3.4E+38 /end CHARACTERISTIC
/begin CHARACTERISTIC P_TOS_IESActive_LaneWidth "" VALUE 0xfe821e8c /* @ECU_Address@P_TOS_IESActive_LaneWidth@ */ Record_FLOAT32_IEEE 0 autosar_swc_tos_CM_single -3.4E+38 3.4E+38 /end CHARACTERISTIC
/begin CHARACTERISTIC P_TOS_IESActive_SpeedMax "" VALUE 0xfe821e90 /* @ECU_Address@P_TOS_IESActive_SpeedMax@ */ Record_FLOAT32_IEEE 0 autosar_swc_tos_CM_single -3.4E+38 3.4E+38 /end CHARACTERISTIC
/begin CHARACTERISTIC P_TOS_IESActive_SpeedMin "" VALUE 0xfe821e94 /* @ECU_Address@P_TOS_IESActive_SpeedMin@ */ Record_FLOAT32_IEEE 0 autosar_swc_tos_CM_single -3.4E+38 3.4E+38 /end CHARACTERISTIC
/begin CHARACTERISTIC P_TOS_IESOffset_BoundaryExist_Max "" VALUE 0xfe821e98 /* @ECU_Address@P_TOS_IESOffset_BoundaryExist_Max@ */ Record_FLOAT32_IEEE 0 autosar_swc_tos_CM_single -3.4E+38 3.4E+38 /end CHARACTERISTIC
/begin CHARACTERISTIC P_TOS_IESOffset_BoundaryExist_Min "" VALUE 0xfe821e9c /* @ECU_Address@P_TOS_IESOffset_BoundaryExist_Min@ */ Record_FLOAT32_IEEE 0 autosar_swc_tos_CM_single -3.4E+38 3.4E+38 /end CHARACTERISTIC
/begin CHARACTERISTIC P_TOS_IESOffset_GeneralScene_Max "" VALUE 0xfe821ea0 /* @ECU_Address@P_TOS_IESOffset_GeneralScene_Max@ */ Record_FLOAT32_IEEE 0 autosar_swc_tos_CM_single -3.4E+38 3.4E+38 /end CHARACTERISTIC
/begin CHARACTERISTIC P_TOS_IESOffset_GeneralScene_Min "" VALUE 0xfe821ea4 /* @ECU_Address@P_TOS_IESOffset_GeneralScene_Min@ */ Record_FLOAT32_IEEE 0 autosar_swc_tos_CM_single -3.4E+38 3.4E+38 /end CHARACTERISTIC
/begin CHARACTERISTIC P_TOS_IESOffset_HighSpeed_Max "" VALUE 0xfe821ea8 /* @ECU_Address@P_TOS_IESOffset_HighSpeed_Max@ */ Record_FLOAT32_IEEE 0 autosar_swc_tos_CM_single -3.4E+38 3.4E+38 /end CHARACTERISTIC
/begin CHARACTERISTIC P_TOS_IESOffset_HighSpeed_Min "" VALUE 0xfe821eac /* @ECU_Address@P_TOS_IESOffset_HighSpeed_Min@ */ Record_FLOAT32_IEEE 0 autosar_swc_tos_CM_single -3.4E+38 3.4E+38 /end CHARACTERISTIC
/begin CHARACTERISTIC P_TOS_IESOffset_NarrowLane_Max "" VALUE 0xfe821eb0 /* @ECU_Address@P_TOS_IESOffset_NarrowLane_Max@ */ Record_FLOAT32_IEEE 0 autosar_swc_tos_CM_single -3.4E+38 3.4E+38 /end CHARACTERISTIC
/begin CHARACTERISTIC P_TOS_IESOffset_NarrowLane_Min "" VALUE 0xfe821eb4 /* @ECU_Address@P_TOS_IESOffset_NarrowLane_Min@ */ Record_FLOAT32_IEEE 0 autosar_swc_tos_CM_single -3.4E+38 3.4E+38 /end CHARACTERISTIC
/begin CHARACTERISTIC P_TOS_IES_IntervalActive2Active "" VALUE 0xfe821eb8 /* @ECU_Address@P_TOS_IES_IntervalActive2Active@ */ Record_FLOAT32_IEEE 0 autosar_swc_tos_CM_single -3.4E+38 3.4E+38 /end CHARACTERISTIC
/begin CHARACTERISTIC P_TOS_IES_LaneCurV_in "" VALUE 0xfe821ebc /* @ECU_Address@P_TOS_IES_LaneCurV_in@ */ Record_FLOAT32_IEEE 0 autosar_swc_tos_CM_single -3.4E+38 3.4E+38 /end CHARACTERISTIC
/begin CHARACTERISTIC P_TOS_IES_LaneCurV_out "" VALUE 0xfe821ec0 /* @ECU_Address@P_TOS_IES_LaneCurV_out@ */ Record_FLOAT32_IEEE 0 autosar_swc_tos_CM_single -3.4E+38 3.4E+38 /end CHARACTERISTIC
/begin CHARACTERISTIC P_TOS_IES_LowSpeedODD_Limit "" VALUE 0xfe821ec4 /* @ECU_Address@P_TOS_IES_LowSpeedODD_Limit@ */ Record_FLOAT32_IEEE 0 autosar_swc_tos_CM_single -3.4E+38 3.4E+38 /end CHARACTERISTIC
/begin CHARACTERISTIC P_TOS_IES_StationaryObj_SafeDisEgo2Lane "" VALUE 0xfe821ec8 /* @ECU_Address@P_TOS_IES_StationaryObj_SafeDisEgo2Lane@ */ Record_FLOAT32_IEEE 0 autosar_swc_tos_CM_single -3.4E+38 3.4E+38 /end CHARACTERISTIC
/begin CHARACTERISTIC P_TOS_IES_StationaryObj_SafeDisEgo2Obj "" VALUE 0xfe821ecc /* @ECU_Address@P_TOS_IES_StationaryObj_SafeDisEgo2Obj@ */ Record_FLOAT32_IEEE 0 autosar_swc_tos_CM_single -3.4E+38 3.4E+38 /end CHARACTERISTIC
/begin CHARACTERISTIC P_TOS_IES_StationaryObj_offsetMax "" VALUE 0xfe821ed0 /* @ECU_Address@P_TOS_IES_StationaryObj_offsetMax@ */ Record_FLOAT32_IEEE 0 autosar_swc_tos_CM_single -3.4E+38 3.4E+38 /end CHARACTERISTIC
/begin CHARACTERISTIC P_TOS_IES_StationaryObj_offsetMid "" VALUE 0xfe821ed4 /* @ECU_Address@P_TOS_IES_StationaryObj_offsetMid@ */ Record_FLOAT32_IEEE 0 autosar_swc_tos_CM_single -3.4E+38 3.4E+38 /end CHARACTERISTIC
/begin CHARACTERISTIC P_TOS_IES_StationaryObj_offsetMin "" VALUE 0xfe821ed8 /* @ECU_Address@P_TOS_IES_StationaryObj_offsetMin@ */ Record_FLOAT32_IEEE 0 autosar_swc_tos_CM_single -3.4E+38 3.4E+38 /end CHARACTERISTIC
/begin CHARACTERISTIC P_TOS_LCLM_Switch "" VALUE 0xfe821ee2 /* @ECU_Address@P_TOS_LCLM_Switch@ */ Record_BOOLEAN 0 autosar_swc_tos_CM_boolean 0 1 /end CHARACTERISTIC
/begin CHARACTERISTIC P_TOS_TRAFFIC_SCEN_LgtMax "" VALUE 0xfe821edc /* @ECU_Address@P_TOS_TRAFFIC_SCEN_LgtMax@ */ Record_FLOAT32_IEEE 0 autosar_swc_tos_CM_single -3.4E+38 3.4E+38 /end CHARACTERISTIC
/begin MEASUREMENT SwcOut_TOS_LM_FusCase "" FLOAT32_IEEE autosar_swc_tos_CM_single 0 0 -3.4E+38 3.4E+38 ECU_ADDRESS 0xfe4b46b0 /* @ECU_Address@SwcOut_TOS_LM_FusCase@ */ /end MEASUREMENT
/begin MEASUREMENT TOS_DOPSelectDiffRef "" FLOAT32_IEEE autosar_swc_tos_CM_single 0 0 -3.4E+38 3.4E+38 LAYOUT COLUMN_DIR MATRIX_DIM 6 ECU_ADDRESS 0xfe4b18c0 /* @ECU_Address@TOS_DOPSelectDiffRef@ */ /end MEASUREMENT
/begin MEASUREMENT TOS_DOPSelectReason "" UBYTE autosar_swc_tos_CM_uint8 0 0 0 255 ECU_ADDRESS 0xfe4b490b /* @ECU_Address@TOS_DOPSelectReason@ */ /end MEASUREMENT
/begin MEASUREMENT TOS_OPParalNum "" UBYTE autosar_swc_tos_CM_uint8 0 0 0 255 LAYOUT COLUMN_DIR MATRIX_DIM 6 ECU_ADDRESS 0xfe4b4902 /* @ECU_Address@TOS_OPParalNum@ */ /end MEASUREMENT
/begin MEASUREMENT TOS_OPSelectIndex "" UBYTE autosar_swc_tos_CM_uint8 0 0 0 255 ECU_ADDRESS 0xfe4b490c /* @ECU_Address@TOS_OPSelectIndex@ */ /end MEASUREMENT
/begin MEASUREMENT TOS_reserve01 "" FLOAT32_IEEE autosar_swc_tos_CM_single 0 0 -3.4E+38 3.4E+38 MATRIX_DIM 1 1 ECU_ADDRESS 0xfe4b48dc /* @ECU_Address@TOS_reserve01@ */ /end MEASUREMENT
/begin MEASUREMENT TOS_reserve02 "" FLOAT32_IEEE autosar_swc_tos_CM_single 0 0 -3.4E+38 3.4E+38 ECU_ADDRESS 0xfe4b48e0 /* @ECU_Address@TOS_reserve02@ */ /end MEASUREMENT
/begin MEASUREMENT TOS_reserve03 "" FLOAT32_IEEE autosar_swc_tos_CM_single 0 0 -3.4E+38 3.4E+38 MATRIX_DIM 1 1 ECU_ADDRESS 0xfe4b48e4 /* @ECU_Address@TOS_reserve03@ */ /end MEASUREMENT
/begin MEASUREMENT TOS_reserve04 "" UBYTE autosar_swc_tos_CM_uint8 0 0 0 255 ECU_ADDRESS 0xfe4b490d /* @ECU_Address@TOS_reserve04@ */ /end MEASUREMENT
/begin MEASUREMENT TOS_reserve06 "" FLOAT32_IEEE autosar_swc_tos_CM_single 0 0 -3.4E+38 3.4E+38 MATRIX_DIM 1 1 ECU_ADDRESS 0xfe4b48ec /* @ECU_Address@TOS_reserve06@ */ /end MEASUREMENT
/begin MEASUREMENT TOS_reserve07 "" FLOAT32_IEEE autosar_swc_tos_CM_single 0 0 -3.4E+38 3.4E+38 ECU_ADDRESS 0xfe4b48f0 /* @ECU_Address@TOS_reserve07@ */ /end MEASUREMENT
/begin MEASUREMENT TOS_reserve08 "" FLOAT32_IEEE autosar_swc_tos_CM_single 0 0 -3.4E+38 3.4E+38 MATRIX_DIM 1 1 ECU_ADDRESS 0xfe4b48f4 /* @ECU_Address@TOS_reserve08@ */ /end MEASUREMENT
/begin MEASUREMENT TOS_reserve09 "" FLOAT32_IEEE autosar_swc_tos_CM_single 0 0 -3.4E+38 3.4E+38 ECU_ADDRESS 0xfe4b48f8 /* @ECU_Address@TOS_reserve09@ */ /end MEASUREMENT
/begin MEASUREMENT TOS_reserve10 "" FLOAT32_IEEE autosar_swc_tos_CM_single 0 0 -3.4E+38 3.4E+38 ECU_ADDRESS 0xfe4b48fc /* @ECU_Address@TOS_reserve10@ */ /end MEASUREMENT
/begin MEASUREMENT autosar_swc_tos_rtARID_DEF.BufObj_Class "" UBYTE autosar_swc_tos_CM_uint8 0 0 0 255 LAYOUT COLUMN_DIR MATRIX_DIM 20 ECU_ADDRESS 0xfe4c514f /* @ECU_Address@autosar_swc_tos_rtARID_DEF.BufObj_Class@ */ /end MEASUREMENT
/begin MEASUREMENT autosar_swc_tos_rtARID_DEF.BufObj_Class_p "" UBYTE autosar_swc_tos_CM_uint8 0 0 0 255 LAYOUT COLUMN_DIR MATRIX_DIM 5 ECU_ADDRESS 0xfe4c5172 /* @ECU_Address@autosar_swc_tos_rtARID_DEF.BufObj_Class_p@ */ /end MEASUREMENT
/begin MEASUREMENT autosar_swc_tos_rtARID_DEF.BufObj_Dx "" FLOAT32_IEEE autosar_swc_tos_CM_single 0 0 -3.4E+38 3.4E+38 LAYOUT COLUMN_DIR MATRIX_DIM 20 ECU_ADDRESS 0xfe4c4118 /* @ECU_Address@autosar_swc_tos_rtARID_DEF.BufObj_Dx@ */ /end MEASUREMENT
/begin MEASUREMENT autosar_swc_tos_rtARID_DEF.BufObj_Dx_i "" FLOAT32_IEEE autosar_swc_tos_CM_single 0 0 -3.4E+38 3.4E+38 LAYOUT COLUMN_DIR MATRIX_DIM 5 ECU_ADDRESS 0xfe4c4adc /* @ECU_Address@autosar_swc_tos_rtARID_DEF.BufObj_Dx_i@ */ /end MEASUREMENT
/begin MEASUREMENT autosar_swc_tos_rtARID_DEF.BufObj_Dy "" FLOAT32_IEEE autosar_swc_tos_CM_single 0 0 -3.4E+38 3.4E+38 LAYOUT COLUMN_DIR MATRIX_DIM 20 ECU_ADDRESS 0xfe4c40c8 /* @ECU_Address@autosar_swc_tos_rtARID_DEF.BufObj_Dy@ */ /end MEASUREMENT
/begin MEASUREMENT autosar_swc_tos_rtARID_DEF.BufObj_Dy_d "" FLOAT32_IEEE autosar_swc_tos_CM_single 0 0 -3.4E+38 3.4E+38 LAYOUT COLUMN_DIR MATRIX_DIM 5 ECU_ADDRESS 0xfe4c4ac8 /* @ECU_Address@autosar_swc_tos_rtARID_DEF.BufObj_Dy_d@ */ /end MEASUREMENT
/begin MEASUREMENT autosar_swc_tos_rtARID_DEF.BufObj_HeadingAngle "" FLOAT32_IEEE autosar_swc_tos_CM_single 0 0 -3.4E+38 3.4E+38 LAYOUT COLUMN_DIR MATRIX_DIM 20 ECU_ADDRESS 0xfe4c4208 /* @ECU_Address@autosar_swc_tos_rtARID_DEF.BufObj_HeadingAngle@ */ /end MEASUREMENT
/begin MEASUREMENT autosar_swc_tos_rtARID_DEF.BufObj_HeadingAngle_g "" FLOAT32_IEEE autosar_swc_tos_CM_single 0 0 -3.4E+38 3.4E+38 LAYOUT COLUMN_DIR MATRIX_DIM 5 ECU_ADDRESS 0xfe4c4b18 /* @ECU_Address@autosar_swc_tos_rtARID_DEF.BufObj_HeadingAngle_g@ */ /end MEASUREMENT
/begin MEASUREMENT autosar_swc_tos_rtARID_DEF.BufObj_Id "" ULONG autosar_swc_tos_CM_uint32 0 0 0 4294967295 LAYOUT COLUMN_DIR MATRIX_DIM 20 ECU_ADDRESS 0xfe4c4f38 /* @ECU_Address@autosar_swc_tos_rtARID_DEF.BufObj_Id@ */ /end MEASUREMENT
/begin MEASUREMENT autosar_swc_tos_rtARID_DEF.BufObj_Id_p "" ULONG autosar_swc_tos_CM_uint32 0 0 0 4294967295 LAYOUT COLUMN_DIR MATRIX_DIM 5 ECU_ADDRESS 0xfe4c5040 /* @ECU_Address@autosar_swc_tos_rtARID_DEF.BufObj_Id_p@ */ /end MEASUREMENT
/begin MEASUREMENT autosar_swc_tos_rtARID_DEF.BufObj_Invalid "" UBYTE autosar_swc_tos_CM_logical 0 0 0 1 LAYOUT COLUMN_DIR MATRIX_DIM 5 ECU_ADDRESS 0xfe4c920d /* @ECU_Address@autosar_swc_tos_rtARID_DEF.BufObj_Invalid@ */ /end MEASUREMENT
/begin MEASUREMENT autosar_swc_tos_rtARID_DEF.BufObj_LostAge "" ULONG autosar_swc_tos_CM_uint32 0 0 0 4294967295 LAYOUT COLUMN_DIR MATRIX_DIM 20 ECU_ADDRESS 0xfe4c4fd8 /* @ECU_Address@autosar_swc_tos_rtARID_DEF.BufObj_LostAge@ */ /end MEASUREMENT
/begin MEASUREMENT autosar_swc_tos_rtARID_DEF.BufObj_LostAge_f "" ULONG autosar_swc_tos_CM_uint32 0 0 0 4294967295 LAYOUT COLUMN_DIR MATRIX_DIM 5 ECU_ADDRESS 0xfe4c5068 /* @ECU_Address@autosar_swc_tos_rtARID_DEF.BufObj_LostAge_f@ */ /end MEASUREMENT
/begin MEASUREMENT autosar_swc_tos_rtARID_DEF.BufObj_MovingState "" FLOAT32_IEEE autosar_swc_tos_CM_single 0 0 -3.4E+38 3.4E+38 LAYOUT COLUMN_DIR MATRIX_DIM 20 ECU_ADDRESS 0xfe4c4258 /* @ECU_Address@autosar_swc_tos_rtARID_DEF.BufObj_MovingState@ */ /end MEASUREMENT
/begin MEASUREMENT autosar_swc_tos_rtARID_DEF.BufObj_MovingState_g "" FLOAT32_IEEE autosar_swc_tos_CM_single 0 0 -3.4E+38 3.4E+38 LAYOUT COLUMN_DIR MATRIX_DIM 5 ECU_ADDRESS 0xfe4c4b2c /* @ECU_Address@autosar_swc_tos_rtARID_DEF.BufObj_MovingState_g@ */ /end MEASUREMENT
/begin MEASUREMENT autosar_swc_tos_rtARID_DEF.BufObj_TrackAge "" ULONG autosar_swc_tos_CM_uint32 0 0 0 4294967295 LAYOUT COLUMN_DIR MATRIX_DIM 20 ECU_ADDRESS 0xfe4c4f88 /* @ECU_Address@autosar_swc_tos_rtARID_DEF.BufObj_TrackAge@ */ /end MEASUREMENT
/begin MEASUREMENT autosar_swc_tos_rtARID_DEF.BufObj_TrackAge_p "" ULONG autosar_swc_tos_CM_uint32 0 0 0 4294967295 LAYOUT COLUMN_DIR MATRIX_DIM 5 ECU_ADDRESS 0xfe4c5054 /* @ECU_Address@autosar_swc_tos_rtARID_DEF.BufObj_TrackAge_p@ */ /end MEASUREMENT
/begin MEASUREMENT autosar_swc_tos_rtARID_DEF.BufObj_TrackSts "" UBYTE autosar_swc_tos_CM_uint8 0 0 0 255 LAYOUT COLUMN_DIR MATRIX_DIM 20 ECU_ADDRESS 0xfe4c513b /* @ECU_Address@autosar_swc_tos_rtARID_DEF.BufObj_TrackSts@ */ /end MEASUREMENT
/begin MEASUREMENT autosar_swc_tos_rtARID_DEF.BufObj_TrackSts_b "" UBYTE autosar_swc_tos_CM_uint8 0 0 0 255 LAYOUT COLUMN_DIR MATRIX_DIM 5 ECU_ADDRESS 0xfe4c516d /* @ECU_Address@autosar_swc_tos_rtARID_DEF.BufObj_TrackSts_b@ */ /end MEASUREMENT
/begin MEASUREMENT autosar_swc_tos_rtARID_DEF.BufObj_VxG "" FLOAT32_IEEE autosar_swc_tos_CM_single 0 0 -3.4E+38 3.4E+38 LAYOUT COLUMN_DIR MATRIX_DIM 20 ECU_ADDRESS 0xfe4c4168 /* @ECU_Address@autosar_swc_tos_rtARID_DEF.BufObj_VxG@ */ /end MEASUREMENT
/begin MEASUREMENT autosar_swc_tos_rtARID_DEF.BufObj_VxG_m "" FLOAT32_IEEE autosar_swc_tos_CM_single 0 0 -3.4E+38 3.4E+38 LAYOUT COLUMN_DIR MATRIX_DIM 5 ECU_ADDRESS 0xfe4c4af0 /* @ECU_Address@autosar_swc_tos_rtARID_DEF.BufObj_VxG_m@ */ /end MEASUREMENT
/begin MEASUREMENT autosar_swc_tos_rtARID_DEF.BufObj_VyG "" FLOAT32_IEEE autosar_swc_tos_CM_single 0 0 -3.4E+38 3.4E+38 LAYOUT COLUMN_DIR MATRIX_DIM 20 ECU_ADDRESS 0xfe4c41b8 /* @ECU_Address@autosar_swc_tos_rtARID_DEF.BufObj_VyG@ */ /end MEASUREMENT
/begin MEASUREMENT autosar_swc_tos_rtARID_DEF.BufObj_VyG_p "" FLOAT32_IEEE autosar_swc_tos_CM_single 0 0 -3.4E+38 3.4E+38 LAYOUT COLUMN_DIR MATRIX_DIM 5 ECU_ADDRESS 0xfe4c4b04 /* @ECU_Address@autosar_swc_tos_rtARID_DEF.BufObj_VyG_p@ */ /end MEASUREMENT
/begin MEASUREMENT autosar_swc_tos_rtARID_DEF.BufObj_width "" FLOAT32_IEEE autosar_swc_tos_CM_single 0 0 -3.4E+38 3.4E+38 LAYOUT COLUMN_DIR MATRIX_DIM 20 ECU_ADDRESS 0xfe4c42a8 /* @ECU_Address@autosar_swc_tos_rtARID_DEF.BufObj_width@ */ /end MEASUREMENT
/begin MEASUREMENT autosar_swc_tos_rtARID_DEF.BufObj_width_f "" FLOAT32_IEEE autosar_swc_tos_CM_single 0 0 -3.4E+38 3.4E+38 LAYOUT COLUMN_DIR MATRIX_DIM 5 ECU_ADDRESS 0xfe4c4b40 /* @ECU_Address@autosar_swc_tos_rtARID_DEF.BufObj_width_f@ */ /end MEASUREMENT
/begin MEASUREMENT autosar_swc_tos_rtARID_DEF.BufUsedNum "" FLOAT32_IEEE autosar_swc_tos_CM_single 0 0 -3.4E+38 3.4E+38 ECU_ADDRESS 0xfe4c4bb0 /* @ECU_Address@autosar_swc_tos_rtARID_DEF.BufUsedNum@ */ /end MEASUREMENT
/begin MEASUREMENT autosar_swc_tos_rtARID_DEF.BufUsedNum_f "" FLOAT32_IEEE autosar_swc_tos_CM_single 0 0 -3.4E+38 3.4E+38 ECU_ADDRESS 0xfe4c4bb8 /* @ECU_Address@autosar_swc_tos_rtARID_DEF.BufUsedNum_f@ */ /end MEASUREMENT
/begin MEASUREMENT autosar_swc_tos_rtARID_DEF.Cnt "" UBYTE autosar_swc_tos_CM_uint8 0 0 0 255 ECU_ADDRESS 0xfe4c9193 /* @ECU_Address@autosar_swc_tos_rtARID_DEF.Cnt@ */ /end MEASUREMENT
/begin MEASUREMENT autosar_swc_tos_rtARID_DEF.Cnt1 "" UBYTE autosar_swc_tos_CM_uint8 0 0 0 255 ECU_ADDRESS 0xfe4c918f /* @ECU_Address@autosar_swc_tos_rtARID_DEF.Cnt1@ */ /end MEASUREMENT
/begin MEASUREMENT autosar_swc_tos_rtARID_DEF.Cnt2 "" UBYTE autosar_swc_tos_CM_uint8 0 0 0 255 ECU_ADDRESS 0xfe4c9190 /* @ECU_Address@autosar_swc_tos_rtARID_DEF.Cnt2@ */ /end MEASUREMENT
/begin MEASUREMENT autosar_swc_tos_rtARID_DEF.ContinuousNudge "" UBYTE autosar_swc_tos_CM_logical 0 0 0 1 ECU_ADDRESS 0xfe4c9241 /* @ECU_Address@autosar_swc_tos_rtARID_DEF.ContinuousNudge@ */ /end MEASUREMENT
/begin MEASUREMENT autosar_swc_tos_rtARID_DEF.ContinuousNudgeTime "" FLOAT32_IEEE autosar_swc_tos_CM_single 0 0 -3.4E+38 3.4E+38 ECU_ADDRESS 0xfe4c4be0 /* @ECU_Address@autosar_swc_tos_rtARID_DEF.ContinuousNudgeTime@ */ /end MEASUREMENT
/begin MEASUREMENT autosar_swc_tos_rtARID_DEF.ContinuousNudgeTime_not_empty "" UBYTE autosar_swc_tos_CM_logical 0 0 0 1 ECU_ADDRESS 0xfe4c9242 /* @ECU_Address@autosar_swc_tos_rtARID_DEF.ContinuousNudgeTime_not_empty@ */ /end MEASUREMENT
/begin MEASUREMENT autosar_swc_tos_rtARID_DEF.DOPSelectPrecheck "" UBYTE autosar_swc_tos_CM_logical 0 0 0 1 LAYOUT COLUMN_DIR MATRIX_DIM 6 ECU_ADDRESS 0xfe4c91ed /* @ECU_Address@autosar_swc_tos_rtARID_DEF.DOPSelectPrecheck@ */ /end MEASUREMENT
/begin MEASUREMENT autosar_swc_tos_rtARID_DEF.DOPSelectPrecheckId "" ULONG autosar_swc_tos_CM_uint32 0 0 0 4294967295 LAYOUT COLUMN_DIR MATRIX_DIM 6 ECU_ADDRESS 0xfe4c4f20 /* @ECU_Address@autosar_swc_tos_rtARID_DEF.DOPSelectPrecheckId@ */ /end MEASUREMENT
/begin MEASUREMENT autosar_swc_tos_rtARID_DEF.DOPSelectPrecheckId_m "" ULONG autosar_swc_tos_CM_uint32 0 0 0 4294967295 LAYOUT COLUMN_DIR MATRIX_DIM 6 ECU_ADDRESS 0xfe4c5028 /* @ECU_Address@autosar_swc_tos_rtARID_DEF.DOPSelectPrecheckId_m@ */ /end MEASUREMENT
/begin MEASUREMENT autosar_swc_tos_rtARID_DEF.DOPSelectPrecheck_i "" UBYTE autosar_swc_tos_CM_logical 0 0 0 1 LAYOUT COLUMN_DIR MATRIX_DIM 6 ECU_ADDRESS 0xfe4c91f3 /* @ECU_Address@autosar_swc_tos_rtARID_DEF.DOPSelectPrecheck_i@ */ /end MEASUREMENT
/begin MEASUREMENT autosar_swc_tos_rtARID_DEF.DOPSelectReason "" UBYTE autosar_swc_tos_CM_uint8 0 0 0 255 ECU_ADDRESS 0xfe4c918c /* @ECU_Address@autosar_swc_tos_rtARID_DEF.DOPSelectReason@ */ /end MEASUREMENT
/begin MEASUREMENT autosar_swc_tos_rtARID_DEF.DOPSelectReason_g "" UBYTE autosar_swc_tos_CM_uint8 0 0 0 255 ECU_ADDRESS 0xfe4c918e /* @ECU_Address@autosar_swc_tos_rtARID_DEF.DOPSelectReason_g@ */ /end MEASUREMENT
/begin MEASUREMENT autosar_swc_tos_rtARID_DEF.Delay10_DSTATE "" FLOAT32_IEEE autosar_swc_tos_CM_single 0 0 -3.4E+38 3.4E+38 ECU_ADDRESS 0xfe4c4b58 /* @ECU_Address@autosar_swc_tos_rtARID_DEF.Delay10_DSTATE@ */ /end MEASUREMENT
/begin MEASUREMENT autosar_swc_tos_rtARID_DEF.Delay10_DSTATE_d "" FLOAT32_IEEE autosar_swc_tos_CM_single 0 0 -3.4E+38 3.4E+38 LAYOUT COLUMN_DIR MATRIX_DIM 2 ECU_ADDRESS 0xfe4c38e8 /* @ECU_Address@autosar_swc_tos_rtARID_DEF.Delay10_DSTATE_d@ */ /end MEASUREMENT
/begin MEASUREMENT autosar_swc_tos_rtARID_DEF.Delay11_DSTATE "" FLOAT32_IEEE autosar_swc_tos_CM_single 0 0 -3.4E+38 3.4E+38 ECU_ADDRESS 0xfe4c4b68 /* @ECU_Address@autosar_swc_tos_rtARID_DEF.Delay11_DSTATE@ */ /end MEASUREMENT
/begin MEASUREMENT autosar_swc_tos_rtARID_DEF.Delay11_DSTATE_f "" UBYTE autosar_swc_tos_CM_uint8 0 0 0 255 ECU_ADDRESS 0xfe4c917e /* @ECU_Address@autosar_swc_tos_rtARID_DEF.Delay11_DSTATE_f@ */ /end MEASUREMENT
/begin MEASUREMENT autosar_swc_tos_rtARID_DEF.Delay12_DSTATE "" FLOAT32_IEEE autosar_swc_tos_CM_single 0 0 -3.4E+38 3.4E+38 ECU_ADDRESS 0xfe4c4b6c /* @ECU_Address@autosar_swc_tos_rtARID_DEF.Delay12_DSTATE@ */ /end MEASUREMENT
/begin MEASUREMENT autosar_swc_tos_rtARID_DEF.Delay12_DSTATE_e "" FLOAT32_IEEE autosar_swc_tos_CM_single 0 0 -3.4E+38 3.4E+38 LAYOUT COLUMN_DIR MATRIX_DIM 64 ECU_ADDRESS 0xfe4c37e8 /* @ECU_Address@autosar_swc_tos_rtARID_DEF.Delay12_DSTATE_e@ */ /end MEASUREMENT
/begin MEASUREMENT autosar_swc_tos_rtARID_DEF.Delay13_DSTATE "" FLOAT32_IEEE autosar_swc_tos_CM_single 0 0 -3.4E+38 3.4E+38 ECU_ADDRESS 0xfe4c4b70 /* @ECU_Address@autosar_swc_tos_rtARID_DEF.Delay13_DSTATE@ */ /end MEASUREMENT
/begin MEASUREMENT autosar_swc_tos_rtARID_DEF.Delay14_DSTATE "" FLOAT32_IEEE autosar_swc_tos_CM_single 0 0 -3.4E+38 3.4E+38 ECU_ADDRESS 0xfe4c4b74 /* @ECU_Address@autosar_swc_tos_rtARID_DEF.Delay14_DSTATE@ */ /end MEASUREMENT
/begin MEASUREMENT autosar_swc_tos_rtARID_DEF.Delay1_DSTATE_c "" ULONG autosar_swc_tos_CM_uint32 0 0 0 4294967295 ECU_ADDRESS 0xfe4c5084 /* @ECU_Address@autosar_swc_tos_rtARID_DEF.Delay1_DSTATE_c@ */ /end MEASUREMENT
/begin MEASUREMENT autosar_swc_tos_rtARID_DEF.Delay1_DSTATE_c4 "" UBYTE autosar_swc_tos_CM_uint8 0 0 0 255 ECU_ADDRESS 0xfe4c917c /* @ECU_Address@autosar_swc_tos_rtARID_DEF.Delay1_DSTATE_c4@ */ /end MEASUREMENT
/begin MEASUREMENT autosar_swc_tos_rtARID_DEF.Delay1_DSTATE_d "" FLOAT32_IEEE autosar_swc_tos_CM_single 0 0 -3.4E+38 3.4E+38 ECU_ADDRESS 0xfe4c4b94 /* @ECU_Address@autosar_swc_tos_rtARID_DEF.Delay1_DSTATE_d@ */ /end MEASUREMENT
/begin MEASUREMENT autosar_swc_tos_rtARID_DEF.Delay1_DSTATE_dp "" ULONG autosar_swc_tos_CM_uint32 0 0 0 4294967295 ECU_ADDRESS 0xfe4c5088 /* @ECU_Address@autosar_swc_tos_rtARID_DEF.Delay1_DSTATE_dp@ */ /end MEASUREMENT
/begin MEASUREMENT autosar_swc_tos_rtARID_DEF.Delay1_DSTATE_i "" FLOAT32_IEEE autosar_swc_tos_CM_single 0 0 -3.4E+38 3.4E+38 ECU_ADDRESS 0xfe4c4ba0 /* @ECU_Address@autosar_swc_tos_rtARID_DEF.Delay1_DSTATE_i@ */ /end MEASUREMENT
/begin MEASUREMENT autosar_swc_tos_rtARID_DEF.Delay1_DSTATE_l "" UBYTE autosar_swc_tos_CM_uint8 0 0 0 255 ECU_ADDRESS 0xfe4c9183 /* @ECU_Address@autosar_swc_tos_rtARID_DEF.Delay1_DSTATE_l@ */ /end MEASUREMENT
/begin MEASUREMENT autosar_swc_tos_rtARID_DEF.Delay2_DSTATE_b "" FLOAT32_IEEE autosar_swc_tos_CM_single 0 0 -3.4E+38 3.4E+38 ECU_ADDRESS 0xfe4c4b80 /* @ECU_Address@autosar_swc_tos_rtARID_DEF.Delay2_DSTATE_b@ */ /end MEASUREMENT
/begin MEASUREMENT autosar_swc_tos_rtARID_DEF.Delay2_DSTATE_bm "" ULONG autosar_swc_tos_CM_uint32 0 0 0 4294967295 ECU_ADDRESS 0xfe4c5080 /* @ECU_Address@autosar_swc_tos_rtARID_DEF.Delay2_DSTATE_bm@ */ /end MEASUREMENT
/begin MEASUREMENT autosar_swc_tos_rtARID_DEF.Delay2_DSTATE_d "" FLOAT32_IEEE autosar_swc_tos_CM_single 0 0 -3.4E+38 3.4E+38 ECU_ADDRESS 0xfe4c4b9c /* @ECU_Address@autosar_swc_tos_rtARID_DEF.Delay2_DSTATE_d@ */ /end MEASUREMENT
/begin MEASUREMENT autosar_swc_tos_rtARID_DEF.Delay2_DSTATE_j "" FLOAT32_IEEE autosar_swc_tos_CM_single 0 0 -3.4E+38 3.4E+38 LAYOUT COLUMN_DIR MATRIX_DIM 2 ECU_ADDRESS 0xfe4c38f0 /* @ECU_Address@autosar_swc_tos_rtARID_DEF.Delay2_DSTATE_j@ */ /end MEASUREMENT
/begin MEASUREMENT autosar_swc_tos_rtARID_DEF.Delay2_DSTATE_p "" UBYTE autosar_swc_tos_CM_uint8 0 0 0 255 ECU_ADDRESS 0xfe4c9184 /* @ECU_Address@autosar_swc_tos_rtARID_DEF.Delay2_DSTATE_p@ */ /end MEASUREMENT
/begin MEASUREMENT autosar_swc_tos_rtARID_DEF.Delay3_DSTATE_e "" FLOAT32_IEEE autosar_swc_tos_CM_single 0 0 -3.4E+38 3.4E+38 ECU_ADDRESS 0xfe4c4ba4 /* @ECU_Address@autosar_swc_tos_rtARID_DEF.Delay3_DSTATE_e@ */ /end MEASUREMENT
/begin MEASUREMENT autosar_swc_tos_rtARID_DEF.Delay3_DSTATE_k "" FLOAT32_IEEE autosar_swc_tos_CM_single 0 0 -3.4E+38 3.4E+38 ECU_ADDRESS 0xfe4c4b8c /* @ECU_Address@autosar_swc_tos_rtARID_DEF.Delay3_DSTATE_k@ */ /end MEASUREMENT
/begin MEASUREMENT autosar_swc_tos_rtARID_DEF.Delay3_DSTATE_n "" UBYTE autosar_swc_tos_CM_uint8 0 0 0 255 ECU_ADDRESS 0xfe4c9186 /* @ECU_Address@autosar_swc_tos_rtARID_DEF.Delay3_DSTATE_n@ */ /end MEASUREMENT
/begin MEASUREMENT autosar_swc_tos_rtARID_DEF.Delay3_DSTATE_o "" ULONG autosar_swc_tos_CM_uint32 0 0 0 4294967295 ECU_ADDRESS 0xfe4c507c /* @ECU_Address@autosar_swc_tos_rtARID_DEF.Delay3_DSTATE_o@ */ /end MEASUREMENT
/begin MEASUREMENT autosar_swc_tos_rtARID_DEF.Delay3_DSTATE_p "" FLOAT32_IEEE autosar_swc_tos_CM_single 0 0 -3.4E+38 3.4E+38 ECU_ADDRESS 0xfe4c4b78 /* @ECU_Address@autosar_swc_tos_rtARID_DEF.Delay3_DSTATE_p@ */ /end MEASUREMENT
/begin MEASUREMENT autosar_swc_tos_rtARID_DEF.Delay4_DSTATE_h "" UBYTE autosar_swc_tos_CM_uint8 0 0 0 255 ECU_ADDRESS 0xfe4c9187 /* @ECU_Address@autosar_swc_tos_rtARID_DEF.Delay4_DSTATE_h@ */ /end MEASUREMENT
/begin MEASUREMENT autosar_swc_tos_rtARID_DEF.Delay4_DSTATE_j "" UBYTE autosar_swc_tos_CM_logical 0 0 0 1 ECU_ADDRESS 0xfe4c9233 /* @ECU_Address@autosar_swc_tos_rtARID_DEF.Delay4_DSTATE_j@ */ /end MEASUREMENT
/begin MEASUREMENT autosar_swc_tos_rtARID_DEF.Delay4_DSTATE_k "" FLOAT32_IEEE autosar_swc_tos_CM_single 0 0 -3.4E+38 3.4E+38 ECU_ADDRESS 0xfe4c4b88 /* @ECU_Address@autosar_swc_tos_rtARID_DEF.Delay4_DSTATE_k@ */ /end MEASUREMENT
/begin MEASUREMENT autosar_swc_tos_rtARID_DEF.Delay5_DSTATE_a "" UBYTE autosar_swc_tos_CM_uint8 0 0 0 255 ECU_ADDRESS 0xfe4c9188 /* @ECU_Address@autosar_swc_tos_rtARID_DEF.Delay5_DSTATE_a@ */ /end MEASUREMENT
/begin MEASUREMENT autosar_swc_tos_rtARID_DEF.Delay5_DSTATE_e "" UBYTE autosar_swc_tos_CM_uint8 0 0 0 255 ECU_ADDRESS 0xfe4c917f /* @ECU_Address@autosar_swc_tos_rtARID_DEF.Delay5_DSTATE_e@ */ /end MEASUREMENT
/begin MEASUREMENT autosar_swc_tos_rtARID_DEF.Delay5_DSTATE_m "" FLOAT32_IEEE autosar_swc_tos_CM_single 0 0 -3.4E+38 3.4E+38 ECU_ADDRESS 0xfe4c4b90 /* @ECU_Address@autosar_swc_tos_rtARID_DEF.Delay5_DSTATE_m@ */ /end MEASUREMENT
/begin MEASUREMENT autosar_swc_tos_rtARID_DEF.Delay6_DSTATE_g "" UBYTE autosar_swc_tos_CM_uint8 0 0 0 255 ECU_ADDRESS 0xfe4c9189 /* @ECU_Address@autosar_swc_tos_rtARID_DEF.Delay6_DSTATE_g@ */ /end MEASUREMENT
/begin MEASUREMENT autosar_swc_tos_rtARID_DEF.Delay6_DSTATE_l "" FLOAT32_IEEE autosar_swc_tos_CM_single 0 0 -3.4E+38 3.4E+38 ECU_ADDRESS 0xfe4c4b5c /* @ECU_Address@autosar_swc_tos_rtARID_DEF.Delay6_DSTATE_l@ */ /end MEASUREMENT
/begin MEASUREMENT autosar_swc_tos_rtARID_DEF.Delay7_DSTATE "" FLOAT32_IEEE autosar_swc_tos_CM_single 0 0 -3.4E+38 3.4E+38 ECU_ADDRESS 0xfe4c4b54 /* @ECU_Address@autosar_swc_tos_rtARID_DEF.Delay7_DSTATE@ */ /end MEASUREMENT
/begin MEASUREMENT autosar_swc_tos_rtARID_DEF.Delay7_DSTATE_j "" UBYTE autosar_swc_tos_CM_uint8 0 0 0 255 ECU_ADDRESS 0xfe4c9182 /* @ECU_Address@autosar_swc_tos_rtARID_DEF.Delay7_DSTATE_j@ */ /end MEASUREMENT
/begin MEASUREMENT autosar_swc_tos_rtARID_DEF.Delay8_DSTATE "" FLOAT32_IEEE autosar_swc_tos_CM_single 0 0 -3.4E+38 3.4E+38 ECU_ADDRESS 0xfe4c4b64 /* @ECU_Address@autosar_swc_tos_rtARID_DEF.Delay8_DSTATE@ */ /end MEASUREMENT
/begin MEASUREMENT autosar_swc_tos_rtARID_DEF.Delay8_DSTATE_n "" UBYTE autosar_swc_tos_CM_uint8 0 0 0 255 ECU_ADDRESS 0xfe4c918a /* @ECU_Address@autosar_swc_tos_rtARID_DEF.Delay8_DSTATE_n@ */ /end MEASUREMENT
/begin MEASUREMENT autosar_swc_tos_rtARID_DEF.Delay9_DSTATE "" FLOAT32_IEEE autosar_swc_tos_CM_single 0 0 -3.4E+38 3.4E+38 ECU_ADDRESS 0xfe4c4b60 /* @ECU_Address@autosar_swc_tos_rtARID_DEF.Delay9_DSTATE@ */ /end MEASUREMENT
/begin MEASUREMENT autosar_swc_tos_rtARID_DEF.Delay9_DSTATE_j "" FLOAT32_IEEE autosar_swc_tos_CM_single 0 0 -3.4E+38 3.4E+38 ECU_ADDRESS 0xfe4c4b7c /* @ECU_Address@autosar_swc_tos_rtARID_DEF.Delay9_DSTATE_j@ */ /end MEASUREMENT
/begin MEASUREMENT autosar_swc_tos_rtARID_DEF.Delay9_DSTATE_l "" UBYTE autosar_swc_tos_CM_uint8 0 0 0 255 ECU_ADDRESS 0xfe4c9185 /* @ECU_Address@autosar_swc_tos_rtARID_DEF.Delay9_DSTATE_l@ */ /end MEASUREMENT
/begin MEASUREMENT autosar_swc_tos_rtARID_DEF.Delay_DSTATE.Object_Hight "" FLOAT32_IEEE autosar_swc_tos_CM_single 0 0 -3.4E+38 3.4E+38 ECU_ADDRESS 0xfe4c35ac /* @ECU_Address@autosar_swc_tos_rtARID_DEF.Delay_DSTATE.Object_Hight@ */ /end MEASUREMENT
/begin MEASUREMENT autosar_swc_tos_rtARID_DEF.Delay_DSTATE.Object_Length "" FLOAT32_IEEE autosar_swc_tos_CM_single 0 0 -3.4E+38 3.4E+38 ECU_ADDRESS 0xfe4c35a4 /* @ECU_Address@autosar_swc_tos_rtARID_DEF.Delay_DSTATE.Object_Length@ */ /end MEASUREMENT
/begin MEASUREMENT autosar_swc_tos_rtARID_DEF.Delay_DSTATE.Object_Width "" FLOAT32_IEEE autosar_swc_tos_CM_single 0 0 -3.4E+38 3.4E+38 ECU_ADDRESS 0xfe4c35a8 /* @ECU_Address@autosar_swc_tos_rtARID_DEF.Delay_DSTATE.Object_Width@ */ /end MEASUREMENT
/begin MEASUREMENT autosar_swc_tos_rtARID_DEF.Delay_DSTATE.age "" A_UINT64 autosar_swc_tos_CM_uint64 0 0 0 18446744073709551615 ECU_ADDRESS 0xfe4c35b8 /* @ECU_Address@autosar_swc_tos_rtARID_DEF.Delay_DSTATE.age@ */ /end MEASUREMENT
/begin MEASUREMENT autosar_swc_tos_rtARID_DEF.Delay_DSTATE.axAbs "" FLOAT32_IEEE autosar_swc_tos_CM_single 0 0 -3.4E+38 3.4E+38 ECU_ADDRESS 0xfe4c3590 /* @ECU_Address@autosar_swc_tos_rtARID_DEF.Delay_DSTATE.axAbs@ */ /end MEASUREMENT
/begin MEASUREMENT autosar_swc_tos_rtARID_DEF.Delay_DSTATE.ayAbs "" FLOAT32_IEEE autosar_swc_tos_CM_single 0 0 -3.4E+38 3.4E+38 ECU_ADDRESS 0xfe4c3594 /* @ECU_Address@autosar_swc_tos_rtARID_DEF.Delay_DSTATE.ayAbs@ */ /end MEASUREMENT
/begin MEASUREMENT autosar_swc_tos_rtARID_DEF.Delay_DSTATE.brakeIntention "" UBYTE autosar_swc_tos_CM_logical 0 0 0 1 ECU_ADDRESS 0xfe4c3572 /* @ECU_Address@autosar_swc_tos_rtARID_DEF.Delay_DSTATE.brakeIntention@ */ /end MEASUREMENT
/begin MEASUREMENT autosar_swc_tos_rtARID_DEF.Delay_DSTATE.cutInflg "" UBYTE autosar_swc_tos_CM_logical 0 0 0 1 ECU_ADDRESS 0xfe4c3571 /* @ECU_Address@autosar_swc_tos_rtARID_DEF.Delay_DSTATE.cutInflg@ */ /end MEASUREMENT
/begin MEASUREMENT autosar_swc_tos_rtARID_DEF.Delay_DSTATE.dx "" FLOAT32_IEEE autosar_swc_tos_CM_single 0 0 -3.4E+38 3.4E+38 ECU_ADDRESS 0xfe4c3578 /* @ECU_Address@autosar_swc_tos_rtARID_DEF.Delay_DSTATE.dx@ */ /end MEASUREMENT
/begin MEASUREMENT autosar_swc_tos_rtARID_DEF.Delay_DSTATE.dy "" FLOAT32_IEEE autosar_swc_tos_CM_single 0 0 -3.4E+38 3.4E+38 ECU_ADDRESS 0xfe4c357c /* @ECU_Address@autosar_swc_tos_rtARID_DEF.Delay_DSTATE.dy@ */ /end MEASUREMENT
/begin MEASUREMENT autosar_swc_tos_rtARID_DEF.Delay_DSTATE.fu_type "" UWORD autosar_swc_tos_CM_uint16 0 0 0 65535 ECU_ADDRESS 0xfe4c3576 /* @ECU_Address@autosar_swc_tos_rtARID_DEF.Delay_DSTATE.fu_type@ */ /end MEASUREMENT
/begin MEASUREMENT autosar_swc_tos_rtARID_DEF.Delay_DSTATE.headingAngle "" FLOAT32_IEEE autosar_swc_tos_CM_single 0 0 -3.4E+38 3.4E+38 ECU_ADDRESS 0xfe4c35a0 /* @ECU_Address@autosar_swc_tos_rtARID_DEF.Delay_DSTATE.headingAngle@ */ /end MEASUREMENT
/begin MEASUREMENT autosar_swc_tos_rtARID_DEF.Delay_DSTATE.id "" ULONG autosar_swc_tos_CM_uint32 0 0 0 4294967295 ECU_ADDRESS 0xfe4c35b0 /* @ECU_Address@autosar_swc_tos_rtARID_DEF.Delay_DSTATE.id@ */ /end MEASUREMENT
/begin MEASUREMENT autosar_swc_tos_rtARID_DEF.Delay_DSTATE.movingState "" UBYTE autosar_swc_tos_CM_uint8 0 0 0 255 ECU_ADDRESS 0xfe4c3573 /* @ECU_Address@autosar_swc_tos_rtARID_DEF.Delay_DSTATE.movingState@ */ /end MEASUREMENT
/begin MEASUREMENT autosar_swc_tos_rtARID_DEF.Delay_DSTATE.objExist "" FLOAT32_IEEE autosar_swc_tos_CM_single 0 0 -3.4E+38 3.4E+38 ECU_ADDRESS 0xfe4c359c /* @ECU_Address@autosar_swc_tos_rtARID_DEF.Delay_DSTATE.objExist@ */ /end MEASUREMENT
/begin MEASUREMENT autosar_swc_tos_rtARID_DEF.Delay_DSTATE.orientation "" UBYTE autosar_swc_tos_CM_uint8 0 0 0 255 ECU_ADDRESS 0xfe4c3574 /* @ECU_Address@autosar_swc_tos_rtARID_DEF.Delay_DSTATE.orientation@ */ /end MEASUREMENT
/begin MEASUREMENT autosar_swc_tos_rtARID_DEF.Delay_DSTATE.range "" FLOAT32_IEEE autosar_swc_tos_CM_single 0 0 -3.4E+38 3.4E+38 ECU_ADDRESS 0xfe4c3598 /* @ECU_Address@autosar_swc_tos_rtARID_DEF.Delay_DSTATE.range@ */ /end MEASUREMENT
/begin MEASUREMENT autosar_swc_tos_rtARID_DEF.Delay_DSTATE.targetExist "" UBYTE autosar_swc_tos_CM_logical 0 0 0 1 ECU_ADDRESS 0xfe4c3570 /* @ECU_Address@autosar_swc_tos_rtARID_DEF.Delay_DSTATE.targetExist@ */ /end MEASUREMENT
/begin MEASUREMENT autosar_swc_tos_rtARID_DEF.Delay_DSTATE.type "" UBYTE autosar_swc_tos_CM_uint8 0 0 0 255 ECU_ADDRESS 0xfe4c3575 /* @ECU_Address@autosar_swc_tos_rtARID_DEF.Delay_DSTATE.type@ */ /end MEASUREMENT
/begin MEASUREMENT autosar_swc_tos_rtARID_DEF.Delay_DSTATE.vxAbs "" FLOAT32_IEEE autosar_swc_tos_CM_single 0 0 -3.4E+38 3.4E+38 ECU_ADDRESS 0xfe4c3588 /* @ECU_Address@autosar_swc_tos_rtARID_DEF.Delay_DSTATE.vxAbs@ */ /end MEASUREMENT
/begin MEASUREMENT autosar_swc_tos_rtARID_DEF.Delay_DSTATE.vxRel "" FLOAT32_IEEE autosar_swc_tos_CM_single 0 0 -3.4E+38 3.4E+38 ECU_ADDRESS 0xfe4c3580 /* @ECU_Address@autosar_swc_tos_rtARID_DEF.Delay_DSTATE.vxRel@ */ /end MEASUREMENT
/begin MEASUREMENT autosar_swc_tos_rtARID_DEF.Delay_DSTATE.vyAbs "" FLOAT32_IEEE autosar_swc_tos_CM_single 0 0 -3.4E+38 3.4E+38 ECU_ADDRESS 0xfe4c358c /* @ECU_Address@autosar_swc_tos_rtARID_DEF.Delay_DSTATE.vyAbs@ */ /end MEASUREMENT
/begin MEASUREMENT autosar_swc_tos_rtARID_DEF.Delay_DSTATE.vyRel "" FLOAT32_IEEE autosar_swc_tos_CM_single 0 0 -3.4E+38 3.4E+38 ECU_ADDRESS 0xfe4c3584 /* @ECU_Address@autosar_swc_tos_rtARID_DEF.Delay_DSTATE.vyRel@ */ /end MEASUREMENT
/begin MEASUREMENT autosar_swc_tos_rtARID_DEF.Delay_DSTATE_a "" UBYTE autosar_swc_tos_CM_uint8 0 0 0 255 ECU_ADDRESS 0xfe4c917d /* @ECU_Address@autosar_swc_tos_rtARID_DEF.Delay_DSTATE_a@ */ /end MEASUREMENT
/begin MEASUREMENT autosar_swc_tos_rtARID_DEF.Delay_DSTATE_c "" FLOAT32_IEEE autosar_swc_tos_CM_single 0 0 -3.4E+38 3.4E+38 ECU_ADDRESS 0xfe4c4ba8 /* @ECU_Address@autosar_swc_tos_rtARID_DEF.Delay_DSTATE_c@ */ /end MEASUREMENT
/begin MEASUREMENT autosar_swc_tos_rtARID_DEF.Delay_DSTATE_d.Object_Hight "" FLOAT32_IEEE autosar_swc_tos_CM_single 0 0 -3.4E+38 3.4E+38 ECU_ADDRESS 0xfe4c35fc /* @ECU_Address@autosar_swc_tos_rtARID_DEF.Delay_DSTATE_d.Object_Hight@ */ /end MEASUREMENT
/begin MEASUREMENT autosar_swc_tos_rtARID_DEF.Delay_DSTATE_d.Object_Length "" FLOAT32_IEEE autosar_swc_tos_CM_single 0 0 -3.4E+38 3.4E+38 ECU_ADDRESS 0xfe4c35f4 /* @ECU_Address@autosar_swc_tos_rtARID_DEF.Delay_DSTATE_d.Object_Length@ */ /end MEASUREMENT
/begin MEASUREMENT autosar_swc_tos_rtARID_DEF.Delay_DSTATE_d.Object_Width "" FLOAT32_IEEE autosar_swc_tos_CM_single 0 0 -3.4E+38 3.4E+38 ECU_ADDRESS 0xfe4c35f8 /* @ECU_Address@autosar_swc_tos_rtARID_DEF.Delay_DSTATE_d.Object_Width@ */ /end MEASUREMENT
/begin MEASUREMENT autosar_swc_tos_rtARID_DEF.Delay_DSTATE_d.age "" A_UINT64 autosar_swc_tos_CM_uint64 0 0 0 18446744073709551615 ECU_ADDRESS 0xfe4c3608 /* @ECU_Address@autosar_swc_tos_rtARID_DEF.Delay_DSTATE_d.age@ */ /end MEASUREMENT
/begin MEASUREMENT autosar_swc_tos_rtARID_DEF.Delay_DSTATE_d.axAbs "" FLOAT32_IEEE autosar_swc_tos_CM_single 0 0 -3.4E+38 3.4E+38 ECU_ADDRESS 0xfe4c35e0 /* @ECU_Address@autosar_swc_tos_rtARID_DEF.Delay_DSTATE_d.axAbs@ */ /end MEASUREMENT
/begin MEASUREMENT autosar_swc_tos_rtARID_DEF.Delay_DSTATE_d.ayAbs "" FLOAT32_IEEE autosar_swc_tos_CM_single 0 0 -3.4E+38 3.4E+38 ECU_ADDRESS 0xfe4c35e4 /* @ECU_Address@autosar_swc_tos_rtARID_DEF.Delay_DSTATE_d.ayAbs@ */ /end MEASUREMENT
/begin MEASUREMENT autosar_swc_tos_rtARID_DEF.Delay_DSTATE_d.brakeIntention "" UBYTE autosar_swc_tos_CM_logical 0 0 0 1 ECU_ADDRESS 0xfe4c35c2 /* @ECU_Address@autosar_swc_tos_rtARID_DEF.Delay_DSTATE_d.brakeIntention@ */ /end MEASUREMENT
/begin MEASUREMENT autosar_swc_tos_rtARID_DEF.Delay_DSTATE_d.cutInflg "" UBYTE autosar_swc_tos_CM_logical 0 0 0 1 ECU_ADDRESS 0xfe4c35c1 /* @ECU_Address@autosar_swc_tos_rtARID_DEF.Delay_DSTATE_d.cutInflg@ */ /end MEASUREMENT
/begin MEASUREMENT autosar_swc_tos_rtARID_DEF.Delay_DSTATE_d.dx "" FLOAT32_IEEE autosar_swc_tos_CM_single 0 0 -3.4E+38 3.4E+38 ECU_ADDRESS 0xfe4c35c8 /* @ECU_Address@autosar_swc_tos_rtARID_DEF.Delay_DSTATE_d.dx@ */ /end MEASUREMENT
/begin MEASUREMENT autosar_swc_tos_rtARID_DEF.Delay_DSTATE_d.dy "" FLOAT32_IEEE autosar_swc_tos_CM_single 0 0 -3.4E+38 3.4E+38 ECU_ADDRESS 0xfe4c35cc /* @ECU_Address@autosar_swc_tos_rtARID_DEF.Delay_DSTATE_d.dy@ */ /end MEASUREMENT
/begin MEASUREMENT autosar_swc_tos_rtARID_DEF.Delay_DSTATE_d.fu_type "" UWORD autosar_swc_tos_CM_uint16 0 0 0 65535 ECU_ADDRESS 0xfe4c35c6 /* @ECU_Address@autosar_swc_tos_rtARID_DEF.Delay_DSTATE_d.fu_type@ */ /end MEASUREMENT
/begin MEASUREMENT autosar_swc_tos_rtARID_DEF.Delay_DSTATE_d.headingAngle "" FLOAT32_IEEE autosar_swc_tos_CM_single 0 0 -3.4E+38 3.4E+38 ECU_ADDRESS 0xfe4c35f0 /* @ECU_Address@autosar_swc_tos_rtARID_DEF.Delay_DSTATE_d.headingAngle@ */ /end MEASUREMENT
/begin MEASUREMENT autosar_swc_tos_rtARID_DEF.Delay_DSTATE_d.id "" ULONG autosar_swc_tos_CM_uint32 0 0 0 4294967295 ECU_ADDRESS 0xfe4c3600 /* @ECU_Address@autosar_swc_tos_rtARID_DEF.Delay_DSTATE_d.id@ */ /end MEASUREMENT
/begin MEASUREMENT autosar_swc_tos_rtARID_DEF.Delay_DSTATE_d.movingState "" UBYTE autosar_swc_tos_CM_uint8 0 0 0 255 ECU_ADDRESS 0xfe4c35c3 /* @ECU_Address@autosar_swc_tos_rtARID_DEF.Delay_DSTATE_d.movingState@ */ /end MEASUREMENT
/begin MEASUREMENT autosar_swc_tos_rtARID_DEF.Delay_DSTATE_d.objExist "" FLOAT32_IEEE autosar_swc_tos_CM_single 0 0 -3.4E+38 3.4E+38 ECU_ADDRESS 0xfe4c35ec /* @ECU_Address@autosar_swc_tos_rtARID_DEF.Delay_DSTATE_d.objExist@ */ /end MEASUREMENT
/begin MEASUREMENT autosar_swc_tos_rtARID_DEF.Delay_DSTATE_d.orientation "" UBYTE autosar_swc_tos_CM_uint8 0 0 0 255 ECU_ADDRESS 0xfe4c35c4 /* @ECU_Address@autosar_swc_tos_rtARID_DEF.Delay_DSTATE_d.orientation@ */ /end MEASUREMENT
/begin MEASUREMENT autosar_swc_tos_rtARID_DEF.Delay_DSTATE_d.range "" FLOAT32_IEEE autosar_swc_tos_CM_single 0 0 -3.4E+38 3.4E+38 ECU_ADDRESS 0xfe4c35e8 /* @ECU_Address@autosar_swc_tos_rtARID_DEF.Delay_DSTATE_d.range@ */ /end MEASUREMENT
/begin MEASUREMENT autosar_swc_tos_rtARID_DEF.Delay_DSTATE_d.targetExist "" UBYTE autosar_swc_tos_CM_logical 0 0 0 1 ECU_ADDRESS 0xfe4c35c0 /* @ECU_Address@autosar_swc_tos_rtARID_DEF.Delay_DSTATE_d.targetExist@ */ /end MEASUREMENT
/begin MEASUREMENT autosar_swc_tos_rtARID_DEF.Delay_DSTATE_d.type "" UBYTE autosar_swc_tos_CM_uint8 0 0 0 255 ECU_ADDRESS 0xfe4c35c5 /* @ECU_Address@autosar_swc_tos_rtARID_DEF.Delay_DSTATE_d.type@ */ /end MEASUREMENT
/begin MEASUREMENT autosar_swc_tos_rtARID_DEF.Delay_DSTATE_d.vxAbs "" FLOAT32_IEEE autosar_swc_tos_CM_single 0 0 -3.4E+38 3.4E+38 ECU_ADDRESS 0xfe4c35d8 /* @ECU_Address@autosar_swc_tos_rtARID_DEF.Delay_DSTATE_d.vxAbs@ */ /end MEASUREMENT
/begin MEASUREMENT autosar_swc_tos_rtARID_DEF.Delay_DSTATE_d.vxRel "" FLOAT32_IEEE autosar_swc_tos_CM_single 0 0 -3.4E+38 3.4E+38 ECU_ADDRESS 0xfe4c35d0 /* @ECU_Address@autosar_swc_tos_rtARID_DEF.Delay_DSTATE_d.vxRel@ */ /end MEASUREMENT
/begin MEASUREMENT autosar_swc_tos_rtARID_DEF.Delay_DSTATE_d.vyAbs "" FLOAT32_IEEE autosar_swc_tos_CM_single 0 0 -3.4E+38 3.4E+38 ECU_ADDRESS 0xfe4c35dc /* @ECU_Address@autosar_swc_tos_rtARID_DEF.Delay_DSTATE_d.vyAbs@ */ /end MEASUREMENT
/begin MEASUREMENT autosar_swc_tos_rtARID_DEF.Delay_DSTATE_d.vyRel "" FLOAT32_IEEE autosar_swc_tos_CM_single 0 0 -3.4E+38 3.4E+38 ECU_ADDRESS 0xfe4c35d4 /* @ECU_Address@autosar_swc_tos_rtARID_DEF.Delay_DSTATE_d.vyRel@ */ /end MEASUREMENT
/begin MEASUREMENT autosar_swc_tos_rtARID_DEF.Delay_DSTATE_f "" FLOAT32_IEEE autosar_swc_tos_CM_single 0 0 -3.4E+38 3.4E+38 ECU_ADDRESS 0xfe4c4b84 /* @ECU_Address@autosar_swc_tos_rtARID_DEF.Delay_DSTATE_f@ */ /end MEASUREMENT
/begin MEASUREMENT autosar_swc_tos_rtARID_DEF.Delay_DSTATE_h.nudge_dx "" FLOAT32_IEEE autosar_swc_tos_CM_single 0 0 -3.4E+38 3.4E+38 ECU_ADDRESS 0xfe4c36ec /* @ECU_Address@autosar_swc_tos_rtARID_DEF.Delay_DSTATE_h.nudge_dx@ */ /end MEASUREMENT
/begin MEASUREMENT autosar_swc_tos_rtARID_DEF.Delay_DSTATE_h.nudge_offset "" FLOAT32_IEEE autosar_swc_tos_CM_single 0 0 -3.4E+38 3.4E+38 ECU_ADDRESS 0xfe4c36f0 /* @ECU_Address@autosar_swc_tos_rtARID_DEF.Delay_DSTATE_h.nudge_offset@ */ /end MEASUREMENT
/begin MEASUREMENT autosar_swc_tos_rtARID_DEF.Delay_DSTATE_h.nudge_speed_limit "" FLOAT32_IEEE autosar_swc_tos_CM_single 0 0 -3.4E+38 3.4E+38 ECU_ADDRESS 0xfe4c36f4 /* @ECU_Address@autosar_swc_tos_rtARID_DEF.Delay_DSTATE_h.nudge_speed_limit@ */ /end MEASUREMENT
/begin MEASUREMENT autosar_swc_tos_rtARID_DEF.Delay_DSTATE_h.nudge_type "" UBYTE autosar_swc_tos_CM_uint8 0 0 0 255 ECU_ADDRESS 0xfe4c36e4 /* @ECU_Address@autosar_swc_tos_rtARID_DEF.Delay_DSTATE_h.nudge_type@ */ /end MEASUREMENT
/begin MEASUREMENT autosar_swc_tos_rtARID_DEF.Delay_DSTATE_h.obj_id "" ULONG autosar_swc_tos_CM_uint32 0 0 0 4294967295 ECU_ADDRESS 0xfe4c36fc /* @ECU_Address@autosar_swc_tos_rtARID_DEF.Delay_DSTATE_h.obj_id@ */ /end MEASUREMENT
/begin MEASUREMENT autosar_swc_tos_rtARID_DEF.Delay_DSTATE_h.ref_lane_id "" FLOAT32_IEEE autosar_swc_tos_CM_single 0 0 -3.4E+38 3.4E+38 ECU_ADDRESS 0xfe4c36e8 /* @ECU_Address@autosar_swc_tos_rtARID_DEF.Delay_DSTATE_h.ref_lane_id@ */ /end MEASUREMENT
/begin MEASUREMENT autosar_swc_tos_rtARID_DEF.Delay_DSTATE_h.reserved "" FLOAT32_IEEE autosar_swc_tos_CM_single 0 0 -3.4E+38 3.4E+38 ECU_ADDRESS 0xfe4c36f8 /* @ECU_Address@autosar_swc_tos_rtARID_DEF.Delay_DSTATE_h.reserved@ */ /end MEASUREMENT
/begin MEASUREMENT autosar_swc_tos_rtARID_DEF.Delay_DSTATE_i "" UBYTE autosar_swc_tos_CM_uint8 0 0 0 255 LAYOUT COLUMN_DIR MATRIX_DIM 9 ECU_ADDRESS 0xfe4c5123 /* @ECU_Address@autosar_swc_tos_rtARID_DEF.Delay_DSTATE_i@ */ /end MEASUREMENT
/begin MEASUREMENT autosar_swc_tos_rtARID_DEF.Delay_DSTATE_l "" UBYTE autosar_swc_tos_CM_uint8 0 0 0 255 ECU_ADDRESS 0xfe4c9180 /* @ECU_Address@autosar_swc_tos_rtARID_DEF.Delay_DSTATE_l@ */ /end MEASUREMENT
/begin MEASUREMENT autosar_swc_tos_rtARID_DEF.Delay_DSTATE_m "" FLOAT32_IEEE autosar_swc_tos_CM_single 0 0 -3.4E+38 3.4E+38 ECU_ADDRESS 0xfe4c4b98 /* @ECU_Address@autosar_swc_tos_rtARID_DEF.Delay_DSTATE_m@ */ /end MEASUREMENT
/begin MEASUREMENT autosar_swc_tos_rtARID_DEF.Delay_DSTATE_o "" UBYTE autosar_swc_tos_CM_uint8 0 0 0 255 ECU_ADDRESS 0xfe4c917b /* @ECU_Address@autosar_swc_tos_rtARID_DEF.Delay_DSTATE_o@ */ /end MEASUREMENT
/begin MEASUREMENT autosar_swc_tos_rtARID_DEF.Delay_DSTATE_p.nudge_dx "" FLOAT32_IEEE autosar_swc_tos_CM_single 0 0 -3.4E+38 3.4E+38 ECU_ADDRESS 0xfe4c3708 /* @ECU_Address@autosar_swc_tos_rtARID_DEF.Delay_DSTATE_p.nudge_dx@ */ /end MEASUREMENT
/begin MEASUREMENT autosar_swc_tos_rtARID_DEF.Delay_DSTATE_p.nudge_offset "" FLOAT32_IEEE autosar_swc_tos_CM_single 0 0 -3.4E+38 3.4E+38 ECU_ADDRESS 0xfe4c370c /* @ECU_Address@autosar_swc_tos_rtARID_DEF.Delay_DSTATE_p.nudge_offset@ */ /end MEASUREMENT
/begin MEASUREMENT autosar_swc_tos_rtARID_DEF.Delay_DSTATE_p.nudge_speed_limit "" FLOAT32_IEEE autosar_swc_tos_CM_single 0 0 -3.4E+38 3.4E+38 ECU_ADDRESS 0xfe4c3710 /* @ECU_Address@autosar_swc_tos_rtARID_DEF.Delay_DSTATE_p.nudge_speed_limit@ */ /end MEASUREMENT
/begin MEASUREMENT autosar_swc_tos_rtARID_DEF.Delay_DSTATE_p.nudge_type "" UBYTE autosar_swc_tos_CM_uint8 0 0 0 255 ECU_ADDRESS 0xfe4c3700 /* @ECU_Address@autosar_swc_tos_rtARID_DEF.Delay_DSTATE_p.nudge_type@ */ /end MEASUREMENT
/begin MEASUREMENT autosar_swc_tos_rtARID_DEF.Delay_DSTATE_p.obj_id "" ULONG autosar_swc_tos_CM_uint32 0 0 0 4294967295 ECU_ADDRESS 0xfe4c3718 /* @ECU_Address@autosar_swc_tos_rtARID_DEF.Delay_DSTATE_p.obj_id@ */ /end MEASUREMENT
/begin MEASUREMENT autosar_swc_tos_rtARID_DEF.Delay_DSTATE_p.ref_lane_id "" FLOAT32_IEEE autosar_swc_tos_CM_single 0 0 -3.4E+38 3.4E+38 ECU_ADDRESS 0xfe4c3704 /* @ECU_Address@autosar_swc_tos_rtARID_DEF.Delay_DSTATE_p.ref_lane_id@ */ /end MEASUREMENT
/begin MEASUREMENT autosar_swc_tos_rtARID_DEF.Delay_DSTATE_p.reserved "" FLOAT32_IEEE autosar_swc_tos_CM_single 0 0 -3.4E+38 3.4E+38 ECU_ADDRESS 0xfe4c3714 /* @ECU_Address@autosar_swc_tos_rtARID_DEF.Delay_DSTATE_p.reserved@ */ /end MEASUREMENT
/begin MEASUREMENT autosar_swc_tos_rtARID_DEF.EgoSpeedLimit "" FLOAT32_IEEE autosar_swc_tos_CM_single 0 0 -3.4E+38 3.4E+38 ECU_ADDRESS 0xfe4c4bd8 /* @ECU_Address@autosar_swc_tos_rtARID_DEF.EgoSpeedLimit@ */ /end MEASUREMENT
/begin MEASUREMENT autosar_swc_tos_rtARID_DEF.IES_Leftindex "" UBYTE autosar_swc_tos_CM_uint8 0 0 0 255 ECU_ADDRESS 0xfe4c9196 /* @ECU_Address@autosar_swc_tos_rtARID_DEF.IES_Leftindex@ */ /end MEASUREMENT
/begin MEASUREMENT autosar_swc_tos_rtARID_DEF.IES_Rightindex "" UBYTE autosar_swc_tos_CM_uint8 0 0 0 255 ECU_ADDRESS 0xfe4c9197 /* @ECU_Address@autosar_swc_tos_rtARID_DEF.IES_Rightindex@ */ /end MEASUREMENT
/begin MEASUREMENT autosar_swc_tos_rtARID_DEF.IESorBreakingSts "" UBYTE autosar_swc_tos_CM_uint8 0 0 0 255 ECU_ADDRESS 0xfe4c9177 /* @ECU_Address@autosar_swc_tos_rtARID_DEF.IESorBreakingSts@ */ /end MEASUREMENT
/begin MEASUREMENT autosar_swc_tos_rtARID_DEF.ImpAsg_InsertedFor_ID_at_inport_0 "" ULONG autosar_swc_tos_CM_uint32 0 0 0 4294967295 LAYOUT COLUMN_DIR MATRIX_DIM 1 64 ECU_ADDRESS 0xfe4c4bf4 /* @ECU_Address@autosar_swc_tos_rtARID_DEF.ImpAsg_InsertedFor_ID_at_inport_0@ */ /end MEASUREMENT
/begin MEASUREMENT autosar_swc_tos_rtARID_DEF.Intersection_Keep "" FLOAT64_IEEE autosar_swc_tos_CM_double 0 0 -1.7E+308 1.7E+308 ECU_ADDRESS 0xfe4c3790 /* @ECU_Address@autosar_swc_tos_rtARID_DEF.Intersection_Keep@ */ /end MEASUREMENT
/begin MEASUREMENT autosar_swc_tos_rtARID_DEF.LM_LR.dDisEnd "" FLOAT32_IEEE autosar_swc_tos_CM_single 0 0 -3.4E+38 3.4E+38 ECU_ADDRESS 0xfe4c368c /* @ECU_Address@autosar_swc_tos_rtARID_DEF.LM_LR.dDisEnd@ */ /end MEASUREMENT
/begin MEASUREMENT autosar_swc_tos_rtARID_DEF.LM_LR.dDisStart "" FLOAT32_IEEE autosar_swc_tos_CM_single 0 0 -3.4E+38 3.4E+38 ECU_ADDRESS 0xfe4c3688 /* @ECU_Address@autosar_swc_tos_rtARID_DEF.LM_LR.dDisStart@ */ /end MEASUREMENT
/begin MEASUREMENT autosar_swc_tos_rtARID_DEF.LM_LR.dQuality "" FLOAT32_IEEE autosar_swc_tos_CM_single 0 0 -3.4E+38 3.4E+38 ECU_ADDRESS 0xfe4c3690 /* @ECU_Address@autosar_swc_tos_rtARID_DEF.LM_LR.dQuality@ */ /end MEASUREMENT
/begin MEASUREMENT autosar_swc_tos_rtARID_DEF.LM_LR.fCamValid "" UBYTE autosar_swc_tos_CM_uint8 0 0 0 255 ECU_ADDRESS 0xfe4c3694 /* @ECU_Address@autosar_swc_tos_rtARID_DEF.LM_LR.fCamValid@ */ /end MEASUREMENT
/begin MEASUREMENT autosar_swc_tos_rtARID_DEF.LM_LR.pC0 "" FLOAT32_IEEE autosar_swc_tos_CM_single 0 0 -3.4E+38 3.4E+38 ECU_ADDRESS 0xfe4c3670 /* @ECU_Address@autosar_swc_tos_rtARID_DEF.LM_LR.pC0@ */ /end MEASUREMENT
/begin MEASUREMENT autosar_swc_tos_rtARID_DEF.LM_LR.pC1 "" FLOAT32_IEEE autosar_swc_tos_CM_single 0 0 -3.4E+38 3.4E+38 ECU_ADDRESS 0xfe4c3674 /* @ECU_Address@autosar_swc_tos_rtARID_DEF.LM_LR.pC1@ */ /end MEASUREMENT
/begin MEASUREMENT autosar_swc_tos_rtARID_DEF.LM_LR.pC2 "" FLOAT32_IEEE autosar_swc_tos_CM_single 0 0 -3.4E+38 3.4E+38 ECU_ADDRESS 0xfe4c3678 /* @ECU_Address@autosar_swc_tos_rtARID_DEF.LM_LR.pC2@ */ /end MEASUREMENT
/begin MEASUREMENT autosar_swc_tos_rtARID_DEF.LM_LR.pC3 "" FLOAT32_IEEE autosar_swc_tos_CM_single 0 0 -3.4E+38 3.4E+38 ECU_ADDRESS 0xfe4c367c /* @ECU_Address@autosar_swc_tos_rtARID_DEF.LM_LR.pC3@ */ /end MEASUREMENT
/begin MEASUREMENT autosar_swc_tos_rtARID_DEF.LM_LR.pC4 "" FLOAT32_IEEE autosar_swc_tos_CM_single 0 0 -3.4E+38 3.4E+38 ECU_ADDRESS 0xfe4c3680 /* @ECU_Address@autosar_swc_tos_rtARID_DEF.LM_LR.pC4@ */ /end MEASUREMENT
/begin MEASUREMENT autosar_swc_tos_rtARID_DEF.LM_LR.pC5 "" FLOAT32_IEEE autosar_swc_tos_CM_single 0 0 -3.4E+38 3.4E+38 ECU_ADDRESS 0xfe4c3684 /* @ECU_Address@autosar_swc_tos_rtARID_DEF.LM_LR.pC5@ */ /end MEASUREMENT
/begin MEASUREMENT autosar_swc_tos_rtARID_DEF.LasNudgeValue "" FLOAT32_IEEE autosar_swc_tos_CM_single 0 0 -3.4E+38 3.4E+38 ECU_ADDRESS 0xfe4c4bdc /* @ECU_Address@autosar_swc_tos_rtARID_DEF.LasNudgeValue@ */ /end MEASUREMENT
/begin MEASUREMENT autosar_swc_tos_rtARID_DEF.LastLM.Lines[0].Source "" UBYTE autosar_swc_tos_CM_uint8 0 0 0 255 ECU_ADDRESS 0xfe4c3118 /* @ECU_Address@autosar_swc_tos_rtARID_DEF.LastLM.Lines[0].Source@ */ /end MEASUREMENT
/begin MEASUREMENT autosar_swc_tos_rtARID_DEF.LastLM.Lines[0].bIsLineExist "" UBYTE autosar_swc_tos_CM_uint8 0 0 0 255 ECU_ADDRESS 0xfe4c3119 /* @ECU_Address@autosar_swc_tos_rtARID_DEF.LastLM.Lines[0].bIsLineExist@ */ /end MEASUREMENT
/begin MEASUREMENT autosar_swc_tos_rtARID_DEF.LastLM.Lines[0].dC0V "" FLOAT32_IEEE autosar_swc_tos_CM_single 0 0 -10.000000 10.000000 ECU_ADDRESS 0xfe4c311c /* @ECU_Address@autosar_swc_tos_rtARID_DEF.LastLM.Lines[0].dC0V@ */ /end MEASUREMENT
/begin MEASUREMENT autosar_swc_tos_rtARID_DEF.LastLM.Lines[0].dC1V "" FLOAT32_IEEE autosar_swc_tos_CM_single 0 0 -3.000000 3.000000 ECU_ADDRESS 0xfe4c3120 /* @ECU_Address@autosar_swc_tos_rtARID_DEF.LastLM.Lines[0].dC1V@ */ /end MEASUREMENT
/begin MEASUREMENT autosar_swc_tos_rtARID_DEF.LastLM.Lines[0].dC2V "" FLOAT32_IEEE autosar_swc_tos_CM_single 0 0 -0.200000 0.200000 ECU_ADDRESS 0xfe4c3124 /* @ECU_Address@autosar_swc_tos_rtARID_DEF.LastLM.Lines[0].dC2V@ */ /end MEASUREMENT
/begin MEASUREMENT autosar_swc_tos_rtARID_DEF.LastLM.Lines[0].dC3V "" FLOAT32_IEEE autosar_swc_tos_CM_single 0 0 -0.100000 0.100000 ECU_ADDRESS 0xfe4c3128 /* @ECU_Address@autosar_swc_tos_rtARID_DEF.LastLM.Lines[0].dC3V@ */ /end MEASUREMENT
/begin MEASUREMENT autosar_swc_tos_rtARID_DEF.LastLM.Lines[0].dC4V "" FLOAT32_IEEE autosar_swc_tos_CM_single 0 0 -3.4E+38 3.4E+38 ECU_ADDRESS 0xfe4c312c /* @ECU_Address@autosar_swc_tos_rtARID_DEF.LastLM.Lines[0].dC4V@ */ /end MEASUREMENT
/begin MEASUREMENT autosar_swc_tos_rtARID_DEF.LastLM.Lines[0].dC5V "" FLOAT32_IEEE autosar_swc_tos_CM_single 0 0 -3.4E+38 3.4E+38 ECU_ADDRESS 0xfe4c3130 /* @ECU_Address@autosar_swc_tos_rtARID_DEF.LastLM.Lines[0].dC5V@ */ /end MEASUREMENT
/begin MEASUREMENT autosar_swc_tos_rtARID_DEF.LastLM.Lines[0].dDisFront "" FLOAT32_IEEE autosar_swc_tos_CM_single 0 0 0.000000 200.000000 ECU_ADDRESS 0xfe4c313c /* @ECU_Address@autosar_swc_tos_rtARID_DEF.LastLM.Lines[0].dDisFront@ */ /end MEASUREMENT
/begin MEASUREMENT autosar_swc_tos_rtARID_DEF.LastLM.Lines[0].dDisStart "" FLOAT32_IEEE autosar_swc_tos_CM_single 0 0 0.000000 200.000000 ECU_ADDRESS 0xfe4c3138 /* @ECU_Address@autosar_swc_tos_rtARID_DEF.LastLM.Lines[0].dDisStart@ */ /end MEASUREMENT
/begin MEASUREMENT autosar_swc_tos_rtARID_DEF.LastLM.Lines[0].dLaneWidth "" FLOAT32_IEEE autosar_swc_tos_CM_single 0 0 0.000000 10.000000 ECU_ADDRESS 0xfe4c3144 /* @ECU_Address@autosar_swc_tos_rtARID_DEF.LastLM.Lines[0].dLaneWidth@ */ /end MEASUREMENT
/begin MEASUREMENT autosar_swc_tos_rtARID_DEF.LastLM.Lines[0].dQuality "" FLOAT32_IEEE autosar_swc_tos_CM_single 0 0 -3.4E+38 3.4E+38 ECU_ADDRESS 0xfe4c3140 /* @ECU_Address@autosar_swc_tos_rtARID_DEF.LastLM.Lines[0].dQuality@ */ /end MEASUREMENT
/begin MEASUREMENT autosar_swc_tos_rtARID_DEF.LastLM.Lines[0].eLineType "" UBYTE autosar_swc_tos_CM_uint8 0 0 0 255 ECU_ADDRESS 0xfe4c3134 /* @ECU_Address@autosar_swc_tos_rtARID_DEF.LastLM.Lines[0].eLineType@ */ /end MEASUREMENT
/begin MEASUREMENT autosar_swc_tos_rtARID_DEF.LastLM.Lines[0].eLinefusType "" UBYTE autosar_swc_tos_CM_uint8 0 0 0 255 ECU_ADDRESS 0xfe4c3148 /* @ECU_Address@autosar_swc_tos_rtARID_DEF.LastLM.Lines[0].eLinefusType@ */ /end MEASUREMENT
/begin MEASUREMENT autosar_swc_tos_rtARID_DEF.LastLM.ObjectID "" UBYTE autosar_swc_tos_CM_uint8 0 0 0 255 ECU_ADDRESS 0xfe4c3108 /* @ECU_Address@autosar_swc_tos_rtARID_DEF.LastLM.ObjectID@ */ /end MEASUREMENT
/begin MEASUREMENT autosar_swc_tos_rtARID_DEF.LastLM.Timestamp "" A_UINT64 autosar_swc_tos_CM_uint64 0 0 0 18446744073709551615 ECU_ADDRESS 0xfe4c3110 /* @ECU_Address@autosar_swc_tos_rtARID_DEF.LastLM.Timestamp@ */ /end MEASUREMENT
/begin MEASUREMENT autosar_swc_tos_rtARID_DEF.LastLM_not_empty "" UBYTE autosar_swc_tos_CM_logical 0 0 0 1 ECU_ADDRESS 0xfe4c9243 /* @ECU_Address@autosar_swc_tos_rtARID_DEF.LastLM_not_empty@ */ /end MEASUREMENT
/begin MEASUREMENT autosar_swc_tos_rtARID_DEF.LastWidth "" FLOAT32_IEEE autosar_swc_tos_CM_single 0 0 -3.4E+38 3.4E+38 ECU_ADDRESS 0xfe4c4be4 /* @ECU_Address@autosar_swc_tos_rtARID_DEF.LastWidth@ */ /end MEASUREMENT
/begin MEASUREMENT autosar_swc_tos_rtARID_DEF.Lastmodel "" FLOAT64_IEEE autosar_swc_tos_CM_double 0 0 -1.7E+308 1.7E+308 ECU_ADDRESS 0xfe4c3788 /* @ECU_Address@autosar_swc_tos_rtARID_DEF.Lastmodel@ */ /end MEASUREMENT
/begin MEASUREMENT autosar_swc_tos_rtARID_DEF.LcTimeCntL "" UBYTE autosar_swc_tos_CM_uint8 0 0 0 255 ECU_ADDRESS 0xfe4c91a2 /* @ECU_Address@autosar_swc_tos_rtARID_DEF.LcTimeCntL@ */ /end MEASUREMENT
/begin MEASUREMENT autosar_swc_tos_rtARID_DEF.LcTimeCntR "" UBYTE autosar_swc_tos_CM_uint8 0 0 0 255 ECU_ADDRESS 0xfe4c91a1 /* @ECU_Address@autosar_swc_tos_rtARID_DEF.LcTimeCntR@ */ /end MEASUREMENT
/begin MEASUREMENT autosar_swc_tos_rtARID_DEF.Maxoffset "" FLOAT32_IEEE autosar_swc_tos_CM_single 0 0 -3.4E+38 3.4E+38 ECU_ADDRESS 0xfe4c4bbc /* @ECU_Address@autosar_swc_tos_rtARID_DEF.Maxoffset@ */ /end MEASUREMENT
/begin MEASUREMENT autosar_swc_tos_rtARID_DEF.MelpKapBuf "" FLOAT64_IEEE autosar_swc_tos_CM_double 0 0 -1.7E+308 1.7E+308 LAYOUT COLUMN_DIR MATRIX_DIM 10 ECU_ADDRESS 0xfe4c3730 /* @ECU_Address@autosar_swc_tos_rtARID_DEF.MelpKapBuf@ */ /end MEASUREMENT
/begin MEASUREMENT autosar_swc_tos_rtARID_DEF.Mem_Value "" FLOAT32_IEEE autosar_swc_tos_CM_single 0 0 -3.4E+38 3.4E+38 ECU_ADDRESS 0xfe4c4bc8 /* @ECU_Address@autosar_swc_tos_rtARID_DEF.Mem_Value@ */ /end MEASUREMENT
/begin MEASUREMENT autosar_swc_tos_rtARID_DEF.Mem_Value_b "" FLOAT32_IEEE autosar_swc_tos_CM_single 0 0 -3.4E+38 3.4E+38 ECU_ADDRESS 0xfe4c4bd4 /* @ECU_Address@autosar_swc_tos_rtARID_DEF.Mem_Value_b@ */ /end MEASUREMENT
/begin MEASUREMENT autosar_swc_tos_rtARID_DEF.MemoryWidth "" FLOAT32_IEEE autosar_swc_tos_CM_single 0 0 -3.4E+38 3.4E+38 ECU_ADDRESS 0xfe4c4be8 /* @ECU_Address@autosar_swc_tos_rtARID_DEF.MemoryWidth@ */ /end MEASUREMENT
/begin MEASUREMENT autosar_swc_tos_rtARID_DEF.NudgeOver "" UBYTE autosar_swc_tos_CM_logical 0 0 0 1 ECU_ADDRESS 0xfe4c923e /* @ECU_Address@autosar_swc_tos_rtARID_DEF.NudgeOver@ */ /end MEASUREMENT
/begin MEASUREMENT autosar_swc_tos_rtARID_DEF.NudgeOverTime "" FLOAT32_IEEE autosar_swc_tos_CM_single 0 0 -3.4E+38 3.4E+38 ECU_ADDRESS 0xfe4c4bc4 /* @ECU_Address@autosar_swc_tos_rtARID_DEF.NudgeOverTime@ */ /end MEASUREMENT
/begin MEASUREMENT autosar_swc_tos_rtARID_DEF.NudgeOverTime_k "" FLOAT32_IEEE autosar_swc_tos_CM_single 0 0 -3.4E+38 3.4E+38 ECU_ADDRESS 0xfe4c4bd0 /* @ECU_Address@autosar_swc_tos_rtARID_DEF.NudgeOverTime_k@ */ /end MEASUREMENT
/begin MEASUREMENT autosar_swc_tos_rtARID_DEF.NudgeOverTime_not_empty "" UBYTE autosar_swc_tos_CM_logical 0 0 0 1 ECU_ADDRESS 0xfe4c923d /* @ECU_Address@autosar_swc_tos_rtARID_DEF.NudgeOverTime_not_empty@ */ /end MEASUREMENT
/begin MEASUREMENT autosar_swc_tos_rtARID_DEF.NudgeOverTime_not_empty_p "" UBYTE autosar_swc_tos_CM_logical 0 0 0 1 ECU_ADDRESS 0xfe4c923f /* @ECU_Address@autosar_swc_tos_rtARID_DEF.NudgeOverTime_not_empty_p@ */ /end MEASUREMENT
/begin MEASUREMENT autosar_swc_tos_rtARID_DEF.NudgeOver_k "" UBYTE autosar_swc_tos_CM_logical 0 0 0 1 ECU_ADDRESS 0xfe4c9240 /* @ECU_Address@autosar_swc_tos_rtARID_DEF.NudgeOver_k@ */ /end MEASUREMENT
/begin MEASUREMENT autosar_swc_tos_rtARID_DEF.OriLaneID "" ULONG autosar_swc_tos_CM_uint32 0 0 0 4294967295 ECU_ADDRESS 0xfe4c5090 /* @ECU_Address@autosar_swc_tos_rtARID_DEF.OriLaneID@ */ /end MEASUREMENT
/begin MEASUREMENT autosar_swc_tos_rtARID_DEF.Output_DSTATE "" UBYTE autosar_swc_tos_CM_uint8 0 0 0 255 ECU_ADDRESS 0xfe4c917a /* @ECU_Address@autosar_swc_tos_rtARID_DEF.Output_DSTATE@ */ /end MEASUREMENT
/begin MEASUREMENT autosar_swc_tos_rtARID_DEF.OverBreaking "" UBYTE autosar_swc_tos_CM_logical 0 0 0 1 ECU_ADDRESS 0xfe4c923c /* @ECU_Address@autosar_swc_tos_rtARID_DEF.OverBreaking@ */ /end MEASUREMENT
/begin MEASUREMENT autosar_swc_tos_rtARID_DEF.RFMsustained "" FLOAT64_IEEE autosar_swc_tos_CM_double 0 0 -1.7E+308 1.7E+308 ECU_ADDRESS 0xfe4c3780 /* @ECU_Address@autosar_swc_tos_rtARID_DEF.RFMsustained@ */ /end MEASUREMENT
/begin MEASUREMENT autosar_swc_tos_rtARID_DEF.Relay_Mode "" UBYTE autosar_swc_tos_CM_logical 0 0 0 1 ECU_ADDRESS 0xfe4c923a /* @ECU_Address@autosar_swc_tos_rtARID_DEF.Relay_Mode@ */ /end MEASUREMENT
/begin MEASUREMENT autosar_swc_tos_rtARID_DEF.Relay_Mode_g "" UBYTE autosar_swc_tos_CM_logical 0 0 0 1 ECU_ADDRESS 0xfe4c923b /* @ECU_Address@autosar_swc_tos_rtARID_DEF.Relay_Mode_g@ */ /end MEASUREMENT
/begin MEASUREMENT autosar_swc_tos_rtARID_DEF.SelectIndex "" UBYTE autosar_swc_tos_CM_uint8 0 0 0 255 ECU_ADDRESS 0xfe4c918b /* @ECU_Address@autosar_swc_tos_rtARID_DEF.SelectIndex@ */ /end MEASUREMENT
/begin MEASUREMENT autosar_swc_tos_rtARID_DEF.SelectIndex_i "" UBYTE autosar_swc_tos_CM_uint8 0 0 0 255 ECU_ADDRESS 0xfe4c918d /* @ECU_Address@autosar_swc_tos_rtARID_DEF.SelectIndex_i@ */ /end MEASUREMENT
/begin MEASUREMENT autosar_swc_tos_rtARID_DEF.SourceObj_Invalid "" UBYTE autosar_swc_tos_CM_logical 0 0 0 1 LAYOUT COLUMN_DIR MATRIX_DIM 20 ECU_ADDRESS 0xfe4c91f9 /* @ECU_Address@autosar_swc_tos_rtARID_DEF.SourceObj_Invalid@ */ /end MEASUREMENT
/begin MEASUREMENT autosar_swc_tos_rtARID_DEF.TarLaneID "" ULONG autosar_swc_tos_CM_uint32 0 0 0 4294967295 ECU_ADDRESS 0xfe4c508c /* @ECU_Address@autosar_swc_tos_rtARID_DEF.TarLaneID@ */ /end MEASUREMENT
/begin MEASUREMENT autosar_swc_tos_rtARID_DEF.TimeCnt "" UBYTE autosar_swc_tos_CM_uint8 0 0 0 255 ECU_ADDRESS 0xfe4c919a /* @ECU_Address@autosar_swc_tos_rtARID_DEF.TimeCnt@ */ /end MEASUREMENT
/begin MEASUREMENT autosar_swc_tos_rtARID_DEF.Turn_Left "" UBYTE autosar_swc_tos_CM_logical 0 0 0 1 ECU_ADDRESS 0xfe4c9213 /* @ECU_Address@autosar_swc_tos_rtARID_DEF.Turn_Left@ */ /end MEASUREMENT
/begin MEASUREMENT autosar_swc_tos_rtARID_DEF.Turn_Right "" UBYTE autosar_swc_tos_CM_logical 0 0 0 1 ECU_ADDRESS 0xfe4c9212 /* @ECU_Address@autosar_swc_tos_rtARID_DEF.Turn_Right@ */ /end MEASUREMENT
/begin MEASUREMENT autosar_swc_tos_rtARID_DEF.UnitDelay1_DSTATE "" FLOAT32_IEEE autosar_swc_tos_CM_single 0 0 -3.4E+38 3.4E+38 LAYOUT COLUMN_DIR MATRIX_DIM 20 ECU_ADDRESS 0xfe4c3798 /* @ECU_Address@autosar_swc_tos_rtARID_DEF.UnitDelay1_DSTATE@ */ /end MEASUREMENT
/begin MEASUREMENT autosar_swc_tos_rtARID_DEF.UnitDelay1_DSTATE_a "" UWORD autosar_swc_tos_CM_uint16 0 0 0 65535 ECU_ADDRESS 0xfe4c50b4 /* @ECU_Address@autosar_swc_tos_rtARID_DEF.UnitDelay1_DSTATE_a@ */ /end MEASUREMENT
/begin MEASUREMENT autosar_swc_tos_rtARID_DEF.UnitDelay1_DSTATE_a2 "" UWORD autosar_swc_tos_CM_uint16 0 0 0 65535 ECU_ADDRESS 0xfe4c50dc /* @ECU_Address@autosar_swc_tos_rtARID_DEF.UnitDelay1_DSTATE_a2@ */ /end MEASUREMENT
/begin MEASUREMENT autosar_swc_tos_rtARID_DEF.UnitDelay1_DSTATE_b "" UWORD autosar_swc_tos_CM_uint16 0 0 0 65535 ECU_ADDRESS 0xfe4c50bc /* @ECU_Address@autosar_swc_tos_rtARID_DEF.UnitDelay1_DSTATE_b@ */ /end MEASUREMENT
/begin MEASUREMENT autosar_swc_tos_rtARID_DEF.UnitDelay1_DSTATE_c "" UWORD autosar_swc_tos_CM_uint16 0 0 0 65535 ECU_ADDRESS 0xfe4c50a8 /* @ECU_Address@autosar_swc_tos_rtARID_DEF.UnitDelay1_DSTATE_c@ */ /end MEASUREMENT
/begin MEASUREMENT autosar_swc_tos_rtARID_DEF.UnitDelay1_DSTATE_c2 "" UWORD autosar_swc_tos_CM_uint16 0 0 0 65535 ECU_ADDRESS 0xfe4c50d0 /* @ECU_Address@autosar_swc_tos_rtARID_DEF.UnitDelay1_DSTATE_c2@ */ /end MEASUREMENT
/begin MEASUREMENT autosar_swc_tos_rtARID_DEF.UnitDelay1_DSTATE_cl "" UWORD autosar_swc_tos_CM_uint16 0 0 0 65535 ECU_ADDRESS 0xfe4c50aa /* @ECU_Address@autosar_swc_tos_rtARID_DEF.UnitDelay1_DSTATE_cl@ */ /end MEASUREMENT
/begin MEASUREMENT autosar_swc_tos_rtARID_DEF.UnitDelay1_DSTATE_d "" UWORD autosar_swc_tos_CM_uint16 0 0 0 65535 ECU_ADDRESS 0xfe4c5098 /* @ECU_Address@autosar_swc_tos_rtARID_DEF.UnitDelay1_DSTATE_d@ */ /end MEASUREMENT
/begin MEASUREMENT autosar_swc_tos_rtARID_DEF.UnitDelay1_DSTATE_da "" UWORD autosar_swc_tos_CM_uint16 0 0 0 65535 ECU_ADDRESS 0xfe4c50a2 /* @ECU_Address@autosar_swc_tos_rtARID_DEF.UnitDelay1_DSTATE_da@ */ /end MEASUREMENT
/begin MEASUREMENT autosar_swc_tos_rtARID_DEF.UnitDelay1_DSTATE_dn "" UWORD autosar_swc_tos_CM_uint16 0 0 0 65535 ECU_ADDRESS 0xfe4c50c6 /* @ECU_Address@autosar_swc_tos_rtARID_DEF.UnitDelay1_DSTATE_dn@ */ /end MEASUREMENT
/begin MEASUREMENT autosar_swc_tos_rtARID_DEF.UnitDelay1_DSTATE_du "" UWORD autosar_swc_tos_CM_uint16 0 0 0 65535 ECU_ADDRESS 0xfe4c50ca /* @ECU_Address@autosar_swc_tos_rtARID_DEF.UnitDelay1_DSTATE_du@ */ /end MEASUREMENT
/begin MEASUREMENT autosar_swc_tos_rtARID_DEF.UnitDelay1_DSTATE_e "" UWORD autosar_swc_tos_CM_uint16 0 0 0 65535 ECU_ADDRESS 0xfe4c50c8 /* @ECU_Address@autosar_swc_tos_rtARID_DEF.UnitDelay1_DSTATE_e@ */ /end MEASUREMENT
/begin MEASUREMENT autosar_swc_tos_rtARID_DEF.UnitDelay1_DSTATE_f "" UWORD autosar_swc_tos_CM_uint16 0 0 0 65535 ECU_ADDRESS 0xfe4c50d4 /* @ECU_Address@autosar_swc_tos_rtARID_DEF.UnitDelay1_DSTATE_f@ */ /end MEASUREMENT
/begin MEASUREMENT autosar_swc_tos_rtARID_DEF.UnitDelay1_DSTATE_h "" UWORD autosar_swc_tos_CM_uint16 0 0 0 65535 ECU_ADDRESS 0xfe4c50a6 /* @ECU_Address@autosar_swc_tos_rtARID_DEF.UnitDelay1_DSTATE_h@ */ /end MEASUREMENT
/begin MEASUREMENT autosar_swc_tos_rtARID_DEF.UnitDelay1_DSTATE_he "" UWORD autosar_swc_tos_CM_uint16 0 0 0 65535 ECU_ADDRESS 0xfe4c50c2 /* @ECU_Address@autosar_swc_tos_rtARID_DEF.UnitDelay1_DSTATE_he@ */ /end MEASUREMENT
/begin MEASUREMENT autosar_swc_tos_rtARID_DEF.UnitDelay1_DSTATE_hj "" UWORD autosar_swc_tos_CM_uint16 0 0 0 65535 ECU_ADDRESS 0xfe4c50d2 /* @ECU_Address@autosar_swc_tos_rtARID_DEF.UnitDelay1_DSTATE_hj@ */ /end MEASUREMENT
/begin MEASUREMENT autosar_swc_tos_rtARID_DEF.UnitDelay1_DSTATE_hm "" UWORD autosar_swc_tos_CM_uint16 0 0 0 65535 ECU_ADDRESS 0xfe4c50ac /* @ECU_Address@autosar_swc_tos_rtARID_DEF.UnitDelay1_DSTATE_hm@ */ /end MEASUREMENT
/begin MEASUREMENT autosar_swc_tos_rtARID_DEF.UnitDelay1_DSTATE_ht "" UWORD autosar_swc_tos_CM_uint16 0 0 0 65535 ECU_ADDRESS 0xfe4c50ae /* @ECU_Address@autosar_swc_tos_rtARID_DEF.UnitDelay1_DSTATE_ht@ */ /end MEASUREMENT
/begin MEASUREMENT autosar_swc_tos_rtARID_DEF.UnitDelay1_DSTATE_i "" UWORD autosar_swc_tos_CM_uint16 0 0 0 65535 ECU_ADDRESS 0xfe4c50ce /* @ECU_Address@autosar_swc_tos_rtARID_DEF.UnitDelay1_DSTATE_i@ */ /end MEASUREMENT
/begin MEASUREMENT autosar_swc_tos_rtARID_DEF.UnitDelay1_DSTATE_i1 "" UWORD autosar_swc_tos_CM_uint16 0 0 0 65535 ECU_ADDRESS 0xfe4c50d8 /* @ECU_Address@autosar_swc_tos_rtARID_DEF.UnitDelay1_DSTATE_i1@ */ /end MEASUREMENT
/begin MEASUREMENT autosar_swc_tos_rtARID_DEF.UnitDelay1_DSTATE_j "" UWORD autosar_swc_tos_CM_uint16 0 0 0 65535 ECU_ADDRESS 0xfe4c509a /* @ECU_Address@autosar_swc_tos_rtARID_DEF.UnitDelay1_DSTATE_j@ */ /end MEASUREMENT
/begin MEASUREMENT autosar_swc_tos_rtARID_DEF.UnitDelay1_DSTATE_ja "" UWORD autosar_swc_tos_CM_uint16 0 0 0 65535 ECU_ADDRESS 0xfe4c509c /* @ECU_Address@autosar_swc_tos_rtARID_DEF.UnitDelay1_DSTATE_ja@ */ /end MEASUREMENT
/begin MEASUREMENT autosar_swc_tos_rtARID_DEF.UnitDelay1_DSTATE_jr "" UWORD autosar_swc_tos_CM_uint16 0 0 0 65535 ECU_ADDRESS 0xfe4c50da /* @ECU_Address@autosar_swc_tos_rtARID_DEF.UnitDelay1_DSTATE_jr@ */ /end MEASUREMENT
/begin MEASUREMENT autosar_swc_tos_rtARID_DEF.UnitDelay1_DSTATE_jt "" UWORD autosar_swc_tos_CM_uint16 0 0 0 65535 ECU_ADDRESS 0xfe4c50b0 /* @ECU_Address@autosar_swc_tos_rtARID_DEF.UnitDelay1_DSTATE_jt@ */ /end MEASUREMENT
/begin MEASUREMENT autosar_swc_tos_rtARID_DEF.UnitDelay1_DSTATE_ju "" UWORD autosar_swc_tos_CM_uint16 0 0 0 65535 ECU_ADDRESS 0xfe4c50d6 /* @ECU_Address@autosar_swc_tos_rtARID_DEF.UnitDelay1_DSTATE_ju@ */ /end MEASUREMENT
/begin MEASUREMENT autosar_swc_tos_rtARID_DEF.UnitDelay1_DSTATE_k "" UWORD autosar_swc_tos_CM_uint16 0 0 0 65535 ECU_ADDRESS 0xfe4c50cc /* @ECU_Address@autosar_swc_tos_rtARID_DEF.UnitDelay1_DSTATE_k@ */ /end MEASUREMENT
/begin MEASUREMENT autosar_swc_tos_rtARID_DEF.UnitDelay1_DSTATE_l "" UWORD autosar_swc_tos_CM_uint16 0 0 0 65535 ECU_ADDRESS 0xfe4c50b6 /* @ECU_Address@autosar_swc_tos_rtARID_DEF.UnitDelay1_DSTATE_l@ */ /end MEASUREMENT
/begin MEASUREMENT autosar_swc_tos_rtARID_DEF.UnitDelay1_DSTATE_lf "" UWORD autosar_swc_tos_CM_uint16 0 0 0 65535 ECU_ADDRESS 0xfe4c50be /* @ECU_Address@autosar_swc_tos_rtARID_DEF.UnitDelay1_DSTATE_lf@ */ /end MEASUREMENT
/begin MEASUREMENT autosar_swc_tos_rtARID_DEF.UnitDelay1_DSTATE_lk "" UWORD autosar_swc_tos_CM_uint16 0 0 0 65535 ECU_ADDRESS 0xfe4c50c0 /* @ECU_Address@autosar_swc_tos_rtARID_DEF.UnitDelay1_DSTATE_lk@ */ /end MEASUREMENT
/begin MEASUREMENT autosar_swc_tos_rtARID_DEF.UnitDelay1_DSTATE_m "" UWORD autosar_swc_tos_CM_uint16 0 0 0 65535 ECU_ADDRESS 0xfe4c50a0 /* @ECU_Address@autosar_swc_tos_rtARID_DEF.UnitDelay1_DSTATE_m@ */ /end MEASUREMENT
/begin MEASUREMENT autosar_swc_tos_rtARID_DEF.UnitDelay1_DSTATE_n "" UWORD autosar_swc_tos_CM_uint16 0 0 0 65535 ECU_ADDRESS 0xfe4c5096 /* @ECU_Address@autosar_swc_tos_rtARID_DEF.UnitDelay1_DSTATE_n@ */ /end MEASUREMENT
/begin MEASUREMENT autosar_swc_tos_rtARID_DEF.UnitDelay1_DSTATE_n3 "" UWORD autosar_swc_tos_CM_uint16 0 0 0 65535 ECU_ADDRESS 0xfe4c50b2 /* @ECU_Address@autosar_swc_tos_rtARID_DEF.UnitDelay1_DSTATE_n3@ */ /end MEASUREMENT
/begin MEASUREMENT autosar_swc_tos_rtARID_DEF.UnitDelay1_DSTATE_n3q "" UWORD autosar_swc_tos_CM_uint16 0 0 0 65535 ECU_ADDRESS 0xfe4c50b8 /* @ECU_Address@autosar_swc_tos_rtARID_DEF.UnitDelay1_DSTATE_n3q@ */ /end MEASUREMENT
/begin MEASUREMENT autosar_swc_tos_rtARID_DEF.UnitDelay1_DSTATE_nf "" UWORD autosar_swc_tos_CM_uint16 0 0 0 65535 ECU_ADDRESS 0xfe4c509e /* @ECU_Address@autosar_swc_tos_rtARID_DEF.UnitDelay1_DSTATE_nf@ */ /end MEASUREMENT
/begin MEASUREMENT autosar_swc_tos_rtARID_DEF.UnitDelay1_DSTATE_o "" UWORD autosar_swc_tos_CM_uint16 0 0 0 65535 ECU_ADDRESS 0xfe4c5094 /* @ECU_Address@autosar_swc_tos_rtARID_DEF.UnitDelay1_DSTATE_o@ */ /end MEASUREMENT
/begin MEASUREMENT autosar_swc_tos_rtARID_DEF.UnitDelay1_DSTATE_ok "" UWORD autosar_swc_tos_CM_uint16 0 0 0 65535 ECU_ADDRESS 0xfe4c50c4 /* @ECU_Address@autosar_swc_tos_rtARID_DEF.UnitDelay1_DSTATE_ok@ */ /end MEASUREMENT
/begin MEASUREMENT autosar_swc_tos_rtARID_DEF.UnitDelay1_DSTATE_on "" UWORD autosar_swc_tos_CM_uint16 0 0 0 65535 ECU_ADDRESS 0xfe4c50ba /* @ECU_Address@autosar_swc_tos_rtARID_DEF.UnitDelay1_DSTATE_on@ */ /end MEASUREMENT
/begin MEASUREMENT autosar_swc_tos_rtARID_DEF.UnitDelay1_DSTATE_ox "" UBYTE autosar_swc_tos_CM_uint8 0 0 0 255 LAYOUT COLUMN_DIR MATRIX_DIM 64 ECU_ADDRESS 0xfe4c50e3 /* @ECU_Address@autosar_swc_tos_rtARID_DEF.UnitDelay1_DSTATE_ox@ */ /end MEASUREMENT
/begin MEASUREMENT autosar_swc_tos_rtARID_DEF.UnitDelay1_DSTATE_p "" UWORD autosar_swc_tos_CM_uint16 0 0 0 65535 ECU_ADDRESS 0xfe4c50a4 /* @ECU_Address@autosar_swc_tos_rtARID_DEF.UnitDelay1_DSTATE_p@ */ /end MEASUREMENT
/begin MEASUREMENT autosar_swc_tos_rtARID_DEF.UnitDelay2_DSTATE "" ULONG autosar_swc_tos_CM_uint32 0 0 0 4294967295 LAYOUT COLUMN_DIR MATRIX_DIM 20 ECU_ADDRESS 0xfe4c4cf4 /* @ECU_Address@autosar_swc_tos_rtARID_DEF.UnitDelay2_DSTATE@ */ /end MEASUREMENT
/begin MEASUREMENT autosar_swc_tos_rtARID_DEF.UnitDelay2_DSTATE_a "" ULONG autosar_swc_tos_CM_uint32 0 0 0 4294967295 LAYOUT COLUMN_DIR MATRIX_DIM 20 ECU_ADDRESS 0xfe4c4e0c /* @ECU_Address@autosar_swc_tos_rtARID_DEF.UnitDelay2_DSTATE_a@ */ /end MEASUREMENT
/begin MEASUREMENT autosar_swc_tos_rtARID_DEF.UnitDelay2_DSTATE_b "" UBYTE autosar_swc_tos_CM_logical 0 0 0 1 ECU_ADDRESS 0xfe4c9220 /* @ECU_Address@autosar_swc_tos_rtARID_DEF.UnitDelay2_DSTATE_b@ */ /end MEASUREMENT
/begin MEASUREMENT autosar_swc_tos_rtARID_DEF.UnitDelay2_DSTATE_bc "" UBYTE autosar_swc_tos_CM_logical 0 0 0 1 ECU_ADDRESS 0xfe4c9234 /* @ECU_Address@autosar_swc_tos_rtARID_DEF.UnitDelay2_DSTATE_bc@ */ /end MEASUREMENT
/begin MEASUREMENT autosar_swc_tos_rtARID_DEF.UnitDelay2_DSTATE_bd "" UBYTE autosar_swc_tos_CM_logical 0 0 0 1 ECU_ADDRESS 0xfe4c922d /* @ECU_Address@autosar_swc_tos_rtARID_DEF.UnitDelay2_DSTATE_bd@ */ /end MEASUREMENT
/begin MEASUREMENT autosar_swc_tos_rtARID_DEF.UnitDelay2_DSTATE_bf "" UBYTE autosar_swc_tos_CM_logical 0 0 0 1 ECU_ADDRESS 0xfe4c9224 /* @ECU_Address@autosar_swc_tos_rtARID_DEF.UnitDelay2_DSTATE_bf@ */ /end MEASUREMENT
/begin MEASUREMENT autosar_swc_tos_rtARID_DEF.UnitDelay2_DSTATE_c "" UBYTE autosar_swc_tos_CM_logical 0 0 0 1 ECU_ADDRESS 0xfe4c921a /* @ECU_Address@autosar_swc_tos_rtARID_DEF.UnitDelay2_DSTATE_c@ */ /end MEASUREMENT
/begin MEASUREMENT autosar_swc_tos_rtARID_DEF.UnitDelay2_DSTATE_cg "" UBYTE autosar_swc_tos_CM_logical 0 0 0 1 ECU_ADDRESS 0xfe4c922c /* @ECU_Address@autosar_swc_tos_rtARID_DEF.UnitDelay2_DSTATE_cg@ */ /end MEASUREMENT
/begin MEASUREMENT autosar_swc_tos_rtARID_DEF.UnitDelay2_DSTATE_d "" ULONG autosar_swc_tos_CM_uint32 0 0 0 4294967295 LAYOUT COLUMN_DIR MATRIX_DIM 5 ECU_ADDRESS 0xfe4c4d94 /* @ECU_Address@autosar_swc_tos_rtARID_DEF.UnitDelay2_DSTATE_d@ */ /end MEASUREMENT
/begin MEASUREMENT autosar_swc_tos_rtARID_DEF.UnitDelay2_DSTATE_db "" UBYTE autosar_swc_tos_CM_logical 0 0 0 1 ECU_ADDRESS 0xfe4c9223 /* @ECU_Address@autosar_swc_tos_rtARID_DEF.UnitDelay2_DSTATE_db@ */ /end MEASUREMENT
/begin MEASUREMENT autosar_swc_tos_rtARID_DEF.UnitDelay2_DSTATE_de "" UBYTE autosar_swc_tos_CM_logical 0 0 0 1 ECU_ADDRESS 0xfe4c9216 /* @ECU_Address@autosar_swc_tos_rtARID_DEF.UnitDelay2_DSTATE_de@ */ /end MEASUREMENT
/begin MEASUREMENT autosar_swc_tos_rtARID_DEF.UnitDelay2_DSTATE_dt "" UBYTE autosar_swc_tos_CM_logical 0 0 0 1 ECU_ADDRESS 0xfe4c9226 /* @ECU_Address@autosar_swc_tos_rtARID_DEF.UnitDelay2_DSTATE_dt@ */ /end MEASUREMENT
/begin MEASUREMENT autosar_swc_tos_rtARID_DEF.UnitDelay2_DSTATE_e "" UBYTE autosar_swc_tos_CM_logical 0 0 0 1 ECU_ADDRESS 0xfe4c9230 /* @ECU_Address@autosar_swc_tos_rtARID_DEF.UnitDelay2_DSTATE_e@ */ /end MEASUREMENT
/begin MEASUREMENT autosar_swc_tos_rtARID_DEF.UnitDelay2_DSTATE_eq "" UBYTE autosar_swc_tos_CM_logical 0 0 0 1 ECU_ADDRESS 0xfe4c9237 /* @ECU_Address@autosar_swc_tos_rtARID_DEF.UnitDelay2_DSTATE_eq@ */ /end MEASUREMENT
/begin MEASUREMENT autosar_swc_tos_rtARID_DEF.UnitDelay2_DSTATE_ew "" UBYTE autosar_swc_tos_CM_logical 0 0 0 1 ECU_ADDRESS 0xfe4c9238 /* @ECU_Address@autosar_swc_tos_rtARID_DEF.UnitDelay2_DSTATE_ew@ */ /end MEASUREMENT
/begin MEASUREMENT autosar_swc_tos_rtARID_DEF.UnitDelay2_DSTATE_f "" UBYTE autosar_swc_tos_CM_logical 0 0 0 1 ECU_ADDRESS 0xfe4c9219 /* @ECU_Address@autosar_swc_tos_rtARID_DEF.UnitDelay2_DSTATE_f@ */ /end MEASUREMENT
/begin MEASUREMENT autosar_swc_tos_rtARID_DEF.UnitDelay2_DSTATE_fc "" UBYTE autosar_swc_tos_CM_logical 0 0 0 1 ECU_ADDRESS 0xfe4c921c /* @ECU_Address@autosar_swc_tos_rtARID_DEF.UnitDelay2_DSTATE_fc@ */ /end MEASUREMENT
/begin MEASUREMENT autosar_swc_tos_rtARID_DEF.UnitDelay2_DSTATE_fd "" UBYTE autosar_swc_tos_CM_logical 0 0 0 1 ECU_ADDRESS 0xfe4c922e /* @ECU_Address@autosar_swc_tos_rtARID_DEF.UnitDelay2_DSTATE_fd@ */ /end MEASUREMENT
/begin MEASUREMENT autosar_swc_tos_rtARID_DEF.UnitDelay2_DSTATE_fq "" UBYTE autosar_swc_tos_CM_logical 0 0 0 1 ECU_ADDRESS 0xfe4c9227 /* @ECU_Address@autosar_swc_tos_rtARID_DEF.UnitDelay2_DSTATE_fq@ */ /end MEASUREMENT
/begin MEASUREMENT autosar_swc_tos_rtARID_DEF.UnitDelay2_DSTATE_g "" ULONG autosar_swc_tos_CM_uint32 0 0 0 4294967295 LAYOUT COLUMN_DIR MATRIX_DIM 20 ECU_ADDRESS 0xfe4c4dbc /* @ECU_Address@autosar_swc_tos_rtARID_DEF.UnitDelay2_DSTATE_g@ */ /end MEASUREMENT
/begin MEASUREMENT autosar_swc_tos_rtARID_DEF.UnitDelay2_DSTATE_g0 "" UBYTE autosar_swc_tos_CM_logical 0 0 0 1 ECU_ADDRESS 0xfe4c922a /* @ECU_Address@autosar_swc_tos_rtARID_DEF.UnitDelay2_DSTATE_g0@ */ /end MEASUREMENT
/begin MEASUREMENT autosar_swc_tos_rtARID_DEF.UnitDelay2_DSTATE_gl "" UBYTE autosar_swc_tos_CM_logical 0 0 0 1 ECU_ADDRESS 0xfe4c9221 /* @ECU_Address@autosar_swc_tos_rtARID_DEF.UnitDelay2_DSTATE_gl@ */ /end MEASUREMENT
/begin MEASUREMENT autosar_swc_tos_rtARID_DEF.UnitDelay2_DSTATE_h "" ULONG autosar_swc_tos_CM_uint32 0 0 0 4294967295 LAYOUT COLUMN_DIR MATRIX_DIM 20 ECU_ADDRESS 0xfe4c4e5c /* @ECU_Address@autosar_swc_tos_rtARID_DEF.UnitDelay2_DSTATE_h@ */ /end MEASUREMENT
/begin MEASUREMENT autosar_swc_tos_rtARID_DEF.UnitDelay2_DSTATE_hf "" UBYTE autosar_swc_tos_CM_logical 0 0 0 1 ECU_ADDRESS 0xfe4c9214 /* @ECU_Address@autosar_swc_tos_rtARID_DEF.UnitDelay2_DSTATE_hf@ */ /end MEASUREMENT
/begin MEASUREMENT autosar_swc_tos_rtARID_DEF.UnitDelay2_DSTATE_hi "" UBYTE autosar_swc_tos_CM_logical 0 0 0 1 ECU_ADDRESS 0xfe4c9231 /* @ECU_Address@autosar_swc_tos_rtARID_DEF.UnitDelay2_DSTATE_hi@ */ /end MEASUREMENT
/begin MEASUREMENT autosar_swc_tos_rtARID_DEF.UnitDelay2_DSTATE_hm "" UBYTE autosar_swc_tos_CM_logical 0 0 0 1 ECU_ADDRESS 0xfe4c921b /* @ECU_Address@autosar_swc_tos_rtARID_DEF.UnitDelay2_DSTATE_hm@ */ /end MEASUREMENT
/begin MEASUREMENT autosar_swc_tos_rtARID_DEF.UnitDelay2_DSTATE_i "" UBYTE autosar_swc_tos_CM_logical 0 0 0 1 ECU_ADDRESS 0xfe4c9228 /* @ECU_Address@autosar_swc_tos_rtARID_DEF.UnitDelay2_DSTATE_i@ */ /end MEASUREMENT
/begin MEASUREMENT autosar_swc_tos_rtARID_DEF.UnitDelay2_DSTATE_j "" UBYTE autosar_swc_tos_CM_logical 0 0 0 1 ECU_ADDRESS 0xfe4c9236 /* @ECU_Address@autosar_swc_tos_rtARID_DEF.UnitDelay2_DSTATE_j@ */ /end MEASUREMENT
/begin MEASUREMENT autosar_swc_tos_rtARID_DEF.UnitDelay2_DSTATE_k "" ULONG autosar_swc_tos_CM_uint32 0 0 0 4294967295 LAYOUT COLUMN_DIR MATRIX_DIM 9 ECU_ADDRESS 0xfe4c4efc /* @ECU_Address@autosar_swc_tos_rtARID_DEF.UnitDelay2_DSTATE_k@ */ /end MEASUREMENT
/begin MEASUREMENT autosar_swc_tos_rtARID_DEF.UnitDelay2_DSTATE_k1 "" UBYTE autosar_swc_tos_CM_logical 0 0 0 1 ECU_ADDRESS 0xfe4c921d /* @ECU_Address@autosar_swc_tos_rtARID_DEF.UnitDelay2_DSTATE_k1@ */ /end MEASUREMENT
/begin MEASUREMENT autosar_swc_tos_rtARID_DEF.UnitDelay2_DSTATE_kg "" UBYTE autosar_swc_tos_CM_logical 0 0 0 1 ECU_ADDRESS 0xfe4c9229 /* @ECU_Address@autosar_swc_tos_rtARID_DEF.UnitDelay2_DSTATE_kg@ */ /end MEASUREMENT
/begin MEASUREMENT autosar_swc_tos_rtARID_DEF.UnitDelay2_DSTATE_kk "" UBYTE autosar_swc_tos_CM_logical 0 0 0 1 ECU_ADDRESS 0xfe4c9239 /* @ECU_Address@autosar_swc_tos_rtARID_DEF.UnitDelay2_DSTATE_kk@ */ /end MEASUREMENT
/begin MEASUREMENT autosar_swc_tos_rtARID_DEF.UnitDelay2_DSTATE_l "" UBYTE autosar_swc_tos_CM_logical 0 0 0 1 ECU_ADDRESS 0xfe4c921f /* @ECU_Address@autosar_swc_tos_rtARID_DEF.UnitDelay2_DSTATE_l@ */ /end MEASUREMENT
/begin MEASUREMENT autosar_swc_tos_rtARID_DEF.UnitDelay2_DSTATE_m "" UBYTE autosar_swc_tos_CM_logical 0 0 0 1 ECU_ADDRESS 0xfe4c9218 /* @ECU_Address@autosar_swc_tos_rtARID_DEF.UnitDelay2_DSTATE_m@ */ /end MEASUREMENT
/begin MEASUREMENT autosar_swc_tos_rtARID_DEF.UnitDelay2_DSTATE_m5 "" UBYTE autosar_swc_tos_CM_logical 0 0 0 1 ECU_ADDRESS 0xfe4c9232 /* @ECU_Address@autosar_swc_tos_rtARID_DEF.UnitDelay2_DSTATE_m5@ */ /end MEASUREMENT
/begin MEASUREMENT autosar_swc_tos_rtARID_DEF.UnitDelay2_DSTATE_n "" UBYTE autosar_swc_tos_CM_logical 0 0 0 1 ECU_ADDRESS 0xfe4c9215 /* @ECU_Address@autosar_swc_tos_rtARID_DEF.UnitDelay2_DSTATE_n@ */ /end MEASUREMENT
/begin MEASUREMENT autosar_swc_tos_rtARID_DEF.UnitDelay2_DSTATE_n0 "" UBYTE autosar_swc_tos_CM_logical 0 0 0 1 ECU_ADDRESS 0xfe4c921e /* @ECU_Address@autosar_swc_tos_rtARID_DEF.UnitDelay2_DSTATE_n0@ */ /end MEASUREMENT
/begin MEASUREMENT autosar_swc_tos_rtARID_DEF.UnitDelay2_DSTATE_nl "" UBYTE autosar_swc_tos_CM_logical 0 0 0 1 ECU_ADDRESS 0xfe4c9222 /* @ECU_Address@autosar_swc_tos_rtARID_DEF.UnitDelay2_DSTATE_nl@ */ /end MEASUREMENT
/begin MEASUREMENT autosar_swc_tos_rtARID_DEF.UnitDelay2_DSTATE_nt "" UBYTE autosar_swc_tos_CM_logical 0 0 0 1 ECU_ADDRESS 0xfe4c9235 /* @ECU_Address@autosar_swc_tos_rtARID_DEF.UnitDelay2_DSTATE_nt@ */ /end MEASUREMENT
/begin MEASUREMENT autosar_swc_tos_rtARID_DEF.UnitDelay2_DSTATE_o "" UBYTE autosar_swc_tos_CM_logical 0 0 0 1 ECU_ADDRESS 0xfe4c9217 /* @ECU_Address@autosar_swc_tos_rtARID_DEF.UnitDelay2_DSTATE_o@ */ /end MEASUREMENT
/begin MEASUREMENT autosar_swc_tos_rtARID_DEF.UnitDelay2_DSTATE_oq "" UBYTE autosar_swc_tos_CM_logical 0 0 0 1 ECU_ADDRESS 0xfe4c922b /* @ECU_Address@autosar_swc_tos_rtARID_DEF.UnitDelay2_DSTATE_oq@ */ /end MEASUREMENT
/begin MEASUREMENT autosar_swc_tos_rtARID_DEF.UnitDelay2_DSTATE_os "" UBYTE autosar_swc_tos_CM_logical 0 0 0 1 ECU_ADDRESS 0xfe4c9225 /* @ECU_Address@autosar_swc_tos_rtARID_DEF.UnitDelay2_DSTATE_os@ */ /end MEASUREMENT
/begin MEASUREMENT autosar_swc_tos_rtARID_DEF.UnitDelay2_DSTATE_p "" UBYTE autosar_swc_tos_CM_logical 0 0 0 1 ECU_ADDRESS 0xfe4c922f /* @ECU_Address@autosar_swc_tos_rtARID_DEF.UnitDelay2_DSTATE_p@ */ /end MEASUREMENT
/begin MEASUREMENT autosar_swc_tos_rtARID_DEF.UnitDelay_DSTATE "" ULONG autosar_swc_tos_CM_uint32 0 0 0 4294967295 LAYOUT COLUMN_DIR MATRIX_DIM 20 ECU_ADDRESS 0xfe4c4d44 /* @ECU_Address@autosar_swc_tos_rtARID_DEF.UnitDelay_DSTATE@ */ /end MEASUREMENT
/begin MEASUREMENT autosar_swc_tos_rtARID_DEF.UnitDelay_DSTATE_c "" ULONG autosar_swc_tos_CM_uint32 0 0 0 4294967295 LAYOUT COLUMN_DIR MATRIX_DIM 5 ECU_ADDRESS 0xfe4c4da8 /* @ECU_Address@autosar_swc_tos_rtARID_DEF.UnitDelay_DSTATE_c@ */ /end MEASUREMENT
/begin MEASUREMENT autosar_swc_tos_rtARID_DEF.UnitDelay_DSTATE_h "" UBYTE autosar_swc_tos_CM_logical 0 0 0 1 LAYOUT COLUMN_DIR MATRIX_DIM 64 ECU_ADDRESS 0xfe4c91ad /* @ECU_Address@autosar_swc_tos_rtARID_DEF.UnitDelay_DSTATE_h@ */ /end MEASUREMENT
/begin MEASUREMENT autosar_swc_tos_rtARID_DEF.UnitDelay_DSTATE_j "" ULONG autosar_swc_tos_CM_uint32 0 0 0 4294967295 LAYOUT COLUMN_DIR MATRIX_DIM 20 ECU_ADDRESS 0xfe4c4eac /* @ECU_Address@autosar_swc_tos_rtARID_DEF.UnitDelay_DSTATE_j@ */ /end MEASUREMENT
/begin MEASUREMENT autosar_swc_tos_rtARID_DEF.ctrlT "" FLOAT32_IEEE autosar_swc_tos_CM_single 0 0 -3.4E+38 3.4E+38 ECU_ADDRESS 0xfe4c4bac /* @ECU_Address@autosar_swc_tos_rtARID_DEF.ctrlT@ */ /end MEASUREMENT
/begin MEASUREMENT autosar_swc_tos_rtARID_DEF.ctrlT_e "" FLOAT32_IEEE autosar_swc_tos_CM_single 0 0 -3.4E+38 3.4E+38 ECU_ADDRESS 0xfe4c4bb4 /* @ECU_Address@autosar_swc_tos_rtARID_DEF.ctrlT_e@ */ /end MEASUREMENT
/begin MEASUREMENT autosar_swc_tos_rtARID_DEF.is_active_c393_autosar_swc_tos "" UBYTE autosar_swc_tos_CM_uint8 0 0 0 255 ECU_ADDRESS 0xfe4c91a7 /* @ECU_Address@autosar_swc_tos_rtARID_DEF.is_active_c393_autosar_swc_tos@ */ /end MEASUREMENT
/begin MEASUREMENT autosar_swc_tos_rtARID_DEF.is_active_c394_autosar_swc_tos "" UBYTE autosar_swc_tos_CM_uint8 0 0 0 255 ECU_ADDRESS 0xfe4c91a5 /* @ECU_Address@autosar_swc_tos_rtARID_DEF.is_active_c394_autosar_swc_tos@ */ /end MEASUREMENT
/begin MEASUREMENT autosar_swc_tos_rtARID_DEF.is_active_c395_autosar_swc_tos "" UBYTE autosar_swc_tos_CM_uint8 0 0 0 255 ECU_ADDRESS 0xfe4c91a3 /* @ECU_Address@autosar_swc_tos_rtARID_DEF.is_active_c395_autosar_swc_tos@ */ /end MEASUREMENT
/begin MEASUREMENT autosar_swc_tos_rtARID_DEF.is_active_c728_autosar_swc_tos "" UBYTE autosar_swc_tos_CM_uint8 0 0 0 255 ECU_ADDRESS 0xfe4c919f /* @ECU_Address@autosar_swc_tos_rtARID_DEF.is_active_c728_autosar_swc_tos@ */ /end MEASUREMENT
/begin MEASUREMENT autosar_swc_tos_rtARID_DEF.is_active_c741_autosar_swc_tos "" UBYTE autosar_swc_tos_CM_uint8 0 0 0 255 ECU_ADDRESS 0xfe4c919d /* @ECU_Address@autosar_swc_tos_rtARID_DEF.is_active_c741_autosar_swc_tos@ */ /end MEASUREMENT
/begin MEASUREMENT autosar_swc_tos_rtARID_DEF.is_active_c742_autosar_swc_tos "" UBYTE autosar_swc_tos_CM_uint8 0 0 0 255 ECU_ADDRESS 0xfe4c919b /* @ECU_Address@autosar_swc_tos_rtARID_DEF.is_active_c742_autosar_swc_tos@ */ /end MEASUREMENT
/begin MEASUREMENT autosar_swc_tos_rtARID_DEF.is_active_c743_autosar_swc_tos "" UBYTE autosar_swc_tos_CM_uint8 0 0 0 255 ECU_ADDRESS 0xfe4c9198 /* @ECU_Address@autosar_swc_tos_rtARID_DEF.is_active_c743_autosar_swc_tos@ */ /end MEASUREMENT
/begin MEASUREMENT autosar_swc_tos_rtARID_DEF.is_active_c748_autosar_swc_tos "" UBYTE autosar_swc_tos_CM_uint8 0 0 0 255 ECU_ADDRESS 0xfe4c9194 /* @ECU_Address@autosar_swc_tos_rtARID_DEF.is_active_c748_autosar_swc_tos@ */ /end MEASUREMENT
/begin MEASUREMENT autosar_swc_tos_rtARID_DEF.is_active_c757_autosar_swc_tos "" UBYTE autosar_swc_tos_CM_uint8 0 0 0 255 ECU_ADDRESS 0xfe4c9191 /* @ECU_Address@autosar_swc_tos_rtARID_DEF.is_active_c757_autosar_swc_tos@ */ /end MEASUREMENT
/begin MEASUREMENT autosar_swc_tos_rtARID_DEF.is_c393_autosar_swc_tos "" UBYTE autosar_swc_tos_CM_uint8 0 0 0 255 ECU_ADDRESS 0xfe4c91a8 /* @ECU_Address@autosar_swc_tos_rtARID_DEF.is_c393_autosar_swc_tos@ */ /end MEASUREMENT
/begin MEASUREMENT autosar_swc_tos_rtARID_DEF.is_c394_autosar_swc_tos "" UBYTE autosar_swc_tos_CM_uint8 0 0 0 255 ECU_ADDRESS 0xfe4c91a6 /* @ECU_Address@autosar_swc_tos_rtARID_DEF.is_c394_autosar_swc_tos@ */ /end MEASUREMENT
/begin MEASUREMENT autosar_swc_tos_rtARID_DEF.is_c395_autosar_swc_tos "" UBYTE autosar_swc_tos_CM_uint8 0 0 0 255 ECU_ADDRESS 0xfe4c91a4 /* @ECU_Address@autosar_swc_tos_rtARID_DEF.is_c395_autosar_swc_tos@ */ /end MEASUREMENT
/begin MEASUREMENT autosar_swc_tos_rtARID_DEF.is_c728_autosar_swc_tos "" UBYTE autosar_swc_tos_CM_uint8 0 0 0 255 ECU_ADDRESS 0xfe4c91a0 /* @ECU_Address@autosar_swc_tos_rtARID_DEF.is_c728_autosar_swc_tos@ */ /end MEASUREMENT
/begin MEASUREMENT autosar_swc_tos_rtARID_DEF.is_c741_autosar_swc_tos "" UBYTE autosar_swc_tos_CM_uint8 0 0 0 255 ECU_ADDRESS 0xfe4c919e /* @ECU_Address@autosar_swc_tos_rtARID_DEF.is_c741_autosar_swc_tos@ */ /end MEASUREMENT
/begin MEASUREMENT autosar_swc_tos_rtARID_DEF.is_c742_autosar_swc_tos "" UBYTE autosar_swc_tos_CM_uint8 0 0 0 255 ECU_ADDRESS 0xfe4c919c /* @ECU_Address@autosar_swc_tos_rtARID_DEF.is_c742_autosar_swc_tos@ */ /end MEASUREMENT
/begin MEASUREMENT autosar_swc_tos_rtARID_DEF.is_c743_autosar_swc_tos "" UBYTE autosar_swc_tos_CM_uint8 0 0 0 255 ECU_ADDRESS 0xfe4c9199 /* @ECU_Address@autosar_swc_tos_rtARID_DEF.is_c743_autosar_swc_tos@ */ /end MEASUREMENT
/begin MEASUREMENT autosar_swc_tos_rtARID_DEF.is_c748_autosar_swc_tos "" UBYTE autosar_swc_tos_CM_uint8 0 0 0 255 ECU_ADDRESS 0xfe4c9195 /* @ECU_Address@autosar_swc_tos_rtARID_DEF.is_c748_autosar_swc_tos@ */ /end MEASUREMENT
/begin MEASUREMENT autosar_swc_tos_rtARID_DEF.is_c757_autosar_swc_tos "" UBYTE autosar_swc_tos_CM_uint8 0 0 0 255 ECU_ADDRESS 0xfe4c9192 /* @ECU_Address@autosar_swc_tos_rtARID_DEF.is_c757_autosar_swc_tos@ */ /end MEASUREMENT
/begin MEASUREMENT autosar_swc_tos_rtARID_DEF.sTrajBufSts "" UBYTE autosar_swc_tos_CM_uint8 0 0 0 255 LAYOUT COLUMN_DIR MATRIX_DIM 5 ECU_ADDRESS 0xfe4c5136 /* @ECU_Address@autosar_swc_tos_rtARID_DEF.sTrajBufSts@ */ /end MEASUREMENT
/begin MEASUREMENT autosar_swc_tos_rtARID_DEF.sTrajBufSts_h "" UBYTE autosar_swc_tos_CM_uint8 0 0 0 255 LAYOUT COLUMN_DIR MATRIX_DIM 5 ECU_ADDRESS 0xfe4c5168 /* @ECU_Address@autosar_swc_tos_rtARID_DEF.sTrajBufSts_h@ */ /end MEASUREMENT
/begin MEASUREMENT autosar_swc_tos_rtARID_DEF.sTrajDx "" FLOAT32_IEEE autosar_swc_tos_CM_single 0 0 -3.4E+38 3.4E+38 LAYOUT COLUMN_DIR MATRIX_DIM 5 50 ECU_ADDRESS 0xfe4c3ce0 /* @ECU_Address@autosar_swc_tos_rtARID_DEF.sTrajDx@ */ /end MEASUREMENT
/begin MEASUREMENT autosar_swc_tos_rtARID_DEF.sTrajDx_f "" FLOAT32_IEEE autosar_swc_tos_CM_single 0 0 -3.4E+38 3.4E+38 LAYOUT COLUMN_DIR MATRIX_DIM 5 50 ECU_ADDRESS 0xfe4c46e0 /* @ECU_Address@autosar_swc_tos_rtARID_DEF.sTrajDx_f@ */ /end MEASUREMENT
/begin MEASUREMENT autosar_swc_tos_rtARID_DEF.sTrajDy "" FLOAT32_IEEE autosar_swc_tos_CM_single 0 0 -3.4E+38 3.4E+38 LAYOUT COLUMN_DIR MATRIX_DIM 5 50 ECU_ADDRESS 0xfe4c38f8 /* @ECU_Address@autosar_swc_tos_rtARID_DEF.sTrajDy@ */ /end MEASUREMENT
/begin MEASUREMENT autosar_swc_tos_rtARID_DEF.sTrajDy_o "" FLOAT32_IEEE autosar_swc_tos_CM_single 0 0 -3.4E+38 3.4E+38 LAYOUT COLUMN_DIR MATRIX_DIM 5 50 ECU_ADDRESS 0xfe4c42f8 /* @ECU_Address@autosar_swc_tos_rtARID_DEF.sTrajDy_o@ */ /end MEASUREMENT
/begin MEASUREMENT autosar_swc_tos_rtARID_DEF.sTrajPointNum "" UBYTE autosar_swc_tos_CM_uint8 0 0 0 255 LAYOUT COLUMN_DIR MATRIX_DIM 5 ECU_ADDRESS 0xfe4c5131 /* @ECU_Address@autosar_swc_tos_rtARID_DEF.sTrajPointNum@ */ /end MEASUREMENT
/begin MEASUREMENT autosar_swc_tos_rtARID_DEF.sTrajPointNum_c "" UBYTE autosar_swc_tos_CM_uint8 0 0 0 255 LAYOUT COLUMN_DIR MATRIX_DIM 5 ECU_ADDRESS 0xfe4c5163 /* @ECU_Address@autosar_swc_tos_rtARID_DEF.sTrajPointNum_c@ */ /end MEASUREMENT
/begin MEASUREMENT autosar_swc_tos_rtARID_DEF.timeCnt "" FLOAT32_IEEE autosar_swc_tos_CM_single 0 0 -3.4E+38 3.4E+38 ECU_ADDRESS 0xfe4c4bc0 /* @ECU_Address@autosar_swc_tos_rtARID_DEF.timeCnt@ */ /end MEASUREMENT
/begin MEASUREMENT autosar_swc_tos_rtARID_DEF.timeCnt_L "" FLOAT32_IEEE autosar_swc_tos_CM_single 0 0 -3.4E+38 3.4E+38 ECU_ADDRESS 0xfe4c4bf0 /* @ECU_Address@autosar_swc_tos_rtARID_DEF.timeCnt_L@ */ /end MEASUREMENT
/begin MEASUREMENT autosar_swc_tos_rtARID_DEF.timeCnt_R "" FLOAT32_IEEE autosar_swc_tos_CM_single 0 0 -3.4E+38 3.4E+38 ECU_ADDRESS 0xfe4c4bec /* @ECU_Address@autosar_swc_tos_rtARID_DEF.timeCnt_R@ */ /end MEASUREMENT
/begin MEASUREMENT autosar_swc_tos_rtARID_DEF.timeCnt_i "" FLOAT32_IEEE autosar_swc_tos_CM_single 0 0 -3.4E+38 3.4E+38 ECU_ADDRESS 0xfe4c4bcc /* @ECU_Address@autosar_swc_tos_rtARID_DEF.timeCnt_i@ */ /end MEASUREMENT
/begin COMPU_METHOD autosar_swc_tos_CM_boolean "Q = V" IDENTICAL "%1.0" "" /end COMPU_METHOD
/begin COMPU_METHOD autosar_swc_tos_CM_double "Q = V" IDENTICAL "%15.10" "" /end COMPU_METHOD
/begin COMPU_METHOD autosar_swc_tos_CM_logical "Q = V" IDENTICAL "%1.0" "" /end COMPU_METHOD
/begin COMPU_METHOD autosar_swc_tos_CM_single "Q = V" IDENTICAL "%8.6" "" /end COMPU_METHOD
/begin COMPU_METHOD autosar_swc_tos_CM_uint16 "Q = V" IDENTICAL "%5.0" "" /end COMPU_METHOD
/begin COMPU_METHOD autosar_swc_tos_CM_uint32 "Q = V" IDENTICAL "%10.0" "" /end COMPU_METHOD
/begin COMPU_METHOD autosar_swc_tos_CM_uint64 "Q = V" IDENTICAL "%20.0" "" /end COMPU_METHOD
/begin COMPU_METHOD autosar_swc_tos_CM_uint8 "Q = V" IDENTICAL "%3.0" "" /end COMPU_METHOD
/begin RECORD_LAYOUT Record_BOOLEAN FNC_VALUES 1 UBYTE COLUMN_DIR DIRECT /end RECORD_LAYOUT
/begin RECORD_LAYOUT Record_FLOAT32_IEEE FNC_VALUES 1 FLOAT32_IEEE COLUMN_DIR DIRECT /end RECORD_LAYOUT
/begin GROUP autosar_swc_tos_autosar_swc_tos_Step_sys_TOS_main_Ego_Veh_LC_Sts1_LaneChanging "autosar_swc_tos/autosar_swc_tos_Step_sys/TOS_main/Ego_Veh_LC_Sts1/LaneChanging"
 /begin SUB_GROUP autosar_swc_tos_autosar_swc_tos_Step_sys_TOS_main_Ego_Veh_LC_Sts1_LaneChanging_Ego_MovDir1 autosar_swc_tos_autosar_swc_tos_Step_sys_TOS_main_Ego_Veh_LC_Sts1_LaneChanging_TrueDurationTime1 autosar_swc_tos_autosar_swc_tos_Step_sys_TOS_main_Ego_Veh_LC_Sts1_LaneChanging_TrueDurationTime2 autosar_swc_tos_autosar_swc_tos_Step_sys_TOS_main_Ego_Veh_LC_Sts1_LaneChanging_TrueDurationTime3 autosar_swc_tos_autosar_swc_tos_Step_sys_TOS_main_Ego_Veh_LC_Sts1_LaneChanging_TrueDurationTime4 autosar_swc_tos_autosar_swc_tos_Step_sys_TOS_main_Ego_Veh_LC_Sts1_LaneChanging_TrueDurationTime5 /end SUB_GROUP
 /begin REF_CHARACTERISTIC P_TOS_EgoLC_FrontThre P_TOS_EgoLC_RearThre /end REF_CHARACTERISTIC
 /begin REF_MEASUREMENT autosar_swc_tos_rtARID_DEF.Delay10_DSTATE autosar_swc_tos_rtARID_DEF.Delay11_DSTATE autosar_swc_tos_rtARID_DEF.Delay12_DSTATE autosar_swc_tos_rtARID_DEF.Delay13_DSTATE autosar_swc_tos_rtARID_DEF.Delay14_DSTATE autosar_swc_tos_rtARID_DEF.Delay1_DSTATE_d autosar_swc_tos_rtARID_DEF.Delay2_DSTATE_b autosar_swc_tos_rtARID_DEF.Delay3_DSTATE_k autosar_swc_tos_rtARID_DEF.Delay4_DSTATE_k autosar_swc_tos_rtARID_DEF.Delay5_DSTATE_m autosar_swc_tos_rtARID_DEF.Delay6_DSTATE_l autosar_swc_tos_rtARID_DEF.Delay7_DSTATE autosar_swc_tos_rtARID_DEF.Delay8_DSTATE autosar_swc_tos_rtARID_DEF.Delay9_DSTATE autosar_swc_tos_rtARID_DEF.Delay_DSTATE_f autosar_swc_tos_rtARID_DEF.LcTimeCntL autosar_swc_tos_rtARID_DEF.LcTimeCntR autosar_swc_tos_rtARID_DEF.Turn_Left autosar_swc_tos_rtARID_DEF.Turn_Right autosar_swc_tos_rtARID_DEF.is_active_c393_autosar_swc_tos autosar_swc_tos_rtARID_DEF.is_active_c394_autosar_swc_tos autosar_swc_tos_rtARID_DEF.is_active_c395_autosar_swc_tos autosar_swc_tos_rtARID_DEF.is_c393_autosar_swc_tos autosar_swc_tos_rtARID_DEF.is_c394_autosar_swc_tos autosar_swc_tos_rtARID_DEF.is_c395_autosar_swc_tos autosar_swc_tos_rtARID_DEF.timeCnt_L autosar_swc_tos_rtARID_DEF.timeCnt_R /end REF_MEASUREMENT
/end GROUP
/begin GROUP autosar_swc_tos_autosar_swc_tos_Step_sys_TOS_main_Ego_Veh_LC_Sts1_LaneChanging_Ego_MovDir1 "autosar_swc_tos/autosar_swc_tos_Step_sys/TOS_main/Ego_Veh_LC_Sts1/LaneChanging/Ego_MovDir1"
 /begin SUB_GROUP autosar_swc_tos_autosar_swc_tos_Step_sys_TOS_main_Ego_Veh_LC_Sts1_LaneChanging_Ego_MovDir1_Subsystem1 /end SUB_GROUP
/end GROUP
/begin GROUP autosar_swc_tos_autosar_swc_tos_Step_sys_TOS_main_Ego_Veh_LC_Sts1_LaneChanging_Ego_MovDir1_Subsystem1 "autosar_swc_tos/autosar_swc_tos_Step_sys/TOS_main/Ego_Veh_LC_Sts1/LaneChanging/Ego_MovDir1/Subsystem1"
 /begin REF_MEASUREMENT autosar_swc_tos_rtARID_DEF.UnitDelay1_DSTATE_o autosar_swc_tos_rtARID_DEF.UnitDelay2_DSTATE_hf /end REF_MEASUREMENT
/end GROUP
/begin GROUP autosar_swc_tos_autosar_swc_tos_Step_sys_TOS_main_Ego_Veh_LC_Sts1_LaneChanging_TrueDurationTime1 "autosar_swc_tos/autosar_swc_tos_Step_sys/TOS_main/Ego_Veh_LC_Sts1/LaneChanging/TrueDurationTime1"
 /begin REF_MEASUREMENT autosar_swc_tos_rtARID_DEF.UnitDelay1_DSTATE_hj autosar_swc_tos_rtARID_DEF.UnitDelay2_DSTATE_bc /end REF_MEASUREMENT
/end GROUP
/begin GROUP autosar_swc_tos_autosar_swc_tos_Step_sys_TOS_main_Ego_Veh_LC_Sts1_LaneChanging_TrueDurationTime2 "autosar_swc_tos/autosar_swc_tos_Step_sys/TOS_main/Ego_Veh_LC_Sts1/LaneChanging/TrueDurationTime2"
 /begin REF_MEASUREMENT autosar_swc_tos_rtARID_DEF.UnitDelay1_DSTATE_ju autosar_swc_tos_rtARID_DEF.UnitDelay2_DSTATE_j /end REF_MEASUREMENT
/end GROUP
/begin GROUP autosar_swc_tos_autosar_swc_tos_Step_sys_TOS_main_Ego_Veh_LC_Sts1_LaneChanging_TrueDurationTime3 "autosar_swc_tos/autosar_swc_tos_Step_sys/TOS_main/Ego_Veh_LC_Sts1/LaneChanging/TrueDurationTime3"
 /begin REF_MEASUREMENT autosar_swc_tos_rtARID_DEF.UnitDelay1_DSTATE_f autosar_swc_tos_rtARID_DEF.UnitDelay2_DSTATE_nt /end REF_MEASUREMENT
/end GROUP
/begin GROUP autosar_swc_tos_autosar_swc_tos_Step_sys_TOS_main_Ego_Veh_LC_Sts1_LaneChanging_TrueDurationTime4 "autosar_swc_tos/autosar_swc_tos_Step_sys/TOS_main/Ego_Veh_LC_Sts1/LaneChanging/TrueDurationTime4"
 /begin REF_MEASUREMENT autosar_swc_tos_rtARID_DEF.UnitDelay1_DSTATE_i1 autosar_swc_tos_rtARID_DEF.UnitDelay2_DSTATE_eq /end REF_MEASUREMENT
/end GROUP
/begin GROUP autosar_swc_tos_autosar_swc_tos_Step_sys_TOS_main_Ego_Veh_LC_Sts1_LaneChanging_TrueDurationTime5 "autosar_swc_tos/autosar_swc_tos_Step_sys/TOS_main/Ego_Veh_LC_Sts1/LaneChanging/TrueDurationTime5"
 /begin REF_MEASUREMENT autosar_swc_tos_rtARID_DEF.UnitDelay1_DSTATE_n autosar_swc_tos_rtARID_DEF.UnitDelay2_DSTATE_n /end REF_MEASUREMENT
/end GROUP
/begin GROUP autosar_swc_tos_autosar_swc_tos_Step_sys_TOS_main_Ego_Veh_LC_Sts1_Subsystem "autosar_swc_tos/autosar_swc_tos_Step_sys/TOS_main/Ego_Veh_LC_Sts1/Subsystem"
 /begin REF_MEASUREMENT autosar_swc_tos_rtARID_DEF.OriLaneID autosar_swc_tos_rtARID_DEF.TarLaneID /end REF_MEASUREMENT
/end GROUP
/begin GROUP autosar_swc_tos_autosar_swc_tos_Step_sys_TOS_main_Ego_Veh_LC_Sts1_Subsystem1 "autosar_swc_tos/autosar_swc_tos_Step_sys/TOS_main/Ego_Veh_LC_Sts1/Subsystem1"
 /begin REF_MEASUREMENT autosar_swc_tos_rtARID_DEF.Delay1_DSTATE_i autosar_swc_tos_rtARID_DEF.Delay2_DSTATE_d autosar_swc_tos_rtARID_DEF.Delay3_DSTATE_e autosar_swc_tos_rtARID_DEF.Delay_DSTATE_m /end REF_MEASUREMENT
/end GROUP
/begin GROUP autosar_swc_tos_autosar_swc_tos_Step_sys_TOS_main_LM_Model "autosar_swc_tos/autosar_swc_tos_Step_sys/TOS_main/LM_Model"
 /begin SUB_GROUP autosar_swc_tos_autosar_swc_tos_Step_sys_TOS_main_LM_Model_EML autosar_swc_tos_autosar_swc_tos_Step_sys_TOS_main_LM_Model_Subsystem autosar_swc_tos_autosar_swc_tos_Step_sys_TOS_main_LM_Model_Subsystem5 autosar_swc_tos_autosar_swc_tos_Step_sys_TOS_main_LM_Model_VSL /end SUB_GROUP
/end GROUP
/begin GROUP autosar_swc_tos_autosar_swc_tos_Step_sys_TOS_main_LM_Model_EML "autosar_swc_tos/autosar_swc_tos_Step_sys/TOS_main/LM_Model/EML" /begin REF_MEASUREMENT autosar_swc_tos_rtARID_DEF.MelpKapBuf /end REF_MEASUREMENT /end GROUP
/begin GROUP autosar_swc_tos_autosar_swc_tos_Step_sys_TOS_main_LM_Model_Subsystem "autosar_swc_tos/autosar_swc_tos_Step_sys/TOS_main/LM_Model/Subsystem"
 /begin SUB_GROUP autosar_swc_tos_autosar_swc_tos_Step_sys_TOS_main_LM_Model_Subsystem_Subsystem /end SUB_GROUP
/end GROUP
/begin GROUP autosar_swc_tos_autosar_swc_tos_Step_sys_TOS_main_LM_Model_Subsystem5 "autosar_swc_tos/autosar_swc_tos_Step_sys/TOS_main/LM_Model/Subsystem5"
 /begin REF_MEASUREMENT autosar_swc_tos_rtARID_DEF.Intersection_Keep autosar_swc_tos_rtARID_DEF.LastLM_not_empty autosar_swc_tos_rtARID_DEF.Lastmodel autosar_swc_tos_rtARID_DEF.RFMsustained /end REF_MEASUREMENT
/end GROUP
/begin GROUP autosar_swc_tos_autosar_swc_tos_Step_sys_TOS_main_LM_Model_Subsystem_Subsystem "autosar_swc_tos/autosar_swc_tos_Step_sys/TOS_main/LM_Model/Subsystem/Subsystem" /begin REF_CHARACTERISTIC P_TOS_LCLM_Switch /end REF_CHARACTERISTIC /end GROUP
/begin GROUP autosar_swc_tos_autosar_swc_tos_Step_sys_TOS_main_LM_Model_VSL "autosar_swc_tos/autosar_swc_tos_Step_sys/TOS_main/LM_Model/VSL"
 /begin SUB_GROUP autosar_swc_tos_autosar_swc_tos_Step_sys_TOS_main_LM_Model_VSL_If_Action_Subsystem /end SUB_GROUP
/end GROUP
/begin GROUP autosar_swc_tos_autosar_swc_tos_Step_sys_TOS_main_LM_Model_VSL_If_Action_Subsystem "autosar_swc_tos/autosar_swc_tos_Step_sys/TOS_main/LM_Model/VSL/If Action\nSubsystem"
 /begin SUB_GROUP autosar_swc_tos_autosar_swc_tos_Step_sys_TOS_main_LM_Model_VSL_If_Action_Subsystem_Subsystem autosar_swc_tos_autosar_swc_tos_Step_sys_TOS_main_LM_Model_VSL_If_Action_Subsystem_Subsystem1 /end SUB_GROUP
/end GROUP
/begin GROUP autosar_swc_tos_autosar_swc_tos_Step_sys_TOS_main_LM_Model_VSL_If_Action_Subsystem_Subsystem "autosar_swc_tos/autosar_swc_tos_Step_sys/TOS_main/LM_Model/VSL/If Action\nSubsystem/Subsystem"
 /begin SUB_GROUP autosar_swc_tos_autosar_swc_tos_Step_sys_TOS_main_LM_Model_VSL_If_Action_Subsystem_Subsystem_Subsystem1 autosar_swc_tos_autosar_swc_tos_Step_sys_TOS_main_LM_Model_VSL_If_Action_Subsystem_Subsystem_Subsystem2 /end SUB_GROUP
/end GROUP
/begin GROUP autosar_swc_tos_autosar_swc_tos_Step_sys_TOS_main_LM_Model_VSL_If_Action_Subsystem_Subsystem1 "autosar_swc_tos/autosar_swc_tos_Step_sys/TOS_main/LM_Model/VSL/If Action\nSubsystem/Subsystem1"
 /begin REF_MEASUREMENT autosar_swc_tos_rtARID_DEF.LastWidth autosar_swc_tos_rtARID_DEF.MemoryWidth /end REF_MEASUREMENT
/end GROUP
/begin GROUP autosar_swc_tos_autosar_swc_tos_Step_sys_TOS_main_LM_Model_VSL_If_Action_Subsystem_Subsystem_Subsystem1 "autosar_swc_tos/autosar_swc_tos_Step_sys/TOS_main/LM_Model/VSL/If Action\nSubsystem/Subsystem/Subsystem1"
 /begin REF_MEASUREMENT autosar_swc_tos_rtARID_DEF.UnitDelay1_DSTATE_a2 autosar_swc_tos_rtARID_DEF.UnitDelay2_DSTATE_kk /end REF_MEASUREMENT
/end GROUP
/begin GROUP autosar_swc_tos_autosar_swc_tos_Step_sys_TOS_main_LM_Model_VSL_If_Action_Subsystem_Subsystem_Subsystem2 "autosar_swc_tos/autosar_swc_tos_Step_sys/TOS_main/LM_Model/VSL/If Action\nSubsystem/Subsystem/Subsystem2"
 /begin REF_MEASUREMENT autosar_swc_tos_rtARID_DEF.UnitDelay1_DSTATE_jr autosar_swc_tos_rtARID_DEF.UnitDelay2_DSTATE_ew /end REF_MEASUREMENT
/end GROUP
/begin GROUP autosar_swc_tos_autosar_swc_tos_Step_sys_TOS_main_Output_Model "autosar_swc_tos/autosar_swc_tos_Step_sys/TOS_main/Output_Model"
 /begin SUB_GROUP autosar_swc_tos_autosar_swc_tos_Step_sys_TOS_main_Output_Model_A2L autosar_swc_tos_autosar_swc_tos_Step_sys_TOS_main_Output_Model_Output_Model /end SUB_GROUP
/end GROUP
/begin GROUP autosar_swc_tos_autosar_swc_tos_Step_sys_TOS_main_Output_Model_A2L "autosar_swc_tos/autosar_swc_tos_Step_sys/TOS_main/Output_Model/A2L" /begin REF_MEASUREMENT SwcOut_TOS_LM_FusCase /end REF_MEASUREMENT /end GROUP
/begin GROUP autosar_swc_tos_autosar_swc_tos_Step_sys_TOS_main_Output_Model_Output_Model "autosar_swc_tos/autosar_swc_tos_Step_sys/TOS_main/Output_Model/Output_Model"
 /begin SUB_GROUP autosar_swc_tos_autosar_swc_tos_Step_sys_TOS_main_Output_Model_Output_Model_Counter_Limited autosar_swc_tos_autosar_swc_tos_Step_sys_TOS_main_Output_Model_Output_Model_Subsystem5 /end SUB_GROUP
 /begin REF_MEASUREMENT autosar_swc_tos_rtARID_DEF.ImpAsg_InsertedFor_ID_at_inport_0 /end REF_MEASUREMENT
/end GROUP
/begin GROUP autosar_swc_tos_autosar_swc_tos_Step_sys_TOS_main_Output_Model_Output_Model_Counter_Limited "autosar_swc_tos/autosar_swc_tos_Step_sys/TOS_main/Output_Model/Output_Model/Counter\nLimited" /begin REF_MEASUREMENT autosar_swc_tos_rtARID_DEF.Output_DSTATE /end REF_MEASUREMENT /end GROUP
/begin GROUP autosar_swc_tos_autosar_swc_tos_Step_sys_TOS_main_Output_Model_Output_Model_Subsystem5 "autosar_swc_tos/autosar_swc_tos_Step_sys/TOS_main/Output_Model/Output_Model/Subsystem5"
 /begin REF_MEASUREMENT autosar_swc_tos_rtARID_DEF.Delay_DSTATE_l autosar_swc_tos_rtARID_DEF.ImpAsg_InsertedFor_ID_at_inport_0 /end REF_MEASUREMENT
/end GROUP
/begin GROUP autosar_swc_tos_autosar_swc_tos_Step_sys_TOS_main_TOS_ACC "autosar_swc_tos/autosar_swc_tos_Step_sys/TOS_main/TOS_ACC"
 /begin SUB_GROUP autosar_swc_tos_autosar_swc_tos_Step_sys_TOS_main_TOS_ACC_Subsystem1 autosar_swc_tos_autosar_swc_tos_Step_sys_TOS_main_TOS_ACC_Subsystem_Reference autosar_swc_tos_autosar_swc_tos_Step_sys_TOS_main_TOS_ACC_TOS_ACC_For_Each_64 autosar_swc_tos_autosar_swc_tos_Step_sys_TOS_main_TOS_ACC_TOS_ACC_Sort_Index2 /end SUB_GROUP
 /begin REF_MEASUREMENT autosar_swc_tos_rtARID_DEF.UnitDelay1_DSTATE_ox autosar_swc_tos_rtARID_DEF.UnitDelay_DSTATE_h /end REF_MEASUREMENT
/end GROUP
/begin GROUP autosar_swc_tos_autosar_swc_tos_Step_sys_TOS_main_TOS_ACC_Subsystem1 "autosar_swc_tos/autosar_swc_tos_Step_sys/TOS_main/TOS_ACC/Subsystem1"
 /begin REF_MEASUREMENT autosar_swc_tos_rtARID_DEF.ImpAsg_InsertedFor_ID_at_inport_0 /end REF_MEASUREMENT
/end GROUP
/begin GROUP autosar_swc_tos_autosar_swc_tos_Step_sys_TOS_main_TOS_ACC_Subsystem_Reference "autosar_swc_tos/autosar_swc_tos_Step_sys/TOS_main/TOS_ACC/Subsystem Reference"
 /begin SUB_GROUP autosar_swc_tos_autosar_swc_tos_Step_sys_TOS_main_TOS_ACC_Subsystem_Reference_Compare_To_Constant autosar_swc_tos_autosar_swc_tos_Step_sys_TOS_main_TOS_ACC_Subsystem_Reference_Compare_To_Constant1 autosar_swc_tos_autosar_swc_tos_Step_sys_TOS_main_TOS_ACC_Subsystem_Reference_Compare_To_Constant2 autosar_swc_tos_autosar_swc_tos_Step_sys_TOS_main_TOS_ACC_Subsystem_Reference_Compare_To_Constant3 autosar_swc_tos_autosar_swc_tos_Step_sys_TOS_main_TOS_ACC_Subsystem_Reference_Compare_To_Constant4 autosar_swc_tos_autosar_swc_tos_Step_sys_TOS_main_TOS_ACC_Subsystem_Reference_For_Each_Subsystem1 autosar_swc_tos_autosar_swc_tos_Step_sys_TOS_main_TOS_ACC_Subsystem_Reference_IES_EgoSts autosar_swc_tos_autosar_swc_tos_Step_sys_TOS_main_TOS_ACC_Subsystem_Reference_Subsystem autosar_swc_tos_autosar_swc_tos_Step_sys_TOS_main_TOS_ACC_Subsystem_Reference_Subsystem1 autosar_swc_tos_autosar_swc_tos_Step_sys_TOS_main_TOS_ACC_Subsystem_Reference_Subsystem2 autosar_swc_tos_autosar_swc_tos_Step_sys_TOS_main_TOS_ACC_Subsystem_Reference_Subsystem3 autosar_swc_tos_autosar_swc_tos_Step_sys_TOS_main_TOS_ACC_Subsystem_Reference_Subsystem4 autosar_swc_tos_autosar_swc_tos_Step_sys_TOS_main_TOS_ACC_Subsystem_Reference_Subsystem5 autosar_swc_tos_autosar_swc_tos_Step_sys_TOS_main_TOS_ACC_Subsystem_Reference_Subsystem6 autosar_swc_tos_autosar_swc_tos_Step_sys_TOS_main_TOS_ACC_Subsystem_Reference_Subsystem7 autosar_swc_tos_autosar_swc_tos_Step_sys_TOS_main_TOS_ACC_Subsystem_Reference_TrueDurationTime autosar_swc_tos_autosar_swc_tos_Step_sys_TOS_main_TOS_ACC_Subsystem_Reference_TrueDurationTime1 autosar_swc_tos_autosar_swc_tos_Step_sys_TOS_main_TOS_ACC_Subsystem_Reference_TrueDurationTime2 /end SUB_GROUP
 /begin REF_CHARACTERISTIC P_TOS_IESActive_BreakingDis P_TOS_IESActive_IESSTTC P_TOS_IESActive_IESSafetyDis /end REF_CHARACTERISTIC
 /begin REF_MEASUREMENT TOS_reserve04 autosar_swc_tos_rtARID_DEF.ContinuousNudge autosar_swc_tos_rtARID_DEF.ContinuousNudgeTime autosar_swc_tos_rtARID_DEF.ContinuousNudgeTime_not_empty autosar_swc_tos_rtARID_DEF.Delay10_DSTATE_d autosar_swc_tos_rtARID_DEF.Delay11_DSTATE_f autosar_swc_tos_rtARID_DEF.Delay12_DSTATE_e autosar_swc_tos_rtARID_DEF.Delay2_DSTATE_j autosar_swc_tos_rtARID_DEF.Delay3_DSTATE_p autosar_swc_tos_rtARID_DEF.Delay4_DSTATE_j autosar_swc_tos_rtARID_DEF.Delay5_DSTATE_e autosar_swc_tos_rtARID_DEF.Delay9_DSTATE_j autosar_swc_tos_rtARID_DEF.EgoSpeedLimit autosar_swc_tos_rtARID_DEF.IESorBreakingSts autosar_swc_tos_rtARID_DEF.ImpAsg_InsertedFor_ID_at_inport_0 autosar_swc_tos_rtARID_DEF.LasNudgeValue autosar_swc_tos_rtARID_DEF.Mem_Value autosar_swc_tos_rtARID_DEF.Mem_Value_b autosar_swc_tos_rtARID_DEF.NudgeOver autosar_swc_tos_rtARID_DEF.NudgeOverTime autosar_swc_tos_rtARID_DEF.NudgeOverTime_k autosar_swc_tos_rtARID_DEF.NudgeOverTime_not_empty autosar_swc_tos_rtARID_DEF.NudgeOverTime_not_empty_p autosar_swc_tos_rtARID_DEF.NudgeOver_k autosar_swc_tos_rtARID_DEF.timeCnt autosar_swc_tos_rtARID_DEF.timeCnt_i /end REF_MEASUREMENT
/end GROUP
/begin GROUP autosar_swc_tos_autosar_swc_tos_Step_sys_TOS_main_TOS_ACC_Subsystem_Reference_Compare_To_Constant "autosar_swc_tos/autosar_swc_tos_Step_sys/TOS_main/TOS_ACC/Subsystem Reference/Compare\nTo Constant" /begin REF_MEASUREMENT autosar_swc_tos_rtARID_DEF.IESorBreakingSts /end REF_MEASUREMENT /end GROUP
/begin GROUP autosar_swc_tos_autosar_swc_tos_Step_sys_TOS_main_TOS_ACC_Subsystem_Reference_Compare_To_Constant1 "autosar_swc_tos/autosar_swc_tos_Step_sys/TOS_main/TOS_ACC/Subsystem Reference/Compare\nTo Constant1" /begin REF_MEASUREMENT autosar_swc_tos_rtARID_DEF.IESorBreakingSts /end REF_MEASUREMENT /end GROUP
/begin GROUP autosar_swc_tos_autosar_swc_tos_Step_sys_TOS_main_TOS_ACC_Subsystem_Reference_Compare_To_Constant2 "autosar_swc_tos/autosar_swc_tos_Step_sys/TOS_main/TOS_ACC/Subsystem Reference/Compare\nTo Constant2" /begin REF_MEASUREMENT autosar_swc_tos_rtARID_DEF.IESorBreakingSts /end REF_MEASUREMENT /end GROUP
/begin GROUP autosar_swc_tos_autosar_swc_tos_Step_sys_TOS_main_TOS_ACC_Subsystem_Reference_Compare_To_Constant3 "autosar_swc_tos/autosar_swc_tos_Step_sys/TOS_main/TOS_ACC/Subsystem Reference/Compare\nTo Constant3" /begin REF_MEASUREMENT autosar_swc_tos_rtARID_DEF.IESorBreakingSts /end REF_MEASUREMENT /end GROUP
/begin GROUP autosar_swc_tos_autosar_swc_tos_Step_sys_TOS_main_TOS_ACC_Subsystem_Reference_Compare_To_Constant4 "autosar_swc_tos/autosar_swc_tos_Step_sys/TOS_main/TOS_ACC/Subsystem Reference/Compare\nTo Constant4" /begin REF_MEASUREMENT autosar_swc_tos_rtARID_DEF.IESorBreakingSts /end REF_MEASUREMENT /end GROUP
/begin GROUP autosar_swc_tos_autosar_swc_tos_Step_sys_TOS_main_TOS_ACC_Subsystem_Reference_For_Each_Subsystem1 "autosar_swc_tos/autosar_swc_tos_Step_sys/TOS_main/TOS_ACC/Subsystem Reference/For Each\nSubsystem1"
 /begin SUB_GROUP autosar_swc_tos_autosar_swc_tos_Step_sys_TOS_main_TOS_ACC_Subsystem_Reference_For_Each_Subsystem1_For_Each_Subsystem autosar_swc_tos_autosar_swc_tos_Step_sys_TOS_main_TOS_ACC_Subsystem_Reference_For_Each_Subsystem1_For_Each_Subsystem1 autosar_swc_tos_autosar_swc_tos_Step_sys_TOS_main_TOS_ACC_Subsystem_Reference_For_Each_Subsystem1_Subsystem autosar_swc_tos_autosar_swc_tos_Step_sys_TOS_main_TOS_ACC_Subsystem_Reference_For_Each_Subsystem1_Subsystem1 /end SUB_GROUP
 /begin REF_CHARACTERISTIC P_TOS_IESOffset_BoundaryExist_Max P_TOS_IESOffset_BoundaryExist_Min P_TOS_IESOffset_GeneralScene_Max P_TOS_IESOffset_GeneralScene_Min P_TOS_IESOffset_HighSpeed_Max P_TOS_IESOffset_HighSpeed_Min P_TOS_IESOffset_NarrowLane_Max P_TOS_IESOffset_NarrowLane_Min /end REF_CHARACTERISTIC
 /begin REF_MEASUREMENT autosar_swc_tos_rtARID_DEF.Delay1_DSTATE_l autosar_swc_tos_rtARID_DEF.Delay2_DSTATE_p autosar_swc_tos_rtARID_DEF.Delay3_DSTATE_n autosar_swc_tos_rtARID_DEF.Delay4_DSTATE_h autosar_swc_tos_rtARID_DEF.Delay5_DSTATE_a autosar_swc_tos_rtARID_DEF.Delay6_DSTATE_g autosar_swc_tos_rtARID_DEF.Delay7_DSTATE_j autosar_swc_tos_rtARID_DEF.Delay8_DSTATE_n autosar_swc_tos_rtARID_DEF.Delay9_DSTATE_l /end REF_MEASUREMENT
/end GROUP
/begin GROUP autosar_swc_tos_autosar_swc_tos_Step_sys_TOS_main_TOS_ACC_Subsystem_Reference_For_Each_Subsystem1_For_Each_Subsystem "autosar_swc_tos/autosar_swc_tos_Step_sys/TOS_main/TOS_ACC/Subsystem Reference/For Each\nSubsystem1/For Each\nSubsystem"
 /begin SUB_GROUP autosar_swc_tos_autosar_swc_tos_Step_sys_TOS_main_TOS_ACC_Subsystem_Reference_For_Each_Subsystem1_For_Each_Subsystem_Compare_To_Constant13 autosar_swc_tos_autosar_swc_tos_Step_sys_TOS_main_TOS_ACC_Subsystem_Reference_For_Each_Subsystem1_For_Each_Subsystem_Compare_To_Constant9 /end SUB_GROUP
/end GROUP
/begin GROUP autosar_swc_tos_autosar_swc_tos_Step_sys_TOS_main_TOS_ACC_Subsystem_Reference_For_Each_Subsystem1_For_Each_Subsystem1 "autosar_swc_tos/autosar_swc_tos_Step_sys/TOS_main/TOS_ACC/Subsystem Reference/For Each\nSubsystem1/For Each\nSubsystem1"
 /begin REF_CHARACTERISTIC P_TOS_IES_StationaryObj_SafeDisEgo2Lane P_TOS_IES_StationaryObj_SafeDisEgo2Obj P_TOS_IES_StationaryObj_offsetMax P_TOS_IES_StationaryObj_offsetMid P_TOS_IES_StationaryObj_offsetMin /end REF_CHARACTERISTIC
/end GROUP
/begin GROUP autosar_swc_tos_autosar_swc_tos_Step_sys_TOS_main_TOS_ACC_Subsystem_Reference_For_Each_Subsystem1_For_Each_Subsystem_Compare_To_Constant13 "autosar_swc_tos/autosar_swc_tos_Step_sys/TOS_main/TOS_ACC/Subsystem Reference/For Each\nSubsystem1/For Each\nSubsystem/Compare\nTo Constant13" /begin REF_CHARACTERISTIC P_TOS_IES_LowSpeedODD_Limit /end REF_CHARACTERISTIC /end GROUP
/begin GROUP autosar_swc_tos_autosar_swc_tos_Step_sys_TOS_main_TOS_ACC_Subsystem_Reference_For_Each_Subsystem1_For_Each_Subsystem_Compare_To_Constant9 "autosar_swc_tos/autosar_swc_tos_Step_sys/TOS_main/TOS_ACC/Subsystem Reference/For Each\nSubsystem1/For Each\nSubsystem/Compare\nTo Constant9" /begin REF_CHARACTERISTIC P_TOS_IES_LowSpeedODD_Limit /end REF_CHARACTERISTIC /end GROUP
/begin GROUP autosar_swc_tos_autosar_swc_tos_Step_sys_TOS_main_TOS_ACC_Subsystem_Reference_For_Each_Subsystem1_Subsystem "autosar_swc_tos/autosar_swc_tos_Step_sys/TOS_main/TOS_ACC/Subsystem Reference/For Each\nSubsystem1/Subsystem" /begin REF_MEASUREMENT autosar_swc_tos_rtARID_DEF.Delay_DSTATE_c /end REF_MEASUREMENT /end GROUP
/begin GROUP autosar_swc_tos_autosar_swc_tos_Step_sys_TOS_main_TOS_ACC_Subsystem_Reference_For_Each_Subsystem1_Subsystem1 "autosar_swc_tos/autosar_swc_tos_Step_sys/TOS_main/TOS_ACC/Subsystem Reference/For Each\nSubsystem1/Subsystem1"
 /begin REF_MEASUREMENT autosar_swc_tos_rtARID_DEF.ImpAsg_InsertedFor_ID_at_inport_0 autosar_swc_tos_rtARID_DEF.UnitDelay2_DSTATE_k /end REF_MEASUREMENT
/end GROUP
/begin GROUP autosar_swc_tos_autosar_swc_tos_Step_sys_TOS_main_TOS_ACC_Subsystem_Reference_IES_EgoSts "autosar_swc_tos/autosar_swc_tos_Step_sys/TOS_main/TOS_ACC/Subsystem Reference/IES_EgoSts"
 /begin SUB_GROUP autosar_swc_tos_autosar_swc_tos_Step_sys_TOS_main_TOS_ACC_Subsystem_Reference_IES_EgoSts_Compare_To_Constant12 autosar_swc_tos_autosar_swc_tos_Step_sys_TOS_main_TOS_ACC_Subsystem_Reference_IES_EgoSts_Compare_To_Constant13 autosar_swc_tos_autosar_swc_tos_Step_sys_TOS_main_TOS_ACC_Subsystem_Reference_IES_EgoSts_Compare_To_Constant4 autosar_swc_tos_autosar_swc_tos_Step_sys_TOS_main_TOS_ACC_Subsystem_Reference_IES_EgoSts_Subsystem1 autosar_swc_tos_autosar_swc_tos_Step_sys_TOS_main_TOS_ACC_Subsystem_Reference_IES_EgoSts_TrueDurationTime autosar_swc_tos_autosar_swc_tos_Step_sys_TOS_main_TOS_ACC_Subsystem_Reference_IES_EgoSts_TrueDurationTime1 autosar_swc_tos_autosar_swc_tos_Step_sys_TOS_main_TOS_ACC_Subsystem_Reference_IES_EgoSts_TrueDurationTime2 autosar_swc_tos_autosar_swc_tos_Step_sys_TOS_main_TOS_ACC_Subsystem_Reference_IES_EgoSts_TrueDurationTime3 /end SUB_GROUP
 /begin REF_MEASUREMENT TOS_reserve01 TOS_reserve02 TOS_reserve03 TOS_reserve07 TOS_reserve08 TOS_reserve09 TOS_reserve10 /end REF_MEASUREMENT
/end GROUP
/begin GROUP autosar_swc_tos_autosar_swc_tos_Step_sys_TOS_main_TOS_ACC_Subsystem_Reference_IES_EgoSts_Compare_To_Constant12 "autosar_swc_tos/autosar_swc_tos_Step_sys/TOS_main/TOS_ACC/Subsystem Reference/IES_EgoSts/Compare\nTo Constant12" /begin REF_CHARACTERISTIC P_TOS_IESActive_SpeedMax /end REF_CHARACTERISTIC /end GROUP
/begin GROUP autosar_swc_tos_autosar_swc_tos_Step_sys_TOS_main_TOS_ACC_Subsystem_Reference_IES_EgoSts_Compare_To_Constant13 "autosar_swc_tos/autosar_swc_tos_Step_sys/TOS_main/TOS_ACC/Subsystem Reference/IES_EgoSts/Compare\nTo Constant13" /begin REF_CHARACTERISTIC P_TOS_IESActive_LaneWidth /end REF_CHARACTERISTIC /end GROUP
/begin GROUP autosar_swc_tos_autosar_swc_tos_Step_sys_TOS_main_TOS_ACC_Subsystem_Reference_IES_EgoSts_Compare_To_Constant4 "autosar_swc_tos/autosar_swc_tos_Step_sys/TOS_main/TOS_ACC/Subsystem Reference/IES_EgoSts/Compare\nTo Constant4" /begin REF_CHARACTERISTIC P_TOS_IESActive_LaneWidth /end REF_CHARACTERISTIC /end GROUP
/begin GROUP autosar_swc_tos_autosar_swc_tos_Step_sys_TOS_main_TOS_ACC_Subsystem_Reference_IES_EgoSts_Subsystem1 "autosar_swc_tos/autosar_swc_tos_Step_sys/TOS_main/TOS_ACC/Subsystem Reference/IES_EgoSts/Subsystem1"
 /begin SUB_GROUP autosar_swc_tos_autosar_swc_tos_Step_sys_TOS_main_TOS_ACC_Subsystem_Reference_IES_EgoSts_Subsystem1_Compare_To_Constant1 autosar_swc_tos_autosar_swc_tos_Step_sys_TOS_main_TOS_ACC_Subsystem_Reference_IES_EgoSts_Subsystem1_Compare_To_Constant3 autosar_swc_tos_autosar_swc_tos_Step_sys_TOS_main_TOS_ACC_Subsystem_Reference_IES_EgoSts_Subsystem1_TrueDurationTime autosar_swc_tos_autosar_swc_tos_Step_sys_TOS_main_TOS_ACC_Subsystem_Reference_IES_EgoSts_Subsystem1_TrueDurationTime1 /end SUB_GROUP
 /begin REF_MEASUREMENT autosar_swc_tos_rtARID_DEF.is_active_c728_autosar_swc_tos autosar_swc_tos_rtARID_DEF.is_c728_autosar_swc_tos /end REF_MEASUREMENT
/end GROUP
/begin GROUP autosar_swc_tos_autosar_swc_tos_Step_sys_TOS_main_TOS_ACC_Subsystem_Reference_IES_EgoSts_Subsystem1_Compare_To_Constant1 "autosar_swc_tos/autosar_swc_tos_Step_sys/TOS_main/TOS_ACC/Subsystem Reference/IES_EgoSts/Subsystem1/Compare\nTo Constant1" /begin REF_CHARACTERISTIC P_TOS_IES_LaneCurV_in /end REF_CHARACTERISTIC /end GROUP
/begin GROUP autosar_swc_tos_autosar_swc_tos_Step_sys_TOS_main_TOS_ACC_Subsystem_Reference_IES_EgoSts_Subsystem1_Compare_To_Constant3 "autosar_swc_tos/autosar_swc_tos_Step_sys/TOS_main/TOS_ACC/Subsystem Reference/IES_EgoSts/Subsystem1/Compare\nTo Constant3" /begin REF_CHARACTERISTIC P_TOS_IES_LaneCurV_out /end REF_CHARACTERISTIC /end GROUP
/begin GROUP autosar_swc_tos_autosar_swc_tos_Step_sys_TOS_main_TOS_ACC_Subsystem_Reference_IES_EgoSts_Subsystem1_TrueDurationTime "autosar_swc_tos/autosar_swc_tos_Step_sys/TOS_main/TOS_ACC/Subsystem Reference/IES_EgoSts/Subsystem1/TrueDurationTime"
 /begin REF_MEASUREMENT autosar_swc_tos_rtARID_DEF.UnitDelay1_DSTATE_ja autosar_swc_tos_rtARID_DEF.UnitDelay2_DSTATE_m /end REF_MEASUREMENT
/end GROUP
/begin GROUP autosar_swc_tos_autosar_swc_tos_Step_sys_TOS_main_TOS_ACC_Subsystem_Reference_IES_EgoSts_Subsystem1_TrueDurationTime1 "autosar_swc_tos/autosar_swc_tos_Step_sys/TOS_main/TOS_ACC/Subsystem Reference/IES_EgoSts/Subsystem1/TrueDurationTime1"
 /begin REF_MEASUREMENT autosar_swc_tos_rtARID_DEF.UnitDelay1_DSTATE_nf autosar_swc_tos_rtARID_DEF.UnitDelay2_DSTATE_f /end REF_MEASUREMENT
/end GROUP
/begin GROUP autosar_swc_tos_autosar_swc_tos_Step_sys_TOS_main_TOS_ACC_Subsystem_Reference_IES_EgoSts_TrueDurationTime "autosar_swc_tos/autosar_swc_tos_Step_sys/TOS_main/TOS_ACC/Subsystem Reference/IES_EgoSts/TrueDurationTime"
 /begin REF_MEASUREMENT autosar_swc_tos_rtARID_DEF.UnitDelay1_DSTATE_d autosar_swc_tos_rtARID_DEF.UnitDelay2_DSTATE_de /end REF_MEASUREMENT
/end GROUP
/begin GROUP autosar_swc_tos_autosar_swc_tos_Step_sys_TOS_main_TOS_ACC_Subsystem_Reference_IES_EgoSts_TrueDurationTime1 "autosar_swc_tos/autosar_swc_tos_Step_sys/TOS_main/TOS_ACC/Subsystem Reference/IES_EgoSts/TrueDurationTime1"
 /begin REF_MEASUREMENT autosar_swc_tos_rtARID_DEF.UnitDelay1_DSTATE_j autosar_swc_tos_rtARID_DEF.UnitDelay2_DSTATE_o /end REF_MEASUREMENT
/end GROUP
/begin GROUP autosar_swc_tos_autosar_swc_tos_Step_sys_TOS_main_TOS_ACC_Subsystem_Reference_IES_EgoSts_TrueDurationTime2 "autosar_swc_tos/autosar_swc_tos_Step_sys/TOS_main/TOS_ACC/Subsystem Reference/IES_EgoSts/TrueDurationTime2"
 /begin REF_MEASUREMENT autosar_swc_tos_rtARID_DEF.UnitDelay1_DSTATE_da autosar_swc_tos_rtARID_DEF.UnitDelay2_DSTATE_hm /end REF_MEASUREMENT
/end GROUP
/begin GROUP autosar_swc_tos_autosar_swc_tos_Step_sys_TOS_main_TOS_ACC_Subsystem_Reference_IES_EgoSts_TrueDurationTime3 "autosar_swc_tos/autosar_swc_tos_Step_sys/TOS_main/TOS_ACC/Subsystem Reference/IES_EgoSts/TrueDurationTime3"
 /begin REF_MEASUREMENT autosar_swc_tos_rtARID_DEF.UnitDelay1_DSTATE_m autosar_swc_tos_rtARID_DEF.UnitDelay2_DSTATE_c /end REF_MEASUREMENT
/end GROUP
/begin GROUP autosar_swc_tos_autosar_swc_tos_Step_sys_TOS_main_TOS_ACC_Subsystem_Reference_Subsystem "autosar_swc_tos/autosar_swc_tos_Step_sys/TOS_main/TOS_ACC/Subsystem Reference/Subsystem"
 /begin SUB_GROUP autosar_swc_tos_autosar_swc_tos_Step_sys_TOS_main_TOS_ACC_Subsystem_Reference_Subsystem_Subsystem1 autosar_swc_tos_autosar_swc_tos_Step_sys_TOS_main_TOS_ACC_Subsystem_Reference_Subsystem_Subsystem3 /end SUB_GROUP
 /begin REF_MEASUREMENT autosar_swc_tos_rtARID_DEF.Delay_DSTATE_a autosar_swc_tos_rtARID_DEF.IES_Leftindex autosar_swc_tos_rtARID_DEF.IES_Rightindex autosar_swc_tos_rtARID_DEF.IESorBreakingSts autosar_swc_tos_rtARID_DEF.OverBreaking autosar_swc_tos_rtARID_DEF.TimeCnt autosar_swc_tos_rtARID_DEF.is_active_c741_autosar_swc_tos autosar_swc_tos_rtARID_DEF.is_active_c742_autosar_swc_tos autosar_swc_tos_rtARID_DEF.is_active_c743_autosar_swc_tos autosar_swc_tos_rtARID_DEF.is_c741_autosar_swc_tos autosar_swc_tos_rtARID_DEF.is_c742_autosar_swc_tos autosar_swc_tos_rtARID_DEF.is_c743_autosar_swc_tos /end REF_MEASUREMENT
/end GROUP
/begin GROUP autosar_swc_tos_autosar_swc_tos_Step_sys_TOS_main_TOS_ACC_Subsystem_Reference_Subsystem1 "autosar_swc_tos/autosar_swc_tos_Step_sys/TOS_main/TOS_ACC/Subsystem Reference/Subsystem1"
 /begin SUB_GROUP autosar_swc_tos_autosar_swc_tos_Step_sys_TOS_main_TOS_ACC_Subsystem_Reference_Subsystem1_TrueDurationTime1 autosar_swc_tos_autosar_swc_tos_Step_sys_TOS_main_TOS_ACC_Subsystem_Reference_Subsystem1_TrueDurationTime10 autosar_swc_tos_autosar_swc_tos_Step_sys_TOS_main_TOS_ACC_Subsystem_Reference_Subsystem1_TrueDurationTime11 autosar_swc_tos_autosar_swc_tos_Step_sys_TOS_main_TOS_ACC_Subsystem_Reference_Subsystem1_TrueDurationTime12 autosar_swc_tos_autosar_swc_tos_Step_sys_TOS_main_TOS_ACC_Subsystem_Reference_Subsystem1_TrueDurationTime2 autosar_swc_tos_autosar_swc_tos_Step_sys_TOS_main_TOS_ACC_Subsystem_Reference_Subsystem1_TrueDurationTime3 autosar_swc_tos_autosar_swc_tos_Step_sys_TOS_main_TOS_ACC_Subsystem_Reference_Subsystem1_TrueDurationTime4 autosar_swc_tos_autosar_swc_tos_Step_sys_TOS_main_TOS_ACC_Subsystem_Reference_Subsystem1_TrueDurationTime6 autosar_swc_tos_autosar_swc_tos_Step_sys_TOS_main_TOS_ACC_Subsystem_Reference_Subsystem1_TrueDurationTime7 autosar_swc_tos_autosar_swc_tos_Step_sys_TOS_main_TOS_ACC_Subsystem_Reference_Subsystem1_TrueDurationTime8 autosar_swc_tos_autosar_swc_tos_Step_sys_TOS_main_TOS_ACC_Subsystem_Reference_Subsystem1_TrueDurationTime9 /end SUB_GROUP
 /begin REF_MEASUREMENT autosar_swc_tos_rtARID_DEF.Delay1_DSTATE_c4 autosar_swc_tos_rtARID_DEF.Delay2_DSTATE_bm autosar_swc_tos_rtARID_DEF.Delay3_DSTATE_o autosar_swc_tos_rtARID_DEF.Delay_DSTATE_o autosar_swc_tos_rtARID_DEF.ImpAsg_InsertedFor_ID_at_inport_0 /end REF_MEASUREMENT
/end GROUP
/begin GROUP autosar_swc_tos_autosar_swc_tos_Step_sys_TOS_main_TOS_ACC_Subsystem_Reference_Subsystem1_TrueDurationTime1 "autosar_swc_tos/autosar_swc_tos_Step_sys/TOS_main/TOS_ACC/Subsystem Reference/Subsystem1/TrueDurationTime1"
 /begin REF_MEASUREMENT autosar_swc_tos_rtARID_DEF.UnitDelay1_DSTATE_n3 autosar_swc_tos_rtARID_DEF.UnitDelay2_DSTATE_db /end REF_MEASUREMENT
/end GROUP
/begin GROUP autosar_swc_tos_autosar_swc_tos_Step_sys_TOS_main_TOS_ACC_Subsystem_Reference_Subsystem1_TrueDurationTime10 "autosar_swc_tos/autosar_swc_tos_Step_sys/TOS_main/TOS_ACC/Subsystem Reference/Subsystem1/TrueDurationTime10"
 /begin REF_MEASUREMENT autosar_swc_tos_rtARID_DEF.UnitDelay1_DSTATE_ht autosar_swc_tos_rtARID_DEF.UnitDelay2_DSTATE_gl /end REF_MEASUREMENT
/end GROUP
/begin GROUP autosar_swc_tos_autosar_swc_tos_Step_sys_TOS_main_TOS_ACC_Subsystem_Reference_Subsystem1_TrueDurationTime11 "autosar_swc_tos/autosar_swc_tos_Step_sys/TOS_main/TOS_ACC/Subsystem Reference/Subsystem1/TrueDurationTime11"
 /begin REF_MEASUREMENT autosar_swc_tos_rtARID_DEF.UnitDelay1_DSTATE_on autosar_swc_tos_rtARID_DEF.UnitDelay2_DSTATE_fq /end REF_MEASUREMENT
/end GROUP
/begin GROUP autosar_swc_tos_autosar_swc_tos_Step_sys_TOS_main_TOS_ACC_Subsystem_Reference_Subsystem1_TrueDurationTime12 "autosar_swc_tos/autosar_swc_tos_Step_sys/TOS_main/TOS_ACC/Subsystem Reference/Subsystem1/TrueDurationTime12"
 /begin REF_MEASUREMENT autosar_swc_tos_rtARID_DEF.UnitDelay1_DSTATE_jt autosar_swc_tos_rtARID_DEF.UnitDelay2_DSTATE_nl /end REF_MEASUREMENT
/end GROUP
/begin GROUP autosar_swc_tos_autosar_swc_tos_Step_sys_TOS_main_TOS_ACC_Subsystem_Reference_Subsystem1_TrueDurationTime2 "autosar_swc_tos/autosar_swc_tos_Step_sys/TOS_main/TOS_ACC/Subsystem Reference/Subsystem1/TrueDurationTime2"
 /begin REF_MEASUREMENT autosar_swc_tos_rtARID_DEF.UnitDelay1_DSTATE_cl autosar_swc_tos_rtARID_DEF.UnitDelay2_DSTATE_l /end REF_MEASUREMENT
/end GROUP
/begin GROUP autosar_swc_tos_autosar_swc_tos_Step_sys_TOS_main_TOS_ACC_Subsystem_Reference_Subsystem1_TrueDurationTime3 "autosar_swc_tos/autosar_swc_tos_Step_sys/TOS_main/TOS_ACC/Subsystem Reference/Subsystem1/TrueDurationTime3"
 /begin REF_MEASUREMENT autosar_swc_tos_rtARID_DEF.UnitDelay1_DSTATE_c autosar_swc_tos_rtARID_DEF.UnitDelay2_DSTATE_n0 /end REF_MEASUREMENT
/end GROUP
/begin GROUP autosar_swc_tos_autosar_swc_tos_Step_sys_TOS_main_TOS_ACC_Subsystem_Reference_Subsystem1_TrueDurationTime4 "autosar_swc_tos/autosar_swc_tos_Step_sys/TOS_main/TOS_ACC/Subsystem Reference/Subsystem1/TrueDurationTime4"
 /begin REF_MEASUREMENT autosar_swc_tos_rtARID_DEF.UnitDelay1_DSTATE_a autosar_swc_tos_rtARID_DEF.UnitDelay2_DSTATE_bf /end REF_MEASUREMENT
/end GROUP
/begin GROUP autosar_swc_tos_autosar_swc_tos_Step_sys_TOS_main_TOS_ACC_Subsystem_Reference_Subsystem1_TrueDurationTime6 "autosar_swc_tos/autosar_swc_tos_Step_sys/TOS_main/TOS_ACC/Subsystem Reference/Subsystem1/TrueDurationTime6"
 /begin REF_MEASUREMENT autosar_swc_tos_rtARID_DEF.UnitDelay1_DSTATE_l autosar_swc_tos_rtARID_DEF.UnitDelay2_DSTATE_os /end REF_MEASUREMENT
/end GROUP
/begin GROUP autosar_swc_tos_autosar_swc_tos_Step_sys_TOS_main_TOS_ACC_Subsystem_Reference_Subsystem1_TrueDurationTime7 "autosar_swc_tos/autosar_swc_tos_Step_sys/TOS_main/TOS_ACC/Subsystem Reference/Subsystem1/TrueDurationTime7"
 /begin REF_MEASUREMENT autosar_swc_tos_rtARID_DEF.UnitDelay1_DSTATE_h autosar_swc_tos_rtARID_DEF.UnitDelay2_DSTATE_k1 /end REF_MEASUREMENT
/end GROUP
/begin GROUP autosar_swc_tos_autosar_swc_tos_Step_sys_TOS_main_TOS_ACC_Subsystem_Reference_Subsystem1_TrueDurationTime8 "autosar_swc_tos/autosar_swc_tos_Step_sys/TOS_main/TOS_ACC/Subsystem Reference/Subsystem1/TrueDurationTime8"
 /begin REF_MEASUREMENT autosar_swc_tos_rtARID_DEF.UnitDelay1_DSTATE_hm autosar_swc_tos_rtARID_DEF.UnitDelay2_DSTATE_b /end REF_MEASUREMENT
/end GROUP
/begin GROUP autosar_swc_tos_autosar_swc_tos_Step_sys_TOS_main_TOS_ACC_Subsystem_Reference_Subsystem1_TrueDurationTime9 "autosar_swc_tos/autosar_swc_tos_Step_sys/TOS_main/TOS_ACC/Subsystem Reference/Subsystem1/TrueDurationTime9"
 /begin REF_MEASUREMENT autosar_swc_tos_rtARID_DEF.UnitDelay1_DSTATE_n3q autosar_swc_tos_rtARID_DEF.UnitDelay2_DSTATE_dt /end REF_MEASUREMENT
/end GROUP
/begin GROUP autosar_swc_tos_autosar_swc_tos_Step_sys_TOS_main_TOS_ACC_Subsystem_Reference_Subsystem2 "autosar_swc_tos/autosar_swc_tos_Step_sys/TOS_main/TOS_ACC/Subsystem Reference/Subsystem2" /begin REF_CHARACTERISTIC P_TOS_IES_IntervalActive2Active /end REF_CHARACTERISTIC
 /begin REF_MEASUREMENT autosar_swc_tos_rtARID_DEF.Cnt autosar_swc_tos_rtARID_DEF.Delay1_DSTATE_c autosar_swc_tos_rtARID_DEF.is_active_c748_autosar_swc_tos autosar_swc_tos_rtARID_DEF.is_c748_autosar_swc_tos /end REF_MEASUREMENT
/end GROUP
/begin GROUP autosar_swc_tos_autosar_swc_tos_Step_sys_TOS_main_TOS_ACC_Subsystem_Reference_Subsystem3 "autosar_swc_tos/autosar_swc_tos_Step_sys/TOS_main/TOS_ACC/Subsystem Reference/Subsystem3"
 /begin SUB_GROUP autosar_swc_tos_autosar_swc_tos_Step_sys_TOS_main_TOS_ACC_Subsystem_Reference_Subsystem3_Subsystem6 /end SUB_GROUP
 /begin REF_CHARACTERISTIC P_TOS_IESActive_IESSTTC /end REF_CHARACTERISTIC
/end GROUP
/begin GROUP autosar_swc_tos_autosar_swc_tos_Step_sys_TOS_main_TOS_ACC_Subsystem_Reference_Subsystem3_Subsystem6 "autosar_swc_tos/autosar_swc_tos_Step_sys/TOS_main/TOS_ACC/Subsystem Reference/Subsystem3/Subsystem6"
 /begin SUB_GROUP autosar_swc_tos_autosar_swc_tos_Step_sys_TOS_main_TOS_ACC_Subsystem_Reference_Subsystem3_Subsystem6_TrueDurationTime1 autosar_swc_tos_autosar_swc_tos_Step_sys_TOS_main_TOS_ACC_Subsystem_Reference_Subsystem3_Subsystem6_TrueDurationTime2 /end SUB_GROUP
/end GROUP
/begin GROUP autosar_swc_tos_autosar_swc_tos_Step_sys_TOS_main_TOS_ACC_Subsystem_Reference_Subsystem3_Subsystem6_TrueDurationTime1 "autosar_swc_tos/autosar_swc_tos_Step_sys/TOS_main/TOS_ACC/Subsystem Reference/Subsystem3/Subsystem6/TrueDurationTime1"
 /begin REF_MEASUREMENT autosar_swc_tos_rtARID_DEF.UnitDelay1_DSTATE_dn autosar_swc_tos_rtARID_DEF.UnitDelay2_DSTATE_bd /end REF_MEASUREMENT
/end GROUP
/begin GROUP autosar_swc_tos_autosar_swc_tos_Step_sys_TOS_main_TOS_ACC_Subsystem_Reference_Subsystem3_Subsystem6_TrueDurationTime2 "autosar_swc_tos/autosar_swc_tos_Step_sys/TOS_main/TOS_ACC/Subsystem Reference/Subsystem3/Subsystem6/TrueDurationTime2"
 /begin REF_MEASUREMENT autosar_swc_tos_rtARID_DEF.UnitDelay1_DSTATE_ok autosar_swc_tos_rtARID_DEF.UnitDelay2_DSTATE_cg /end REF_MEASUREMENT
/end GROUP
/begin GROUP autosar_swc_tos_autosar_swc_tos_Step_sys_TOS_main_TOS_ACC_Subsystem_Reference_Subsystem4 "autosar_swc_tos/autosar_swc_tos_Step_sys/TOS_main/TOS_ACC/Subsystem Reference/Subsystem4"
 /begin SUB_GROUP autosar_swc_tos_autosar_swc_tos_Step_sys_TOS_main_TOS_ACC_Subsystem_Reference_Subsystem4_TrueDurationTime1 autosar_swc_tos_autosar_swc_tos_Step_sys_TOS_main_TOS_ACC_Subsystem_Reference_Subsystem4_TrueDurationTime2 /end SUB_GROUP
 /begin REF_MEASUREMENT autosar_swc_tos_rtARID_DEF.Maxoffset /end REF_MEASUREMENT
/end GROUP
/begin GROUP autosar_swc_tos_autosar_swc_tos_Step_sys_TOS_main_TOS_ACC_Subsystem_Reference_Subsystem4_TrueDurationTime1 "autosar_swc_tos/autosar_swc_tos_Step_sys/TOS_main/TOS_ACC/Subsystem Reference/Subsystem4/TrueDurationTime1"
 /begin REF_MEASUREMENT autosar_swc_tos_rtARID_DEF.UnitDelay1_DSTATE_du autosar_swc_tos_rtARID_DEF.UnitDelay2_DSTATE_p /end REF_MEASUREMENT
/end GROUP
/begin GROUP autosar_swc_tos_autosar_swc_tos_Step_sys_TOS_main_TOS_ACC_Subsystem_Reference_Subsystem4_TrueDurationTime2 "autosar_swc_tos/autosar_swc_tos_Step_sys/TOS_main/TOS_ACC/Subsystem Reference/Subsystem4/TrueDurationTime2"
 /begin REF_MEASUREMENT autosar_swc_tos_rtARID_DEF.UnitDelay1_DSTATE_k autosar_swc_tos_rtARID_DEF.UnitDelay2_DSTATE_e /end REF_MEASUREMENT
/end GROUP
/begin GROUP autosar_swc_tos_autosar_swc_tos_Step_sys_TOS_main_TOS_ACC_Subsystem_Reference_Subsystem5 "autosar_swc_tos/autosar_swc_tos_Step_sys/TOS_main/TOS_ACC/Subsystem Reference/Subsystem5"
 /begin SUB_GROUP autosar_swc_tos_autosar_swc_tos_Step_sys_TOS_main_TOS_ACC_Subsystem_Reference_Subsystem5_Compare_To_Constant1 autosar_swc_tos_autosar_swc_tos_Step_sys_TOS_main_TOS_ACC_Subsystem_Reference_Subsystem5_Compare_To_Constant12 autosar_swc_tos_autosar_swc_tos_Step_sys_TOS_main_TOS_ACC_Subsystem_Reference_Subsystem5_TrueDurationTime1 /end SUB_GROUP
/end GROUP
/begin GROUP autosar_swc_tos_autosar_swc_tos_Step_sys_TOS_main_TOS_ACC_Subsystem_Reference_Subsystem5_Compare_To_Constant1 "autosar_swc_tos/autosar_swc_tos_Step_sys/TOS_main/TOS_ACC/Subsystem Reference/Subsystem5/Compare\nTo Constant1" /begin REF_CHARACTERISTIC P_TOS_IESActive_SpeedMin /end REF_CHARACTERISTIC /end GROUP
/begin GROUP autosar_swc_tos_autosar_swc_tos_Step_sys_TOS_main_TOS_ACC_Subsystem_Reference_Subsystem5_Compare_To_Constant12 "autosar_swc_tos/autosar_swc_tos_Step_sys/TOS_main/TOS_ACC/Subsystem Reference/Subsystem5/Compare\nTo Constant12" /begin REF_CHARACTERISTIC P_TOS_IESActive_SpeedMax /end REF_CHARACTERISTIC /end GROUP
/begin GROUP autosar_swc_tos_autosar_swc_tos_Step_sys_TOS_main_TOS_ACC_Subsystem_Reference_Subsystem5_TrueDurationTime1 "autosar_swc_tos/autosar_swc_tos_Step_sys/TOS_main/TOS_ACC/Subsystem Reference/Subsystem5/TrueDurationTime1"
 /begin REF_MEASUREMENT autosar_swc_tos_rtARID_DEF.UnitDelay1_DSTATE_p autosar_swc_tos_rtARID_DEF.UnitDelay2_DSTATE_fc /end REF_MEASUREMENT
/end GROUP
/begin GROUP autosar_swc_tos_autosar_swc_tos_Step_sys_TOS_main_TOS_ACC_Subsystem_Reference_Subsystem6 "autosar_swc_tos/autosar_swc_tos_Step_sys/TOS_main/TOS_ACC/Subsystem Reference/Subsystem6"
 /begin SUB_GROUP autosar_swc_tos_autosar_swc_tos_Step_sys_TOS_main_TOS_ACC_Subsystem_Reference_Subsystem6_TrueDurationTime1 autosar_swc_tos_autosar_swc_tos_Step_sys_TOS_main_TOS_ACC_Subsystem_Reference_Subsystem6_TrueDurationTime2 /end SUB_GROUP
/end GROUP
/begin GROUP autosar_swc_tos_autosar_swc_tos_Step_sys_TOS_main_TOS_ACC_Subsystem_Reference_Subsystem6_TrueDurationTime1 "autosar_swc_tos/autosar_swc_tos_Step_sys/TOS_main/TOS_ACC/Subsystem Reference/Subsystem6/TrueDurationTime1"
 /begin REF_MEASUREMENT autosar_swc_tos_rtARID_DEF.UnitDelay1_DSTATE_he autosar_swc_tos_rtARID_DEF.UnitDelay2_DSTATE_oq /end REF_MEASUREMENT
/end GROUP
/begin GROUP autosar_swc_tos_autosar_swc_tos_Step_sys_TOS_main_TOS_ACC_Subsystem_Reference_Subsystem6_TrueDurationTime2 "autosar_swc_tos/autosar_swc_tos_Step_sys/TOS_main/TOS_ACC/Subsystem Reference/Subsystem6/TrueDurationTime2"
 /begin REF_MEASUREMENT autosar_swc_tos_rtARID_DEF.UnitDelay1_DSTATE_lk autosar_swc_tos_rtARID_DEF.UnitDelay2_DSTATE_g0 /end REF_MEASUREMENT
/end GROUP
/begin GROUP autosar_swc_tos_autosar_swc_tos_Step_sys_TOS_main_TOS_ACC_Subsystem_Reference_Subsystem7 "autosar_swc_tos/autosar_swc_tos_Step_sys/TOS_main/TOS_ACC/Subsystem Reference/Subsystem7" /begin REF_CHARACTERISTIC P_TOS_IES_IntervalActive2Active /end REF_CHARACTERISTIC
 /begin REF_MEASUREMENT autosar_swc_tos_rtARID_DEF.Cnt1 autosar_swc_tos_rtARID_DEF.Cnt2 autosar_swc_tos_rtARID_DEF.Delay1_DSTATE_dp autosar_swc_tos_rtARID_DEF.is_active_c757_autosar_swc_tos autosar_swc_tos_rtARID_DEF.is_c757_autosar_swc_tos /end REF_MEASUREMENT
/end GROUP
/begin GROUP autosar_swc_tos_autosar_swc_tos_Step_sys_TOS_main_TOS_ACC_Subsystem_Reference_Subsystem_Subsystem1 "autosar_swc_tos/autosar_swc_tos_Step_sys/TOS_main/TOS_ACC/Subsystem Reference/Subsystem/Subsystem1"
 /begin REF_MEASUREMENT autosar_swc_tos_rtARID_DEF.UnitDelay1_DSTATE_b autosar_swc_tos_rtARID_DEF.UnitDelay2_DSTATE_i /end REF_MEASUREMENT
/end GROUP
/begin GROUP autosar_swc_tos_autosar_swc_tos_Step_sys_TOS_main_TOS_ACC_Subsystem_Reference_Subsystem_Subsystem3 "autosar_swc_tos/autosar_swc_tos_Step_sys/TOS_main/TOS_ACC/Subsystem Reference/Subsystem/Subsystem3"
 /begin REF_MEASUREMENT autosar_swc_tos_rtARID_DEF.UnitDelay1_DSTATE_lf autosar_swc_tos_rtARID_DEF.UnitDelay2_DSTATE_kg /end REF_MEASUREMENT
/end GROUP
/begin GROUP autosar_swc_tos_autosar_swc_tos_Step_sys_TOS_main_TOS_ACC_Subsystem_Reference_TrueDurationTime "autosar_swc_tos/autosar_swc_tos_Step_sys/TOS_main/TOS_ACC/Subsystem Reference/TrueDurationTime"
 /begin REF_MEASUREMENT autosar_swc_tos_rtARID_DEF.UnitDelay1_DSTATE_c2 autosar_swc_tos_rtARID_DEF.UnitDelay2_DSTATE_m5 /end REF_MEASUREMENT
/end GROUP
/begin GROUP autosar_swc_tos_autosar_swc_tos_Step_sys_TOS_main_TOS_ACC_Subsystem_Reference_TrueDurationTime1 "autosar_swc_tos/autosar_swc_tos_Step_sys/TOS_main/TOS_ACC/Subsystem Reference/TrueDurationTime1"
 /begin REF_MEASUREMENT autosar_swc_tos_rtARID_DEF.UnitDelay1_DSTATE_i autosar_swc_tos_rtARID_DEF.UnitDelay2_DSTATE_hi /end REF_MEASUREMENT
/end GROUP
/begin GROUP autosar_swc_tos_autosar_swc_tos_Step_sys_TOS_main_TOS_ACC_Subsystem_Reference_TrueDurationTime2 "autosar_swc_tos/autosar_swc_tos_Step_sys/TOS_main/TOS_ACC/Subsystem Reference/TrueDurationTime2"
 /begin REF_MEASUREMENT autosar_swc_tos_rtARID_DEF.UnitDelay1_DSTATE_e autosar_swc_tos_rtARID_DEF.UnitDelay2_DSTATE_fd /end REF_MEASUREMENT
/end GROUP
/begin GROUP autosar_swc_tos_autosar_swc_tos_Step_sys_TOS_main_TOS_ACC_TOS_ACC_For_Each_64 "autosar_swc_tos/autosar_swc_tos_Step_sys/TOS_main/TOS_ACC/TOS_ACC_For Each_64"
 /begin SUB_GROUP autosar_swc_tos_autosar_swc_tos_Step_sys_TOS_main_TOS_ACC_TOS_ACC_For_Each_64_TOS_ACC_For_Each /end SUB_GROUP
/end GROUP
/begin GROUP autosar_swc_tos_autosar_swc_tos_Step_sys_TOS_main_TOS_ACC_TOS_ACC_For_Each_64_TOS_ACC_For_Each "autosar_swc_tos/autosar_swc_tos_Step_sys/TOS_main/TOS_ACC/TOS_ACC_For Each_64/TOS_ACC_For Each"
 /begin SUB_GROUP autosar_swc_tos_autosar_swc_tos_Step_sys_TOS_main_TOS_ACC_TOS_ACC_For_Each_64_TOS_ACC_For_Each_ACC_TAS autosar_swc_tos_autosar_swc_tos_Step_sys_TOS_main_TOS_ACC_TOS_ACC_For_Each_64_TOS_ACC_For_Each_HWA_LSS_ELK autosar_swc_tos_autosar_swc_tos_Step_sys_TOS_main_TOS_ACC_TOS_ACC_For_Each_64_TOS_ACC_For_Each_IES_OnComing autosar_swc_tos_autosar_swc_tos_Step_sys_TOS_main_TOS_ACC_TOS_ACC_For_Each_64_TOS_ACC_For_Each_Subsystem2 /end SUB_GROUP
/end GROUP
/begin GROUP autosar_swc_tos_autosar_swc_tos_Step_sys_TOS_main_TOS_ACC_TOS_ACC_For_Each_64_TOS_ACC_For_Each_ACC_TAS "autosar_swc_tos/autosar_swc_tos_Step_sys/TOS_main/TOS_ACC/TOS_ACC_For Each_64/TOS_ACC_For Each/ACC_TAS"
 /begin SUB_GROUP autosar_swc_tos_autosar_swc_tos_Step_sys_TOS_main_TOS_ACC_TOS_ACC_For_Each_64_TOS_ACC_For_Each_ACC_TAS_Sports_Attributes /end SUB_GROUP
/end GROUP
/begin GROUP autosar_swc_tos_autosar_swc_tos_Step_sys_TOS_main_TOS_ACC_TOS_ACC_For_Each_64_TOS_ACC_For_Each_ACC_TAS_Sports_Attributes "autosar_swc_tos/autosar_swc_tos_Step_sys/TOS_main/TOS_ACC/TOS_ACC_For Each_64/TOS_ACC_For Each/ACC_TAS/Sports_Attributes"
 /begin SUB_GROUP autosar_swc_tos_autosar_swc_tos_Step_sys_TOS_main_TOS_ACC_TOS_ACC_For_Each_64_TOS_ACC_For_Each_ACC_TAS_Sports_Attributes_Obj_PressLine_assignment /end SUB_GROUP
/end GROUP
/begin GROUP autosar_swc_tos_autosar_swc_tos_Step_sys_TOS_main_TOS_ACC_TOS_ACC_For_Each_64_TOS_ACC_For_Each_ACC_TAS_Sports_Attributes_Obj_PressLine_assignment "autosar_swc_tos/autosar_swc_tos_Step_sys/TOS_main/TOS_ACC/TOS_ACC_For Each_64/TOS_ACC_For Each/ACC_TAS/Sports_Attributes/Obj_PressLine_assignment"
 /begin SUB_GROUP autosar_swc_tos_autosar_swc_tos_Step_sys_TOS_main_TOS_ACC_TOS_ACC_For_Each_64_TOS_ACC_For_Each_ACC_TAS_Sports_Attributes_Obj_PressLine_assignment_If_Action_Subsystem autosar_swc_tos_autosar_swc_tos_Step_sys_TOS_main_TOS_ACC_TOS_ACC_For_Each_64_TOS_ACC_For_Each_ACC_TAS_Sports_Attributes_Obj_PressLine_assignment_PressedLane_Or_CrossingLane /end SUB_GROUP
/end GROUP
/begin GROUP autosar_swc_tos_autosar_swc_tos_Step_sys_TOS_main_TOS_ACC_TOS_ACC_For_Each_64_TOS_ACC_For_Each_ACC_TAS_Sports_Attributes_Obj_PressLine_assignment_If_Action_Subsystem "autosar_swc_tos/autosar_swc_tos_Step_sys/TOS_main/TOS_ACC/TOS_ACC_For Each_64/TOS_ACC_For Each/ACC_TAS/Sports_Attributes/Obj_PressLine_assignment/If Action\nSubsystem"
 /begin SUB_GROUP autosar_swc_tos_autosar_swc_tos_Step_sys_TOS_main_TOS_ACC_TOS_ACC_For_Each_64_TOS_ACC_For_Each_ACC_TAS_Sports_Attributes_Obj_PressLine_assignment_If_Action_Subsystem_Car_Tricycle_PressedLane /end SUB_GROUP
/end GROUP
/begin GROUP autosar_swc_tos_autosar_swc_tos_Step_sys_TOS_main_TOS_ACC_TOS_ACC_For_Each_64_TOS_ACC_For_Each_ACC_TAS_Sports_Attributes_Obj_PressLine_assignment_If_Action_Subsystem_Car_Tricycle_PressedLane "autosar_swc_tos/autosar_swc_tos_Step_sys/TOS_main/TOS_ACC/TOS_ACC_For Each_64/TOS_ACC_For Each/ACC_TAS/Sports_Attributes/Obj_PressLine_assignment/If Action\nSubsystem/Car_Tricycle_PressedLane"
 /begin SUB_GROUP autosar_swc_tos_autosar_swc_tos_Step_sys_TOS_main_TOS_ACC_TOS_ACC_For_Each_64_TOS_ACC_For_Each_ACC_TAS_Sports_Attributes_Obj_PressLine_assignment_If_Action_Subsystem_Car_Tricycle_PressedLane_Car_PressedLane_CutIn1 /end SUB_GROUP
/end GROUP
/begin GROUP autosar_swc_tos_autosar_swc_tos_Step_sys_TOS_main_TOS_ACC_TOS_ACC_For_Each_64_TOS_ACC_For_Each_ACC_TAS_Sports_Attributes_Obj_PressLine_assignment_If_Action_Subsystem_Car_Tricycle_PressedLane_Car_PressedLane_CutIn1 "autosar_swc_tos/autosar_swc_tos_Step_sys/TOS_main/TOS_ACC/TOS_ACC_For Each_64/TOS_ACC_For Each/ACC_TAS/Sports_Attributes/Obj_PressLine_assignment/If Action\nSubsystem/Car_Tricycle_PressedLane/Car_PressedLane_CutIn1"
 /begin SUB_GROUP autosar_swc_tos_autosar_swc_tos_Step_sys_TOS_main_TOS_ACC_TOS_ACC_For_Each_64_TOS_ACC_For_Each_ACC_TAS_Sports_Attributes_Obj_PressLine_assignment_If_Action_Subsystem_Car_Tricycle_PressedLane_Car_PressedLane_CutIn1_Subsystem7 /end SUB_GROUP
/end GROUP
/begin GROUP autosar_swc_tos_autosar_swc_tos_Step_sys_TOS_main_TOS_ACC_TOS_ACC_For_Each_64_TOS_ACC_For_Each_ACC_TAS_Sports_Attributes_Obj_PressLine_assignment_If_Action_Subsystem_Car_Tricycle_PressedLane_Car_PressedLane_CutIn1_Subsystem7 "autosar_swc_tos/autosar_swc_tos_Step_sys/TOS_main/TOS_ACC/TOS_ACC_For Each_64/TOS_ACC_For Each/ACC_TAS/Sports_Attributes/Obj_PressLine_assignment/If Action\nSubsystem/Car_Tricycle_PressedLane/Car_PressedLane_CutIn1/Subsystem7"
 /begin SUB_GROUP autosar_swc_tos_autosar_swc_tos_Step_sys_TOS_main_TOS_ACC_TOS_ACC_For_Each_64_TOS_ACC_For_Each_ACC_TAS_Sports_Attributes_Obj_PressLine_assignment_If_Action_Subsystem_Car_Tricycle_PressedLane_Car_PressedLane_CutIn1_Subsystem7_Compare_To_Constant autosar_swc_tos_autosar_swc_tos_Step_sys_TOS_main_TOS_ACC_TOS_ACC_For_Each_64_TOS_ACC_For_Each_ACC_TAS_Sports_Attributes_Obj_PressLine_assignment_If_Action_Subsystem_Car_Tricycle_PressedLane_Car_PressedLane_CutIn1_Subsystem7_Compare_To_Constant1 autosar_swc_tos_autosar_swc_tos_Step_sys_TOS_main_TOS_ACC_TOS_ACC_For_Each_64_TOS_ACC_For_Each_ACC_TAS_Sports_Attributes_Obj_PressLine_assignment_If_Action_Subsystem_Car_Tricycle_PressedLane_Car_PressedLane_CutIn1_Subsystem7_Compare_To_Constant2 autosar_swc_tos_autosar_swc_tos_Step_sys_TOS_main_TOS_ACC_TOS_ACC_For_Each_64_TOS_ACC_For_Each_ACC_TAS_Sports_Attributes_Obj_PressLine_assignment_If_Action_Subsystem_Car_Tricycle_PressedLane_Car_PressedLane_CutIn1_Subsystem7_Compare_To_Constant3 /end SUB_GROUP
/end GROUP
/begin GROUP autosar_swc_tos_autosar_swc_tos_Step_sys_TOS_main_TOS_ACC_TOS_ACC_For_Each_64_TOS_ACC_For_Each_ACC_TAS_Sports_Attributes_Obj_PressLine_assignment_If_Action_Subsystem_Car_Tricycle_PressedLane_Car_PressedLane_CutIn1_Subsystem7_Compare_To_Constant "autosar_swc_tos/autosar_swc_tos_Step_sys/TOS_main/TOS_ACC/TOS_ACC_For Each_64/TOS_ACC_For Each/ACC_TAS/Sports_Attributes/Obj_PressLine_assignment/If Action\nSubsystem/Car_Tricycle_PressedLane/Car_PressedLane_CutIn1/Subsystem7/Compare\nTo Constant" /begin REF_CHARACTERISTIC P_TOS_EgoLowSpd_ObjVx_Thre /end REF_CHARACTERISTIC /end GROUP
/begin GROUP autosar_swc_tos_autosar_swc_tos_Step_sys_TOS_main_TOS_ACC_TOS_ACC_For_Each_64_TOS_ACC_For_Each_ACC_TAS_Sports_Attributes_Obj_PressLine_assignment_If_Action_Subsystem_Car_Tricycle_PressedLane_Car_PressedLane_CutIn1_Subsystem7_Compare_To_Constant1 "autosar_swc_tos/autosar_swc_tos_Step_sys/TOS_main/TOS_ACC/TOS_ACC_For Each_64/TOS_ACC_For Each/ACC_TAS/Sports_Attributes/Obj_PressLine_assignment/If Action\nSubsystem/Car_Tricycle_PressedLane/Car_PressedLane_CutIn1/Subsystem7/Compare\nTo Constant1" /begin REF_CHARACTERISTIC P_TOS_EgoLowSpd_Thre /end REF_CHARACTERISTIC /end GROUP
/begin GROUP autosar_swc_tos_autosar_swc_tos_Step_sys_TOS_main_TOS_ACC_TOS_ACC_For_Each_64_TOS_ACC_For_Each_ACC_TAS_Sports_Attributes_Obj_PressLine_assignment_If_Action_Subsystem_Car_Tricycle_PressedLane_Car_PressedLane_CutIn1_Subsystem7_Compare_To_Constant2 "autosar_swc_tos/autosar_swc_tos_Step_sys/TOS_main/TOS_ACC/TOS_ACC_For Each_64/TOS_ACC_For Each/ACC_TAS/Sports_Attributes/Obj_PressLine_assignment/If Action\nSubsystem/Car_Tricycle_PressedLane/Car_PressedLane_CutIn1/Subsystem7/Compare\nTo Constant2" /begin REF_CHARACTERISTIC P_TOS_EgoLowSpd_Lat_Thre /end REF_CHARACTERISTIC /end GROUP
/begin GROUP autosar_swc_tos_autosar_swc_tos_Step_sys_TOS_main_TOS_ACC_TOS_ACC_For_Each_64_TOS_ACC_For_Each_ACC_TAS_Sports_Attributes_Obj_PressLine_assignment_If_Action_Subsystem_Car_Tricycle_PressedLane_Car_PressedLane_CutIn1_Subsystem7_Compare_To_Constant3 "autosar_swc_tos/autosar_swc_tos_Step_sys/TOS_main/TOS_ACC/TOS_ACC_For Each_64/TOS_ACC_For Each/ACC_TAS/Sports_Attributes/Obj_PressLine_assignment/If Action\nSubsystem/Car_Tricycle_PressedLane/Car_PressedLane_CutIn1/Subsystem7/Compare\nTo Constant3" /begin REF_CHARACTERISTIC P_TOS_EgoLowSpd_Range_Thre /end REF_CHARACTERISTIC /end GROUP
/begin GROUP autosar_swc_tos_autosar_swc_tos_Step_sys_TOS_main_TOS_ACC_TOS_ACC_For_Each_64_TOS_ACC_For_Each_ACC_TAS_Sports_Attributes_Obj_PressLine_assignment_PressedLane_Or_CrossingLane "autosar_swc_tos/autosar_swc_tos_Step_sys/TOS_main/TOS_ACC/TOS_ACC_For Each_64/TOS_ACC_For Each/ACC_TAS/Sports_Attributes/Obj_PressLine_assignment/PressedLane_Or_CrossingLane" /begin REF_CHARACTERISTIC P_TOS_ACC_CutInSwitch /end REF_CHARACTERISTIC /end GROUP
/begin GROUP autosar_swc_tos_autosar_swc_tos_Step_sys_TOS_main_TOS_ACC_TOS_ACC_For_Each_64_TOS_ACC_For_Each_HWA_LSS_ELK "autosar_swc_tos/autosar_swc_tos_Step_sys/TOS_main/TOS_ACC/TOS_ACC_For Each_64/TOS_ACC_For Each/HWA_LSS_ELK" /begin REF_CHARACTERISTIC P_TOS_ELK_MaxDis P_TOS_ELK_MinDis /end REF_CHARACTERISTIC /end GROUP
/begin GROUP autosar_swc_tos_autosar_swc_tos_Step_sys_TOS_main_TOS_ACC_TOS_ACC_For_Each_64_TOS_ACC_For_Each_IES_OnComing "autosar_swc_tos/autosar_swc_tos_Step_sys/TOS_main/TOS_ACC/TOS_ACC_For Each_64/TOS_ACC_For Each/IES_OnComing" /begin REF_CHARACTERISTIC P_TOS_ELK_MaxDis P_TOS_ELK_MinDis /end REF_CHARACTERISTIC /end GROUP
/begin GROUP autosar_swc_tos_autosar_swc_tos_Step_sys_TOS_main_TOS_ACC_TOS_ACC_For_Each_64_TOS_ACC_For_Each_Subsystem2 "autosar_swc_tos/autosar_swc_tos_Step_sys/TOS_main/TOS_ACC/TOS_ACC_For Each_64/TOS_ACC_For Each/Subsystem2" /begin REF_CHARACTERISTIC P_TOS_TRAFFIC_SCEN_LgtMax /end REF_CHARACTERISTIC /end GROUP
/begin GROUP autosar_swc_tos_autosar_swc_tos_Step_sys_TOS_main_TOS_ACC_TOS_ACC_Sort_Index2 "autosar_swc_tos/autosar_swc_tos_Step_sys/TOS_main/TOS_ACC/TOS_ACC_Sort_Index2"
 /begin REF_MEASUREMENT autosar_swc_tos_rtARID_DEF.Delay_DSTATE_i autosar_swc_tos_rtARID_DEF.ImpAsg_InsertedFor_ID_at_inport_0 /end REF_MEASUREMENT
/end GROUP
/begin GROUP autosar_swc_tos_autosar_swc_tos_Step_sys_TOS_main_TOS_P0_TARGET_LINE "autosar_swc_tos/autosar_swc_tos_Step_sys/TOS_main/TOS_P0_TARGET_LINE"
 /begin SUB_GROUP autosar_swc_tos_autosar_swc_tos_Step_sys_TOS_main_TOS_P0_TARGET_LINE_AEB autosar_swc_tos_autosar_swc_tos_Step_sys_TOS_main_TOS_P0_TARGET_LINE_DOP autosar_swc_tos_autosar_swc_tos_Step_sys_TOS_main_TOS_P0_TARGET_LINE_Subsystem autosar_swc_tos_autosar_swc_tos_Step_sys_TOS_main_TOS_P0_TARGET_LINE_Subsystem1 autosar_swc_tos_autosar_swc_tos_Step_sys_TOS_main_TOS_P0_TARGET_LINE_VT /end SUB_GROUP
/end GROUP
/begin GROUP autosar_swc_tos_autosar_swc_tos_Step_sys_TOS_main_TOS_P0_TARGET_LINE_AEB "autosar_swc_tos/autosar_swc_tos_Step_sys/TOS_main/TOS_P0_TARGET_LINE/AEB"
 /begin SUB_GROUP autosar_swc_tos_autosar_swc_tos_Step_sys_TOS_main_TOS_P0_TARGET_LINE_AEB_PEM_POE_InterstObjSelc /end SUB_GROUP
/end GROUP
/begin GROUP autosar_swc_tos_autosar_swc_tos_Step_sys_TOS_main_TOS_P0_TARGET_LINE_AEB_PEM_POE_InterstObjSelc "autosar_swc_tos/autosar_swc_tos_Step_sys/TOS_main/TOS_P0_TARGET_LINE/AEB/PEM_POE_InterstObjSelc"
 /begin REF_MEASUREMENT autosar_swc_tos_rtARID_DEF.ImpAsg_InsertedFor_ID_at_inport_0 autosar_swc_tos_rtARID_DEF.UnitDelay2_DSTATE_a /end REF_MEASUREMENT
/end GROUP
/begin GROUP autosar_swc_tos_autosar_swc_tos_Step_sys_TOS_main_TOS_P0_TARGET_LINE_DOP "autosar_swc_tos/autosar_swc_tos_Step_sys/TOS_main/TOS_P0_TARGET_LINE/DOP"
 /begin SUB_GROUP autosar_swc_tos_autosar_swc_tos_Step_sys_TOS_main_TOS_P0_TARGET_LINE_DOP_op_grp_dopTrajCalc /end SUB_GROUP
/end GROUP
/begin GROUP autosar_swc_tos_autosar_swc_tos_Step_sys_TOS_main_TOS_P0_TARGET_LINE_DOP_op_grp_dopTrajCalc "autosar_swc_tos/autosar_swc_tos_Step_sys/TOS_main/TOS_P0_TARGET_LINE/DOP/op_grp_dopTrajCalc"
 /begin SUB_GROUP autosar_swc_tos_autosar_swc_tos_Step_sys_TOS_main_TOS_P0_TARGET_LINE_DOP_op_grp_dopTrajCalc_op_aproPointGenerate autosar_swc_tos_autosar_swc_tos_Step_sys_TOS_main_TOS_P0_TARGET_LINE_DOP_op_grp_dopTrajCalc_op_trajObjBuf autosar_swc_tos_autosar_swc_tos_Step_sys_TOS_main_TOS_P0_TARGET_LINE_DOP_op_grp_dopTrajCalc_op_trajPointGenerate autosar_swc_tos_autosar_swc_tos_Step_sys_TOS_main_TOS_P0_TARGET_LINE_DOP_op_grp_dopTrajCalc_op_trajPolySelect /end SUB_GROUP
/end GROUP
/begin GROUP autosar_swc_tos_autosar_swc_tos_Step_sys_TOS_main_TOS_P0_TARGET_LINE_DOP_op_grp_dopTrajCalc_op_aproPointGenerate "autosar_swc_tos/autosar_swc_tos_Step_sys/TOS_main/TOS_P0_TARGET_LINE/DOP/op_grp_dopTrajCalc/op_aproPointGenerate" /begin REF_MEASUREMENT autosar_swc_tos_rtARID_DEF.Relay_Mode /end REF_MEASUREMENT /end GROUP
/begin GROUP autosar_swc_tos_autosar_swc_tos_Step_sys_TOS_main_TOS_P0_TARGET_LINE_DOP_op_grp_dopTrajCalc_op_trajObjBuf "autosar_swc_tos/autosar_swc_tos_Step_sys/TOS_main/TOS_P0_TARGET_LINE/DOP/op_grp_dopTrajCalc/op_trajObjBuf"
 /begin REF_MEASUREMENT autosar_swc_tos_rtARID_DEF.BufObj_Class_p autosar_swc_tos_rtARID_DEF.BufObj_Dx_i autosar_swc_tos_rtARID_DEF.BufObj_Dy_d autosar_swc_tos_rtARID_DEF.BufObj_HeadingAngle_g autosar_swc_tos_rtARID_DEF.BufObj_Id_p autosar_swc_tos_rtARID_DEF.BufObj_Invalid autosar_swc_tos_rtARID_DEF.BufObj_LostAge_f autosar_swc_tos_rtARID_DEF.BufObj_MovingState_g autosar_swc_tos_rtARID_DEF.BufObj_TrackAge_p autosar_swc_tos_rtARID_DEF.BufObj_TrackSts_b autosar_swc_tos_rtARID_DEF.BufObj_VxG_m autosar_swc_tos_rtARID_DEF.BufObj_VyG_p autosar_swc_tos_rtARID_DEF.BufObj_width_f autosar_swc_tos_rtARID_DEF.BufUsedNum_f autosar_swc_tos_rtARID_DEF.ImpAsg_InsertedFor_ID_at_inport_0 autosar_swc_tos_rtARID_DEF.SourceObj_Invalid autosar_swc_tos_rtARID_DEF.UnitDelay1_DSTATE autosar_swc_tos_rtARID_DEF.UnitDelay_DSTATE /end REF_MEASUREMENT
/end GROUP
/begin GROUP autosar_swc_tos_autosar_swc_tos_Step_sys_TOS_main_TOS_P0_TARGET_LINE_DOP_op_grp_dopTrajCalc_op_trajPointGenerate "autosar_swc_tos/autosar_swc_tos_Step_sys/TOS_main/TOS_P0_TARGET_LINE/DOP/op_grp_dopTrajCalc/op_trajPointGenerate"
 /begin REF_MEASUREMENT autosar_swc_tos_rtARID_DEF.UnitDelay2_DSTATE_d autosar_swc_tos_rtARID_DEF.UnitDelay_DSTATE_c autosar_swc_tos_rtARID_DEF.sTrajBufSts_h autosar_swc_tos_rtARID_DEF.sTrajDx_f autosar_swc_tos_rtARID_DEF.sTrajDy_o autosar_swc_tos_rtARID_DEF.sTrajPointNum_c /end REF_MEASUREMENT
/end GROUP
/begin GROUP autosar_swc_tos_autosar_swc_tos_Step_sys_TOS_main_TOS_P0_TARGET_LINE_DOP_op_grp_dopTrajCalc_op_trajPolySelect "autosar_swc_tos/autosar_swc_tos_Step_sys/TOS_main/TOS_P0_TARGET_LINE/DOP/op_grp_dopTrajCalc/op_trajPolySelect" /begin REF_CHARACTERISTIC P_TOS_DOP_DiffThre P_TOS_DOP_MeanCurvaLim /end REF_CHARACTERISTIC
 /begin REF_MEASUREMENT TOS_DOPSelectDiffRef TOS_DOPSelectReason TOS_OPParalNum TOS_OPSelectIndex autosar_swc_tos_rtARID_DEF.DOPSelectPrecheckId_m autosar_swc_tos_rtARID_DEF.DOPSelectPrecheck_i autosar_swc_tos_rtARID_DEF.DOPSelectReason_g autosar_swc_tos_rtARID_DEF.SelectIndex_i autosar_swc_tos_rtARID_DEF.ctrlT_e /end REF_MEASUREMENT
/end GROUP
/begin GROUP autosar_swc_tos_autosar_swc_tos_Step_sys_TOS_main_TOS_P0_TARGET_LINE_Subsystem "autosar_swc_tos/autosar_swc_tos_Step_sys/TOS_main/TOS_P0_TARGET_LINE/Subsystem"
 /begin SUB_GROUP autosar_swc_tos_autosar_swc_tos_Step_sys_TOS_main_TOS_P0_TARGET_LINE_Subsystem_HWA /end SUB_GROUP
/end GROUP
/begin GROUP autosar_swc_tos_autosar_swc_tos_Step_sys_TOS_main_TOS_P0_TARGET_LINE_Subsystem1 "autosar_swc_tos/autosar_swc_tos_Step_sys/TOS_main/TOS_P0_TARGET_LINE/Subsystem1"
 /begin SUB_GROUP autosar_swc_tos_autosar_swc_tos_Step_sys_TOS_main_TOS_P0_TARGET_LINE_Subsystem1_HWA /end SUB_GROUP
/end GROUP
/begin GROUP autosar_swc_tos_autosar_swc_tos_Step_sys_TOS_main_TOS_P0_TARGET_LINE_Subsystem1_HWA "autosar_swc_tos/autosar_swc_tos_Step_sys/TOS_main/TOS_P0_TARGET_LINE/Subsystem1/HWA"
 /begin SUB_GROUP autosar_swc_tos_autosar_swc_tos_Step_sys_TOS_main_TOS_P0_TARGET_LINE_Subsystem1_HWA_PEM_POE_InterstObjSelc /end SUB_GROUP
/end GROUP
/begin GROUP autosar_swc_tos_autosar_swc_tos_Step_sys_TOS_main_TOS_P0_TARGET_LINE_Subsystem1_HWA_PEM_POE_InterstObjSelc "autosar_swc_tos/autosar_swc_tos_Step_sys/TOS_main/TOS_P0_TARGET_LINE/Subsystem1/HWA/PEM_POE_InterstObjSelc"
 /begin REF_MEASUREMENT autosar_swc_tos_rtARID_DEF.ImpAsg_InsertedFor_ID_at_inport_0 autosar_swc_tos_rtARID_DEF.UnitDelay2_DSTATE_g /end REF_MEASUREMENT
/end GROUP
/begin GROUP autosar_swc_tos_autosar_swc_tos_Step_sys_TOS_main_TOS_P0_TARGET_LINE_Subsystem_HWA "autosar_swc_tos/autosar_swc_tos_Step_sys/TOS_main/TOS_P0_TARGET_LINE/Subsystem/HWA"
 /begin SUB_GROUP autosar_swc_tos_autosar_swc_tos_Step_sys_TOS_main_TOS_P0_TARGET_LINE_Subsystem_HWA_PEM_POE_InterstObjSelc /end SUB_GROUP
/end GROUP
/begin GROUP autosar_swc_tos_autosar_swc_tos_Step_sys_TOS_main_TOS_P0_TARGET_LINE_Subsystem_HWA_PEM_POE_InterstObjSelc "autosar_swc_tos/autosar_swc_tos_Step_sys/TOS_main/TOS_P0_TARGET_LINE/Subsystem/HWA/PEM_POE_InterstObjSelc"
 /begin REF_MEASUREMENT autosar_swc_tos_rtARID_DEF.ImpAsg_InsertedFor_ID_at_inport_0 autosar_swc_tos_rtARID_DEF.UnitDelay2_DSTATE /end REF_MEASUREMENT
/end GROUP
/begin GROUP autosar_swc_tos_autosar_swc_tos_Step_sys_TOS_main_TOS_P0_TARGET_LINE_VT "autosar_swc_tos/autosar_swc_tos_Step_sys/TOS_main/TOS_P0_TARGET_LINE/VT"
 /begin SUB_GROUP autosar_swc_tos_autosar_swc_tos_Step_sys_TOS_main_TOS_P0_TARGET_LINE_VT_If_Action_Subsystem /end SUB_GROUP
 /begin REF_CHARACTERISTIC P_TOS_EVM_VT_Switch /end REF_CHARACTERISTIC
/end GROUP
/begin GROUP autosar_swc_tos_autosar_swc_tos_Step_sys_TOS_main_TOS_P0_TARGET_LINE_VT_If_Action_Subsystem "autosar_swc_tos/autosar_swc_tos_Step_sys/TOS_main/TOS_P0_TARGET_LINE/VT/If Action\nSubsystem"
 /begin SUB_GROUP autosar_swc_tos_autosar_swc_tos_Step_sys_TOS_main_TOS_P0_TARGET_LINE_VT_If_Action_Subsystem_op_grp_dopTrajCalc /end SUB_GROUP
/end GROUP
/begin GROUP autosar_swc_tos_autosar_swc_tos_Step_sys_TOS_main_TOS_P0_TARGET_LINE_VT_If_Action_Subsystem_op_grp_dopTrajCalc "autosar_swc_tos/autosar_swc_tos_Step_sys/TOS_main/TOS_P0_TARGET_LINE/VT/If Action\nSubsystem/op_grp_dopTrajCalc"
 /begin SUB_GROUP autosar_swc_tos_autosar_swc_tos_Step_sys_TOS_main_TOS_P0_TARGET_LINE_VT_If_Action_Subsystem_op_grp_dopTrajCalc_op_aproPointGenerate autosar_swc_tos_autosar_swc_tos_Step_sys_TOS_main_TOS_P0_TARGET_LINE_VT_If_Action_Subsystem_op_grp_dopTrajCalc_op_trajObjBuf autosar_swc_tos_autosar_swc_tos_Step_sys_TOS_main_TOS_P0_TARGET_LINE_VT_If_Action_Subsystem_op_grp_dopTrajCalc_op_trajPointGenerate autosar_swc_tos_autosar_swc_tos_Step_sys_TOS_main_TOS_P0_TARGET_LINE_VT_If_Action_Subsystem_op_grp_dopTrajCalc_op_trajPolySelect /end SUB_GROUP
/end GROUP
/begin GROUP autosar_swc_tos_autosar_swc_tos_Step_sys_TOS_main_TOS_P0_TARGET_LINE_VT_If_Action_Subsystem_op_grp_dopTrajCalc_op_aproPointGenerate "autosar_swc_tos/autosar_swc_tos_Step_sys/TOS_main/TOS_P0_TARGET_LINE/VT/If Action\nSubsystem/op_grp_dopTrajCalc/op_aproPointGenerate" /begin REF_MEASUREMENT autosar_swc_tos_rtARID_DEF.Relay_Mode_g /end REF_MEASUREMENT /end GROUP
/begin GROUP autosar_swc_tos_autosar_swc_tos_Step_sys_TOS_main_TOS_P0_TARGET_LINE_VT_If_Action_Subsystem_op_grp_dopTrajCalc_op_trajObjBuf "autosar_swc_tos/autosar_swc_tos_Step_sys/TOS_main/TOS_P0_TARGET_LINE/VT/If Action\nSubsystem/op_grp_dopTrajCalc/op_trajObjBuf"
 /begin REF_MEASUREMENT autosar_swc_tos_rtARID_DEF.BufObj_Class autosar_swc_tos_rtARID_DEF.BufObj_Dx autosar_swc_tos_rtARID_DEF.BufObj_Dy autosar_swc_tos_rtARID_DEF.BufObj_HeadingAngle autosar_swc_tos_rtARID_DEF.BufObj_Id autosar_swc_tos_rtARID_DEF.BufObj_LostAge autosar_swc_tos_rtARID_DEF.BufObj_MovingState autosar_swc_tos_rtARID_DEF.BufObj_TrackAge autosar_swc_tos_rtARID_DEF.BufObj_TrackSts autosar_swc_tos_rtARID_DEF.BufObj_VxG autosar_swc_tos_rtARID_DEF.BufObj_VyG autosar_swc_tos_rtARID_DEF.BufObj_width autosar_swc_tos_rtARID_DEF.BufUsedNum autosar_swc_tos_rtARID_DEF.ImpAsg_InsertedFor_ID_at_inport_0 /end REF_MEASUREMENT
/end GROUP
/begin GROUP autosar_swc_tos_autosar_swc_tos_Step_sys_TOS_main_TOS_P0_TARGET_LINE_VT_If_Action_Subsystem_op_grp_dopTrajCalc_op_trajPointGenerate "autosar_swc_tos/autosar_swc_tos_Step_sys/TOS_main/TOS_P0_TARGET_LINE/VT/If Action\nSubsystem/op_grp_dopTrajCalc/op_trajPointGenerate"
 /begin REF_MEASUREMENT autosar_swc_tos_rtARID_DEF.UnitDelay2_DSTATE_h autosar_swc_tos_rtARID_DEF.UnitDelay_DSTATE_j autosar_swc_tos_rtARID_DEF.sTrajBufSts autosar_swc_tos_rtARID_DEF.sTrajDx autosar_swc_tos_rtARID_DEF.sTrajDy autosar_swc_tos_rtARID_DEF.sTrajPointNum /end REF_MEASUREMENT
/end GROUP
/begin GROUP autosar_swc_tos_autosar_swc_tos_Step_sys_TOS_main_TOS_P0_TARGET_LINE_VT_If_Action_Subsystem_op_grp_dopTrajCalc_op_trajPolySelect "autosar_swc_tos/autosar_swc_tos_Step_sys/TOS_main/TOS_P0_TARGET_LINE/VT/If Action\nSubsystem/op_grp_dopTrajCalc/op_trajPolySelect" /begin REF_CHARACTERISTIC P_TOS_DOP_DiffThre /end REF_CHARACTERISTIC
 /begin REF_MEASUREMENT autosar_swc_tos_rtARID_DEF.DOPSelectPrecheck autosar_swc_tos_rtARID_DEF.DOPSelectPrecheckId autosar_swc_tos_rtARID_DEF.DOPSelectReason autosar_swc_tos_rtARID_DEF.SelectIndex autosar_swc_tos_rtARID_DEF.ctrlT /end REF_MEASUREMENT
/end GROUP
/begin GROUP autosar_swc_tos_autosar_swc_tos_Step_sys_Tos_inport "autosar_swc_tos/autosar_swc_tos_Step_sys/Tos_inport"
 /begin SUB_GROUP autosar_swc_tos_autosar_swc_tos_Step_sys_Tos_inport_Subsystem1 /end SUB_GROUP
/end GROUP
/begin GROUP autosar_swc_tos_autosar_swc_tos_Step_sys_Tos_inport_Subsystem1 "autosar_swc_tos/autosar_swc_tos_Step_sys/Tos_inport/Subsystem1"
 /begin SUB_GROUP autosar_swc_tos_autosar_swc_tos_Step_sys_Tos_inport_Subsystem1_Fusion_TO_TosObj /end SUB_GROUP
 /begin REF_MEASUREMENT TOS_reserve06 /end REF_MEASUREMENT
/end GROUP
/begin GROUP autosar_swc_tos_autosar_swc_tos_Step_sys_Tos_inport_Subsystem1_Fusion_TO_TosObj "autosar_swc_tos/autosar_swc_tos_Step_sys/Tos_inport/Subsystem1/Fusion_TO_TosObj"
 /begin SUB_GROUP autosar_swc_tos_autosar_swc_tos_Step_sys_Tos_inport_Subsystem1_Fusion_TO_TosObj_Subsystem1 /end SUB_GROUP
/end GROUP
/begin GROUP autosar_swc_tos_autosar_swc_tos_Step_sys_Tos_inport_Subsystem1_Fusion_TO_TosObj_Subsystem1 "autosar_swc_tos/autosar_swc_tos_Step_sys/Tos_inport/Subsystem1/Fusion_TO_TosObj/Subsystem1"
 /begin REF_MEASUREMENT autosar_swc_tos_rtARID_DEF.ImpAsg_InsertedFor_ID_at_inport_0 /end REF_MEASUREMENT
/end GROUP
/begin GROUP autosar_swc_tos_rtARID_DEF.Delay_DSTATE ""
 /begin REF_MEASUREMENT autosar_swc_tos_rtARID_DEF.Delay_DSTATE.targetExist autosar_swc_tos_rtARID_DEF.Delay_DSTATE.cutInflg autosar_swc_tos_rtARID_DEF.Delay_DSTATE.brakeIntention autosar_swc_tos_rtARID_DEF.Delay_DSTATE.movingState autosar_swc_tos_rtARID_DEF.Delay_DSTATE.orientation autosar_swc_tos_rtARID_DEF.Delay_DSTATE.type autosar_swc_tos_rtARID_DEF.Delay_DSTATE.fu_type autosar_swc_tos_rtARID_DEF.Delay_DSTATE.dx autosar_swc_tos_rtARID_DEF.Delay_DSTATE.dy autosar_swc_tos_rtARID_DEF.Delay_DSTATE.vxRel autosar_swc_tos_rtARID_DEF.Delay_DSTATE.vyRel autosar_swc_tos_rtARID_DEF.Delay_DSTATE.vxAbs autosar_swc_tos_rtARID_DEF.Delay_DSTATE.vyAbs autosar_swc_tos_rtARID_DEF.Delay_DSTATE.axAbs autosar_swc_tos_rtARID_DEF.Delay_DSTATE.ayAbs autosar_swc_tos_rtARID_DEF.Delay_DSTATE.range autosar_swc_tos_rtARID_DEF.Delay_DSTATE.objExist autosar_swc_tos_rtARID_DEF.Delay_DSTATE.headingAngle autosar_swc_tos_rtARID_DEF.Delay_DSTATE.Object_Length autosar_swc_tos_rtARID_DEF.Delay_DSTATE.Object_Width autosar_swc_tos_rtARID_DEF.Delay_DSTATE.Object_Hight autosar_swc_tos_rtARID_DEF.Delay_DSTATE.id autosar_swc_tos_rtARID_DEF.Delay_DSTATE.age /end REF_MEASUREMENT
/end GROUP
/begin GROUP autosar_swc_tos_rtARID_DEF.Delay_DSTATE_d ""
 /begin REF_MEASUREMENT autosar_swc_tos_rtARID_DEF.Delay_DSTATE_d.targetExist autosar_swc_tos_rtARID_DEF.Delay_DSTATE_d.cutInflg autosar_swc_tos_rtARID_DEF.Delay_DSTATE_d.brakeIntention autosar_swc_tos_rtARID_DEF.Delay_DSTATE_d.movingState autosar_swc_tos_rtARID_DEF.Delay_DSTATE_d.orientation autosar_swc_tos_rtARID_DEF.Delay_DSTATE_d.type autosar_swc_tos_rtARID_DEF.Delay_DSTATE_d.fu_type autosar_swc_tos_rtARID_DEF.Delay_DSTATE_d.dx autosar_swc_tos_rtARID_DEF.Delay_DSTATE_d.dy autosar_swc_tos_rtARID_DEF.Delay_DSTATE_d.vxRel autosar_swc_tos_rtARID_DEF.Delay_DSTATE_d.vyRel autosar_swc_tos_rtARID_DEF.Delay_DSTATE_d.vxAbs autosar_swc_tos_rtARID_DEF.Delay_DSTATE_d.vyAbs autosar_swc_tos_rtARID_DEF.Delay_DSTATE_d.axAbs autosar_swc_tos_rtARID_DEF.Delay_DSTATE_d.ayAbs autosar_swc_tos_rtARID_DEF.Delay_DSTATE_d.range autosar_swc_tos_rtARID_DEF.Delay_DSTATE_d.objExist autosar_swc_tos_rtARID_DEF.Delay_DSTATE_d.headingAngle autosar_swc_tos_rtARID_DEF.Delay_DSTATE_d.Object_Length autosar_swc_tos_rtARID_DEF.Delay_DSTATE_d.Object_Width autosar_swc_tos_rtARID_DEF.Delay_DSTATE_d.Object_Hight autosar_swc_tos_rtARID_DEF.Delay_DSTATE_d.id autosar_swc_tos_rtARID_DEF.Delay_DSTATE_d.age /end REF_MEASUREMENT
/end GROUP
/begin GROUP autosar_swc_tos_rtARID_DEF.Delay_DSTATE_h ""
 /begin REF_MEASUREMENT autosar_swc_tos_rtARID_DEF.Delay_DSTATE_h.nudge_type autosar_swc_tos_rtARID_DEF.Delay_DSTATE_h.ref_lane_id autosar_swc_tos_rtARID_DEF.Delay_DSTATE_h.nudge_dx autosar_swc_tos_rtARID_DEF.Delay_DSTATE_h.nudge_offset autosar_swc_tos_rtARID_DEF.Delay_DSTATE_h.nudge_speed_limit autosar_swc_tos_rtARID_DEF.Delay_DSTATE_h.reserved autosar_swc_tos_rtARID_DEF.Delay_DSTATE_h.obj_id /end REF_MEASUREMENT
/end GROUP
/begin GROUP autosar_swc_tos_rtARID_DEF.Delay_DSTATE_p ""
 /begin REF_MEASUREMENT autosar_swc_tos_rtARID_DEF.Delay_DSTATE_p.nudge_type autosar_swc_tos_rtARID_DEF.Delay_DSTATE_p.ref_lane_id autosar_swc_tos_rtARID_DEF.Delay_DSTATE_p.nudge_dx autosar_swc_tos_rtARID_DEF.Delay_DSTATE_p.nudge_offset autosar_swc_tos_rtARID_DEF.Delay_DSTATE_p.nudge_speed_limit autosar_swc_tos_rtARID_DEF.Delay_DSTATE_p.reserved autosar_swc_tos_rtARID_DEF.Delay_DSTATE_p.obj_id /end REF_MEASUREMENT
/end GROUP
/begin GROUP autosar_swc_tos_rtARID_DEF.LM_LR ""
 /begin REF_MEASUREMENT autosar_swc_tos_rtARID_DEF.LM_LR.pC0 autosar_swc_tos_rtARID_DEF.LM_LR.pC1 autosar_swc_tos_rtARID_DEF.LM_LR.pC2 autosar_swc_tos_rtARID_DEF.LM_LR.pC3 autosar_swc_tos_rtARID_DEF.LM_LR.pC4 autosar_swc_tos_rtARID_DEF.LM_LR.pC5 autosar_swc_tos_rtARID_DEF.LM_LR.dDisStart autosar_swc_tos_rtARID_DEF.LM_LR.dDisEnd autosar_swc_tos_rtARID_DEF.LM_LR.dQuality autosar_swc_tos_rtARID_DEF.LM_LR.fCamValid /end REF_MEASUREMENT
/end GROUP
/begin GROUP autosar_swc_tos_rtARID_DEF.LastLM ""
 /begin REF_MEASUREMENT autosar_swc_tos_rtARID_DEF.LastLM.ObjectID autosar_swc_tos_rtARID_DEF.LastLM.Timestamp /end REF_MEASUREMENT
/end GROUP
/begin GROUP autosar_swc_tos_rtARID_DEF.LastLM.Lines[0] ""
 /begin REF_MEASUREMENT autosar_swc_tos_rtARID_DEF.LastLM.Lines[0].Source autosar_swc_tos_rtARID_DEF.LastLM.Lines[0].bIsLineExist autosar_swc_tos_rtARID_DEF.LastLM.Lines[0].dC0V autosar_swc_tos_rtARID_DEF.LastLM.Lines[0].dC1V autosar_swc_tos_rtARID_DEF.LastLM.Lines[0].dC2V autosar_swc_tos_rtARID_DEF.LastLM.Lines[0].dC3V autosar_swc_tos_rtARID_DEF.LastLM.Lines[0].dC4V autosar_swc_tos_rtARID_DEF.LastLM.Lines[0].dC5V autosar_swc_tos_rtARID_DEF.LastLM.Lines[0].eLineType autosar_swc_tos_rtARID_DEF.LastLM.Lines[0].dDisStart autosar_swc_tos_rtARID_DEF.LastLM.Lines[0].dDisFront autosar_swc_tos_rtARID_DEF.LastLM.Lines[0].dQuality autosar_swc_tos_rtARID_DEF.LastLM.Lines[0].dLaneWidth autosar_swc_tos_rtARID_DEF.LastLM.Lines[0].eLinefusType /end REF_MEASUREMENT
/end GROUP
/begin CHARACTERISTIC P_LATC_ManMachineSteerAng_C0Gain "" CURVE 0xfe822380 /* @ECU_Address@P_LATC_ManMachineSteerAng_C0Gain@ */ Record_FLOAT32_IEEE 0 autosar_swc_vmc_CM_single -3.4E+38 3.4E+38
 /begin AXIS_DESCR COM_AXIS NO_INPUT_QUANTITY autosar_swc_vmc_CM_single 6 -3.4E+38 3.4E+38 AXIS_PTS_REF P_LATC_ManMachineSteerAng_C0 /end AXIS_DESCR
/end CHARACTERISTIC
/begin CHARACTERISTIC P_LATC_ManMachineSteerAng_C2Gain "" CURVE 0xfe8223c0 /* @ECU_Address@P_LATC_ManMachineSteerAng_C2Gain@ */ Record_FLOAT32_IEEE 0 autosar_swc_vmc_CM_single -3.4E+38 3.4E+38
 /begin AXIS_DESCR COM_AXIS NO_INPUT_QUANTITY autosar_swc_vmc_CM_single 10 -3.4E+38 3.4E+38 AXIS_PTS_REF P_LATC_ManMachineSteerAng_C2 /end AXIS_DESCR
/end CHARACTERISTIC
/begin CHARACTERISTIC P_LATC_SteerManMachineGainChange "" VALUE 0xfe822040 /* @ECU_Address@P_LATC_SteerManMachineGainChange@ */ Record_FLOAT32_IEEE 0 autosar_swc_vmc_CM_single -3.4E+38 3.4E+38 /end CHARACTERISTIC
/begin CHARACTERISTIC P_LATC_SteerManMachineSW "" VALUE 0xfe82212f /* @ECU_Address@P_LATC_SteerManMachineSW@ */ Record_BOOLEAN 0 autosar_swc_vmc_CM_boolean 0 1 /end CHARACTERISTIC
/begin CHARACTERISTIC P_LATC_SteerTorFilterLimit "" MAP 0xfe825560 /* @ECU_Address@P_LATC_SteerTorFilterLimit@ */ Record_FLOAT32_IEEE 0 autosar_swc_vmc_CM_single -3.4E+38 3.4E+38
 /begin AXIS_DESCR COM_AXIS LATC_DisplaySpd_kph autosar_swc_vmc_CM_single 16 -3.4E+38 3.4E+38 AXIS_PTS_REF P_LATC_preDis_spd /end AXIS_DESCR
 /begin AXIS_DESCR COM_AXIS NO_INPUT_QUANTITY autosar_swc_vmc_CM_single 19 -3.4E+38 3.4E+38 AXIS_PTS_REF P_LATC_SteerTrqVal /end AXIS_DESCR
/end CHARACTERISTIC
/begin CHARACTERISTIC P_LATC_SteerTorInitLimit "" VALUE 0xfe822044 /* @ECU_Address@P_LATC_SteerTorInitLimit@ */ Record_FLOAT32_IEEE 0 autosar_swc_vmc_CM_single -3.4E+38 3.4E+38 /end CHARACTERISTIC
/begin CHARACTERISTIC P_LATC_SteerTorLimit "" MAP 0xfe825a20 /* @ECU_Address@P_LATC_SteerTorLimit@ */ Record_FLOAT32_IEEE 0 autosar_swc_vmc_CM_single -3.4E+38 3.4E+38
 /begin AXIS_DESCR COM_AXIS LATC_DisplaySpd_kph autosar_swc_vmc_CM_single 16 -3.4E+38 3.4E+38 AXIS_PTS_REF P_LATC_preDis_spd /end AXIS_DESCR
 /begin AXIS_DESCR COM_AXIS NO_INPUT_QUANTITY autosar_swc_vmc_CM_single 19 -3.4E+38 3.4E+38 AXIS_PTS_REF P_LATC_SteerTrqVal /end AXIS_DESCR
/end CHARACTERISTIC
/begin CHARACTERISTIC P_LATC_SteerTorMaxLimit "" VALUE 0xfe822048 /* @ECU_Address@P_LATC_SteerTorMaxLimit@ */ Record_FLOAT32_IEEE 0 autosar_swc_vmc_CM_single -3.4E+38 3.4E+38 /end CHARACTERISTIC
/begin MEASUREMENT LATC_DangerLevel "" UBYTE autosar_swc_vmc_CM_uint8 0 0 0 255 ECU_ADDRESS 0xfe4cc292 /* @ECU_Address@LATC_DangerLevel@ */ /end MEASUREMENT
/begin MEASUREMENT LATC_DisplaySpd_kph "" FLOAT32_IEEE autosar_swc_vmc_CM_single 0 0 -3.4E+38 3.4E+38 ECU_ADDRESS 0xfe4cc040 /* @ECU_Address@LATC_DisplaySpd_kph@ */ /end MEASUREMENT
/begin MEASUREMENT SwcOut_VMC_EXEC_POS.heading_angle "" FLOAT32_IEEE autosar_swc_vmc_CM_single 0 0 -3.4E+38 3.4E+38 ECU_ADDRESS 0xfe4cc258 /* @ECU_Address@SwcOut_VMC_EXEC_POS.heading_angle@ */ /end MEASUREMENT
/begin MEASUREMENT SwcOut_VMC_EXEC_POS.x "" FLOAT32_IEEE autosar_swc_vmc_CM_single 0 0 -3.4E+38 3.4E+38 ECU_ADDRESS 0xfe4cc250 /* @ECU_Address@SwcOut_VMC_EXEC_POS.x@ */ /end MEASUREMENT
/begin MEASUREMENT SwcOut_VMC_EXEC_POS.y "" FLOAT32_IEEE autosar_swc_vmc_CM_single 0 0 -3.4E+38 3.4E+38 ECU_ADDRESS 0xfe4cc254 /* @ECU_Address@SwcOut_VMC_EXEC_POS.y@ */ /end MEASUREMENT
/begin MEASUREMENT SwcOut_VMC_Herbeat_Info.inner_error "" ULONG autosar_swc_vmc_CM_uint32 0 0 0 4294967295 ECU_ADDRESS 0xfe4cc260 /* @ECU_Address@SwcOut_VMC_Herbeat_Info.inner_error@ */ /end MEASUREMENT
/begin MEASUREMENT SwcOut_VMC_Herbeat_Info.module_status "" UBYTE autosar_swc_vmc_CM_SM_MODULE_STATUS 0 0 0 3 ECU_ADDRESS 0xfe4cc264 /* @ECU_Address@SwcOut_VMC_Herbeat_Info.module_status@ */ /end MEASUREMENT
/begin MEASUREMENT SwcOut_VMC_Herbeat_Info.sequence_num "" UBYTE autosar_swc_vmc_CM_uint8 0 0 0 255 ECU_ADDRESS 0xfe4cc25d /* @ECU_Address@SwcOut_VMC_Herbeat_Info.sequence_num@ */ /end MEASUREMENT
/begin MEASUREMENT SwcOut_VMC_Herbeat_Info.swc_id "" UBYTE autosar_swc_vmc_CM_uint8 0 0 0 255 ECU_ADDRESS 0xfe4cc25c /* @ECU_Address@SwcOut_VMC_Herbeat_Info.swc_id@ */ /end MEASUREMENT
/begin MEASUREMENT SwcOut_VMC_LAT.aim_point_xy "" FLOAT32_IEEE autosar_swc_vmc_CM_single 0 0 -3.4E+38 3.4E+38 LAYOUT COLUMN_DIR MATRIX_DIM 2 ECU_ADDRESS 0xfe4cbd90 /* @ECU_Address@SwcOut_VMC_LAT.aim_point_xy@ */ /end MEASUREMENT
/begin MEASUREMENT SwcOut_VMC_LAT.ang_cmd_req "" UBYTE autosar_swc_vmc_CM_uint8 0 0 0 255 ECU_ADDRESS 0xfe4cbd79 /* @ECU_Address@SwcOut_VMC_LAT.ang_cmd_req@ */ /end MEASUREMENT
/begin MEASUREMENT SwcOut_VMC_LAT.ang_cmd_req_value "" FLOAT32_IEEE autosar_swc_vmc_CM_single 0 0 -3.4E+38 3.4E+38 ECU_ADDRESS 0xfe4cbd80 /* @ECU_Address@SwcOut_VMC_LAT.ang_cmd_req_value@ */ /end MEASUREMENT
/begin MEASUREMENT SwcOut_VMC_LAT.latc_effect "" FLOAT32_IEEE autosar_swc_vmc_CM_single 0 0 -3.4E+38 3.4E+38 ECU_ADDRESS 0xfe4cbd8c /* @ECU_Address@SwcOut_VMC_LAT.latc_effect@ */ /end MEASUREMENT
/begin MEASUREMENT SwcOut_VMC_LAT.steer_max_trq_req "" FLOAT32_IEEE autosar_swc_vmc_CM_single 0 0 -3.4E+38 3.4E+38 ECU_ADDRESS 0xfe4cbd84 /* @ECU_Address@SwcOut_VMC_LAT.steer_max_trq_req@ */ /end MEASUREMENT
/begin MEASUREMENT SwcOut_VMC_LAT.steer_min_trq_req "" FLOAT32_IEEE autosar_swc_vmc_CM_single 0 0 -3.4E+38 3.4E+38 ECU_ADDRESS 0xfe4cbd88 /* @ECU_Address@SwcOut_VMC_LAT.steer_min_trq_req@ */ /end MEASUREMENT
/begin MEASUREMENT SwcOut_VMC_LAT.trq_cmd_req "" UBYTE autosar_swc_vmc_CM_uint8 0 0 0 255 ECU_ADDRESS 0xfe4cbd78 /* @ECU_Address@SwcOut_VMC_LAT.trq_cmd_req@ */ /end MEASUREMENT
/begin MEASUREMENT SwcOut_VMC_LAT.trq_cmd_req_value "" FLOAT32_IEEE autosar_swc_vmc_CM_single 0 0 -3.4E+38 3.4E+38 ECU_ADDRESS 0xfe4cbd7c /* @ECU_Address@SwcOut_VMC_LAT.trq_cmd_req_value@ */ /end MEASUREMENT
/begin MEASUREMENT SwcOut_VMC_LGT.acc_mode "" UBYTE autosar_swc_vmc_CM_uint8 0 0 0 255 ECU_ADDRESS 0xfe4cc26c /* @ECU_Address@SwcOut_VMC_LGT.acc_mode@ */ /end MEASUREMENT
/begin MEASUREMENT SwcOut_VMC_LGT.brk_perfer "" UBYTE autosar_swc_vmc_CM_uint8 0 0 0 255 ECU_ADDRESS 0xfe4cc26d /* @ECU_Address@SwcOut_VMC_LGT.brk_perfer@ */ /end MEASUREMENT
/begin MEASUREMENT SwcOut_VMC_LGT.comfort_low "" FLOAT32_IEEE autosar_swc_vmc_CM_single 0 0 -3.4E+38 3.4E+38 ECU_ADDRESS 0xfe4cc278 /* @ECU_Address@SwcOut_VMC_LGT.comfort_low@ */ /end MEASUREMENT
/begin MEASUREMENT SwcOut_VMC_LGT.comfort_up "" FLOAT32_IEEE autosar_swc_vmc_CM_single 0 0 -3.4E+38 3.4E+38 ECU_ADDRESS 0xfe4cc27c /* @ECU_Address@SwcOut_VMC_LGT.comfort_up@ */ /end MEASUREMENT
/begin MEASUREMENT SwcOut_VMC_LGT.dc_ec_sts "" UBYTE autosar_swc_vmc_CM_uint8 0 0 0 255 ECU_ADDRESS 0xfe4cc26e /* @ECU_Address@SwcOut_VMC_LGT.dc_ec_sts@ */ /end MEASUREMENT
/begin MEASUREMENT SwcOut_VMC_LGT.dec_to_stop "" UBYTE autosar_swc_vmc_CM_uint8 0 0 0 255 ECU_ADDRESS 0xfe4cc26b /* @ECU_Address@SwcOut_VMC_LGT.dec_to_stop@ */ /end MEASUREMENT
/begin MEASUREMENT SwcOut_VMC_LGT.decel_acc_req "" UBYTE autosar_swc_vmc_CM_boolean 0 0 0 1 ECU_ADDRESS 0xfe4cc269 /* @ECU_Address@SwcOut_VMC_LGT.decel_acc_req@ */ /end MEASUREMENT
/begin MEASUREMENT SwcOut_VMC_LGT.decel_acc_req_value "" FLOAT32_IEEE autosar_swc_vmc_CM_single 0 0 -3.4E+38 3.4E+38 ECU_ADDRESS 0xfe4cc288 /* @ECU_Address@SwcOut_VMC_LGT.decel_acc_req_value@ */ /end MEASUREMENT
/begin MEASUREMENT SwcOut_VMC_LGT.drv_off "" UBYTE autosar_swc_vmc_CM_uint8 0 0 0 255 ECU_ADDRESS 0xfe4cc26a /* @ECU_Address@SwcOut_VMC_LGT.drv_off@ */ /end MEASUREMENT
/begin MEASUREMENT SwcOut_VMC_LGT.max_jerk "" FLOAT32_IEEE autosar_swc_vmc_CM_single 0 0 -3.4E+38 3.4E+38 ECU_ADDRESS 0xfe4cc270 /* @ECU_Address@SwcOut_VMC_LGT.max_jerk@ */ /end MEASUREMENT
/begin MEASUREMENT SwcOut_VMC_LGT.min_jerk "" FLOAT32_IEEE autosar_swc_vmc_CM_single 0 0 -3.4E+38 3.4E+38 ECU_ADDRESS 0xfe4cc274 /* @ECU_Address@SwcOut_VMC_LGT.min_jerk@ */ /end MEASUREMENT
/begin MEASUREMENT SwcOut_VMC_LGT.tar_accel "" FLOAT32_IEEE autosar_swc_vmc_CM_single 0 0 -3.4E+38 3.4E+38 ECU_ADDRESS 0xfe4cc280 /* @ECU_Address@SwcOut_VMC_LGT.tar_accel@ */ /end MEASUREMENT
/begin MEASUREMENT SwcOut_VMC_LGT.trq_req_active "" UBYTE autosar_swc_vmc_CM_boolean 0 0 0 1 ECU_ADDRESS 0xfe4cc268 /* @ECU_Address@SwcOut_VMC_LGT.trq_req_active@ */ /end MEASUREMENT
/begin MEASUREMENT SwcOut_VMC_LGT.trq_req_value "" FLOAT32_IEEE autosar_swc_vmc_CM_single 0 0 -3.4E+38 3.4E+38 ECU_ADDRESS 0xfe4cc284 /* @ECU_Address@SwcOut_VMC_LGT.trq_req_value@ */ /end MEASUREMENT
/begin MEASUREMENT VMC_ExecTimestamp.nanoseconds "" ULONG autosar_swc_vmc_CM_uint32 0 0 0 4294967295 ECU_ADDRESS 0xfe4cbd9c /* @ECU_Address@VMC_ExecTimestamp.nanoseconds@ */ /end MEASUREMENT
/begin MEASUREMENT VMC_ExecTimestamp.seconds "" A_UINT64 autosar_swc_vmc_CM_uint64 0 0 0 18446744073709551615 ECU_ADDRESS 0xfe4cbda0 /* @ECU_Address@VMC_ExecTimestamp.seconds@ */ /end MEASUREMENT
/begin MEASUREMENT VMC_ExecTimestamp.timeBaseStatus "" UBYTE autosar_swc_vmc_CM_uint8 0 0 0 255 ECU_ADDRESS 0xfe4cbd98 /* @ECU_Address@VMC_ExecTimestamp.timeBaseStatus@ */ /end MEASUREMENT
/begin MEASUREMENT VMC_UpdateCnt "" UBYTE autosar_swc_vmc_CM_uint8 0 0 0 255 ECU_ADDRESS 0xfe4cc29a /* @ECU_Address@VMC_UpdateCnt@ */ /end MEASUREMENT
/begin MEASUREMENT VMC_Version "" ULONG autosar_swc_vmc_CM_uint32 0 0 0 4294967295 ECU_ADDRESS 0xfe4cc28c /* @ECU_Address@VMC_Version@ */ /end MEASUREMENT
/begin MEASUREMENT autosar_swc_vmc_rtARID_DEF.ManMachineEndGain "" FLOAT32_IEEE autosar_swc_vmc_CM_single 0 0 -3.4E+38 3.4E+38 ECU_ADDRESS 0xfe4cbfdc /* @ECU_Address@autosar_swc_vmc_rtARID_DEF.ManMachineEndGain@ */ /end MEASUREMENT
/begin MEASUREMENT autosar_swc_vmc_rtARID_DEF.Output_DSTATE "" UBYTE autosar_swc_vmc_CM_uint8 0 0 0 255 ECU_ADDRESS 0xfe4cbff2 /* @ECU_Address@autosar_swc_vmc_rtARID_DEF.Output_DSTATE@ */ /end MEASUREMENT
/begin MEASUREMENT autosar_swc_vmc_rtARID_DEF.steertorlimval "" FLOAT32_IEEE autosar_swc_vmc_CM_single 0 0 -3.4E+38 3.4E+38 ECU_ADDRESS 0xfe4cbfe0 /* @ECU_Address@autosar_swc_vmc_rtARID_DEF.steertorlimval@ */ /end MEASUREMENT
/begin AXIS_PTS P_LATC_ManMachineSteerAng_C0 "" 0xfe822368 /* @ECU_Address@P_LATC_ManMachineSteerAng_C0@ */ NO_INPUT_QUANTITY Axis_FLOAT32_IEEE 0 autosar_swc_vmc_CM_single 6 -3.4E+38 3.4E+38 /end AXIS_PTS
/begin AXIS_PTS P_LATC_ManMachineSteerAng_C2 "" 0xfe822398 /* @ECU_Address@P_LATC_ManMachineSteerAng_C2@ */ NO_INPUT_QUANTITY Axis_FLOAT32_IEEE 0 autosar_swc_vmc_CM_single 10 -3.4E+38 3.4E+38 /end AXIS_PTS
/begin AXIS_PTS P_LATC_SteerTrqVal "" 0xfe825ee0 /* @ECU_Address@P_LATC_SteerTrqVal@ */ NO_INPUT_QUANTITY Axis_FLOAT32_IEEE 0 autosar_swc_vmc_CM_single 19 -3.4E+38 3.4E+38 /end AXIS_PTS
/begin AXIS_PTS P_LATC_preDis_spd "" 0xfe822450 /* @ECU_Address@P_LATC_preDis_spd@ */ NO_INPUT_QUANTITY Axis_FLOAT32_IEEE 0 autosar_swc_vmc_CM_single 16 -3.4E+38 3.4E+38 /end AXIS_PTS
/begin COMPU_METHOD autosar_swc_vmc_CM_SM_MODULE_STATUS "Enumerated data type: SM_MODULE_STATUS" TAB_VERB "%0.6" "" COMPU_TAB_REF VTAB_FOR_autosar_swc_vmc_CM_SM_MODULE_STATUS /end COMPU_METHOD
/begin COMPU_VTAB VTAB_FOR_autosar_swc_vmc_CM_SM_MODULE_STATUS "Enumerated data type: SM_MODULE_STATUS" TAB_VERB 4 0 "STATUS_NORMAL" 1 "STATUS_NOT_CONNECTED" 2 "STATUS_HEARTBEAT_MISSED" 3 "STATUS_ABNORMAL" /end COMPU_VTAB
/begin COMPU_METHOD autosar_swc_vmc_CM_boolean "Q = V" IDENTICAL "%1.0" "" /end COMPU_METHOD
/begin COMPU_METHOD autosar_swc_vmc_CM_single "Q = V" IDENTICAL "%8.6" "" /end COMPU_METHOD
/begin COMPU_METHOD autosar_swc_vmc_CM_uint32 "Q = V" IDENTICAL "%10.0" "" /end COMPU_METHOD
/begin COMPU_METHOD autosar_swc_vmc_CM_uint64 "Q = V" IDENTICAL "%20.0" "" /end COMPU_METHOD
/begin COMPU_METHOD autosar_swc_vmc_CM_uint8 "Q = V" IDENTICAL "%3.0" "" /end COMPU_METHOD
/begin RECORD_LAYOUT Record_BOOLEAN FNC_VALUES 1 UBYTE COLUMN_DIR DIRECT /end RECORD_LAYOUT
/begin RECORD_LAYOUT Record_FLOAT32_IEEE FNC_VALUES 1 FLOAT32_IEEE COLUMN_DIR DIRECT /end RECORD_LAYOUT
/begin RECORD_LAYOUT Axis_FLOAT32_IEEE AXIS_PTS_X 1 FLOAT32_IEEE INDEX_INCR DIRECT /end RECORD_LAYOUT
/begin GROUP SwcOut_VMC_EXEC_POS ""
 /begin REF_MEASUREMENT SwcOut_VMC_EXEC_POS.x SwcOut_VMC_EXEC_POS.y SwcOut_VMC_EXEC_POS.heading_angle /end REF_MEASUREMENT
/end GROUP
/begin GROUP SwcOut_VMC_Herbeat_Info ""
 /begin REF_MEASUREMENT SwcOut_VMC_Herbeat_Info.swc_id SwcOut_VMC_Herbeat_Info.sequence_num SwcOut_VMC_Herbeat_Info.inner_error SwcOut_VMC_Herbeat_Info.module_status /end REF_MEASUREMENT
/end GROUP
/begin GROUP SwcOut_VMC_LAT ""
 /begin REF_MEASUREMENT SwcOut_VMC_LAT.trq_cmd_req SwcOut_VMC_LAT.ang_cmd_req SwcOut_VMC_LAT.trq_cmd_req_value SwcOut_VMC_LAT.ang_cmd_req_value SwcOut_VMC_LAT.steer_max_trq_req SwcOut_VMC_LAT.steer_min_trq_req SwcOut_VMC_LAT.latc_effect SwcOut_VMC_LAT.aim_point_xy /end REF_MEASUREMENT
/end GROUP
/begin GROUP SwcOut_VMC_LGT ""
 /begin REF_MEASUREMENT SwcOut_VMC_LGT.trq_req_active SwcOut_VMC_LGT.decel_acc_req SwcOut_VMC_LGT.drv_off SwcOut_VMC_LGT.dec_to_stop SwcOut_VMC_LGT.acc_mode SwcOut_VMC_LGT.brk_perfer SwcOut_VMC_LGT.dc_ec_sts SwcOut_VMC_LGT.max_jerk SwcOut_VMC_LGT.min_jerk SwcOut_VMC_LGT.comfort_low SwcOut_VMC_LGT.comfort_up SwcOut_VMC_LGT.tar_accel SwcOut_VMC_LGT.trq_req_value SwcOut_VMC_LGT.decel_acc_req_value /end REF_MEASUREMENT
/end GROUP
/begin GROUP VMC_ExecTimestamp ""
 /begin REF_MEASUREMENT VMC_ExecTimestamp.timeBaseStatus VMC_ExecTimestamp.nanoseconds VMC_ExecTimestamp.seconds /end REF_MEASUREMENT
/end GROUP
/begin GROUP ZDrive_BSW_Cal_Cal "" /begin SUB_GROUP ZDrive_BSW_Cal_Cal.ZDrive_BSW_Cal_VehicleInfomationTable /end SUB_GROUP /end GROUP
/begin GROUP autosar_swc_vmc "autosar_swc_vmc" ROOT
 /begin SUB_GROUP SwcOut_VMC_EXEC_POS SwcOut_VMC_Herbeat_Info SwcOut_VMC_LAT SwcOut_VMC_LGT VMC_ExecTimestamp autosar_swc_vmc_autosar_swc_vmc_Step_sys /end SUB_GROUP
/end GROUP
/begin GROUP autosar_swc_vmc_autosar_swc_vmc_Step_sys "autosar_swc_vmc/autosar_swc_vmc_Step_sys"
 /begin SUB_GROUP autosar_swc_vmc_autosar_swc_vmc_Step_sys_Counter_Limited autosar_swc_vmc_autosar_swc_vmc_Step_sys_LATC autosar_swc_vmc_autosar_swc_vmc_Step_sys_LONC /end SUB_GROUP
 /begin REF_MEASUREMENT VMC_UpdateCnt VMC_Version /end REF_MEASUREMENT
/end GROUP
/begin GROUP autosar_swc_vmc_autosar_swc_vmc_Step_sys_Counter_Limited "autosar_swc_vmc/autosar_swc_vmc_Step_sys/Counter\nLimited"
 /begin SUB_GROUP autosar_swc_vmc_autosar_swc_vmc_Step_sys_Counter_Limited_Increment_Real_World /end SUB_GROUP
 /begin REF_MEASUREMENT VMC_UpdateCnt autosar_swc_vmc_rtARID_DEF.Output_DSTATE /end REF_MEASUREMENT
/end GROUP
/begin GROUP autosar_swc_vmc_autosar_swc_vmc_Step_sys_Counter_Limited_Increment_Real_World "autosar_swc_vmc/autosar_swc_vmc_Step_sys/Counter\nLimited/Increment\nReal World" /begin REF_MEASUREMENT VMC_UpdateCnt /end REF_MEASUREMENT /end GROUP
/begin GROUP autosar_swc_vmc_autosar_swc_vmc_Step_sys_LATC "autosar_swc_vmc/autosar_swc_vmc_Step_sys/LATC"
 /begin SUB_GROUP autosar_swc_vmc_autosar_swc_vmc_Step_sys_LATC_latc_AngleCalc autosar_swc_vmc_autosar_swc_vmc_Step_sys_LATC_latc_adaptIn autosar_swc_vmc_autosar_swc_vmc_Step_sys_LATC_latc_adaptOut /end SUB_GROUP
/end GROUP
/begin GROUP autosar_swc_vmc_autosar_swc_vmc_Step_sys_LATC_latc_AngleCalc "autosar_swc_vmc/autosar_swc_vmc_Step_sys/LATC/latc_AngleCalc"
 /begin SUB_GROUP autosar_swc_vmc_autosar_swc_vmc_Step_sys_LATC_latc_AngleCalc_Subsystem autosar_swc_vmc_autosar_swc_vmc_Step_sys_LATC_latc_AngleCalc_latc_angslopeCalc autosar_swc_vmc_autosar_swc_vmc_Step_sys_LATC_latc_AngleCalc_latc_effectCalc autosar_swc_vmc_autosar_swc_vmc_Step_sys_LATC_latc_AngleCalc_latc_epsreqflgCalc autosar_swc_vmc_autosar_swc_vmc_Step_sys_LATC_latc_AngleCalc_latc_linepreviewCalc autosar_swc_vmc_autosar_swc_vmc_Step_sys_LATC_latc_AngleCalc_latc_predisCalc autosar_swc_vmc_autosar_swc_vmc_Step_sys_LATC_latc_AngleCalc_latc_tarSteerAngleCalc autosar_swc_vmc_autosar_swc_vmc_Step_sys_LATC_latc_AngleCalc_latc_valconvertCalc /end SUB_GROUP
/end GROUP
/begin GROUP autosar_swc_vmc_autosar_swc_vmc_Step_sys_LATC_latc_AngleCalc_Subsystem "autosar_swc_vmc/autosar_swc_vmc_Step_sys/LATC/latc_AngleCalc/Subsystem"
 /begin REF_CHARACTERISTIC P_LATC_ManMachineSteerAng_C0 P_LATC_ManMachineSteerAng_C0Gain P_LATC_ManMachineSteerAng_C2 P_LATC_ManMachineSteerAng_C2Gain P_LATC_SteerManMachineGainChange P_LATC_SteerManMachineSW P_LATC_SteerTorFilterLimit P_LATC_SteerTorInitLimit P_LATC_SteerTorLimit P_LATC_SteerTorMaxLimit P_LATC_SteerTrqVal P_LATC_preDis_spd /end REF_CHARACTERISTIC
 /begin REF_MEASUREMENT LATC_DangerLevel LATC_DisplaySpd_kph autosar_swc_vmc_rtARID_DEF.ManMachineEndGain autosar_swc_vmc_rtARID_DEF.steertorlimval /end REF_MEASUREMENT
/end GROUP
/begin GROUP autosar_swc_vmc_autosar_swc_vmc_Step_sys_LATC_latc_AngleCalc_latc_angslopeCalc "autosar_swc_vmc/autosar_swc_vmc_Step_sys/LATC/latc_AngleCalc/latc_angslopeCalc" /begin REF_MEASUREMENT LATC_DangerLevel LATC_DisplaySpd_kph /end REF_MEASUREMENT /end GROUP
/begin GROUP autosar_swc_vmc_autosar_swc_vmc_Step_sys_LATC_latc_AngleCalc_latc_effectCalc_Compare_To_Constant4 "autosar_swc_vmc/autosar_swc_vmc_Step_sys/LATC/latc_AngleCalc/latc_effectCalc/Compare\nTo Constant4" /begin REF_MEASUREMENT LATC_DangerLevel /end REF_MEASUREMENT /end GROUP
/begin GROUP autosar_swc_vmc_autosar_swc_vmc_Step_sys_LATC_latc_AngleCalc_latc_epsreqflgCalc "autosar_swc_vmc/autosar_swc_vmc_Step_sys/LATC/latc_AngleCalc/latc_epsreqflgCalc" /begin REF_MEASUREMENT LATC_DangerLevel /end REF_MEASUREMENT /end GROUP
/begin GROUP autosar_swc_vmc_autosar_swc_vmc_Step_sys_LATC_latc_AngleCalc_latc_epsreqflgCalc_Compare_To_Constant3 "autosar_swc_vmc/autosar_swc_vmc_Step_sys/LATC/latc_AngleCalc/latc_epsreqflgCalc/Compare\nTo Constant3" /begin REF_MEASUREMENT LATC_DisplaySpd_kph /end REF_MEASUREMENT /end GROUP
/begin GROUP autosar_swc_vmc_autosar_swc_vmc_Step_sys_LATC_latc_AngleCalc_latc_linepreviewCalc "autosar_swc_vmc/autosar_swc_vmc_Step_sys/LATC/latc_AngleCalc/latc_linepreviewCalc" /begin REF_MEASUREMENT LATC_DangerLevel /end REF_MEASUREMENT /end GROUP
/begin GROUP autosar_swc_vmc_autosar_swc_vmc_Step_sys_LATC_latc_AngleCalc_latc_linepreviewCalc_PreView_Distance "autosar_swc_vmc/autosar_swc_vmc_Step_sys/LATC/latc_AngleCalc/latc_linepreviewCalc/PreView_Distance" /begin REF_CHARACTERISTIC P_LATC_preDis_spd /end REF_CHARACTERISTIC /begin REF_MEASUREMENT LATC_DisplaySpd_kph /end REF_MEASUREMENT /end GROUP
/begin GROUP autosar_swc_vmc_autosar_swc_vmc_Step_sys_LATC_latc_AngleCalc_latc_predisCalc "autosar_swc_vmc/autosar_swc_vmc_Step_sys/LATC/latc_AngleCalc/latc_predisCalc" /begin REF_CHARACTERISTIC P_LATC_preDis_spd /end REF_CHARACTERISTIC /begin REF_MEASUREMENT LATC_DangerLevel LATC_DisplaySpd_kph /end REF_MEASUREMENT /end GROUP
/begin GROUP autosar_swc_vmc_autosar_swc_vmc_Step_sys_LATC_latc_AngleCalc_latc_predisCalc_Subsystem "autosar_swc_vmc/autosar_swc_vmc_Step_sys/LATC/latc_AngleCalc/latc_predisCalc/Subsystem" /begin REF_CHARACTERISTIC P_LATC_preDis_spd /end REF_CHARACTERISTIC /begin REF_MEASUREMENT LATC_DisplaySpd_kph /end REF_MEASUREMENT /end GROUP
/begin GROUP autosar_swc_vmc_autosar_swc_vmc_Step_sys_LATC_latc_AngleCalc_latc_tarSteerAngleCalc_latc_tarSteerAngleCalc "autosar_swc_vmc/autosar_swc_vmc_Step_sys/LATC/latc_AngleCalc/latc_tarSteerAngleCalc/latc_tarSteerAngleCalc" /begin REF_MEASUREMENT LATC_DisplaySpd_kph /end REF_MEASUREMENT /end GROUP
/begin GROUP autosar_swc_vmc_autosar_swc_vmc_Step_sys_LATC_latc_AngleCalc_latc_tarSteerAngleCalc_latc_tarSteerAngleCalc_Subsystem3 "autosar_swc_vmc/autosar_swc_vmc_Step_sys/LATC/latc_AngleCalc/latc_tarSteerAngleCalc/latc_tarSteerAngleCalc/Subsystem3" /begin REF_MEASUREMENT LATC_DangerLevel LATC_DisplaySpd_kph /end REF_MEASUREMENT /end GROUP
/begin GROUP autosar_swc_vmc_autosar_swc_vmc_Step_sys_LATC_latc_AngleCalc_latc_valconvertCalc "autosar_swc_vmc/autosar_swc_vmc_Step_sys/LATC/latc_AngleCalc/latc_valconvertCalc" /begin REF_MEASUREMENT LATC_DisplaySpd_kph /end REF_MEASUREMENT /end GROUP
/begin RECORD_LAYOUT Record_BOOLEAN FNC_VALUES 1 UBYTE COLUMN_DIR DIRECT /end RECORD_LAYOUT
/begin RECORD_LAYOUT Record_FLOAT32_IEEE FNC_VALUES 1 FLOAT32_IEEE COLUMN_DIR DIRECT /end RECORD_LAYOUT
/begin RECORD_LAYOUT Axis_FLOAT32_IEEE AXIS_PTS_X 1 FLOAT32_IEEE INDEX_INCR DIRECT /end RECORD_LAYOUT
/begin RECORD_LAYOUT Record_BOOLEAN FNC_VALUES 1 UBYTE COLUMN_DIR DIRECT /end RECORD_LAYOUT
/begin RECORD_LAYOUT Record_FLOAT32_IEEE FNC_VALUES 1 FLOAT32_IEEE COLUMN_DIR DIRECT /end RECORD_LAYOUT
/begin RECORD_LAYOUT Axis_FLOAT32_IEEE AXIS_PTS_X 1 FLOAT32_IEEE INDEX_INCR DIRECT /end RECORD_LAYOUT
/begin RECORD_LAYOUT Record_BOOLEAN FNC_VALUES 1 UBYTE COLUMN_DIR DIRECT /end RECORD_LAYOUT
/begin RECORD_LAYOUT Record_FLOAT32_IEEE FNC_VALUES 1 FLOAT32_IEEE COLUMN_DIR DIRECT /end RECORD_LAYOUT
/begin RECORD_LAYOUT Axis_FLOAT32_IEEE AXIS_PTS_X 1 FLOAT32_IEEE INDEX_INCR DIRECT /end RECORD_LAYOUT
/end MODULE
/end PROJECT
