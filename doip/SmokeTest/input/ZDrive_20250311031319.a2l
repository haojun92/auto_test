ASAP2_VERSION 1 71
/begin PROJECT ProjectName ""
/begin MODULE ModuleName ""
/begin MOD_COMMON "" BYTE_ORDER MSB_LAST ALIGNMENT_BYTE 1 ALIGNMENT_WORD 1 ALIGNMENT_LONG 1 ALIGNMENT_INT64 1 ALIGNMENT_FLOAT16_IEEE 1 ALIGNMENT_FLOAT32_IEEE 1 ALIGNMENT_FLOAT64_IEEE 1 /end MOD_COMMON
/begin RECORD_LAYOUT __SWORD_Z FNC_VALUES 1 SWORD ROW_DIR DIRECT /end RECORD_LAYOUT
/begin MEASUREMENT autosar_swc_aeb_rtARID_DEF.ALatObj "" FLOAT32_IEEE autosar_swc_aeb_CM_single 0 0 -3.4E+38 3.4E+38 ECU_ADDRESS 0xfe4ab68c /* @ECU_Address@autosar_swc_aeb_rtARID_DEF.ALatObj@ */ /end MEASUREMENT
/begin MEASUREMENT autosar_swc_aeb_rtARID_DEF.ALatObj_p "" FLOAT32_IEEE autosar_swc_aeb_CM_single 0 0 -3.4E+38 3.4E+38 ECU_ADDRESS 0xfe4ab690 /* @ECU_Address@autosar_swc_aeb_rtARID_DEF.ALatObj_p@ */ /end MEASUREMENT
/begin MEASUREMENT autosar_swc_aeb_rtARID_DEF.ALatObj_p4 "" FLOAT32_IEEE autosar_swc_aeb_CM_single 0 0 -3.4E+38 3.4E+38 ECU_ADDRESS 0xfe4ab698 /* @ECU_Address@autosar_swc_aeb_rtARID_DEF.ALatObj_p4@ */ /end MEASUREMENT
/begin MEASUREMENT autosar_swc_aeb_rtARID_DEF.ALatObj_p41 "" FLOAT32_IEEE autosar_swc_aeb_CM_single 0 0 -3.4E+38 3.4E+38 ECU_ADDRESS 0xfe4ab708 /* @ECU_Address@autosar_swc_aeb_rtARID_DEF.ALatObj_p41@ */ /end MEASUREMENT
/begin MEASUREMENT autosar_swc_aeb_rtARID_DEF.ALgtObj "" FLOAT32_IEEE autosar_swc_aeb_CM_single 0 0 -3.4E+38 3.4E+38 ECU_ADDRESS 0xfe4ab680 /* @ECU_Address@autosar_swc_aeb_rtARID_DEF.ALgtObj@ */ /end MEASUREMENT
/begin MEASUREMENT autosar_swc_aeb_rtARID_DEF.ALgtObj_i "" FLOAT32_IEEE autosar_swc_aeb_CM_single 0 0 -3.4E+38 3.4E+38 ECU_ADDRESS 0xfe4ab684 /* @ECU_Address@autosar_swc_aeb_rtARID_DEF.ALgtObj_i@ */ /end MEASUREMENT
/begin MEASUREMENT autosar_swc_aeb_rtARID_DEF.ALgtObj_i5 "" FLOAT32_IEEE autosar_swc_aeb_CM_single 0 0 -3.4E+38 3.4E+38 ECU_ADDRESS 0xfe4ab688 /* @ECU_Address@autosar_swc_aeb_rtARID_DEF.ALgtObj_i5@ */ /end MEASUREMENT
/begin MEASUREMENT autosar_swc_aeb_rtARID_DEF.ALgtObj_i5c "" FLOAT32_IEEE autosar_swc_aeb_CM_single 0 0 -3.4E+38 3.4E+38 ECU_ADDRESS 0xfe4ab704 /* @ECU_Address@autosar_swc_aeb_rtARID_DEF.ALgtObj_i5c@ */ /end MEASUREMENT
/begin MEASUREMENT autosar_swc_aeb_rtARID_DEF.CrvtObj "" FLOAT32_IEEE autosar_swc_aeb_CM_single 0 0 -3.4E+38 3.4E+38 ECU_ADDRESS 0xfe4ab694 /* @ECU_Address@autosar_swc_aeb_rtARID_DEF.CrvtObj@ */ /end MEASUREMENT
/begin MEASUREMENT autosar_swc_aeb_rtARID_DEF.CrvtObj_a "" FLOAT32_IEEE autosar_swc_aeb_CM_single 0 0 -3.4E+38 3.4E+38 ECU_ADDRESS 0xfe4ab69c /* @ECU_Address@autosar_swc_aeb_rtARID_DEF.CrvtObj_a@ */ /end MEASUREMENT
/begin MEASUREMENT autosar_swc_aeb_rtARID_DEF.HeadingObj "" FLOAT32_IEEE autosar_swc_aeb_CM_single 0 0 -3.4E+38 3.4E+38 ECU_ADDRESS 0xfe4ab650 /* @ECU_Address@autosar_swc_aeb_rtARID_DEF.HeadingObj@ */ /end MEASUREMENT
/begin MEASUREMENT autosar_swc_aeb_rtARID_DEF.HeadingObj_h "" FLOAT32_IEEE autosar_swc_aeb_CM_single 0 0 -3.4E+38 3.4E+38 ECU_ADDRESS 0xfe4ab664 /* @ECU_Address@autosar_swc_aeb_rtARID_DEF.HeadingObj_h@ */ /end MEASUREMENT
/begin MEASUREMENT autosar_swc_aeb_rtARID_DEF.HeadingObj_hj "" FLOAT32_IEEE autosar_swc_aeb_CM_single 0 0 -3.4E+38 3.4E+38 ECU_ADDRESS 0xfe4ab670 /* @ECU_Address@autosar_swc_aeb_rtARID_DEF.HeadingObj_hj@ */ /end MEASUREMENT
/begin MEASUREMENT autosar_swc_aeb_rtARID_DEF.HeadingObj_hja "" FLOAT32_IEEE autosar_swc_aeb_CM_single 0 0 -3.4E+38 3.4E+38 ECU_ADDRESS 0xfe4ab67c /* @ECU_Address@autosar_swc_aeb_rtARID_DEF.HeadingObj_hja@ */ /end MEASUREMENT
/begin MEASUREMENT autosar_swc_aeb_rtARID_DEF.HeadingObj_hja3 "" FLOAT32_IEEE autosar_swc_aeb_CM_single 0 0 -3.4E+38 3.4E+38 ECU_ADDRESS 0xfe4ab700 /* @ECU_Address@autosar_swc_aeb_rtARID_DEF.HeadingObj_hja3@ */ /end MEASUREMENT
/begin MEASUREMENT autosar_swc_aeb_rtARID_DEF.LastSegment_g "" UBYTE autosar_swc_aeb_CM_uint8 0 0 0 255 ECU_ADDRESS 0xfe4aba4a /* @ECU_Address@autosar_swc_aeb_rtARID_DEF.LastSegment_g@ */ /end MEASUREMENT
/begin MEASUREMENT autosar_swc_aeb_rtARID_DEF.PosnLatObj "" FLOAT32_IEEE autosar_swc_aeb_CM_single 0 0 -3.4E+38 3.4E+38 ECU_ADDRESS 0xfe4ab64c /* @ECU_Address@autosar_swc_aeb_rtARID_DEF.PosnLatObj@ */ /end MEASUREMENT
/begin MEASUREMENT autosar_swc_aeb_rtARID_DEF.PosnLatObj_k "" FLOAT32_IEEE autosar_swc_aeb_CM_single 0 0 -3.4E+38 3.4E+38 ECU_ADDRESS 0xfe4ab660 /* @ECU_Address@autosar_swc_aeb_rtARID_DEF.PosnLatObj_k@ */ /end MEASUREMENT
/begin MEASUREMENT autosar_swc_aeb_rtARID_DEF.PosnLatObj_kr "" FLOAT32_IEEE autosar_swc_aeb_CM_single 0 0 -3.4E+38 3.4E+38 ECU_ADDRESS 0xfe4ab66c /* @ECU_Address@autosar_swc_aeb_rtARID_DEF.PosnLatObj_kr@ */ /end MEASUREMENT
/begin MEASUREMENT autosar_swc_aeb_rtARID_DEF.PosnLatObj_krk "" FLOAT32_IEEE autosar_swc_aeb_CM_single 0 0 -3.4E+38 3.4E+38 ECU_ADDRESS 0xfe4ab678 /* @ECU_Address@autosar_swc_aeb_rtARID_DEF.PosnLatObj_krk@ */ /end MEASUREMENT
/begin MEASUREMENT autosar_swc_aeb_rtARID_DEF.PosnLatObj_krkk "" FLOAT32_IEEE autosar_swc_aeb_CM_single 0 0 -3.4E+38 3.4E+38 ECU_ADDRESS 0xfe4ab6fc /* @ECU_Address@autosar_swc_aeb_rtARID_DEF.PosnLatObj_krkk@ */ /end MEASUREMENT
/begin MEASUREMENT autosar_swc_aeb_rtARID_DEF.PosnLgtObj "" FLOAT32_IEEE autosar_swc_aeb_CM_single 0 0 -3.4E+38 3.4E+38 ECU_ADDRESS 0xfe4ab648 /* @ECU_Address@autosar_swc_aeb_rtARID_DEF.PosnLgtObj@ */ /end MEASUREMENT
/begin MEASUREMENT autosar_swc_aeb_rtARID_DEF.PosnLgtObj_c "" FLOAT32_IEEE autosar_swc_aeb_CM_single 0 0 -3.4E+38 3.4E+38 ECU_ADDRESS 0xfe4ab65c /* @ECU_Address@autosar_swc_aeb_rtARID_DEF.PosnLgtObj_c@ */ /end MEASUREMENT
/begin MEASUREMENT autosar_swc_aeb_rtARID_DEF.PosnLgtObj_ck "" FLOAT32_IEEE autosar_swc_aeb_CM_single 0 0 -3.4E+38 3.4E+38 ECU_ADDRESS 0xfe4ab668 /* @ECU_Address@autosar_swc_aeb_rtARID_DEF.PosnLgtObj_ck@ */ /end MEASUREMENT
/begin MEASUREMENT autosar_swc_aeb_rtARID_DEF.PosnLgtObj_cki "" FLOAT32_IEEE autosar_swc_aeb_CM_single 0 0 -3.4E+38 3.4E+38 ECU_ADDRESS 0xfe4ab674 /* @ECU_Address@autosar_swc_aeb_rtARID_DEF.PosnLgtObj_cki@ */ /end MEASUREMENT
/begin MEASUREMENT autosar_swc_aeb_rtARID_DEF.PosnLgtObj_cki3 "" FLOAT32_IEEE autosar_swc_aeb_CM_single 0 0 -3.4E+38 3.4E+38 ECU_ADDRESS 0xfe4ab6f8 /* @ECU_Address@autosar_swc_aeb_rtARID_DEF.PosnLgtObj_cki3@ */ /end MEASUREMENT
/begin MEASUREMENT autosar_swc_aeb_rtARID_DEF.VLatObj "" FLOAT32_IEEE autosar_swc_aeb_CM_single 0 0 -3.4E+38 3.4E+38 ECU_ADDRESS 0xfe4ab658 /* @ECU_Address@autosar_swc_aeb_rtARID_DEF.VLatObj@ */ /end MEASUREMENT
/begin MEASUREMENT autosar_swc_aeb_rtARID_DEF.VLatObj_b "" FLOAT32_IEEE autosar_swc_aeb_CM_single 0 0 -3.4E+38 3.4E+38 ECU_ADDRESS 0xfe4ab744 /* @ECU_Address@autosar_swc_aeb_rtARID_DEF.VLatObj_b@ */ /end MEASUREMENT
/begin MEASUREMENT autosar_swc_aeb_rtARID_DEF.VLatObj_bm "" FLOAT32_IEEE autosar_swc_aeb_CM_single 0 0 -3.4E+38 3.4E+38 ECU_ADDRESS 0xfe4ab74c /* @ECU_Address@autosar_swc_aeb_rtARID_DEF.VLatObj_bm@ */ /end MEASUREMENT
/begin MEASUREMENT autosar_swc_aeb_rtARID_DEF.VLatObj_bmz "" FLOAT32_IEEE autosar_swc_aeb_CM_single 0 0 -3.4E+38 3.4E+38 ECU_ADDRESS 0xfe4ab754 /* @ECU_Address@autosar_swc_aeb_rtARID_DEF.VLatObj_bmz@ */ /end MEASUREMENT
/begin MEASUREMENT autosar_swc_aeb_rtARID_DEF.VLatObj_bmzl "" FLOAT32_IEEE autosar_swc_aeb_CM_single 0 0 -3.4E+38 3.4E+38 ECU_ADDRESS 0xfe4ab75c /* @ECU_Address@autosar_swc_aeb_rtARID_DEF.VLatObj_bmzl@ */ /end MEASUREMENT
/begin MEASUREMENT autosar_swc_aeb_rtARID_DEF.VLgtObj "" FLOAT32_IEEE autosar_swc_aeb_CM_single 0 0 -3.4E+38 3.4E+38 ECU_ADDRESS 0xfe4ab654 /* @ECU_Address@autosar_swc_aeb_rtARID_DEF.VLgtObj@ */ /end MEASUREMENT
/begin MEASUREMENT autosar_swc_aeb_rtARID_DEF.VLgtObj_g "" FLOAT32_IEEE autosar_swc_aeb_CM_single 0 0 -3.4E+38 3.4E+38 ECU_ADDRESS 0xfe4ab740 /* @ECU_Address@autosar_swc_aeb_rtARID_DEF.VLgtObj_g@ */ /end MEASUREMENT
/begin MEASUREMENT autosar_swc_aeb_rtARID_DEF.VLgtObj_gh "" FLOAT32_IEEE autosar_swc_aeb_CM_single 0 0 -3.4E+38 3.4E+38 ECU_ADDRESS 0xfe4ab748 /* @ECU_Address@autosar_swc_aeb_rtARID_DEF.VLgtObj_gh@ */ /end MEASUREMENT
/begin MEASUREMENT autosar_swc_aeb_rtARID_DEF.VLgtObj_gh1 "" FLOAT32_IEEE autosar_swc_aeb_CM_single 0 0 -3.4E+38 3.4E+38 ECU_ADDRESS 0xfe4ab750 /* @ECU_Address@autosar_swc_aeb_rtARID_DEF.VLgtObj_gh1@ */ /end MEASUREMENT
/begin MEASUREMENT autosar_swc_aeb_rtARID_DEF.VLgtObj_gh1e "" FLOAT32_IEEE autosar_swc_aeb_CM_single 0 0 -3.4E+38 3.4E+38 ECU_ADDRESS 0xfe4ab758 /* @ECU_Address@autosar_swc_aeb_rtARID_DEF.VLgtObj_gh1e@ */ /end MEASUREMENT
/begin COMPU_METHOD autosar_swc_aeb_CM_single "Q = V" IDENTICAL "%8.6" "" /end COMPU_METHOD
/begin COMPU_METHOD autosar_swc_aeb_CM_uint8 "Q = V" IDENTICAL "%3.0" "" /end COMPU_METHOD
/begin GROUP autosar_swc_aeb_autosar_swc_aeb_Step_sys_Subsystem_Reference_AEB_Function_Run_AsyEvlrCritEve_Step_Func_Run_AsyEvlrCritEve_Step_Func_TAWrapper_PreProcessor_ObjectPreProcessor_ObjectPreProcessorLoop_ValidObject_SafetyMarginFrontObjects_InPathCalculationWithPredictedObjPositions_CreateInPathDataTTR "autosar_swc_aeb/autosar_swc_aeb_Step_sys/Subsystem Reference/AEB Function/Run_AsyEvlrCritEve_Step_Func/Run_AsyEvlrCritEve_Step_Func/TAWrapper/PreProcessor/ObjectPreProcessor/ObjectPreProcessorLoop/ValidObject/SafetyMarginFrontObjects/InPathCalculationWithPredictedObjPositions/CreateInPathDataTTR"
 /begin SUB_GROUP autosar_swc_aeb_autosar_swc_aeb_Step_sys_Subsystem_Reference_AEB_Function_Run_AsyEvlrCritEve_Step_Func_Run_AsyEvlrCritEve_Step_Func_TAWrapper_PreProcessor_ObjectPreProcessor_ObjectPreProcessorLoop_ValidObject_SafetyMarginFrontObjects_InPathCalculationWithPredictedObjPositions_CreateInPathDataTTR_CalculateAccelerationAndPredictPosition autosar_swc_aeb_autosar_swc_aeb_Step_sys_Subsystem_Reference_AEB_Function_Run_AsyEvlrCritEve_Step_Func_Run_AsyEvlrCritEve_Step_Func_TAWrapper_PreProcessor_ObjectPreProcessor_ObjectPreProcessorLoop_ValidObject_SafetyMarginFrontObjects_InPathCalculationWithPredictedObjPositions_CreateInPathDataTTR_CheckBrakingAndSteering autosar_swc_aeb_autosar_swc_aeb_Step_sys_Subsystem_Reference_AEB_Function_Run_AsyEvlrCritEve_Step_Func_Run_AsyEvlrCritEve_Step_Func_TAWrapper_PreProcessor_ObjectPreProcessor_ObjectPreProcessorLoop_ValidObject_SafetyMarginFrontObjects_InPathCalculationWithPredictedObjPositions_CreateInPathDataTTR_CreateInPathData autosar_swc_aeb_autosar_swc_aeb_Step_sys_Subsystem_Reference_AEB_Function_Run_AsyEvlrCritEve_Step_Func_Run_AsyEvlrCritEve_Step_Func_TAWrapper_PreProcessor_ObjectPreProcessor_ObjectPreProcessorLoop_ValidObject_SafetyMarginFrontObjects_InPathCalculationWithPredictedObjPositions_CreateInPathDataTTR_RelativePositionAtTTR autosar_swc_aeb_autosar_swc_aeb_Step_sys_Subsystem_Reference_AEB_Function_Run_AsyEvlrCritEve_Step_Func_Run_AsyEvlrCritEve_Step_Func_TAWrapper_PreProcessor_ObjectPreProcessor_ObjectPreProcessorLoop_ValidObject_SafetyMarginFrontObjects_InPathCalculationWithPredictedObjPositions_CreateInPathDataTTR_ToDiag /end SUB_GROUP
 /begin REF_MEASUREMENT autosar_swc_aeb_rtARID_DEF.HeadingObj autosar_swc_aeb_rtARID_DEF.HeadingObj_h autosar_swc_aeb_rtARID_DEF.HeadingObj_hj autosar_swc_aeb_rtARID_DEF.HeadingObj_hja autosar_swc_aeb_rtARID_DEF.HeadingObj_hja3 autosar_swc_aeb_rtARID_DEF.PosnLatObj autosar_swc_aeb_rtARID_DEF.PosnLatObj_k autosar_swc_aeb_rtARID_DEF.PosnLatObj_kr autosar_swc_aeb_rtARID_DEF.PosnLatObj_krk autosar_swc_aeb_rtARID_DEF.PosnLatObj_krkk autosar_swc_aeb_rtARID_DEF.PosnLgtObj autosar_swc_aeb_rtARID_DEF.PosnLgtObj_c autosar_swc_aeb_rtARID_DEF.PosnLgtObj_ck autosar_swc_aeb_rtARID_DEF.PosnLgtObj_cki autosar_swc_aeb_rtARID_DEF.PosnLgtObj_cki3 /end REF_MEASUREMENT
/end GROUP
/begin GROUP autosar_swc_aeb_autosar_swc_aeb_Step_sys_Subsystem_Reference_AEB_Function_Run_AsyEvlrCritEve_Step_Func_Run_AsyEvlrCritEve_Step_Func_TAWrapper_PreProcessor_ObjectPreProcessor_ObjectPreProcessorLoop_ValidObject_SafetyMarginFrontObjects_InPathCalculationWithPredictedObjPositions_CreateInPathDataTTR_CalculateAccelerationAndPredictPosition "autosar_swc_aeb/autosar_swc_aeb_Step_sys/Subsystem Reference/AEB Function/Run_AsyEvlrCritEve_Step_Func/Run_AsyEvlrCritEve_Step_Func/TAWrapper/PreProcessor/ObjectPreProcessor/ObjectPreProcessorLoop/ValidObject/SafetyMarginFrontObjects/InPathCalculationWithPredictedObjPositions/CreateInPathDataTTR/CalculateAccelerationAndPredictPosition"
 /begin SUB_GROUP autosar_swc_aeb_autosar_swc_aeb_Step_sys_Subsystem_Reference_AEB_Function_Run_AsyEvlrCritEve_Step_Func_Run_AsyEvlrCritEve_Step_Func_TAWrapper_PreProcessor_ObjectPreProcessor_ObjectPreProcessorLoop_ValidObject_SafetyMarginFrontObjects_InPathCalculationWithPredictedObjPositions_CreateInPathDataTTR_CalculateAccelerationAndPredictPosition_CircularPrediction autosar_swc_aeb_autosar_swc_aeb_Step_sys_Subsystem_Reference_AEB_Function_Run_AsyEvlrCritEve_Step_Func_Run_AsyEvlrCritEve_Step_Func_TAWrapper_PreProcessor_ObjectPreProcessor_ObjectPreProcessorLoop_ValidObject_SafetyMarginFrontObjects_InPathCalculationWithPredictedObjPositions_CreateInPathDataTTR_CalculateAccelerationAndPredictPosition_LinearPrediction autosar_swc_aeb_autosar_swc_aeb_Step_sys_Subsystem_Reference_AEB_Function_Run_AsyEvlrCritEve_Step_Func_Run_AsyEvlrCritEve_Step_Func_TAWrapper_PreProcessor_ObjectPreProcessor_ObjectPreProcessorLoop_ValidObject_SafetyMarginFrontObjects_InPathCalculationWithPredictedObjPositions_CreateInPathDataTTR_CalculateAccelerationAndPredictPosition_NoPrediction autosar_swc_aeb_autosar_swc_aeb_Step_sys_Subsystem_Reference_AEB_Function_Run_AsyEvlrCritEve_Step_Func_Run_AsyEvlrCritEve_Step_Func_TAWrapper_PreProcessor_ObjectPreProcessor_ObjectPreProcessorLoop_ValidObject_SafetyMarginFrontObjects_InPathCalculationWithPredictedObjPositions_CreateInPathDataTTR_CalculateAccelerationAndPredictPosition_PredictHostLateralPositionAtTTR /end SUB_GROUP
/end GROUP
/begin GROUP autosar_swc_aeb_autosar_swc_aeb_Step_sys_Subsystem_Reference_AEB_Function_Run_AsyEvlrCritEve_Step_Func_Run_AsyEvlrCritEve_Step_Func_TAWrapper_PreProcessor_ObjectPreProcessor_ObjectPreProcessorLoop_ValidObject_SafetyMarginFrontObjects_InPathCalculationWithPredictedObjPositions_CreateInPathDataTTR_CalculateAccelerationAndPredictPosition_CircularPrediction "autosar_swc_aeb/autosar_swc_aeb_Step_sys/Subsystem Reference/AEB Function/Run_AsyEvlrCritEve_Step_Func/Run_AsyEvlrCritEve_Step_Func/TAWrapper/PreProcessor/ObjectPreProcessor/ObjectPreProcessorLoop/ValidObject/SafetyMarginFrontObjects/InPathCalculationWithPredictedObjPositions/CreateInPathDataTTR/CalculateAccelerationAndPredictPosition/CircularPrediction"
 /begin SUB_GROUP autosar_swc_aeb_autosar_swc_aeb_Step_sys_Subsystem_Reference_AEB_Function_Run_AsyEvlrCritEve_Step_Func_Run_AsyEvlrCritEve_Step_Func_TAWrapper_PreProcessor_ObjectPreProcessor_ObjectPreProcessorLoop_ValidObject_SafetyMarginFrontObjects_InPathCalculationWithPredictedObjPositions_CreateInPathDataTTR_CalculateAccelerationAndPredictPosition_CircularPrediction_AccelerationCalculationAndCircularPredictionOfBrakingObjAtTTR autosar_swc_aeb_autosar_swc_aeb_Step_sys_Subsystem_Reference_AEB_Function_Run_AsyEvlrCritEve_Step_Func_Run_AsyEvlrCritEve_Step_Func_TAWrapper_PreProcessor_ObjectPreProcessor_ObjectPreProcessorLoop_ValidObject_SafetyMarginFrontObjects_InPathCalculationWithPredictedObjPositions_CreateInPathDataTTR_CalculateAccelerationAndPredictPosition_CircularPrediction_AccelerationCalculationAndCircularPredictionOfBrakingObjAtTTR1 autosar_swc_aeb_autosar_swc_aeb_Step_sys_Subsystem_Reference_AEB_Function_Run_AsyEvlrCritEve_Step_Func_Run_AsyEvlrCritEve_Step_Func_TAWrapper_PreProcessor_ObjectPreProcessor_ObjectPreProcessorLoop_ValidObject_SafetyMarginFrontObjects_InPathCalculationWithPredictedObjPositions_CreateInPathDataTTR_CalculateAccelerationAndPredictPosition_CircularPrediction_AccelerationCalculationAndCircularPredictionOfTurningObjAtTTR autosar_swc_aeb_autosar_swc_aeb_Step_sys_Subsystem_Reference_AEB_Function_Run_AsyEvlrCritEve_Step_Func_Run_AsyEvlrCritEve_Step_Func_TAWrapper_PreProcessor_ObjectPreProcessor_ObjectPreProcessorLoop_ValidObject_SafetyMarginFrontObjects_InPathCalculationWithPredictedObjPositions_CreateInPathDataTTR_CalculateAccelerationAndPredictPosition_CircularPrediction_AccelerationCalculationAndCircularPredictionOfTurningObjAtTTR1 autosar_swc_aeb_autosar_swc_aeb_Step_sys_Subsystem_Reference_AEB_Function_Run_AsyEvlrCritEve_Step_Func_Run_AsyEvlrCritEve_Step_Func_TAWrapper_PreProcessor_ObjectPreProcessor_ObjectPreProcessorLoop_ValidObject_SafetyMarginFrontObjects_InPathCalculationWithPredictedObjPositions_CreateInPathDataTTR_CalculateAccelerationAndPredictPosition_CircularPrediction_CircularPredictionOfObjAtTTR /end SUB_GROUP
/end GROUP
/begin GROUP autosar_swc_aeb_autosar_swc_aeb_Step_sys_Subsystem_Reference_AEB_Function_Run_AsyEvlrCritEve_Step_Func_Run_AsyEvlrCritEve_Step_Func_TAWrapper_PreProcessor_ObjectPreProcessor_ObjectPreProcessorLoop_ValidObject_SafetyMarginFrontObjects_InPathCalculationWithPredictedObjPositions_CreateInPathDataTTR_CalculateAccelerationAndPredictPosition_CircularPrediction_AccelerationCalculationAndCircularPredictionOfBrakingObjAtTTR "autosar_swc_aeb/autosar_swc_aeb_Step_sys/Subsystem Reference/AEB Function/Run_AsyEvlrCritEve_Step_Func/Run_AsyEvlrCritEve_Step_Func/TAWrapper/PreProcessor/ObjectPreProcessor/ObjectPreProcessorLoop/ValidObject/SafetyMarginFrontObjects/InPathCalculationWithPredictedObjPositions/CreateInPathDataTTR/CalculateAccelerationAndPredictPosition/CircularPrediction/AccelerationCalculationAndCircularPredictionOfBrakingObjAtTTR"
 /begin SUB_GROUP autosar_swc_aeb_autosar_swc_aeb_Step_sys_Subsystem_Reference_AEB_Function_Run_AsyEvlrCritEve_Step_Func_Run_AsyEvlrCritEve_Step_Func_TAWrapper_PreProcessor_ObjectPreProcessor_ObjectPreProcessorLoop_ValidObject_SafetyMarginFrontObjects_InPathCalculationWithPredictedObjPositions_CreateInPathDataTTR_CalculateAccelerationAndPredictPosition_CircularPrediction_AccelerationCalculationAndCircularPredictionOfBrakingObjAtTTR_ComputeCartesianMovement autosar_swc_aeb_autosar_swc_aeb_Step_sys_Subsystem_Reference_AEB_Function_Run_AsyEvlrCritEve_Step_Func_Run_AsyEvlrCritEve_Step_Func_TAWrapper_PreProcessor_ObjectPreProcessor_ObjectPreProcessorLoop_ValidObject_SafetyMarginFrontObjects_InPathCalculationWithPredictedObjPositions_CreateInPathDataTTR_CalculateAccelerationAndPredictPosition_CircularPrediction_AccelerationCalculationAndCircularPredictionOfBrakingObjAtTTR_NoOperation autosar_swc_aeb_autosar_swc_aeb_Step_sys_Subsystem_Reference_AEB_Function_Run_AsyEvlrCritEve_Step_Func_Run_AsyEvlrCritEve_Step_Func_TAWrapper_PreProcessor_ObjectPreProcessor_ObjectPreProcessorLoop_ValidObject_SafetyMarginFrontObjects_InPathCalculationWithPredictedObjPositions_CreateInPathDataTTR_CalculateAccelerationAndPredictPosition_CircularPrediction_AccelerationCalculationAndCircularPredictionOfBrakingObjAtTTR_PredictedPositionAtTimeHeadingAngleAndCurvatureBased /end SUB_GROUP
 /begin REF_MEASUREMENT autosar_swc_aeb_rtARID_DEF.VLatObj_bmzl autosar_swc_aeb_rtARID_DEF.VLgtObj_gh1e /end REF_MEASUREMENT
/end GROUP
/begin GROUP autosar_swc_aeb_autosar_swc_aeb_Step_sys_Subsystem_Reference_AEB_Function_Run_AsyEvlrCritEve_Step_Func_Run_AsyEvlrCritEve_Step_Func_TAWrapper_PreProcessor_ObjectPreProcessor_ObjectPreProcessorLoop_ValidObject_SafetyMarginFrontObjects_InPathCalculationWithPredictedObjPositions_CreateInPathDataTTR_CalculateAccelerationAndPredictPosition_CircularPrediction_AccelerationCalculationAndCircularPredictionOfBrakingObjAtTTR1 "autosar_swc_aeb/autosar_swc_aeb_Step_sys/Subsystem Reference/AEB Function/Run_AsyEvlrCritEve_Step_Func/Run_AsyEvlrCritEve_Step_Func/TAWrapper/PreProcessor/ObjectPreProcessor/ObjectPreProcessorLoop/ValidObject/SafetyMarginFrontObjects/InPathCalculationWithPredictedObjPositions/CreateInPathDataTTR/CalculateAccelerationAndPredictPosition/CircularPrediction/AccelerationCalculationAndCircularPredictionOfBrakingObjAtTTR1"
 /begin SUB_GROUP autosar_swc_aeb_autosar_swc_aeb_Step_sys_Subsystem_Reference_AEB_Function_Run_AsyEvlrCritEve_Step_Func_Run_AsyEvlrCritEve_Step_Func_TAWrapper_PreProcessor_ObjectPreProcessor_ObjectPreProcessorLoop_ValidObject_SafetyMarginFrontObjects_InPathCalculationWithPredictedObjPositions_CreateInPathDataTTR_CalculateAccelerationAndPredictPosition_CircularPrediction_AccelerationCalculationAndCircularPredictionOfBrakingObjAtTTR1_ComputeCartesianMovement autosar_swc_aeb_autosar_swc_aeb_Step_sys_Subsystem_Reference_AEB_Function_Run_AsyEvlrCritEve_Step_Func_Run_AsyEvlrCritEve_Step_Func_TAWrapper_PreProcessor_ObjectPreProcessor_ObjectPreProcessorLoop_ValidObject_SafetyMarginFrontObjects_InPathCalculationWithPredictedObjPositions_CreateInPathDataTTR_CalculateAccelerationAndPredictPosition_CircularPrediction_AccelerationCalculationAndCircularPredictionOfBrakingObjAtTTR1_NoOperation autosar_swc_aeb_autosar_swc_aeb_Step_sys_Subsystem_Reference_AEB_Function_Run_AsyEvlrCritEve_Step_Func_Run_AsyEvlrCritEve_Step_Func_TAWrapper_PreProcessor_ObjectPreProcessor_ObjectPreProcessorLoop_ValidObject_SafetyMarginFrontObjects_InPathCalculationWithPredictedObjPositions_CreateInPathDataTTR_CalculateAccelerationAndPredictPosition_CircularPrediction_AccelerationCalculationAndCircularPredictionOfBrakingObjAtTTR1_PredictedPositionAtTimeHeadingAngleAndCurvatureBased /end SUB_GROUP
 /begin REF_MEASUREMENT autosar_swc_aeb_rtARID_DEF.VLatObj_b autosar_swc_aeb_rtARID_DEF.VLgtObj_g /end REF_MEASUREMENT
/end GROUP
/begin GROUP autosar_swc_aeb_autosar_swc_aeb_Step_sys_Subsystem_Reference_AEB_Function_Run_AsyEvlrCritEve_Step_Func_Run_AsyEvlrCritEve_Step_Func_TAWrapper_PreProcessor_ObjectPreProcessor_ObjectPreProcessorLoop_ValidObject_SafetyMarginFrontObjects_InPathCalculationWithPredictedObjPositions_CreateInPathDataTTR_CalculateAccelerationAndPredictPosition_CircularPrediction_AccelerationCalculationAndCircularPredictionOfBrakingObjAtTTR1_ComputeCartesianMovement "autosar_swc_aeb/autosar_swc_aeb_Step_sys/Subsystem Reference/AEB Function/Run_AsyEvlrCritEve_Step_Func/Run_AsyEvlrCritEve_Step_Func/TAWrapper/PreProcessor/ObjectPreProcessor/ObjectPreProcessorLoop/ValidObject/SafetyMarginFrontObjects/InPathCalculationWithPredictedObjPositions/CreateInPathDataTTR/CalculateAccelerationAndPredictPosition/CircularPrediction/AccelerationCalculationAndCircularPredictionOfBrakingObjAtTTR1/ComputeCartesianMovement"
 /begin REF_MEASUREMENT autosar_swc_aeb_rtARID_DEF.ALatObj_p41 autosar_swc_aeb_rtARID_DEF.ALgtObj_i5c /end REF_MEASUREMENT
/end GROUP
/begin GROUP autosar_swc_aeb_autosar_swc_aeb_Step_sys_Subsystem_Reference_AEB_Function_Run_AsyEvlrCritEve_Step_Func_Run_AsyEvlrCritEve_Step_Func_TAWrapper_PreProcessor_ObjectPreProcessor_ObjectPreProcessorLoop_ValidObject_SafetyMarginFrontObjects_InPathCalculationWithPredictedObjPositions_CreateInPathDataTTR_CalculateAccelerationAndPredictPosition_CircularPrediction_AccelerationCalculationAndCircularPredictionOfBrakingObjAtTTR1_NoOperation "autosar_swc_aeb/autosar_swc_aeb_Step_sys/Subsystem Reference/AEB Function/Run_AsyEvlrCritEve_Step_Func/Run_AsyEvlrCritEve_Step_Func/TAWrapper/PreProcessor/ObjectPreProcessor/ObjectPreProcessorLoop/ValidObject/SafetyMarginFrontObjects/InPathCalculationWithPredictedObjPositions/CreateInPathDataTTR/CalculateAccelerationAndPredictPosition/CircularPrediction/AccelerationCalculationAndCircularPredictionOfBrakingObjAtTTR1/NoOperation" /begin REF_MEASUREMENT autosar_swc_aeb_rtARID_DEF.HeadingObj_hja3 /end REF_MEASUREMENT /end GROUP
/begin GROUP autosar_swc_aeb_autosar_swc_aeb_Step_sys_Subsystem_Reference_AEB_Function_Run_AsyEvlrCritEve_Step_Func_Run_AsyEvlrCritEve_Step_Func_TAWrapper_PreProcessor_ObjectPreProcessor_ObjectPreProcessorLoop_ValidObject_SafetyMarginFrontObjects_InPathCalculationWithPredictedObjPositions_CreateInPathDataTTR_CalculateAccelerationAndPredictPosition_CircularPrediction_AccelerationCalculationAndCircularPredictionOfBrakingObjAtTTR1_PredictedPositionAtTimeHeadingAngleAndCurvatureBased "autosar_swc_aeb/autosar_swc_aeb_Step_sys/Subsystem Reference/AEB Function/Run_AsyEvlrCritEve_Step_Func/Run_AsyEvlrCritEve_Step_Func/TAWrapper/PreProcessor/ObjectPreProcessor/ObjectPreProcessorLoop/ValidObject/SafetyMarginFrontObjects/InPathCalculationWithPredictedObjPositions/CreateInPathDataTTR/CalculateAccelerationAndPredictPosition/CircularPrediction/AccelerationCalculationAndCircularPredictionOfBrakingObjAtTTR1/PredictedPositionAtTimeHeadingAngleAndCurvatureBased"
 /begin REF_MEASUREMENT autosar_swc_aeb_rtARID_DEF.PosnLatObj_krkk autosar_swc_aeb_rtARID_DEF.PosnLgtObj_cki3 /end REF_MEASUREMENT
/end GROUP
/begin GROUP autosar_swc_aeb_autosar_swc_aeb_Step_sys_Subsystem_Reference_AEB_Function_Run_AsyEvlrCritEve_Step_Func_Run_AsyEvlrCritEve_Step_Func_TAWrapper_PreProcessor_ObjectPreProcessor_ObjectPreProcessorLoop_ValidObject_SafetyMarginFrontObjects_InPathCalculationWithPredictedObjPositions_CreateInPathDataTTR_CalculateAccelerationAndPredictPosition_CircularPrediction_AccelerationCalculationAndCircularPredictionOfBrakingObjAtTTR_ComputeCartesianMovement "autosar_swc_aeb/autosar_swc_aeb_Step_sys/Subsystem Reference/AEB Function/Run_AsyEvlrCritEve_Step_Func/Run_AsyEvlrCritEve_Step_Func/TAWrapper/PreProcessor/ObjectPreProcessor/ObjectPreProcessorLoop/ValidObject/SafetyMarginFrontObjects/InPathCalculationWithPredictedObjPositions/CreateInPathDataTTR/CalculateAccelerationAndPredictPosition/CircularPrediction/AccelerationCalculationAndCircularPredictionOfBrakingObjAtTTR/ComputeCartesianMovement"
 /begin REF_MEASUREMENT autosar_swc_aeb_rtARID_DEF.ALatObj autosar_swc_aeb_rtARID_DEF.ALgtObj /end REF_MEASUREMENT
/end GROUP
/begin GROUP autosar_swc_aeb_autosar_swc_aeb_Step_sys_Subsystem_Reference_AEB_Function_Run_AsyEvlrCritEve_Step_Func_Run_AsyEvlrCritEve_Step_Func_TAWrapper_PreProcessor_ObjectPreProcessor_ObjectPreProcessorLoop_ValidObject_SafetyMarginFrontObjects_InPathCalculationWithPredictedObjPositions_CreateInPathDataTTR_CalculateAccelerationAndPredictPosition_CircularPrediction_AccelerationCalculationAndCircularPredictionOfBrakingObjAtTTR_NoOperation "autosar_swc_aeb/autosar_swc_aeb_Step_sys/Subsystem Reference/AEB Function/Run_AsyEvlrCritEve_Step_Func/Run_AsyEvlrCritEve_Step_Func/TAWrapper/PreProcessor/ObjectPreProcessor/ObjectPreProcessorLoop/ValidObject/SafetyMarginFrontObjects/InPathCalculationWithPredictedObjPositions/CreateInPathDataTTR/CalculateAccelerationAndPredictPosition/CircularPrediction/AccelerationCalculationAndCircularPredictionOfBrakingObjAtTTR/NoOperation" /begin REF_MEASUREMENT autosar_swc_aeb_rtARID_DEF.HeadingObj_h /end REF_MEASUREMENT /end GROUP
/begin GROUP autosar_swc_aeb_autosar_swc_aeb_Step_sys_Subsystem_Reference_AEB_Function_Run_AsyEvlrCritEve_Step_Func_Run_AsyEvlrCritEve_Step_Func_TAWrapper_PreProcessor_ObjectPreProcessor_ObjectPreProcessorLoop_ValidObject_SafetyMarginFrontObjects_InPathCalculationWithPredictedObjPositions_CreateInPathDataTTR_CalculateAccelerationAndPredictPosition_CircularPrediction_AccelerationCalculationAndCircularPredictionOfBrakingObjAtTTR_PredictedPositionAtTimeHeadingAngleAndCurvatureBased "autosar_swc_aeb/autosar_swc_aeb_Step_sys/Subsystem Reference/AEB Function/Run_AsyEvlrCritEve_Step_Func/Run_AsyEvlrCritEve_Step_Func/TAWrapper/PreProcessor/ObjectPreProcessor/ObjectPreProcessorLoop/ValidObject/SafetyMarginFrontObjects/InPathCalculationWithPredictedObjPositions/CreateInPathDataTTR/CalculateAccelerationAndPredictPosition/CircularPrediction/AccelerationCalculationAndCircularPredictionOfBrakingObjAtTTR/PredictedPositionAtTimeHeadingAngleAndCurvatureBased"
 /begin REF_MEASUREMENT autosar_swc_aeb_rtARID_DEF.PosnLatObj_k autosar_swc_aeb_rtARID_DEF.PosnLgtObj_c /end REF_MEASUREMENT
/end GROUP
/begin GROUP autosar_swc_aeb_autosar_swc_aeb_Step_sys_Subsystem_Reference_AEB_Function_Run_AsyEvlrCritEve_Step_Func_Run_AsyEvlrCritEve_Step_Func_TAWrapper_PreProcessor_ObjectPreProcessor_ObjectPreProcessorLoop_ValidObject_SafetyMarginFrontObjects_InPathCalculationWithPredictedObjPositions_CreateInPathDataTTR_CalculateAccelerationAndPredictPosition_CircularPrediction_AccelerationCalculationAndCircularPredictionOfTurningObjAtTTR "autosar_swc_aeb/autosar_swc_aeb_Step_sys/Subsystem Reference/AEB Function/Run_AsyEvlrCritEve_Step_Func/Run_AsyEvlrCritEve_Step_Func/TAWrapper/PreProcessor/ObjectPreProcessor/ObjectPreProcessorLoop/ValidObject/SafetyMarginFrontObjects/InPathCalculationWithPredictedObjPositions/CreateInPathDataTTR/CalculateAccelerationAndPredictPosition/CircularPrediction/AccelerationCalculationAndCircularPredictionOfTurningObjAtTTR"
 /begin SUB_GROUP autosar_swc_aeb_autosar_swc_aeb_Step_sys_Subsystem_Reference_AEB_Function_Run_AsyEvlrCritEve_Step_Func_Run_AsyEvlrCritEve_Step_Func_TAWrapper_PreProcessor_ObjectPreProcessor_ObjectPreProcessorLoop_ValidObject_SafetyMarginFrontObjects_InPathCalculationWithPredictedObjPositions_CreateInPathDataTTR_CalculateAccelerationAndPredictPosition_CircularPrediction_AccelerationCalculationAndCircularPredictionOfTurningObjAtTTR_CalculateCurvature autosar_swc_aeb_autosar_swc_aeb_Step_sys_Subsystem_Reference_AEB_Function_Run_AsyEvlrCritEve_Step_Func_Run_AsyEvlrCritEve_Step_Func_TAWrapper_PreProcessor_ObjectPreProcessor_ObjectPreProcessorLoop_ValidObject_SafetyMarginFrontObjects_InPathCalculationWithPredictedObjPositions_CreateInPathDataTTR_CalculateAccelerationAndPredictPosition_CircularPrediction_AccelerationCalculationAndCircularPredictionOfTurningObjAtTTR_ComputeCartesianMovement autosar_swc_aeb_autosar_swc_aeb_Step_sys_Subsystem_Reference_AEB_Function_Run_AsyEvlrCritEve_Step_Func_Run_AsyEvlrCritEve_Step_Func_TAWrapper_PreProcessor_ObjectPreProcessor_ObjectPreProcessorLoop_ValidObject_SafetyMarginFrontObjects_InPathCalculationWithPredictedObjPositions_CreateInPathDataTTR_CalculateAccelerationAndPredictPosition_CircularPrediction_AccelerationCalculationAndCircularPredictionOfTurningObjAtTTR_NoOperation autosar_swc_aeb_autosar_swc_aeb_Step_sys_Subsystem_Reference_AEB_Function_Run_AsyEvlrCritEve_Step_Func_Run_AsyEvlrCritEve_Step_Func_TAWrapper_PreProcessor_ObjectPreProcessor_ObjectPreProcessorLoop_ValidObject_SafetyMarginFrontObjects_InPathCalculationWithPredictedObjPositions_CreateInPathDataTTR_CalculateAccelerationAndPredictPosition_CircularPrediction_AccelerationCalculationAndCircularPredictionOfTurningObjAtTTR_NoOperation1 autosar_swc_aeb_autosar_swc_aeb_Step_sys_Subsystem_Reference_AEB_Function_Run_AsyEvlrCritEve_Step_Func_Run_AsyEvlrCritEve_Step_Func_TAWrapper_PreProcessor_ObjectPreProcessor_ObjectPreProcessorLoop_ValidObject_SafetyMarginFrontObjects_InPathCalculationWithPredictedObjPositions_CreateInPathDataTTR_CalculateAccelerationAndPredictPosition_CircularPrediction_AccelerationCalculationAndCircularPredictionOfTurningObjAtTTR_PredictedPositionAtTimeHeadingAngleAndCurvatureBased /end SUB_GROUP
 /begin REF_MEASUREMENT autosar_swc_aeb_rtARID_DEF.VLatObj_bm autosar_swc_aeb_rtARID_DEF.VLgtObj_gh /end REF_MEASUREMENT
/end GROUP
/begin GROUP autosar_swc_aeb_autosar_swc_aeb_Step_sys_Subsystem_Reference_AEB_Function_Run_AsyEvlrCritEve_Step_Func_Run_AsyEvlrCritEve_Step_Func_TAWrapper_PreProcessor_ObjectPreProcessor_ObjectPreProcessorLoop_ValidObject_SafetyMarginFrontObjects_InPathCalculationWithPredictedObjPositions_CreateInPathDataTTR_CalculateAccelerationAndPredictPosition_CircularPrediction_AccelerationCalculationAndCircularPredictionOfTurningObjAtTTR1 "autosar_swc_aeb/autosar_swc_aeb_Step_sys/Subsystem Reference/AEB Function/Run_AsyEvlrCritEve_Step_Func/Run_AsyEvlrCritEve_Step_Func/TAWrapper/PreProcessor/ObjectPreProcessor/ObjectPreProcessorLoop/ValidObject/SafetyMarginFrontObjects/InPathCalculationWithPredictedObjPositions/CreateInPathDataTTR/CalculateAccelerationAndPredictPosition/CircularPrediction/AccelerationCalculationAndCircularPredictionOfTurningObjAtTTR1"
 /begin SUB_GROUP autosar_swc_aeb_autosar_swc_aeb_Step_sys_Subsystem_Reference_AEB_Function_Run_AsyEvlrCritEve_Step_Func_Run_AsyEvlrCritEve_Step_Func_TAWrapper_PreProcessor_ObjectPreProcessor_ObjectPreProcessorLoop_ValidObject_SafetyMarginFrontObjects_InPathCalculationWithPredictedObjPositions_CreateInPathDataTTR_CalculateAccelerationAndPredictPosition_CircularPrediction_AccelerationCalculationAndCircularPredictionOfTurningObjAtTTR1_CalculateCurvature autosar_swc_aeb_autosar_swc_aeb_Step_sys_Subsystem_Reference_AEB_Function_Run_AsyEvlrCritEve_Step_Func_Run_AsyEvlrCritEve_Step_Func_TAWrapper_PreProcessor_ObjectPreProcessor_ObjectPreProcessorLoop_ValidObject_SafetyMarginFrontObjects_InPathCalculationWithPredictedObjPositions_CreateInPathDataTTR_CalculateAccelerationAndPredictPosition_CircularPrediction_AccelerationCalculationAndCircularPredictionOfTurningObjAtTTR1_ComputeCartesianMovement autosar_swc_aeb_autosar_swc_aeb_Step_sys_Subsystem_Reference_AEB_Function_Run_AsyEvlrCritEve_Step_Func_Run_AsyEvlrCritEve_Step_Func_TAWrapper_PreProcessor_ObjectPreProcessor_ObjectPreProcessorLoop_ValidObject_SafetyMarginFrontObjects_InPathCalculationWithPredictedObjPositions_CreateInPathDataTTR_CalculateAccelerationAndPredictPosition_CircularPrediction_AccelerationCalculationAndCircularPredictionOfTurningObjAtTTR1_NoOperation autosar_swc_aeb_autosar_swc_aeb_Step_sys_Subsystem_Reference_AEB_Function_Run_AsyEvlrCritEve_Step_Func_Run_AsyEvlrCritEve_Step_Func_TAWrapper_PreProcessor_ObjectPreProcessor_ObjectPreProcessorLoop_ValidObject_SafetyMarginFrontObjects_InPathCalculationWithPredictedObjPositions_CreateInPathDataTTR_CalculateAccelerationAndPredictPosition_CircularPrediction_AccelerationCalculationAndCircularPredictionOfTurningObjAtTTR1_NoOperation1 autosar_swc_aeb_autosar_swc_aeb_Step_sys_Subsystem_Reference_AEB_Function_Run_AsyEvlrCritEve_Step_Func_Run_AsyEvlrCritEve_Step_Func_TAWrapper_PreProcessor_ObjectPreProcessor_ObjectPreProcessorLoop_ValidObject_SafetyMarginFrontObjects_InPathCalculationWithPredictedObjPositions_CreateInPathDataTTR_CalculateAccelerationAndPredictPosition_CircularPrediction_AccelerationCalculationAndCircularPredictionOfTurningObjAtTTR1_PredictedPositionAtTimeHeadingAngleAndCurvatureBased /end SUB_GROUP
 /begin REF_MEASUREMENT autosar_swc_aeb_rtARID_DEF.VLatObj_bmz autosar_swc_aeb_rtARID_DEF.VLgtObj_gh1 /end REF_MEASUREMENT
/end GROUP
/begin GROUP autosar_swc_aeb_autosar_swc_aeb_Step_sys_Subsystem_Reference_AEB_Function_Run_AsyEvlrCritEve_Step_Func_Run_AsyEvlrCritEve_Step_Func_TAWrapper_PreProcessor_ObjectPreProcessor_ObjectPreProcessorLoop_ValidObject_SafetyMarginFrontObjects_InPathCalculationWithPredictedObjPositions_CreateInPathDataTTR_CalculateAccelerationAndPredictPosition_CircularPrediction_AccelerationCalculationAndCircularPredictionOfTurningObjAtTTR1_ComputeCartesianMovement "autosar_swc_aeb/autosar_swc_aeb_Step_sys/Subsystem Reference/AEB Function/Run_AsyEvlrCritEve_Step_Func/Run_AsyEvlrCritEve_Step_Func/TAWrapper/PreProcessor/ObjectPreProcessor/ObjectPreProcessorLoop/ValidObject/SafetyMarginFrontObjects/InPathCalculationWithPredictedObjPositions/CreateInPathDataTTR/CalculateAccelerationAndPredictPosition/CircularPrediction/AccelerationCalculationAndCircularPredictionOfTurningObjAtTTR1/ComputeCartesianMovement"
 /begin REF_MEASUREMENT autosar_swc_aeb_rtARID_DEF.ALatObj_p4 autosar_swc_aeb_rtARID_DEF.ALgtObj_i5 /end REF_MEASUREMENT
/end GROUP
/begin GROUP autosar_swc_aeb_autosar_swc_aeb_Step_sys_Subsystem_Reference_AEB_Function_Run_AsyEvlrCritEve_Step_Func_Run_AsyEvlrCritEve_Step_Func_TAWrapper_PreProcessor_ObjectPreProcessor_ObjectPreProcessorLoop_ValidObject_SafetyMarginFrontObjects_InPathCalculationWithPredictedObjPositions_CreateInPathDataTTR_CalculateAccelerationAndPredictPosition_CircularPrediction_AccelerationCalculationAndCircularPredictionOfTurningObjAtTTR1_NoOperation "autosar_swc_aeb/autosar_swc_aeb_Step_sys/Subsystem Reference/AEB Function/Run_AsyEvlrCritEve_Step_Func/Run_AsyEvlrCritEve_Step_Func/TAWrapper/PreProcessor/ObjectPreProcessor/ObjectPreProcessorLoop/ValidObject/SafetyMarginFrontObjects/InPathCalculationWithPredictedObjPositions/CreateInPathDataTTR/CalculateAccelerationAndPredictPosition/CircularPrediction/AccelerationCalculationAndCircularPredictionOfTurningObjAtTTR1/NoOperation" /begin REF_MEASUREMENT autosar_swc_aeb_rtARID_DEF.HeadingObj_hja /end REF_MEASUREMENT /end GROUP
/begin GROUP autosar_swc_aeb_autosar_swc_aeb_Step_sys_Subsystem_Reference_AEB_Function_Run_AsyEvlrCritEve_Step_Func_Run_AsyEvlrCritEve_Step_Func_TAWrapper_PreProcessor_ObjectPreProcessor_ObjectPreProcessorLoop_ValidObject_SafetyMarginFrontObjects_InPathCalculationWithPredictedObjPositions_CreateInPathDataTTR_CalculateAccelerationAndPredictPosition_CircularPrediction_AccelerationCalculationAndCircularPredictionOfTurningObjAtTTR1_NoOperation1 "autosar_swc_aeb/autosar_swc_aeb_Step_sys/Subsystem Reference/AEB Function/Run_AsyEvlrCritEve_Step_Func/Run_AsyEvlrCritEve_Step_Func/TAWrapper/PreProcessor/ObjectPreProcessor/ObjectPreProcessorLoop/ValidObject/SafetyMarginFrontObjects/InPathCalculationWithPredictedObjPositions/CreateInPathDataTTR/CalculateAccelerationAndPredictPosition/CircularPrediction/AccelerationCalculationAndCircularPredictionOfTurningObjAtTTR1/NoOperation1" /begin REF_MEASUREMENT autosar_swc_aeb_rtARID_DEF.CrvtObj_a /end REF_MEASUREMENT /end GROUP
/begin GROUP autosar_swc_aeb_autosar_swc_aeb_Step_sys_Subsystem_Reference_AEB_Function_Run_AsyEvlrCritEve_Step_Func_Run_AsyEvlrCritEve_Step_Func_TAWrapper_PreProcessor_ObjectPreProcessor_ObjectPreProcessorLoop_ValidObject_SafetyMarginFrontObjects_InPathCalculationWithPredictedObjPositions_CreateInPathDataTTR_CalculateAccelerationAndPredictPosition_CircularPrediction_AccelerationCalculationAndCircularPredictionOfTurningObjAtTTR1_PredictedPositionAtTimeHeadingAngleAndCurvatureBased "autosar_swc_aeb/autosar_swc_aeb_Step_sys/Subsystem Reference/AEB Function/Run_AsyEvlrCritEve_Step_Func/Run_AsyEvlrCritEve_Step_Func/TAWrapper/PreProcessor/ObjectPreProcessor/ObjectPreProcessorLoop/ValidObject/SafetyMarginFrontObjects/InPathCalculationWithPredictedObjPositions/CreateInPathDataTTR/CalculateAccelerationAndPredictPosition/CircularPrediction/AccelerationCalculationAndCircularPredictionOfTurningObjAtTTR1/PredictedPositionAtTimeHeadingAngleAndCurvatureBased"
 /begin REF_MEASUREMENT autosar_swc_aeb_rtARID_DEF.PosnLatObj_krk autosar_swc_aeb_rtARID_DEF.PosnLgtObj_cki /end REF_MEASUREMENT
/end GROUP
/begin GROUP autosar_swc_aeb_autosar_swc_aeb_Step_sys_Subsystem_Reference_AEB_Function_Run_AsyEvlrCritEve_Step_Func_Run_AsyEvlrCritEve_Step_Func_TAWrapper_PreProcessor_ObjectPreProcessor_ObjectPreProcessorLoop_ValidObject_SafetyMarginFrontObjects_InPathCalculationWithPredictedObjPositions_CreateInPathDataTTR_CalculateAccelerationAndPredictPosition_CircularPrediction_AccelerationCalculationAndCircularPredictionOfTurningObjAtTTR_ComputeCartesianMovement "autosar_swc_aeb/autosar_swc_aeb_Step_sys/Subsystem Reference/AEB Function/Run_AsyEvlrCritEve_Step_Func/Run_AsyEvlrCritEve_Step_Func/TAWrapper/PreProcessor/ObjectPreProcessor/ObjectPreProcessorLoop/ValidObject/SafetyMarginFrontObjects/InPathCalculationWithPredictedObjPositions/CreateInPathDataTTR/CalculateAccelerationAndPredictPosition/CircularPrediction/AccelerationCalculationAndCircularPredictionOfTurningObjAtTTR/ComputeCartesianMovement"
 /begin REF_MEASUREMENT autosar_swc_aeb_rtARID_DEF.ALatObj_p autosar_swc_aeb_rtARID_DEF.ALgtObj_i /end REF_MEASUREMENT
/end GROUP
/begin GROUP autosar_swc_aeb_autosar_swc_aeb_Step_sys_Subsystem_Reference_AEB_Function_Run_AsyEvlrCritEve_Step_Func_Run_AsyEvlrCritEve_Step_Func_TAWrapper_PreProcessor_ObjectPreProcessor_ObjectPreProcessorLoop_ValidObject_SafetyMarginFrontObjects_InPathCalculationWithPredictedObjPositions_CreateInPathDataTTR_CalculateAccelerationAndPredictPosition_CircularPrediction_AccelerationCalculationAndCircularPredictionOfTurningObjAtTTR_NoOperation "autosar_swc_aeb/autosar_swc_aeb_Step_sys/Subsystem Reference/AEB Function/Run_AsyEvlrCritEve_Step_Func/Run_AsyEvlrCritEve_Step_Func/TAWrapper/PreProcessor/ObjectPreProcessor/ObjectPreProcessorLoop/ValidObject/SafetyMarginFrontObjects/InPathCalculationWithPredictedObjPositions/CreateInPathDataTTR/CalculateAccelerationAndPredictPosition/CircularPrediction/AccelerationCalculationAndCircularPredictionOfTurningObjAtTTR/NoOperation" /begin REF_MEASUREMENT autosar_swc_aeb_rtARID_DEF.HeadingObj_hj /end REF_MEASUREMENT /end GROUP
/begin GROUP autosar_swc_aeb_autosar_swc_aeb_Step_sys_Subsystem_Reference_AEB_Function_Run_AsyEvlrCritEve_Step_Func_Run_AsyEvlrCritEve_Step_Func_TAWrapper_PreProcessor_ObjectPreProcessor_ObjectPreProcessorLoop_ValidObject_SafetyMarginFrontObjects_InPathCalculationWithPredictedObjPositions_CreateInPathDataTTR_CalculateAccelerationAndPredictPosition_CircularPrediction_AccelerationCalculationAndCircularPredictionOfTurningObjAtTTR_NoOperation1 "autosar_swc_aeb/autosar_swc_aeb_Step_sys/Subsystem Reference/AEB Function/Run_AsyEvlrCritEve_Step_Func/Run_AsyEvlrCritEve_Step_Func/TAWrapper/PreProcessor/ObjectPreProcessor/ObjectPreProcessorLoop/ValidObject/SafetyMarginFrontObjects/InPathCalculationWithPredictedObjPositions/CreateInPathDataTTR/CalculateAccelerationAndPredictPosition/CircularPrediction/AccelerationCalculationAndCircularPredictionOfTurningObjAtTTR/NoOperation1" /begin REF_MEASUREMENT autosar_swc_aeb_rtARID_DEF.CrvtObj /end REF_MEASUREMENT /end GROUP
/begin GROUP autosar_swc_aeb_autosar_swc_aeb_Step_sys_Subsystem_Reference_AEB_Function_Run_AsyEvlrCritEve_Step_Func_Run_AsyEvlrCritEve_Step_Func_TAWrapper_PreProcessor_ObjectPreProcessor_ObjectPreProcessorLoop_ValidObject_SafetyMarginFrontObjects_InPathCalculationWithPredictedObjPositions_CreateInPathDataTTR_CalculateAccelerationAndPredictPosition_CircularPrediction_AccelerationCalculationAndCircularPredictionOfTurningObjAtTTR_PredictedPositionAtTimeHeadingAngleAndCurvatureBased "autosar_swc_aeb/autosar_swc_aeb_Step_sys/Subsystem Reference/AEB Function/Run_AsyEvlrCritEve_Step_Func/Run_AsyEvlrCritEve_Step_Func/TAWrapper/PreProcessor/ObjectPreProcessor/ObjectPreProcessorLoop/ValidObject/SafetyMarginFrontObjects/InPathCalculationWithPredictedObjPositions/CreateInPathDataTTR/CalculateAccelerationAndPredictPosition/CircularPrediction/AccelerationCalculationAndCircularPredictionOfTurningObjAtTTR/PredictedPositionAtTimeHeadingAngleAndCurvatureBased"
 /begin REF_MEASUREMENT autosar_swc_aeb_rtARID_DEF.PosnLatObj_kr autosar_swc_aeb_rtARID_DEF.PosnLgtObj_ck /end REF_MEASUREMENT
/end GROUP
/begin GROUP autosar_swc_aeb_autosar_swc_aeb_Step_sys_Subsystem_Reference_AEB_Function_Run_AsyEvlrCritEve_Step_Func_Run_AsyEvlrCritEve_Step_Func_TAWrapper_PreProcessor_ObjectPreProcessor_ObjectPreProcessorLoop_ValidObject_SafetyMarginFrontObjects_InPathCalculationWithPredictedObjPositions_CreateInPathDataTTR_CalculateAccelerationAndPredictPosition_CircularPrediction_CircularPredictionOfObjAtTTR "autosar_swc_aeb/autosar_swc_aeb_Step_sys/Subsystem Reference/AEB Function/Run_AsyEvlrCritEve_Step_Func/Run_AsyEvlrCritEve_Step_Func/TAWrapper/PreProcessor/ObjectPreProcessor/ObjectPreProcessorLoop/ValidObject/SafetyMarginFrontObjects/InPathCalculationWithPredictedObjPositions/CreateInPathDataTTR/CalculateAccelerationAndPredictPosition/CircularPrediction/CircularPredictionOfObjAtTTR"
 /begin SUB_GROUP autosar_swc_aeb_autosar_swc_aeb_Step_sys_Subsystem_Reference_AEB_Function_Run_AsyEvlrCritEve_Step_Func_Run_AsyEvlrCritEve_Step_Func_TAWrapper_PreProcessor_ObjectPreProcessor_ObjectPreProcessorLoop_ValidObject_SafetyMarginFrontObjects_InPathCalculationWithPredictedObjPositions_CreateInPathDataTTR_CalculateAccelerationAndPredictPosition_CircularPrediction_CircularPredictionOfObjAtTTR_NoOperation autosar_swc_aeb_autosar_swc_aeb_Step_sys_Subsystem_Reference_AEB_Function_Run_AsyEvlrCritEve_Step_Func_Run_AsyEvlrCritEve_Step_Func_TAWrapper_PreProcessor_ObjectPreProcessor_ObjectPreProcessorLoop_ValidObject_SafetyMarginFrontObjects_InPathCalculationWithPredictedObjPositions_CreateInPathDataTTR_CalculateAccelerationAndPredictPosition_CircularPrediction_CircularPredictionOfObjAtTTR_PredictedPositionAtTimeHeadingAngleAndCurvatureBased /end SUB_GROUP
 /begin REF_MEASUREMENT autosar_swc_aeb_rtARID_DEF.VLatObj autosar_swc_aeb_rtARID_DEF.VLgtObj /end REF_MEASUREMENT
/end GROUP
/begin GROUP autosar_swc_aeb_autosar_swc_aeb_Step_sys_Subsystem_Reference_AEB_Function_Run_AsyEvlrCritEve_Step_Func_Run_AsyEvlrCritEve_Step_Func_TAWrapper_PreProcessor_ObjectPreProcessor_ObjectPreProcessorLoop_ValidObject_SafetyMarginFrontObjects_InPathCalculationWithPredictedObjPositions_CreateInPathDataTTR_CalculateAccelerationAndPredictPosition_CircularPrediction_CircularPredictionOfObjAtTTR_NoOperation "autosar_swc_aeb/autosar_swc_aeb_Step_sys/Subsystem Reference/AEB Function/Run_AsyEvlrCritEve_Step_Func/Run_AsyEvlrCritEve_Step_Func/TAWrapper/PreProcessor/ObjectPreProcessor/ObjectPreProcessorLoop/ValidObject/SafetyMarginFrontObjects/InPathCalculationWithPredictedObjPositions/CreateInPathDataTTR/CalculateAccelerationAndPredictPosition/CircularPrediction/CircularPredictionOfObjAtTTR/NoOperation" /begin REF_MEASUREMENT autosar_swc_aeb_rtARID_DEF.HeadingObj /end REF_MEASUREMENT /end GROUP
/begin GROUP autosar_swc_aeb_autosar_swc_aeb_Step_sys_Subsystem_Reference_AEB_Function_Run_AsyEvlrCritEve_Step_Func_Run_AsyEvlrCritEve_Step_Func_TAWrapper_PreProcessor_ObjectPreProcessor_ObjectPreProcessorLoop_ValidObject_SafetyMarginFrontObjects_InPathCalculationWithPredictedObjPositions_CreateInPathDataTTR_CalculateAccelerationAndPredictPosition_CircularPrediction_CircularPredictionOfObjAtTTR_PredictedPositionAtTimeHeadingAngleAndCurvatureBased "autosar_swc_aeb/autosar_swc_aeb_Step_sys/Subsystem Reference/AEB Function/Run_AsyEvlrCritEve_Step_Func/Run_AsyEvlrCritEve_Step_Func/TAWrapper/PreProcessor/ObjectPreProcessor/ObjectPreProcessorLoop/ValidObject/SafetyMarginFrontObjects/InPathCalculationWithPredictedObjPositions/CreateInPathDataTTR/CalculateAccelerationAndPredictPosition/CircularPrediction/CircularPredictionOfObjAtTTR/PredictedPositionAtTimeHeadingAngleAndCurvatureBased"
 /begin REF_MEASUREMENT autosar_swc_aeb_rtARID_DEF.PosnLatObj autosar_swc_aeb_rtARID_DEF.PosnLgtObj /end REF_MEASUREMENT
/end GROUP
/begin GROUP autosar_swc_aeb_autosar_swc_aeb_Step_sys_Subsystem_Reference_AEB_Function_Run_AsyEvlrCritEve_Step_Func_Run_AsyEvlrCritEve_Step_Func_TAWrapper_PreProcessor_ObjectPreProcessor_ObjectPreProcessorLoop_ValidObject_SafetyMarginFrontObjects_InPathCalculationWithPredictedObjPositions_CreateInPathDataTTR_CalculateAccelerationAndPredictPosition_LinearPrediction "autosar_swc_aeb/autosar_swc_aeb_Step_sys/Subsystem Reference/AEB Function/Run_AsyEvlrCritEve_Step_Func/Run_AsyEvlrCritEve_Step_Func/TAWrapper/PreProcessor/ObjectPreProcessor/ObjectPreProcessorLoop/ValidObject/SafetyMarginFrontObjects/InPathCalculationWithPredictedObjPositions/CreateInPathDataTTR/CalculateAccelerationAndPredictPosition/LinearPrediction"
 /begin SUB_GROUP autosar_swc_aeb_autosar_swc_aeb_Step_sys_Subsystem_Reference_AEB_Function_Run_AsyEvlrCritEve_Step_Func_Run_AsyEvlrCritEve_Step_Func_TAWrapper_PreProcessor_ObjectPreProcessor_ObjectPreProcessorLoop_ValidObject_SafetyMarginFrontObjects_InPathCalculationWithPredictedObjPositions_CreateInPathDataTTR_CalculateAccelerationAndPredictPosition_LinearPrediction_AccelerationCalculationAndLinearPredictionOfBrakingObjAtTTR autosar_swc_aeb_autosar_swc_aeb_Step_sys_Subsystem_Reference_AEB_Function_Run_AsyEvlrCritEve_Step_Func_Run_AsyEvlrCritEve_Step_Func_TAWrapper_PreProcessor_ObjectPreProcessor_ObjectPreProcessorLoop_ValidObject_SafetyMarginFrontObjects_InPathCalculationWithPredictedObjPositions_CreateInPathDataTTR_CalculateAccelerationAndPredictPosition_LinearPrediction_AccelerationCalculationAndLinearPredictionOfBrakingObjAtTTR1 autosar_swc_aeb_autosar_swc_aeb_Step_sys_Subsystem_Reference_AEB_Function_Run_AsyEvlrCritEve_Step_Func_Run_AsyEvlrCritEve_Step_Func_TAWrapper_PreProcessor_ObjectPreProcessor_ObjectPreProcessorLoop_ValidObject_SafetyMarginFrontObjects_InPathCalculationWithPredictedObjPositions_CreateInPathDataTTR_CalculateAccelerationAndPredictPosition_LinearPrediction_AccelerationCalculationAndLinearPredictionOfTurningObjAtTTR autosar_swc_aeb_autosar_swc_aeb_Step_sys_Subsystem_Reference_AEB_Function_Run_AsyEvlrCritEve_Step_Func_Run_AsyEvlrCritEve_Step_Func_TAWrapper_PreProcessor_ObjectPreProcessor_ObjectPreProcessorLoop_ValidObject_SafetyMarginFrontObjects_InPathCalculationWithPredictedObjPositions_CreateInPathDataTTR_CalculateAccelerationAndPredictPosition_LinearPrediction_AccelerationCalculationAndLinearPredictionOfTurningObjAtTTR1 /end SUB_GROUP
/end GROUP
/begin GROUP autosar_swc_aeb_autosar_swc_aeb_Step_sys_Subsystem_Reference_AEB_Function_Run_AsyEvlrCritEve_Step_Func_Run_AsyEvlrCritEve_Step_Func_TAWrapper_PreProcessor_ObjectPreProcessor_ObjectPreProcessorLoop_ValidObject_SafetyMarginFrontObjects_InPathCalculationWithPredictedObjPositions_CreateInPathDataTTR_CalculateAccelerationAndPredictPosition_LinearPrediction_AccelerationCalculationAndLinearPredictionOfBrakingObjAtTTR "autosar_swc_aeb/autosar_swc_aeb_Step_sys/Subsystem Reference/AEB Function/Run_AsyEvlrCritEve_Step_Func/Run_AsyEvlrCritEve_Step_Func/TAWrapper/PreProcessor/ObjectPreProcessor/ObjectPreProcessorLoop/ValidObject/SafetyMarginFrontObjects/InPathCalculationWithPredictedObjPositions/CreateInPathDataTTR/CalculateAccelerationAndPredictPosition/LinearPrediction/AccelerationCalculationAndLinearPredictionOfBrakingObjAtTTR"
 /begin SUB_GROUP autosar_swc_aeb_autosar_swc_aeb_Step_sys_Subsystem_Reference_AEB_Function_Run_AsyEvlrCritEve_Step_Func_Run_AsyEvlrCritEve_Step_Func_TAWrapper_PreProcessor_ObjectPreProcessor_ObjectPreProcessorLoop_ValidObject_SafetyMarginFrontObjects_InPathCalculationWithPredictedObjPositions_CreateInPathDataTTR_CalculateAccelerationAndPredictPosition_LinearPrediction_AccelerationCalculationAndLinearPredictionOfBrakingObjAtTTR_NoOperation3 autosar_swc_aeb_autosar_swc_aeb_Step_sys_Subsystem_Reference_AEB_Function_Run_AsyEvlrCritEve_Step_Func_Run_AsyEvlrCritEve_Step_Func_TAWrapper_PreProcessor_ObjectPreProcessor_ObjectPreProcessorLoop_ValidObject_SafetyMarginFrontObjects_InPathCalculationWithPredictedObjPositions_CreateInPathDataTTR_CalculateAccelerationAndPredictPosition_LinearPrediction_AccelerationCalculationAndLinearPredictionOfBrakingObjAtTTR_NoOperation4 /end SUB_GROUP
/end GROUP
/begin GROUP autosar_swc_aeb_autosar_swc_aeb_Step_sys_Subsystem_Reference_AEB_Function_Run_AsyEvlrCritEve_Step_Func_Run_AsyEvlrCritEve_Step_Func_TAWrapper_PreProcessor_ObjectPreProcessor_ObjectPreProcessorLoop_ValidObject_SafetyMarginFrontObjects_InPathCalculationWithPredictedObjPositions_CreateInPathDataTTR_CalculateAccelerationAndPredictPosition_LinearPrediction_AccelerationCalculationAndLinearPredictionOfBrakingObjAtTTR1 "autosar_swc_aeb/autosar_swc_aeb_Step_sys/Subsystem Reference/AEB Function/Run_AsyEvlrCritEve_Step_Func/Run_AsyEvlrCritEve_Step_Func/TAWrapper/PreProcessor/ObjectPreProcessor/ObjectPreProcessorLoop/ValidObject/SafetyMarginFrontObjects/InPathCalculationWithPredictedObjPositions/CreateInPathDataTTR/CalculateAccelerationAndPredictPosition/LinearPrediction/AccelerationCalculationAndLinearPredictionOfBrakingObjAtTTR1"
 /begin SUB_GROUP autosar_swc_aeb_autosar_swc_aeb_Step_sys_Subsystem_Reference_AEB_Function_Run_AsyEvlrCritEve_Step_Func_Run_AsyEvlrCritEve_Step_Func_TAWrapper_PreProcessor_ObjectPreProcessor_ObjectPreProcessorLoop_ValidObject_SafetyMarginFrontObjects_InPathCalculationWithPredictedObjPositions_CreateInPathDataTTR_CalculateAccelerationAndPredictPosition_LinearPrediction_AccelerationCalculationAndLinearPredictionOfBrakingObjAtTTR1_NoOperation3 autosar_swc_aeb_autosar_swc_aeb_Step_sys_Subsystem_Reference_AEB_Function_Run_AsyEvlrCritEve_Step_Func_Run_AsyEvlrCritEve_Step_Func_TAWrapper_PreProcessor_ObjectPreProcessor_ObjectPreProcessorLoop_ValidObject_SafetyMarginFrontObjects_InPathCalculationWithPredictedObjPositions_CreateInPathDataTTR_CalculateAccelerationAndPredictPosition_LinearPrediction_AccelerationCalculationAndLinearPredictionOfBrakingObjAtTTR1_NoOperation4 /end SUB_GROUP
/end GROUP
/begin GROUP autosar_swc_aeb_autosar_swc_aeb_Step_sys_Subsystem_Reference_AEB_Function_Run_AsyEvlrCritEve_Step_Func_Run_AsyEvlrCritEve_Step_Func_TAWrapper_PreProcessor_ObjectPreProcessor_ObjectPreProcessorLoop_ValidObject_SafetyMarginFrontObjects_InPathCalculationWithPredictedObjPositions_CreateInPathDataTTR_CalculateAccelerationAndPredictPosition_LinearPrediction_AccelerationCalculationAndLinearPredictionOfBrakingObjAtTTR1_NoOperation3 "autosar_swc_aeb/autosar_swc_aeb_Step_sys/Subsystem Reference/AEB Function/Run_AsyEvlrCritEve_Step_Func/Run_AsyEvlrCritEve_Step_Func/TAWrapper/PreProcessor/ObjectPreProcessor/ObjectPreProcessorLoop/ValidObject/SafetyMarginFrontObjects/InPathCalculationWithPredictedObjPositions/CreateInPathDataTTR/CalculateAccelerationAndPredictPosition/LinearPrediction/AccelerationCalculationAndLinearPredictionOfBrakingObjAtTTR1/NoOperation3" /begin REF_MEASUREMENT autosar_swc_aeb_rtARID_DEF.ALgtObj_i5c /end REF_MEASUREMENT /end GROUP
/begin GROUP autosar_swc_aeb_autosar_swc_aeb_Step_sys_Subsystem_Reference_AEB_Function_Run_AsyEvlrCritEve_Step_Func_Run_AsyEvlrCritEve_Step_Func_TAWrapper_PreProcessor_ObjectPreProcessor_ObjectPreProcessorLoop_ValidObject_SafetyMarginFrontObjects_InPathCalculationWithPredictedObjPositions_CreateInPathDataTTR_CalculateAccelerationAndPredictPosition_LinearPrediction_AccelerationCalculationAndLinearPredictionOfBrakingObjAtTTR1_NoOperation4 "autosar_swc_aeb/autosar_swc_aeb_Step_sys/Subsystem Reference/AEB Function/Run_AsyEvlrCritEve_Step_Func/Run_AsyEvlrCritEve_Step_Func/TAWrapper/PreProcessor/ObjectPreProcessor/ObjectPreProcessorLoop/ValidObject/SafetyMarginFrontObjects/InPathCalculationWithPredictedObjPositions/CreateInPathDataTTR/CalculateAccelerationAndPredictPosition/LinearPrediction/AccelerationCalculationAndLinearPredictionOfBrakingObjAtTTR1/NoOperation4" /begin REF_MEASUREMENT autosar_swc_aeb_rtARID_DEF.ALatObj_p41 /end REF_MEASUREMENT /end GROUP
/begin GROUP autosar_swc_aeb_autosar_swc_aeb_Step_sys_Subsystem_Reference_AEB_Function_Run_AsyEvlrCritEve_Step_Func_Run_AsyEvlrCritEve_Step_Func_TAWrapper_PreProcessor_ObjectPreProcessor_ObjectPreProcessorLoop_ValidObject_SafetyMarginFrontObjects_InPathCalculationWithPredictedObjPositions_CreateInPathDataTTR_CalculateAccelerationAndPredictPosition_LinearPrediction_AccelerationCalculationAndLinearPredictionOfBrakingObjAtTTR_NoOperation3 "autosar_swc_aeb/autosar_swc_aeb_Step_sys/Subsystem Reference/AEB Function/Run_AsyEvlrCritEve_Step_Func/Run_AsyEvlrCritEve_Step_Func/TAWrapper/PreProcessor/ObjectPreProcessor/ObjectPreProcessorLoop/ValidObject/SafetyMarginFrontObjects/InPathCalculationWithPredictedObjPositions/CreateInPathDataTTR/CalculateAccelerationAndPredictPosition/LinearPrediction/AccelerationCalculationAndLinearPredictionOfBrakingObjAtTTR/NoOperation3" /begin REF_MEASUREMENT autosar_swc_aeb_rtARID_DEF.ALgtObj /end REF_MEASUREMENT /end GROUP
/begin GROUP autosar_swc_aeb_autosar_swc_aeb_Step_sys_Subsystem_Reference_AEB_Function_Run_AsyEvlrCritEve_Step_Func_Run_AsyEvlrCritEve_Step_Func_TAWrapper_PreProcessor_ObjectPreProcessor_ObjectPreProcessorLoop_ValidObject_SafetyMarginFrontObjects_InPathCalculationWithPredictedObjPositions_CreateInPathDataTTR_CalculateAccelerationAndPredictPosition_LinearPrediction_AccelerationCalculationAndLinearPredictionOfBrakingObjAtTTR_NoOperation4 "autosar_swc_aeb/autosar_swc_aeb_Step_sys/Subsystem Reference/AEB Function/Run_AsyEvlrCritEve_Step_Func/Run_AsyEvlrCritEve_Step_Func/TAWrapper/PreProcessor/ObjectPreProcessor/ObjectPreProcessorLoop/ValidObject/SafetyMarginFrontObjects/InPathCalculationWithPredictedObjPositions/CreateInPathDataTTR/CalculateAccelerationAndPredictPosition/LinearPrediction/AccelerationCalculationAndLinearPredictionOfBrakingObjAtTTR/NoOperation4" /begin REF_MEASUREMENT autosar_swc_aeb_rtARID_DEF.ALatObj /end REF_MEASUREMENT /end GROUP
/begin GROUP autosar_swc_aeb_autosar_swc_aeb_Step_sys_Subsystem_Reference_AEB_Function_Run_AsyEvlrCritEve_Step_Func_Run_AsyEvlrCritEve_Step_Func_TAWrapper_PreProcessor_ObjectPreProcessor_ObjectPreProcessorLoop_ValidObject_SafetyMarginFrontObjects_InPathCalculationWithPredictedObjPositions_CreateInPathDataTTR_CalculateAccelerationAndPredictPosition_LinearPrediction_AccelerationCalculationAndLinearPredictionOfTurningObjAtTTR "autosar_swc_aeb/autosar_swc_aeb_Step_sys/Subsystem Reference/AEB Function/Run_AsyEvlrCritEve_Step_Func/Run_AsyEvlrCritEve_Step_Func/TAWrapper/PreProcessor/ObjectPreProcessor/ObjectPreProcessorLoop/ValidObject/SafetyMarginFrontObjects/InPathCalculationWithPredictedObjPositions/CreateInPathDataTTR/CalculateAccelerationAndPredictPosition/LinearPrediction/AccelerationCalculationAndLinearPredictionOfTurningObjAtTTR"
 /begin SUB_GROUP autosar_swc_aeb_autosar_swc_aeb_Step_sys_Subsystem_Reference_AEB_Function_Run_AsyEvlrCritEve_Step_Func_Run_AsyEvlrCritEve_Step_Func_TAWrapper_PreProcessor_ObjectPreProcessor_ObjectPreProcessorLoop_ValidObject_SafetyMarginFrontObjects_InPathCalculationWithPredictedObjPositions_CreateInPathDataTTR_CalculateAccelerationAndPredictPosition_LinearPrediction_AccelerationCalculationAndLinearPredictionOfTurningObjAtTTR_NoOperation2 autosar_swc_aeb_autosar_swc_aeb_Step_sys_Subsystem_Reference_AEB_Function_Run_AsyEvlrCritEve_Step_Func_Run_AsyEvlrCritEve_Step_Func_TAWrapper_PreProcessor_ObjectPreProcessor_ObjectPreProcessorLoop_ValidObject_SafetyMarginFrontObjects_InPathCalculationWithPredictedObjPositions_CreateInPathDataTTR_CalculateAccelerationAndPredictPosition_LinearPrediction_AccelerationCalculationAndLinearPredictionOfTurningObjAtTTR_NoOperation3 autosar_swc_aeb_autosar_swc_aeb_Step_sys_Subsystem_Reference_AEB_Function_Run_AsyEvlrCritEve_Step_Func_Run_AsyEvlrCritEve_Step_Func_TAWrapper_PreProcessor_ObjectPreProcessor_ObjectPreProcessorLoop_ValidObject_SafetyMarginFrontObjects_InPathCalculationWithPredictedObjPositions_CreateInPathDataTTR_CalculateAccelerationAndPredictPosition_LinearPrediction_AccelerationCalculationAndLinearPredictionOfTurningObjAtTTR_NoOperation4 /end SUB_GROUP
/end GROUP
/begin GROUP autosar_swc_aeb_autosar_swc_aeb_Step_sys_Subsystem_Reference_AEB_Function_Run_AsyEvlrCritEve_Step_Func_Run_AsyEvlrCritEve_Step_Func_TAWrapper_PreProcessor_ObjectPreProcessor_ObjectPreProcessorLoop_ValidObject_SafetyMarginFrontObjects_InPathCalculationWithPredictedObjPositions_CreateInPathDataTTR_CalculateAccelerationAndPredictPosition_LinearPrediction_AccelerationCalculationAndLinearPredictionOfTurningObjAtTTR1 "autosar_swc_aeb/autosar_swc_aeb_Step_sys/Subsystem Reference/AEB Function/Run_AsyEvlrCritEve_Step_Func/Run_AsyEvlrCritEve_Step_Func/TAWrapper/PreProcessor/ObjectPreProcessor/ObjectPreProcessorLoop/ValidObject/SafetyMarginFrontObjects/InPathCalculationWithPredictedObjPositions/CreateInPathDataTTR/CalculateAccelerationAndPredictPosition/LinearPrediction/AccelerationCalculationAndLinearPredictionOfTurningObjAtTTR1"
 /begin SUB_GROUP autosar_swc_aeb_autosar_swc_aeb_Step_sys_Subsystem_Reference_AEB_Function_Run_AsyEvlrCritEve_Step_Func_Run_AsyEvlrCritEve_Step_Func_TAWrapper_PreProcessor_ObjectPreProcessor_ObjectPreProcessorLoop_ValidObject_SafetyMarginFrontObjects_InPathCalculationWithPredictedObjPositions_CreateInPathDataTTR_CalculateAccelerationAndPredictPosition_LinearPrediction_AccelerationCalculationAndLinearPredictionOfTurningObjAtTTR1_NoOperation2 autosar_swc_aeb_autosar_swc_aeb_Step_sys_Subsystem_Reference_AEB_Function_Run_AsyEvlrCritEve_Step_Func_Run_AsyEvlrCritEve_Step_Func_TAWrapper_PreProcessor_ObjectPreProcessor_ObjectPreProcessorLoop_ValidObject_SafetyMarginFrontObjects_InPathCalculationWithPredictedObjPositions_CreateInPathDataTTR_CalculateAccelerationAndPredictPosition_LinearPrediction_AccelerationCalculationAndLinearPredictionOfTurningObjAtTTR1_NoOperation3 autosar_swc_aeb_autosar_swc_aeb_Step_sys_Subsystem_Reference_AEB_Function_Run_AsyEvlrCritEve_Step_Func_Run_AsyEvlrCritEve_Step_Func_TAWrapper_PreProcessor_ObjectPreProcessor_ObjectPreProcessorLoop_ValidObject_SafetyMarginFrontObjects_InPathCalculationWithPredictedObjPositions_CreateInPathDataTTR_CalculateAccelerationAndPredictPosition_LinearPrediction_AccelerationCalculationAndLinearPredictionOfTurningObjAtTTR1_NoOperation4 /end SUB_GROUP
/end GROUP
/begin GROUP autosar_swc_aeb_autosar_swc_aeb_Step_sys_Subsystem_Reference_AEB_Function_Run_AsyEvlrCritEve_Step_Func_Run_AsyEvlrCritEve_Step_Func_TAWrapper_PreProcessor_ObjectPreProcessor_ObjectPreProcessorLoop_ValidObject_SafetyMarginFrontObjects_InPathCalculationWithPredictedObjPositions_CreateInPathDataTTR_CalculateAccelerationAndPredictPosition_LinearPrediction_AccelerationCalculationAndLinearPredictionOfTurningObjAtTTR1_NoOperation2 "autosar_swc_aeb/autosar_swc_aeb_Step_sys/Subsystem Reference/AEB Function/Run_AsyEvlrCritEve_Step_Func/Run_AsyEvlrCritEve_Step_Func/TAWrapper/PreProcessor/ObjectPreProcessor/ObjectPreProcessorLoop/ValidObject/SafetyMarginFrontObjects/InPathCalculationWithPredictedObjPositions/CreateInPathDataTTR/CalculateAccelerationAndPredictPosition/LinearPrediction/AccelerationCalculationAndLinearPredictionOfTurningObjAtTTR1/NoOperation2" /begin REF_MEASUREMENT autosar_swc_aeb_rtARID_DEF.CrvtObj_a /end REF_MEASUREMENT /end GROUP
/begin GROUP autosar_swc_aeb_autosar_swc_aeb_Step_sys_Subsystem_Reference_AEB_Function_Run_AsyEvlrCritEve_Step_Func_Run_AsyEvlrCritEve_Step_Func_TAWrapper_PreProcessor_ObjectPreProcessor_ObjectPreProcessorLoop_ValidObject_SafetyMarginFrontObjects_InPathCalculationWithPredictedObjPositions_CreateInPathDataTTR_CalculateAccelerationAndPredictPosition_LinearPrediction_AccelerationCalculationAndLinearPredictionOfTurningObjAtTTR1_NoOperation3 "autosar_swc_aeb/autosar_swc_aeb_Step_sys/Subsystem Reference/AEB Function/Run_AsyEvlrCritEve_Step_Func/Run_AsyEvlrCritEve_Step_Func/TAWrapper/PreProcessor/ObjectPreProcessor/ObjectPreProcessorLoop/ValidObject/SafetyMarginFrontObjects/InPathCalculationWithPredictedObjPositions/CreateInPathDataTTR/CalculateAccelerationAndPredictPosition/LinearPrediction/AccelerationCalculationAndLinearPredictionOfTurningObjAtTTR1/NoOperation3" /begin REF_MEASUREMENT autosar_swc_aeb_rtARID_DEF.ALatObj_p4 /end REF_MEASUREMENT /end GROUP
/begin GROUP autosar_swc_aeb_autosar_swc_aeb_Step_sys_Subsystem_Reference_AEB_Function_Run_AsyEvlrCritEve_Step_Func_Run_AsyEvlrCritEve_Step_Func_TAWrapper_PreProcessor_ObjectPreProcessor_ObjectPreProcessorLoop_ValidObject_SafetyMarginFrontObjects_InPathCalculationWithPredictedObjPositions_CreateInPathDataTTR_CalculateAccelerationAndPredictPosition_LinearPrediction_AccelerationCalculationAndLinearPredictionOfTurningObjAtTTR1_NoOperation4 "autosar_swc_aeb/autosar_swc_aeb_Step_sys/Subsystem Reference/AEB Function/Run_AsyEvlrCritEve_Step_Func/Run_AsyEvlrCritEve_Step_Func/TAWrapper/PreProcessor/ObjectPreProcessor/ObjectPreProcessorLoop/ValidObject/SafetyMarginFrontObjects/InPathCalculationWithPredictedObjPositions/CreateInPathDataTTR/CalculateAccelerationAndPredictPosition/LinearPrediction/AccelerationCalculationAndLinearPredictionOfTurningObjAtTTR1/NoOperation4" /begin REF_MEASUREMENT autosar_swc_aeb_rtARID_DEF.ALgtObj_i5 /end REF_MEASUREMENT /end GROUP
/begin GROUP autosar_swc_aeb_autosar_swc_aeb_Step_sys_Subsystem_Reference_AEB_Function_Run_AsyEvlrCritEve_Step_Func_Run_AsyEvlrCritEve_Step_Func_TAWrapper_PreProcessor_ObjectPreProcessor_ObjectPreProcessorLoop_ValidObject_SafetyMarginFrontObjects_InPathCalculationWithPredictedObjPositions_CreateInPathDataTTR_CalculateAccelerationAndPredictPosition_LinearPrediction_AccelerationCalculationAndLinearPredictionOfTurningObjAtTTR_NoOperation2 "autosar_swc_aeb/autosar_swc_aeb_Step_sys/Subsystem Reference/AEB Function/Run_AsyEvlrCritEve_Step_Func/Run_AsyEvlrCritEve_Step_Func/TAWrapper/PreProcessor/ObjectPreProcessor/ObjectPreProcessorLoop/ValidObject/SafetyMarginFrontObjects/InPathCalculationWithPredictedObjPositions/CreateInPathDataTTR/CalculateAccelerationAndPredictPosition/LinearPrediction/AccelerationCalculationAndLinearPredictionOfTurningObjAtTTR/NoOperation2" /begin REF_MEASUREMENT autosar_swc_aeb_rtARID_DEF.CrvtObj /end REF_MEASUREMENT /end GROUP
/begin GROUP autosar_swc_aeb_autosar_swc_aeb_Step_sys_Subsystem_Reference_AEB_Function_Run_AsyEvlrCritEve_Step_Func_Run_AsyEvlrCritEve_Step_Func_TAWrapper_PreProcessor_ObjectPreProcessor_ObjectPreProcessorLoop_ValidObject_SafetyMarginFrontObjects_InPathCalculationWithPredictedObjPositions_CreateInPathDataTTR_CalculateAccelerationAndPredictPosition_LinearPrediction_AccelerationCalculationAndLinearPredictionOfTurningObjAtTTR_NoOperation3 "autosar_swc_aeb/autosar_swc_aeb_Step_sys/Subsystem Reference/AEB Function/Run_AsyEvlrCritEve_Step_Func/Run_AsyEvlrCritEve_Step_Func/TAWrapper/PreProcessor/ObjectPreProcessor/ObjectPreProcessorLoop/ValidObject/SafetyMarginFrontObjects/InPathCalculationWithPredictedObjPositions/CreateInPathDataTTR/CalculateAccelerationAndPredictPosition/LinearPrediction/AccelerationCalculationAndLinearPredictionOfTurningObjAtTTR/NoOperation3" /begin REF_MEASUREMENT autosar_swc_aeb_rtARID_DEF.ALatObj_p /end REF_MEASUREMENT /end GROUP
/begin GROUP autosar_swc_aeb_autosar_swc_aeb_Step_sys_Subsystem_Reference_AEB_Function_Run_AsyEvlrCritEve_Step_Func_Run_AsyEvlrCritEve_Step_Func_TAWrapper_PreProcessor_ObjectPreProcessor_ObjectPreProcessorLoop_ValidObject_SafetyMarginFrontObjects_InPathCalculationWithPredictedObjPositions_CreateInPathDataTTR_CalculateAccelerationAndPredictPosition_LinearPrediction_AccelerationCalculationAndLinearPredictionOfTurningObjAtTTR_NoOperation4 "autosar_swc_aeb/autosar_swc_aeb_Step_sys/Subsystem Reference/AEB Function/Run_AsyEvlrCritEve_Step_Func/Run_AsyEvlrCritEve_Step_Func/TAWrapper/PreProcessor/ObjectPreProcessor/ObjectPreProcessorLoop/ValidObject/SafetyMarginFrontObjects/InPathCalculationWithPredictedObjPositions/CreateInPathDataTTR/CalculateAccelerationAndPredictPosition/LinearPrediction/AccelerationCalculationAndLinearPredictionOfTurningObjAtTTR/NoOperation4" /begin REF_MEASUREMENT autosar_swc_aeb_rtARID_DEF.ALgtObj_i /end REF_MEASUREMENT /end GROUP
/begin GROUP autosar_swc_aeb_autosar_swc_aeb_Step_sys_Subsystem_Reference_AEB_Function_Run_AsyEvlrCritEve_Step_Func_Run_AsyEvlrCritEve_Step_Func_TAWrapper_PreProcessor_ObjectPreProcessor_ObjectPreProcessorLoop_ValidObject_SafetyMarginFrontObjects_InPathCalculationWithPredictedObjPositions_CreateInPathDataTTR_CalculateAccelerationAndPredictPosition_NoPrediction "autosar_swc_aeb/autosar_swc_aeb_Step_sys/Subsystem Reference/AEB Function/Run_AsyEvlrCritEve_Step_Func/Run_AsyEvlrCritEve_Step_Func/TAWrapper/PreProcessor/ObjectPreProcessor/ObjectPreProcessorLoop/ValidObject/SafetyMarginFrontObjects/InPathCalculationWithPredictedObjPositions/CreateInPathDataTTR/CalculateAccelerationAndPredictPosition/NoPrediction"
 /begin SUB_GROUP autosar_swc_aeb_autosar_swc_aeb_Step_sys_Subsystem_Reference_AEB_Function_Run_AsyEvlrCritEve_Step_Func_Run_AsyEvlrCritEve_Step_Func_TAWrapper_PreProcessor_ObjectPreProcessor_ObjectPreProcessorLoop_ValidObject_SafetyMarginFrontObjects_InPathCalculationWithPredictedObjPositions_CreateInPathDataTTR_CalculateAccelerationAndPredictPosition_NoPrediction_NoOperation autosar_swc_aeb_autosar_swc_aeb_Step_sys_Subsystem_Reference_AEB_Function_Run_AsyEvlrCritEve_Step_Func_Run_AsyEvlrCritEve_Step_Func_TAWrapper_PreProcessor_ObjectPreProcessor_ObjectPreProcessorLoop_ValidObject_SafetyMarginFrontObjects_InPathCalculationWithPredictedObjPositions_CreateInPathDataTTR_CalculateAccelerationAndPredictPosition_NoPrediction_NoOperation1 autosar_swc_aeb_autosar_swc_aeb_Step_sys_Subsystem_Reference_AEB_Function_Run_AsyEvlrCritEve_Step_Func_Run_AsyEvlrCritEve_Step_Func_TAWrapper_PreProcessor_ObjectPreProcessor_ObjectPreProcessorLoop_ValidObject_SafetyMarginFrontObjects_InPathCalculationWithPredictedObjPositions_CreateInPathDataTTR_CalculateAccelerationAndPredictPosition_NoPrediction_NoOperation10 autosar_swc_aeb_autosar_swc_aeb_Step_sys_Subsystem_Reference_AEB_Function_Run_AsyEvlrCritEve_Step_Func_Run_AsyEvlrCritEve_Step_Func_TAWrapper_PreProcessor_ObjectPreProcessor_ObjectPreProcessorLoop_ValidObject_SafetyMarginFrontObjects_InPathCalculationWithPredictedObjPositions_CreateInPathDataTTR_CalculateAccelerationAndPredictPosition_NoPrediction_NoOperation11 autosar_swc_aeb_autosar_swc_aeb_Step_sys_Subsystem_Reference_AEB_Function_Run_AsyEvlrCritEve_Step_Func_Run_AsyEvlrCritEve_Step_Func_TAWrapper_PreProcessor_ObjectPreProcessor_ObjectPreProcessorLoop_ValidObject_SafetyMarginFrontObjects_InPathCalculationWithPredictedObjPositions_CreateInPathDataTTR_CalculateAccelerationAndPredictPosition_NoPrediction_NoOperation12 autosar_swc_aeb_autosar_swc_aeb_Step_sys_Subsystem_Reference_AEB_Function_Run_AsyEvlrCritEve_Step_Func_Run_AsyEvlrCritEve_Step_Func_TAWrapper_PreProcessor_ObjectPreProcessor_ObjectPreProcessorLoop_ValidObject_SafetyMarginFrontObjects_InPathCalculationWithPredictedObjPositions_CreateInPathDataTTR_CalculateAccelerationAndPredictPosition_NoPrediction_NoOperation13 autosar_swc_aeb_autosar_swc_aeb_Step_sys_Subsystem_Reference_AEB_Function_Run_AsyEvlrCritEve_Step_Func_Run_AsyEvlrCritEve_Step_Func_TAWrapper_PreProcessor_ObjectPreProcessor_ObjectPreProcessorLoop_ValidObject_SafetyMarginFrontObjects_InPathCalculationWithPredictedObjPositions_CreateInPathDataTTR_CalculateAccelerationAndPredictPosition_NoPrediction_NoOperation14 autosar_swc_aeb_autosar_swc_aeb_Step_sys_Subsystem_Reference_AEB_Function_Run_AsyEvlrCritEve_Step_Func_Run_AsyEvlrCritEve_Step_Func_TAWrapper_PreProcessor_ObjectPreProcessor_ObjectPreProcessorLoop_ValidObject_SafetyMarginFrontObjects_InPathCalculationWithPredictedObjPositions_CreateInPathDataTTR_CalculateAccelerationAndPredictPosition_NoPrediction_NoOperation15 autosar_swc_aeb_autosar_swc_aeb_Step_sys_Subsystem_Reference_AEB_Function_Run_AsyEvlrCritEve_Step_Func_Run_AsyEvlrCritEve_Step_Func_TAWrapper_PreProcessor_ObjectPreProcessor_ObjectPreProcessorLoop_ValidObject_SafetyMarginFrontObjects_InPathCalculationWithPredictedObjPositions_CreateInPathDataTTR_CalculateAccelerationAndPredictPosition_NoPrediction_NoOperation16 autosar_swc_aeb_autosar_swc_aeb_Step_sys_Subsystem_Reference_AEB_Function_Run_AsyEvlrCritEve_Step_Func_Run_AsyEvlrCritEve_Step_Func_TAWrapper_PreProcessor_ObjectPreProcessor_ObjectPreProcessorLoop_ValidObject_SafetyMarginFrontObjects_InPathCalculationWithPredictedObjPositions_CreateInPathDataTTR_CalculateAccelerationAndPredictPosition_NoPrediction_NoOperation17 autosar_swc_aeb_autosar_swc_aeb_Step_sys_Subsystem_Reference_AEB_Function_Run_AsyEvlrCritEve_Step_Func_Run_AsyEvlrCritEve_Step_Func_TAWrapper_PreProcessor_ObjectPreProcessor_ObjectPreProcessorLoop_ValidObject_SafetyMarginFrontObjects_InPathCalculationWithPredictedObjPositions_CreateInPathDataTTR_CalculateAccelerationAndPredictPosition_NoPrediction_NoOperation18 autosar_swc_aeb_autosar_swc_aeb_Step_sys_Subsystem_Reference_AEB_Function_Run_AsyEvlrCritEve_Step_Func_Run_AsyEvlrCritEve_Step_Func_TAWrapper_PreProcessor_ObjectPreProcessor_ObjectPreProcessorLoop_ValidObject_SafetyMarginFrontObjects_InPathCalculationWithPredictedObjPositions_CreateInPathDataTTR_CalculateAccelerationAndPredictPosition_NoPrediction_NoOperation19 autosar_swc_aeb_autosar_swc_aeb_Step_sys_Subsystem_Reference_AEB_Function_Run_AsyEvlrCritEve_Step_Func_Run_AsyEvlrCritEve_Step_Func_TAWrapper_PreProcessor_ObjectPreProcessor_ObjectPreProcessorLoop_ValidObject_SafetyMarginFrontObjects_InPathCalculationWithPredictedObjPositions_CreateInPathDataTTR_CalculateAccelerationAndPredictPosition_NoPrediction_NoOperation2 autosar_swc_aeb_autosar_swc_aeb_Step_sys_Subsystem_Reference_AEB_Function_Run_AsyEvlrCritEve_Step_Func_Run_AsyEvlrCritEve_Step_Func_TAWrapper_PreProcessor_ObjectPreProcessor_ObjectPreProcessorLoop_ValidObject_SafetyMarginFrontObjects_InPathCalculationWithPredictedObjPositions_CreateInPathDataTTR_CalculateAccelerationAndPredictPosition_NoPrediction_NoOperation20 autosar_swc_aeb_autosar_swc_aeb_Step_sys_Subsystem_Reference_AEB_Function_Run_AsyEvlrCritEve_Step_Func_Run_AsyEvlrCritEve_Step_Func_TAWrapper_PreProcessor_ObjectPreProcessor_ObjectPreProcessorLoop_ValidObject_SafetyMarginFrontObjects_InPathCalculationWithPredictedObjPositions_CreateInPathDataTTR_CalculateAccelerationAndPredictPosition_NoPrediction_NoOperation21 autosar_swc_aeb_autosar_swc_aeb_Step_sys_Subsystem_Reference_AEB_Function_Run_AsyEvlrCritEve_Step_Func_Run_AsyEvlrCritEve_Step_Func_TAWrapper_PreProcessor_ObjectPreProcessor_ObjectPreProcessorLoop_ValidObject_SafetyMarginFrontObjects_InPathCalculationWithPredictedObjPositions_CreateInPathDataTTR_CalculateAccelerationAndPredictPosition_NoPrediction_NoOperation22 autosar_swc_aeb_autosar_swc_aeb_Step_sys_Subsystem_Reference_AEB_Function_Run_AsyEvlrCritEve_Step_Func_Run_AsyEvlrCritEve_Step_Func_TAWrapper_PreProcessor_ObjectPreProcessor_ObjectPreProcessorLoop_ValidObject_SafetyMarginFrontObjects_InPathCalculationWithPredictedObjPositions_CreateInPathDataTTR_CalculateAccelerationAndPredictPosition_NoPrediction_NoOperation23 autosar_swc_aeb_autosar_swc_aeb_Step_sys_Subsystem_Reference_AEB_Function_Run_AsyEvlrCritEve_Step_Func_Run_AsyEvlrCritEve_Step_Func_TAWrapper_PreProcessor_ObjectPreProcessor_ObjectPreProcessorLoop_ValidObject_SafetyMarginFrontObjects_InPathCalculationWithPredictedObjPositions_CreateInPathDataTTR_CalculateAccelerationAndPredictPosition_NoPrediction_NoOperation24 autosar_swc_aeb_autosar_swc_aeb_Step_sys_Subsystem_Reference_AEB_Function_Run_AsyEvlrCritEve_Step_Func_Run_AsyEvlrCritEve_Step_Func_TAWrapper_PreProcessor_ObjectPreProcessor_ObjectPreProcessorLoop_ValidObject_SafetyMarginFrontObjects_InPathCalculationWithPredictedObjPositions_CreateInPathDataTTR_CalculateAccelerationAndPredictPosition_NoPrediction_NoOperation25 autosar_swc_aeb_autosar_swc_aeb_Step_sys_Subsystem_Reference_AEB_Function_Run_AsyEvlrCritEve_Step_Func_Run_AsyEvlrCritEve_Step_Func_TAWrapper_PreProcessor_ObjectPreProcessor_ObjectPreProcessorLoop_ValidObject_SafetyMarginFrontObjects_InPathCalculationWithPredictedObjPositions_CreateInPathDataTTR_CalculateAccelerationAndPredictPosition_NoPrediction_NoOperation26 autosar_swc_aeb_autosar_swc_aeb_Step_sys_Subsystem_Reference_AEB_Function_Run_AsyEvlrCritEve_Step_Func_Run_AsyEvlrCritEve_Step_Func_TAWrapper_PreProcessor_ObjectPreProcessor_ObjectPreProcessorLoop_ValidObject_SafetyMarginFrontObjects_InPathCalculationWithPredictedObjPositions_CreateInPathDataTTR_CalculateAccelerationAndPredictPosition_NoPrediction_NoOperation27 autosar_swc_aeb_autosar_swc_aeb_Step_sys_Subsystem_Reference_AEB_Function_Run_AsyEvlrCritEve_Step_Func_Run_AsyEvlrCritEve_Step_Func_TAWrapper_PreProcessor_ObjectPreProcessor_ObjectPreProcessorLoop_ValidObject_SafetyMarginFrontObjects_InPathCalculationWithPredictedObjPositions_CreateInPathDataTTR_CalculateAccelerationAndPredictPosition_NoPrediction_NoOperation28 autosar_swc_aeb_autosar_swc_aeb_Step_sys_Subsystem_Reference_AEB_Function_Run_AsyEvlrCritEve_Step_Func_Run_AsyEvlrCritEve_Step_Func_TAWrapper_PreProcessor_ObjectPreProcessor_ObjectPreProcessorLoop_ValidObject_SafetyMarginFrontObjects_InPathCalculationWithPredictedObjPositions_CreateInPathDataTTR_CalculateAccelerationAndPredictPosition_NoPrediction_NoOperation29 autosar_swc_aeb_autosar_swc_aeb_Step_sys_Subsystem_Reference_AEB_Function_Run_AsyEvlrCritEve_Step_Func_Run_AsyEvlrCritEve_Step_Func_TAWrapper_PreProcessor_ObjectPreProcessor_ObjectPreProcessorLoop_ValidObject_SafetyMarginFrontObjects_InPathCalculationWithPredictedObjPositions_CreateInPathDataTTR_CalculateAccelerationAndPredictPosition_NoPrediction_NoOperation3 autosar_swc_aeb_autosar_swc_aeb_Step_sys_Subsystem_Reference_AEB_Function_Run_AsyEvlrCritEve_Step_Func_Run_AsyEvlrCritEve_Step_Func_TAWrapper_PreProcessor_ObjectPreProcessor_ObjectPreProcessorLoop_ValidObject_SafetyMarginFrontObjects_InPathCalculationWithPredictedObjPositions_CreateInPathDataTTR_CalculateAccelerationAndPredictPosition_NoPrediction_NoOperation30 autosar_swc_aeb_autosar_swc_aeb_Step_sys_Subsystem_Reference_AEB_Function_Run_AsyEvlrCritEve_Step_Func_Run_AsyEvlrCritEve_Step_Func_TAWrapper_PreProcessor_ObjectPreProcessor_ObjectPreProcessorLoop_ValidObject_SafetyMarginFrontObjects_InPathCalculationWithPredictedObjPositions_CreateInPathDataTTR_CalculateAccelerationAndPredictPosition_NoPrediction_NoOperation31 autosar_swc_aeb_autosar_swc_aeb_Step_sys_Subsystem_Reference_AEB_Function_Run_AsyEvlrCritEve_Step_Func_Run_AsyEvlrCritEve_Step_Func_TAWrapper_PreProcessor_ObjectPreProcessor_ObjectPreProcessorLoop_ValidObject_SafetyMarginFrontObjects_InPathCalculationWithPredictedObjPositions_CreateInPathDataTTR_CalculateAccelerationAndPredictPosition_NoPrediction_NoOperation32 autosar_swc_aeb_autosar_swc_aeb_Step_sys_Subsystem_Reference_AEB_Function_Run_AsyEvlrCritEve_Step_Func_Run_AsyEvlrCritEve_Step_Func_TAWrapper_PreProcessor_ObjectPreProcessor_ObjectPreProcessorLoop_ValidObject_SafetyMarginFrontObjects_InPathCalculationWithPredictedObjPositions_CreateInPathDataTTR_CalculateAccelerationAndPredictPosition_NoPrediction_NoOperation33 autosar_swc_aeb_autosar_swc_aeb_Step_sys_Subsystem_Reference_AEB_Function_Run_AsyEvlrCritEve_Step_Func_Run_AsyEvlrCritEve_Step_Func_TAWrapper_PreProcessor_ObjectPreProcessor_ObjectPreProcessorLoop_ValidObject_SafetyMarginFrontObjects_InPathCalculationWithPredictedObjPositions_CreateInPathDataTTR_CalculateAccelerationAndPredictPosition_NoPrediction_NoOperation34 autosar_swc_aeb_autosar_swc_aeb_Step_sys_Subsystem_Reference_AEB_Function_Run_AsyEvlrCritEve_Step_Func_Run_AsyEvlrCritEve_Step_Func_TAWrapper_PreProcessor_ObjectPreProcessor_ObjectPreProcessorLoop_ValidObject_SafetyMarginFrontObjects_InPathCalculationWithPredictedObjPositions_CreateInPathDataTTR_CalculateAccelerationAndPredictPosition_NoPrediction_NoOperation4 autosar_swc_aeb_autosar_swc_aeb_Step_sys_Subsystem_Reference_AEB_Function_Run_AsyEvlrCritEve_Step_Func_Run_AsyEvlrCritEve_Step_Func_TAWrapper_PreProcessor_ObjectPreProcessor_ObjectPreProcessorLoop_ValidObject_SafetyMarginFrontObjects_InPathCalculationWithPredictedObjPositions_CreateInPathDataTTR_CalculateAccelerationAndPredictPosition_NoPrediction_NoOperation5 autosar_swc_aeb_autosar_swc_aeb_Step_sys_Subsystem_Reference_AEB_Function_Run_AsyEvlrCritEve_Step_Func_Run_AsyEvlrCritEve_Step_Func_TAWrapper_PreProcessor_ObjectPreProcessor_ObjectPreProcessorLoop_ValidObject_SafetyMarginFrontObjects_InPathCalculationWithPredictedObjPositions_CreateInPathDataTTR_CalculateAccelerationAndPredictPosition_NoPrediction_NoOperation6 autosar_swc_aeb_autosar_swc_aeb_Step_sys_Subsystem_Reference_AEB_Function_Run_AsyEvlrCritEve_Step_Func_Run_AsyEvlrCritEve_Step_Func_TAWrapper_PreProcessor_ObjectPreProcessor_ObjectPreProcessorLoop_ValidObject_SafetyMarginFrontObjects_InPathCalculationWithPredictedObjPositions_CreateInPathDataTTR_CalculateAccelerationAndPredictPosition_NoPrediction_NoOperation7 autosar_swc_aeb_autosar_swc_aeb_Step_sys_Subsystem_Reference_AEB_Function_Run_AsyEvlrCritEve_Step_Func_Run_AsyEvlrCritEve_Step_Func_TAWrapper_PreProcessor_ObjectPreProcessor_ObjectPreProcessorLoop_ValidObject_SafetyMarginFrontObjects_InPathCalculationWithPredictedObjPositions_CreateInPathDataTTR_CalculateAccelerationAndPredictPosition_NoPrediction_NoOperation8 autosar_swc_aeb_autosar_swc_aeb_Step_sys_Subsystem_Reference_AEB_Function_Run_AsyEvlrCritEve_Step_Func_Run_AsyEvlrCritEve_Step_Func_TAWrapper_PreProcessor_ObjectPreProcessor_ObjectPreProcessorLoop_ValidObject_SafetyMarginFrontObjects_InPathCalculationWithPredictedObjPositions_CreateInPathDataTTR_CalculateAccelerationAndPredictPosition_NoPrediction_NoOperation9 /end SUB_GROUP
/end GROUP
/begin GROUP autosar_swc_aeb_autosar_swc_aeb_Step_sys_Subsystem_Reference_AEB_Function_Run_AsyEvlrCritEve_Step_Func_Run_AsyEvlrCritEve_Step_Func_TAWrapper_PreProcessor_ObjectPreProcessor_ObjectPreProcessorLoop_ValidObject_SafetyMarginFrontObjects_InPathCalculationWithPredictedObjPositions_CreateInPathDataTTR_CalculateAccelerationAndPredictPosition_NoPrediction_NoOperation "autosar_swc_aeb/autosar_swc_aeb_Step_sys/Subsystem Reference/AEB Function/Run_AsyEvlrCritEve_Step_Func/Run_AsyEvlrCritEve_Step_Func/TAWrapper/PreProcessor/ObjectPreProcessor/ObjectPreProcessorLoop/ValidObject/SafetyMarginFrontObjects/InPathCalculationWithPredictedObjPositions/CreateInPathDataTTR/CalculateAccelerationAndPredictPosition/NoPrediction/NoOperation" /begin REF_MEASUREMENT autosar_swc_aeb_rtARID_DEF.PosnLgtObj /end REF_MEASUREMENT /end GROUP
/begin GROUP autosar_swc_aeb_autosar_swc_aeb_Step_sys_Subsystem_Reference_AEB_Function_Run_AsyEvlrCritEve_Step_Func_Run_AsyEvlrCritEve_Step_Func_TAWrapper_PreProcessor_ObjectPreProcessor_ObjectPreProcessorLoop_ValidObject_SafetyMarginFrontObjects_InPathCalculationWithPredictedObjPositions_CreateInPathDataTTR_CalculateAccelerationAndPredictPosition_NoPrediction_NoOperation1 "autosar_swc_aeb/autosar_swc_aeb_Step_sys/Subsystem Reference/AEB Function/Run_AsyEvlrCritEve_Step_Func/Run_AsyEvlrCritEve_Step_Func/TAWrapper/PreProcessor/ObjectPreProcessor/ObjectPreProcessorLoop/ValidObject/SafetyMarginFrontObjects/InPathCalculationWithPredictedObjPositions/CreateInPathDataTTR/CalculateAccelerationAndPredictPosition/NoPrediction/NoOperation1" /begin REF_MEASUREMENT autosar_swc_aeb_rtARID_DEF.PosnLatObj /end REF_MEASUREMENT /end GROUP
/begin GROUP autosar_swc_aeb_autosar_swc_aeb_Step_sys_Subsystem_Reference_AEB_Function_Run_AsyEvlrCritEve_Step_Func_Run_AsyEvlrCritEve_Step_Func_TAWrapper_PreProcessor_ObjectPreProcessor_ObjectPreProcessorLoop_ValidObject_SafetyMarginFrontObjects_InPathCalculationWithPredictedObjPositions_CreateInPathDataTTR_CalculateAccelerationAndPredictPosition_NoPrediction_NoOperation10 "autosar_swc_aeb/autosar_swc_aeb_Step_sys/Subsystem Reference/AEB Function/Run_AsyEvlrCritEve_Step_Func/Run_AsyEvlrCritEve_Step_Func/TAWrapper/PreProcessor/ObjectPreProcessor/ObjectPreProcessorLoop/ValidObject/SafetyMarginFrontObjects/InPathCalculationWithPredictedObjPositions/CreateInPathDataTTR/CalculateAccelerationAndPredictPosition/NoPrediction/NoOperation10" /begin REF_MEASUREMENT autosar_swc_aeb_rtARID_DEF.PosnLgtObj_cki3 /end REF_MEASUREMENT /end GROUP
/begin GROUP autosar_swc_aeb_autosar_swc_aeb_Step_sys_Subsystem_Reference_AEB_Function_Run_AsyEvlrCritEve_Step_Func_Run_AsyEvlrCritEve_Step_Func_TAWrapper_PreProcessor_ObjectPreProcessor_ObjectPreProcessorLoop_ValidObject_SafetyMarginFrontObjects_InPathCalculationWithPredictedObjPositions_CreateInPathDataTTR_CalculateAccelerationAndPredictPosition_NoPrediction_NoOperation11 "autosar_swc_aeb/autosar_swc_aeb_Step_sys/Subsystem Reference/AEB Function/Run_AsyEvlrCritEve_Step_Func/Run_AsyEvlrCritEve_Step_Func/TAWrapper/PreProcessor/ObjectPreProcessor/ObjectPreProcessorLoop/ValidObject/SafetyMarginFrontObjects/InPathCalculationWithPredictedObjPositions/CreateInPathDataTTR/CalculateAccelerationAndPredictPosition/NoPrediction/NoOperation11" /begin REF_MEASUREMENT autosar_swc_aeb_rtARID_DEF.PosnLgtObj_ck /end REF_MEASUREMENT /end GROUP
/begin GROUP autosar_swc_aeb_autosar_swc_aeb_Step_sys_Subsystem_Reference_AEB_Function_Run_AsyEvlrCritEve_Step_Func_Run_AsyEvlrCritEve_Step_Func_TAWrapper_PreProcessor_ObjectPreProcessor_ObjectPreProcessorLoop_ValidObject_SafetyMarginFrontObjects_InPathCalculationWithPredictedObjPositions_CreateInPathDataTTR_CalculateAccelerationAndPredictPosition_NoPrediction_NoOperation12 "autosar_swc_aeb/autosar_swc_aeb_Step_sys/Subsystem Reference/AEB Function/Run_AsyEvlrCritEve_Step_Func/Run_AsyEvlrCritEve_Step_Func/TAWrapper/PreProcessor/ObjectPreProcessor/ObjectPreProcessorLoop/ValidObject/SafetyMarginFrontObjects/InPathCalculationWithPredictedObjPositions/CreateInPathDataTTR/CalculateAccelerationAndPredictPosition/NoPrediction/NoOperation12" /begin REF_MEASUREMENT autosar_swc_aeb_rtARID_DEF.PosnLatObj_kr /end REF_MEASUREMENT /end GROUP
/begin GROUP autosar_swc_aeb_autosar_swc_aeb_Step_sys_Subsystem_Reference_AEB_Function_Run_AsyEvlrCritEve_Step_Func_Run_AsyEvlrCritEve_Step_Func_TAWrapper_PreProcessor_ObjectPreProcessor_ObjectPreProcessorLoop_ValidObject_SafetyMarginFrontObjects_InPathCalculationWithPredictedObjPositions_CreateInPathDataTTR_CalculateAccelerationAndPredictPosition_NoPrediction_NoOperation13 "autosar_swc_aeb/autosar_swc_aeb_Step_sys/Subsystem Reference/AEB Function/Run_AsyEvlrCritEve_Step_Func/Run_AsyEvlrCritEve_Step_Func/TAWrapper/PreProcessor/ObjectPreProcessor/ObjectPreProcessorLoop/ValidObject/SafetyMarginFrontObjects/InPathCalculationWithPredictedObjPositions/CreateInPathDataTTR/CalculateAccelerationAndPredictPosition/NoPrediction/NoOperation13" /begin REF_MEASUREMENT autosar_swc_aeb_rtARID_DEF.VLgtObj_gh /end REF_MEASUREMENT /end GROUP
/begin GROUP autosar_swc_aeb_autosar_swc_aeb_Step_sys_Subsystem_Reference_AEB_Function_Run_AsyEvlrCritEve_Step_Func_Run_AsyEvlrCritEve_Step_Func_TAWrapper_PreProcessor_ObjectPreProcessor_ObjectPreProcessorLoop_ValidObject_SafetyMarginFrontObjects_InPathCalculationWithPredictedObjPositions_CreateInPathDataTTR_CalculateAccelerationAndPredictPosition_NoPrediction_NoOperation14 "autosar_swc_aeb/autosar_swc_aeb_Step_sys/Subsystem Reference/AEB Function/Run_AsyEvlrCritEve_Step_Func/Run_AsyEvlrCritEve_Step_Func/TAWrapper/PreProcessor/ObjectPreProcessor/ObjectPreProcessorLoop/ValidObject/SafetyMarginFrontObjects/InPathCalculationWithPredictedObjPositions/CreateInPathDataTTR/CalculateAccelerationAndPredictPosition/NoPrediction/NoOperation14" /begin REF_MEASUREMENT autosar_swc_aeb_rtARID_DEF.VLatObj_bm /end REF_MEASUREMENT /end GROUP
/begin GROUP autosar_swc_aeb_autosar_swc_aeb_Step_sys_Subsystem_Reference_AEB_Function_Run_AsyEvlrCritEve_Step_Func_Run_AsyEvlrCritEve_Step_Func_TAWrapper_PreProcessor_ObjectPreProcessor_ObjectPreProcessorLoop_ValidObject_SafetyMarginFrontObjects_InPathCalculationWithPredictedObjPositions_CreateInPathDataTTR_CalculateAccelerationAndPredictPosition_NoPrediction_NoOperation15 "autosar_swc_aeb/autosar_swc_aeb_Step_sys/Subsystem Reference/AEB Function/Run_AsyEvlrCritEve_Step_Func/Run_AsyEvlrCritEve_Step_Func/TAWrapper/PreProcessor/ObjectPreProcessor/ObjectPreProcessorLoop/ValidObject/SafetyMarginFrontObjects/InPathCalculationWithPredictedObjPositions/CreateInPathDataTTR/CalculateAccelerationAndPredictPosition/NoPrediction/NoOperation15" /begin REF_MEASUREMENT autosar_swc_aeb_rtARID_DEF.ALgtObj_i /end REF_MEASUREMENT /end GROUP
/begin GROUP autosar_swc_aeb_autosar_swc_aeb_Step_sys_Subsystem_Reference_AEB_Function_Run_AsyEvlrCritEve_Step_Func_Run_AsyEvlrCritEve_Step_Func_TAWrapper_PreProcessor_ObjectPreProcessor_ObjectPreProcessorLoop_ValidObject_SafetyMarginFrontObjects_InPathCalculationWithPredictedObjPositions_CreateInPathDataTTR_CalculateAccelerationAndPredictPosition_NoPrediction_NoOperation16 "autosar_swc_aeb/autosar_swc_aeb_Step_sys/Subsystem Reference/AEB Function/Run_AsyEvlrCritEve_Step_Func/Run_AsyEvlrCritEve_Step_Func/TAWrapper/PreProcessor/ObjectPreProcessor/ObjectPreProcessorLoop/ValidObject/SafetyMarginFrontObjects/InPathCalculationWithPredictedObjPositions/CreateInPathDataTTR/CalculateAccelerationAndPredictPosition/NoPrediction/NoOperation16" /begin REF_MEASUREMENT autosar_swc_aeb_rtARID_DEF.PosnLatObj_krkk /end REF_MEASUREMENT /end GROUP
/begin GROUP autosar_swc_aeb_autosar_swc_aeb_Step_sys_Subsystem_Reference_AEB_Function_Run_AsyEvlrCritEve_Step_Func_Run_AsyEvlrCritEve_Step_Func_TAWrapper_PreProcessor_ObjectPreProcessor_ObjectPreProcessorLoop_ValidObject_SafetyMarginFrontObjects_InPathCalculationWithPredictedObjPositions_CreateInPathDataTTR_CalculateAccelerationAndPredictPosition_NoPrediction_NoOperation17 "autosar_swc_aeb/autosar_swc_aeb_Step_sys/Subsystem Reference/AEB Function/Run_AsyEvlrCritEve_Step_Func/Run_AsyEvlrCritEve_Step_Func/TAWrapper/PreProcessor/ObjectPreProcessor/ObjectPreProcessorLoop/ValidObject/SafetyMarginFrontObjects/InPathCalculationWithPredictedObjPositions/CreateInPathDataTTR/CalculateAccelerationAndPredictPosition/NoPrediction/NoOperation17" /begin REF_MEASUREMENT autosar_swc_aeb_rtARID_DEF.ALgtObj /end REF_MEASUREMENT /end GROUP
/begin GROUP autosar_swc_aeb_autosar_swc_aeb_Step_sys_Subsystem_Reference_AEB_Function_Run_AsyEvlrCritEve_Step_Func_Run_AsyEvlrCritEve_Step_Func_TAWrapper_PreProcessor_ObjectPreProcessor_ObjectPreProcessorLoop_ValidObject_SafetyMarginFrontObjects_InPathCalculationWithPredictedObjPositions_CreateInPathDataTTR_CalculateAccelerationAndPredictPosition_NoPrediction_NoOperation18 "autosar_swc_aeb/autosar_swc_aeb_Step_sys/Subsystem Reference/AEB Function/Run_AsyEvlrCritEve_Step_Func/Run_AsyEvlrCritEve_Step_Func/TAWrapper/PreProcessor/ObjectPreProcessor/ObjectPreProcessorLoop/ValidObject/SafetyMarginFrontObjects/InPathCalculationWithPredictedObjPositions/CreateInPathDataTTR/CalculateAccelerationAndPredictPosition/NoPrediction/NoOperation18" /begin REF_MEASUREMENT autosar_swc_aeb_rtARID_DEF.ALatObj /end REF_MEASUREMENT /end GROUP
/begin GROUP autosar_swc_aeb_autosar_swc_aeb_Step_sys_Subsystem_Reference_AEB_Function_Run_AsyEvlrCritEve_Step_Func_Run_AsyEvlrCritEve_Step_Func_TAWrapper_PreProcessor_ObjectPreProcessor_ObjectPreProcessorLoop_ValidObject_SafetyMarginFrontObjects_InPathCalculationWithPredictedObjPositions_CreateInPathDataTTR_CalculateAccelerationAndPredictPosition_NoPrediction_NoOperation19 "autosar_swc_aeb/autosar_swc_aeb_Step_sys/Subsystem Reference/AEB Function/Run_AsyEvlrCritEve_Step_Func/Run_AsyEvlrCritEve_Step_Func/TAWrapper/PreProcessor/ObjectPreProcessor/ObjectPreProcessorLoop/ValidObject/SafetyMarginFrontObjects/InPathCalculationWithPredictedObjPositions/CreateInPathDataTTR/CalculateAccelerationAndPredictPosition/NoPrediction/NoOperation19" /begin REF_MEASUREMENT autosar_swc_aeb_rtARID_DEF.ALatObj_p /end REF_MEASUREMENT /end GROUP
/begin GROUP autosar_swc_aeb_autosar_swc_aeb_Step_sys_Subsystem_Reference_AEB_Function_Run_AsyEvlrCritEve_Step_Func_Run_AsyEvlrCritEve_Step_Func_TAWrapper_PreProcessor_ObjectPreProcessor_ObjectPreProcessorLoop_ValidObject_SafetyMarginFrontObjects_InPathCalculationWithPredictedObjPositions_CreateInPathDataTTR_CalculateAccelerationAndPredictPosition_NoPrediction_NoOperation2 "autosar_swc_aeb/autosar_swc_aeb_Step_sys/Subsystem Reference/AEB Function/Run_AsyEvlrCritEve_Step_Func/Run_AsyEvlrCritEve_Step_Func/TAWrapper/PreProcessor/ObjectPreProcessor/ObjectPreProcessorLoop/ValidObject/SafetyMarginFrontObjects/InPathCalculationWithPredictedObjPositions/CreateInPathDataTTR/CalculateAccelerationAndPredictPosition/NoPrediction/NoOperation2" /begin REF_MEASUREMENT autosar_swc_aeb_rtARID_DEF.VLgtObj /end REF_MEASUREMENT /end GROUP
/begin GROUP autosar_swc_aeb_autosar_swc_aeb_Step_sys_Subsystem_Reference_AEB_Function_Run_AsyEvlrCritEve_Step_Func_Run_AsyEvlrCritEve_Step_Func_TAWrapper_PreProcessor_ObjectPreProcessor_ObjectPreProcessorLoop_ValidObject_SafetyMarginFrontObjects_InPathCalculationWithPredictedObjPositions_CreateInPathDataTTR_CalculateAccelerationAndPredictPosition_NoPrediction_NoOperation20 "autosar_swc_aeb/autosar_swc_aeb_Step_sys/Subsystem Reference/AEB Function/Run_AsyEvlrCritEve_Step_Func/Run_AsyEvlrCritEve_Step_Func/TAWrapper/PreProcessor/ObjectPreProcessor/ObjectPreProcessorLoop/ValidObject/SafetyMarginFrontObjects/InPathCalculationWithPredictedObjPositions/CreateInPathDataTTR/CalculateAccelerationAndPredictPosition/NoPrediction/NoOperation20" /begin REF_MEASUREMENT autosar_swc_aeb_rtARID_DEF.CrvtObj /end REF_MEASUREMENT /end GROUP
/begin GROUP autosar_swc_aeb_autosar_swc_aeb_Step_sys_Subsystem_Reference_AEB_Function_Run_AsyEvlrCritEve_Step_Func_Run_AsyEvlrCritEve_Step_Func_TAWrapper_PreProcessor_ObjectPreProcessor_ObjectPreProcessorLoop_ValidObject_SafetyMarginFrontObjects_InPathCalculationWithPredictedObjPositions_CreateInPathDataTTR_CalculateAccelerationAndPredictPosition_NoPrediction_NoOperation21 "autosar_swc_aeb/autosar_swc_aeb_Step_sys/Subsystem Reference/AEB Function/Run_AsyEvlrCritEve_Step_Func/Run_AsyEvlrCritEve_Step_Func/TAWrapper/PreProcessor/ObjectPreProcessor/ObjectPreProcessorLoop/ValidObject/SafetyMarginFrontObjects/InPathCalculationWithPredictedObjPositions/CreateInPathDataTTR/CalculateAccelerationAndPredictPosition/NoPrediction/NoOperation21" /begin REF_MEASUREMENT autosar_swc_aeb_rtARID_DEF.VLgtObj_g /end REF_MEASUREMENT /end GROUP
/begin GROUP autosar_swc_aeb_autosar_swc_aeb_Step_sys_Subsystem_Reference_AEB_Function_Run_AsyEvlrCritEve_Step_Func_Run_AsyEvlrCritEve_Step_Func_TAWrapper_PreProcessor_ObjectPreProcessor_ObjectPreProcessorLoop_ValidObject_SafetyMarginFrontObjects_InPathCalculationWithPredictedObjPositions_CreateInPathDataTTR_CalculateAccelerationAndPredictPosition_NoPrediction_NoOperation22 "autosar_swc_aeb/autosar_swc_aeb_Step_sys/Subsystem Reference/AEB Function/Run_AsyEvlrCritEve_Step_Func/Run_AsyEvlrCritEve_Step_Func/TAWrapper/PreProcessor/ObjectPreProcessor/ObjectPreProcessorLoop/ValidObject/SafetyMarginFrontObjects/InPathCalculationWithPredictedObjPositions/CreateInPathDataTTR/CalculateAccelerationAndPredictPosition/NoPrediction/NoOperation22" /begin REF_MEASUREMENT autosar_swc_aeb_rtARID_DEF.HeadingObj_h /end REF_MEASUREMENT /end GROUP
/begin GROUP autosar_swc_aeb_autosar_swc_aeb_Step_sys_Subsystem_Reference_AEB_Function_Run_AsyEvlrCritEve_Step_Func_Run_AsyEvlrCritEve_Step_Func_TAWrapper_PreProcessor_ObjectPreProcessor_ObjectPreProcessorLoop_ValidObject_SafetyMarginFrontObjects_InPathCalculationWithPredictedObjPositions_CreateInPathDataTTR_CalculateAccelerationAndPredictPosition_NoPrediction_NoOperation23 "autosar_swc_aeb/autosar_swc_aeb_Step_sys/Subsystem Reference/AEB Function/Run_AsyEvlrCritEve_Step_Func/Run_AsyEvlrCritEve_Step_Func/TAWrapper/PreProcessor/ObjectPreProcessor/ObjectPreProcessorLoop/ValidObject/SafetyMarginFrontObjects/InPathCalculationWithPredictedObjPositions/CreateInPathDataTTR/CalculateAccelerationAndPredictPosition/NoPrediction/NoOperation23" /begin REF_MEASUREMENT autosar_swc_aeb_rtARID_DEF.HeadingObj_hj /end REF_MEASUREMENT /end GROUP
/begin GROUP autosar_swc_aeb_autosar_swc_aeb_Step_sys_Subsystem_Reference_AEB_Function_Run_AsyEvlrCritEve_Step_Func_Run_AsyEvlrCritEve_Step_Func_TAWrapper_PreProcessor_ObjectPreProcessor_ObjectPreProcessorLoop_ValidObject_SafetyMarginFrontObjects_InPathCalculationWithPredictedObjPositions_CreateInPathDataTTR_CalculateAccelerationAndPredictPosition_NoPrediction_NoOperation24 "autosar_swc_aeb/autosar_swc_aeb_Step_sys/Subsystem Reference/AEB Function/Run_AsyEvlrCritEve_Step_Func/Run_AsyEvlrCritEve_Step_Func/TAWrapper/PreProcessor/ObjectPreProcessor/ObjectPreProcessorLoop/ValidObject/SafetyMarginFrontObjects/InPathCalculationWithPredictedObjPositions/CreateInPathDataTTR/CalculateAccelerationAndPredictPosition/NoPrediction/NoOperation24" /begin REF_MEASUREMENT autosar_swc_aeb_rtARID_DEF.VLatObj_b /end REF_MEASUREMENT /end GROUP
/begin GROUP autosar_swc_aeb_autosar_swc_aeb_Step_sys_Subsystem_Reference_AEB_Function_Run_AsyEvlrCritEve_Step_Func_Run_AsyEvlrCritEve_Step_Func_TAWrapper_PreProcessor_ObjectPreProcessor_ObjectPreProcessorLoop_ValidObject_SafetyMarginFrontObjects_InPathCalculationWithPredictedObjPositions_CreateInPathDataTTR_CalculateAccelerationAndPredictPosition_NoPrediction_NoOperation25 "autosar_swc_aeb/autosar_swc_aeb_Step_sys/Subsystem Reference/AEB Function/Run_AsyEvlrCritEve_Step_Func/Run_AsyEvlrCritEve_Step_Func/TAWrapper/PreProcessor/ObjectPreProcessor/ObjectPreProcessorLoop/ValidObject/SafetyMarginFrontObjects/InPathCalculationWithPredictedObjPositions/CreateInPathDataTTR/CalculateAccelerationAndPredictPosition/NoPrediction/NoOperation25" /begin REF_MEASUREMENT autosar_swc_aeb_rtARID_DEF.PosnLgtObj_cki /end REF_MEASUREMENT /end GROUP
/begin GROUP autosar_swc_aeb_autosar_swc_aeb_Step_sys_Subsystem_Reference_AEB_Function_Run_AsyEvlrCritEve_Step_Func_Run_AsyEvlrCritEve_Step_Func_TAWrapper_PreProcessor_ObjectPreProcessor_ObjectPreProcessorLoop_ValidObject_SafetyMarginFrontObjects_InPathCalculationWithPredictedObjPositions_CreateInPathDataTTR_CalculateAccelerationAndPredictPosition_NoPrediction_NoOperation26 "autosar_swc_aeb/autosar_swc_aeb_Step_sys/Subsystem Reference/AEB Function/Run_AsyEvlrCritEve_Step_Func/Run_AsyEvlrCritEve_Step_Func/TAWrapper/PreProcessor/ObjectPreProcessor/ObjectPreProcessorLoop/ValidObject/SafetyMarginFrontObjects/InPathCalculationWithPredictedObjPositions/CreateInPathDataTTR/CalculateAccelerationAndPredictPosition/NoPrediction/NoOperation26" /begin REF_MEASUREMENT autosar_swc_aeb_rtARID_DEF.PosnLatObj_krk /end REF_MEASUREMENT /end GROUP
/begin GROUP autosar_swc_aeb_autosar_swc_aeb_Step_sys_Subsystem_Reference_AEB_Function_Run_AsyEvlrCritEve_Step_Func_Run_AsyEvlrCritEve_Step_Func_TAWrapper_PreProcessor_ObjectPreProcessor_ObjectPreProcessorLoop_ValidObject_SafetyMarginFrontObjects_InPathCalculationWithPredictedObjPositions_CreateInPathDataTTR_CalculateAccelerationAndPredictPosition_NoPrediction_NoOperation27 "autosar_swc_aeb/autosar_swc_aeb_Step_sys/Subsystem Reference/AEB Function/Run_AsyEvlrCritEve_Step_Func/Run_AsyEvlrCritEve_Step_Func/TAWrapper/PreProcessor/ObjectPreProcessor/ObjectPreProcessorLoop/ValidObject/SafetyMarginFrontObjects/InPathCalculationWithPredictedObjPositions/CreateInPathDataTTR/CalculateAccelerationAndPredictPosition/NoPrediction/NoOperation27" /begin REF_MEASUREMENT autosar_swc_aeb_rtARID_DEF.VLgtObj_gh1 /end REF_MEASUREMENT /end GROUP
/begin GROUP autosar_swc_aeb_autosar_swc_aeb_Step_sys_Subsystem_Reference_AEB_Function_Run_AsyEvlrCritEve_Step_Func_Run_AsyEvlrCritEve_Step_Func_TAWrapper_PreProcessor_ObjectPreProcessor_ObjectPreProcessorLoop_ValidObject_SafetyMarginFrontObjects_InPathCalculationWithPredictedObjPositions_CreateInPathDataTTR_CalculateAccelerationAndPredictPosition_NoPrediction_NoOperation28 "autosar_swc_aeb/autosar_swc_aeb_Step_sys/Subsystem Reference/AEB Function/Run_AsyEvlrCritEve_Step_Func/Run_AsyEvlrCritEve_Step_Func/TAWrapper/PreProcessor/ObjectPreProcessor/ObjectPreProcessorLoop/ValidObject/SafetyMarginFrontObjects/InPathCalculationWithPredictedObjPositions/CreateInPathDataTTR/CalculateAccelerationAndPredictPosition/NoPrediction/NoOperation28" /begin REF_MEASUREMENT autosar_swc_aeb_rtARID_DEF.VLatObj_bmz /end REF_MEASUREMENT /end GROUP
/begin GROUP autosar_swc_aeb_autosar_swc_aeb_Step_sys_Subsystem_Reference_AEB_Function_Run_AsyEvlrCritEve_Step_Func_Run_AsyEvlrCritEve_Step_Func_TAWrapper_PreProcessor_ObjectPreProcessor_ObjectPreProcessorLoop_ValidObject_SafetyMarginFrontObjects_InPathCalculationWithPredictedObjPositions_CreateInPathDataTTR_CalculateAccelerationAndPredictPosition_NoPrediction_NoOperation29 "autosar_swc_aeb/autosar_swc_aeb_Step_sys/Subsystem Reference/AEB Function/Run_AsyEvlrCritEve_Step_Func/Run_AsyEvlrCritEve_Step_Func/TAWrapper/PreProcessor/ObjectPreProcessor/ObjectPreProcessorLoop/ValidObject/SafetyMarginFrontObjects/InPathCalculationWithPredictedObjPositions/CreateInPathDataTTR/CalculateAccelerationAndPredictPosition/NoPrediction/NoOperation29" /begin REF_MEASUREMENT autosar_swc_aeb_rtARID_DEF.HeadingObj_hja /end REF_MEASUREMENT /end GROUP
/begin GROUP autosar_swc_aeb_autosar_swc_aeb_Step_sys_Subsystem_Reference_AEB_Function_Run_AsyEvlrCritEve_Step_Func_Run_AsyEvlrCritEve_Step_Func_TAWrapper_PreProcessor_ObjectPreProcessor_ObjectPreProcessorLoop_ValidObject_SafetyMarginFrontObjects_InPathCalculationWithPredictedObjPositions_CreateInPathDataTTR_CalculateAccelerationAndPredictPosition_NoPrediction_NoOperation3 "autosar_swc_aeb/autosar_swc_aeb_Step_sys/Subsystem Reference/AEB Function/Run_AsyEvlrCritEve_Step_Func/Run_AsyEvlrCritEve_Step_Func/TAWrapper/PreProcessor/ObjectPreProcessor/ObjectPreProcessorLoop/ValidObject/SafetyMarginFrontObjects/InPathCalculationWithPredictedObjPositions/CreateInPathDataTTR/CalculateAccelerationAndPredictPosition/NoPrediction/NoOperation3" /begin REF_MEASUREMENT autosar_swc_aeb_rtARID_DEF.VLatObj /end REF_MEASUREMENT /end GROUP
/begin GROUP autosar_swc_aeb_autosar_swc_aeb_Step_sys_Subsystem_Reference_AEB_Function_Run_AsyEvlrCritEve_Step_Func_Run_AsyEvlrCritEve_Step_Func_TAWrapper_PreProcessor_ObjectPreProcessor_ObjectPreProcessorLoop_ValidObject_SafetyMarginFrontObjects_InPathCalculationWithPredictedObjPositions_CreateInPathDataTTR_CalculateAccelerationAndPredictPosition_NoPrediction_NoOperation30 "autosar_swc_aeb/autosar_swc_aeb_Step_sys/Subsystem Reference/AEB Function/Run_AsyEvlrCritEve_Step_Func/Run_AsyEvlrCritEve_Step_Func/TAWrapper/PreProcessor/ObjectPreProcessor/ObjectPreProcessorLoop/ValidObject/SafetyMarginFrontObjects/InPathCalculationWithPredictedObjPositions/CreateInPathDataTTR/CalculateAccelerationAndPredictPosition/NoPrediction/NoOperation30" /begin REF_MEASUREMENT autosar_swc_aeb_rtARID_DEF.ALgtObj_i5c /end REF_MEASUREMENT /end GROUP
/begin GROUP autosar_swc_aeb_autosar_swc_aeb_Step_sys_Subsystem_Reference_AEB_Function_Run_AsyEvlrCritEve_Step_Func_Run_AsyEvlrCritEve_Step_Func_TAWrapper_PreProcessor_ObjectPreProcessor_ObjectPreProcessorLoop_ValidObject_SafetyMarginFrontObjects_InPathCalculationWithPredictedObjPositions_CreateInPathDataTTR_CalculateAccelerationAndPredictPosition_NoPrediction_NoOperation31 "autosar_swc_aeb/autosar_swc_aeb_Step_sys/Subsystem Reference/AEB Function/Run_AsyEvlrCritEve_Step_Func/Run_AsyEvlrCritEve_Step_Func/TAWrapper/PreProcessor/ObjectPreProcessor/ObjectPreProcessorLoop/ValidObject/SafetyMarginFrontObjects/InPathCalculationWithPredictedObjPositions/CreateInPathDataTTR/CalculateAccelerationAndPredictPosition/NoPrediction/NoOperation31" /begin REF_MEASUREMENT autosar_swc_aeb_rtARID_DEF.ALatObj_p41 /end REF_MEASUREMENT /end GROUP
/begin GROUP autosar_swc_aeb_autosar_swc_aeb_Step_sys_Subsystem_Reference_AEB_Function_Run_AsyEvlrCritEve_Step_Func_Run_AsyEvlrCritEve_Step_Func_TAWrapper_PreProcessor_ObjectPreProcessor_ObjectPreProcessorLoop_ValidObject_SafetyMarginFrontObjects_InPathCalculationWithPredictedObjPositions_CreateInPathDataTTR_CalculateAccelerationAndPredictPosition_NoPrediction_NoOperation32 "autosar_swc_aeb/autosar_swc_aeb_Step_sys/Subsystem Reference/AEB Function/Run_AsyEvlrCritEve_Step_Func/Run_AsyEvlrCritEve_Step_Func/TAWrapper/PreProcessor/ObjectPreProcessor/ObjectPreProcessorLoop/ValidObject/SafetyMarginFrontObjects/InPathCalculationWithPredictedObjPositions/CreateInPathDataTTR/CalculateAccelerationAndPredictPosition/NoPrediction/NoOperation32" /begin REF_MEASUREMENT autosar_swc_aeb_rtARID_DEF.ALgtObj_i5 /end REF_MEASUREMENT /end GROUP
/begin GROUP autosar_swc_aeb_autosar_swc_aeb_Step_sys_Subsystem_Reference_AEB_Function_Run_AsyEvlrCritEve_Step_Func_Run_AsyEvlrCritEve_Step_Func_TAWrapper_PreProcessor_ObjectPreProcessor_ObjectPreProcessorLoop_ValidObject_SafetyMarginFrontObjects_InPathCalculationWithPredictedObjPositions_CreateInPathDataTTR_CalculateAccelerationAndPredictPosition_NoPrediction_NoOperation33 "autosar_swc_aeb/autosar_swc_aeb_Step_sys/Subsystem Reference/AEB Function/Run_AsyEvlrCritEve_Step_Func/Run_AsyEvlrCritEve_Step_Func/TAWrapper/PreProcessor/ObjectPreProcessor/ObjectPreProcessorLoop/ValidObject/SafetyMarginFrontObjects/InPathCalculationWithPredictedObjPositions/CreateInPathDataTTR/CalculateAccelerationAndPredictPosition/NoPrediction/NoOperation33" /begin REF_MEASUREMENT autosar_swc_aeb_rtARID_DEF.ALatObj_p4 /end REF_MEASUREMENT /end GROUP
/begin GROUP autosar_swc_aeb_autosar_swc_aeb_Step_sys_Subsystem_Reference_AEB_Function_Run_AsyEvlrCritEve_Step_Func_Run_AsyEvlrCritEve_Step_Func_TAWrapper_PreProcessor_ObjectPreProcessor_ObjectPreProcessorLoop_ValidObject_SafetyMarginFrontObjects_InPathCalculationWithPredictedObjPositions_CreateInPathDataTTR_CalculateAccelerationAndPredictPosition_NoPrediction_NoOperation34 "autosar_swc_aeb/autosar_swc_aeb_Step_sys/Subsystem Reference/AEB Function/Run_AsyEvlrCritEve_Step_Func/Run_AsyEvlrCritEve_Step_Func/TAWrapper/PreProcessor/ObjectPreProcessor/ObjectPreProcessorLoop/ValidObject/SafetyMarginFrontObjects/InPathCalculationWithPredictedObjPositions/CreateInPathDataTTR/CalculateAccelerationAndPredictPosition/NoPrediction/NoOperation34" /begin REF_MEASUREMENT autosar_swc_aeb_rtARID_DEF.CrvtObj_a /end REF_MEASUREMENT /end GROUP
/begin GROUP autosar_swc_aeb_autosar_swc_aeb_Step_sys_Subsystem_Reference_AEB_Function_Run_AsyEvlrCritEve_Step_Func_Run_AsyEvlrCritEve_Step_Func_TAWrapper_PreProcessor_ObjectPreProcessor_ObjectPreProcessorLoop_ValidObject_SafetyMarginFrontObjects_InPathCalculationWithPredictedObjPositions_CreateInPathDataTTR_CalculateAccelerationAndPredictPosition_NoPrediction_NoOperation4 "autosar_swc_aeb/autosar_swc_aeb_Step_sys/Subsystem Reference/AEB Function/Run_AsyEvlrCritEve_Step_Func/Run_AsyEvlrCritEve_Step_Func/TAWrapper/PreProcessor/ObjectPreProcessor/ObjectPreProcessorLoop/ValidObject/SafetyMarginFrontObjects/InPathCalculationWithPredictedObjPositions/CreateInPathDataTTR/CalculateAccelerationAndPredictPosition/NoPrediction/NoOperation4" /begin REF_MEASUREMENT autosar_swc_aeb_rtARID_DEF.HeadingObj_hja3 /end REF_MEASUREMENT /end GROUP
/begin GROUP autosar_swc_aeb_autosar_swc_aeb_Step_sys_Subsystem_Reference_AEB_Function_Run_AsyEvlrCritEve_Step_Func_Run_AsyEvlrCritEve_Step_Func_TAWrapper_PreProcessor_ObjectPreProcessor_ObjectPreProcessorLoop_ValidObject_SafetyMarginFrontObjects_InPathCalculationWithPredictedObjPositions_CreateInPathDataTTR_CalculateAccelerationAndPredictPosition_NoPrediction_NoOperation5 "autosar_swc_aeb/autosar_swc_aeb_Step_sys/Subsystem Reference/AEB Function/Run_AsyEvlrCritEve_Step_Func/Run_AsyEvlrCritEve_Step_Func/TAWrapper/PreProcessor/ObjectPreProcessor/ObjectPreProcessorLoop/ValidObject/SafetyMarginFrontObjects/InPathCalculationWithPredictedObjPositions/CreateInPathDataTTR/CalculateAccelerationAndPredictPosition/NoPrediction/NoOperation5" /begin REF_MEASUREMENT autosar_swc_aeb_rtARID_DEF.PosnLgtObj_c /end REF_MEASUREMENT /end GROUP
/begin GROUP autosar_swc_aeb_autosar_swc_aeb_Step_sys_Subsystem_Reference_AEB_Function_Run_AsyEvlrCritEve_Step_Func_Run_AsyEvlrCritEve_Step_Func_TAWrapper_PreProcessor_ObjectPreProcessor_ObjectPreProcessorLoop_ValidObject_SafetyMarginFrontObjects_InPathCalculationWithPredictedObjPositions_CreateInPathDataTTR_CalculateAccelerationAndPredictPosition_NoPrediction_NoOperation6 "autosar_swc_aeb/autosar_swc_aeb_Step_sys/Subsystem Reference/AEB Function/Run_AsyEvlrCritEve_Step_Func/Run_AsyEvlrCritEve_Step_Func/TAWrapper/PreProcessor/ObjectPreProcessor/ObjectPreProcessorLoop/ValidObject/SafetyMarginFrontObjects/InPathCalculationWithPredictedObjPositions/CreateInPathDataTTR/CalculateAccelerationAndPredictPosition/NoPrediction/NoOperation6" /begin REF_MEASUREMENT autosar_swc_aeb_rtARID_DEF.PosnLatObj_k /end REF_MEASUREMENT /end GROUP
/begin GROUP autosar_swc_aeb_autosar_swc_aeb_Step_sys_Subsystem_Reference_AEB_Function_Run_AsyEvlrCritEve_Step_Func_Run_AsyEvlrCritEve_Step_Func_TAWrapper_PreProcessor_ObjectPreProcessor_ObjectPreProcessorLoop_ValidObject_SafetyMarginFrontObjects_InPathCalculationWithPredictedObjPositions_CreateInPathDataTTR_CalculateAccelerationAndPredictPosition_NoPrediction_NoOperation7 "autosar_swc_aeb/autosar_swc_aeb_Step_sys/Subsystem Reference/AEB Function/Run_AsyEvlrCritEve_Step_Func/Run_AsyEvlrCritEve_Step_Func/TAWrapper/PreProcessor/ObjectPreProcessor/ObjectPreProcessorLoop/ValidObject/SafetyMarginFrontObjects/InPathCalculationWithPredictedObjPositions/CreateInPathDataTTR/CalculateAccelerationAndPredictPosition/NoPrediction/NoOperation7" /begin REF_MEASUREMENT autosar_swc_aeb_rtARID_DEF.VLgtObj_gh1e /end REF_MEASUREMENT /end GROUP
/begin GROUP autosar_swc_aeb_autosar_swc_aeb_Step_sys_Subsystem_Reference_AEB_Function_Run_AsyEvlrCritEve_Step_Func_Run_AsyEvlrCritEve_Step_Func_TAWrapper_PreProcessor_ObjectPreProcessor_ObjectPreProcessorLoop_ValidObject_SafetyMarginFrontObjects_InPathCalculationWithPredictedObjPositions_CreateInPathDataTTR_CalculateAccelerationAndPredictPosition_NoPrediction_NoOperation8 "autosar_swc_aeb/autosar_swc_aeb_Step_sys/Subsystem Reference/AEB Function/Run_AsyEvlrCritEve_Step_Func/Run_AsyEvlrCritEve_Step_Func/TAWrapper/PreProcessor/ObjectPreProcessor/ObjectPreProcessorLoop/ValidObject/SafetyMarginFrontObjects/InPathCalculationWithPredictedObjPositions/CreateInPathDataTTR/CalculateAccelerationAndPredictPosition/NoPrediction/NoOperation8" /begin REF_MEASUREMENT autosar_swc_aeb_rtARID_DEF.VLatObj_bmzl /end REF_MEASUREMENT /end GROUP
/begin GROUP autosar_swc_aeb_autosar_swc_aeb_Step_sys_Subsystem_Reference_AEB_Function_Run_AsyEvlrCritEve_Step_Func_Run_AsyEvlrCritEve_Step_Func_TAWrapper_PreProcessor_ObjectPreProcessor_ObjectPreProcessorLoop_ValidObject_SafetyMarginFrontObjects_InPathCalculationWithPredictedObjPositions_CreateInPathDataTTR_CalculateAccelerationAndPredictPosition_NoPrediction_NoOperation9 "autosar_swc_aeb/autosar_swc_aeb_Step_sys/Subsystem Reference/AEB Function/Run_AsyEvlrCritEve_Step_Func/Run_AsyEvlrCritEve_Step_Func/TAWrapper/PreProcessor/ObjectPreProcessor/ObjectPreProcessorLoop/ValidObject/SafetyMarginFrontObjects/InPathCalculationWithPredictedObjPositions/CreateInPathDataTTR/CalculateAccelerationAndPredictPosition/NoPrediction/NoOperation9" /begin REF_MEASUREMENT autosar_swc_aeb_rtARID_DEF.HeadingObj /end REF_MEASUREMENT /end GROUP
/begin GROUP autosar_swc_aeb_autosar_swc_aeb_Step_sys_Subsystem_Reference_AEB_Function_Run_AsyEvlrCritEve_Step_Func_Run_AsyEvlrCritEve_Step_Func_TAWrapper_PreProcessor_ObjectPreProcessor_ObjectPreProcessorLoop_ValidObject_SafetyMarginFrontObjects_InPathCalculationWithPredictedObjPositions_CreateInPathDataTTR_CalculateAccelerationAndPredictPosition_PredictHostLateralPositionAtTTR "autosar_swc_aeb/autosar_swc_aeb_Step_sys/Subsystem Reference/AEB Function/Run_AsyEvlrCritEve_Step_Func/Run_AsyEvlrCritEve_Step_Func/TAWrapper/PreProcessor/ObjectPreProcessor/ObjectPreProcessorLoop/ValidObject/SafetyMarginFrontObjects/InPathCalculationWithPredictedObjPositions/CreateInPathDataTTR/CalculateAccelerationAndPredictPosition/PredictHostLateralPositionAtTTR"
 /begin SUB_GROUP autosar_swc_aeb_autosar_swc_aeb_Step_sys_Subsystem_Reference_AEB_Function_Run_AsyEvlrCritEve_Step_Func_Run_AsyEvlrCritEve_Step_Func_TAWrapper_PreProcessor_ObjectPreProcessor_ObjectPreProcessorLoop_ValidObject_SafetyMarginFrontObjects_InPathCalculationWithPredictedObjPositions_CreateInPathDataTTR_CalculateAccelerationAndPredictPosition_PredictHostLateralPositionAtTTR_CalculateHeading autosar_swc_aeb_autosar_swc_aeb_Step_sys_Subsystem_Reference_AEB_Function_Run_AsyEvlrCritEve_Step_Func_Run_AsyEvlrCritEve_Step_Func_TAWrapper_PreProcessor_ObjectPreProcessor_ObjectPreProcessorLoop_ValidObject_SafetyMarginFrontObjects_InPathCalculationWithPredictedObjPositions_CreateInPathDataTTR_CalculateAccelerationAndPredictPosition_PredictHostLateralPositionAtTTR_SelectSegment /end SUB_GROUP
/end GROUP
/begin GROUP autosar_swc_aeb_autosar_swc_aeb_Step_sys_Subsystem_Reference_AEB_Function_Run_AsyEvlrCritEve_Step_Func_Run_AsyEvlrCritEve_Step_Func_TAWrapper_PreProcessor_ObjectPreProcessor_ObjectPreProcessorLoop_ValidObject_SafetyMarginFrontObjects_InPathCalculationWithPredictedObjPositions_CreateInPathDataTTR_CalculateAccelerationAndPredictPosition_PredictHostLateralPositionAtTTR_CalculateHeading "autosar_swc_aeb/autosar_swc_aeb_Step_sys/Subsystem Reference/AEB Function/Run_AsyEvlrCritEve_Step_Func/Run_AsyEvlrCritEve_Step_Func/TAWrapper/PreProcessor/ObjectPreProcessor/ObjectPreProcessorLoop/ValidObject/SafetyMarginFrontObjects/InPathCalculationWithPredictedObjPositions/CreateInPathDataTTR/CalculateAccelerationAndPredictPosition/PredictHostLateralPositionAtTTR/CalculateHeading"
 /begin SUB_GROUP autosar_swc_aeb_autosar_swc_aeb_Step_sys_Subsystem_Reference_AEB_Function_Run_AsyEvlrCritEve_Step_Func_Run_AsyEvlrCritEve_Step_Func_TAWrapper_PreProcessor_ObjectPreProcessor_ObjectPreProcessorLoop_ValidObject_SafetyMarginFrontObjects_InPathCalculationWithPredictedObjPositions_CreateInPathDataTTR_CalculateAccelerationAndPredictPosition_PredictHostLateralPositionAtTTR_CalculateHeading_CheckSpeed autosar_swc_aeb_autosar_swc_aeb_Step_sys_Subsystem_Reference_AEB_Function_Run_AsyEvlrCritEve_Step_Func_Run_AsyEvlrCritEve_Step_Func_TAWrapper_PreProcessor_ObjectPreProcessor_ObjectPreProcessorLoop_ValidObject_SafetyMarginFrontObjects_InPathCalculationWithPredictedObjPositions_CreateInPathDataTTR_CalculateAccelerationAndPredictPosition_PredictHostLateralPositionAtTTR_CalculateHeading_ExtractVelocitiesAtStartOfSegments /end SUB_GROUP
/end GROUP
/begin GROUP autosar_swc_aeb_autosar_swc_aeb_Step_sys_Subsystem_Reference_AEB_Function_Run_AsyEvlrCritEve_Step_Func_Run_AsyEvlrCritEve_Step_Func_TAWrapper_PreProcessor_ObjectPreProcessor_ObjectPreProcessorLoop_ValidObject_SafetyMarginFrontObjects_InPathCalculationWithPredictedObjPositions_CreateInPathDataTTR_CalculateAccelerationAndPredictPosition_PredictHostLateralPositionAtTTR_CalculateHeading_ExtractVelocitiesAtStartOfSegments "autosar_swc_aeb/autosar_swc_aeb_Step_sys/Subsystem Reference/AEB Function/Run_AsyEvlrCritEve_Step_Func/Run_AsyEvlrCritEve_Step_Func/TAWrapper/PreProcessor/ObjectPreProcessor/ObjectPreProcessorLoop/ValidObject/SafetyMarginFrontObjects/InPathCalculationWithPredictedObjPositions/CreateInPathDataTTR/CalculateAccelerationAndPredictPosition/PredictHostLateralPositionAtTTR/CalculateHeading/ExtractVelocitiesAtStartOfSegments"
 /begin SUB_GROUP autosar_swc_aeb_autosar_swc_aeb_Step_sys_Subsystem_Reference_AEB_Function_Run_AsyEvlrCritEve_Step_Func_Run_AsyEvlrCritEve_Step_Func_TAWrapper_PreProcessor_ObjectPreProcessor_ObjectPreProcessorLoop_ValidObject_SafetyMarginFrontObjects_InPathCalculationWithPredictedObjPositions_CreateInPathDataTTR_CalculateAccelerationAndPredictPosition_PredictHostLateralPositionAtTTR_CalculateHeading_ExtractVelocitiesAtStartOfSegments_CheckSpeed /end SUB_GROUP
/end GROUP
/begin GROUP autosar_swc_aeb_autosar_swc_aeb_Step_sys_Subsystem_Reference_AEB_Function_Run_AsyEvlrCritEve_Step_Func_Run_AsyEvlrCritEve_Step_Func_TAWrapper_PreProcessor_ObjectPreProcessor_ObjectPreProcessorLoop_ValidObject_SafetyMarginFrontObjects_InPathCalculationWithPredictedObjPositions_CreateInPathDataTTR_CalculateAccelerationAndPredictPosition_PredictHostLateralPositionAtTTR_SelectSegment "autosar_swc_aeb/autosar_swc_aeb_Step_sys/Subsystem Reference/AEB Function/Run_AsyEvlrCritEve_Step_Func/Run_AsyEvlrCritEve_Step_Func/TAWrapper/PreProcessor/ObjectPreProcessor/ObjectPreProcessorLoop/ValidObject/SafetyMarginFrontObjects/InPathCalculationWithPredictedObjPositions/CreateInPathDataTTR/CalculateAccelerationAndPredictPosition/PredictHostLateralPositionAtTTR/SelectSegment" /begin REF_MEASUREMENT autosar_swc_aeb_rtARID_DEF.LastSegment_g /end REF_MEASUREMENT /end GROUP
/begin GROUP autosar_swc_aeb_autosar_swc_aeb_Step_sys_Subsystem_Reference_AEB_Function_Run_AsyEvlrCritEve_Step_Func_Run_AsyEvlrCritEve_Step_Func_TAWrapper_PreProcessor_ObjectPreProcessor_ObjectPreProcessorLoop_ValidObject_SafetyMarginFrontObjects_InPathCalculationWithPredictedObjPositions_CreateInPathDataTTR_CheckBrakingAndSteering "autosar_swc_aeb/autosar_swc_aeb_Step_sys/Subsystem Reference/AEB Function/Run_AsyEvlrCritEve_Step_Func/Run_AsyEvlrCritEve_Step_Func/TAWrapper/PreProcessor/ObjectPreProcessor/ObjectPreProcessorLoop/ValidObject/SafetyMarginFrontObjects/InPathCalculationWithPredictedObjPositions/CreateInPathDataTTR/CheckBrakingAndSteering"
 /begin SUB_GROUP autosar_swc_aeb_autosar_swc_aeb_Step_sys_Subsystem_Reference_AEB_Function_Run_AsyEvlrCritEve_Step_Func_Run_AsyEvlrCritEve_Step_Func_TAWrapper_PreProcessor_ObjectPreProcessor_ObjectPreProcessorLoop_ValidObject_SafetyMarginFrontObjects_InPathCalculationWithPredictedObjPositions_CreateInPathDataTTR_CheckBrakingAndSteering_CheckIfObjectTriesToManoeuver /end SUB_GROUP
/end GROUP
/begin GROUP autosar_swc_aeb_autosar_swc_aeb_Step_sys_Subsystem_Reference_AEB_Function_Run_AsyEvlrCritEve_Step_Func_Run_AsyEvlrCritEve_Step_Func_TAWrapper_PreProcessor_ObjectPreProcessor_ObjectPreProcessorLoop_ValidObject_SafetyMarginFrontObjects_InPathCalculationWithPredictedObjPositions_CreateInPathDataTTR_CreateInPathData "autosar_swc_aeb/autosar_swc_aeb_Step_sys/Subsystem Reference/AEB Function/Run_AsyEvlrCritEve_Step_Func/Run_AsyEvlrCritEve_Step_Func/TAWrapper/PreProcessor/ObjectPreProcessor/ObjectPreProcessorLoop/ValidObject/SafetyMarginFrontObjects/InPathCalculationWithPredictedObjPositions/CreateInPathDataTTR/CreateInPathData"
 /begin SUB_GROUP autosar_swc_aeb_autosar_swc_aeb_Step_sys_Subsystem_Reference_AEB_Function_Run_AsyEvlrCritEve_Step_Func_Run_AsyEvlrCritEve_Step_Func_TAWrapper_PreProcessor_ObjectPreProcessor_ObjectPreProcessorLoop_ValidObject_SafetyMarginFrontObjects_InPathCalculationWithPredictedObjPositions_CreateInPathDataTTR_CreateInPathData_DetermineIfObjectIsBraking autosar_swc_aeb_autosar_swc_aeb_Step_sys_Subsystem_Reference_AEB_Function_Run_AsyEvlrCritEve_Step_Func_Run_AsyEvlrCritEve_Step_Func_TAWrapper_PreProcessor_ObjectPreProcessor_ObjectPreProcessorLoop_ValidObject_SafetyMarginFrontObjects_InPathCalculationWithPredictedObjPositions_CreateInPathDataTTR_CreateInPathData_DetermineInPathDataLongPredTime autosar_swc_aeb_autosar_swc_aeb_Step_sys_Subsystem_Reference_AEB_Function_Run_AsyEvlrCritEve_Step_Func_Run_AsyEvlrCritEve_Step_Func_TAWrapper_PreProcessor_ObjectPreProcessor_ObjectPreProcessorLoop_ValidObject_SafetyMarginFrontObjects_InPathCalculationWithPredictedObjPositions_CreateInPathDataTTR_CreateInPathData_DetermineInPathDataShortPredTime /end SUB_GROUP
/end GROUP
/begin GROUP autosar_swc_aeb_autosar_swc_aeb_Step_sys_Subsystem_Reference_AEB_Function_Run_AsyEvlrCritEve_Step_Func_Run_AsyEvlrCritEve_Step_Func_TAWrapper_PreProcessor_ObjectPreProcessor_ObjectPreProcessorLoop_ValidObject_SafetyMarginFrontObjects_InPathCalculationWithPredictedObjPositions_CreateInPathDataTTR_CreateInPathData_DetermineInPathDataLongPredTime "autosar_swc_aeb/autosar_swc_aeb_Step_sys/Subsystem Reference/AEB Function/Run_AsyEvlrCritEve_Step_Func/Run_AsyEvlrCritEve_Step_Func/TAWrapper/PreProcessor/ObjectPreProcessor/ObjectPreProcessorLoop/ValidObject/SafetyMarginFrontObjects/InPathCalculationWithPredictedObjPositions/CreateInPathDataTTR/CreateInPathData/DetermineInPathDataLongPredTime"
 /begin SUB_GROUP autosar_swc_aeb_autosar_swc_aeb_Step_sys_Subsystem_Reference_AEB_Function_Run_AsyEvlrCritEve_Step_Func_Run_AsyEvlrCritEve_Step_Func_TAWrapper_PreProcessor_ObjectPreProcessor_ObjectPreProcessorLoop_ValidObject_SafetyMarginFrontObjects_InPathCalculationWithPredictedObjPositions_CreateInPathDataTTR_CreateInPathData_DetermineInPathDataLongPredTime_ObjectWillBrake autosar_swc_aeb_autosar_swc_aeb_Step_sys_Subsystem_Reference_AEB_Function_Run_AsyEvlrCritEve_Step_Func_Run_AsyEvlrCritEve_Step_Func_TAWrapper_PreProcessor_ObjectPreProcessor_ObjectPreProcessorLoop_ValidObject_SafetyMarginFrontObjects_InPathCalculationWithPredictedObjPositions_CreateInPathDataTTR_CreateInPathData_DetermineInPathDataLongPredTime_ObjectWillSteerLeft autosar_swc_aeb_autosar_swc_aeb_Step_sys_Subsystem_Reference_AEB_Function_Run_AsyEvlrCritEve_Step_Func_Run_AsyEvlrCritEve_Step_Func_TAWrapper_PreProcessor_ObjectPreProcessor_ObjectPreProcessorLoop_ValidObject_SafetyMarginFrontObjects_InPathCalculationWithPredictedObjPositions_CreateInPathDataTTR_CreateInPathData_DetermineInPathDataLongPredTime_ObjectWillSteerRight /end SUB_GROUP
 /begin REF_MEASUREMENT autosar_swc_aeb_rtARID_DEF.ALgtObj autosar_swc_aeb_rtARID_DEF.ALgtObj_i autosar_swc_aeb_rtARID_DEF.ALgtObj_i5 /end REF_MEASUREMENT
/end GROUP
/begin GROUP autosar_swc_aeb_autosar_swc_aeb_Step_sys_Subsystem_Reference_AEB_Function_Run_AsyEvlrCritEve_Step_Func_Run_AsyEvlrCritEve_Step_Func_TAWrapper_PreProcessor_ObjectPreProcessor_ObjectPreProcessorLoop_ValidObject_SafetyMarginFrontObjects_InPathCalculationWithPredictedObjPositions_CreateInPathDataTTR_CreateInPathData_DetermineInPathDataLongPredTime_ObjectWillBrake "autosar_swc_aeb/autosar_swc_aeb_Step_sys/Subsystem Reference/AEB Function/Run_AsyEvlrCritEve_Step_Func/Run_AsyEvlrCritEve_Step_Func/TAWrapper/PreProcessor/ObjectPreProcessor/ObjectPreProcessorLoop/ValidObject/SafetyMarginFrontObjects/InPathCalculationWithPredictedObjPositions/CreateInPathDataTTR/CreateInPathData/DetermineInPathDataLongPredTime/ObjectWillBrake"
 /begin SUB_GROUP autosar_swc_aeb_autosar_swc_aeb_Step_sys_Subsystem_Reference_AEB_Function_Run_AsyEvlrCritEve_Step_Func_Run_AsyEvlrCritEve_Step_Func_TAWrapper_PreProcessor_ObjectPreProcessor_ObjectPreProcessorLoop_ValidObject_SafetyMarginFrontObjects_InPathCalculationWithPredictedObjPositions_CreateInPathDataTTR_CreateInPathData_DetermineInPathDataLongPredTime_ObjectWillBrake_NoOperation_3 autosar_swc_aeb_autosar_swc_aeb_Step_sys_Subsystem_Reference_AEB_Function_Run_AsyEvlrCritEve_Step_Func_Run_AsyEvlrCritEve_Step_Func_TAWrapper_PreProcessor_ObjectPreProcessor_ObjectPreProcessorLoop_ValidObject_SafetyMarginFrontObjects_InPathCalculationWithPredictedObjPositions_CreateInPathDataTTR_CreateInPathData_DetermineInPathDataLongPredTime_ObjectWillBrake_NoOperation_4 /end SUB_GROUP
/end GROUP
/begin GROUP autosar_swc_aeb_autosar_swc_aeb_Step_sys_Subsystem_Reference_AEB_Function_Run_AsyEvlrCritEve_Step_Func_Run_AsyEvlrCritEve_Step_Func_TAWrapper_PreProcessor_ObjectPreProcessor_ObjectPreProcessorLoop_ValidObject_SafetyMarginFrontObjects_InPathCalculationWithPredictedObjPositions_CreateInPathDataTTR_CreateInPathData_DetermineInPathDataLongPredTime_ObjectWillBrake_NoOperation_3 "autosar_swc_aeb/autosar_swc_aeb_Step_sys/Subsystem Reference/AEB Function/Run_AsyEvlrCritEve_Step_Func/Run_AsyEvlrCritEve_Step_Func/TAWrapper/PreProcessor/ObjectPreProcessor/ObjectPreProcessorLoop/ValidObject/SafetyMarginFrontObjects/InPathCalculationWithPredictedObjPositions/CreateInPathDataTTR/CreateInPathData/DetermineInPathDataLongPredTime/ObjectWillBrake/NoOperation_3" /begin REF_MEASUREMENT autosar_swc_aeb_rtARID_DEF.ALgtObj /end REF_MEASUREMENT /end GROUP
/begin GROUP autosar_swc_aeb_autosar_swc_aeb_Step_sys_Subsystem_Reference_AEB_Function_Run_AsyEvlrCritEve_Step_Func_Run_AsyEvlrCritEve_Step_Func_TAWrapper_PreProcessor_ObjectPreProcessor_ObjectPreProcessorLoop_ValidObject_SafetyMarginFrontObjects_InPathCalculationWithPredictedObjPositions_CreateInPathDataTTR_CreateInPathData_DetermineInPathDataLongPredTime_ObjectWillBrake_NoOperation_4 "autosar_swc_aeb/autosar_swc_aeb_Step_sys/Subsystem Reference/AEB Function/Run_AsyEvlrCritEve_Step_Func/Run_AsyEvlrCritEve_Step_Func/TAWrapper/PreProcessor/ObjectPreProcessor/ObjectPreProcessorLoop/ValidObject/SafetyMarginFrontObjects/InPathCalculationWithPredictedObjPositions/CreateInPathDataTTR/CreateInPathData/DetermineInPathDataLongPredTime/ObjectWillBrake/NoOperation_4" /begin REF_MEASUREMENT autosar_swc_aeb_rtARID_DEF.ALatObj /end REF_MEASUREMENT /end GROUP
/begin GROUP autosar_swc_aeb_autosar_swc_aeb_Step_sys_Subsystem_Reference_AEB_Function_Run_AsyEvlrCritEve_Step_Func_Run_AsyEvlrCritEve_Step_Func_TAWrapper_PreProcessor_ObjectPreProcessor_ObjectPreProcessorLoop_ValidObject_SafetyMarginFrontObjects_InPathCalculationWithPredictedObjPositions_CreateInPathDataTTR_CreateInPathData_DetermineInPathDataLongPredTime_ObjectWillSteerLeft "autosar_swc_aeb/autosar_swc_aeb_Step_sys/Subsystem Reference/AEB Function/Run_AsyEvlrCritEve_Step_Func/Run_AsyEvlrCritEve_Step_Func/TAWrapper/PreProcessor/ObjectPreProcessor/ObjectPreProcessorLoop/ValidObject/SafetyMarginFrontObjects/InPathCalculationWithPredictedObjPositions/CreateInPathDataTTR/CreateInPathData/DetermineInPathDataLongPredTime/ObjectWillSteerLeft"
 /begin SUB_GROUP autosar_swc_aeb_autosar_swc_aeb_Step_sys_Subsystem_Reference_AEB_Function_Run_AsyEvlrCritEve_Step_Func_Run_AsyEvlrCritEve_Step_Func_TAWrapper_PreProcessor_ObjectPreProcessor_ObjectPreProcessorLoop_ValidObject_SafetyMarginFrontObjects_InPathCalculationWithPredictedObjPositions_CreateInPathDataTTR_CreateInPathData_DetermineInPathDataLongPredTime_ObjectWillSteerLeft_NoOperation_3 autosar_swc_aeb_autosar_swc_aeb_Step_sys_Subsystem_Reference_AEB_Function_Run_AsyEvlrCritEve_Step_Func_Run_AsyEvlrCritEve_Step_Func_TAWrapper_PreProcessor_ObjectPreProcessor_ObjectPreProcessorLoop_ValidObject_SafetyMarginFrontObjects_InPathCalculationWithPredictedObjPositions_CreateInPathDataTTR_CreateInPathData_DetermineInPathDataLongPredTime_ObjectWillSteerLeft_NoOperation_4 autosar_swc_aeb_autosar_swc_aeb_Step_sys_Subsystem_Reference_AEB_Function_Run_AsyEvlrCritEve_Step_Func_Run_AsyEvlrCritEve_Step_Func_TAWrapper_PreProcessor_ObjectPreProcessor_ObjectPreProcessorLoop_ValidObject_SafetyMarginFrontObjects_InPathCalculationWithPredictedObjPositions_CreateInPathDataTTR_CreateInPathData_DetermineInPathDataLongPredTime_ObjectWillSteerLeft_NoOperation_5 /end SUB_GROUP
/end GROUP
/begin GROUP autosar_swc_aeb_autosar_swc_aeb_Step_sys_Subsystem_Reference_AEB_Function_Run_AsyEvlrCritEve_Step_Func_Run_AsyEvlrCritEve_Step_Func_TAWrapper_PreProcessor_ObjectPreProcessor_ObjectPreProcessorLoop_ValidObject_SafetyMarginFrontObjects_InPathCalculationWithPredictedObjPositions_CreateInPathDataTTR_CreateInPathData_DetermineInPathDataLongPredTime_ObjectWillSteerLeft_NoOperation_3 "autosar_swc_aeb/autosar_swc_aeb_Step_sys/Subsystem Reference/AEB Function/Run_AsyEvlrCritEve_Step_Func/Run_AsyEvlrCritEve_Step_Func/TAWrapper/PreProcessor/ObjectPreProcessor/ObjectPreProcessorLoop/ValidObject/SafetyMarginFrontObjects/InPathCalculationWithPredictedObjPositions/CreateInPathDataTTR/CreateInPathData/DetermineInPathDataLongPredTime/ObjectWillSteerLeft/NoOperation_3" /begin REF_MEASUREMENT autosar_swc_aeb_rtARID_DEF.ALgtObj_i /end REF_MEASUREMENT /end GROUP
/begin GROUP autosar_swc_aeb_autosar_swc_aeb_Step_sys_Subsystem_Reference_AEB_Function_Run_AsyEvlrCritEve_Step_Func_Run_AsyEvlrCritEve_Step_Func_TAWrapper_PreProcessor_ObjectPreProcessor_ObjectPreProcessorLoop_ValidObject_SafetyMarginFrontObjects_InPathCalculationWithPredictedObjPositions_CreateInPathDataTTR_CreateInPathData_DetermineInPathDataLongPredTime_ObjectWillSteerLeft_NoOperation_4 "autosar_swc_aeb/autosar_swc_aeb_Step_sys/Subsystem Reference/AEB Function/Run_AsyEvlrCritEve_Step_Func/Run_AsyEvlrCritEve_Step_Func/TAWrapper/PreProcessor/ObjectPreProcessor/ObjectPreProcessorLoop/ValidObject/SafetyMarginFrontObjects/InPathCalculationWithPredictedObjPositions/CreateInPathDataTTR/CreateInPathData/DetermineInPathDataLongPredTime/ObjectWillSteerLeft/NoOperation_4" /begin REF_MEASUREMENT autosar_swc_aeb_rtARID_DEF.ALatObj_p /end REF_MEASUREMENT /end GROUP
/begin GROUP autosar_swc_aeb_autosar_swc_aeb_Step_sys_Subsystem_Reference_AEB_Function_Run_AsyEvlrCritEve_Step_Func_Run_AsyEvlrCritEve_Step_Func_TAWrapper_PreProcessor_ObjectPreProcessor_ObjectPreProcessorLoop_ValidObject_SafetyMarginFrontObjects_InPathCalculationWithPredictedObjPositions_CreateInPathDataTTR_CreateInPathData_DetermineInPathDataLongPredTime_ObjectWillSteerLeft_NoOperation_5 "autosar_swc_aeb/autosar_swc_aeb_Step_sys/Subsystem Reference/AEB Function/Run_AsyEvlrCritEve_Step_Func/Run_AsyEvlrCritEve_Step_Func/TAWrapper/PreProcessor/ObjectPreProcessor/ObjectPreProcessorLoop/ValidObject/SafetyMarginFrontObjects/InPathCalculationWithPredictedObjPositions/CreateInPathDataTTR/CreateInPathData/DetermineInPathDataLongPredTime/ObjectWillSteerLeft/NoOperation_5" /begin REF_MEASUREMENT autosar_swc_aeb_rtARID_DEF.CrvtObj /end REF_MEASUREMENT /end GROUP
/begin GROUP autosar_swc_aeb_autosar_swc_aeb_Step_sys_Subsystem_Reference_AEB_Function_Run_AsyEvlrCritEve_Step_Func_Run_AsyEvlrCritEve_Step_Func_TAWrapper_PreProcessor_ObjectPreProcessor_ObjectPreProcessorLoop_ValidObject_SafetyMarginFrontObjects_InPathCalculationWithPredictedObjPositions_CreateInPathDataTTR_CreateInPathData_DetermineInPathDataLongPredTime_ObjectWillSteerRight "autosar_swc_aeb/autosar_swc_aeb_Step_sys/Subsystem Reference/AEB Function/Run_AsyEvlrCritEve_Step_Func/Run_AsyEvlrCritEve_Step_Func/TAWrapper/PreProcessor/ObjectPreProcessor/ObjectPreProcessorLoop/ValidObject/SafetyMarginFrontObjects/InPathCalculationWithPredictedObjPositions/CreateInPathDataTTR/CreateInPathData/DetermineInPathDataLongPredTime/ObjectWillSteerRight"
 /begin SUB_GROUP autosar_swc_aeb_autosar_swc_aeb_Step_sys_Subsystem_Reference_AEB_Function_Run_AsyEvlrCritEve_Step_Func_Run_AsyEvlrCritEve_Step_Func_TAWrapper_PreProcessor_ObjectPreProcessor_ObjectPreProcessorLoop_ValidObject_SafetyMarginFrontObjects_InPathCalculationWithPredictedObjPositions_CreateInPathDataTTR_CreateInPathData_DetermineInPathDataLongPredTime_ObjectWillSteerRight_NoOperation_1 autosar_swc_aeb_autosar_swc_aeb_Step_sys_Subsystem_Reference_AEB_Function_Run_AsyEvlrCritEve_Step_Func_Run_AsyEvlrCritEve_Step_Func_TAWrapper_PreProcessor_ObjectPreProcessor_ObjectPreProcessorLoop_ValidObject_SafetyMarginFrontObjects_InPathCalculationWithPredictedObjPositions_CreateInPathDataTTR_CreateInPathData_DetermineInPathDataLongPredTime_ObjectWillSteerRight_NoOperation_2 autosar_swc_aeb_autosar_swc_aeb_Step_sys_Subsystem_Reference_AEB_Function_Run_AsyEvlrCritEve_Step_Func_Run_AsyEvlrCritEve_Step_Func_TAWrapper_PreProcessor_ObjectPreProcessor_ObjectPreProcessorLoop_ValidObject_SafetyMarginFrontObjects_InPathCalculationWithPredictedObjPositions_CreateInPathDataTTR_CreateInPathData_DetermineInPathDataLongPredTime_ObjectWillSteerRight_NoOperation_3 /end SUB_GROUP
/end GROUP
/begin GROUP autosar_swc_aeb_autosar_swc_aeb_Step_sys_Subsystem_Reference_AEB_Function_Run_AsyEvlrCritEve_Step_Func_Run_AsyEvlrCritEve_Step_Func_TAWrapper_PreProcessor_ObjectPreProcessor_ObjectPreProcessorLoop_ValidObject_SafetyMarginFrontObjects_InPathCalculationWithPredictedObjPositions_CreateInPathDataTTR_CreateInPathData_DetermineInPathDataLongPredTime_ObjectWillSteerRight_NoOperation_1 "autosar_swc_aeb/autosar_swc_aeb_Step_sys/Subsystem Reference/AEB Function/Run_AsyEvlrCritEve_Step_Func/Run_AsyEvlrCritEve_Step_Func/TAWrapper/PreProcessor/ObjectPreProcessor/ObjectPreProcessorLoop/ValidObject/SafetyMarginFrontObjects/InPathCalculationWithPredictedObjPositions/CreateInPathDataTTR/CreateInPathData/DetermineInPathDataLongPredTime/ObjectWillSteerRight/NoOperation_1" /begin REF_MEASUREMENT autosar_swc_aeb_rtARID_DEF.CrvtObj_a /end REF_MEASUREMENT /end GROUP
/begin GROUP autosar_swc_aeb_autosar_swc_aeb_Step_sys_Subsystem_Reference_AEB_Function_Run_AsyEvlrCritEve_Step_Func_Run_AsyEvlrCritEve_Step_Func_TAWrapper_PreProcessor_ObjectPreProcessor_ObjectPreProcessorLoop_ValidObject_SafetyMarginFrontObjects_InPathCalculationWithPredictedObjPositions_CreateInPathDataTTR_CreateInPathData_DetermineInPathDataLongPredTime_ObjectWillSteerRight_NoOperation_2 "autosar_swc_aeb/autosar_swc_aeb_Step_sys/Subsystem Reference/AEB Function/Run_AsyEvlrCritEve_Step_Func/Run_AsyEvlrCritEve_Step_Func/TAWrapper/PreProcessor/ObjectPreProcessor/ObjectPreProcessorLoop/ValidObject/SafetyMarginFrontObjects/InPathCalculationWithPredictedObjPositions/CreateInPathDataTTR/CreateInPathData/DetermineInPathDataLongPredTime/ObjectWillSteerRight/NoOperation_2" /begin REF_MEASUREMENT autosar_swc_aeb_rtARID_DEF.ALatObj_p4 /end REF_MEASUREMENT /end GROUP
/begin GROUP autosar_swc_aeb_autosar_swc_aeb_Step_sys_Subsystem_Reference_AEB_Function_Run_AsyEvlrCritEve_Step_Func_Run_AsyEvlrCritEve_Step_Func_TAWrapper_PreProcessor_ObjectPreProcessor_ObjectPreProcessorLoop_ValidObject_SafetyMarginFrontObjects_InPathCalculationWithPredictedObjPositions_CreateInPathDataTTR_CreateInPathData_DetermineInPathDataLongPredTime_ObjectWillSteerRight_NoOperation_3 "autosar_swc_aeb/autosar_swc_aeb_Step_sys/Subsystem Reference/AEB Function/Run_AsyEvlrCritEve_Step_Func/Run_AsyEvlrCritEve_Step_Func/TAWrapper/PreProcessor/ObjectPreProcessor/ObjectPreProcessorLoop/ValidObject/SafetyMarginFrontObjects/InPathCalculationWithPredictedObjPositions/CreateInPathDataTTR/CreateInPathData/DetermineInPathDataLongPredTime/ObjectWillSteerRight/NoOperation_3" /begin REF_MEASUREMENT autosar_swc_aeb_rtARID_DEF.ALgtObj_i5 /end REF_MEASUREMENT /end GROUP
/begin GROUP autosar_swc_aeb_autosar_swc_aeb_Step_sys_Subsystem_Reference_AEB_Function_Run_AsyEvlrCritEve_Step_Func_Run_AsyEvlrCritEve_Step_Func_TAWrapper_PreProcessor_ObjectPreProcessor_ObjectPreProcessorLoop_ValidObject_SafetyMarginFrontObjects_InPathCalculationWithPredictedObjPositions_CreateInPathDataTTR_CreateInPathData_DetermineInPathDataShortPredTime "autosar_swc_aeb/autosar_swc_aeb_Step_sys/Subsystem Reference/AEB Function/Run_AsyEvlrCritEve_Step_Func/Run_AsyEvlrCritEve_Step_Func/TAWrapper/PreProcessor/ObjectPreProcessor/ObjectPreProcessorLoop/ValidObject/SafetyMarginFrontObjects/InPathCalculationWithPredictedObjPositions/CreateInPathDataTTR/CreateInPathData/DetermineInPathDataShortPredTime"
 /begin SUB_GROUP autosar_swc_aeb_autosar_swc_aeb_Step_sys_Subsystem_Reference_AEB_Function_Run_AsyEvlrCritEve_Step_Func_Run_AsyEvlrCritEve_Step_Func_TAWrapper_PreProcessor_ObjectPreProcessor_ObjectPreProcessorLoop_ValidObject_SafetyMarginFrontObjects_InPathCalculationWithPredictedObjPositions_CreateInPathDataTTR_CreateInPathData_DetermineInPathDataShortPredTime_ObjectWillBrake autosar_swc_aeb_autosar_swc_aeb_Step_sys_Subsystem_Reference_AEB_Function_Run_AsyEvlrCritEve_Step_Func_Run_AsyEvlrCritEve_Step_Func_TAWrapper_PreProcessor_ObjectPreProcessor_ObjectPreProcessorLoop_ValidObject_SafetyMarginFrontObjects_InPathCalculationWithPredictedObjPositions_CreateInPathDataTTR_CreateInPathData_DetermineInPathDataShortPredTime_ObjectWillSteerLeft autosar_swc_aeb_autosar_swc_aeb_Step_sys_Subsystem_Reference_AEB_Function_Run_AsyEvlrCritEve_Step_Func_Run_AsyEvlrCritEve_Step_Func_TAWrapper_PreProcessor_ObjectPreProcessor_ObjectPreProcessorLoop_ValidObject_SafetyMarginFrontObjects_InPathCalculationWithPredictedObjPositions_CreateInPathDataTTR_CreateInPathData_DetermineInPathDataShortPredTime_ObjectWillSteerRight /end SUB_GROUP
 /begin REF_MEASUREMENT autosar_swc_aeb_rtARID_DEF.ALgtObj_i autosar_swc_aeb_rtARID_DEF.ALgtObj_i5 autosar_swc_aeb_rtARID_DEF.ALgtObj_i5c /end REF_MEASUREMENT
/end GROUP
/begin GROUP autosar_swc_aeb_autosar_swc_aeb_Step_sys_Subsystem_Reference_AEB_Function_Run_AsyEvlrCritEve_Step_Func_Run_AsyEvlrCritEve_Step_Func_TAWrapper_PreProcessor_ObjectPreProcessor_ObjectPreProcessorLoop_ValidObject_SafetyMarginFrontObjects_InPathCalculationWithPredictedObjPositions_CreateInPathDataTTR_CreateInPathData_DetermineInPathDataShortPredTime_ObjectWillBrake "autosar_swc_aeb/autosar_swc_aeb_Step_sys/Subsystem Reference/AEB Function/Run_AsyEvlrCritEve_Step_Func/Run_AsyEvlrCritEve_Step_Func/TAWrapper/PreProcessor/ObjectPreProcessor/ObjectPreProcessorLoop/ValidObject/SafetyMarginFrontObjects/InPathCalculationWithPredictedObjPositions/CreateInPathDataTTR/CreateInPathData/DetermineInPathDataShortPredTime/ObjectWillBrake"
 /begin SUB_GROUP autosar_swc_aeb_autosar_swc_aeb_Step_sys_Subsystem_Reference_AEB_Function_Run_AsyEvlrCritEve_Step_Func_Run_AsyEvlrCritEve_Step_Func_TAWrapper_PreProcessor_ObjectPreProcessor_ObjectPreProcessorLoop_ValidObject_SafetyMarginFrontObjects_InPathCalculationWithPredictedObjPositions_CreateInPathDataTTR_CreateInPathData_DetermineInPathDataShortPredTime_ObjectWillBrake_NoOperation_3 autosar_swc_aeb_autosar_swc_aeb_Step_sys_Subsystem_Reference_AEB_Function_Run_AsyEvlrCritEve_Step_Func_Run_AsyEvlrCritEve_Step_Func_TAWrapper_PreProcessor_ObjectPreProcessor_ObjectPreProcessorLoop_ValidObject_SafetyMarginFrontObjects_InPathCalculationWithPredictedObjPositions_CreateInPathDataTTR_CreateInPathData_DetermineInPathDataShortPredTime_ObjectWillBrake_NoOperation_4 /end SUB_GROUP
/end GROUP
/begin GROUP autosar_swc_aeb_autosar_swc_aeb_Step_sys_Subsystem_Reference_AEB_Function_Run_AsyEvlrCritEve_Step_Func_Run_AsyEvlrCritEve_Step_Func_TAWrapper_PreProcessor_ObjectPreProcessor_ObjectPreProcessorLoop_ValidObject_SafetyMarginFrontObjects_InPathCalculationWithPredictedObjPositions_CreateInPathDataTTR_CreateInPathData_DetermineInPathDataShortPredTime_ObjectWillBrake_NoOperation_3 "autosar_swc_aeb/autosar_swc_aeb_Step_sys/Subsystem Reference/AEB Function/Run_AsyEvlrCritEve_Step_Func/Run_AsyEvlrCritEve_Step_Func/TAWrapper/PreProcessor/ObjectPreProcessor/ObjectPreProcessorLoop/ValidObject/SafetyMarginFrontObjects/InPathCalculationWithPredictedObjPositions/CreateInPathDataTTR/CreateInPathData/DetermineInPathDataShortPredTime/ObjectWillBrake/NoOperation_3" /begin REF_MEASUREMENT autosar_swc_aeb_rtARID_DEF.ALgtObj_i5c /end REF_MEASUREMENT /end GROUP
/begin GROUP autosar_swc_aeb_autosar_swc_aeb_Step_sys_Subsystem_Reference_AEB_Function_Run_AsyEvlrCritEve_Step_Func_Run_AsyEvlrCritEve_Step_Func_TAWrapper_PreProcessor_ObjectPreProcessor_ObjectPreProcessorLoop_ValidObject_SafetyMarginFrontObjects_InPathCalculationWithPredictedObjPositions_CreateInPathDataTTR_CreateInPathData_DetermineInPathDataShortPredTime_ObjectWillBrake_NoOperation_4 "autosar_swc_aeb/autosar_swc_aeb_Step_sys/Subsystem Reference/AEB Function/Run_AsyEvlrCritEve_Step_Func/Run_AsyEvlrCritEve_Step_Func/TAWrapper/PreProcessor/ObjectPreProcessor/ObjectPreProcessorLoop/ValidObject/SafetyMarginFrontObjects/InPathCalculationWithPredictedObjPositions/CreateInPathDataTTR/CreateInPathData/DetermineInPathDataShortPredTime/ObjectWillBrake/NoOperation_4" /begin REF_MEASUREMENT autosar_swc_aeb_rtARID_DEF.ALatObj_p41 /end REF_MEASUREMENT /end GROUP
/begin GROUP autosar_swc_aeb_autosar_swc_aeb_Step_sys_Subsystem_Reference_AEB_Function_Run_AsyEvlrCritEve_Step_Func_Run_AsyEvlrCritEve_Step_Func_TAWrapper_PreProcessor_ObjectPreProcessor_ObjectPreProcessorLoop_ValidObject_SafetyMarginFrontObjects_InPathCalculationWithPredictedObjPositions_CreateInPathDataTTR_CreateInPathData_DetermineInPathDataShortPredTime_ObjectWillSteerLeft "autosar_swc_aeb/autosar_swc_aeb_Step_sys/Subsystem Reference/AEB Function/Run_AsyEvlrCritEve_Step_Func/Run_AsyEvlrCritEve_Step_Func/TAWrapper/PreProcessor/ObjectPreProcessor/ObjectPreProcessorLoop/ValidObject/SafetyMarginFrontObjects/InPathCalculationWithPredictedObjPositions/CreateInPathDataTTR/CreateInPathData/DetermineInPathDataShortPredTime/ObjectWillSteerLeft"
 /begin SUB_GROUP autosar_swc_aeb_autosar_swc_aeb_Step_sys_Subsystem_Reference_AEB_Function_Run_AsyEvlrCritEve_Step_Func_Run_AsyEvlrCritEve_Step_Func_TAWrapper_PreProcessor_ObjectPreProcessor_ObjectPreProcessorLoop_ValidObject_SafetyMarginFrontObjects_InPathCalculationWithPredictedObjPositions_CreateInPathDataTTR_CreateInPathData_DetermineInPathDataShortPredTime_ObjectWillSteerLeft_NoOperation_3 autosar_swc_aeb_autosar_swc_aeb_Step_sys_Subsystem_Reference_AEB_Function_Run_AsyEvlrCritEve_Step_Func_Run_AsyEvlrCritEve_Step_Func_TAWrapper_PreProcessor_ObjectPreProcessor_ObjectPreProcessorLoop_ValidObject_SafetyMarginFrontObjects_InPathCalculationWithPredictedObjPositions_CreateInPathDataTTR_CreateInPathData_DetermineInPathDataShortPredTime_ObjectWillSteerLeft_NoOperation_4 autosar_swc_aeb_autosar_swc_aeb_Step_sys_Subsystem_Reference_AEB_Function_Run_AsyEvlrCritEve_Step_Func_Run_AsyEvlrCritEve_Step_Func_TAWrapper_PreProcessor_ObjectPreProcessor_ObjectPreProcessorLoop_ValidObject_SafetyMarginFrontObjects_InPathCalculationWithPredictedObjPositions_CreateInPathDataTTR_CreateInPathData_DetermineInPathDataShortPredTime_ObjectWillSteerLeft_NoOperation_5 /end SUB_GROUP
/end GROUP
/begin GROUP autosar_swc_aeb_autosar_swc_aeb_Step_sys_Subsystem_Reference_AEB_Function_Run_AsyEvlrCritEve_Step_Func_Run_AsyEvlrCritEve_Step_Func_TAWrapper_PreProcessor_ObjectPreProcessor_ObjectPreProcessorLoop_ValidObject_SafetyMarginFrontObjects_InPathCalculationWithPredictedObjPositions_CreateInPathDataTTR_CreateInPathData_DetermineInPathDataShortPredTime_ObjectWillSteerLeft_NoOperation_3 "autosar_swc_aeb/autosar_swc_aeb_Step_sys/Subsystem Reference/AEB Function/Run_AsyEvlrCritEve_Step_Func/Run_AsyEvlrCritEve_Step_Func/TAWrapper/PreProcessor/ObjectPreProcessor/ObjectPreProcessorLoop/ValidObject/SafetyMarginFrontObjects/InPathCalculationWithPredictedObjPositions/CreateInPathDataTTR/CreateInPathData/DetermineInPathDataShortPredTime/ObjectWillSteerLeft/NoOperation_3" /begin REF_MEASUREMENT autosar_swc_aeb_rtARID_DEF.ALgtObj_i /end REF_MEASUREMENT /end GROUP
/begin GROUP autosar_swc_aeb_autosar_swc_aeb_Step_sys_Subsystem_Reference_AEB_Function_Run_AsyEvlrCritEve_Step_Func_Run_AsyEvlrCritEve_Step_Func_TAWrapper_PreProcessor_ObjectPreProcessor_ObjectPreProcessorLoop_ValidObject_SafetyMarginFrontObjects_InPathCalculationWithPredictedObjPositions_CreateInPathDataTTR_CreateInPathData_DetermineInPathDataShortPredTime_ObjectWillSteerLeft_NoOperation_4 "autosar_swc_aeb/autosar_swc_aeb_Step_sys/Subsystem Reference/AEB Function/Run_AsyEvlrCritEve_Step_Func/Run_AsyEvlrCritEve_Step_Func/TAWrapper/PreProcessor/ObjectPreProcessor/ObjectPreProcessorLoop/ValidObject/SafetyMarginFrontObjects/InPathCalculationWithPredictedObjPositions/CreateInPathDataTTR/CreateInPathData/DetermineInPathDataShortPredTime/ObjectWillSteerLeft/NoOperation_4" /begin REF_MEASUREMENT autosar_swc_aeb_rtARID_DEF.ALatObj_p /end REF_MEASUREMENT /end GROUP
/begin GROUP autosar_swc_aeb_autosar_swc_aeb_Step_sys_Subsystem_Reference_AEB_Function_Run_AsyEvlrCritEve_Step_Func_Run_AsyEvlrCritEve_Step_Func_TAWrapper_PreProcessor_ObjectPreProcessor_ObjectPreProcessorLoop_ValidObject_SafetyMarginFrontObjects_InPathCalculationWithPredictedObjPositions_CreateInPathDataTTR_CreateInPathData_DetermineInPathDataShortPredTime_ObjectWillSteerLeft_NoOperation_5 "autosar_swc_aeb/autosar_swc_aeb_Step_sys/Subsystem Reference/AEB Function/Run_AsyEvlrCritEve_Step_Func/Run_AsyEvlrCritEve_Step_Func/TAWrapper/PreProcessor/ObjectPreProcessor/ObjectPreProcessorLoop/ValidObject/SafetyMarginFrontObjects/InPathCalculationWithPredictedObjPositions/CreateInPathDataTTR/CreateInPathData/DetermineInPathDataShortPredTime/ObjectWillSteerLeft/NoOperation_5" /begin REF_MEASUREMENT autosar_swc_aeb_rtARID_DEF.CrvtObj /end REF_MEASUREMENT /end GROUP
/begin GROUP autosar_swc_aeb_autosar_swc_aeb_Step_sys_Subsystem_Reference_AEB_Function_Run_AsyEvlrCritEve_Step_Func_Run_AsyEvlrCritEve_Step_Func_TAWrapper_PreProcessor_ObjectPreProcessor_ObjectPreProcessorLoop_ValidObject_SafetyMarginFrontObjects_InPathCalculationWithPredictedObjPositions_CreateInPathDataTTR_CreateInPathData_DetermineInPathDataShortPredTime_ObjectWillSteerRight "autosar_swc_aeb/autosar_swc_aeb_Step_sys/Subsystem Reference/AEB Function/Run_AsyEvlrCritEve_Step_Func/Run_AsyEvlrCritEve_Step_Func/TAWrapper/PreProcessor/ObjectPreProcessor/ObjectPreProcessorLoop/ValidObject/SafetyMarginFrontObjects/InPathCalculationWithPredictedObjPositions/CreateInPathDataTTR/CreateInPathData/DetermineInPathDataShortPredTime/ObjectWillSteerRight"
 /begin SUB_GROUP autosar_swc_aeb_autosar_swc_aeb_Step_sys_Subsystem_Reference_AEB_Function_Run_AsyEvlrCritEve_Step_Func_Run_AsyEvlrCritEve_Step_Func_TAWrapper_PreProcessor_ObjectPreProcessor_ObjectPreProcessorLoop_ValidObject_SafetyMarginFrontObjects_InPathCalculationWithPredictedObjPositions_CreateInPathDataTTR_CreateInPathData_DetermineInPathDataShortPredTime_ObjectWillSteerRight_NoOperation_1 autosar_swc_aeb_autosar_swc_aeb_Step_sys_Subsystem_Reference_AEB_Function_Run_AsyEvlrCritEve_Step_Func_Run_AsyEvlrCritEve_Step_Func_TAWrapper_PreProcessor_ObjectPreProcessor_ObjectPreProcessorLoop_ValidObject_SafetyMarginFrontObjects_InPathCalculationWithPredictedObjPositions_CreateInPathDataTTR_CreateInPathData_DetermineInPathDataShortPredTime_ObjectWillSteerRight_NoOperation_2 autosar_swc_aeb_autosar_swc_aeb_Step_sys_Subsystem_Reference_AEB_Function_Run_AsyEvlrCritEve_Step_Func_Run_AsyEvlrCritEve_Step_Func_TAWrapper_PreProcessor_ObjectPreProcessor_ObjectPreProcessorLoop_ValidObject_SafetyMarginFrontObjects_InPathCalculationWithPredictedObjPositions_CreateInPathDataTTR_CreateInPathData_DetermineInPathDataShortPredTime_ObjectWillSteerRight_NoOperation_3 /end SUB_GROUP
/end GROUP
/begin GROUP autosar_swc_aeb_autosar_swc_aeb_Step_sys_Subsystem_Reference_AEB_Function_Run_AsyEvlrCritEve_Step_Func_Run_AsyEvlrCritEve_Step_Func_TAWrapper_PreProcessor_ObjectPreProcessor_ObjectPreProcessorLoop_ValidObject_SafetyMarginFrontObjects_InPathCalculationWithPredictedObjPositions_CreateInPathDataTTR_CreateInPathData_DetermineInPathDataShortPredTime_ObjectWillSteerRight_NoOperation_1 "autosar_swc_aeb/autosar_swc_aeb_Step_sys/Subsystem Reference/AEB Function/Run_AsyEvlrCritEve_Step_Func/Run_AsyEvlrCritEve_Step_Func/TAWrapper/PreProcessor/ObjectPreProcessor/ObjectPreProcessorLoop/ValidObject/SafetyMarginFrontObjects/InPathCalculationWithPredictedObjPositions/CreateInPathDataTTR/CreateInPathData/DetermineInPathDataShortPredTime/ObjectWillSteerRight/NoOperation_1" /begin REF_MEASUREMENT autosar_swc_aeb_rtARID_DEF.CrvtObj_a /end REF_MEASUREMENT /end GROUP
/begin GROUP autosar_swc_aeb_autosar_swc_aeb_Step_sys_Subsystem_Reference_AEB_Function_Run_AsyEvlrCritEve_Step_Func_Run_AsyEvlrCritEve_Step_Func_TAWrapper_PreProcessor_ObjectPreProcessor_ObjectPreProcessorLoop_ValidObject_SafetyMarginFrontObjects_InPathCalculationWithPredictedObjPositions_CreateInPathDataTTR_CreateInPathData_DetermineInPathDataShortPredTime_ObjectWillSteerRight_NoOperation_2 "autosar_swc_aeb/autosar_swc_aeb_Step_sys/Subsystem Reference/AEB Function/Run_AsyEvlrCritEve_Step_Func/Run_AsyEvlrCritEve_Step_Func/TAWrapper/PreProcessor/ObjectPreProcessor/ObjectPreProcessorLoop/ValidObject/SafetyMarginFrontObjects/InPathCalculationWithPredictedObjPositions/CreateInPathDataTTR/CreateInPathData/DetermineInPathDataShortPredTime/ObjectWillSteerRight/NoOperation_2" /begin REF_MEASUREMENT autosar_swc_aeb_rtARID_DEF.ALatObj_p4 /end REF_MEASUREMENT /end GROUP
/begin GROUP autosar_swc_aeb_autosar_swc_aeb_Step_sys_Subsystem_Reference_AEB_Function_Run_AsyEvlrCritEve_Step_Func_Run_AsyEvlrCritEve_Step_Func_TAWrapper_PreProcessor_ObjectPreProcessor_ObjectPreProcessorLoop_ValidObject_SafetyMarginFrontObjects_InPathCalculationWithPredictedObjPositions_CreateInPathDataTTR_CreateInPathData_DetermineInPathDataShortPredTime_ObjectWillSteerRight_NoOperation_3 "autosar_swc_aeb/autosar_swc_aeb_Step_sys/Subsystem Reference/AEB Function/Run_AsyEvlrCritEve_Step_Func/Run_AsyEvlrCritEve_Step_Func/TAWrapper/PreProcessor/ObjectPreProcessor/ObjectPreProcessorLoop/ValidObject/SafetyMarginFrontObjects/InPathCalculationWithPredictedObjPositions/CreateInPathDataTTR/CreateInPathData/DetermineInPathDataShortPredTime/ObjectWillSteerRight/NoOperation_3" /begin REF_MEASUREMENT autosar_swc_aeb_rtARID_DEF.ALgtObj_i5 /end REF_MEASUREMENT /end GROUP
/begin GROUP autosar_swc_aeb_autosar_swc_aeb_Step_sys_Subsystem_Reference_AEB_Function_Run_AsyEvlrCritEve_Step_Func_Run_AsyEvlrCritEve_Step_Func_TAWrapper_PreProcessor_ObjectPreProcessor_ObjectPreProcessorLoop_ValidObject_SafetyMarginFrontObjects_InPathCalculationWithPredictedObjPositions_CreateInPathDataTTR_RelativePositionAtTTR "autosar_swc_aeb/autosar_swc_aeb_Step_sys/Subsystem Reference/AEB Function/Run_AsyEvlrCritEve_Step_Func/Run_AsyEvlrCritEve_Step_Func/TAWrapper/PreProcessor/ObjectPreProcessor/ObjectPreProcessorLoop/ValidObject/SafetyMarginFrontObjects/InPathCalculationWithPredictedObjPositions/CreateInPathDataTTR/RelativePositionAtTTR"
 /begin SUB_GROUP autosar_swc_aeb_autosar_swc_aeb_Step_sys_Subsystem_Reference_AEB_Function_Run_AsyEvlrCritEve_Step_Func_Run_AsyEvlrCritEve_Step_Func_TAWrapper_PreProcessor_ObjectPreProcessor_ObjectPreProcessorLoop_ValidObject_SafetyMarginFrontObjects_InPathCalculationWithPredictedObjPositions_CreateInPathDataTTR_RelativePositionAtTTR_RelativePositionToHostPath autosar_swc_aeb_autosar_swc_aeb_Step_sys_Subsystem_Reference_AEB_Function_Run_AsyEvlrCritEve_Step_Func_Run_AsyEvlrCritEve_Step_Func_TAWrapper_PreProcessor_ObjectPreProcessor_ObjectPreProcessorLoop_ValidObject_SafetyMarginFrontObjects_InPathCalculationWithPredictedObjPositions_CreateInPathDataTTR_RelativePositionAtTTR_RelativePositionToHostPath1 autosar_swc_aeb_autosar_swc_aeb_Step_sys_Subsystem_Reference_AEB_Function_Run_AsyEvlrCritEve_Step_Func_Run_AsyEvlrCritEve_Step_Func_TAWrapper_PreProcessor_ObjectPreProcessor_ObjectPreProcessorLoop_ValidObject_SafetyMarginFrontObjects_InPathCalculationWithPredictedObjPositions_CreateInPathDataTTR_RelativePositionAtTTR_RelativePositionToHostPath2 autosar_swc_aeb_autosar_swc_aeb_Step_sys_Subsystem_Reference_AEB_Function_Run_AsyEvlrCritEve_Step_Func_Run_AsyEvlrCritEve_Step_Func_TAWrapper_PreProcessor_ObjectPreProcessor_ObjectPreProcessorLoop_ValidObject_SafetyMarginFrontObjects_InPathCalculationWithPredictedObjPositions_CreateInPathDataTTR_RelativePositionAtTTR_RelativePositionToHostPath3 autosar_swc_aeb_autosar_swc_aeb_Step_sys_Subsystem_Reference_AEB_Function_Run_AsyEvlrCritEve_Step_Func_Run_AsyEvlrCritEve_Step_Func_TAWrapper_PreProcessor_ObjectPreProcessor_ObjectPreProcessorLoop_ValidObject_SafetyMarginFrontObjects_InPathCalculationWithPredictedObjPositions_CreateInPathDataTTR_RelativePositionAtTTR_RelativePositionToHostPath4 /end SUB_GROUP
/end GROUP
/begin GROUP autosar_swc_aeb_autosar_swc_aeb_Step_sys_Subsystem_Reference_AEB_Function_Run_AsyEvlrCritEve_Step_Func_Run_AsyEvlrCritEve_Step_Func_TAWrapper_PreProcessor_ObjectPreProcessor_ObjectPreProcessorLoop_ValidObject_SafetyMarginFrontObjects_InPathCalculationWithPredictedObjPositions_CreateInPathDataTTR_RelativePositionAtTTR_RelativePositionToHostPath "autosar_swc_aeb/autosar_swc_aeb_Step_sys/Subsystem Reference/AEB Function/Run_AsyEvlrCritEve_Step_Func/Run_AsyEvlrCritEve_Step_Func/TAWrapper/PreProcessor/ObjectPreProcessor/ObjectPreProcessorLoop/ValidObject/SafetyMarginFrontObjects/InPathCalculationWithPredictedObjPositions/CreateInPathDataTTR/RelativePositionAtTTR/RelativePositionToHostPath"
 /begin SUB_GROUP autosar_swc_aeb_autosar_swc_aeb_Step_sys_Subsystem_Reference_AEB_Function_Run_AsyEvlrCritEve_Step_Func_Run_AsyEvlrCritEve_Step_Func_TAWrapper_PreProcessor_ObjectPreProcessor_ObjectPreProcessorLoop_ValidObject_SafetyMarginFrontObjects_InPathCalculationWithPredictedObjPositions_CreateInPathDataTTR_RelativePositionAtTTR_RelativePositionToHostPath_RelativeHeadingAndRotation autosar_swc_aeb_autosar_swc_aeb_Step_sys_Subsystem_Reference_AEB_Function_Run_AsyEvlrCritEve_Step_Func_Run_AsyEvlrCritEve_Step_Func_TAWrapper_PreProcessor_ObjectPreProcessor_ObjectPreProcessorLoop_ValidObject_SafetyMarginFrontObjects_InPathCalculationWithPredictedObjPositions_CreateInPathDataTTR_RelativePositionAtTTR_RelativePositionToHostPath_RelativePosnLatAndVLat /end SUB_GROUP
/end GROUP
/begin GROUP autosar_swc_aeb_autosar_swc_aeb_Step_sys_Subsystem_Reference_AEB_Function_Run_AsyEvlrCritEve_Step_Func_Run_AsyEvlrCritEve_Step_Func_TAWrapper_PreProcessor_ObjectPreProcessor_ObjectPreProcessorLoop_ValidObject_SafetyMarginFrontObjects_InPathCalculationWithPredictedObjPositions_CreateInPathDataTTR_RelativePositionAtTTR_RelativePositionToHostPath1 "autosar_swc_aeb/autosar_swc_aeb_Step_sys/Subsystem Reference/AEB Function/Run_AsyEvlrCritEve_Step_Func/Run_AsyEvlrCritEve_Step_Func/TAWrapper/PreProcessor/ObjectPreProcessor/ObjectPreProcessorLoop/ValidObject/SafetyMarginFrontObjects/InPathCalculationWithPredictedObjPositions/CreateInPathDataTTR/RelativePositionAtTTR/RelativePositionToHostPath1"
 /begin SUB_GROUP autosar_swc_aeb_autosar_swc_aeb_Step_sys_Subsystem_Reference_AEB_Function_Run_AsyEvlrCritEve_Step_Func_Run_AsyEvlrCritEve_Step_Func_TAWrapper_PreProcessor_ObjectPreProcessor_ObjectPreProcessorLoop_ValidObject_SafetyMarginFrontObjects_InPathCalculationWithPredictedObjPositions_CreateInPathDataTTR_RelativePositionAtTTR_RelativePositionToHostPath1_RelativeHeadingAndRotation autosar_swc_aeb_autosar_swc_aeb_Step_sys_Subsystem_Reference_AEB_Function_Run_AsyEvlrCritEve_Step_Func_Run_AsyEvlrCritEve_Step_Func_TAWrapper_PreProcessor_ObjectPreProcessor_ObjectPreProcessorLoop_ValidObject_SafetyMarginFrontObjects_InPathCalculationWithPredictedObjPositions_CreateInPathDataTTR_RelativePositionAtTTR_RelativePositionToHostPath1_RelativePosnLatAndVLat /end SUB_GROUP
/end GROUP
/begin GROUP autosar_swc_aeb_autosar_swc_aeb_Step_sys_Subsystem_Reference_AEB_Function_Run_AsyEvlrCritEve_Step_Func_Run_AsyEvlrCritEve_Step_Func_TAWrapper_PreProcessor_ObjectPreProcessor_ObjectPreProcessorLoop_ValidObject_SafetyMarginFrontObjects_InPathCalculationWithPredictedObjPositions_CreateInPathDataTTR_RelativePositionAtTTR_RelativePositionToHostPath1_RelativeHeadingAndRotation "autosar_swc_aeb/autosar_swc_aeb_Step_sys/Subsystem Reference/AEB Function/Run_AsyEvlrCritEve_Step_Func/Run_AsyEvlrCritEve_Step_Func/TAWrapper/PreProcessor/ObjectPreProcessor/ObjectPreProcessorLoop/ValidObject/SafetyMarginFrontObjects/InPathCalculationWithPredictedObjPositions/CreateInPathDataTTR/RelativePositionAtTTR/RelativePositionToHostPath1/RelativeHeadingAndRotation"
 /begin SUB_GROUP autosar_swc_aeb_autosar_swc_aeb_Step_sys_Subsystem_Reference_AEB_Function_Run_AsyEvlrCritEve_Step_Func_Run_AsyEvlrCritEve_Step_Func_TAWrapper_PreProcessor_ObjectPreProcessor_ObjectPreProcessorLoop_ValidObject_SafetyMarginFrontObjects_InPathCalculationWithPredictedObjPositions_CreateInPathDataTTR_RelativePositionAtTTR_RelativePositionToHostPath1_RelativeHeadingAndRotation_MovingObject autosar_swc_aeb_autosar_swc_aeb_Step_sys_Subsystem_Reference_AEB_Function_Run_AsyEvlrCritEve_Step_Func_Run_AsyEvlrCritEve_Step_Func_TAWrapper_PreProcessor_ObjectPreProcessor_ObjectPreProcessorLoop_ValidObject_SafetyMarginFrontObjects_InPathCalculationWithPredictedObjPositions_CreateInPathDataTTR_RelativePositionAtTTR_RelativePositionToHostPath1_RelativeHeadingAndRotation_StationaryObject /end SUB_GROUP
/end GROUP
/begin GROUP autosar_swc_aeb_autosar_swc_aeb_Step_sys_Subsystem_Reference_AEB_Function_Run_AsyEvlrCritEve_Step_Func_Run_AsyEvlrCritEve_Step_Func_TAWrapper_PreProcessor_ObjectPreProcessor_ObjectPreProcessorLoop_ValidObject_SafetyMarginFrontObjects_InPathCalculationWithPredictedObjPositions_CreateInPathDataTTR_RelativePositionAtTTR_RelativePositionToHostPath1_RelativeHeadingAndRotation_MovingObject "autosar_swc_aeb/autosar_swc_aeb_Step_sys/Subsystem Reference/AEB Function/Run_AsyEvlrCritEve_Step_Func/Run_AsyEvlrCritEve_Step_Func/TAWrapper/PreProcessor/ObjectPreProcessor/ObjectPreProcessorLoop/ValidObject/SafetyMarginFrontObjects/InPathCalculationWithPredictedObjPositions/CreateInPathDataTTR/RelativePositionAtTTR/RelativePositionToHostPath1/RelativeHeadingAndRotation/MovingObject" /begin REF_MEASUREMENT autosar_swc_aeb_rtARID_DEF.HeadingObj_h /end REF_MEASUREMENT /end GROUP
/begin GROUP autosar_swc_aeb_autosar_swc_aeb_Step_sys_Subsystem_Reference_AEB_Function_Run_AsyEvlrCritEve_Step_Func_Run_AsyEvlrCritEve_Step_Func_TAWrapper_PreProcessor_ObjectPreProcessor_ObjectPreProcessorLoop_ValidObject_SafetyMarginFrontObjects_InPathCalculationWithPredictedObjPositions_CreateInPathDataTTR_RelativePositionAtTTR_RelativePositionToHostPath1_RelativeHeadingAndRotation_StationaryObject "autosar_swc_aeb/autosar_swc_aeb_Step_sys/Subsystem Reference/AEB Function/Run_AsyEvlrCritEve_Step_Func/Run_AsyEvlrCritEve_Step_Func/TAWrapper/PreProcessor/ObjectPreProcessor/ObjectPreProcessorLoop/ValidObject/SafetyMarginFrontObjects/InPathCalculationWithPredictedObjPositions/CreateInPathDataTTR/RelativePositionAtTTR/RelativePositionToHostPath1/RelativeHeadingAndRotation/StationaryObject" /begin REF_MEASUREMENT autosar_swc_aeb_rtARID_DEF.HeadingObj_h /end REF_MEASUREMENT /end GROUP
/begin GROUP autosar_swc_aeb_autosar_swc_aeb_Step_sys_Subsystem_Reference_AEB_Function_Run_AsyEvlrCritEve_Step_Func_Run_AsyEvlrCritEve_Step_Func_TAWrapper_PreProcessor_ObjectPreProcessor_ObjectPreProcessorLoop_ValidObject_SafetyMarginFrontObjects_InPathCalculationWithPredictedObjPositions_CreateInPathDataTTR_RelativePositionAtTTR_RelativePositionToHostPath1_RelativePosnLatAndVLat "autosar_swc_aeb/autosar_swc_aeb_Step_sys/Subsystem Reference/AEB Function/Run_AsyEvlrCritEve_Step_Func/Run_AsyEvlrCritEve_Step_Func/TAWrapper/PreProcessor/ObjectPreProcessor/ObjectPreProcessorLoop/ValidObject/SafetyMarginFrontObjects/InPathCalculationWithPredictedObjPositions/CreateInPathDataTTR/RelativePositionAtTTR/RelativePositionToHostPath1/RelativePosnLatAndVLat"
 /begin REF_MEASUREMENT autosar_swc_aeb_rtARID_DEF.PosnLatObj_k autosar_swc_aeb_rtARID_DEF.PosnLgtObj_c autosar_swc_aeb_rtARID_DEF.VLatObj_bmzl autosar_swc_aeb_rtARID_DEF.VLgtObj_gh1e /end REF_MEASUREMENT
/end GROUP
/begin GROUP autosar_swc_aeb_autosar_swc_aeb_Step_sys_Subsystem_Reference_AEB_Function_Run_AsyEvlrCritEve_Step_Func_Run_AsyEvlrCritEve_Step_Func_TAWrapper_PreProcessor_ObjectPreProcessor_ObjectPreProcessorLoop_ValidObject_SafetyMarginFrontObjects_InPathCalculationWithPredictedObjPositions_CreateInPathDataTTR_RelativePositionAtTTR_RelativePositionToHostPath2 "autosar_swc_aeb/autosar_swc_aeb_Step_sys/Subsystem Reference/AEB Function/Run_AsyEvlrCritEve_Step_Func/Run_AsyEvlrCritEve_Step_Func/TAWrapper/PreProcessor/ObjectPreProcessor/ObjectPreProcessorLoop/ValidObject/SafetyMarginFrontObjects/InPathCalculationWithPredictedObjPositions/CreateInPathDataTTR/RelativePositionAtTTR/RelativePositionToHostPath2"
 /begin SUB_GROUP autosar_swc_aeb_autosar_swc_aeb_Step_sys_Subsystem_Reference_AEB_Function_Run_AsyEvlrCritEve_Step_Func_Run_AsyEvlrCritEve_Step_Func_TAWrapper_PreProcessor_ObjectPreProcessor_ObjectPreProcessorLoop_ValidObject_SafetyMarginFrontObjects_InPathCalculationWithPredictedObjPositions_CreateInPathDataTTR_RelativePositionAtTTR_RelativePositionToHostPath2_RelativeHeadingAndRotation autosar_swc_aeb_autosar_swc_aeb_Step_sys_Subsystem_Reference_AEB_Function_Run_AsyEvlrCritEve_Step_Func_Run_AsyEvlrCritEve_Step_Func_TAWrapper_PreProcessor_ObjectPreProcessor_ObjectPreProcessorLoop_ValidObject_SafetyMarginFrontObjects_InPathCalculationWithPredictedObjPositions_CreateInPathDataTTR_RelativePositionAtTTR_RelativePositionToHostPath2_RelativePosnLatAndVLat /end SUB_GROUP
/end GROUP
/begin GROUP autosar_swc_aeb_autosar_swc_aeb_Step_sys_Subsystem_Reference_AEB_Function_Run_AsyEvlrCritEve_Step_Func_Run_AsyEvlrCritEve_Step_Func_TAWrapper_PreProcessor_ObjectPreProcessor_ObjectPreProcessorLoop_ValidObject_SafetyMarginFrontObjects_InPathCalculationWithPredictedObjPositions_CreateInPathDataTTR_RelativePositionAtTTR_RelativePositionToHostPath2_RelativeHeadingAndRotation "autosar_swc_aeb/autosar_swc_aeb_Step_sys/Subsystem Reference/AEB Function/Run_AsyEvlrCritEve_Step_Func/Run_AsyEvlrCritEve_Step_Func/TAWrapper/PreProcessor/ObjectPreProcessor/ObjectPreProcessorLoop/ValidObject/SafetyMarginFrontObjects/InPathCalculationWithPredictedObjPositions/CreateInPathDataTTR/RelativePositionAtTTR/RelativePositionToHostPath2/RelativeHeadingAndRotation"
 /begin SUB_GROUP autosar_swc_aeb_autosar_swc_aeb_Step_sys_Subsystem_Reference_AEB_Function_Run_AsyEvlrCritEve_Step_Func_Run_AsyEvlrCritEve_Step_Func_TAWrapper_PreProcessor_ObjectPreProcessor_ObjectPreProcessorLoop_ValidObject_SafetyMarginFrontObjects_InPathCalculationWithPredictedObjPositions_CreateInPathDataTTR_RelativePositionAtTTR_RelativePositionToHostPath2_RelativeHeadingAndRotation_MovingObject autosar_swc_aeb_autosar_swc_aeb_Step_sys_Subsystem_Reference_AEB_Function_Run_AsyEvlrCritEve_Step_Func_Run_AsyEvlrCritEve_Step_Func_TAWrapper_PreProcessor_ObjectPreProcessor_ObjectPreProcessorLoop_ValidObject_SafetyMarginFrontObjects_InPathCalculationWithPredictedObjPositions_CreateInPathDataTTR_RelativePositionAtTTR_RelativePositionToHostPath2_RelativeHeadingAndRotation_StationaryObject /end SUB_GROUP
/end GROUP
/begin GROUP autosar_swc_aeb_autosar_swc_aeb_Step_sys_Subsystem_Reference_AEB_Function_Run_AsyEvlrCritEve_Step_Func_Run_AsyEvlrCritEve_Step_Func_TAWrapper_PreProcessor_ObjectPreProcessor_ObjectPreProcessorLoop_ValidObject_SafetyMarginFrontObjects_InPathCalculationWithPredictedObjPositions_CreateInPathDataTTR_RelativePositionAtTTR_RelativePositionToHostPath2_RelativeHeadingAndRotation_MovingObject "autosar_swc_aeb/autosar_swc_aeb_Step_sys/Subsystem Reference/AEB Function/Run_AsyEvlrCritEve_Step_Func/Run_AsyEvlrCritEve_Step_Func/TAWrapper/PreProcessor/ObjectPreProcessor/ObjectPreProcessorLoop/ValidObject/SafetyMarginFrontObjects/InPathCalculationWithPredictedObjPositions/CreateInPathDataTTR/RelativePositionAtTTR/RelativePositionToHostPath2/RelativeHeadingAndRotation/MovingObject" /begin REF_MEASUREMENT autosar_swc_aeb_rtARID_DEF.HeadingObj_hja3 /end REF_MEASUREMENT /end GROUP
/begin GROUP autosar_swc_aeb_autosar_swc_aeb_Step_sys_Subsystem_Reference_AEB_Function_Run_AsyEvlrCritEve_Step_Func_Run_AsyEvlrCritEve_Step_Func_TAWrapper_PreProcessor_ObjectPreProcessor_ObjectPreProcessorLoop_ValidObject_SafetyMarginFrontObjects_InPathCalculationWithPredictedObjPositions_CreateInPathDataTTR_RelativePositionAtTTR_RelativePositionToHostPath2_RelativeHeadingAndRotation_StationaryObject "autosar_swc_aeb/autosar_swc_aeb_Step_sys/Subsystem Reference/AEB Function/Run_AsyEvlrCritEve_Step_Func/Run_AsyEvlrCritEve_Step_Func/TAWrapper/PreProcessor/ObjectPreProcessor/ObjectPreProcessorLoop/ValidObject/SafetyMarginFrontObjects/InPathCalculationWithPredictedObjPositions/CreateInPathDataTTR/RelativePositionAtTTR/RelativePositionToHostPath2/RelativeHeadingAndRotation/StationaryObject" /begin REF_MEASUREMENT autosar_swc_aeb_rtARID_DEF.HeadingObj_hja3 /end REF_MEASUREMENT /end GROUP
/begin GROUP autosar_swc_aeb_autosar_swc_aeb_Step_sys_Subsystem_Reference_AEB_Function_Run_AsyEvlrCritEve_Step_Func_Run_AsyEvlrCritEve_Step_Func_TAWrapper_PreProcessor_ObjectPreProcessor_ObjectPreProcessorLoop_ValidObject_SafetyMarginFrontObjects_InPathCalculationWithPredictedObjPositions_CreateInPathDataTTR_RelativePositionAtTTR_RelativePositionToHostPath2_RelativePosnLatAndVLat "autosar_swc_aeb/autosar_swc_aeb_Step_sys/Subsystem Reference/AEB Function/Run_AsyEvlrCritEve_Step_Func/Run_AsyEvlrCritEve_Step_Func/TAWrapper/PreProcessor/ObjectPreProcessor/ObjectPreProcessorLoop/ValidObject/SafetyMarginFrontObjects/InPathCalculationWithPredictedObjPositions/CreateInPathDataTTR/RelativePositionAtTTR/RelativePositionToHostPath2/RelativePosnLatAndVLat"
 /begin REF_MEASUREMENT autosar_swc_aeb_rtARID_DEF.PosnLatObj_krkk autosar_swc_aeb_rtARID_DEF.PosnLgtObj_cki3 autosar_swc_aeb_rtARID_DEF.VLatObj_b autosar_swc_aeb_rtARID_DEF.VLgtObj_g /end REF_MEASUREMENT
/end GROUP
/begin GROUP autosar_swc_aeb_autosar_swc_aeb_Step_sys_Subsystem_Reference_AEB_Function_Run_AsyEvlrCritEve_Step_Func_Run_AsyEvlrCritEve_Step_Func_TAWrapper_PreProcessor_ObjectPreProcessor_ObjectPreProcessorLoop_ValidObject_SafetyMarginFrontObjects_InPathCalculationWithPredictedObjPositions_CreateInPathDataTTR_RelativePositionAtTTR_RelativePositionToHostPath3 "autosar_swc_aeb/autosar_swc_aeb_Step_sys/Subsystem Reference/AEB Function/Run_AsyEvlrCritEve_Step_Func/Run_AsyEvlrCritEve_Step_Func/TAWrapper/PreProcessor/ObjectPreProcessor/ObjectPreProcessorLoop/ValidObject/SafetyMarginFrontObjects/InPathCalculationWithPredictedObjPositions/CreateInPathDataTTR/RelativePositionAtTTR/RelativePositionToHostPath3"
 /begin SUB_GROUP autosar_swc_aeb_autosar_swc_aeb_Step_sys_Subsystem_Reference_AEB_Function_Run_AsyEvlrCritEve_Step_Func_Run_AsyEvlrCritEve_Step_Func_TAWrapper_PreProcessor_ObjectPreProcessor_ObjectPreProcessorLoop_ValidObject_SafetyMarginFrontObjects_InPathCalculationWithPredictedObjPositions_CreateInPathDataTTR_RelativePositionAtTTR_RelativePositionToHostPath3_RelativeHeadingAndRotation autosar_swc_aeb_autosar_swc_aeb_Step_sys_Subsystem_Reference_AEB_Function_Run_AsyEvlrCritEve_Step_Func_Run_AsyEvlrCritEve_Step_Func_TAWrapper_PreProcessor_ObjectPreProcessor_ObjectPreProcessorLoop_ValidObject_SafetyMarginFrontObjects_InPathCalculationWithPredictedObjPositions_CreateInPathDataTTR_RelativePositionAtTTR_RelativePositionToHostPath3_RelativePosnLatAndVLat /end SUB_GROUP
/end GROUP
/begin GROUP autosar_swc_aeb_autosar_swc_aeb_Step_sys_Subsystem_Reference_AEB_Function_Run_AsyEvlrCritEve_Step_Func_Run_AsyEvlrCritEve_Step_Func_TAWrapper_PreProcessor_ObjectPreProcessor_ObjectPreProcessorLoop_ValidObject_SafetyMarginFrontObjects_InPathCalculationWithPredictedObjPositions_CreateInPathDataTTR_RelativePositionAtTTR_RelativePositionToHostPath3_RelativeHeadingAndRotation "autosar_swc_aeb/autosar_swc_aeb_Step_sys/Subsystem Reference/AEB Function/Run_AsyEvlrCritEve_Step_Func/Run_AsyEvlrCritEve_Step_Func/TAWrapper/PreProcessor/ObjectPreProcessor/ObjectPreProcessorLoop/ValidObject/SafetyMarginFrontObjects/InPathCalculationWithPredictedObjPositions/CreateInPathDataTTR/RelativePositionAtTTR/RelativePositionToHostPath3/RelativeHeadingAndRotation"
 /begin SUB_GROUP autosar_swc_aeb_autosar_swc_aeb_Step_sys_Subsystem_Reference_AEB_Function_Run_AsyEvlrCritEve_Step_Func_Run_AsyEvlrCritEve_Step_Func_TAWrapper_PreProcessor_ObjectPreProcessor_ObjectPreProcessorLoop_ValidObject_SafetyMarginFrontObjects_InPathCalculationWithPredictedObjPositions_CreateInPathDataTTR_RelativePositionAtTTR_RelativePositionToHostPath3_RelativeHeadingAndRotation_MovingObject autosar_swc_aeb_autosar_swc_aeb_Step_sys_Subsystem_Reference_AEB_Function_Run_AsyEvlrCritEve_Step_Func_Run_AsyEvlrCritEve_Step_Func_TAWrapper_PreProcessor_ObjectPreProcessor_ObjectPreProcessorLoop_ValidObject_SafetyMarginFrontObjects_InPathCalculationWithPredictedObjPositions_CreateInPathDataTTR_RelativePositionAtTTR_RelativePositionToHostPath3_RelativeHeadingAndRotation_StationaryObject /end SUB_GROUP
/end GROUP
/begin GROUP autosar_swc_aeb_autosar_swc_aeb_Step_sys_Subsystem_Reference_AEB_Function_Run_AsyEvlrCritEve_Step_Func_Run_AsyEvlrCritEve_Step_Func_TAWrapper_PreProcessor_ObjectPreProcessor_ObjectPreProcessorLoop_ValidObject_SafetyMarginFrontObjects_InPathCalculationWithPredictedObjPositions_CreateInPathDataTTR_RelativePositionAtTTR_RelativePositionToHostPath3_RelativeHeadingAndRotation_MovingObject "autosar_swc_aeb/autosar_swc_aeb_Step_sys/Subsystem Reference/AEB Function/Run_AsyEvlrCritEve_Step_Func/Run_AsyEvlrCritEve_Step_Func/TAWrapper/PreProcessor/ObjectPreProcessor/ObjectPreProcessorLoop/ValidObject/SafetyMarginFrontObjects/InPathCalculationWithPredictedObjPositions/CreateInPathDataTTR/RelativePositionAtTTR/RelativePositionToHostPath3/RelativeHeadingAndRotation/MovingObject" /begin REF_MEASUREMENT autosar_swc_aeb_rtARID_DEF.HeadingObj_hj /end REF_MEASUREMENT /end GROUP
/begin GROUP autosar_swc_aeb_autosar_swc_aeb_Step_sys_Subsystem_Reference_AEB_Function_Run_AsyEvlrCritEve_Step_Func_Run_AsyEvlrCritEve_Step_Func_TAWrapper_PreProcessor_ObjectPreProcessor_ObjectPreProcessorLoop_ValidObject_SafetyMarginFrontObjects_InPathCalculationWithPredictedObjPositions_CreateInPathDataTTR_RelativePositionAtTTR_RelativePositionToHostPath3_RelativeHeadingAndRotation_StationaryObject "autosar_swc_aeb/autosar_swc_aeb_Step_sys/Subsystem Reference/AEB Function/Run_AsyEvlrCritEve_Step_Func/Run_AsyEvlrCritEve_Step_Func/TAWrapper/PreProcessor/ObjectPreProcessor/ObjectPreProcessorLoop/ValidObject/SafetyMarginFrontObjects/InPathCalculationWithPredictedObjPositions/CreateInPathDataTTR/RelativePositionAtTTR/RelativePositionToHostPath3/RelativeHeadingAndRotation/StationaryObject" /begin REF_MEASUREMENT autosar_swc_aeb_rtARID_DEF.HeadingObj_hj /end REF_MEASUREMENT /end GROUP
/begin GROUP autosar_swc_aeb_autosar_swc_aeb_Step_sys_Subsystem_Reference_AEB_Function_Run_AsyEvlrCritEve_Step_Func_Run_AsyEvlrCritEve_Step_Func_TAWrapper_PreProcessor_ObjectPreProcessor_ObjectPreProcessorLoop_ValidObject_SafetyMarginFrontObjects_InPathCalculationWithPredictedObjPositions_CreateInPathDataTTR_RelativePositionAtTTR_RelativePositionToHostPath3_RelativePosnLatAndVLat "autosar_swc_aeb/autosar_swc_aeb_Step_sys/Subsystem Reference/AEB Function/Run_AsyEvlrCritEve_Step_Func/Run_AsyEvlrCritEve_Step_Func/TAWrapper/PreProcessor/ObjectPreProcessor/ObjectPreProcessorLoop/ValidObject/SafetyMarginFrontObjects/InPathCalculationWithPredictedObjPositions/CreateInPathDataTTR/RelativePositionAtTTR/RelativePositionToHostPath3/RelativePosnLatAndVLat"
 /begin REF_MEASUREMENT autosar_swc_aeb_rtARID_DEF.PosnLatObj_kr autosar_swc_aeb_rtARID_DEF.PosnLgtObj_ck autosar_swc_aeb_rtARID_DEF.VLatObj_bm autosar_swc_aeb_rtARID_DEF.VLgtObj_gh /end REF_MEASUREMENT
/end GROUP
/begin GROUP autosar_swc_aeb_autosar_swc_aeb_Step_sys_Subsystem_Reference_AEB_Function_Run_AsyEvlrCritEve_Step_Func_Run_AsyEvlrCritEve_Step_Func_TAWrapper_PreProcessor_ObjectPreProcessor_ObjectPreProcessorLoop_ValidObject_SafetyMarginFrontObjects_InPathCalculationWithPredictedObjPositions_CreateInPathDataTTR_RelativePositionAtTTR_RelativePositionToHostPath4 "autosar_swc_aeb/autosar_swc_aeb_Step_sys/Subsystem Reference/AEB Function/Run_AsyEvlrCritEve_Step_Func/Run_AsyEvlrCritEve_Step_Func/TAWrapper/PreProcessor/ObjectPreProcessor/ObjectPreProcessorLoop/ValidObject/SafetyMarginFrontObjects/InPathCalculationWithPredictedObjPositions/CreateInPathDataTTR/RelativePositionAtTTR/RelativePositionToHostPath4"
 /begin SUB_GROUP autosar_swc_aeb_autosar_swc_aeb_Step_sys_Subsystem_Reference_AEB_Function_Run_AsyEvlrCritEve_Step_Func_Run_AsyEvlrCritEve_Step_Func_TAWrapper_PreProcessor_ObjectPreProcessor_ObjectPreProcessorLoop_ValidObject_SafetyMarginFrontObjects_InPathCalculationWithPredictedObjPositions_CreateInPathDataTTR_RelativePositionAtTTR_RelativePositionToHostPath4_RelativeHeadingAndRotation autosar_swc_aeb_autosar_swc_aeb_Step_sys_Subsystem_Reference_AEB_Function_Run_AsyEvlrCritEve_Step_Func_Run_AsyEvlrCritEve_Step_Func_TAWrapper_PreProcessor_ObjectPreProcessor_ObjectPreProcessorLoop_ValidObject_SafetyMarginFrontObjects_InPathCalculationWithPredictedObjPositions_CreateInPathDataTTR_RelativePositionAtTTR_RelativePositionToHostPath4_RelativePosnLatAndVLat /end SUB_GROUP
/end GROUP
/begin GROUP autosar_swc_aeb_autosar_swc_aeb_Step_sys_Subsystem_Reference_AEB_Function_Run_AsyEvlrCritEve_Step_Func_Run_AsyEvlrCritEve_Step_Func_TAWrapper_PreProcessor_ObjectPreProcessor_ObjectPreProcessorLoop_ValidObject_SafetyMarginFrontObjects_InPathCalculationWithPredictedObjPositions_CreateInPathDataTTR_RelativePositionAtTTR_RelativePositionToHostPath4_RelativeHeadingAndRotation "autosar_swc_aeb/autosar_swc_aeb_Step_sys/Subsystem Reference/AEB Function/Run_AsyEvlrCritEve_Step_Func/Run_AsyEvlrCritEve_Step_Func/TAWrapper/PreProcessor/ObjectPreProcessor/ObjectPreProcessorLoop/ValidObject/SafetyMarginFrontObjects/InPathCalculationWithPredictedObjPositions/CreateInPathDataTTR/RelativePositionAtTTR/RelativePositionToHostPath4/RelativeHeadingAndRotation"
 /begin SUB_GROUP autosar_swc_aeb_autosar_swc_aeb_Step_sys_Subsystem_Reference_AEB_Function_Run_AsyEvlrCritEve_Step_Func_Run_AsyEvlrCritEve_Step_Func_TAWrapper_PreProcessor_ObjectPreProcessor_ObjectPreProcessorLoop_ValidObject_SafetyMarginFrontObjects_InPathCalculationWithPredictedObjPositions_CreateInPathDataTTR_RelativePositionAtTTR_RelativePositionToHostPath4_RelativeHeadingAndRotation_MovingObject autosar_swc_aeb_autosar_swc_aeb_Step_sys_Subsystem_Reference_AEB_Function_Run_AsyEvlrCritEve_Step_Func_Run_AsyEvlrCritEve_Step_Func_TAWrapper_PreProcessor_ObjectPreProcessor_ObjectPreProcessorLoop_ValidObject_SafetyMarginFrontObjects_InPathCalculationWithPredictedObjPositions_CreateInPathDataTTR_RelativePositionAtTTR_RelativePositionToHostPath4_RelativeHeadingAndRotation_StationaryObject /end SUB_GROUP
/end GROUP
/begin GROUP autosar_swc_aeb_autosar_swc_aeb_Step_sys_Subsystem_Reference_AEB_Function_Run_AsyEvlrCritEve_Step_Func_Run_AsyEvlrCritEve_Step_Func_TAWrapper_PreProcessor_ObjectPreProcessor_ObjectPreProcessorLoop_ValidObject_SafetyMarginFrontObjects_InPathCalculationWithPredictedObjPositions_CreateInPathDataTTR_RelativePositionAtTTR_RelativePositionToHostPath4_RelativeHeadingAndRotation_MovingObject "autosar_swc_aeb/autosar_swc_aeb_Step_sys/Subsystem Reference/AEB Function/Run_AsyEvlrCritEve_Step_Func/Run_AsyEvlrCritEve_Step_Func/TAWrapper/PreProcessor/ObjectPreProcessor/ObjectPreProcessorLoop/ValidObject/SafetyMarginFrontObjects/InPathCalculationWithPredictedObjPositions/CreateInPathDataTTR/RelativePositionAtTTR/RelativePositionToHostPath4/RelativeHeadingAndRotation/MovingObject" /begin REF_MEASUREMENT autosar_swc_aeb_rtARID_DEF.HeadingObj_hja /end REF_MEASUREMENT /end GROUP
/begin GROUP autosar_swc_aeb_autosar_swc_aeb_Step_sys_Subsystem_Reference_AEB_Function_Run_AsyEvlrCritEve_Step_Func_Run_AsyEvlrCritEve_Step_Func_TAWrapper_PreProcessor_ObjectPreProcessor_ObjectPreProcessorLoop_ValidObject_SafetyMarginFrontObjects_InPathCalculationWithPredictedObjPositions_CreateInPathDataTTR_RelativePositionAtTTR_RelativePositionToHostPath4_RelativeHeadingAndRotation_StationaryObject "autosar_swc_aeb/autosar_swc_aeb_Step_sys/Subsystem Reference/AEB Function/Run_AsyEvlrCritEve_Step_Func/Run_AsyEvlrCritEve_Step_Func/TAWrapper/PreProcessor/ObjectPreProcessor/ObjectPreProcessorLoop/ValidObject/SafetyMarginFrontObjects/InPathCalculationWithPredictedObjPositions/CreateInPathDataTTR/RelativePositionAtTTR/RelativePositionToHostPath4/RelativeHeadingAndRotation/StationaryObject" /begin REF_MEASUREMENT autosar_swc_aeb_rtARID_DEF.HeadingObj_hja /end REF_MEASUREMENT /end GROUP
/begin GROUP autosar_swc_aeb_autosar_swc_aeb_Step_sys_Subsystem_Reference_AEB_Function_Run_AsyEvlrCritEve_Step_Func_Run_AsyEvlrCritEve_Step_Func_TAWrapper_PreProcessor_ObjectPreProcessor_ObjectPreProcessorLoop_ValidObject_SafetyMarginFrontObjects_InPathCalculationWithPredictedObjPositions_CreateInPathDataTTR_RelativePositionAtTTR_RelativePositionToHostPath4_RelativePosnLatAndVLat "autosar_swc_aeb/autosar_swc_aeb_Step_sys/Subsystem Reference/AEB Function/Run_AsyEvlrCritEve_Step_Func/Run_AsyEvlrCritEve_Step_Func/TAWrapper/PreProcessor/ObjectPreProcessor/ObjectPreProcessorLoop/ValidObject/SafetyMarginFrontObjects/InPathCalculationWithPredictedObjPositions/CreateInPathDataTTR/RelativePositionAtTTR/RelativePositionToHostPath4/RelativePosnLatAndVLat"
 /begin REF_MEASUREMENT autosar_swc_aeb_rtARID_DEF.PosnLatObj_krk autosar_swc_aeb_rtARID_DEF.PosnLgtObj_cki autosar_swc_aeb_rtARID_DEF.VLatObj_bmz autosar_swc_aeb_rtARID_DEF.VLgtObj_gh1 /end REF_MEASUREMENT
/end GROUP
/begin GROUP autosar_swc_aeb_autosar_swc_aeb_Step_sys_Subsystem_Reference_AEB_Function_Run_AsyEvlrCritEve_Step_Func_Run_AsyEvlrCritEve_Step_Func_TAWrapper_PreProcessor_ObjectPreProcessor_ObjectPreProcessorLoop_ValidObject_SafetyMarginFrontObjects_InPathCalculationWithPredictedObjPositions_CreateInPathDataTTR_RelativePositionAtTTR_RelativePositionToHostPath_RelativeHeadingAndRotation "autosar_swc_aeb/autosar_swc_aeb_Step_sys/Subsystem Reference/AEB Function/Run_AsyEvlrCritEve_Step_Func/Run_AsyEvlrCritEve_Step_Func/TAWrapper/PreProcessor/ObjectPreProcessor/ObjectPreProcessorLoop/ValidObject/SafetyMarginFrontObjects/InPathCalculationWithPredictedObjPositions/CreateInPathDataTTR/RelativePositionAtTTR/RelativePositionToHostPath/RelativeHeadingAndRotation"
 /begin SUB_GROUP autosar_swc_aeb_autosar_swc_aeb_Step_sys_Subsystem_Reference_AEB_Function_Run_AsyEvlrCritEve_Step_Func_Run_AsyEvlrCritEve_Step_Func_TAWrapper_PreProcessor_ObjectPreProcessor_ObjectPreProcessorLoop_ValidObject_SafetyMarginFrontObjects_InPathCalculationWithPredictedObjPositions_CreateInPathDataTTR_RelativePositionAtTTR_RelativePositionToHostPath_RelativeHeadingAndRotation_MovingObject autosar_swc_aeb_autosar_swc_aeb_Step_sys_Subsystem_Reference_AEB_Function_Run_AsyEvlrCritEve_Step_Func_Run_AsyEvlrCritEve_Step_Func_TAWrapper_PreProcessor_ObjectPreProcessor_ObjectPreProcessorLoop_ValidObject_SafetyMarginFrontObjects_InPathCalculationWithPredictedObjPositions_CreateInPathDataTTR_RelativePositionAtTTR_RelativePositionToHostPath_RelativeHeadingAndRotation_StationaryObject /end SUB_GROUP
/end GROUP
/begin GROUP autosar_swc_aeb_autosar_swc_aeb_Step_sys_Subsystem_Reference_AEB_Function_Run_AsyEvlrCritEve_Step_Func_Run_AsyEvlrCritEve_Step_Func_TAWrapper_PreProcessor_ObjectPreProcessor_ObjectPreProcessorLoop_ValidObject_SafetyMarginFrontObjects_InPathCalculationWithPredictedObjPositions_CreateInPathDataTTR_RelativePositionAtTTR_RelativePositionToHostPath_RelativeHeadingAndRotation_MovingObject "autosar_swc_aeb/autosar_swc_aeb_Step_sys/Subsystem Reference/AEB Function/Run_AsyEvlrCritEve_Step_Func/Run_AsyEvlrCritEve_Step_Func/TAWrapper/PreProcessor/ObjectPreProcessor/ObjectPreProcessorLoop/ValidObject/SafetyMarginFrontObjects/InPathCalculationWithPredictedObjPositions/CreateInPathDataTTR/RelativePositionAtTTR/RelativePositionToHostPath/RelativeHeadingAndRotation/MovingObject" /begin REF_MEASUREMENT autosar_swc_aeb_rtARID_DEF.HeadingObj /end REF_MEASUREMENT /end GROUP
/begin GROUP autosar_swc_aeb_autosar_swc_aeb_Step_sys_Subsystem_Reference_AEB_Function_Run_AsyEvlrCritEve_Step_Func_Run_AsyEvlrCritEve_Step_Func_TAWrapper_PreProcessor_ObjectPreProcessor_ObjectPreProcessorLoop_ValidObject_SafetyMarginFrontObjects_InPathCalculationWithPredictedObjPositions_CreateInPathDataTTR_RelativePositionAtTTR_RelativePositionToHostPath_RelativeHeadingAndRotation_StationaryObject "autosar_swc_aeb/autosar_swc_aeb_Step_sys/Subsystem Reference/AEB Function/Run_AsyEvlrCritEve_Step_Func/Run_AsyEvlrCritEve_Step_Func/TAWrapper/PreProcessor/ObjectPreProcessor/ObjectPreProcessorLoop/ValidObject/SafetyMarginFrontObjects/InPathCalculationWithPredictedObjPositions/CreateInPathDataTTR/RelativePositionAtTTR/RelativePositionToHostPath/RelativeHeadingAndRotation/StationaryObject" /begin REF_MEASUREMENT autosar_swc_aeb_rtARID_DEF.HeadingObj /end REF_MEASUREMENT /end GROUP
/begin GROUP autosar_swc_aeb_autosar_swc_aeb_Step_sys_Subsystem_Reference_AEB_Function_Run_AsyEvlrCritEve_Step_Func_Run_AsyEvlrCritEve_Step_Func_TAWrapper_PreProcessor_ObjectPreProcessor_ObjectPreProcessorLoop_ValidObject_SafetyMarginFrontObjects_InPathCalculationWithPredictedObjPositions_CreateInPathDataTTR_RelativePositionAtTTR_RelativePositionToHostPath_RelativePosnLatAndVLat "autosar_swc_aeb/autosar_swc_aeb_Step_sys/Subsystem Reference/AEB Function/Run_AsyEvlrCritEve_Step_Func/Run_AsyEvlrCritEve_Step_Func/TAWrapper/PreProcessor/ObjectPreProcessor/ObjectPreProcessorLoop/ValidObject/SafetyMarginFrontObjects/InPathCalculationWithPredictedObjPositions/CreateInPathDataTTR/RelativePositionAtTTR/RelativePositionToHostPath/RelativePosnLatAndVLat"
 /begin REF_MEASUREMENT autosar_swc_aeb_rtARID_DEF.PosnLatObj autosar_swc_aeb_rtARID_DEF.PosnLgtObj autosar_swc_aeb_rtARID_DEF.VLatObj autosar_swc_aeb_rtARID_DEF.VLgtObj /end REF_MEASUREMENT
/end GROUP
/begin GROUP autosar_swc_aeb_autosar_swc_aeb_Step_sys_Subsystem_Reference_AEB_Function_Run_AsyEvlrCritEve_Step_Func_Run_AsyEvlrCritEve_Step_Func_TAWrapper_PreProcessor_ObjectPreProcessor_ObjectPreProcessorLoop_ValidObject_SafetyMarginFrontObjects_InPathCalculationWithPredictedObjPositions_CreateInPathDataTTR_ToDiag_DIAG_TA_Inpath_PredObjAnBL_off_ALVTerm "autosar_swc_aeb/autosar_swc_aeb_Step_sys/Subsystem Reference/AEB Function/Run_AsyEvlrCritEve_Step_Func/Run_AsyEvlrCritEve_Step_Func/TAWrapper/PreProcessor/ObjectPreProcessor/ObjectPreProcessorLoop/ValidObject/SafetyMarginFrontObjects/InPathCalculationWithPredictedObjPositions/CreateInPathDataTTR/ToDiag/DIAG_TA_Inpath_PredObjAnBL/off/ALVTerm" /begin REF_MEASUREMENT autosar_swc_aeb_rtARID_DEF.HeadingObj_h /end REF_MEASUREMENT /end GROUP
/begin GROUP autosar_swc_aeb_autosar_swc_aeb_Step_sys_Subsystem_Reference_AEB_Function_Run_AsyEvlrCritEve_Step_Func_Run_AsyEvlrCritEve_Step_Func_TAWrapper_PreProcessor_ObjectPreProcessor_ObjectPreProcessorLoop_ValidObject_SafetyMarginFrontObjects_InPathCalculationWithPredictedObjPositions_CreateInPathDataTTR_ToDiag_DIAG_TA_Inpath_PredObjAnBS_off_ALVTerm "autosar_swc_aeb/autosar_swc_aeb_Step_sys/Subsystem Reference/AEB Function/Run_AsyEvlrCritEve_Step_Func/Run_AsyEvlrCritEve_Step_Func/TAWrapper/PreProcessor/ObjectPreProcessor/ObjectPreProcessorLoop/ValidObject/SafetyMarginFrontObjects/InPathCalculationWithPredictedObjPositions/CreateInPathDataTTR/ToDiag/DIAG_TA_Inpath_PredObjAnBS/off/ALVTerm" /begin REF_MEASUREMENT autosar_swc_aeb_rtARID_DEF.HeadingObj_hja3 /end REF_MEASUREMENT /end GROUP
/begin GROUP autosar_swc_aeb_autosar_swc_aeb_Step_sys_Subsystem_Reference_AEB_Function_Run_AsyEvlrCritEve_Step_Func_Run_AsyEvlrCritEve_Step_Func_TAWrapper_PreProcessor_ObjectPreProcessor_ObjectPreProcessorLoop_ValidObject_SafetyMarginFrontObjects_InPathCalculationWithPredictedObjPositions_CreateInPathDataTTR_ToDiag_DIAG_TA_Inpath_PredObjAn_Le_off_ALVTerm "autosar_swc_aeb/autosar_swc_aeb_Step_sys/Subsystem Reference/AEB Function/Run_AsyEvlrCritEve_Step_Func/Run_AsyEvlrCritEve_Step_Func/TAWrapper/PreProcessor/ObjectPreProcessor/ObjectPreProcessorLoop/ValidObject/SafetyMarginFrontObjects/InPathCalculationWithPredictedObjPositions/CreateInPathDataTTR/ToDiag/DIAG_TA_Inpath_PredObjAn_Le/off/ALVTerm" /begin REF_MEASUREMENT autosar_swc_aeb_rtARID_DEF.HeadingObj_hj /end REF_MEASUREMENT /end GROUP
/begin GROUP autosar_swc_aeb_autosar_swc_aeb_Step_sys_Subsystem_Reference_AEB_Function_Run_AsyEvlrCritEve_Step_Func_Run_AsyEvlrCritEve_Step_Func_TAWrapper_PreProcessor_ObjectPreProcessor_ObjectPreProcessorLoop_ValidObject_SafetyMarginFrontObjects_InPathCalculationWithPredictedObjPositions_CreateInPathDataTTR_ToDiag_DIAG_TA_Inpath_PredObjAn_Ri_off_ALVTerm "autosar_swc_aeb/autosar_swc_aeb_Step_sys/Subsystem Reference/AEB Function/Run_AsyEvlrCritEve_Step_Func/Run_AsyEvlrCritEve_Step_Func/TAWrapper/PreProcessor/ObjectPreProcessor/ObjectPreProcessorLoop/ValidObject/SafetyMarginFrontObjects/InPathCalculationWithPredictedObjPositions/CreateInPathDataTTR/ToDiag/DIAG_TA_Inpath_PredObjAn_Ri/off/ALVTerm" /begin REF_MEASUREMENT autosar_swc_aeb_rtARID_DEF.HeadingObj_hja /end REF_MEASUREMENT /end GROUP
/begin GROUP autosar_swc_aeb_autosar_swc_aeb_Step_sys_Subsystem_Reference_AEB_Function_Run_AsyEvlrCritEve_Step_Func_Run_AsyEvlrCritEve_Step_Func_TAWrapper_PreProcessor_ObjectPreProcessor_ObjectPreProcessorLoop_ValidObject_SafetyMarginFrontObjects_InPathCalculationWithPredictedObjPositions_CreateInPathDataTTR_ToDiag_DIAG_TA_Inpath_PredObjAn_off_ALVTerm "autosar_swc_aeb/autosar_swc_aeb_Step_sys/Subsystem Reference/AEB Function/Run_AsyEvlrCritEve_Step_Func/Run_AsyEvlrCritEve_Step_Func/TAWrapper/PreProcessor/ObjectPreProcessor/ObjectPreProcessorLoop/ValidObject/SafetyMarginFrontObjects/InPathCalculationWithPredictedObjPositions/CreateInPathDataTTR/ToDiag/DIAG_TA_Inpath_PredObjAn/off/ALVTerm" /begin REF_MEASUREMENT autosar_swc_aeb_rtARID_DEF.HeadingObj /end REF_MEASUREMENT /end GROUP
/begin GROUP autosar_swc_aeb_autosar_swc_aeb_Step_sys_Subsystem_Reference_AEB_Function_Run_AsyEvlrCritEve_Step_Func_Run_AsyEvlrCritEve_Step_Func_TAWrapper_PreProcessor_ObjectPreProcessor_ObjectPreProcessorLoop_ValidObject_SafetyMarginFrontObjects_InPathCalculationWithPredictedObjPositions_CreateInPathDataTTR_ToDiag_DIAG_TA_Inpath_PredObjLatBL_off_ALVTerm "autosar_swc_aeb/autosar_swc_aeb_Step_sys/Subsystem Reference/AEB Function/Run_AsyEvlrCritEve_Step_Func/Run_AsyEvlrCritEve_Step_Func/TAWrapper/PreProcessor/ObjectPreProcessor/ObjectPreProcessorLoop/ValidObject/SafetyMarginFrontObjects/InPathCalculationWithPredictedObjPositions/CreateInPathDataTTR/ToDiag/DIAG_TA_Inpath_PredObjLatBL/off/ALVTerm" /begin REF_MEASUREMENT autosar_swc_aeb_rtARID_DEF.PosnLatObj_k /end REF_MEASUREMENT /end GROUP
/begin GROUP autosar_swc_aeb_autosar_swc_aeb_Step_sys_Subsystem_Reference_AEB_Function_Run_AsyEvlrCritEve_Step_Func_Run_AsyEvlrCritEve_Step_Func_TAWrapper_PreProcessor_ObjectPreProcessor_ObjectPreProcessorLoop_ValidObject_SafetyMarginFrontObjects_InPathCalculationWithPredictedObjPositions_CreateInPathDataTTR_ToDiag_DIAG_TA_Inpath_PredObjLatBS_off_ALVTerm "autosar_swc_aeb/autosar_swc_aeb_Step_sys/Subsystem Reference/AEB Function/Run_AsyEvlrCritEve_Step_Func/Run_AsyEvlrCritEve_Step_Func/TAWrapper/PreProcessor/ObjectPreProcessor/ObjectPreProcessorLoop/ValidObject/SafetyMarginFrontObjects/InPathCalculationWithPredictedObjPositions/CreateInPathDataTTR/ToDiag/DIAG_TA_Inpath_PredObjLatBS/off/ALVTerm" /begin REF_MEASUREMENT autosar_swc_aeb_rtARID_DEF.PosnLatObj_krkk /end REF_MEASUREMENT /end GROUP
/begin GROUP autosar_swc_aeb_autosar_swc_aeb_Step_sys_Subsystem_Reference_AEB_Function_Run_AsyEvlrCritEve_Step_Func_Run_AsyEvlrCritEve_Step_Func_TAWrapper_PreProcessor_ObjectPreProcessor_ObjectPreProcessorLoop_ValidObject_SafetyMarginFrontObjects_InPathCalculationWithPredictedObjPositions_CreateInPathDataTTR_ToDiag_DIAG_TA_Inpath_PredObjLat_Le_off_ALVTerm "autosar_swc_aeb/autosar_swc_aeb_Step_sys/Subsystem Reference/AEB Function/Run_AsyEvlrCritEve_Step_Func/Run_AsyEvlrCritEve_Step_Func/TAWrapper/PreProcessor/ObjectPreProcessor/ObjectPreProcessorLoop/ValidObject/SafetyMarginFrontObjects/InPathCalculationWithPredictedObjPositions/CreateInPathDataTTR/ToDiag/DIAG_TA_Inpath_PredObjLat_Le/off/ALVTerm" /begin REF_MEASUREMENT autosar_swc_aeb_rtARID_DEF.PosnLatObj_kr /end REF_MEASUREMENT /end GROUP
/begin GROUP autosar_swc_aeb_autosar_swc_aeb_Step_sys_Subsystem_Reference_AEB_Function_Run_AsyEvlrCritEve_Step_Func_Run_AsyEvlrCritEve_Step_Func_TAWrapper_PreProcessor_ObjectPreProcessor_ObjectPreProcessorLoop_ValidObject_SafetyMarginFrontObjects_InPathCalculationWithPredictedObjPositions_CreateInPathDataTTR_ToDiag_DIAG_TA_Inpath_PredObjLat_Ri_off_ALVTerm "autosar_swc_aeb/autosar_swc_aeb_Step_sys/Subsystem Reference/AEB Function/Run_AsyEvlrCritEve_Step_Func/Run_AsyEvlrCritEve_Step_Func/TAWrapper/PreProcessor/ObjectPreProcessor/ObjectPreProcessorLoop/ValidObject/SafetyMarginFrontObjects/InPathCalculationWithPredictedObjPositions/CreateInPathDataTTR/ToDiag/DIAG_TA_Inpath_PredObjLat_Ri/off/ALVTerm" /begin REF_MEASUREMENT autosar_swc_aeb_rtARID_DEF.PosnLatObj_krk /end REF_MEASUREMENT /end GROUP
/begin GROUP autosar_swc_aeb_autosar_swc_aeb_Step_sys_Subsystem_Reference_AEB_Function_Run_AsyEvlrCritEve_Step_Func_Run_AsyEvlrCritEve_Step_Func_TAWrapper_PreProcessor_ObjectPreProcessor_ObjectPreProcessorLoop_ValidObject_SafetyMarginFrontObjects_InPathCalculationWithPredictedObjPositions_CreateInPathDataTTR_ToDiag_DIAG_TA_Inpath_PredObjLat_off_ALVTerm "autosar_swc_aeb/autosar_swc_aeb_Step_sys/Subsystem Reference/AEB Function/Run_AsyEvlrCritEve_Step_Func/Run_AsyEvlrCritEve_Step_Func/TAWrapper/PreProcessor/ObjectPreProcessor/ObjectPreProcessorLoop/ValidObject/SafetyMarginFrontObjects/InPathCalculationWithPredictedObjPositions/CreateInPathDataTTR/ToDiag/DIAG_TA_Inpath_PredObjLat/off/ALVTerm" /begin REF_MEASUREMENT autosar_swc_aeb_rtARID_DEF.PosnLatObj /end REF_MEASUREMENT /end GROUP
/begin GROUP autosar_swc_aeb_autosar_swc_aeb_Step_sys_Subsystem_Reference_AEB_Function_Run_AsyEvlrCritEve_Step_Func_Run_AsyEvlrCritEve_Step_Func_TAWrapper_PreProcessor_ObjectPreProcessor_ObjectPreProcessorLoop_ValidObject_SafetyMarginFrontObjects_InPathCalculationWithPredictedObjPositions_CreateInPathDataTTR_ToDiag_DIAG_TA_Inpath_PredObjLgtBS_off_ALVTerm "autosar_swc_aeb/autosar_swc_aeb_Step_sys/Subsystem Reference/AEB Function/Run_AsyEvlrCritEve_Step_Func/Run_AsyEvlrCritEve_Step_Func/TAWrapper/PreProcessor/ObjectPreProcessor/ObjectPreProcessorLoop/ValidObject/SafetyMarginFrontObjects/InPathCalculationWithPredictedObjPositions/CreateInPathDataTTR/ToDiag/DIAG_TA_Inpath_PredObjLgtBS/off/ALVTerm" /begin REF_MEASUREMENT autosar_swc_aeb_rtARID_DEF.PosnLgtObj_cki3 /end REF_MEASUREMENT /end GROUP
/begin GROUP autosar_swc_aeb_autosar_swc_aeb_Step_sys_Subsystem_Reference_AEB_Function_Run_AsyEvlrCritEve_Step_Func_Run_AsyEvlrCritEve_Step_Func_TAWrapper_PreProcessor_ObjectPreProcessor_ObjectPreProcessorLoop_ValidObject_SafetyMarginFrontObjects_InPathCalculationWithPredictedObjPositions_CreateInPathDataTTR_ToDiag_DIAG_TA_Inpath_PredObjLgt_BL_off_ALVTerm "autosar_swc_aeb/autosar_swc_aeb_Step_sys/Subsystem Reference/AEB Function/Run_AsyEvlrCritEve_Step_Func/Run_AsyEvlrCritEve_Step_Func/TAWrapper/PreProcessor/ObjectPreProcessor/ObjectPreProcessorLoop/ValidObject/SafetyMarginFrontObjects/InPathCalculationWithPredictedObjPositions/CreateInPathDataTTR/ToDiag/DIAG_TA_Inpath_PredObjLgt_BL/off/ALVTerm" /begin REF_MEASUREMENT autosar_swc_aeb_rtARID_DEF.PosnLgtObj_c /end REF_MEASUREMENT /end GROUP
/begin GROUP autosar_swc_aeb_autosar_swc_aeb_Step_sys_Subsystem_Reference_AEB_Function_Run_AsyEvlrCritEve_Step_Func_Run_AsyEvlrCritEve_Step_Func_TAWrapper_PreProcessor_ObjectPreProcessor_ObjectPreProcessorLoop_ValidObject_SafetyMarginFrontObjects_InPathCalculationWithPredictedObjPositions_CreateInPathDataTTR_ToDiag_DIAG_TA_Inpath_PredObjLgt_Le_off_ALVTerm "autosar_swc_aeb/autosar_swc_aeb_Step_sys/Subsystem Reference/AEB Function/Run_AsyEvlrCritEve_Step_Func/Run_AsyEvlrCritEve_Step_Func/TAWrapper/PreProcessor/ObjectPreProcessor/ObjectPreProcessorLoop/ValidObject/SafetyMarginFrontObjects/InPathCalculationWithPredictedObjPositions/CreateInPathDataTTR/ToDiag/DIAG_TA_Inpath_PredObjLgt_Le/off/ALVTerm" /begin REF_MEASUREMENT autosar_swc_aeb_rtARID_DEF.PosnLgtObj_ck /end REF_MEASUREMENT /end GROUP
/begin GROUP autosar_swc_aeb_autosar_swc_aeb_Step_sys_Subsystem_Reference_AEB_Function_Run_AsyEvlrCritEve_Step_Func_Run_AsyEvlrCritEve_Step_Func_TAWrapper_PreProcessor_ObjectPreProcessor_ObjectPreProcessorLoop_ValidObject_SafetyMarginFrontObjects_InPathCalculationWithPredictedObjPositions_CreateInPathDataTTR_ToDiag_DIAG_TA_Inpath_PredObjLgt_Ri_off_ALVTerm "autosar_swc_aeb/autosar_swc_aeb_Step_sys/Subsystem Reference/AEB Function/Run_AsyEvlrCritEve_Step_Func/Run_AsyEvlrCritEve_Step_Func/TAWrapper/PreProcessor/ObjectPreProcessor/ObjectPreProcessorLoop/ValidObject/SafetyMarginFrontObjects/InPathCalculationWithPredictedObjPositions/CreateInPathDataTTR/ToDiag/DIAG_TA_Inpath_PredObjLgt_Ri/off/ALVTerm" /begin REF_MEASUREMENT autosar_swc_aeb_rtARID_DEF.PosnLgtObj_cki /end REF_MEASUREMENT /end GROUP
/begin GROUP autosar_swc_aeb_autosar_swc_aeb_Step_sys_Subsystem_Reference_AEB_Function_Run_AsyEvlrCritEve_Step_Func_Run_AsyEvlrCritEve_Step_Func_TAWrapper_PreProcessor_ObjectPreProcessor_ObjectPreProcessorLoop_ValidObject_SafetyMarginFrontObjects_InPathCalculationWithPredictedObjPositions_CreateInPathDataTTR_ToDiag_DIAG_TA_Inpath_PredObjLgt_off_ALVTerm "autosar_swc_aeb/autosar_swc_aeb_Step_sys/Subsystem Reference/AEB Function/Run_AsyEvlrCritEve_Step_Func/Run_AsyEvlrCritEve_Step_Func/TAWrapper/PreProcessor/ObjectPreProcessor/ObjectPreProcessorLoop/ValidObject/SafetyMarginFrontObjects/InPathCalculationWithPredictedObjPositions/CreateInPathDataTTR/ToDiag/DIAG_TA_Inpath_PredObjLgt/off/ALVTerm" /begin REF_MEASUREMENT autosar_swc_aeb_rtARID_DEF.PosnLgtObj /end REF_MEASUREMENT /end GROUP
/end MODULE
/end PROJECT
