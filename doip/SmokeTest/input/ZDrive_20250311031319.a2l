ASAP2_VERSION 1 71
/begin PROJECT ProjectName ""
/begin MODULE ModuleName ""
/begin MOD_COMMON "" BYTE_ORDER MSB_LAST ALIGNMENT_BYTE 1 ALIGNMENT_WORD 1 ALIGNMENT_LONG 1 ALIGNMENT_INT64 1 ALIGNMENT_FLOAT16_IEEE 1 ALIGNMENT_FLOAT32_IEEE 1 ALIGNMENT_FLOAT64_IEEE 1 /end MOD_COMMON
/begin RECORD_LAYOUT Scalar_SWORD FNC_VALUES 1 SWORD COLUMN_DIR DIRECT /end RECORD_LAYOUT
/begin MEASUREMENT SwcIn_J3_LANE.Left_Road_Edge.LaneConfidence "" UBYTE autosar_swc_val_CM_uint8 0 0 0 255 ECU_ADDRESS 0xfe4c9b88 /* @ECU_Address@SwcIn_J3_LANE.Left_Road_Edge.LaneConfidence@ */ /end MEASUREMENT
/begin MEASUREMENT SwcIn_J3_LANE.Left_Road_Edge.LaneExtraFarPointPosX "" FLOAT32_IEEE autosar_swc_val_CM_single 0 0 -3.4E+38 3.4E+38 ECU_ADDRESS 0xfe4c9bb4 /* @ECU_Address@SwcIn_J3_LANE.Left_Road_Edge.LaneExtraFarPointPosX@ */ /end MEASUREMENT
/begin MEASUREMENT SwcIn_J3_LANE.Left_Road_Edge.LaneExtraFarPointPosY "" FLOAT32_IEEE autosar_swc_val_CM_single 0 0 -3.4E+38 3.4E+38 ECU_ADDRESS 0xfe4c9bb8 /* @ECU_Address@SwcIn_J3_LANE.Left_Road_Edge.LaneExtraFarPointPosY@ */ /end MEASUREMENT
/begin MEASUREMENT SwcIn_J3_LANE.Left_Road_Edge.LaneExtraFarPointType "" UBYTE autosar_swc_val_CM_uint8 0 0 0 255 ECU_ADDRESS 0xfe4c9b8f /* @ECU_Address@SwcIn_J3_LANE.Left_Road_Edge.LaneExtraFarPointType@ */ /end MEASUREMENT
/begin MEASUREMENT SwcIn_J3_LANE.Left_Road_Edge.LaneExtraNearPointPosX "" FLOAT32_IEEE autosar_swc_val_CM_single 0 0 -3.4E+38 3.4E+38 ECU_ADDRESS 0xfe4c9bbc /* @ECU_Address@SwcIn_J3_LANE.Left_Road_Edge.LaneExtraNearPointPosX@ */ /end MEASUREMENT
/begin MEASUREMENT SwcIn_J3_LANE.Left_Road_Edge.LaneExtraNearPointPosY "" FLOAT32_IEEE autosar_swc_val_CM_single 0 0 -3.4E+38 3.4E+38 ECU_ADDRESS 0xfe4c9bc0 /* @ECU_Address@SwcIn_J3_LANE.Left_Road_Edge.LaneExtraNearPointPosY@ */ /end MEASUREMENT
/begin MEASUREMENT SwcIn_J3_LANE.Left_Road_Edge.LaneExtraNearPointType "" UBYTE autosar_swc_val_CM_uint8 0 0 0 255 ECU_ADDRESS 0xfe4c9b8e /* @ECU_Address@SwcIn_J3_LANE.Left_Road_Edge.LaneExtraNearPointType@ */ /end MEASUREMENT
/begin MEASUREMENT SwcIn_J3_LANE.Left_Road_Edge.LaneMarkColor "" UBYTE autosar_swc_val_CM_uint8 0 0 0 255 ECU_ADDRESS 0xfe4c9b8b /* @ECU_Address@SwcIn_J3_LANE.Left_Road_Edge.LaneMarkColor@ */ /end MEASUREMENT
/begin MEASUREMENT SwcIn_J3_LANE.Left_Road_Edge.LaneMeasuringStatus "" UBYTE autosar_swc_val_CM_uint8 0 0 0 255 ECU_ADDRESS 0xfe4c9b89 /* @ECU_Address@SwcIn_J3_LANE.Left_Road_Edge.LaneMeasuringStatus@ */ /end MEASUREMENT
/begin MEASUREMENT SwcIn_J3_LANE.Left_Road_Edge.LaneModelC0 "" FLOAT32_IEEE autosar_swc_val_CM_single 0 0 -3.4E+38 3.4E+38 ECU_ADDRESS 0xfe4c9ba0 /* @ECU_Address@SwcIn_J3_LANE.Left_Road_Edge.LaneModelC0@ */ /end MEASUREMENT
/begin MEASUREMENT SwcIn_J3_LANE.Left_Road_Edge.LaneModelC1 "" FLOAT32_IEEE autosar_swc_val_CM_single 0 0 -3.4E+38 3.4E+38 ECU_ADDRESS 0xfe4c9ba4 /* @ECU_Address@SwcIn_J3_LANE.Left_Road_Edge.LaneModelC1@ */ /end MEASUREMENT
/begin MEASUREMENT SwcIn_J3_LANE.Left_Road_Edge.LaneModelC2 "" FLOAT32_IEEE autosar_swc_val_CM_single 0 0 -3.4E+38 3.4E+38 ECU_ADDRESS 0xfe4c9ba8 /* @ECU_Address@SwcIn_J3_LANE.Left_Road_Edge.LaneModelC2@ */ /end MEASUREMENT
/begin MEASUREMENT SwcIn_J3_LANE.Left_Road_Edge.LaneModelC3 "" FLOAT32_IEEE autosar_swc_val_CM_single 0 0 -3.4E+38 3.4E+38 ECU_ADDRESS 0xfe4c9bac /* @ECU_Address@SwcIn_J3_LANE.Left_Road_Edge.LaneModelC3@ */ /end MEASUREMENT
/begin MEASUREMENT SwcIn_J3_LANE.Left_Road_Edge.LaneParsingConfidence "" UBYTE autosar_swc_val_CM_uint8 0 0 0 255 ECU_ADDRESS 0xfe4c9b90 /* @ECU_Address@SwcIn_J3_LANE.Left_Road_Edge.LaneParsingConfidence@ */ /end MEASUREMENT
/begin MEASUREMENT SwcIn_J3_LANE.Left_Road_Edge.LaneQuality "" UBYTE autosar_swc_val_CM_uint8 0 0 0 255 ECU_ADDRESS 0xfe4c9b8c /* @ECU_Address@SwcIn_J3_LANE.Left_Road_Edge.LaneQuality@ */ /end MEASUREMENT
/begin MEASUREMENT SwcIn_J3_LANE.Left_Road_Edge.LaneTLC "" FLOAT32_IEEE autosar_swc_val_CM_single 0 0 -3.4E+38 3.4E+38 ECU_ADDRESS 0xfe4c9bb0 /* @ECU_Address@SwcIn_J3_LANE.Left_Road_Edge.LaneTLC@ */ /end MEASUREMENT
/begin MEASUREMENT SwcIn_J3_LANE.Left_Road_Edge.LaneTrackID "" UWORD autosar_swc_val_CM_uint16 0 0 0 65535 ECU_ADDRESS 0xfe4c9b92 /* @ECU_Address@SwcIn_J3_LANE.Left_Road_Edge.LaneTrackID@ */ /end MEASUREMENT
/begin MEASUREMENT SwcIn_J3_LANE.Left_Road_Edge.LaneTypeClass "" UBYTE autosar_swc_val_CM_uint8 0 0 0 255 ECU_ADDRESS 0xfe4c9b8a /* @ECU_Address@SwcIn_J3_LANE.Left_Road_Edge.LaneTypeClass@ */ /end MEASUREMENT
/begin MEASUREMENT SwcIn_J3_LANE.Left_Road_Edge.LaneViewRangeEnd "" FLOAT32_IEEE autosar_swc_val_CM_single 0 0 -3.4E+38 3.4E+38 ECU_ADDRESS 0xfe4c9b9c /* @ECU_Address@SwcIn_J3_LANE.Left_Road_Edge.LaneViewRangeEnd@ */ /end MEASUREMENT
/begin MEASUREMENT SwcIn_J3_LANE.Left_Road_Edge.LaneViewRangeStart "" FLOAT32_IEEE autosar_swc_val_CM_single 0 0 -3.4E+38 3.4E+38 ECU_ADDRESS 0xfe4c9b98 /* @ECU_Address@SwcIn_J3_LANE.Left_Road_Edge.LaneViewRangeStart@ */ /end MEASUREMENT
/begin MEASUREMENT SwcIn_J3_LANE.Left_Road_Edge.LaneWidthMarking "" FLOAT32_IEEE autosar_swc_val_CM_single 0 0 -3.4E+38 3.4E+38 ECU_ADDRESS 0xfe4c9b94 /* @ECU_Address@SwcIn_J3_LANE.Left_Road_Edge.LaneWidthMarking@ */ /end MEASUREMENT
/begin MEASUREMENT SwcIn_J3_LANE.Left_Road_Edge.ObstacleFlag "" UBYTE autosar_swc_val_CM_uint8 0 0 0 255 ECU_ADDRESS 0xfe4c9b8d /* @ECU_Address@SwcIn_J3_LANE.Left_Road_Edge.ObstacleFlag@ */ /end MEASUREMENT
/begin MEASUREMENT SwcIn_J3_LANE.Left_Road_Edge.Stopline_Relevancy "" UBYTE autosar_swc_val_CM_uint8 0 0 0 255 ECU_ADDRESS 0xfe4c9b91 /* @ECU_Address@SwcIn_J3_LANE.Left_Road_Edge.Stopline_Relevancy@ */ /end MEASUREMENT
/begin MEASUREMENT SwcIn_J3_LANE.LinePoints.linepoints[0].id "" ULONG autosar_swc_val_CM_uint32 0 0 0 4294967295 ECU_ADDRESS 0xfe4c9448 /* @ECU_Address@SwcIn_J3_LANE.LinePoints.linepoints[0].id@ */ /end MEASUREMENT
/begin MEASUREMENT SwcIn_J3_LANE.LinePoints.linepoints[0].point[0].point_x "" FLOAT64_IEEE autosar_swc_val_CM_double 0 0 -1.7E+308 1.7E+308 ECU_ADDRESS 0xfe4c9450 /* @ECU_Address@SwcIn_J3_LANE.LinePoints.linepoints[0].point[0].point_x@ */ /end MEASUREMENT
/begin MEASUREMENT SwcIn_J3_LANE.LinePoints.linepoints[0].point[0].point_y "" FLOAT64_IEEE autosar_swc_val_CM_double 0 0 -1.7E+308 1.7E+308 ECU_ADDRESS 0xfe4c9458 /* @ECU_Address@SwcIn_J3_LANE.LinePoints.linepoints[0].point[0].point_y@ */ /end MEASUREMENT
/begin MEASUREMENT SwcIn_J3_LANE.LinePoints.timestamp "" A_UINT64 autosar_swc_val_CM_uint64 0 0 0.0 1.844674407370955e+19 ECU_ADDRESS 0xfe4c9440 /* @ECU_Address@SwcIn_J3_LANE.LinePoints.timestamp@ */ /end MEASUREMENT
/begin MEASUREMENT SwcIn_J3_LANE.Right_Cone_Road_Edge.ConeRoadEdgeConfidence "" UBYTE autosar_swc_val_CM_uint8 0 0 0 255 ECU_ADDRESS 0xfe4c92f0 /* @ECU_Address@SwcIn_J3_LANE.Right_Cone_Road_Edge.ConeRoadEdgeConfidence@ */ /end MEASUREMENT
/begin MEASUREMENT SwcIn_J3_LANE.Right_Cone_Road_Edge.ConeRoadEdgeMeasuringStatus "" UBYTE autosar_swc_val_CM_uint8 0 0 0 255 ECU_ADDRESS 0xfe4c92f1 /* @ECU_Address@SwcIn_J3_LANE.Right_Cone_Road_Edge.ConeRoadEdgeMeasuringStatus@ */ /end MEASUREMENT
/begin MEASUREMENT SwcIn_J3_LANE.Right_Cone_Road_Edge.ConeRoadEdgeModelC0 "" FLOAT32_IEEE autosar_swc_val_CM_single 0 0 -3.4E+38 3.4E+38 ECU_ADDRESS 0xfe4c9300 /* @ECU_Address@SwcIn_J3_LANE.Right_Cone_Road_Edge.ConeRoadEdgeModelC0@ */ /end MEASUREMENT
/begin MEASUREMENT SwcIn_J3_LANE.Right_Cone_Road_Edge.ConeRoadEdgeModelC1 "" FLOAT32_IEEE autosar_swc_val_CM_single 0 0 -3.4E+38 3.4E+38 ECU_ADDRESS 0xfe4c9304 /* @ECU_Address@SwcIn_J3_LANE.Right_Cone_Road_Edge.ConeRoadEdgeModelC1@ */ /end MEASUREMENT
/begin MEASUREMENT SwcIn_J3_LANE.Right_Cone_Road_Edge.ConeRoadEdgeModelC2 "" FLOAT32_IEEE autosar_swc_val_CM_single 0 0 -3.4E+38 3.4E+38 ECU_ADDRESS 0xfe4c9308 /* @ECU_Address@SwcIn_J3_LANE.Right_Cone_Road_Edge.ConeRoadEdgeModelC2@ */ /end MEASUREMENT
/begin MEASUREMENT SwcIn_J3_LANE.Right_Cone_Road_Edge.ConeRoadEdgeModelC3 "" FLOAT32_IEEE autosar_swc_val_CM_single 0 0 -3.4E+38 3.4E+38 ECU_ADDRESS 0xfe4c930c /* @ECU_Address@SwcIn_J3_LANE.Right_Cone_Road_Edge.ConeRoadEdgeModelC3@ */ /end MEASUREMENT
/begin MEASUREMENT SwcIn_J3_LANE.Right_Cone_Road_Edge.ConeRoadEdgeParsingConfidence "" UBYTE autosar_swc_val_CM_uint8 0 0 0 255 ECU_ADDRESS 0xfe4c92f4 /* @ECU_Address@SwcIn_J3_LANE.Right_Cone_Road_Edge.ConeRoadEdgeParsingConfidence@ */ /end MEASUREMENT
/begin MEASUREMENT SwcIn_J3_LANE.Right_Cone_Road_Edge.ConeRoadEdgeQuality "" UBYTE autosar_swc_val_CM_uint8 0 0 0 255 ECU_ADDRESS 0xfe4c92f3 /* @ECU_Address@SwcIn_J3_LANE.Right_Cone_Road_Edge.ConeRoadEdgeQuality@ */ /end MEASUREMENT
/begin MEASUREMENT SwcIn_J3_LANE.Right_Cone_Road_Edge.ConeRoadEdgeTLC "" FLOAT32_IEEE autosar_swc_val_CM_single 0 0 -3.4E+38 3.4E+38 ECU_ADDRESS 0xfe4c9310 /* @ECU_Address@SwcIn_J3_LANE.Right_Cone_Road_Edge.ConeRoadEdgeTLC@ */ /end MEASUREMENT
/begin MEASUREMENT SwcIn_J3_LANE.Right_Cone_Road_Edge.ConeRoadEdgeTrackID "" UWORD autosar_swc_val_CM_uint16 0 0 0 65535 ECU_ADDRESS 0xfe4c92f6 /* @ECU_Address@SwcIn_J3_LANE.Right_Cone_Road_Edge.ConeRoadEdgeTrackID@ */ /end MEASUREMENT
/begin MEASUREMENT SwcIn_J3_LANE.Right_Cone_Road_Edge.ConeRoadEdgeTypeClass "" UBYTE autosar_swc_val_CM_uint8 0 0 0 255 ECU_ADDRESS 0xfe4c92f2 /* @ECU_Address@SwcIn_J3_LANE.Right_Cone_Road_Edge.ConeRoadEdgeTypeClass@ */ /end MEASUREMENT
/begin MEASUREMENT SwcIn_J3_LANE.Right_Cone_Road_Edge.ConeRoadEdgeViewRangeEnd "" FLOAT32_IEEE autosar_swc_val_CM_single 0 0 -3.4E+38 3.4E+38 ECU_ADDRESS 0xfe4c92fc /* @ECU_Address@SwcIn_J3_LANE.Right_Cone_Road_Edge.ConeRoadEdgeViewRangeEnd@ */ /end MEASUREMENT
/begin MEASUREMENT SwcIn_J3_LANE.Right_Cone_Road_Edge.ConeRoadEdgeViewRangeStart "" FLOAT32_IEEE autosar_swc_val_CM_single 0 0 -3.4E+38 3.4E+38 ECU_ADDRESS 0xfe4c92f8 /* @ECU_Address@SwcIn_J3_LANE.Right_Cone_Road_Edge.ConeRoadEdgeViewRangeStart@ */ /end MEASUREMENT
/begin MEASUREMENT SwcIn_J3_LANE.Right_LKA_Lane.LaneConfidence "" UBYTE autosar_swc_val_CM_uint8 0 0 0 255 ECU_ADDRESS 0xfe4c9400 /* @ECU_Address@SwcIn_J3_LANE.Right_LKA_Lane.LaneConfidence@ */ /end MEASUREMENT
/begin MEASUREMENT SwcIn_J3_LANE.Right_LKA_Lane.LaneCrossing "" UBYTE autosar_swc_val_CM_uint8 0 0 0 255 ECU_ADDRESS 0xfe4c9405 /* @ECU_Address@SwcIn_J3_LANE.Right_LKA_Lane.LaneCrossing@ */ /end MEASUREMENT
/begin MEASUREMENT SwcIn_J3_LANE.Right_LKA_Lane.LaneExtraFarPointPosX "" FLOAT32_IEEE autosar_swc_val_CM_single 0 0 -3.4E+38 3.4E+38 ECU_ADDRESS 0xfe4c9430 /* @ECU_Address@SwcIn_J3_LANE.Right_LKA_Lane.LaneExtraFarPointPosX@ */ /end MEASUREMENT
/begin MEASUREMENT SwcIn_J3_LANE.Right_LKA_Lane.LaneExtraFarPointPosY "" FLOAT32_IEEE autosar_swc_val_CM_single 0 0 -3.4E+38 3.4E+38 ECU_ADDRESS 0xfe4c9434 /* @ECU_Address@SwcIn_J3_LANE.Right_LKA_Lane.LaneExtraFarPointPosY@ */ /end MEASUREMENT
/begin MEASUREMENT SwcIn_J3_LANE.Right_LKA_Lane.LaneExtraFarPointType "" UBYTE autosar_swc_val_CM_uint8 0 0 0 255 ECU_ADDRESS 0xfe4c9408 /* @ECU_Address@SwcIn_J3_LANE.Right_LKA_Lane.LaneExtraFarPointType@ */ /end MEASUREMENT
/begin MEASUREMENT SwcIn_J3_LANE.Right_LKA_Lane.LaneExtraNearPointPosX "" FLOAT32_IEEE autosar_swc_val_CM_single 0 0 -3.4E+38 3.4E+38 ECU_ADDRESS 0xfe4c9438 /* @ECU_Address@SwcIn_J3_LANE.Right_LKA_Lane.LaneExtraNearPointPosX@ */ /end MEASUREMENT
/begin MEASUREMENT SwcIn_J3_LANE.Right_LKA_Lane.LaneExtraNearPointPosY "" FLOAT32_IEEE autosar_swc_val_CM_single 0 0 -3.4E+38 3.4E+38 ECU_ADDRESS 0xfe4c943c /* @ECU_Address@SwcIn_J3_LANE.Right_LKA_Lane.LaneExtraNearPointPosY@ */ /end MEASUREMENT
/begin MEASUREMENT SwcIn_J3_LANE.Right_LKA_Lane.LaneExtraNearPointType "" UBYTE autosar_swc_val_CM_uint8 0 0 0 255 ECU_ADDRESS 0xfe4c9407 /* @ECU_Address@SwcIn_J3_LANE.Right_LKA_Lane.LaneExtraNearPointType@ */ /end MEASUREMENT
/begin MEASUREMENT SwcIn_J3_LANE.Right_LKA_Lane.LaneMarkColor "" UBYTE autosar_swc_val_CM_uint8 0 0 0 255 ECU_ADDRESS 0xfe4c9403 /* @ECU_Address@SwcIn_J3_LANE.Right_LKA_Lane.LaneMarkColor@ */ /end MEASUREMENT
/begin MEASUREMENT SwcIn_J3_LANE.Right_LKA_Lane.LaneMeasuringStatus "" UBYTE autosar_swc_val_CM_uint8 0 0 0 255 ECU_ADDRESS 0xfe4c9401 /* @ECU_Address@SwcIn_J3_LANE.Right_LKA_Lane.LaneMeasuringStatus@ */ /end MEASUREMENT
/begin MEASUREMENT SwcIn_J3_LANE.Right_LKA_Lane.LaneModelC0 "" FLOAT32_IEEE autosar_swc_val_CM_single 0 0 -3.4E+38 3.4E+38 ECU_ADDRESS 0xfe4c941c /* @ECU_Address@SwcIn_J3_LANE.Right_LKA_Lane.LaneModelC0@ */ /end MEASUREMENT
/begin MEASUREMENT SwcIn_J3_LANE.Right_LKA_Lane.LaneModelC1 "" FLOAT32_IEEE autosar_swc_val_CM_single 0 0 -3.4E+38 3.4E+38 ECU_ADDRESS 0xfe4c9420 /* @ECU_Address@SwcIn_J3_LANE.Right_LKA_Lane.LaneModelC1@ */ /end MEASUREMENT
/begin MEASUREMENT SwcIn_J3_LANE.Right_LKA_Lane.LaneModelC2 "" FLOAT32_IEEE autosar_swc_val_CM_single 0 0 -3.4E+38 3.4E+38 ECU_ADDRESS 0xfe4c9424 /* @ECU_Address@SwcIn_J3_LANE.Right_LKA_Lane.LaneModelC2@ */ /end MEASUREMENT
/begin MEASUREMENT SwcIn_J3_LANE.Right_LKA_Lane.LaneModelC3 "" FLOAT32_IEEE autosar_swc_val_CM_single 0 0 -3.4E+38 3.4E+38 ECU_ADDRESS 0xfe4c9428 /* @ECU_Address@SwcIn_J3_LANE.Right_LKA_Lane.LaneModelC3@ */ /end MEASUREMENT
/begin MEASUREMENT SwcIn_J3_LANE.Right_LKA_Lane.LaneParsingConfidence "" UBYTE autosar_swc_val_CM_uint8 0 0 0 255 ECU_ADDRESS 0xfe4c9409 /* @ECU_Address@SwcIn_J3_LANE.Right_LKA_Lane.LaneParsingConfidence@ */ /end MEASUREMENT
/begin MEASUREMENT SwcIn_J3_LANE.Right_LKA_Lane.LaneQuality "" UBYTE autosar_swc_val_CM_uint8 0 0 0 255 ECU_ADDRESS 0xfe4c9404 /* @ECU_Address@SwcIn_J3_LANE.Right_LKA_Lane.LaneQuality@ */ /end MEASUREMENT
/begin MEASUREMENT SwcIn_J3_LANE.Right_LKA_Lane.LaneTLC "" FLOAT32_IEEE autosar_swc_val_CM_single 0 0 -3.4E+38 3.4E+38 ECU_ADDRESS 0xfe4c942c /* @ECU_Address@SwcIn_J3_LANE.Right_LKA_Lane.LaneTLC@ */ /end MEASUREMENT
/begin MEASUREMENT SwcIn_J3_LANE.Right_LKA_Lane.LaneTrackID "" UWORD autosar_swc_val_CM_uint16 0 0 0 65535 ECU_ADDRESS 0xfe4c940c /* @ECU_Address@SwcIn_J3_LANE.Right_LKA_Lane.LaneTrackID@ */ /end MEASUREMENT
/begin MEASUREMENT SwcIn_J3_LANE.Right_LKA_Lane.LaneTypeClass "" UBYTE autosar_swc_val_CM_uint8 0 0 0 255 ECU_ADDRESS 0xfe4c9402 /* @ECU_Address@SwcIn_J3_LANE.Right_LKA_Lane.LaneTypeClass@ */ /end MEASUREMENT
/begin MEASUREMENT SwcIn_J3_LANE.Right_LKA_Lane.LaneViewRangeEnd "" FLOAT32_IEEE autosar_swc_val_CM_single 0 0 -3.4E+38 3.4E+38 ECU_ADDRESS 0xfe4c9418 /* @ECU_Address@SwcIn_J3_LANE.Right_LKA_Lane.LaneViewRangeEnd@ */ /end MEASUREMENT
/begin MEASUREMENT SwcIn_J3_LANE.Right_LKA_Lane.LaneViewRangeStart "" FLOAT32_IEEE autosar_swc_val_CM_single 0 0 -3.4E+38 3.4E+38 ECU_ADDRESS 0xfe4c9414 /* @ECU_Address@SwcIn_J3_LANE.Right_LKA_Lane.LaneViewRangeStart@ */ /end MEASUREMENT
/begin MEASUREMENT SwcIn_J3_LANE.Right_LKA_Lane.LaneWidthMarking "" FLOAT32_IEEE autosar_swc_val_CM_single 0 0 -3.4E+38 3.4E+38 ECU_ADDRESS 0xfe4c9410 /* @ECU_Address@SwcIn_J3_LANE.Right_LKA_Lane.LaneWidthMarking@ */ /end MEASUREMENT
/begin MEASUREMENT SwcIn_J3_LANE.Right_LKA_Lane.ObstacleFlag "" UBYTE autosar_swc_val_CM_uint8 0 0 0 255 ECU_ADDRESS 0xfe4c9406 /* @ECU_Address@SwcIn_J3_LANE.Right_LKA_Lane.ObstacleFlag@ */ /end MEASUREMENT
/begin MEASUREMENT SwcIn_J3_LANE.Right_LKA_Lane.Stopline_Relevancy "" UBYTE autosar_swc_val_CM_uint8 0 0 0 255 ECU_ADDRESS 0xfe4c940a /* @ECU_Address@SwcIn_J3_LANE.Right_LKA_Lane.Stopline_Relevancy@ */ /end MEASUREMENT
/begin MEASUREMENT SwcIn_J3_LANE.Right_Next_Lane.LaneConfidence "" UBYTE autosar_swc_val_CM_uint8 0 0 0 255 ECU_ADDRESS 0xfe4c9ad0 /* @ECU_Address@SwcIn_J3_LANE.Right_Next_Lane.LaneConfidence@ */ /end MEASUREMENT
/begin MEASUREMENT SwcIn_J3_LANE.Right_Next_Lane.LaneExtraFarPointPosX "" FLOAT32_IEEE autosar_swc_val_CM_single 0 0 -3.4E+38 3.4E+38 ECU_ADDRESS 0xfe4c9af8 /* @ECU_Address@SwcIn_J3_LANE.Right_Next_Lane.LaneExtraFarPointPosX@ */ /end MEASUREMENT
/begin MEASUREMENT SwcIn_J3_LANE.Right_Next_Lane.LaneExtraFarPointPosY "" FLOAT32_IEEE autosar_swc_val_CM_single 0 0 -3.4E+38 3.4E+38 ECU_ADDRESS 0xfe4c9afc /* @ECU_Address@SwcIn_J3_LANE.Right_Next_Lane.LaneExtraFarPointPosY@ */ /end MEASUREMENT
/begin MEASUREMENT SwcIn_J3_LANE.Right_Next_Lane.LaneExtraFarPointType "" UBYTE autosar_swc_val_CM_uint8 0 0 0 255 ECU_ADDRESS 0xfe4c9ad7 /* @ECU_Address@SwcIn_J3_LANE.Right_Next_Lane.LaneExtraFarPointType@ */ /end MEASUREMENT
/begin MEASUREMENT SwcIn_J3_LANE.Right_Next_Lane.LaneExtraNearPointPosX "" FLOAT32_IEEE autosar_swc_val_CM_single 0 0 -3.4E+38 3.4E+38 ECU_ADDRESS 0xfe4c9b00 /* @ECU_Address@SwcIn_J3_LANE.Right_Next_Lane.LaneExtraNearPointPosX@ */ /end MEASUREMENT
/begin MEASUREMENT SwcIn_J3_LANE.Right_Next_Lane.LaneExtraNearPointPosY "" FLOAT32_IEEE autosar_swc_val_CM_single 0 0 -3.4E+38 3.4E+38 ECU_ADDRESS 0xfe4c9b04 /* @ECU_Address@SwcIn_J3_LANE.Right_Next_Lane.LaneExtraNearPointPosY@ */ /end MEASUREMENT
/begin MEASUREMENT SwcIn_J3_LANE.Right_Next_Lane.LaneExtraNearPointType "" UBYTE autosar_swc_val_CM_uint8 0 0 0 255 ECU_ADDRESS 0xfe4c9ad6 /* @ECU_Address@SwcIn_J3_LANE.Right_Next_Lane.LaneExtraNearPointType@ */ /end MEASUREMENT
/begin MEASUREMENT SwcIn_J3_LANE.Right_Next_Lane.LaneMarkColor "" UBYTE autosar_swc_val_CM_uint8 0 0 0 255 ECU_ADDRESS 0xfe4c9ad3 /* @ECU_Address@SwcIn_J3_LANE.Right_Next_Lane.LaneMarkColor@ */ /end MEASUREMENT
/begin MEASUREMENT SwcIn_J3_LANE.Right_Next_Lane.LaneMeasuringStatus "" UBYTE autosar_swc_val_CM_uint8 0 0 0 255 ECU_ADDRESS 0xfe4c9ad1 /* @ECU_Address@SwcIn_J3_LANE.Right_Next_Lane.LaneMeasuringStatus@ */ /end MEASUREMENT
/begin MEASUREMENT SwcIn_J3_LANE.Right_Next_Lane.LaneModelC0 "" FLOAT32_IEEE autosar_swc_val_CM_single 0 0 -3.4E+38 3.4E+38 ECU_ADDRESS 0xfe4c9ae8 /* @ECU_Address@SwcIn_J3_LANE.Right_Next_Lane.LaneModelC0@ */ /end MEASUREMENT
/begin MEASUREMENT SwcIn_J3_LANE.Right_Next_Lane.LaneModelC1 "" FLOAT32_IEEE autosar_swc_val_CM_single 0 0 -3.4E+38 3.4E+38 ECU_ADDRESS 0xfe4c9aec /* @ECU_Address@SwcIn_J3_LANE.Right_Next_Lane.LaneModelC1@ */ /end MEASUREMENT
/begin MEASUREMENT SwcIn_J3_LANE.Right_Next_Lane.LaneModelC2 "" FLOAT32_IEEE autosar_swc_val_CM_single 0 0 -3.4E+38 3.4E+38 ECU_ADDRESS 0xfe4c9af0 /* @ECU_Address@SwcIn_J3_LANE.Right_Next_Lane.LaneModelC2@ */ /end MEASUREMENT
/begin MEASUREMENT SwcIn_J3_LANE.Right_Next_Lane.LaneModelC3 "" FLOAT32_IEEE autosar_swc_val_CM_single 0 0 -3.4E+38 3.4E+38 ECU_ADDRESS 0xfe4c9af4 /* @ECU_Address@SwcIn_J3_LANE.Right_Next_Lane.LaneModelC3@ */ /end MEASUREMENT
/begin MEASUREMENT SwcIn_J3_LANE.Right_Next_Lane.LaneParsingConfidence "" UBYTE autosar_swc_val_CM_uint8 0 0 0 255 ECU_ADDRESS 0xfe4c9ad8 /* @ECU_Address@SwcIn_J3_LANE.Right_Next_Lane.LaneParsingConfidence@ */ /end MEASUREMENT
/begin MEASUREMENT SwcIn_J3_LANE.Right_Next_Lane.LaneQuality "" UBYTE autosar_swc_val_CM_uint8 0 0 0 255 ECU_ADDRESS 0xfe4c9ad4 /* @ECU_Address@SwcIn_J3_LANE.Right_Next_Lane.LaneQuality@ */ /end MEASUREMENT
/begin MEASUREMENT SwcIn_J3_LANE.Right_Next_Lane.LaneTrackID "" UWORD autosar_swc_val_CM_uint16 0 0 0 65535 ECU_ADDRESS 0xfe4c9ada /* @ECU_Address@SwcIn_J3_LANE.Right_Next_Lane.LaneTrackID@ */ /end MEASUREMENT
/begin MEASUREMENT SwcIn_J3_LANE.Right_Next_Lane.LaneTypeClass "" UBYTE autosar_swc_val_CM_uint8 0 0 0 255 ECU_ADDRESS 0xfe4c9ad2 /* @ECU_Address@SwcIn_J3_LANE.Right_Next_Lane.LaneTypeClass@ */ /end MEASUREMENT
/begin MEASUREMENT SwcIn_J3_LANE.Right_Next_Lane.LaneViewRangeEnd "" FLOAT32_IEEE autosar_swc_val_CM_single 0 0 -3.4E+38 3.4E+38 ECU_ADDRESS 0xfe4c9ae4 /* @ECU_Address@SwcIn_J3_LANE.Right_Next_Lane.LaneViewRangeEnd@ */ /end MEASUREMENT
/begin MEASUREMENT SwcIn_J3_LANE.Right_Next_Lane.LaneViewRangeStart "" FLOAT32_IEEE autosar_swc_val_CM_single 0 0 -3.4E+38 3.4E+38 ECU_ADDRESS 0xfe4c9ae0 /* @ECU_Address@SwcIn_J3_LANE.Right_Next_Lane.LaneViewRangeStart@ */ /end MEASUREMENT
/begin MEASUREMENT SwcIn_J3_LANE.Right_Next_Lane.LaneWidthMarking "" FLOAT32_IEEE autosar_swc_val_CM_single 0 0 -3.4E+38 3.4E+38 ECU_ADDRESS 0xfe4c9adc /* @ECU_Address@SwcIn_J3_LANE.Right_Next_Lane.LaneWidthMarking@ */ /end MEASUREMENT
/begin MEASUREMENT SwcIn_J3_LANE.Right_Next_Lane.ObstacleFlag "" UBYTE autosar_swc_val_CM_uint8 0 0 0 255 ECU_ADDRESS 0xfe4c9ad5 /* @ECU_Address@SwcIn_J3_LANE.Right_Next_Lane.ObstacleFlag@ */ /end MEASUREMENT
/begin MEASUREMENT SwcIn_J3_LANE.Right_Out_Lane.LaneConfidence "" UBYTE autosar_swc_val_CM_uint8 0 0 0 255 ECU_ADDRESS 0xfe4c9b48 /* @ECU_Address@SwcIn_J3_LANE.Right_Out_Lane.LaneConfidence@ */ /end MEASUREMENT
/begin MEASUREMENT SwcIn_J3_LANE.Right_Out_Lane.LaneCrossing "" UBYTE autosar_swc_val_CM_uint8 0 0 0 255 ECU_ADDRESS 0xfe4c9b4d /* @ECU_Address@SwcIn_J3_LANE.Right_Out_Lane.LaneCrossing@ */ /end MEASUREMENT
/begin MEASUREMENT SwcIn_J3_LANE.Right_Out_Lane.LaneExtraFarPointPosX "" FLOAT32_IEEE autosar_swc_val_CM_single 0 0 -3.4E+38 3.4E+38 ECU_ADDRESS 0xfe4c9b78 /* @ECU_Address@SwcIn_J3_LANE.Right_Out_Lane.LaneExtraFarPointPosX@ */ /end MEASUREMENT
/begin MEASUREMENT SwcIn_J3_LANE.Right_Out_Lane.LaneExtraFarPointPosY "" FLOAT32_IEEE autosar_swc_val_CM_single 0 0 -3.4E+38 3.4E+38 ECU_ADDRESS 0xfe4c9b7c /* @ECU_Address@SwcIn_J3_LANE.Right_Out_Lane.LaneExtraFarPointPosY@ */ /end MEASUREMENT
/begin MEASUREMENT SwcIn_J3_LANE.Right_Out_Lane.LaneExtraFarPointType "" UBYTE autosar_swc_val_CM_uint8 0 0 0 255 ECU_ADDRESS 0xfe4c9b50 /* @ECU_Address@SwcIn_J3_LANE.Right_Out_Lane.LaneExtraFarPointType@ */ /end MEASUREMENT
/begin MEASUREMENT SwcIn_J3_LANE.Right_Out_Lane.LaneExtraNearPointPosX "" FLOAT32_IEEE autosar_swc_val_CM_single 0 0 -3.4E+38 3.4E+38 ECU_ADDRESS 0xfe4c9b80 /* @ECU_Address@SwcIn_J3_LANE.Right_Out_Lane.LaneExtraNearPointPosX@ */ /end MEASUREMENT
/begin MEASUREMENT SwcIn_J3_LANE.Right_Out_Lane.LaneExtraNearPointPosY "" FLOAT32_IEEE autosar_swc_val_CM_single 0 0 -3.4E+38 3.4E+38 ECU_ADDRESS 0xfe4c9b84 /* @ECU_Address@SwcIn_J3_LANE.Right_Out_Lane.LaneExtraNearPointPosY@ */ /end MEASUREMENT
/begin MEASUREMENT SwcIn_J3_LANE.Right_Out_Lane.LaneExtraNearPointType "" UBYTE autosar_swc_val_CM_uint8 0 0 0 255 ECU_ADDRESS 0xfe4c9b4f /* @ECU_Address@SwcIn_J3_LANE.Right_Out_Lane.LaneExtraNearPointType@ */ /end MEASUREMENT
/begin MEASUREMENT SwcIn_J3_LANE.Right_Out_Lane.LaneMarkColor "" UBYTE autosar_swc_val_CM_uint8 0 0 0 255 ECU_ADDRESS 0xfe4c9b4b /* @ECU_Address@SwcIn_J3_LANE.Right_Out_Lane.LaneMarkColor@ */ /end MEASUREMENT
/begin MEASUREMENT SwcIn_J3_LANE.Right_Out_Lane.LaneMeasuringStatus "" UBYTE autosar_swc_val_CM_uint8 0 0 0 255 ECU_ADDRESS 0xfe4c9b49 /* @ECU_Address@SwcIn_J3_LANE.Right_Out_Lane.LaneMeasuringStatus@ */ /end MEASUREMENT
/begin MEASUREMENT SwcIn_J3_LANE.Right_Out_Lane.LaneModelC0 "" FLOAT32_IEEE autosar_swc_val_CM_single 0 0 -3.4E+38 3.4E+38 ECU_ADDRESS 0xfe4c9b64 /* @ECU_Address@SwcIn_J3_LANE.Right_Out_Lane.LaneModelC0@ */ /end MEASUREMENT
/begin MEASUREMENT SwcIn_J3_LANE.Right_Out_Lane.LaneModelC1 "" FLOAT32_IEEE autosar_swc_val_CM_single 0 0 -3.4E+38 3.4E+38 ECU_ADDRESS 0xfe4c9b68 /* @ECU_Address@SwcIn_J3_LANE.Right_Out_Lane.LaneModelC1@ */ /end MEASUREMENT
/begin MEASUREMENT SwcIn_J3_LANE.Right_Out_Lane.LaneModelC2 "" FLOAT32_IEEE autosar_swc_val_CM_single 0 0 -3.4E+38 3.4E+38 ECU_ADDRESS 0xfe4c9b6c /* @ECU_Address@SwcIn_J3_LANE.Right_Out_Lane.LaneModelC2@ */ /end MEASUREMENT
/begin MEASUREMENT SwcIn_J3_LANE.Right_Out_Lane.LaneModelC3 "" FLOAT32_IEEE autosar_swc_val_CM_single 0 0 -3.4E+38 3.4E+38 ECU_ADDRESS 0xfe4c9b70 /* @ECU_Address@SwcIn_J3_LANE.Right_Out_Lane.LaneModelC3@ */ /end MEASUREMENT
/begin MEASUREMENT SwcIn_J3_LANE.Right_Out_Lane.LaneParsingConfidence "" UBYTE autosar_swc_val_CM_uint8 0 0 0 255 ECU_ADDRESS 0xfe4c9b51 /* @ECU_Address@SwcIn_J3_LANE.Right_Out_Lane.LaneParsingConfidence@ */ /end MEASUREMENT
/begin MEASUREMENT SwcIn_J3_LANE.Right_Out_Lane.LaneQuality "" UBYTE autosar_swc_val_CM_uint8 0 0 0 255 ECU_ADDRESS 0xfe4c9b4c /* @ECU_Address@SwcIn_J3_LANE.Right_Out_Lane.LaneQuality@ */ /end MEASUREMENT
/begin MEASUREMENT SwcIn_J3_LANE.Right_Out_Lane.LaneTLC "" FLOAT32_IEEE autosar_swc_val_CM_single 0 0 -3.4E+38 3.4E+38 ECU_ADDRESS 0xfe4c9b74 /* @ECU_Address@SwcIn_J3_LANE.Right_Out_Lane.LaneTLC@ */ /end MEASUREMENT
/begin MEASUREMENT SwcIn_J3_LANE.Right_Out_Lane.LaneTrackID "" UWORD autosar_swc_val_CM_uint16 0 0 0 65535 ECU_ADDRESS 0xfe4c9b54 /* @ECU_Address@SwcIn_J3_LANE.Right_Out_Lane.LaneTrackID@ */ /end MEASUREMENT
/begin MEASUREMENT SwcIn_J3_LANE.Right_Out_Lane.LaneTypeClass "" UBYTE autosar_swc_val_CM_uint8 0 0 0 255 ECU_ADDRESS 0xfe4c9b4a /* @ECU_Address@SwcIn_J3_LANE.Right_Out_Lane.LaneTypeClass@ */ /end MEASUREMENT
/begin MEASUREMENT SwcIn_J3_LANE.Right_Out_Lane.LaneViewRangeEnd "" FLOAT32_IEEE autosar_swc_val_CM_single 0 0 -3.4E+38 3.4E+38 ECU_ADDRESS 0xfe4c9b60 /* @ECU_Address@SwcIn_J3_LANE.Right_Out_Lane.LaneViewRangeEnd@ */ /end MEASUREMENT
/begin MEASUREMENT SwcIn_J3_LANE.Right_Out_Lane.LaneViewRangeStart "" FLOAT32_IEEE autosar_swc_val_CM_single 0 0 -3.4E+38 3.4E+38 ECU_ADDRESS 0xfe4c9b5c /* @ECU_Address@SwcIn_J3_LANE.Right_Out_Lane.LaneViewRangeStart@ */ /end MEASUREMENT
/begin MEASUREMENT SwcIn_J3_LANE.Right_Out_Lane.LaneWidthMarking "" FLOAT32_IEEE autosar_swc_val_CM_single 0 0 -3.4E+38 3.4E+38 ECU_ADDRESS 0xfe4c9b58 /* @ECU_Address@SwcIn_J3_LANE.Right_Out_Lane.LaneWidthMarking@ */ /end MEASUREMENT
/begin MEASUREMENT SwcIn_J3_LANE.Right_Out_Lane.ObstacleFlag "" UBYTE autosar_swc_val_CM_uint8 0 0 0 255 ECU_ADDRESS 0xfe4c9b4e /* @ECU_Address@SwcIn_J3_LANE.Right_Out_Lane.ObstacleFlag@ */ /end MEASUREMENT
/begin MEASUREMENT SwcIn_J3_LANE.Right_Out_Lane.Stopline_Relevancy "" UBYTE autosar_swc_val_CM_uint8 0 0 0 255 ECU_ADDRESS 0xfe4c9b52 /* @ECU_Address@SwcIn_J3_LANE.Right_Out_Lane.Stopline_Relevancy@ */ /end MEASUREMENT
/begin MEASUREMENT SwcIn_J3_LANE.Right_Road_Edge.LaneConfidence "" UBYTE autosar_swc_val_CM_uint8 0 0 0 255 ECU_ADDRESS 0xfe4c9bc4 /* @ECU_Address@SwcIn_J3_LANE.Right_Road_Edge.LaneConfidence@ */ /end MEASUREMENT
/begin MEASUREMENT SwcIn_J3_LANE.Right_Road_Edge.LaneExtraFarPointPosX "" FLOAT32_IEEE autosar_swc_val_CM_single 0 0 -3.4E+38 3.4E+38 ECU_ADDRESS 0xfe4c9bf0 /* @ECU_Address@SwcIn_J3_LANE.Right_Road_Edge.LaneExtraFarPointPosX@ */ /end MEASUREMENT
/begin MEASUREMENT SwcIn_J3_LANE.Right_Road_Edge.LaneExtraFarPointPosY "" FLOAT32_IEEE autosar_swc_val_CM_single 0 0 -3.4E+38 3.4E+38 ECU_ADDRESS 0xfe4c9bf4 /* @ECU_Address@SwcIn_J3_LANE.Right_Road_Edge.LaneExtraFarPointPosY@ */ /end MEASUREMENT
/begin MEASUREMENT SwcIn_J3_LANE.Right_Road_Edge.LaneExtraFarPointType "" UBYTE autosar_swc_val_CM_uint8 0 0 0 255 ECU_ADDRESS 0xfe4c9bcb /* @ECU_Address@SwcIn_J3_LANE.Right_Road_Edge.LaneExtraFarPointType@ */ /end MEASUREMENT
/begin MEASUREMENT SwcIn_J3_LANE.Right_Road_Edge.LaneExtraNearPointPosX "" FLOAT32_IEEE autosar_swc_val_CM_single 0 0 -3.4E+38 3.4E+38 ECU_ADDRESS 0xfe4c9bf8 /* @ECU_Address@SwcIn_J3_LANE.Right_Road_Edge.LaneExtraNearPointPosX@ */ /end MEASUREMENT
/begin MEASUREMENT SwcIn_J3_LANE.Right_Road_Edge.LaneExtraNearPointPosY "" FLOAT32_IEEE autosar_swc_val_CM_single 0 0 -3.4E+38 3.4E+38 ECU_ADDRESS 0xfe4c9bfc /* @ECU_Address@SwcIn_J3_LANE.Right_Road_Edge.LaneExtraNearPointPosY@ */ /end MEASUREMENT
/begin MEASUREMENT SwcIn_J3_LANE.Right_Road_Edge.LaneExtraNearPointType "" UBYTE autosar_swc_val_CM_uint8 0 0 0 255 ECU_ADDRESS 0xfe4c9bca /* @ECU_Address@SwcIn_J3_LANE.Right_Road_Edge.LaneExtraNearPointType@ */ /end MEASUREMENT
/begin MEASUREMENT SwcIn_J3_LANE.Right_Road_Edge.LaneMarkColor "" UBYTE autosar_swc_val_CM_uint8 0 0 0 255 ECU_ADDRESS 0xfe4c9bc7 /* @ECU_Address@SwcIn_J3_LANE.Right_Road_Edge.LaneMarkColor@ */ /end MEASUREMENT
/begin MEASUREMENT SwcIn_J3_LANE.Right_Road_Edge.LaneMeasuringStatus "" UBYTE autosar_swc_val_CM_uint8 0 0 0 255 ECU_ADDRESS 0xfe4c9bc5 /* @ECU_Address@SwcIn_J3_LANE.Right_Road_Edge.LaneMeasuringStatus@ */ /end MEASUREMENT
/begin MEASUREMENT SwcIn_J3_LANE.Right_Road_Edge.LaneModelC0 "" FLOAT32_IEEE autosar_swc_val_CM_single 0 0 -3.4E+38 3.4E+38 ECU_ADDRESS 0xfe4c9bdc /* @ECU_Address@SwcIn_J3_LANE.Right_Road_Edge.LaneModelC0@ */ /end MEASUREMENT
/begin MEASUREMENT SwcIn_J3_LANE.Right_Road_Edge.LaneModelC1 "" FLOAT32_IEEE autosar_swc_val_CM_single 0 0 -3.4E+38 3.4E+38 ECU_ADDRESS 0xfe4c9be0 /* @ECU_Address@SwcIn_J3_LANE.Right_Road_Edge.LaneModelC1@ */ /end MEASUREMENT
/begin MEASUREMENT SwcIn_J3_LANE.Right_Road_Edge.LaneModelC2 "" FLOAT32_IEEE autosar_swc_val_CM_single 0 0 -3.4E+38 3.4E+38 ECU_ADDRESS 0xfe4c9be4 /* @ECU_Address@SwcIn_J3_LANE.Right_Road_Edge.LaneModelC2@ */ /end MEASUREMENT
/begin MEASUREMENT SwcIn_J3_LANE.Right_Road_Edge.LaneModelC3 "" FLOAT32_IEEE autosar_swc_val_CM_single 0 0 -3.4E+38 3.4E+38 ECU_ADDRESS 0xfe4c9be8 /* @ECU_Address@SwcIn_J3_LANE.Right_Road_Edge.LaneModelC3@ */ /end MEASUREMENT
/begin MEASUREMENT SwcIn_J3_LANE.Right_Road_Edge.LaneParsingConfidence "" UBYTE autosar_swc_val_CM_uint8 0 0 0 255 ECU_ADDRESS 0xfe4c9bcc /* @ECU_Address@SwcIn_J3_LANE.Right_Road_Edge.LaneParsingConfidence@ */ /end MEASUREMENT
/begin MEASUREMENT SwcIn_J3_LANE.Right_Road_Edge.LaneQuality "" UBYTE autosar_swc_val_CM_uint8 0 0 0 255 ECU_ADDRESS 0xfe4c9bc8 /* @ECU_Address@SwcIn_J3_LANE.Right_Road_Edge.LaneQuality@ */ /end MEASUREMENT
/begin MEASUREMENT SwcIn_J3_LANE.Right_Road_Edge.LaneTLC "" FLOAT32_IEEE autosar_swc_val_CM_single 0 0 -3.4E+38 3.4E+38 ECU_ADDRESS 0xfe4c9bec /* @ECU_Address@SwcIn_J3_LANE.Right_Road_Edge.LaneTLC@ */ /end MEASUREMENT
/begin MEASUREMENT SwcIn_J3_LANE.Right_Road_Edge.LaneTrackID "" UWORD autosar_swc_val_CM_uint16 0 0 0 65535 ECU_ADDRESS 0xfe4c9bce /* @ECU_Address@SwcIn_J3_LANE.Right_Road_Edge.LaneTrackID@ */ /end MEASUREMENT
/begin MEASUREMENT SwcIn_J3_LANE.Right_Road_Edge.LaneTypeClass "" UBYTE autosar_swc_val_CM_uint8 0 0 0 255 ECU_ADDRESS 0xfe4c9bc6 /* @ECU_Address@SwcIn_J3_LANE.Right_Road_Edge.LaneTypeClass@ */ /end MEASUREMENT
/begin MEASUREMENT SwcIn_J3_LANE.Right_Road_Edge.LaneViewRangeEnd "" FLOAT32_IEEE autosar_swc_val_CM_single 0 0 -3.4E+38 3.4E+38 ECU_ADDRESS 0xfe4c9bd8 /* @ECU_Address@SwcIn_J3_LANE.Right_Road_Edge.LaneViewRangeEnd@ */ /end MEASUREMENT
/begin MEASUREMENT SwcIn_J3_LANE.Right_Road_Edge.LaneViewRangeStart "" FLOAT32_IEEE autosar_swc_val_CM_single 0 0 -3.4E+38 3.4E+38 ECU_ADDRESS 0xfe4c9bd4 /* @ECU_Address@SwcIn_J3_LANE.Right_Road_Edge.LaneViewRangeStart@ */ /end MEASUREMENT
/begin MEASUREMENT SwcIn_J3_LANE.Right_Road_Edge.LaneWidthMarking "" FLOAT32_IEEE autosar_swc_val_CM_single 0 0 -3.4E+38 3.4E+38 ECU_ADDRESS 0xfe4c9bd0 /* @ECU_Address@SwcIn_J3_LANE.Right_Road_Edge.LaneWidthMarking@ */ /end MEASUREMENT
/begin MEASUREMENT SwcIn_J3_LANE.Right_Road_Edge.ObstacleFlag "" UBYTE autosar_swc_val_CM_uint8 0 0 0 255 ECU_ADDRESS 0xfe4c9bc9 /* @ECU_Address@SwcIn_J3_LANE.Right_Road_Edge.ObstacleFlag@ */ /end MEASUREMENT
/begin MEASUREMENT SwcIn_J3_LANE.Right_Road_Edge.Stopline_Relevancy "" UBYTE autosar_swc_val_CM_uint8 0 0 0 255 ECU_ADDRESS 0xfe4c9bcd /* @ECU_Address@SwcIn_J3_LANE.Right_Road_Edge.Stopline_Relevancy@ */ /end MEASUREMENT
/begin MEASUREMENT SwcIn_J3_LANE.Road_Information.CrossWalkBox.corner_x_vec "" FLOAT32_IEEE autosar_swc_val_CM_single 0 0 -3.4E+38 3.4E+38 LAYOUT COLUMN_DIR MATRIX_DIM 4 ECU_ADDRESS 0xfe4c9c10 /* @ECU_Address@SwcIn_J3_LANE.Road_Information.CrossWalkBox.corner_x_vec@ */ /end MEASUREMENT
/begin MEASUREMENT SwcIn_J3_LANE.Road_Information.CrossWalkBox.corner_y_vec "" FLOAT32_IEEE autosar_swc_val_CM_single 0 0 -3.4E+38 3.4E+38 LAYOUT COLUMN_DIR MATRIX_DIM 4 ECU_ADDRESS 0xfe4c9c20 /* @ECU_Address@SwcIn_J3_LANE.Road_Information.CrossWalkBox.corner_y_vec@ */ /end MEASUREMENT
/begin MEASUREMENT SwcIn_J3_LANE.Road_Information.CrossWalkCoor.mod "" FLOAT32_IEEE autosar_swc_val_CM_single 0 0 -3.4E+38 3.4E+38 ECU_ADDRESS 0xfe4c9c38 /* @ECU_Address@SwcIn_J3_LANE.Road_Information.CrossWalkCoor.mod@ */ /end MEASUREMENT
/begin MEASUREMENT SwcIn_J3_LANE.Road_Information.CrossWalkCoor.x "" FLOAT32_IEEE autosar_swc_val_CM_single 0 0 -3.4E+38 3.4E+38 ECU_ADDRESS 0xfe4c9c30 /* @ECU_Address@SwcIn_J3_LANE.Road_Information.CrossWalkCoor.x@ */ /end MEASUREMENT
/begin MEASUREMENT SwcIn_J3_LANE.Road_Information.CrossWalkCoor.y "" FLOAT32_IEEE autosar_swc_val_CM_single 0 0 -3.4E+38 3.4E+38 ECU_ADDRESS 0xfe4c9c34 /* @ECU_Address@SwcIn_J3_LANE.Road_Information.CrossWalkCoor.y@ */ /end MEASUREMENT
/begin MEASUREMENT SwcIn_J3_LANE.Road_Information.CrossWalkValid "" UBYTE autosar_swc_val_CM_uint8 0 0 0 255 ECU_ADDRESS 0xfe4c9c08 /* @ECU_Address@SwcIn_J3_LANE.Road_Information.CrossWalkValid@ */ /end MEASUREMENT
/begin MEASUREMENT SwcIn_J3_LANE.Road_Information.CurrentTime "" UBYTE autosar_swc_val_CM_uint8 0 0 0 255 ECU_ADDRESS 0xfe4c9c02 /* @ECU_Address@SwcIn_J3_LANE.Road_Information.CurrentTime@ */ /end MEASUREMENT
/begin MEASUREMENT SwcIn_J3_LANE.Road_Information.CurrentWeather "" UBYTE autosar_swc_val_CM_uint8 0 0 0 255 ECU_ADDRESS 0xfe4c9c01 /* @ECU_Address@SwcIn_J3_LANE.Road_Information.CurrentWeather@ */ /end MEASUREMENT
/begin MEASUREMENT SwcIn_J3_LANE.Road_Information.DisStopline "" FLOAT32_IEEE autosar_swc_val_CM_single 0 0 -3.4E+38 3.4E+38 ECU_ADDRESS 0xfe4c9c0c /* @ECU_Address@SwcIn_J3_LANE.Road_Information.DisStopline@ */ /end MEASUREMENT
/begin MEASUREMENT SwcIn_J3_LANE.Road_Information.DisStoplineValid "" UBYTE autosar_swc_val_CM_uint8 0 0 0 255 ECU_ADDRESS 0xfe4c9c04 /* @ECU_Address@SwcIn_J3_LANE.Road_Information.DisStoplineValid@ */ /end MEASUREMENT
/begin MEASUREMENT SwcIn_J3_LANE.Road_Information.LightType "" UBYTE autosar_swc_val_CM_uint8 0 0 0 255 ECU_ADDRESS 0xfe4c9c03 /* @ECU_Address@SwcIn_J3_LANE.Road_Information.LightType@ */ /end MEASUREMENT
/begin MEASUREMENT SwcIn_J3_LANE.Road_Information.ProtocolMajorVersion "" UBYTE autosar_swc_val_CM_uint8 0 0 0 255 ECU_ADDRESS 0xfe4c9c05 /* @ECU_Address@SwcIn_J3_LANE.Road_Information.ProtocolMajorVersion@ */ /end MEASUREMENT
/begin MEASUREMENT SwcIn_J3_LANE.Road_Information.ProtocolMinorVersion "" UBYTE autosar_swc_val_CM_uint8 0 0 0 255 ECU_ADDRESS 0xfe4c9c06 /* @ECU_Address@SwcIn_J3_LANE.Road_Information.ProtocolMinorVersion@ */ /end MEASUREMENT
/begin MEASUREMENT SwcIn_J3_LANE.Road_Information.RoadType "" UBYTE autosar_swc_val_CM_uint8 0 0 0 255 ECU_ADDRESS 0xfe4c9c00 /* @ECU_Address@SwcIn_J3_LANE.Road_Information.RoadType@ */ /end MEASUREMENT
/begin MEASUREMENT SwcIn_J3_LANE.Road_Information.TerrainType "" UBYTE autosar_swc_val_CM_uint8 0 0 0 255 ECU_ADDRESS 0xfe4c9c07 /* @ECU_Address@SwcIn_J3_LANE.Road_Information.TerrainType@ */ /end MEASUREMENT
/begin MEASUREMENT SwcIn_MFS_2.MFS_2_CRC "" UBYTE autosar_swc_val_CM_MFS_2_CRC_864_dt 0 0 0 255 ECU_ADDRESS 0xfe4cbc5f /* @ECU_Address@SwcIn_MFS_2.MFS_2_CRC@ */ /end MEASUREMENT
/begin MEASUREMENT SwcIn_MFS_2.MFS_2_RollgCntr "" UBYTE autosar_swc_val_CM_MFS_2_RollgCntr_864_dt 0 0 0 255 ECU_ADDRESS 0xfe4cbc60 /* @ECU_Address@SwcIn_MFS_2.MFS_2_RollgCntr@ */ /end MEASUREMENT
/begin MEASUREMENT SwcIn_MFS_2.MFS_Cruise_Control "" UBYTE autosar_swc_val_CM_MFS_Cruise_Control_864_dt 0 0 0 255 ECU_ADDRESS 0xfe4cbc61 /* @ECU_Address@SwcIn_MFS_2.MFS_Cruise_Control@ */ /end MEASUREMENT
/begin MEASUREMENT SwcIn_MFS_2.MFS_LeRollrUpDwnAdjSteps "" UBYTE autosar_swc_val_CM_MFS_LeRollrUpDwnAdjSteps_864_dt 0 0 0 255 ECU_ADDRESS 0xfe4cbc69 /* @ECU_Address@SwcIn_MFS_2.MFS_LeRollrUpDwnAdjSteps@ */ /end MEASUREMENT
/begin MEASUREMENT SwcIn_MFS_2.MFS_LeftRoller "" UBYTE autosar_swc_val_CM_MFS_LeftRoller_864_dt 0 0 0 255 ECU_ADDRESS 0xfe4cbc67 /* @ECU_Address@SwcIn_MFS_2.MFS_LeftRoller@ */ /end MEASUREMENT
/begin MEASUREMENT SwcIn_MFS_2.MFS_LeftRollerMiddleKey "" UBYTE autosar_swc_val_CM_MFS_LeftRollerMiddleKey_864_dt 0 0 0 255 ECU_ADDRESS 0xfe4cbc68 /* @ECU_Address@SwcIn_MFS_2.MFS_LeftRollerMiddleKey@ */ /end MEASUREMENT
/begin MEASUREMENT SwcIn_MFS_2.MFS_RESPlus "" UBYTE autosar_swc_val_CM_MFS_RESPlus_864_dt 0 0 0 255 ECU_ADDRESS 0xfe4cbc62 /* @ECU_Address@SwcIn_MFS_2.MFS_RESPlus@ */ /end MEASUREMENT
/begin MEASUREMENT SwcIn_MFS_2.MFS_Rsp_Error "" UBYTE autosar_swc_val_CM_MFS_Rsp_Error_864_dt 0 0 0 255 ECU_ADDRESS 0xfe4cbc66 /* @ECU_Address@SwcIn_MFS_2.MFS_Rsp_Error@ */ /end MEASUREMENT
/begin MEASUREMENT SwcIn_MFS_2.MFS_SETMinus "" UBYTE autosar_swc_val_CM_MFS_SETMinus_864_dt 0 0 0 255 ECU_ADDRESS 0xfe4cbc63 /* @ECU_Address@SwcIn_MFS_2.MFS_SETMinus@ */ /end MEASUREMENT
/begin MEASUREMENT SwcIn_MFS_2.MFS_Time_Gap_Add "" UBYTE autosar_swc_val_CM_MFS_Time_Gap_Add_864_dt 0 0 0 255 ECU_ADDRESS 0xfe4cbc65 /* @ECU_Address@SwcIn_MFS_2.MFS_Time_Gap_Add@ */ /end MEASUREMENT
/begin MEASUREMENT SwcIn_MFS_2.MFS_Time_Gap_Reduce "" UBYTE autosar_swc_val_CM_MFS_Time_Gap_Reduce_864_dt 0 0 0 255 ECU_ADDRESS 0xfe4cbc64 /* @ECU_Address@SwcIn_MFS_2.MFS_Time_Gap_Reduce@ */ /end MEASUREMENT
/begin MEASUREMENT SwcIn_ONEBOX_1.ABS_ESP_1_ABSActive "" UBYTE autosar_swc_val_CM_ABS_ESP_1_ABSActive_152_dt 0 0 0 255 ECU_ADDRESS 0xfe4c9c97 /* @ECU_Address@SwcIn_ONEBOX_1.ABS_ESP_1_ABSActive@ */ /end MEASUREMENT
/begin MEASUREMENT SwcIn_ONEBOX_1.ABS_ESP_1_ABSFailSts "" UBYTE autosar_swc_val_CM_ABS_ESP_1_ABSFailSts_152_dt 0 0 0 255 ECU_ADDRESS 0xfe4c9c92 /* @ECU_Address@SwcIn_ONEBOX_1.ABS_ESP_1_ABSFailSts@ */ /end MEASUREMENT
/begin MEASUREMENT SwcIn_ONEBOX_1.ABS_ESP_1_EBDFailSts "" UBYTE autosar_swc_val_CM_ABS_ESP_1_EBDFailSts_152_dt 0 0 0 255 ECU_ADDRESS 0xfe4c9c91 /* @ECU_Address@SwcIn_ONEBOX_1.ABS_ESP_1_EBDFailSts@ */ /end MEASUREMENT
/begin MEASUREMENT SwcIn_ONEBOX_1.ABS_ESP_1_ESPSwitchStatus "" UBYTE autosar_swc_val_CM_ABS_ESP_1_ESPSwitchStatus_152_dt 0 0 0 255 ECU_ADDRESS 0xfe4c9ca2 /* @ECU_Address@SwcIn_ONEBOX_1.ABS_ESP_1_ESPSwitchStatus@ */ /end MEASUREMENT
/begin MEASUREMENT SwcIn_ONEBOX_1.ABS_ESP_1_HDCCtrlSts "" UBYTE autosar_swc_val_CM_ABS_ESP_1_HDCCtrlSts_152_dt 0 0 0 255 ECU_ADDRESS 0xfe4c9c9f /* @ECU_Address@SwcIn_ONEBOX_1.ABS_ESP_1_HDCCtrlSts@ */ /end MEASUREMENT
/begin MEASUREMENT SwcIn_ONEBOX_1.ABS_ESP_1_HDCFailSts "" UBYTE autosar_swc_val_CM_ABS_ESP_1_HDCFailSts_152_dt 0 0 0 255 ECU_ADDRESS 0xfe4c9ca0 /* @ECU_Address@SwcIn_ONEBOX_1.ABS_ESP_1_HDCFailSts@ */ /end MEASUREMENT
/begin MEASUREMENT SwcIn_ONEBOX_1.ABS_ESP_1_HHCFailSts "" UBYTE autosar_swc_val_CM_ABS_ESP_1_HHCFailSts_152_dt 0 0 0 255 ECU_ADDRESS 0xfe4c9c9d /* @ECU_Address@SwcIn_ONEBOX_1.ABS_ESP_1_HHCFailSts@ */ /end MEASUREMENT
/begin MEASUREMENT SwcIn_ONEBOX_1.ABS_ESP_1_TCSActive "" UBYTE autosar_swc_val_CM_ABS_ESP_1_TCSActive_152_dt 0 0 0 255 ECU_ADDRESS 0xfe4c9c9b /* @ECU_Address@SwcIn_ONEBOX_1.ABS_ESP_1_TCSActive@ */ /end MEASUREMENT
/begin MEASUREMENT SwcIn_ONEBOX_1.ABS_ESP_1_TCSFailSts "" UBYTE autosar_swc_val_CM_ABS_ESP_1_TCSFailSts_152_dt 0 0 0 255 ECU_ADDRESS 0xfe4c9c9a /* @ECU_Address@SwcIn_ONEBOX_1.ABS_ESP_1_TCSFailSts@ */ /end MEASUREMENT
/begin MEASUREMENT SwcIn_ONEBOX_1.ABS_ESP_1_VDCActive "" UBYTE autosar_swc_val_CM_ABS_ESP_1_VDCActive_152_dt 0 0 0 255 ECU_ADDRESS 0xfe4c9c99 /* @ECU_Address@SwcIn_ONEBOX_1.ABS_ESP_1_VDCActive@ */ /end MEASUREMENT
/begin MEASUREMENT SwcIn_ONEBOX_1.ABS_ESP_1_VDCFailSts "" UBYTE autosar_swc_val_CM_ABS_ESP_1_VDCFailSts_152_dt 0 0 0 255 ECU_ADDRESS 0xfe4c9c98 /* @ECU_Address@SwcIn_ONEBOX_1.ABS_ESP_1_VDCFailSts@ */ /end MEASUREMENT
/begin MEASUREMENT SwcIn_ONEBOX_1.ABS_ESP_1_VehicleSpeedVSOSig "" FLOAT32_IEEE autosar_swc_val_CM_ABS_ESP_1_VehicleSpeedVSOSig_152_dt 0 0 -3.4E+38 3.4E+38 ECU_ADDRESS 0xfe4c9c8c /* @ECU_Address@SwcIn_ONEBOX_1.ABS_ESP_1_VehicleSpeedVSOSig@ */ /end MEASUREMENT
/begin MEASUREMENT SwcIn_ONEBOX_1.AEBdecActive "" UBYTE autosar_swc_val_CM_AEBdecActive_152_dt 0 0 0 255 ECU_ADDRESS 0xfe4c9cab /* @ECU_Address@SwcIn_ONEBOX_1.AEBdecActive@ */ /end MEASUREMENT
/begin MEASUREMENT SwcIn_ONEBOX_1.AEBdecAvailable "" UBYTE autosar_swc_val_CM_AEBdecAvailable_152_dt 0 0 0 255 ECU_ADDRESS 0xfe4c9cac /* @ECU_Address@SwcIn_ONEBOX_1.AEBdecAvailable@ */ /end MEASUREMENT
/begin MEASUREMENT SwcIn_ONEBOX_1.BLRequestController "" UBYTE autosar_swc_val_CM_BLRequestController_152_dt 0 0 0 255 ECU_ADDRESS 0xfe4c9ca3 /* @ECU_Address@SwcIn_ONEBOX_1.BLRequestController@ */ /end MEASUREMENT
/begin MEASUREMENT SwcIn_ONEBOX_1.BrakeSystemType "" UBYTE autosar_swc_val_CM_BrakeSystemType_152_dt 0 0 0 255 ECU_ADDRESS 0xfe4c9c9c /* @ECU_Address@SwcIn_ONEBOX_1.BrakeSystemType@ */ /end MEASUREMENT
/begin MEASUREMENT SwcIn_ONEBOX_1.CDPActive "" UBYTE autosar_swc_val_CM_CDPActive_152_dt 0 0 0 255 ECU_ADDRESS 0xfe4c9cad /* @ECU_Address@SwcIn_ONEBOX_1.CDPActive@ */ /end MEASUREMENT
/begin MEASUREMENT SwcIn_ONEBOX_1.CDPFailSts "" UBYTE autosar_swc_val_CM_CDPFailSts_152_dt 0 0 0 255 ECU_ADDRESS 0xfe4c9cae /* @ECU_Address@SwcIn_ONEBOX_1.CDPFailSts@ */ /end MEASUREMENT
/begin MEASUREMENT SwcIn_ONEBOX_1.ESP1_VehicleSpeedVSOSigValidData "" UBYTE autosar_swc_val_CM_ESP1_VehicleSpeedVSOSigValidData_152_dt 0 0 0 255 ECU_ADDRESS 0xfe4c9c90 /* @ECU_Address@SwcIn_ONEBOX_1.ESP1_VehicleSpeedVSOSigValidData@ */ /end MEASUREMENT
/begin MEASUREMENT SwcIn_ONEBOX_1.HHCActive "" UBYTE autosar_swc_val_CM_HHCActive_152_dt 0 0 0 255 ECU_ADDRESS 0xfe4c9c9e /* @ECU_Address@SwcIn_ONEBOX_1.HHCActive@ */ /end MEASUREMENT
/begin MEASUREMENT SwcIn_ONEBOX_1.HLRequest "" UBYTE autosar_swc_val_CM_HLRequest_152_dt 0 0 0 255 ECU_ADDRESS 0xfe4c9ca1 /* @ECU_Address@SwcIn_ONEBOX_1.HLRequest@ */ /end MEASUREMENT
/begin MEASUREMENT SwcIn_ONEBOX_1.IPB_1_MbRegenTargetWheel "" SWORD autosar_swc_val_CM_IPB_1_MbRegenTargetWheel_152_dt 0 0 -32768 32767 ECU_ADDRESS 0xfe4c9ca8 /* @ECU_Address@SwcIn_ONEBOX_1.IPB_1_MbRegenTargetWheel@ */ /end MEASUREMENT
/begin MEASUREMENT SwcIn_ONEBOX_1.IPB_1_MbRegenTargetWheelQ "" UBYTE autosar_swc_val_CM_IPB_1_MbRegenTargetWheelQ_152_dt 0 0 0 255 ECU_ADDRESS 0xfe4c9caa /* @ECU_Address@SwcIn_ONEBOX_1.IPB_1_MbRegenTargetWheelQ@ */ /end MEASUREMENT
/begin MEASUREMENT SwcIn_ONEBOX_1.IPB_SimulatorPressure "" UWORD autosar_swc_val_CM_IPB_SimulatorPressure_152_dt 0 0 0 65535 ECU_ADDRESS 0xfe4c9c94 /* @ECU_Address@SwcIn_ONEBOX_1.IPB_SimulatorPressure@ */ /end MEASUREMENT
/begin MEASUREMENT SwcIn_ONEBOX_1.IPB_SimulatorPressureStatus "" UBYTE autosar_swc_val_CM_IPB_SimulatorPressureStatus_152_dt 0 0 0 255 ECU_ADDRESS 0xfe4c9c96 /* @ECU_Address@SwcIn_ONEBOX_1.IPB_SimulatorPressureStatus@ */ /end MEASUREMENT
/begin MEASUREMENT SwcIn_ONEBOX_1.ONEBOX_1_CRC1 "" UBYTE autosar_swc_val_CM_ONEBOX_1_CRC1_152_dt 0 0 0 255 ECU_ADDRESS 0xfe4c9c88 /* @ECU_Address@SwcIn_ONEBOX_1.ONEBOX_1_CRC1@ */ /end MEASUREMENT
/begin MEASUREMENT SwcIn_ONEBOX_1.ONEBOX_1_CRC2 "" UBYTE autosar_swc_val_CM_ONEBOX_1_CRC2_152_dt 0 0 0 255 ECU_ADDRESS 0xfe4c9ca5 /* @ECU_Address@SwcIn_ONEBOX_1.ONEBOX_1_CRC2@ */ /end MEASUREMENT
/begin MEASUREMENT SwcIn_ONEBOX_1.ONEBOX_1_Resd1 "" UBYTE autosar_swc_val_CM_ONEBOX_1_Resd1_152_dt 0 0 0 255 ECU_ADDRESS 0xfe4c9c8a /* @ECU_Address@SwcIn_ONEBOX_1.ONEBOX_1_Resd1@ */ /end MEASUREMENT
/begin MEASUREMENT SwcIn_ONEBOX_1.ONEBOX_1_Resd2 "" UBYTE autosar_swc_val_CM_ONEBOX_1_Resd2_152_dt 0 0 0 255 ECU_ADDRESS 0xfe4c9ca7 /* @ECU_Address@SwcIn_ONEBOX_1.ONEBOX_1_Resd2@ */ /end MEASUREMENT
/begin MEASUREMENT SwcIn_ONEBOX_1.ONEBOX_1_RollgCntr1 "" UBYTE autosar_swc_val_CM_ONEBOX_1_RollgCntr1_152_dt 0 0 0 255 ECU_ADDRESS 0xfe4c9c89 /* @ECU_Address@SwcIn_ONEBOX_1.ONEBOX_1_RollgCntr1@ */ /end MEASUREMENT
/begin MEASUREMENT SwcIn_ONEBOX_1.ONEBOX_1_RollgCntr2 "" UBYTE autosar_swc_val_CM_ONEBOX_1_RollgCntr2_152_dt 0 0 0 255 ECU_ADDRESS 0xfe4c9ca6 /* @ECU_Address@SwcIn_ONEBOX_1.ONEBOX_1_RollgCntr2@ */ /end MEASUREMENT
/begin MEASUREMENT SwcIn_ONEBOX_1.SwitchOffCruiseControl "" UBYTE autosar_swc_val_CM_SwitchOffCruiseControl_152_dt 0 0 0 255 ECU_ADDRESS 0xfe4c9ca4 /* @ECU_Address@SwcIn_ONEBOX_1.SwitchOffCruiseControl@ */ /end MEASUREMENT
/begin MEASUREMENT SwcIn_ONEBOX_2_G.BrakesystemFailSts "" UBYTE autosar_swc_val_CM_BrakesystemFailSts_1193_dt 0 0 0 255 ECU_ADDRESS 0xfe4cb91f /* @ECU_Address@SwcIn_ONEBOX_2_G.BrakesystemFailSts@ */ /end MEASUREMENT
/begin MEASUREMENT SwcIn_ONEBOX_2_G.ONEBOX_2_G_CRC "" UBYTE autosar_swc_val_CM_ONEBOX_2_G_CRC_1193_dt 0 0 0 255 ECU_ADDRESS 0xfe4cb91c /* @ECU_Address@SwcIn_ONEBOX_2_G.ONEBOX_2_G_CRC@ */ /end MEASUREMENT
/begin MEASUREMENT SwcIn_ONEBOX_2_G.ONEBOX_2_G_Resd "" UBYTE autosar_swc_val_CM_ONEBOX_2_G_Resd_1193_dt 0 0 0 255 ECU_ADDRESS 0xfe4cb91e /* @ECU_Address@SwcIn_ONEBOX_2_G.ONEBOX_2_G_Resd@ */ /end MEASUREMENT
/begin MEASUREMENT SwcIn_ONEBOX_2_G.ONEBOX_2_G_RollgCntr "" UBYTE autosar_swc_val_CM_ONEBOX_2_G_RollgCntr_1193_dt 0 0 0 255 ECU_ADDRESS 0xfe4cb91d /* @ECU_Address@SwcIn_ONEBOX_2_G.ONEBOX_2_G_RollgCntr@ */ /end MEASUREMENT
/begin MEASUREMENT SwcIn_ONEBOX_3.AVHFailSts "" UBYTE autosar_swc_val_CM_AVHFailSts_555_dt 0 0 0 255 ECU_ADDRESS 0xfe4c9cb6 /* @ECU_Address@SwcIn_ONEBOX_3.AVHFailSts@ */ /end MEASUREMENT
/begin MEASUREMENT SwcIn_ONEBOX_3.AVHSts "" UBYTE autosar_swc_val_CM_AVHSts_555_dt 0 0 0 255 ECU_ADDRESS 0xfe4c9cb3 /* @ECU_Address@SwcIn_ONEBOX_3.AVHSts@ */ /end MEASUREMENT
/begin MEASUREMENT SwcIn_ONEBOX_3.CDDActive "" UBYTE autosar_swc_val_CM_CDDActive_555_dt 0 0 0 255 ECU_ADDRESS 0xfe4c9cba /* @ECU_Address@SwcIn_ONEBOX_3.CDDActive@ */ /end MEASUREMENT
/begin MEASUREMENT SwcIn_ONEBOX_3.CDDAvailable "" UBYTE autosar_swc_val_CM_CDDAvailable_555_dt 0 0 0 255 ECU_ADDRESS 0xfe4c9cbb /* @ECU_Address@SwcIn_ONEBOX_3.CDDAvailable@ */ /end MEASUREMENT
/begin MEASUREMENT SwcIn_ONEBOX_3.DCFail "" UBYTE autosar_swc_val_CM_DCFail_555_dt 0 0 0 255 ECU_ADDRESS 0xfe4c9cb9 /* @ECU_Address@SwcIn_ONEBOX_3.DCFail@ */ /end MEASUREMENT
/begin MEASUREMENT SwcIn_ONEBOX_3.DTCActive "" UBYTE autosar_swc_val_CM_DTCActive_555_dt 0 0 0 255 ECU_ADDRESS 0xfe4c9cd6 /* @ECU_Address@SwcIn_ONEBOX_3.DTCActive@ */ /end MEASUREMENT
/begin MEASUREMENT SwcIn_ONEBOX_3.DTCAvailable "" UBYTE autosar_swc_val_CM_DTCAvailable_555_dt 0 0 0 255 ECU_ADDRESS 0xfe4c9cd5 /* @ECU_Address@SwcIn_ONEBOX_3.DTCAvailable@ */ /end MEASUREMENT
/begin MEASUREMENT SwcIn_ONEBOX_3.DTC_Intervention "" UBYTE autosar_swc_val_CM_DTC_Intervention_555_dt 0 0 0 255 ECU_ADDRESS 0xfe4c9cd4 /* @ECU_Address@SwcIn_ONEBOX_3.DTC_Intervention@ */ /end MEASUREMENT
/begin MEASUREMENT SwcIn_ONEBOX_3.ECDTempOff "" UBYTE autosar_swc_val_CM_ECDTempOff_555_dt 0 0 0 255 ECU_ADDRESS 0xfe4c9cb8 /* @ECU_Address@SwcIn_ONEBOX_3.ECDTempOff@ */ /end MEASUREMENT
/begin MEASUREMENT SwcIn_ONEBOX_3.IPB_InputRodStroke "" FLOAT32_IEEE autosar_swc_val_CM_IPB_InputRodStroke_555_dt 0 0 -3.4E+38 3.4E+38 ECU_ADDRESS 0xfe4c9cd0 /* @ECU_Address@SwcIn_ONEBOX_3.IPB_InputRodStroke@ */ /end MEASUREMENT
/begin MEASUREMENT SwcIn_ONEBOX_3.IPB_InputRodStrokeStatus "" UBYTE autosar_swc_val_CM_IPB_InputRodStrokeStatus_555_dt 0 0 0 255 ECU_ADDRESS 0xfe4c9cc8 /* @ECU_Address@SwcIn_ONEBOX_3.IPB_InputRodStrokeStatus@ */ /end MEASUREMENT
/begin MEASUREMENT SwcIn_ONEBOX_3.IPB_PlungerPressure "" UWORD autosar_swc_val_CM_IPB_PlungerPressure_555_dt 0 0 0 65535 ECU_ADDRESS 0xfe4c9ccc /* @ECU_Address@SwcIn_ONEBOX_3.IPB_PlungerPressure@ */ /end MEASUREMENT
/begin MEASUREMENT SwcIn_ONEBOX_3.IPB_PlungerPressureValidData "" UBYTE autosar_swc_val_CM_IPB_PlungerPressureValidData_555_dt 0 0 0 255 ECU_ADDRESS 0xfe4c9cc7 /* @ECU_Address@SwcIn_ONEBOX_3.IPB_PlungerPressureValidData@ */ /end MEASUREMENT
/begin MEASUREMENT SwcIn_ONEBOX_3.NoBrakeForce "" UBYTE autosar_swc_val_CM_NoBrakeForce_555_dt 0 0 0 255 ECU_ADDRESS 0xfe4c9cb5 /* @ECU_Address@SwcIn_ONEBOX_3.NoBrakeForce@ */ /end MEASUREMENT
/begin MEASUREMENT SwcIn_ONEBOX_3.ONEBOX_3_CRC1 "" UBYTE autosar_swc_val_CM_ONEBOX_3_CRC1_555_dt 0 0 0 255 ECU_ADDRESS 0xfe4c9cb0 /* @ECU_Address@SwcIn_ONEBOX_3.ONEBOX_3_CRC1@ */ /end MEASUREMENT
/begin MEASUREMENT SwcIn_ONEBOX_3.ONEBOX_3_CRC2 "" UBYTE autosar_swc_val_CM_ONEBOX_3_CRC2_555_dt 0 0 0 255 ECU_ADDRESS 0xfe4c9cbd /* @ECU_Address@SwcIn_ONEBOX_3.ONEBOX_3_CRC2@ */ /end MEASUREMENT
/begin MEASUREMENT SwcIn_ONEBOX_3.ONEBOX_3_CRC4 "" UBYTE autosar_swc_val_CM_ONEBOX_3_CRC4_555_dt 0 0 0 255 ECU_ADDRESS 0xfe4c9cc4 /* @ECU_Address@SwcIn_ONEBOX_3.ONEBOX_3_CRC4@ */ /end MEASUREMENT
/begin MEASUREMENT SwcIn_ONEBOX_3.ONEBOX_3_Resd1 "" UBYTE autosar_swc_val_CM_ONEBOX_3_Resd1_555_dt 0 0 0 255 ECU_ADDRESS 0xfe4c9cb2 /* @ECU_Address@SwcIn_ONEBOX_3.ONEBOX_3_Resd1@ */ /end MEASUREMENT
/begin MEASUREMENT SwcIn_ONEBOX_3.ONEBOX_3_Resd2 "" UBYTE autosar_swc_val_CM_ONEBOX_3_Resd2_555_dt 0 0 0 255 ECU_ADDRESS 0xfe4c9cbf /* @ECU_Address@SwcIn_ONEBOX_3.ONEBOX_3_Resd2@ */ /end MEASUREMENT
/begin MEASUREMENT SwcIn_ONEBOX_3.ONEBOX_3_Resd4 "" UBYTE autosar_swc_val_CM_ONEBOX_3_Resd4_555_dt 0 0 0 255 ECU_ADDRESS 0xfe4c9cc6 /* @ECU_Address@SwcIn_ONEBOX_3.ONEBOX_3_Resd4@ */ /end MEASUREMENT
/begin MEASUREMENT SwcIn_ONEBOX_3.ONEBOX_3_RollgCntr1 "" UBYTE autosar_swc_val_CM_ONEBOX_3_RollgCntr1_555_dt 0 0 0 255 ECU_ADDRESS 0xfe4c9cb1 /* @ECU_Address@SwcIn_ONEBOX_3.ONEBOX_3_RollgCntr1@ */ /end MEASUREMENT
/begin MEASUREMENT SwcIn_ONEBOX_3.ONEBOX_3_RollgCntr2 "" UBYTE autosar_swc_val_CM_ONEBOX_3_RollgCntr2_555_dt 0 0 0 255 ECU_ADDRESS 0xfe4c9cbe /* @ECU_Address@SwcIn_ONEBOX_3.ONEBOX_3_RollgCntr2@ */ /end MEASUREMENT
/begin MEASUREMENT SwcIn_ONEBOX_3.ONEBOX_3_RollgCntr4 "" UBYTE autosar_swc_val_CM_ONEBOX_3_RollgCntr4_555_dt 0 0 0 255 ECU_ADDRESS 0xfe4c9cc5 /* @ECU_Address@SwcIn_ONEBOX_3.ONEBOX_3_RollgCntr4@ */ /end MEASUREMENT
/begin MEASUREMENT SwcIn_ONEBOX_3.Reserved_EDCActive "" UBYTE autosar_swc_val_CM_Reserved_EDCActive_555_dt 0 0 0 255 ECU_ADDRESS 0xfe4c9cb7 /* @ECU_Address@SwcIn_ONEBOX_3.Reserved_EDCActive@ */ /end MEASUREMENT
/begin MEASUREMENT SwcIn_ONEBOX_3.Reserved_ESPLampInformation "" UBYTE autosar_swc_val_CM_Reserved_ESPLampInformation_555_dt 0 0 0 255 ECU_ADDRESS 0xfe4c9cbc /* @ECU_Address@SwcIn_ONEBOX_3.Reserved_ESPLampInformation@ */ /end MEASUREMENT
/begin MEASUREMENT SwcIn_ONEBOX_3.SCMActive "" UBYTE autosar_swc_val_CM_SCMActive_555_dt 0 0 0 255 ECU_ADDRESS 0xfe4c9cc9 /* @ECU_Address@SwcIn_ONEBOX_3.SCMActive@ */ /end MEASUREMENT
/begin MEASUREMENT SwcIn_ONEBOX_3.SCMAvalable "" UBYTE autosar_swc_val_CM_SCMAvalable_555_dt 0 0 0 255 ECU_ADDRESS 0xfe4c9cca /* @ECU_Address@SwcIn_ONEBOX_3.SCMAvalable@ */ /end MEASUREMENT
/begin MEASUREMENT SwcIn_ONEBOX_3.VehicleStandstill "" UBYTE autosar_swc_val_CM_VehicleStandstill_555_dt 0 0 0 255 ECU_ADDRESS 0xfe4c9cb4 /* @ECU_Address@SwcIn_ONEBOX_3.VehicleStandstill@ */ /end MEASUREMENT
/begin MEASUREMENT SwcIn_ONEBOX_3.WheelBrakeForce "" SLONG autosar_swc_val_CM_WheelBrakeForce_555_dt 0 0 -2147483648 2147483647 ECU_ADDRESS 0xfe4c9cc0 /* @ECU_Address@SwcIn_ONEBOX_3.WheelBrakeForce@ */ /end MEASUREMENT
/begin MEASUREMENT SwcIn_ONEBOX_4.LHFPulseCounter "" UWORD autosar_swc_val_CM_LHFPulseCounter_587_dt 0 0 0 65535 ECU_ADDRESS 0xfe4c9d00 /* @ECU_Address@SwcIn_ONEBOX_4.LHFPulseCounter@ */ /end MEASUREMENT
/begin MEASUREMENT SwcIn_ONEBOX_4.LHFPulseCounterFailSts "" UBYTE autosar_swc_val_CM_LHFPulseCounterFailSts_587_dt 0 0 0 255 ECU_ADDRESS 0xfe4c9cfe /* @ECU_Address@SwcIn_ONEBOX_4.LHFPulseCounterFailSts@ */ /end MEASUREMENT
/begin MEASUREMENT SwcIn_ONEBOX_4.LHFWheelDriveDirection "" UBYTE autosar_swc_val_CM_LHFWheelDriveDirection_587_dt 0 0 0 255 ECU_ADDRESS 0xfe4c9d08 /* @ECU_Address@SwcIn_ONEBOX_4.LHFWheelDriveDirection@ */ /end MEASUREMENT
/begin MEASUREMENT SwcIn_ONEBOX_4.LHFWheelSpeedRPM "" FLOAT32_IEEE autosar_swc_val_CM_LHFWheelSpeedRPM_587_dt 0 0 -3.4E+38 3.4E+38 ECU_ADDRESS 0xfe4c9cdc /* @ECU_Address@SwcIn_ONEBOX_4.LHFWheelSpeedRPM@ */ /end MEASUREMENT
/begin MEASUREMENT SwcIn_ONEBOX_4.LHFWheelSpeedRaw "" FLOAT32_IEEE autosar_swc_val_CM_LHFWheelSpeedRaw_587_dt 0 0 -3.4E+38 3.4E+38 ECU_ADDRESS 0xfe4c9d04 /* @ECU_Address@SwcIn_ONEBOX_4.LHFWheelSpeedRaw@ */ /end MEASUREMENT
/begin MEASUREMENT SwcIn_ONEBOX_4.LHFWheelSpeedRawValidData "" UBYTE autosar_swc_val_CM_LHFWheelSpeedRawValidData_587_dt 0 0 0 255 ECU_ADDRESS 0xfe4c9d09 /* @ECU_Address@SwcIn_ONEBOX_4.LHFWheelSpeedRawValidData@ */ /end MEASUREMENT
/begin MEASUREMENT SwcIn_ONEBOX_4.LHRPulseCounter "" UWORD autosar_swc_val_CM_LHRPulseCounter_587_dt 0 0 0 65535 ECU_ADDRESS 0xfe4c9cf2 /* @ECU_Address@SwcIn_ONEBOX_4.LHRPulseCounter@ */ /end MEASUREMENT
/begin MEASUREMENT SwcIn_ONEBOX_4.LHRPulseCounterFailSts "" UBYTE autosar_swc_val_CM_LHRPulseCounterFailSts_587_dt 0 0 0 255 ECU_ADDRESS 0xfe4c9cf0 /* @ECU_Address@SwcIn_ONEBOX_4.LHRPulseCounterFailSts@ */ /end MEASUREMENT
/begin MEASUREMENT SwcIn_ONEBOX_4.LHRWheelDriveDirection "" UBYTE autosar_swc_val_CM_LHRWheelDriveDirection_587_dt 0 0 0 255 ECU_ADDRESS 0xfe4c9d1c /* @ECU_Address@SwcIn_ONEBOX_4.LHRWheelDriveDirection@ */ /end MEASUREMENT
/begin MEASUREMENT SwcIn_ONEBOX_4.LHRWheelSpeedRPM "" FLOAT32_IEEE autosar_swc_val_CM_LHRWheelSpeedRPM_587_dt 0 0 -3.4E+38 3.4E+38 ECU_ADDRESS 0xfe4c9ce4 /* @ECU_Address@SwcIn_ONEBOX_4.LHRWheelSpeedRPM@ */ /end MEASUREMENT
/begin MEASUREMENT SwcIn_ONEBOX_4.LHRWheelSpeedRaw "" FLOAT32_IEEE autosar_swc_val_CM_LHRWheelSpeedRaw_587_dt 0 0 -3.4E+38 3.4E+38 ECU_ADDRESS 0xfe4c9d18 /* @ECU_Address@SwcIn_ONEBOX_4.LHRWheelSpeedRaw@ */ /end MEASUREMENT
/begin MEASUREMENT SwcIn_ONEBOX_4.LHRWheelSpeedRawValidData "" UBYTE autosar_swc_val_CM_LHRWheelSpeedRawValidData_587_dt 0 0 0 255 ECU_ADDRESS 0xfe4c9d1d /* @ECU_Address@SwcIn_ONEBOX_4.LHRWheelSpeedRawValidData@ */ /end MEASUREMENT
/begin MEASUREMENT SwcIn_ONEBOX_4.ONEBOX_4_CRC1 "" UBYTE autosar_swc_val_CM_ONEBOX_4_CRC1_587_dt 0 0 0 255 ECU_ADDRESS 0xfe4c9cd8 /* @ECU_Address@SwcIn_ONEBOX_4.ONEBOX_4_CRC1@ */ /end MEASUREMENT
/begin MEASUREMENT SwcIn_ONEBOX_4.ONEBOX_4_CRC2 "" UBYTE autosar_swc_val_CM_ONEBOX_4_CRC2_587_dt 0 0 0 255 ECU_ADDRESS 0xfe4c9ce8 /* @ECU_Address@SwcIn_ONEBOX_4.ONEBOX_4_CRC2@ */ /end MEASUREMENT
/begin MEASUREMENT SwcIn_ONEBOX_4.ONEBOX_4_CRC3 "" UBYTE autosar_swc_val_CM_ONEBOX_4_CRC3_587_dt 0 0 0 255 ECU_ADDRESS 0xfe4c9cf8 /* @ECU_Address@SwcIn_ONEBOX_4.ONEBOX_4_CRC3@ */ /end MEASUREMENT
/begin MEASUREMENT SwcIn_ONEBOX_4.ONEBOX_4_CRC4 "" UBYTE autosar_swc_val_CM_ONEBOX_4_CRC4_587_dt 0 0 0 255 ECU_ADDRESS 0xfe4c9d0a /* @ECU_Address@SwcIn_ONEBOX_4.ONEBOX_4_CRC4@ */ /end MEASUREMENT
/begin MEASUREMENT SwcIn_ONEBOX_4.ONEBOX_4_Resd1 "" UBYTE autosar_swc_val_CM_ONEBOX_4_Resd1_587_dt 0 0 0 255 ECU_ADDRESS 0xfe4c9cda /* @ECU_Address@SwcIn_ONEBOX_4.ONEBOX_4_Resd1@ */ /end MEASUREMENT
/begin MEASUREMENT SwcIn_ONEBOX_4.ONEBOX_4_Resd2 "" UBYTE autosar_swc_val_CM_ONEBOX_4_Resd2_587_dt 0 0 0 255 ECU_ADDRESS 0xfe4c9cea /* @ECU_Address@SwcIn_ONEBOX_4.ONEBOX_4_Resd2@ */ /end MEASUREMENT
/begin MEASUREMENT SwcIn_ONEBOX_4.ONEBOX_4_Resd3 "" UBYTE autosar_swc_val_CM_ONEBOX_4_Resd3_587_dt 0 0 0 255 ECU_ADDRESS 0xfe4c9cfa /* @ECU_Address@SwcIn_ONEBOX_4.ONEBOX_4_Resd3@ */ /end MEASUREMENT
/begin MEASUREMENT SwcIn_ONEBOX_4.ONEBOX_4_Resd4 "" UBYTE autosar_swc_val_CM_ONEBOX_4_Resd4_587_dt 0 0 0 255 ECU_ADDRESS 0xfe4c9d0c /* @ECU_Address@SwcIn_ONEBOX_4.ONEBOX_4_Resd4@ */ /end MEASUREMENT
/begin MEASUREMENT SwcIn_ONEBOX_4.ONEBOX_4_RollgCntr1 "" UBYTE autosar_swc_val_CM_ONEBOX_4_RollgCntr1_587_dt 0 0 0 255 ECU_ADDRESS 0xfe4c9cd9 /* @ECU_Address@SwcIn_ONEBOX_4.ONEBOX_4_RollgCntr1@ */ /end MEASUREMENT
/begin MEASUREMENT SwcIn_ONEBOX_4.ONEBOX_4_RollgCntr2 "" UBYTE autosar_swc_val_CM_ONEBOX_4_RollgCntr2_587_dt 0 0 0 255 ECU_ADDRESS 0xfe4c9ce9 /* @ECU_Address@SwcIn_ONEBOX_4.ONEBOX_4_RollgCntr2@ */ /end MEASUREMENT
/begin MEASUREMENT SwcIn_ONEBOX_4.ONEBOX_4_RollgCntr3 "" UBYTE autosar_swc_val_CM_ONEBOX_4_RollgCntr3_587_dt 0 0 0 255 ECU_ADDRESS 0xfe4c9cf9 /* @ECU_Address@SwcIn_ONEBOX_4.ONEBOX_4_RollgCntr3@ */ /end MEASUREMENT
/begin MEASUREMENT SwcIn_ONEBOX_4.ONEBOX_4_RollgCntr4 "" UBYTE autosar_swc_val_CM_ONEBOX_4_RollgCntr4_587_dt 0 0 0 255 ECU_ADDRESS 0xfe4c9d0b /* @ECU_Address@SwcIn_ONEBOX_4.ONEBOX_4_RollgCntr4@ */ /end MEASUREMENT
/begin MEASUREMENT SwcIn_ONEBOX_4.RHFPulseCounter "" UWORD autosar_swc_val_CM_RHFPulseCounter_587_dt 0 0 0 65535 ECU_ADDRESS 0xfe4c9cfc /* @ECU_Address@SwcIn_ONEBOX_4.RHFPulseCounter@ */ /end MEASUREMENT
/begin MEASUREMENT SwcIn_ONEBOX_4.RHFPulseCounterFailSts "" UBYTE autosar_swc_val_CM_RHFPulseCounterFailSts_587_dt 0 0 0 255 ECU_ADDRESS 0xfe4c9cfb /* @ECU_Address@SwcIn_ONEBOX_4.RHFPulseCounterFailSts@ */ /end MEASUREMENT
/begin MEASUREMENT SwcIn_ONEBOX_4.RHFWheelDriveDirection "" UBYTE autosar_swc_val_CM_RHFWheelDriveDirection_587_dt 0 0 0 255 ECU_ADDRESS 0xfe4c9d14 /* @ECU_Address@SwcIn_ONEBOX_4.RHFWheelDriveDirection@ */ /end MEASUREMENT
/begin MEASUREMENT SwcIn_ONEBOX_4.RHFWheelSpeedRPM "" FLOAT32_IEEE autosar_swc_val_CM_RHFWheelSpeedRPM_587_dt 0 0 -3.4E+38 3.4E+38 ECU_ADDRESS 0xfe4c9ce0 /* @ECU_Address@SwcIn_ONEBOX_4.RHFWheelSpeedRPM@ */ /end MEASUREMENT
/begin MEASUREMENT SwcIn_ONEBOX_4.RHFWheelSpeedRaw "" FLOAT32_IEEE autosar_swc_val_CM_RHFWheelSpeedRaw_587_dt 0 0 -3.4E+38 3.4E+38 ECU_ADDRESS 0xfe4c9d10 /* @ECU_Address@SwcIn_ONEBOX_4.RHFWheelSpeedRaw@ */ /end MEASUREMENT
/begin MEASUREMENT SwcIn_ONEBOX_4.RHFWheelSpeedRawValidData "" UBYTE autosar_swc_val_CM_RHFWheelSpeedRawValidData_587_dt 0 0 0 255 ECU_ADDRESS 0xfe4c9d15 /* @ECU_Address@SwcIn_ONEBOX_4.RHFWheelSpeedRawValidData@ */ /end MEASUREMENT
/begin MEASUREMENT SwcIn_ONEBOX_4.RHRPulseCounter "" UWORD autosar_swc_val_CM_RHRPulseCounter_587_dt 0 0 0 65535 ECU_ADDRESS 0xfe4c9cf6 /* @ECU_Address@SwcIn_ONEBOX_4.RHRPulseCounter@ */ /end MEASUREMENT
/begin MEASUREMENT SwcIn_ONEBOX_4.RHRPulseCounterFailSts "" UBYTE autosar_swc_val_CM_RHRPulseCounterFailSts_587_dt 0 0 0 255 ECU_ADDRESS 0xfe4c9cf4 /* @ECU_Address@SwcIn_ONEBOX_4.RHRPulseCounterFailSts@ */ /end MEASUREMENT
/begin MEASUREMENT SwcIn_ONEBOX_4.RHRWheelDriveDirection "" UBYTE autosar_swc_val_CM_RHRWheelDriveDirection_587_dt 0 0 0 255 ECU_ADDRESS 0xfe4c9d24 /* @ECU_Address@SwcIn_ONEBOX_4.RHRWheelDriveDirection@ */ /end MEASUREMENT
/begin MEASUREMENT SwcIn_ONEBOX_4.RHRWheelSpeedRPM "" FLOAT32_IEEE autosar_swc_val_CM_RHRWheelSpeedRPM_587_dt 0 0 -3.4E+38 3.4E+38 ECU_ADDRESS 0xfe4c9cec /* @ECU_Address@SwcIn_ONEBOX_4.RHRWheelSpeedRPM@ */ /end MEASUREMENT
/begin MEASUREMENT SwcIn_ONEBOX_4.RHRWheelSpeedRaw "" FLOAT32_IEEE autosar_swc_val_CM_RHRWheelSpeedRaw_587_dt 0 0 -3.4E+38 3.4E+38 ECU_ADDRESS 0xfe4c9d20 /* @ECU_Address@SwcIn_ONEBOX_4.RHRWheelSpeedRaw@ */ /end MEASUREMENT
/begin MEASUREMENT SwcIn_ONEBOX_4.RHRWheelSpeedRawValidData "" UBYTE autosar_swc_val_CM_RHRWheelSpeedRawValidData_587_dt 0 0 0 255 ECU_ADDRESS 0xfe4c9d25 /* @ECU_Address@SwcIn_ONEBOX_4.RHRWheelSpeedRawValidData@ */ /end MEASUREMENT
/begin MEASUREMENT SwcIn_ONEBOX_5.ONEBOX_5_APCFailureSts "" UBYTE autosar_swc_val_CM_ONEBOX_5_APCFailureSts_335_dt 0 0 0 255 ECU_ADDRESS 0xfe4cba9a /* @ECU_Address@SwcIn_ONEBOX_5.ONEBOX_5_APCFailureSts@ */ /end MEASUREMENT
/begin MEASUREMENT SwcIn_ONEBOX_5.ONEBOX_5_APCStatus "" UBYTE autosar_swc_val_CM_ONEBOX_5_APCStatus_335_dt 0 0 0 255 ECU_ADDRESS 0xfe4cba9b /* @ECU_Address@SwcIn_ONEBOX_5.ONEBOX_5_APCStatus@ */ /end MEASUREMENT
/begin MEASUREMENT SwcIn_ONEBOX_5.ONEBOX_5_AbaActSts "" UBYTE autosar_swc_val_CM_ONEBOX_5_AbaActSts_335_dt 0 0 0 255 ECU_ADDRESS 0xfe4cbaa7 /* @ECU_Address@SwcIn_ONEBOX_5.ONEBOX_5_AbaActSts@ */ /end MEASUREMENT
/begin MEASUREMENT SwcIn_ONEBOX_5.ONEBOX_5_AbaAvlSts "" UBYTE autosar_swc_val_CM_ONEBOX_5_AbaAvlSts_335_dt 0 0 0 255 ECU_ADDRESS 0xfe4cbaa8 /* @ECU_Address@SwcIn_ONEBOX_5.ONEBOX_5_AbaAvlSts@ */ /end MEASUREMENT
/begin MEASUREMENT SwcIn_ONEBOX_5.ONEBOX_5_AbaLvlSts "" UBYTE autosar_swc_val_CM_ONEBOX_5_AbaLvlSts_335_dt 0 0 0 255 ECU_ADDRESS 0xfe4cbaa9 /* @ECU_Address@SwcIn_ONEBOX_5.ONEBOX_5_AbaLvlSts@ */ /end MEASUREMENT
/begin MEASUREMENT SwcIn_ONEBOX_5.ONEBOX_5_AbpActSts "" UBYTE autosar_swc_val_CM_ONEBOX_5_AbpActSts_335_dt 0 0 0 255 ECU_ADDRESS 0xfe4cbaa3 /* @ECU_Address@SwcIn_ONEBOX_5.ONEBOX_5_AbpActSts@ */ /end MEASUREMENT
/begin MEASUREMENT SwcIn_ONEBOX_5.ONEBOX_5_AbpAvlSts "" UBYTE autosar_swc_val_CM_ONEBOX_5_AbpAvlSts_335_dt 0 0 0 255 ECU_ADDRESS 0xfe4cbaa4 /* @ECU_Address@SwcIn_ONEBOX_5.ONEBOX_5_AbpAvlSts@ */ /end MEASUREMENT
/begin MEASUREMENT SwcIn_ONEBOX_5.ONEBOX_5_ApaAvl "" UBYTE autosar_swc_val_CM_ONEBOX_5_ApaAvl_335_dt 0 0 0 255 ECU_ADDRESS 0xfe4cba9c /* @ECU_Address@SwcIn_ONEBOX_5.ONEBOX_5_ApaAvl@ */ /end MEASUREMENT
/begin MEASUREMENT SwcIn_ONEBOX_5.ONEBOX_5_AwbActSts "" UBYTE autosar_swc_val_CM_ONEBOX_5_AwbActSts_335_dt 0 0 0 255 ECU_ADDRESS 0xfe4cbaa5 /* @ECU_Address@SwcIn_ONEBOX_5.ONEBOX_5_AwbActSts@ */ /end MEASUREMENT
/begin MEASUREMENT SwcIn_ONEBOX_5.ONEBOX_5_AwbAvlSts "" UBYTE autosar_swc_val_CM_ONEBOX_5_AwbAvlSts_335_dt 0 0 0 255 ECU_ADDRESS 0xfe4cbaa6 /* @ECU_Address@SwcIn_ONEBOX_5.ONEBOX_5_AwbAvlSts@ */ /end MEASUREMENT
/begin MEASUREMENT SwcIn_ONEBOX_5.ONEBOX_5_CRC1 "" UBYTE autosar_swc_val_CM_ONEBOX_5_CRC1_335_dt 0 0 0 255 ECU_ADDRESS 0xfe4cba94 /* @ECU_Address@SwcIn_ONEBOX_5.ONEBOX_5_CRC1@ */ /end MEASUREMENT
/begin MEASUREMENT SwcIn_ONEBOX_5.ONEBOX_5_CddAdcActiveVehHld "" UBYTE autosar_swc_val_CM_ONEBOX_5_CddAdcActiveVehHld_335_dt 0 0 0 255 ECU_ADDRESS 0xfe4cba99 /* @ECU_Address@SwcIn_ONEBOX_5.ONEBOX_5_CddAdcActiveVehHld@ */ /end MEASUREMENT
/begin MEASUREMENT SwcIn_ONEBOX_5.ONEBOX_5_CddApActiveVehHld "" UBYTE autosar_swc_val_CM_ONEBOX_5_CddApActiveVehHld_335_dt 0 0 0 255 ECU_ADDRESS 0xfe4cba9f /* @ECU_Address@SwcIn_ONEBOX_5.ONEBOX_5_CddApActiveVehHld@ */ /end MEASUREMENT
/begin MEASUREMENT SwcIn_ONEBOX_5.ONEBOX_5_MebAvl "" UBYTE autosar_swc_val_CM_ONEBOX_5_MebAvl_335_dt 0 0 0 255 ECU_ADDRESS 0xfe4cba9e /* @ECU_Address@SwcIn_ONEBOX_5.ONEBOX_5_MebAvl@ */ /end MEASUREMENT
/begin MEASUREMENT SwcIn_ONEBOX_5.ONEBOX_5_PilotParkBrkDecActSts "" UBYTE autosar_swc_val_CM_ONEBOX_5_PilotParkBrkDecActSts_335_dt 0 0 0 255 ECU_ADDRESS 0xfe4cba98 /* @ECU_Address@SwcIn_ONEBOX_5.ONEBOX_5_PilotParkBrkDecActSts@ */ /end MEASUREMENT
/begin MEASUREMENT SwcIn_ONEBOX_5.ONEBOX_5_PilotParkBrkDecCtlAvl "" UBYTE autosar_swc_val_CM_ONEBOX_5_PilotParkBrkDecCtlAvl_335_dt 0 0 0 255 ECU_ADDRESS 0xfe4cba97 /* @ECU_Address@SwcIn_ONEBOX_5.ONEBOX_5_PilotParkBrkDecCtlAvl@ */ /end MEASUREMENT
/begin MEASUREMENT SwcIn_ONEBOX_5.ONEBOX_5_Resd1 "" UBYTE autosar_swc_val_CM_ONEBOX_5_Resd1_335_dt 0 0 0 255 ECU_ADDRESS 0xfe4cba96 /* @ECU_Address@SwcIn_ONEBOX_5.ONEBOX_5_Resd1@ */ /end MEASUREMENT
/begin MEASUREMENT SwcIn_ONEBOX_5.ONEBOX_5_RollgCntr1 "" UBYTE autosar_swc_val_CM_ONEBOX_5_RollgCntr1_335_dt 0 0 0 255 ECU_ADDRESS 0xfe4cba95 /* @ECU_Address@SwcIn_ONEBOX_5.ONEBOX_5_RollgCntr1@ */ /end MEASUREMENT
/begin MEASUREMENT SwcIn_ONEBOX_5.ONEBOX_5_RpaAvl "" UBYTE autosar_swc_val_CM_ONEBOX_5_RpaAvl_335_dt 0 0 0 255 ECU_ADDRESS 0xfe4cba9d /* @ECU_Address@SwcIn_ONEBOX_5.ONEBOX_5_RpaAvl@ */ /end MEASUREMENT
/begin MEASUREMENT SwcIn_ONEBOX_5.ONEBOX_5_SysBrkP "" UWORD autosar_swc_val_CM_ONEBOX_5_SysBrkP_335_dt 0 0 0 65535 ECU_ADDRESS 0xfe4cbaa0 /* @ECU_Address@SwcIn_ONEBOX_5.ONEBOX_5_SysBrkP@ */ /end MEASUREMENT
/begin MEASUREMENT SwcIn_ONEBOX_5.ONEBOX_5_SysBrkPVld "" UBYTE autosar_swc_val_CM_ONEBOX_5_SysBrkPVld_335_dt 0 0 0 255 ECU_ADDRESS 0xfe4cbaa2 /* @ECU_Address@SwcIn_ONEBOX_5.ONEBOX_5_SysBrkPVld@ */ /end MEASUREMENT
/begin MEASUREMENT SwcIn_PPMID_1.PPMID_1_HWSt "" UBYTE autosar_swc_val_CM_PPMID_1_HWSt_1208_dt 0 0 0 255 ECU_ADDRESS 0xfe4cb920 /* @ECU_Address@SwcIn_PPMID_1.PPMID_1_HWSt@ */ /end MEASUREMENT
/begin MEASUREMENT SwcIn_PPMID_1.PPMID_1_PPMICounter "" UBYTE autosar_swc_val_CM_PPMID_1_PPMICounter_1208_dt 0 0 0 255 ECU_ADDRESS 0xfe4cb922 /* @ECU_Address@SwcIn_PPMID_1.PPMID_1_PPMICounter@ */ /end MEASUREMENT
/begin MEASUREMENT SwcIn_PPMID_1.PPMID_1_PPMISt "" UBYTE autosar_swc_val_CM_PPMID_1_PPMISt_1208_dt 0 0 0 255 ECU_ADDRESS 0xfe4cb923 /* @ECU_Address@SwcIn_PPMID_1.PPMID_1_PPMISt@ */ /end MEASUREMENT
/begin MEASUREMENT SwcIn_PPMID_1.PPMID_1_PPSt "" UBYTE autosar_swc_val_CM_PPMID_1_PPSt_1208_dt 0 0 0 255 ECU_ADDRESS 0xfe4cb921 /* @ECU_Address@SwcIn_PPMID_1.PPMID_1_PPSt@ */ /end MEASUREMENT
/begin MEASUREMENT SwcIn_RLCR_1.RLCR_1_BSDWarn "" UBYTE autosar_swc_val_CM_RLCR_1_BSDWarn_1095_dt 0 0 0 255 ECU_ADDRESS 0xfe4cbaaf /* @ECU_Address@SwcIn_RLCR_1.RLCR_1_BSDWarn@ */ /end MEASUREMENT
/begin MEASUREMENT SwcIn_RLCR_1.RLCR_1_BlkSts "" UBYTE autosar_swc_val_CM_RLCR_1_BlkSts_1095_dt 0 0 0 255 ECU_ADDRESS 0xfe4cbaae /* @ECU_Address@SwcIn_RLCR_1.RLCR_1_BlkSts@ */ /end MEASUREMENT
/begin MEASUREMENT SwcIn_RLCR_1.RLCR_1_CRC1 "" UBYTE autosar_swc_val_CM_RLCR_1_CRC1_1095_dt 0 0 0 255 ECU_ADDRESS 0xfe4cbaaa /* @ECU_Address@SwcIn_RLCR_1.RLCR_1_CRC1@ */ /end MEASUREMENT
/begin MEASUREMENT SwcIn_RLCR_1.RLCR_1_DOWWarn "" UBYTE autosar_swc_val_CM_RLCR_1_DOWWarn_1095_dt 0 0 0 255 ECU_ADDRESS 0xfe4cbab0 /* @ECU_Address@SwcIn_RLCR_1.RLCR_1_DOWWarn@ */ /end MEASUREMENT
/begin MEASUREMENT SwcIn_RLCR_1.RLCR_1_DowLock "" UBYTE autosar_swc_val_CM_RLCR_1_DowLock_1095_dt 0 0 0 255 ECU_ADDRESS 0xfe4cbab1 /* @ECU_Address@SwcIn_RLCR_1.RLCR_1_DowLock@ */ /end MEASUREMENT
/begin MEASUREMENT SwcIn_RLCR_1.RLCR_1_ELK_CollisionFlagValid "" UBYTE autosar_swc_val_CM_RLCR_1_ELK_CollisionFlagValid_1095_dt 0 0 0 255 ECU_ADDRESS 0xfe4cbab3 /* @ECU_Address@SwcIn_RLCR_1.RLCR_1_ELK_CollisionFlagValid@ */ /end MEASUREMENT
/begin MEASUREMENT SwcIn_RLCR_1.RLCR_1_ELK_Collision_flag "" UBYTE autosar_swc_val_CM_RLCR_1_ELK_Collision_flag_1095_dt 0 0 0 255 ECU_ADDRESS 0xfe4cbab2 /* @ECU_Address@SwcIn_RLCR_1.RLCR_1_ELK_Collision_flag@ */ /end MEASUREMENT
/begin MEASUREMENT SwcIn_RLCR_1.RLCR_1_Resd1 "" UBYTE autosar_swc_val_CM_RLCR_1_Resd1_1095_dt 0 0 0 255 ECU_ADDRESS 0xfe4cbaac /* @ECU_Address@SwcIn_RLCR_1.RLCR_1_Resd1@ */ /end MEASUREMENT
/begin MEASUREMENT SwcIn_RLCR_1.RLCR_1_RollgCntr1 "" UBYTE autosar_swc_val_CM_RLCR_1_RollgCntr1_1095_dt 0 0 0 255 ECU_ADDRESS 0xfe4cbaab /* @ECU_Address@SwcIn_RLCR_1.RLCR_1_RollgCntr1@ */ /end MEASUREMENT
/begin MEASUREMENT SwcIn_RLCR_1.RLCR_1_SysSt "" UBYTE autosar_swc_val_CM_RLCR_1_SysSt_1095_dt 0 0 0 255 ECU_ADDRESS 0xfe4cbaad /* @ECU_Address@SwcIn_RLCR_1.RLCR_1_SysSt@ */ /end MEASUREMENT
/begin MEASUREMENT SwcIn_RLCR_2.RLCR_2_BSDLCWONOFFSts "" UBYTE autosar_swc_val_CM_RLCR_2_BSDLCWONOFFSts_1104_dt 0 0 0 255 ECU_ADDRESS 0xfe4c9d34 /* @ECU_Address@SwcIn_RLCR_2.RLCR_2_BSDLCWONOFFSts@ */ /end MEASUREMENT
/begin MEASUREMENT SwcIn_RLCR_2.RLCR_2_CRC1 "" UBYTE autosar_swc_val_CM_RLCR_2_CRC1_1104_dt 0 0 0 255 ECU_ADDRESS 0xfe4c9d28 /* @ECU_Address@SwcIn_RLCR_2.RLCR_2_CRC1@ */ /end MEASUREMENT
/begin MEASUREMENT SwcIn_RLCR_2.RLCR_2_DOWONOFFSts "" UBYTE autosar_swc_val_CM_RLCR_2_DOWONOFFSts_1104_dt 0 0 0 255 ECU_ADDRESS 0xfe4c9d35 /* @ECU_Address@SwcIn_RLCR_2.RLCR_2_DOWONOFFSts@ */ /end MEASUREMENT
/begin MEASUREMENT SwcIn_RLCR_2.RLCR_2_RCTARCTBONOFFSts "" UBYTE autosar_swc_val_CM_RLCR_2_RCTARCTBONOFFSts_1104_dt 0 0 0 255 ECU_ADDRESS 0xfe4c9d37 /* @ECU_Address@SwcIn_RLCR_2.RLCR_2_RCTARCTBONOFFSts@ */ /end MEASUREMENT
/begin MEASUREMENT SwcIn_RLCR_2.RLCR_2_RCTAWarn "" UBYTE autosar_swc_val_CM_RLCR_2_RCTAWarn_1104_dt 0 0 0 255 ECU_ADDRESS 0xfe4c9d2c /* @ECU_Address@SwcIn_RLCR_2.RLCR_2_RCTAWarn@ */ /end MEASUREMENT
/begin MEASUREMENT SwcIn_RLCR_2.RLCR_2_RCTBCtrlA "" FLOAT32_IEEE autosar_swc_val_CM_RLCR_2_RCTBCtrlA_1104_dt 0 0 -3.4E+38 3.4E+38 ECU_ADDRESS 0xfe4c9d30 /* @ECU_Address@SwcIn_RLCR_2.RLCR_2_RCTBCtrlA@ */ /end MEASUREMENT
/begin MEASUREMENT SwcIn_RLCR_2.RLCR_2_RCTBReq "" UBYTE autosar_swc_val_CM_RLCR_2_RCTBReq_1104_dt 0 0 0 255 ECU_ADDRESS 0xfe4c9d2e /* @ECU_Address@SwcIn_RLCR_2.RLCR_2_RCTBReq@ */ /end MEASUREMENT
/begin MEASUREMENT SwcIn_RLCR_2.RLCR_2_RCTBWarn "" UBYTE autosar_swc_val_CM_RLCR_2_RCTBWarn_1104_dt 0 0 0 255 ECU_ADDRESS 0xfe4c9d2d /* @ECU_Address@SwcIn_RLCR_2.RLCR_2_RCTBWarn@ */ /end MEASUREMENT
/begin MEASUREMENT SwcIn_RLCR_2.RLCR_2_RCWONOFFSts "" UBYTE autosar_swc_val_CM_RLCR_2_RCWONOFFSts_1104_dt 0 0 0 255 ECU_ADDRESS 0xfe4c9d36 /* @ECU_Address@SwcIn_RLCR_2.RLCR_2_RCWONOFFSts@ */ /end MEASUREMENT
/begin MEASUREMENT SwcIn_RLCR_2.RLCR_2_RCWWarn "" UBYTE autosar_swc_val_CM_RLCR_2_RCWWarn_1104_dt 0 0 0 255 ECU_ADDRESS 0xfe4c9d2b /* @ECU_Address@SwcIn_RLCR_2.RLCR_2_RCWWarn@ */ /end MEASUREMENT
/begin MEASUREMENT SwcIn_RLCR_2.RLCR_2_Resd1 "" UBYTE autosar_swc_val_CM_RLCR_2_Resd1_1104_dt 0 0 0 255 ECU_ADDRESS 0xfe4c9d2a /* @ECU_Address@SwcIn_RLCR_2.RLCR_2_Resd1@ */ /end MEASUREMENT
/begin MEASUREMENT SwcIn_RLCR_2.RLCR_2_RollgCntr1 "" UBYTE autosar_swc_val_CM_RLCR_2_RollgCntr1_1104_dt 0 0 0 255 ECU_ADDRESS 0xfe4c9d29 /* @ECU_Address@SwcIn_RLCR_2.RLCR_2_RollgCntr1@ */ /end MEASUREMENT
/begin MEASUREMENT SwcIn_RLCR_3.RLCR_3_CRC "" UWORD autosar_swc_val_CM_RLCR_3_CRC_935_dt 0 0 0 65535 ECU_ADDRESS 0xfe4c9d38 /* @ECU_Address@SwcIn_RLCR_3.RLCR_3_CRC@ */ /end MEASUREMENT
/begin MEASUREMENT SwcIn_RLCR_3.RLCR_3_Le1HdTo "" FLOAT32_IEEE autosar_swc_val_CM_RLCR_3_Le1HdTo_935_dt 0 0 -3.4E+38 3.4E+38 ECU_ADDRESS 0xfe4c9d44 /* @ECU_Address@SwcIn_RLCR_3.RLCR_3_Le1HdTo@ */ /end MEASUREMENT
/begin MEASUREMENT SwcIn_RLCR_3.RLCR_3_Le1ObjBoxLen "" FLOAT32_IEEE autosar_swc_val_CM_RLCR_3_Le1ObjBoxLen_935_dt 0 0 -3.4E+38 3.4E+38 ECU_ADDRESS 0xfe4c9d3c /* @ECU_Address@SwcIn_RLCR_3.RLCR_3_Le1ObjBoxLen@ */ /end MEASUREMENT
/begin MEASUREMENT SwcIn_RLCR_3.RLCR_3_Le1ObjBoxWidth "" FLOAT32_IEEE autosar_swc_val_CM_RLCR_3_Le1ObjBoxWidth_935_dt 0 0 -3.4E+38 3.4E+38 ECU_ADDRESS 0xfe4c9d40 /* @ECU_Address@SwcIn_RLCR_3.RLCR_3_Le1ObjBoxWidth@ */ /end MEASUREMENT
/begin MEASUREMENT SwcIn_RLCR_3.RLCR_3_Le1ObjConf "" UBYTE autosar_swc_val_CM_RLCR_3_Le1ObjConf_935_dt 0 0 0 255 ECU_ADDRESS 0xfe4c9d62 /* @ECU_Address@SwcIn_RLCR_3.RLCR_3_Le1ObjConf@ */ /end MEASUREMENT
/begin MEASUREMENT SwcIn_RLCR_3.RLCR_3_Le1ObjCoordX "" FLOAT32_IEEE autosar_swc_val_CM_RLCR_3_Le1ObjCoordX_935_dt 0 0 -3.4E+38 3.4E+38 ECU_ADDRESS 0xfe4c9d50 /* @ECU_Address@SwcIn_RLCR_3.RLCR_3_Le1ObjCoordX@ */ /end MEASUREMENT
/begin MEASUREMENT SwcIn_RLCR_3.RLCR_3_Le1ObjCoordXDstStdDe "" FLOAT32_IEEE autosar_swc_val_CM_RLCR_3_Le1ObjCoordXDstStdDe_935_dt 0 0 -3.4E+38 3.4E+38 ECU_ADDRESS 0xfe4c9d68 /* @ECU_Address@SwcIn_RLCR_3.RLCR_3_Le1ObjCoordXDstStdDe@ */ /end MEASUREMENT
/begin MEASUREMENT SwcIn_RLCR_3.RLCR_3_Le1ObjCoordY "" FLOAT32_IEEE autosar_swc_val_CM_RLCR_3_Le1ObjCoordY_935_dt 0 0 -3.4E+38 3.4E+38 ECU_ADDRESS 0xfe4c9d4c /* @ECU_Address@SwcIn_RLCR_3.RLCR_3_Le1ObjCoordY@ */ /end MEASUREMENT
/begin MEASUREMENT SwcIn_RLCR_3.RLCR_3_Le1ObjCoordYDstStdDe "" FLOAT32_IEEE autosar_swc_val_CM_RLCR_3_Le1ObjCoordYDstStdDe_935_dt 0 0 -3.4E+38 3.4E+38 ECU_ADDRESS 0xfe4c9d6c /* @ECU_Address@SwcIn_RLCR_3.RLCR_3_Le1ObjCoordYDstStdDe@ */ /end MEASUREMENT
/begin MEASUREMENT SwcIn_RLCR_3.RLCR_3_Le1ObjID "" UBYTE autosar_swc_val_CM_RLCR_3_Le1ObjID_935_dt 0 0 0 255 ECU_ADDRESS 0xfe4c9d48 /* @ECU_Address@SwcIn_RLCR_3.RLCR_3_Le1ObjID@ */ /end MEASUREMENT
/begin MEASUREMENT SwcIn_RLCR_3.RLCR_3_Le1ObjMtnChartc "" UBYTE autosar_swc_val_CM_RLCR_3_Le1ObjMtnChartc_935_dt 0 0 0 255 ECU_ADDRESS 0xfe4c9d60 /* @ECU_Address@SwcIn_RLCR_3.RLCR_3_Le1ObjMtnChartc@ */ /end MEASUREMENT
/begin MEASUREMENT SwcIn_RLCR_3.RLCR_3_Le1ObjNrOffocst "" UBYTE autosar_swc_val_CM_RLCR_3_Le1ObjNrOffocst_935_dt 0 0 0 255 ECU_ADDRESS 0xfe4c9d63 /* @ECU_Address@SwcIn_RLCR_3.RLCR_3_Le1ObjNrOffocst@ */ /end MEASUREMENT
/begin MEASUREMENT SwcIn_RLCR_3.RLCR_3_Le1ObjTrackSt "" UBYTE autosar_swc_val_CM_RLCR_3_Le1ObjTrackSt_935_dt 0 0 0 255 ECU_ADDRESS 0xfe4c9d64 /* @ECU_Address@SwcIn_RLCR_3.RLCR_3_Le1ObjTrackSt@ */ /end MEASUREMENT
/begin MEASUREMENT SwcIn_RLCR_3.RLCR_3_Le1ObjTyp "" UBYTE autosar_swc_val_CM_RLCR_3_Le1ObjTyp_935_dt 0 0 0 255 ECU_ADDRESS 0xfe4c9d61 /* @ECU_Address@SwcIn_RLCR_3.RLCR_3_Le1ObjTyp@ */ /end MEASUREMENT
/begin MEASUREMENT SwcIn_RLCR_3.RLCR_3_Le1ObjXDirAV "" FLOAT32_IEEE autosar_swc_val_CM_RLCR_3_Le1ObjXDirAV_935_dt 0 0 -3.4E+38 3.4E+38 ECU_ADDRESS 0xfe4c9d54 /* @ECU_Address@SwcIn_RLCR_3.RLCR_3_Le1ObjXDirAV@ */ /end MEASUREMENT
/begin MEASUREMENT SwcIn_RLCR_3.RLCR_3_Le1ObjXDirV "" FLOAT32_IEEE autosar_swc_val_CM_RLCR_3_Le1ObjXDirV_935_dt 0 0 -3.4E+38 3.4E+38 ECU_ADDRESS 0xfe4c9d5c /* @ECU_Address@SwcIn_RLCR_3.RLCR_3_Le1ObjXDirV@ */ /end MEASUREMENT
/begin MEASUREMENT SwcIn_RLCR_3.RLCR_3_Le1ObjXDirVStdDe "" FLOAT32_IEEE autosar_swc_val_CM_RLCR_3_Le1ObjXDirVStdDe_935_dt 0 0 -3.4E+38 3.4E+38 ECU_ADDRESS 0xfe4c9d70 /* @ECU_Address@SwcIn_RLCR_3.RLCR_3_Le1ObjXDirVStdDe@ */ /end MEASUREMENT
/begin MEASUREMENT SwcIn_RLCR_3.RLCR_3_Le1ObjYDirV "" FLOAT32_IEEE autosar_swc_val_CM_RLCR_3_Le1ObjYDirV_935_dt 0 0 -3.4E+38 3.4E+38 ECU_ADDRESS 0xfe4c9d58 /* @ECU_Address@SwcIn_RLCR_3.RLCR_3_Le1ObjYDirV@ */ /end MEASUREMENT
/begin MEASUREMENT SwcIn_RLCR_3.RLCR_3_Le1ObjYDirVStdDe "" FLOAT32_IEEE autosar_swc_val_CM_RLCR_3_Le1ObjYDirVStdDe_935_dt 0 0 -3.4E+38 3.4E+38 ECU_ADDRESS 0xfe4c9d74 /* @ECU_Address@SwcIn_RLCR_3.RLCR_3_Le1ObjYDirVStdDe@ */ /end MEASUREMENT
/begin MEASUREMENT SwcIn_RLCR_3.RLCR_3_RollgCntr "" UBYTE autosar_swc_val_CM_RLCR_3_RollgCntr_935_dt 0 0 0 255 ECU_ADDRESS 0xfe4c9d3a /* @ECU_Address@SwcIn_RLCR_3.RLCR_3_RollgCntr@ */ /end MEASUREMENT
/begin MEASUREMENT SwcIn_RLCR_4.RLCR_4_CRC "" UWORD autosar_swc_val_CM_RLCR_4_CRC_937_dt 0 0 0 65535 ECU_ADDRESS 0xfe4c9d78 /* @ECU_Address@SwcIn_RLCR_4.RLCR_4_CRC@ */ /end MEASUREMENT
/begin MEASUREMENT SwcIn_RLCR_4.RLCR_4_Le2HdTo "" FLOAT32_IEEE autosar_swc_val_CM_RLCR_4_Le2HdTo_937_dt 0 0 -3.4E+38 3.4E+38 ECU_ADDRESS 0xfe4c9d84 /* @ECU_Address@SwcIn_RLCR_4.RLCR_4_Le2HdTo@ */ /end MEASUREMENT
/begin MEASUREMENT SwcIn_RLCR_4.RLCR_4_Le2ObjBoxLen "" FLOAT32_IEEE autosar_swc_val_CM_RLCR_4_Le2ObjBoxLen_937_dt 0 0 -3.4E+38 3.4E+38 ECU_ADDRESS 0xfe4c9d7c /* @ECU_Address@SwcIn_RLCR_4.RLCR_4_Le2ObjBoxLen@ */ /end MEASUREMENT
/begin MEASUREMENT SwcIn_RLCR_4.RLCR_4_Le2ObjBoxWidth "" FLOAT32_IEEE autosar_swc_val_CM_RLCR_4_Le2ObjBoxWidth_937_dt 0 0 -3.4E+38 3.4E+38 ECU_ADDRESS 0xfe4c9d80 /* @ECU_Address@SwcIn_RLCR_4.RLCR_4_Le2ObjBoxWidth@ */ /end MEASUREMENT
/begin MEASUREMENT SwcIn_RLCR_4.RLCR_4_Le2ObjConf "" UBYTE autosar_swc_val_CM_RLCR_4_Le2ObjConf_937_dt 0 0 0 255 ECU_ADDRESS 0xfe4c9da2 /* @ECU_Address@SwcIn_RLCR_4.RLCR_4_Le2ObjConf@ */ /end MEASUREMENT
/begin MEASUREMENT SwcIn_RLCR_4.RLCR_4_Le2ObjCoordX "" FLOAT32_IEEE autosar_swc_val_CM_RLCR_4_Le2ObjCoordX_937_dt 0 0 -3.4E+38 3.4E+38 ECU_ADDRESS 0xfe4c9d90 /* @ECU_Address@SwcIn_RLCR_4.RLCR_4_Le2ObjCoordX@ */ /end MEASUREMENT
/begin MEASUREMENT SwcIn_RLCR_4.RLCR_4_Le2ObjCoordXDstStdDe "" FLOAT32_IEEE autosar_swc_val_CM_RLCR_4_Le2ObjCoordXDstStdDe_937_dt 0 0 -3.4E+38 3.4E+38 ECU_ADDRESS 0xfe4c9da8 /* @ECU_Address@SwcIn_RLCR_4.RLCR_4_Le2ObjCoordXDstStdDe@ */ /end MEASUREMENT
/begin MEASUREMENT SwcIn_RLCR_4.RLCR_4_Le2ObjCoordY "" FLOAT32_IEEE autosar_swc_val_CM_RLCR_4_Le2ObjCoordY_937_dt 0 0 -3.4E+38 3.4E+38 ECU_ADDRESS 0xfe4c9d8c /* @ECU_Address@SwcIn_RLCR_4.RLCR_4_Le2ObjCoordY@ */ /end MEASUREMENT
/begin MEASUREMENT SwcIn_RLCR_4.RLCR_4_Le2ObjCoordYDstStdDe "" FLOAT32_IEEE autosar_swc_val_CM_RLCR_4_Le2ObjCoordYDstStdDe_937_dt 0 0 -3.4E+38 3.4E+38 ECU_ADDRESS 0xfe4c9dac /* @ECU_Address@SwcIn_RLCR_4.RLCR_4_Le2ObjCoordYDstStdDe@ */ /end MEASUREMENT
/begin MEASUREMENT SwcIn_RLCR_4.RLCR_4_Le2ObjID "" UBYTE autosar_swc_val_CM_RLCR_4_Le2ObjID_937_dt 0 0 0 255 ECU_ADDRESS 0xfe4c9d88 /* @ECU_Address@SwcIn_RLCR_4.RLCR_4_Le2ObjID@ */ /end MEASUREMENT
/begin MEASUREMENT SwcIn_RLCR_4.RLCR_4_Le2ObjMtnChartc "" UBYTE autosar_swc_val_CM_RLCR_4_Le2ObjMtnChartc_937_dt 0 0 0 255 ECU_ADDRESS 0xfe4c9da0 /* @ECU_Address@SwcIn_RLCR_4.RLCR_4_Le2ObjMtnChartc@ */ /end MEASUREMENT
/begin MEASUREMENT SwcIn_RLCR_4.RLCR_4_Le2ObjNrOffocst "" UBYTE autosar_swc_val_CM_RLCR_4_Le2ObjNrOffocst_937_dt 0 0 0 255 ECU_ADDRESS 0xfe4c9da3 /* @ECU_Address@SwcIn_RLCR_4.RLCR_4_Le2ObjNrOffocst@ */ /end MEASUREMENT
/begin MEASUREMENT SwcIn_RLCR_4.RLCR_4_Le2ObjTrackSt "" UBYTE autosar_swc_val_CM_RLCR_4_Le2ObjTrackSt_937_dt 0 0 0 255 ECU_ADDRESS 0xfe4c9da4 /* @ECU_Address@SwcIn_RLCR_4.RLCR_4_Le2ObjTrackSt@ */ /end MEASUREMENT
/begin MEASUREMENT SwcIn_RLCR_4.RLCR_4_Le2ObjTyp "" UBYTE autosar_swc_val_CM_RLCR_4_Le2ObjTyp_937_dt 0 0 0 255 ECU_ADDRESS 0xfe4c9da1 /* @ECU_Address@SwcIn_RLCR_4.RLCR_4_Le2ObjTyp@ */ /end MEASUREMENT
/begin MEASUREMENT SwcIn_RLCR_4.RLCR_4_Le2ObjXDirAV "" FLOAT32_IEEE autosar_swc_val_CM_RLCR_4_Le2ObjXDirAV_937_dt 0 0 -3.4E+38 3.4E+38 ECU_ADDRESS 0xfe4c9d94 /* @ECU_Address@SwcIn_RLCR_4.RLCR_4_Le2ObjXDirAV@ */ /end MEASUREMENT
/begin MEASUREMENT SwcIn_RLCR_4.RLCR_4_Le2ObjXDirV "" FLOAT32_IEEE autosar_swc_val_CM_RLCR_4_Le2ObjXDirV_937_dt 0 0 -3.4E+38 3.4E+38 ECU_ADDRESS 0xfe4c9d9c /* @ECU_Address@SwcIn_RLCR_4.RLCR_4_Le2ObjXDirV@ */ /end MEASUREMENT
/begin MEASUREMENT SwcIn_RLCR_4.RLCR_4_Le2ObjXDirVStdDe "" FLOAT32_IEEE autosar_swc_val_CM_RLCR_4_Le2ObjXDirVStdDe_937_dt 0 0 -3.4E+38 3.4E+38 ECU_ADDRESS 0xfe4c9db0 /* @ECU_Address@SwcIn_RLCR_4.RLCR_4_Le2ObjXDirVStdDe@ */ /end MEASUREMENT
/begin MEASUREMENT SwcIn_RLCR_4.RLCR_4_Le2ObjYDirV "" FLOAT32_IEEE autosar_swc_val_CM_RLCR_4_Le2ObjYDirV_937_dt 0 0 -3.4E+38 3.4E+38 ECU_ADDRESS 0xfe4c9d98 /* @ECU_Address@SwcIn_RLCR_4.RLCR_4_Le2ObjYDirV@ */ /end MEASUREMENT
/begin MEASUREMENT SwcIn_RLCR_4.RLCR_4_Le2ObjYDirVStdDe "" FLOAT32_IEEE autosar_swc_val_CM_RLCR_4_Le2ObjYDirVStdDe_937_dt 0 0 -3.4E+38 3.4E+38 ECU_ADDRESS 0xfe4c9db4 /* @ECU_Address@SwcIn_RLCR_4.RLCR_4_Le2ObjYDirVStdDe@ */ /end MEASUREMENT
/begin MEASUREMENT SwcIn_RLCR_4.RLCR_4_RollgCntr "" UBYTE autosar_swc_val_CM_RLCR_4_RollgCntr_937_dt 0 0 0 255 ECU_ADDRESS 0xfe4c9d7a /* @ECU_Address@SwcIn_RLCR_4.RLCR_4_RollgCntr@ */ /end MEASUREMENT
/begin MEASUREMENT SwcIn_RLCR_5.RLCR_5_CRC "" UWORD autosar_swc_val_CM_RLCR_5_CRC_941_dt 0 0 0 65535 ECU_ADDRESS 0xfe4c9db8 /* @ECU_Address@SwcIn_RLCR_5.RLCR_5_CRC@ */ /end MEASUREMENT
/begin MEASUREMENT SwcIn_RLCR_5.RLCR_5_Le3HdTo "" FLOAT32_IEEE autosar_swc_val_CM_RLCR_5_Le3HdTo_941_dt 0 0 -3.4E+38 3.4E+38 ECU_ADDRESS 0xfe4c9dc4 /* @ECU_Address@SwcIn_RLCR_5.RLCR_5_Le3HdTo@ */ /end MEASUREMENT
/begin MEASUREMENT SwcIn_RLCR_5.RLCR_5_Le3ObjBoxLen "" FLOAT32_IEEE autosar_swc_val_CM_RLCR_5_Le3ObjBoxLen_941_dt 0 0 -3.4E+38 3.4E+38 ECU_ADDRESS 0xfe4c9dbc /* @ECU_Address@SwcIn_RLCR_5.RLCR_5_Le3ObjBoxLen@ */ /end MEASUREMENT
/begin MEASUREMENT SwcIn_RLCR_5.RLCR_5_Le3ObjBoxWidth "" FLOAT32_IEEE autosar_swc_val_CM_RLCR_5_Le3ObjBoxWidth_941_dt 0 0 -3.4E+38 3.4E+38 ECU_ADDRESS 0xfe4c9dc0 /* @ECU_Address@SwcIn_RLCR_5.RLCR_5_Le3ObjBoxWidth@ */ /end MEASUREMENT
/begin MEASUREMENT SwcIn_RLCR_5.RLCR_5_Le3ObjConf "" UBYTE autosar_swc_val_CM_RLCR_5_Le3ObjConf_941_dt 0 0 0 255 ECU_ADDRESS 0xfe4c9de2 /* @ECU_Address@SwcIn_RLCR_5.RLCR_5_Le3ObjConf@ */ /end MEASUREMENT
/begin MEASUREMENT SwcIn_RLCR_5.RLCR_5_Le3ObjCoordX "" FLOAT32_IEEE autosar_swc_val_CM_RLCR_5_Le3ObjCoordX_941_dt 0 0 -3.4E+38 3.4E+38 ECU_ADDRESS 0xfe4c9dd0 /* @ECU_Address@SwcIn_RLCR_5.RLCR_5_Le3ObjCoordX@ */ /end MEASUREMENT
/begin MEASUREMENT SwcIn_RLCR_5.RLCR_5_Le3ObjCoordXDstStdDe "" FLOAT32_IEEE autosar_swc_val_CM_RLCR_5_Le3ObjCoordXDstStdDe_941_dt 0 0 -3.4E+38 3.4E+38 ECU_ADDRESS 0xfe4c9de8 /* @ECU_Address@SwcIn_RLCR_5.RLCR_5_Le3ObjCoordXDstStdDe@ */ /end MEASUREMENT
/begin MEASUREMENT SwcIn_RLCR_5.RLCR_5_Le3ObjCoordY "" FLOAT32_IEEE autosar_swc_val_CM_RLCR_5_Le3ObjCoordY_941_dt 0 0 -3.4E+38 3.4E+38 ECU_ADDRESS 0xfe4c9dcc /* @ECU_Address@SwcIn_RLCR_5.RLCR_5_Le3ObjCoordY@ */ /end MEASUREMENT
/begin MEASUREMENT SwcIn_RLCR_5.RLCR_5_Le3ObjCoordYDstStdDe "" FLOAT32_IEEE autosar_swc_val_CM_RLCR_5_Le3ObjCoordYDstStdDe_941_dt 0 0 -3.4E+38 3.4E+38 ECU_ADDRESS 0xfe4c9dec /* @ECU_Address@SwcIn_RLCR_5.RLCR_5_Le3ObjCoordYDstStdDe@ */ /end MEASUREMENT
/begin MEASUREMENT SwcIn_RLCR_5.RLCR_5_Le3ObjID "" UBYTE autosar_swc_val_CM_RLCR_5_Le3ObjID_941_dt 0 0 0 255 ECU_ADDRESS 0xfe4c9dc8 /* @ECU_Address@SwcIn_RLCR_5.RLCR_5_Le3ObjID@ */ /end MEASUREMENT
/begin MEASUREMENT SwcIn_RLCR_5.RLCR_5_Le3ObjMtnChartc "" UBYTE autosar_swc_val_CM_RLCR_5_Le3ObjMtnChartc_941_dt 0 0 0 255 ECU_ADDRESS 0xfe4c9de0 /* @ECU_Address@SwcIn_RLCR_5.RLCR_5_Le3ObjMtnChartc@ */ /end MEASUREMENT
/begin MEASUREMENT SwcIn_RLCR_5.RLCR_5_Le3ObjNrOffocst "" UBYTE autosar_swc_val_CM_RLCR_5_Le3ObjNrOffocst_941_dt 0 0 0 255 ECU_ADDRESS 0xfe4c9de3 /* @ECU_Address@SwcIn_RLCR_5.RLCR_5_Le3ObjNrOffocst@ */ /end MEASUREMENT
/begin MEASUREMENT SwcIn_RLCR_5.RLCR_5_Le3ObjTrackSt "" UBYTE autosar_swc_val_CM_RLCR_5_Le3ObjTrackSt_941_dt 0 0 0 255 ECU_ADDRESS 0xfe4c9de4 /* @ECU_Address@SwcIn_RLCR_5.RLCR_5_Le3ObjTrackSt@ */ /end MEASUREMENT
/begin MEASUREMENT SwcIn_RLCR_5.RLCR_5_Le3ObjTyp "" UBYTE autosar_swc_val_CM_RLCR_5_Le3ObjTyp_941_dt 0 0 0 255 ECU_ADDRESS 0xfe4c9de1 /* @ECU_Address@SwcIn_RLCR_5.RLCR_5_Le3ObjTyp@ */ /end MEASUREMENT
/begin MEASUREMENT SwcIn_RLCR_5.RLCR_5_Le3ObjXDirAV "" FLOAT32_IEEE autosar_swc_val_CM_RLCR_5_Le3ObjXDirAV_941_dt 0 0 -3.4E+38 3.4E+38 ECU_ADDRESS 0xfe4c9dd4 /* @ECU_Address@SwcIn_RLCR_5.RLCR_5_Le3ObjXDirAV@ */ /end MEASUREMENT
/begin MEASUREMENT SwcIn_RLCR_5.RLCR_5_Le3ObjXDirV "" FLOAT32_IEEE autosar_swc_val_CM_RLCR_5_Le3ObjXDirV_941_dt 0 0 -3.4E+38 3.4E+38 ECU_ADDRESS 0xfe4c9ddc /* @ECU_Address@SwcIn_RLCR_5.RLCR_5_Le3ObjXDirV@ */ /end MEASUREMENT
/begin MEASUREMENT SwcIn_RLCR_5.RLCR_5_Le3ObjXDirVStdDe "" FLOAT32_IEEE autosar_swc_val_CM_RLCR_5_Le3ObjXDirVStdDe_941_dt 0 0 -3.4E+38 3.4E+38 ECU_ADDRESS 0xfe4c9df0 /* @ECU_Address@SwcIn_RLCR_5.RLCR_5_Le3ObjXDirVStdDe@ */ /end MEASUREMENT
/begin MEASUREMENT SwcIn_RLCR_5.RLCR_5_Le3ObjYDirV "" FLOAT32_IEEE autosar_swc_val_CM_RLCR_5_Le3ObjYDirV_941_dt 0 0 -3.4E+38 3.4E+38 ECU_ADDRESS 0xfe4c9dd8 /* @ECU_Address@SwcIn_RLCR_5.RLCR_5_Le3ObjYDirV@ */ /end MEASUREMENT
/begin MEASUREMENT SwcIn_RLCR_5.RLCR_5_Le3ObjYDirVStdDe "" FLOAT32_IEEE autosar_swc_val_CM_RLCR_5_Le3ObjYDirVStdDe_941_dt 0 0 -3.4E+38 3.4E+38 ECU_ADDRESS 0xfe4c9df4 /* @ECU_Address@SwcIn_RLCR_5.RLCR_5_Le3ObjYDirVStdDe@ */ /end MEASUREMENT
/begin MEASUREMENT SwcIn_RLCR_5.RLCR_5_RollgCntr "" UBYTE autosar_swc_val_CM_RLCR_5_RollgCntr_941_dt 0 0 0 255 ECU_ADDRESS 0xfe4c9dba /* @ECU_Address@SwcIn_RLCR_5.RLCR_5_RollgCntr@ */ /end MEASUREMENT
/begin MEASUREMENT SwcIn_RLCR_6.RLCR_6_CRC "" UWORD autosar_swc_val_CM_RLCR_6_CRC_946_dt 0 0 0 65535 ECU_ADDRESS 0xfe4c9df8 /* @ECU_Address@SwcIn_RLCR_6.RLCR_6_CRC@ */ /end MEASUREMENT
/begin MEASUREMENT SwcIn_RLCR_6.RLCR_6_Le4HdTo "" FLOAT32_IEEE autosar_swc_val_CM_RLCR_6_Le4HdTo_946_dt 0 0 -3.4E+38 3.4E+38 ECU_ADDRESS 0xfe4c9e04 /* @ECU_Address@SwcIn_RLCR_6.RLCR_6_Le4HdTo@ */ /end MEASUREMENT
/begin MEASUREMENT SwcIn_RLCR_6.RLCR_6_Le4ObjBoxLen "" FLOAT32_IEEE autosar_swc_val_CM_RLCR_6_Le4ObjBoxLen_946_dt 0 0 -3.4E+38 3.4E+38 ECU_ADDRESS 0xfe4c9dfc /* @ECU_Address@SwcIn_RLCR_6.RLCR_6_Le4ObjBoxLen@ */ /end MEASUREMENT
/begin MEASUREMENT SwcIn_RLCR_6.RLCR_6_Le4ObjBoxWidth "" FLOAT32_IEEE autosar_swc_val_CM_RLCR_6_Le4ObjBoxWidth_946_dt 0 0 -3.4E+38 3.4E+38 ECU_ADDRESS 0xfe4c9e00 /* @ECU_Address@SwcIn_RLCR_6.RLCR_6_Le4ObjBoxWidth@ */ /end MEASUREMENT
/begin MEASUREMENT SwcIn_RLCR_6.RLCR_6_Le4ObjConf "" UBYTE autosar_swc_val_CM_RLCR_6_Le4ObjConf_946_dt 0 0 0 255 ECU_ADDRESS 0xfe4c9e22 /* @ECU_Address@SwcIn_RLCR_6.RLCR_6_Le4ObjConf@ */ /end MEASUREMENT
/begin MEASUREMENT SwcIn_RLCR_6.RLCR_6_Le4ObjCoordX "" FLOAT32_IEEE autosar_swc_val_CM_RLCR_6_Le4ObjCoordX_946_dt 0 0 -3.4E+38 3.4E+38 ECU_ADDRESS 0xfe4c9e10 /* @ECU_Address@SwcIn_RLCR_6.RLCR_6_Le4ObjCoordX@ */ /end MEASUREMENT
/begin MEASUREMENT SwcIn_RLCR_6.RLCR_6_Le4ObjCoordXDstStdDe "" FLOAT32_IEEE autosar_swc_val_CM_RLCR_6_Le4ObjCoordXDstStdDe_946_dt 0 0 -3.4E+38 3.4E+38 ECU_ADDRESS 0xfe4c9e28 /* @ECU_Address@SwcIn_RLCR_6.RLCR_6_Le4ObjCoordXDstStdDe@ */ /end MEASUREMENT
/begin MEASUREMENT SwcIn_RLCR_6.RLCR_6_Le4ObjCoordY "" FLOAT32_IEEE autosar_swc_val_CM_RLCR_6_Le4ObjCoordY_946_dt 0 0 -3.4E+38 3.4E+38 ECU_ADDRESS 0xfe4c9e0c /* @ECU_Address@SwcIn_RLCR_6.RLCR_6_Le4ObjCoordY@ */ /end MEASUREMENT
/begin MEASUREMENT SwcIn_RLCR_6.RLCR_6_Le4ObjCoordYDstStdDe "" FLOAT32_IEEE autosar_swc_val_CM_RLCR_6_Le4ObjCoordYDstStdDe_946_dt 0 0 -3.4E+38 3.4E+38 ECU_ADDRESS 0xfe4c9e2c /* @ECU_Address@SwcIn_RLCR_6.RLCR_6_Le4ObjCoordYDstStdDe@ */ /end MEASUREMENT
/begin MEASUREMENT SwcIn_RLCR_6.RLCR_6_Le4ObjID "" UBYTE autosar_swc_val_CM_RLCR_6_Le4ObjID_946_dt 0 0 0 255 ECU_ADDRESS 0xfe4c9e08 /* @ECU_Address@SwcIn_RLCR_6.RLCR_6_Le4ObjID@ */ /end MEASUREMENT
/begin MEASUREMENT SwcIn_RLCR_6.RLCR_6_Le4ObjMtnChartc "" UBYTE autosar_swc_val_CM_RLCR_6_Le4ObjMtnChartc_946_dt 0 0 0 255 ECU_ADDRESS 0xfe4c9e20 /* @ECU_Address@SwcIn_RLCR_6.RLCR_6_Le4ObjMtnChartc@ */ /end MEASUREMENT
/begin MEASUREMENT SwcIn_RLCR_6.RLCR_6_Le4ObjNrOffocst "" UBYTE autosar_swc_val_CM_RLCR_6_Le4ObjNrOffocst_946_dt 0 0 0 255 ECU_ADDRESS 0xfe4c9e23 /* @ECU_Address@SwcIn_RLCR_6.RLCR_6_Le4ObjNrOffocst@ */ /end MEASUREMENT
/begin MEASUREMENT SwcIn_RLCR_6.RLCR_6_Le4ObjTrackSt "" UBYTE autosar_swc_val_CM_RLCR_6_Le4ObjTrackSt_946_dt 0 0 0 255 ECU_ADDRESS 0xfe4c9e24 /* @ECU_Address@SwcIn_RLCR_6.RLCR_6_Le4ObjTrackSt@ */ /end MEASUREMENT
/begin MEASUREMENT SwcIn_RLCR_6.RLCR_6_Le4ObjTyp "" UBYTE autosar_swc_val_CM_RLCR_6_Le4ObjTyp_946_dt 0 0 0 255 ECU_ADDRESS 0xfe4c9e21 /* @ECU_Address@SwcIn_RLCR_6.RLCR_6_Le4ObjTyp@ */ /end MEASUREMENT
/begin MEASUREMENT SwcIn_RLCR_6.RLCR_6_Le4ObjXDirAV "" FLOAT32_IEEE autosar_swc_val_CM_RLCR_6_Le4ObjXDirAV_946_dt 0 0 -3.4E+38 3.4E+38 ECU_ADDRESS 0xfe4c9e14 /* @ECU_Address@SwcIn_RLCR_6.RLCR_6_Le4ObjXDirAV@ */ /end MEASUREMENT
/begin MEASUREMENT SwcIn_RLCR_6.RLCR_6_Le4ObjXDirV "" FLOAT32_IEEE autosar_swc_val_CM_RLCR_6_Le4ObjXDirV_946_dt 0 0 -3.4E+38 3.4E+38 ECU_ADDRESS 0xfe4c9e1c /* @ECU_Address@SwcIn_RLCR_6.RLCR_6_Le4ObjXDirV@ */ /end MEASUREMENT
/begin MEASUREMENT SwcIn_RLCR_6.RLCR_6_Le4ObjXDirVStdDe "" FLOAT32_IEEE autosar_swc_val_CM_RLCR_6_Le4ObjXDirVStdDe_946_dt 0 0 -3.4E+38 3.4E+38 ECU_ADDRESS 0xfe4c9e30 /* @ECU_Address@SwcIn_RLCR_6.RLCR_6_Le4ObjXDirVStdDe@ */ /end MEASUREMENT
/begin MEASUREMENT SwcIn_RLCR_6.RLCR_6_Le4ObjYDirV "" FLOAT32_IEEE autosar_swc_val_CM_RLCR_6_Le4ObjYDirV_946_dt 0 0 -3.4E+38 3.4E+38 ECU_ADDRESS 0xfe4c9e18 /* @ECU_Address@SwcIn_RLCR_6.RLCR_6_Le4ObjYDirV@ */ /end MEASUREMENT
/begin MEASUREMENT SwcIn_RLCR_6.RLCR_6_Le4ObjYDirVStdDe "" FLOAT32_IEEE autosar_swc_val_CM_RLCR_6_Le4ObjYDirVStdDe_946_dt 0 0 -3.4E+38 3.4E+38 ECU_ADDRESS 0xfe4c9e34 /* @ECU_Address@SwcIn_RLCR_6.RLCR_6_Le4ObjYDirVStdDe@ */ /end MEASUREMENT
/begin MEASUREMENT SwcIn_RLCR_6.RLCR_6_RollgCntr "" UBYTE autosar_swc_val_CM_RLCR_6_RollgCntr_946_dt 0 0 0 255 ECU_ADDRESS 0xfe4c9dfa /* @ECU_Address@SwcIn_RLCR_6.RLCR_6_RollgCntr@ */ /end MEASUREMENT
/begin MEASUREMENT SwcIn_RLCR_7.RLCR_7_CRC "" UWORD autosar_swc_val_CM_RLCR_7_CRC_948_dt 0 0 0 65535 ECU_ADDRESS 0xfe4c9e38 /* @ECU_Address@SwcIn_RLCR_7.RLCR_7_CRC@ */ /end MEASUREMENT
/begin MEASUREMENT SwcIn_RLCR_7.RLCR_7_Le5HdTo "" FLOAT32_IEEE autosar_swc_val_CM_RLCR_7_Le5HdTo_948_dt 0 0 -3.4E+38 3.4E+38 ECU_ADDRESS 0xfe4c9e44 /* @ECU_Address@SwcIn_RLCR_7.RLCR_7_Le5HdTo@ */ /end MEASUREMENT
/begin MEASUREMENT SwcIn_RLCR_7.RLCR_7_Le5ObjBoxLen "" FLOAT32_IEEE autosar_swc_val_CM_RLCR_7_Le5ObjBoxLen_948_dt 0 0 -3.4E+38 3.4E+38 ECU_ADDRESS 0xfe4c9e3c /* @ECU_Address@SwcIn_RLCR_7.RLCR_7_Le5ObjBoxLen@ */ /end MEASUREMENT
/begin MEASUREMENT SwcIn_RLCR_7.RLCR_7_Le5ObjBoxWidth "" FLOAT32_IEEE autosar_swc_val_CM_RLCR_7_Le5ObjBoxWidth_948_dt 0 0 -3.4E+38 3.4E+38 ECU_ADDRESS 0xfe4c9e40 /* @ECU_Address@SwcIn_RLCR_7.RLCR_7_Le5ObjBoxWidth@ */ /end MEASUREMENT
/begin MEASUREMENT SwcIn_RLCR_7.RLCR_7_Le5ObjConf "" UBYTE autosar_swc_val_CM_RLCR_7_Le5ObjConf_948_dt 0 0 0 255 ECU_ADDRESS 0xfe4c9e62 /* @ECU_Address@SwcIn_RLCR_7.RLCR_7_Le5ObjConf@ */ /end MEASUREMENT
/begin MEASUREMENT SwcIn_RLCR_7.RLCR_7_Le5ObjCoordX "" FLOAT32_IEEE autosar_swc_val_CM_RLCR_7_Le5ObjCoordX_948_dt 0 0 -3.4E+38 3.4E+38 ECU_ADDRESS 0xfe4c9e50 /* @ECU_Address@SwcIn_RLCR_7.RLCR_7_Le5ObjCoordX@ */ /end MEASUREMENT
/begin MEASUREMENT SwcIn_RLCR_7.RLCR_7_Le5ObjCoordXDstStdDe "" FLOAT32_IEEE autosar_swc_val_CM_RLCR_7_Le5ObjCoordXDstStdDe_948_dt 0 0 -3.4E+38 3.4E+38 ECU_ADDRESS 0xfe4c9e68 /* @ECU_Address@SwcIn_RLCR_7.RLCR_7_Le5ObjCoordXDstStdDe@ */ /end MEASUREMENT
/begin MEASUREMENT SwcIn_RLCR_7.RLCR_7_Le5ObjCoordY "" FLOAT32_IEEE autosar_swc_val_CM_RLCR_7_Le5ObjCoordY_948_dt 0 0 -3.4E+38 3.4E+38 ECU_ADDRESS 0xfe4c9e4c /* @ECU_Address@SwcIn_RLCR_7.RLCR_7_Le5ObjCoordY@ */ /end MEASUREMENT
/begin MEASUREMENT SwcIn_RLCR_7.RLCR_7_Le5ObjCoordYDstStdDe "" FLOAT32_IEEE autosar_swc_val_CM_RLCR_7_Le5ObjCoordYDstStdDe_948_dt 0 0 -3.4E+38 3.4E+38 ECU_ADDRESS 0xfe4c9e6c /* @ECU_Address@SwcIn_RLCR_7.RLCR_7_Le5ObjCoordYDstStdDe@ */ /end MEASUREMENT
/begin MEASUREMENT SwcIn_RLCR_7.RLCR_7_Le5ObjID "" UBYTE autosar_swc_val_CM_RLCR_7_Le5ObjID_948_dt 0 0 0 255 ECU_ADDRESS 0xfe4c9e48 /* @ECU_Address@SwcIn_RLCR_7.RLCR_7_Le5ObjID@ */ /end MEASUREMENT
/begin MEASUREMENT SwcIn_RLCR_7.RLCR_7_Le5ObjMtnChartc "" UBYTE autosar_swc_val_CM_RLCR_7_Le5ObjMtnChartc_948_dt 0 0 0 255 ECU_ADDRESS 0xfe4c9e60 /* @ECU_Address@SwcIn_RLCR_7.RLCR_7_Le5ObjMtnChartc@ */ /end MEASUREMENT
/begin MEASUREMENT SwcIn_RLCR_7.RLCR_7_Le5ObjNrOffocst "" UBYTE autosar_swc_val_CM_RLCR_7_Le5ObjNrOffocst_948_dt 0 0 0 255 ECU_ADDRESS 0xfe4c9e63 /* @ECU_Address@SwcIn_RLCR_7.RLCR_7_Le5ObjNrOffocst@ */ /end MEASUREMENT
/begin MEASUREMENT SwcIn_RLCR_7.RLCR_7_Le5ObjTrackSt "" UBYTE autosar_swc_val_CM_RLCR_7_Le5ObjTrackSt_948_dt 0 0 0 255 ECU_ADDRESS 0xfe4c9e64 /* @ECU_Address@SwcIn_RLCR_7.RLCR_7_Le5ObjTrackSt@ */ /end MEASUREMENT
/begin MEASUREMENT SwcIn_RLCR_7.RLCR_7_Le5ObjTyp "" UBYTE autosar_swc_val_CM_RLCR_7_Le5ObjTyp_948_dt 0 0 0 255 ECU_ADDRESS 0xfe4c9e61 /* @ECU_Address@SwcIn_RLCR_7.RLCR_7_Le5ObjTyp@ */ /end MEASUREMENT
/begin MEASUREMENT SwcIn_RLCR_7.RLCR_7_Le5ObjXDirAV "" FLOAT32_IEEE autosar_swc_val_CM_RLCR_7_Le5ObjXDirAV_948_dt 0 0 -3.4E+38 3.4E+38 ECU_ADDRESS 0xfe4c9e54 /* @ECU_Address@SwcIn_RLCR_7.RLCR_7_Le5ObjXDirAV@ */ /end MEASUREMENT
/begin MEASUREMENT SwcIn_RLCR_7.RLCR_7_Le5ObjXDirV "" FLOAT32_IEEE autosar_swc_val_CM_RLCR_7_Le5ObjXDirV_948_dt 0 0 -3.4E+38 3.4E+38 ECU_ADDRESS 0xfe4c9e5c /* @ECU_Address@SwcIn_RLCR_7.RLCR_7_Le5ObjXDirV@ */ /end MEASUREMENT
/begin MEASUREMENT SwcIn_RLCR_7.RLCR_7_Le5ObjXDirVStdDe "" FLOAT32_IEEE autosar_swc_val_CM_RLCR_7_Le5ObjXDirVStdDe_948_dt 0 0 -3.4E+38 3.4E+38 ECU_ADDRESS 0xfe4c9e70 /* @ECU_Address@SwcIn_RLCR_7.RLCR_7_Le5ObjXDirVStdDe@ */ /end MEASUREMENT
/begin MEASUREMENT SwcIn_RLCR_7.RLCR_7_Le5ObjYDirV "" FLOAT32_IEEE autosar_swc_val_CM_RLCR_7_Le5ObjYDirV_948_dt 0 0 -3.4E+38 3.4E+38 ECU_ADDRESS 0xfe4c9e58 /* @ECU_Address@SwcIn_RLCR_7.RLCR_7_Le5ObjYDirV@ */ /end MEASUREMENT
/begin MEASUREMENT SwcIn_RLCR_7.RLCR_7_Le5ObjYDirVStdDe "" FLOAT32_IEEE autosar_swc_val_CM_RLCR_7_Le5ObjYDirVStdDe_948_dt 0 0 -3.4E+38 3.4E+38 ECU_ADDRESS 0xfe4c9e74 /* @ECU_Address@SwcIn_RLCR_7.RLCR_7_Le5ObjYDirVStdDe@ */ /end MEASUREMENT
/begin MEASUREMENT SwcIn_RLCR_7.RLCR_7_RollgCntr "" UBYTE autosar_swc_val_CM_RLCR_7_RollgCntr_948_dt 0 0 0 255 ECU_ADDRESS 0xfe4c9e3a /* @ECU_Address@SwcIn_RLCR_7.RLCR_7_RollgCntr@ */ /end MEASUREMENT
/begin MEASUREMENT SwcIn_RLCR_8.RLCR_8_CRC "" UWORD autosar_swc_val_CM_RLCR_8_CRC_953_dt 0 0 0 65535 ECU_ADDRESS 0xfe4cbab4 /* @ECU_Address@SwcIn_RLCR_8.RLCR_8_CRC@ */ /end MEASUREMENT
/begin MEASUREMENT SwcIn_RLCR_8.RLCR_8_RollgCntr "" UBYTE autosar_swc_val_CM_RLCR_8_RollgCntr_953_dt 0 0 0 255 ECU_ADDRESS 0xfe4cbab6 /* @ECU_Address@SwcIn_RLCR_8.RLCR_8_RollgCntr@ */ /end MEASUREMENT
/begin MEASUREMENT SwcIn_RLCR_8.RLCR_8_TiStampLaten "" UWORD autosar_swc_val_CM_RLCR_8_TiStampLaten_953_dt 0 0 0 65535 ECU_ADDRESS 0xfe4cbab8 /* @ECU_Address@SwcIn_RLCR_8.RLCR_8_TiStampLaten@ */ /end MEASUREMENT
/begin MEASUREMENT SwcIn_RRCR_1.RRCR_1_BSDWarn "" UBYTE autosar_swc_val_CM_RRCR_1_BSDWarn_1267_dt 0 0 0 255 ECU_ADDRESS 0xfe4cbabf /* @ECU_Address@SwcIn_RRCR_1.RRCR_1_BSDWarn@ */ /end MEASUREMENT
/begin MEASUREMENT SwcIn_RRCR_1.RRCR_1_BlkSts "" UBYTE autosar_swc_val_CM_RRCR_1_BlkSts_1267_dt 0 0 0 255 ECU_ADDRESS 0xfe4cbabe /* @ECU_Address@SwcIn_RRCR_1.RRCR_1_BlkSts@ */ /end MEASUREMENT
/begin MEASUREMENT SwcIn_RRCR_1.RRCR_1_CRC1 "" UBYTE autosar_swc_val_CM_RRCR_1_CRC1_1267_dt 0 0 0 255 ECU_ADDRESS 0xfe4cbaba /* @ECU_Address@SwcIn_RRCR_1.RRCR_1_CRC1@ */ /end MEASUREMENT
/begin MEASUREMENT SwcIn_RRCR_1.RRCR_1_DOWWarn "" UBYTE autosar_swc_val_CM_RRCR_1_DOWWarn_1267_dt 0 0 0 255 ECU_ADDRESS 0xfe4cbac0 /* @ECU_Address@SwcIn_RRCR_1.RRCR_1_DOWWarn@ */ /end MEASUREMENT
/begin MEASUREMENT SwcIn_RRCR_1.RRCR_1_DowLock "" UBYTE autosar_swc_val_CM_RRCR_1_DowLock_1267_dt 0 0 0 255 ECU_ADDRESS 0xfe4cbac1 /* @ECU_Address@SwcIn_RRCR_1.RRCR_1_DowLock@ */ /end MEASUREMENT
/begin MEASUREMENT SwcIn_RRCR_1.RRCR_1_ELK_CollisionFlagValid "" UBYTE autosar_swc_val_CM_RRCR_1_ELK_CollisionFlagValid_1267_dt 0 0 0 255 ECU_ADDRESS 0xfe4cbac3 /* @ECU_Address@SwcIn_RRCR_1.RRCR_1_ELK_CollisionFlagValid@ */ /end MEASUREMENT
/begin MEASUREMENT SwcIn_RRCR_1.RRCR_1_ELK_Collision_flag "" UBYTE autosar_swc_val_CM_RRCR_1_ELK_Collision_flag_1267_dt 0 0 0 255 ECU_ADDRESS 0xfe4cbac2 /* @ECU_Address@SwcIn_RRCR_1.RRCR_1_ELK_Collision_flag@ */ /end MEASUREMENT
/begin MEASUREMENT SwcIn_RRCR_1.RRCR_1_Resd1 "" UBYTE autosar_swc_val_CM_RRCR_1_Resd1_1267_dt 0 0 0 255 ECU_ADDRESS 0xfe4cbabc /* @ECU_Address@SwcIn_RRCR_1.RRCR_1_Resd1@ */ /end MEASUREMENT
/begin MEASUREMENT SwcIn_RRCR_1.RRCR_1_RollgCntr1 "" UBYTE autosar_swc_val_CM_RRCR_1_RollgCntr1_1267_dt 0 0 0 255 ECU_ADDRESS 0xfe4cbabb /* @ECU_Address@SwcIn_RRCR_1.RRCR_1_RollgCntr1@ */ /end MEASUREMENT
/begin MEASUREMENT SwcIn_RRCR_1.RRCR_1_SysSt "" UBYTE autosar_swc_val_CM_RRCR_1_SysSt_1267_dt 0 0 0 255 ECU_ADDRESS 0xfe4cbabd /* @ECU_Address@SwcIn_RRCR_1.RRCR_1_SysSt@ */ /end MEASUREMENT
/begin MEASUREMENT SwcIn_RRCR_3.RRCR_3_CRC "" UWORD autosar_swc_val_CM_RRCR_3_CRC_959_dt 0 0 0 65535 ECU_ADDRESS 0xfe4c9e78 /* @ECU_Address@SwcIn_RRCR_3.RRCR_3_CRC@ */ /end MEASUREMENT
/begin MEASUREMENT SwcIn_RRCR_3.RRCR_3_Ri1HdTo "" FLOAT32_IEEE autosar_swc_val_CM_RRCR_3_Ri1HdTo_959_dt 0 0 -3.4E+38 3.4E+38 ECU_ADDRESS 0xfe4c9e84 /* @ECU_Address@SwcIn_RRCR_3.RRCR_3_Ri1HdTo@ */ /end MEASUREMENT
/begin MEASUREMENT SwcIn_RRCR_3.RRCR_3_Ri1ObjBoxLen "" FLOAT32_IEEE autosar_swc_val_CM_RRCR_3_Ri1ObjBoxLen_959_dt 0 0 -3.4E+38 3.4E+38 ECU_ADDRESS 0xfe4c9e7c /* @ECU_Address@SwcIn_RRCR_3.RRCR_3_Ri1ObjBoxLen@ */ /end MEASUREMENT
/begin MEASUREMENT SwcIn_RRCR_3.RRCR_3_Ri1ObjBoxWidth "" FLOAT32_IEEE autosar_swc_val_CM_RRCR_3_Ri1ObjBoxWidth_959_dt 0 0 -3.4E+38 3.4E+38 ECU_ADDRESS 0xfe4c9e80 /* @ECU_Address@SwcIn_RRCR_3.RRCR_3_Ri1ObjBoxWidth@ */ /end MEASUREMENT
/begin MEASUREMENT SwcIn_RRCR_3.RRCR_3_Ri1ObjConf "" UBYTE autosar_swc_val_CM_RRCR_3_Ri1ObjConf_959_dt 0 0 0 255 ECU_ADDRESS 0xfe4c9ea2 /* @ECU_Address@SwcIn_RRCR_3.RRCR_3_Ri1ObjConf@ */ /end MEASUREMENT
/begin MEASUREMENT SwcIn_RRCR_3.RRCR_3_Ri1ObjCoordX "" FLOAT32_IEEE autosar_swc_val_CM_RRCR_3_Ri1ObjCoordX_959_dt 0 0 -3.4E+38 3.4E+38 ECU_ADDRESS 0xfe4c9e90 /* @ECU_Address@SwcIn_RRCR_3.RRCR_3_Ri1ObjCoordX@ */ /end MEASUREMENT
/begin MEASUREMENT SwcIn_RRCR_3.RRCR_3_Ri1ObjCoordXDstStdDe "" FLOAT32_IEEE autosar_swc_val_CM_RRCR_3_Ri1ObjCoordXDstStdDe_959_dt 0 0 -3.4E+38 3.4E+38 ECU_ADDRESS 0xfe4c9ea8 /* @ECU_Address@SwcIn_RRCR_3.RRCR_3_Ri1ObjCoordXDstStdDe@ */ /end MEASUREMENT
/begin MEASUREMENT SwcIn_RRCR_3.RRCR_3_Ri1ObjCoordY "" FLOAT32_IEEE autosar_swc_val_CM_RRCR_3_Ri1ObjCoordY_959_dt 0 0 -3.4E+38 3.4E+38 ECU_ADDRESS 0xfe4c9e8c /* @ECU_Address@SwcIn_RRCR_3.RRCR_3_Ri1ObjCoordY@ */ /end MEASUREMENT
/begin MEASUREMENT SwcIn_RRCR_3.RRCR_3_Ri1ObjCoordYDstStdDe "" FLOAT32_IEEE autosar_swc_val_CM_RRCR_3_Ri1ObjCoordYDstStdDe_959_dt 0 0 -3.4E+38 3.4E+38 ECU_ADDRESS 0xfe4c9eac /* @ECU_Address@SwcIn_RRCR_3.RRCR_3_Ri1ObjCoordYDstStdDe@ */ /end MEASUREMENT
/begin MEASUREMENT SwcIn_RRCR_3.RRCR_3_Ri1ObjID "" UBYTE autosar_swc_val_CM_RRCR_3_Ri1ObjID_959_dt 0 0 0 255 ECU_ADDRESS 0xfe4c9e88 /* @ECU_Address@SwcIn_RRCR_3.RRCR_3_Ri1ObjID@ */ /end MEASUREMENT
/begin MEASUREMENT SwcIn_RRCR_3.RRCR_3_Ri1ObjMtnChartc "" UBYTE autosar_swc_val_CM_RRCR_3_Ri1ObjMtnChartc_959_dt 0 0 0 255 ECU_ADDRESS 0xfe4c9ea0 /* @ECU_Address@SwcIn_RRCR_3.RRCR_3_Ri1ObjMtnChartc@ */ /end MEASUREMENT
/begin MEASUREMENT SwcIn_RRCR_3.RRCR_3_Ri1ObjNrOffocst "" UBYTE autosar_swc_val_CM_RRCR_3_Ri1ObjNrOffocst_959_dt 0 0 0 255 ECU_ADDRESS 0xfe4c9ea3 /* @ECU_Address@SwcIn_RRCR_3.RRCR_3_Ri1ObjNrOffocst@ */ /end MEASUREMENT
/begin MEASUREMENT SwcIn_RRCR_3.RRCR_3_Ri1ObjTrackSt "" UBYTE autosar_swc_val_CM_RRCR_3_Ri1ObjTrackSt_959_dt 0 0 0 255 ECU_ADDRESS 0xfe4c9ea4 /* @ECU_Address@SwcIn_RRCR_3.RRCR_3_Ri1ObjTrackSt@ */ /end MEASUREMENT
/begin MEASUREMENT SwcIn_RRCR_3.RRCR_3_Ri1ObjTyp "" UBYTE autosar_swc_val_CM_RRCR_3_Ri1ObjTyp_959_dt 0 0 0 255 ECU_ADDRESS 0xfe4c9ea1 /* @ECU_Address@SwcIn_RRCR_3.RRCR_3_Ri1ObjTyp@ */ /end MEASUREMENT
/begin MEASUREMENT SwcIn_RRCR_3.RRCR_3_Ri1ObjXDirAV "" FLOAT32_IEEE autosar_swc_val_CM_RRCR_3_Ri1ObjXDirAV_959_dt 0 0 -3.4E+38 3.4E+38 ECU_ADDRESS 0xfe4c9e94 /* @ECU_Address@SwcIn_RRCR_3.RRCR_3_Ri1ObjXDirAV@ */ /end MEASUREMENT
/begin MEASUREMENT SwcIn_RRCR_3.RRCR_3_Ri1ObjXDirV "" FLOAT32_IEEE autosar_swc_val_CM_RRCR_3_Ri1ObjXDirV_959_dt 0 0 -3.4E+38 3.4E+38 ECU_ADDRESS 0xfe4c9e9c /* @ECU_Address@SwcIn_RRCR_3.RRCR_3_Ri1ObjXDirV@ */ /end MEASUREMENT
/begin MEASUREMENT SwcIn_RRCR_3.RRCR_3_Ri1ObjXDirVStdDe "" FLOAT32_IEEE autosar_swc_val_CM_RRCR_3_Ri1ObjXDirVStdDe_959_dt 0 0 -3.4E+38 3.4E+38 ECU_ADDRESS 0xfe4c9eb0 /* @ECU_Address@SwcIn_RRCR_3.RRCR_3_Ri1ObjXDirVStdDe@ */ /end MEASUREMENT
/begin MEASUREMENT SwcIn_RRCR_3.RRCR_3_Ri1ObjYDirV "" FLOAT32_IEEE autosar_swc_val_CM_RRCR_3_Ri1ObjYDirV_959_dt 0 0 -3.4E+38 3.4E+38 ECU_ADDRESS 0xfe4c9e98 /* @ECU_Address@SwcIn_RRCR_3.RRCR_3_Ri1ObjYDirV@ */ /end MEASUREMENT
/begin MEASUREMENT SwcIn_RRCR_3.RRCR_3_Ri1ObjYDirVStdDe "" FLOAT32_IEEE autosar_swc_val_CM_RRCR_3_Ri1ObjYDirVStdDe_959_dt 0 0 -3.4E+38 3.4E+38 ECU_ADDRESS 0xfe4c9eb4 /* @ECU_Address@SwcIn_RRCR_3.RRCR_3_Ri1ObjYDirVStdDe@ */ /end MEASUREMENT
/begin MEASUREMENT SwcIn_RRCR_3.RRCR_3_RollgCntr "" UBYTE autosar_swc_val_CM_RRCR_3_RollgCntr_959_dt 0 0 0 255 ECU_ADDRESS 0xfe4c9e7a /* @ECU_Address@SwcIn_RRCR_3.RRCR_3_RollgCntr@ */ /end MEASUREMENT
/begin MEASUREMENT SwcIn_RRCR_4.RRCR_4_CRC "" UWORD autosar_swc_val_CM_RRCR_4_CRC_969_dt 0 0 0 65535 ECU_ADDRESS 0xfe4c9eb8 /* @ECU_Address@SwcIn_RRCR_4.RRCR_4_CRC@ */ /end MEASUREMENT
/begin MEASUREMENT SwcIn_RRCR_4.RRCR_4_Ri2HdTo "" FLOAT32_IEEE autosar_swc_val_CM_RRCR_4_Ri2HdTo_969_dt 0 0 -3.4E+38 3.4E+38 ECU_ADDRESS 0xfe4c9ec4 /* @ECU_Address@SwcIn_RRCR_4.RRCR_4_Ri2HdTo@ */ /end MEASUREMENT
/begin MEASUREMENT SwcIn_RRCR_4.RRCR_4_Ri2ObjBoxLen "" FLOAT32_IEEE autosar_swc_val_CM_RRCR_4_Ri2ObjBoxLen_969_dt 0 0 -3.4E+38 3.4E+38 ECU_ADDRESS 0xfe4c9ebc /* @ECU_Address@SwcIn_RRCR_4.RRCR_4_Ri2ObjBoxLen@ */ /end MEASUREMENT
/begin MEASUREMENT SwcIn_RRCR_4.RRCR_4_Ri2ObjBoxWidth "" FLOAT32_IEEE autosar_swc_val_CM_RRCR_4_Ri2ObjBoxWidth_969_dt 0 0 -3.4E+38 3.4E+38 ECU_ADDRESS 0xfe4c9ec0 /* @ECU_Address@SwcIn_RRCR_4.RRCR_4_Ri2ObjBoxWidth@ */ /end MEASUREMENT
/begin MEASUREMENT SwcIn_RRCR_4.RRCR_4_Ri2ObjConf "" UBYTE autosar_swc_val_CM_RRCR_4_Ri2ObjConf_969_dt 0 0 0 255 ECU_ADDRESS 0xfe4c9ee2 /* @ECU_Address@SwcIn_RRCR_4.RRCR_4_Ri2ObjConf@ */ /end MEASUREMENT
/begin MEASUREMENT SwcIn_RRCR_4.RRCR_4_Ri2ObjCoordX "" FLOAT32_IEEE autosar_swc_val_CM_RRCR_4_Ri2ObjCoordX_969_dt 0 0 -3.4E+38 3.4E+38 ECU_ADDRESS 0xfe4c9ed0 /* @ECU_Address@SwcIn_RRCR_4.RRCR_4_Ri2ObjCoordX@ */ /end MEASUREMENT
/begin MEASUREMENT SwcIn_RRCR_4.RRCR_4_Ri2ObjCoordXDstStdDe "" FLOAT32_IEEE autosar_swc_val_CM_RRCR_4_Ri2ObjCoordXDstStdDe_969_dt 0 0 -3.4E+38 3.4E+38 ECU_ADDRESS 0xfe4c9ee8 /* @ECU_Address@SwcIn_RRCR_4.RRCR_4_Ri2ObjCoordXDstStdDe@ */ /end MEASUREMENT
/begin MEASUREMENT SwcIn_RRCR_4.RRCR_4_Ri2ObjCoordY "" FLOAT32_IEEE autosar_swc_val_CM_RRCR_4_Ri2ObjCoordY_969_dt 0 0 -3.4E+38 3.4E+38 ECU_ADDRESS 0xfe4c9ecc /* @ECU_Address@SwcIn_RRCR_4.RRCR_4_Ri2ObjCoordY@ */ /end MEASUREMENT
/begin MEASUREMENT SwcIn_RRCR_4.RRCR_4_Ri2ObjCoordYDstStdDe "" FLOAT32_IEEE autosar_swc_val_CM_RRCR_4_Ri2ObjCoordYDstStdDe_969_dt 0 0 -3.4E+38 3.4E+38 ECU_ADDRESS 0xfe4c9eec /* @ECU_Address@SwcIn_RRCR_4.RRCR_4_Ri2ObjCoordYDstStdDe@ */ /end MEASUREMENT
/begin MEASUREMENT SwcIn_RRCR_4.RRCR_4_Ri2ObjID "" UBYTE autosar_swc_val_CM_RRCR_4_Ri2ObjID_969_dt 0 0 0 255 ECU_ADDRESS 0xfe4c9ec8 /* @ECU_Address@SwcIn_RRCR_4.RRCR_4_Ri2ObjID@ */ /end MEASUREMENT
/begin MEASUREMENT SwcIn_RRCR_4.RRCR_4_Ri2ObjMtnChartc "" UBYTE autosar_swc_val_CM_RRCR_4_Ri2ObjMtnChartc_969_dt 0 0 0 255 ECU_ADDRESS 0xfe4c9ee0 /* @ECU_Address@SwcIn_RRCR_4.RRCR_4_Ri2ObjMtnChartc@ */ /end MEASUREMENT
/begin MEASUREMENT SwcIn_RRCR_4.RRCR_4_Ri2ObjNrOffocst "" UBYTE autosar_swc_val_CM_RRCR_4_Ri2ObjNrOffocst_969_dt 0 0 0 255 ECU_ADDRESS 0xfe4c9ee3 /* @ECU_Address@SwcIn_RRCR_4.RRCR_4_Ri2ObjNrOffocst@ */ /end MEASUREMENT
/begin MEASUREMENT SwcIn_RRCR_4.RRCR_4_Ri2ObjTrackSt "" UBYTE autosar_swc_val_CM_RRCR_4_Ri2ObjTrackSt_969_dt 0 0 0 255 ECU_ADDRESS 0xfe4c9ee4 /* @ECU_Address@SwcIn_RRCR_4.RRCR_4_Ri2ObjTrackSt@ */ /end MEASUREMENT
/begin MEASUREMENT SwcIn_RRCR_4.RRCR_4_Ri2ObjTyp "" UBYTE autosar_swc_val_CM_RRCR_4_Ri2ObjTyp_969_dt 0 0 0 255 ECU_ADDRESS 0xfe4c9ee1 /* @ECU_Address@SwcIn_RRCR_4.RRCR_4_Ri2ObjTyp@ */ /end MEASUREMENT
/begin MEASUREMENT SwcIn_RRCR_4.RRCR_4_Ri2ObjXDirAV "" FLOAT32_IEEE autosar_swc_val_CM_RRCR_4_Ri2ObjXDirAV_969_dt 0 0 -3.4E+38 3.4E+38 ECU_ADDRESS 0xfe4c9ed4 /* @ECU_Address@SwcIn_RRCR_4.RRCR_4_Ri2ObjXDirAV@ */ /end MEASUREMENT
/begin MEASUREMENT SwcIn_RRCR_4.RRCR_4_Ri2ObjXDirV "" FLOAT32_IEEE autosar_swc_val_CM_RRCR_4_Ri2ObjXDirV_969_dt 0 0 -3.4E+38 3.4E+38 ECU_ADDRESS 0xfe4c9edc /* @ECU_Address@SwcIn_RRCR_4.RRCR_4_Ri2ObjXDirV@ */ /end MEASUREMENT
/begin MEASUREMENT SwcIn_RRCR_4.RRCR_4_Ri2ObjXDirVStdDe "" FLOAT32_IEEE autosar_swc_val_CM_RRCR_4_Ri2ObjXDirVStdDe_969_dt 0 0 -3.4E+38 3.4E+38 ECU_ADDRESS 0xfe4c9ef0 /* @ECU_Address@SwcIn_RRCR_4.RRCR_4_Ri2ObjXDirVStdDe@ */ /end MEASUREMENT
/begin MEASUREMENT SwcIn_RRCR_4.RRCR_4_Ri2ObjYDirV "" FLOAT32_IEEE autosar_swc_val_CM_RRCR_4_Ri2ObjYDirV_969_dt 0 0 -3.4E+38 3.4E+38 ECU_ADDRESS 0xfe4c9ed8 /* @ECU_Address@SwcIn_RRCR_4.RRCR_4_Ri2ObjYDirV@ */ /end MEASUREMENT
/begin MEASUREMENT SwcIn_RRCR_4.RRCR_4_Ri2ObjYDirVStdDe "" FLOAT32_IEEE autosar_swc_val_CM_RRCR_4_Ri2ObjYDirVStdDe_969_dt 0 0 -3.4E+38 3.4E+38 ECU_ADDRESS 0xfe4c9ef4 /* @ECU_Address@SwcIn_RRCR_4.RRCR_4_Ri2ObjYDirVStdDe@ */ /end MEASUREMENT
/begin MEASUREMENT SwcIn_RRCR_4.RRCR_4_RollgCntr "" UBYTE autosar_swc_val_CM_RRCR_4_RollgCntr_969_dt 0 0 0 255 ECU_ADDRESS 0xfe4c9eba /* @ECU_Address@SwcIn_RRCR_4.RRCR_4_RollgCntr@ */ /end MEASUREMENT
/begin MEASUREMENT SwcIn_RRCR_5.RRCR_5_CRC "" UWORD autosar_swc_val_CM_RRCR_5_CRC_976_dt 0 0 0 65535 ECU_ADDRESS 0xfe4c9ef8 /* @ECU_Address@SwcIn_RRCR_5.RRCR_5_CRC@ */ /end MEASUREMENT
/begin MEASUREMENT SwcIn_RRCR_5.RRCR_5_Ri3HdTo "" FLOAT32_IEEE autosar_swc_val_CM_RRCR_5_Ri3HdTo_976_dt 0 0 -3.4E+38 3.4E+38 ECU_ADDRESS 0xfe4c9f04 /* @ECU_Address@SwcIn_RRCR_5.RRCR_5_Ri3HdTo@ */ /end MEASUREMENT
/begin MEASUREMENT SwcIn_RRCR_5.RRCR_5_Ri3ObjBoxLen "" FLOAT32_IEEE autosar_swc_val_CM_RRCR_5_Ri3ObjBoxLen_976_dt 0 0 -3.4E+38 3.4E+38 ECU_ADDRESS 0xfe4c9efc /* @ECU_Address@SwcIn_RRCR_5.RRCR_5_Ri3ObjBoxLen@ */ /end MEASUREMENT
/begin MEASUREMENT SwcIn_RRCR_5.RRCR_5_Ri3ObjBoxWidth "" FLOAT32_IEEE autosar_swc_val_CM_RRCR_5_Ri3ObjBoxWidth_976_dt 0 0 -3.4E+38 3.4E+38 ECU_ADDRESS 0xfe4c9f00 /* @ECU_Address@SwcIn_RRCR_5.RRCR_5_Ri3ObjBoxWidth@ */ /end MEASUREMENT
/begin MEASUREMENT SwcIn_RRCR_5.RRCR_5_Ri3ObjConf "" UBYTE autosar_swc_val_CM_RRCR_5_Ri3ObjConf_976_dt 0 0 0 255 ECU_ADDRESS 0xfe4c9f22 /* @ECU_Address@SwcIn_RRCR_5.RRCR_5_Ri3ObjConf@ */ /end MEASUREMENT
/begin MEASUREMENT SwcIn_RRCR_5.RRCR_5_Ri3ObjCoordX "" FLOAT32_IEEE autosar_swc_val_CM_RRCR_5_Ri3ObjCoordX_976_dt 0 0 -3.4E+38 3.4E+38 ECU_ADDRESS 0xfe4c9f10 /* @ECU_Address@SwcIn_RRCR_5.RRCR_5_Ri3ObjCoordX@ */ /end MEASUREMENT
/begin MEASUREMENT SwcIn_RRCR_5.RRCR_5_Ri3ObjCoordXDstStdDe "" FLOAT32_IEEE autosar_swc_val_CM_RRCR_5_Ri3ObjCoordXDstStdDe_976_dt 0 0 -3.4E+38 3.4E+38 ECU_ADDRESS 0xfe4c9f28 /* @ECU_Address@SwcIn_RRCR_5.RRCR_5_Ri3ObjCoordXDstStdDe@ */ /end MEASUREMENT
/begin MEASUREMENT SwcIn_RRCR_5.RRCR_5_Ri3ObjCoordY "" FLOAT32_IEEE autosar_swc_val_CM_RRCR_5_Ri3ObjCoordY_976_dt 0 0 -3.4E+38 3.4E+38 ECU_ADDRESS 0xfe4c9f0c /* @ECU_Address@SwcIn_RRCR_5.RRCR_5_Ri3ObjCoordY@ */ /end MEASUREMENT
/begin MEASUREMENT SwcIn_RRCR_5.RRCR_5_Ri3ObjCoordYDstStdDe "" FLOAT32_IEEE autosar_swc_val_CM_RRCR_5_Ri3ObjCoordYDstStdDe_976_dt 0 0 -3.4E+38 3.4E+38 ECU_ADDRESS 0xfe4c9f2c /* @ECU_Address@SwcIn_RRCR_5.RRCR_5_Ri3ObjCoordYDstStdDe@ */ /end MEASUREMENT
/begin MEASUREMENT SwcIn_RRCR_5.RRCR_5_Ri3ObjID "" UBYTE autosar_swc_val_CM_RRCR_5_Ri3ObjID_976_dt 0 0 0 255 ECU_ADDRESS 0xfe4c9f08 /* @ECU_Address@SwcIn_RRCR_5.RRCR_5_Ri3ObjID@ */ /end MEASUREMENT
/begin MEASUREMENT SwcIn_RRCR_5.RRCR_5_Ri3ObjMtnChartc "" UBYTE autosar_swc_val_CM_RRCR_5_Ri3ObjMtnChartc_976_dt 0 0 0 255 ECU_ADDRESS 0xfe4c9f20 /* @ECU_Address@SwcIn_RRCR_5.RRCR_5_Ri3ObjMtnChartc@ */ /end MEASUREMENT
/begin MEASUREMENT SwcIn_RRCR_5.RRCR_5_Ri3ObjNrOffocst "" UBYTE autosar_swc_val_CM_RRCR_5_Ri3ObjNrOffocst_976_dt 0 0 0 255 ECU_ADDRESS 0xfe4c9f23 /* @ECU_Address@SwcIn_RRCR_5.RRCR_5_Ri3ObjNrOffocst@ */ /end MEASUREMENT
/begin MEASUREMENT SwcIn_RRCR_5.RRCR_5_Ri3ObjTrackSt "" UBYTE autosar_swc_val_CM_RRCR_5_Ri3ObjTrackSt_976_dt 0 0 0 255 ECU_ADDRESS 0xfe4c9f24 /* @ECU_Address@SwcIn_RRCR_5.RRCR_5_Ri3ObjTrackSt@ */ /end MEASUREMENT
/begin MEASUREMENT SwcIn_RRCR_5.RRCR_5_Ri3ObjTyp "" UBYTE autosar_swc_val_CM_RRCR_5_Ri3ObjTyp_976_dt 0 0 0 255 ECU_ADDRESS 0xfe4c9f21 /* @ECU_Address@SwcIn_RRCR_5.RRCR_5_Ri3ObjTyp@ */ /end MEASUREMENT
/begin MEASUREMENT SwcIn_RRCR_5.RRCR_5_Ri3ObjXDirAV "" FLOAT32_IEEE autosar_swc_val_CM_RRCR_5_Ri3ObjXDirAV_976_dt 0 0 -3.4E+38 3.4E+38 ECU_ADDRESS 0xfe4c9f14 /* @ECU_Address@SwcIn_RRCR_5.RRCR_5_Ri3ObjXDirAV@ */ /end MEASUREMENT
/begin MEASUREMENT SwcIn_RRCR_5.RRCR_5_Ri3ObjXDirV "" FLOAT32_IEEE autosar_swc_val_CM_RRCR_5_Ri3ObjXDirV_976_dt 0 0 -3.4E+38 3.4E+38 ECU_ADDRESS 0xfe4c9f1c /* @ECU_Address@SwcIn_RRCR_5.RRCR_5_Ri3ObjXDirV@ */ /end MEASUREMENT
/begin MEASUREMENT SwcIn_RRCR_5.RRCR_5_Ri3ObjXDirVStdDe "" FLOAT32_IEEE autosar_swc_val_CM_RRCR_5_Ri3ObjXDirVStdDe_976_dt 0 0 -3.4E+38 3.4E+38 ECU_ADDRESS 0xfe4c9f30 /* @ECU_Address@SwcIn_RRCR_5.RRCR_5_Ri3ObjXDirVStdDe@ */ /end MEASUREMENT
/begin MEASUREMENT SwcIn_RRCR_5.RRCR_5_Ri3ObjYDirV "" FLOAT32_IEEE autosar_swc_val_CM_RRCR_5_Ri3ObjYDirV_976_dt 0 0 -3.4E+38 3.4E+38 ECU_ADDRESS 0xfe4c9f18 /* @ECU_Address@SwcIn_RRCR_5.RRCR_5_Ri3ObjYDirV@ */ /end MEASUREMENT
/begin MEASUREMENT SwcIn_RRCR_5.RRCR_5_Ri3ObjYDirVStdDe "" FLOAT32_IEEE autosar_swc_val_CM_RRCR_5_Ri3ObjYDirVStdDe_976_dt 0 0 -3.4E+38 3.4E+38 ECU_ADDRESS 0xfe4c9f34 /* @ECU_Address@SwcIn_RRCR_5.RRCR_5_Ri3ObjYDirVStdDe@ */ /end MEASUREMENT
/begin MEASUREMENT SwcIn_RRCR_5.RRCR_5_RollgCntr "" UBYTE autosar_swc_val_CM_RRCR_5_RollgCntr_976_dt 0 0 0 255 ECU_ADDRESS 0xfe4c9efa /* @ECU_Address@SwcIn_RRCR_5.RRCR_5_RollgCntr@ */ /end MEASUREMENT
/begin MEASUREMENT SwcIn_RRCR_6.RRCR_6_CRC "" UWORD autosar_swc_val_CM_RRCR_6_CRC_984_dt 0 0 0 65535 ECU_ADDRESS 0xfe4c9f38 /* @ECU_Address@SwcIn_RRCR_6.RRCR_6_CRC@ */ /end MEASUREMENT
/begin MEASUREMENT SwcIn_RRCR_6.RRCR_6_Ri4HdTo "" FLOAT32_IEEE autosar_swc_val_CM_RRCR_6_Ri4HdTo_984_dt 0 0 -3.4E+38 3.4E+38 ECU_ADDRESS 0xfe4c9f44 /* @ECU_Address@SwcIn_RRCR_6.RRCR_6_Ri4HdTo@ */ /end MEASUREMENT
/begin MEASUREMENT SwcIn_RRCR_6.RRCR_6_Ri4ObjBoxLen "" FLOAT32_IEEE autosar_swc_val_CM_RRCR_6_Ri4ObjBoxLen_984_dt 0 0 -3.4E+38 3.4E+38 ECU_ADDRESS 0xfe4c9f3c /* @ECU_Address@SwcIn_RRCR_6.RRCR_6_Ri4ObjBoxLen@ */ /end MEASUREMENT
/begin MEASUREMENT SwcIn_RRCR_6.RRCR_6_Ri4ObjBoxWidth "" FLOAT32_IEEE autosar_swc_val_CM_RRCR_6_Ri4ObjBoxWidth_984_dt 0 0 -3.4E+38 3.4E+38 ECU_ADDRESS 0xfe4c9f40 /* @ECU_Address@SwcIn_RRCR_6.RRCR_6_Ri4ObjBoxWidth@ */ /end MEASUREMENT
/begin MEASUREMENT SwcIn_RRCR_6.RRCR_6_Ri4ObjConf "" UBYTE autosar_swc_val_CM_RRCR_6_Ri4ObjConf_984_dt 0 0 0 255 ECU_ADDRESS 0xfe4c9f62 /* @ECU_Address@SwcIn_RRCR_6.RRCR_6_Ri4ObjConf@ */ /end MEASUREMENT
/begin MEASUREMENT SwcIn_RRCR_6.RRCR_6_Ri4ObjCoordX "" FLOAT32_IEEE autosar_swc_val_CM_RRCR_6_Ri4ObjCoordX_984_dt 0 0 -3.4E+38 3.4E+38 ECU_ADDRESS 0xfe4c9f50 /* @ECU_Address@SwcIn_RRCR_6.RRCR_6_Ri4ObjCoordX@ */ /end MEASUREMENT
/begin MEASUREMENT SwcIn_RRCR_6.RRCR_6_Ri4ObjCoordXDstStdDe "" FLOAT32_IEEE autosar_swc_val_CM_RRCR_6_Ri4ObjCoordXDstStdDe_984_dt 0 0 -3.4E+38 3.4E+38 ECU_ADDRESS 0xfe4c9f68 /* @ECU_Address@SwcIn_RRCR_6.RRCR_6_Ri4ObjCoordXDstStdDe@ */ /end MEASUREMENT
/begin MEASUREMENT SwcIn_RRCR_6.RRCR_6_Ri4ObjCoordY "" FLOAT32_IEEE autosar_swc_val_CM_RRCR_6_Ri4ObjCoordY_984_dt 0 0 -3.4E+38 3.4E+38 ECU_ADDRESS 0xfe4c9f4c /* @ECU_Address@SwcIn_RRCR_6.RRCR_6_Ri4ObjCoordY@ */ /end MEASUREMENT
/begin MEASUREMENT SwcIn_RRCR_6.RRCR_6_Ri4ObjCoordYDstStdDe "" FLOAT32_IEEE autosar_swc_val_CM_RRCR_6_Ri4ObjCoordYDstStdDe_984_dt 0 0 -3.4E+38 3.4E+38 ECU_ADDRESS 0xfe4c9f6c /* @ECU_Address@SwcIn_RRCR_6.RRCR_6_Ri4ObjCoordYDstStdDe@ */ /end MEASUREMENT
/begin MEASUREMENT SwcIn_RRCR_6.RRCR_6_Ri4ObjID "" UBYTE autosar_swc_val_CM_RRCR_6_Ri4ObjID_984_dt 0 0 0 255 ECU_ADDRESS 0xfe4c9f48 /* @ECU_Address@SwcIn_RRCR_6.RRCR_6_Ri4ObjID@ */ /end MEASUREMENT
/begin MEASUREMENT SwcIn_RRCR_6.RRCR_6_Ri4ObjMtnChartc "" UBYTE autosar_swc_val_CM_RRCR_6_Ri4ObjMtnChartc_984_dt 0 0 0 255 ECU_ADDRESS 0xfe4c9f60 /* @ECU_Address@SwcIn_RRCR_6.RRCR_6_Ri4ObjMtnChartc@ */ /end MEASUREMENT
/begin MEASUREMENT SwcIn_RRCR_6.RRCR_6_Ri4ObjNrOffocst "" UBYTE autosar_swc_val_CM_RRCR_6_Ri4ObjNrOffocst_984_dt 0 0 0 255 ECU_ADDRESS 0xfe4c9f63 /* @ECU_Address@SwcIn_RRCR_6.RRCR_6_Ri4ObjNrOffocst@ */ /end MEASUREMENT
/begin MEASUREMENT SwcIn_RRCR_6.RRCR_6_Ri4ObjTrackSt "" UBYTE autosar_swc_val_CM_RRCR_6_Ri4ObjTrackSt_984_dt 0 0 0 255 ECU_ADDRESS 0xfe4c9f64 /* @ECU_Address@SwcIn_RRCR_6.RRCR_6_Ri4ObjTrackSt@ */ /end MEASUREMENT
/begin MEASUREMENT SwcIn_RRCR_6.RRCR_6_Ri4ObjTyp "" UBYTE autosar_swc_val_CM_RRCR_6_Ri4ObjTyp_984_dt 0 0 0 255 ECU_ADDRESS 0xfe4c9f61 /* @ECU_Address@SwcIn_RRCR_6.RRCR_6_Ri4ObjTyp@ */ /end MEASUREMENT
/begin MEASUREMENT SwcIn_RRCR_6.RRCR_6_Ri4ObjXDirAV "" FLOAT32_IEEE autosar_swc_val_CM_RRCR_6_Ri4ObjXDirAV_984_dt 0 0 -3.4E+38 3.4E+38 ECU_ADDRESS 0xfe4c9f54 /* @ECU_Address@SwcIn_RRCR_6.RRCR_6_Ri4ObjXDirAV@ */ /end MEASUREMENT
/begin MEASUREMENT SwcIn_RRCR_6.RRCR_6_Ri4ObjXDirV "" FLOAT32_IEEE autosar_swc_val_CM_RRCR_6_Ri4ObjXDirV_984_dt 0 0 -3.4E+38 3.4E+38 ECU_ADDRESS 0xfe4c9f5c /* @ECU_Address@SwcIn_RRCR_6.RRCR_6_Ri4ObjXDirV@ */ /end MEASUREMENT
/begin MEASUREMENT SwcIn_RRCR_6.RRCR_6_Ri4ObjXDirVStdDe "" FLOAT32_IEEE autosar_swc_val_CM_RRCR_6_Ri4ObjXDirVStdDe_984_dt 0 0 -3.4E+38 3.4E+38 ECU_ADDRESS 0xfe4c9f70 /* @ECU_Address@SwcIn_RRCR_6.RRCR_6_Ri4ObjXDirVStdDe@ */ /end MEASUREMENT
/begin MEASUREMENT SwcIn_RRCR_6.RRCR_6_Ri4ObjYDirV "" FLOAT32_IEEE autosar_swc_val_CM_RRCR_6_Ri4ObjYDirV_984_dt 0 0 -3.4E+38 3.4E+38 ECU_ADDRESS 0xfe4c9f58 /* @ECU_Address@SwcIn_RRCR_6.RRCR_6_Ri4ObjYDirV@ */ /end MEASUREMENT
/begin MEASUREMENT SwcIn_RRCR_6.RRCR_6_Ri4ObjYDirVStdDe "" FLOAT32_IEEE autosar_swc_val_CM_RRCR_6_Ri4ObjYDirVStdDe_984_dt 0 0 -3.4E+38 3.4E+38 ECU_ADDRESS 0xfe4c9f74 /* @ECU_Address@SwcIn_RRCR_6.RRCR_6_Ri4ObjYDirVStdDe@ */ /end MEASUREMENT
/begin MEASUREMENT SwcIn_RRCR_6.RRCR_6_RollgCntr "" UBYTE autosar_swc_val_CM_RRCR_6_RollgCntr_984_dt 0 0 0 255 ECU_ADDRESS 0xfe4c9f3a /* @ECU_Address@SwcIn_RRCR_6.RRCR_6_RollgCntr@ */ /end MEASUREMENT
/begin MEASUREMENT SwcIn_RRCR_7.RRCR_7_CRC "" UWORD autosar_swc_val_CM_RRCR_7_CRC_986_dt 0 0 0 65535 ECU_ADDRESS 0xfe4c9f78 /* @ECU_Address@SwcIn_RRCR_7.RRCR_7_CRC@ */ /end MEASUREMENT
/begin MEASUREMENT SwcIn_RRCR_7.RRCR_7_Ri5HdTo "" FLOAT32_IEEE autosar_swc_val_CM_RRCR_7_Ri5HdTo_986_dt 0 0 -3.4E+38 3.4E+38 ECU_ADDRESS 0xfe4c9f84 /* @ECU_Address@SwcIn_RRCR_7.RRCR_7_Ri5HdTo@ */ /end MEASUREMENT
/begin MEASUREMENT SwcIn_RRCR_7.RRCR_7_Ri5ObjBoxLen "" FLOAT32_IEEE autosar_swc_val_CM_RRCR_7_Ri5ObjBoxLen_986_dt 0 0 -3.4E+38 3.4E+38 ECU_ADDRESS 0xfe4c9f7c /* @ECU_Address@SwcIn_RRCR_7.RRCR_7_Ri5ObjBoxLen@ */ /end MEASUREMENT
/begin MEASUREMENT SwcIn_RRCR_7.RRCR_7_Ri5ObjBoxWidth "" FLOAT32_IEEE autosar_swc_val_CM_RRCR_7_Ri5ObjBoxWidth_986_dt 0 0 -3.4E+38 3.4E+38 ECU_ADDRESS 0xfe4c9f80 /* @ECU_Address@SwcIn_RRCR_7.RRCR_7_Ri5ObjBoxWidth@ */ /end MEASUREMENT
/begin MEASUREMENT SwcIn_RRCR_7.RRCR_7_Ri5ObjConf "" UBYTE autosar_swc_val_CM_RRCR_7_Ri5ObjConf_986_dt 0 0 0 255 ECU_ADDRESS 0xfe4c9fa2 /* @ECU_Address@SwcIn_RRCR_7.RRCR_7_Ri5ObjConf@ */ /end MEASUREMENT
/begin MEASUREMENT SwcIn_RRCR_7.RRCR_7_Ri5ObjCoordX "" FLOAT32_IEEE autosar_swc_val_CM_RRCR_7_Ri5ObjCoordX_986_dt 0 0 -3.4E+38 3.4E+38 ECU_ADDRESS 0xfe4c9f90 /* @ECU_Address@SwcIn_RRCR_7.RRCR_7_Ri5ObjCoordX@ */ /end MEASUREMENT
/begin MEASUREMENT SwcIn_RRCR_7.RRCR_7_Ri5ObjCoordXDstStdDe "" FLOAT32_IEEE autosar_swc_val_CM_RRCR_7_Ri5ObjCoordXDstStdDe_986_dt 0 0 -3.4E+38 3.4E+38 ECU_ADDRESS 0xfe4c9fa8 /* @ECU_Address@SwcIn_RRCR_7.RRCR_7_Ri5ObjCoordXDstStdDe@ */ /end MEASUREMENT
/begin MEASUREMENT SwcIn_RRCR_7.RRCR_7_Ri5ObjCoordY "" FLOAT32_IEEE autosar_swc_val_CM_RRCR_7_Ri5ObjCoordY_986_dt 0 0 -3.4E+38 3.4E+38 ECU_ADDRESS 0xfe4c9f8c /* @ECU_Address@SwcIn_RRCR_7.RRCR_7_Ri5ObjCoordY@ */ /end MEASUREMENT
/begin MEASUREMENT SwcIn_RRCR_7.RRCR_7_Ri5ObjCoordYDstStdDe "" FLOAT32_IEEE autosar_swc_val_CM_RRCR_7_Ri5ObjCoordYDstStdDe_986_dt 0 0 -3.4E+38 3.4E+38 ECU_ADDRESS 0xfe4c9fac /* @ECU_Address@SwcIn_RRCR_7.RRCR_7_Ri5ObjCoordYDstStdDe@ */ /end MEASUREMENT
/begin MEASUREMENT SwcIn_RRCR_7.RRCR_7_Ri5ObjID "" UBYTE autosar_swc_val_CM_RRCR_7_Ri5ObjID_986_dt 0 0 0 255 ECU_ADDRESS 0xfe4c9f88 /* @ECU_Address@SwcIn_RRCR_7.RRCR_7_Ri5ObjID@ */ /end MEASUREMENT
/begin MEASUREMENT SwcIn_RRCR_7.RRCR_7_Ri5ObjMtnChartc "" UBYTE autosar_swc_val_CM_RRCR_7_Ri5ObjMtnChartc_986_dt 0 0 0 255 ECU_ADDRESS 0xfe4c9fa0 /* @ECU_Address@SwcIn_RRCR_7.RRCR_7_Ri5ObjMtnChartc@ */ /end MEASUREMENT
/begin MEASUREMENT SwcIn_RRCR_7.RRCR_7_Ri5ObjNrOffocst "" UBYTE autosar_swc_val_CM_RRCR_7_Ri5ObjNrOffocst_986_dt 0 0 0 255 ECU_ADDRESS 0xfe4c9fa3 /* @ECU_Address@SwcIn_RRCR_7.RRCR_7_Ri5ObjNrOffocst@ */ /end MEASUREMENT
/begin MEASUREMENT SwcIn_RRCR_7.RRCR_7_Ri5ObjTrackSt "" UBYTE autosar_swc_val_CM_RRCR_7_Ri5ObjTrackSt_986_dt 0 0 0 255 ECU_ADDRESS 0xfe4c9fa4 /* @ECU_Address@SwcIn_RRCR_7.RRCR_7_Ri5ObjTrackSt@ */ /end MEASUREMENT
/begin MEASUREMENT SwcIn_RRCR_7.RRCR_7_Ri5ObjTyp "" UBYTE autosar_swc_val_CM_RRCR_7_Ri5ObjTyp_986_dt 0 0 0 255 ECU_ADDRESS 0xfe4c9fa1 /* @ECU_Address@SwcIn_RRCR_7.RRCR_7_Ri5ObjTyp@ */ /end MEASUREMENT
/begin MEASUREMENT SwcIn_RRCR_7.RRCR_7_Ri5ObjXDirAV "" FLOAT32_IEEE autosar_swc_val_CM_RRCR_7_Ri5ObjXDirAV_986_dt 0 0 -3.4E+38 3.4E+38 ECU_ADDRESS 0xfe4c9f94 /* @ECU_Address@SwcIn_RRCR_7.RRCR_7_Ri5ObjXDirAV@ */ /end MEASUREMENT
/begin MEASUREMENT SwcIn_RRCR_7.RRCR_7_Ri5ObjXDirV "" FLOAT32_IEEE autosar_swc_val_CM_RRCR_7_Ri5ObjXDirV_986_dt 0 0 -3.4E+38 3.4E+38 ECU_ADDRESS 0xfe4c9f9c /* @ECU_Address@SwcIn_RRCR_7.RRCR_7_Ri5ObjXDirV@ */ /end MEASUREMENT
/begin MEASUREMENT SwcIn_RRCR_7.RRCR_7_Ri5ObjXDirVStdDe "" FLOAT32_IEEE autosar_swc_val_CM_RRCR_7_Ri5ObjXDirVStdDe_986_dt 0 0 -3.4E+38 3.4E+38 ECU_ADDRESS 0xfe4c9fb0 /* @ECU_Address@SwcIn_RRCR_7.RRCR_7_Ri5ObjXDirVStdDe@ */ /end MEASUREMENT
/begin MEASUREMENT SwcIn_RRCR_7.RRCR_7_Ri5ObjYDirV "" FLOAT32_IEEE autosar_swc_val_CM_RRCR_7_Ri5ObjYDirV_986_dt 0 0 -3.4E+38 3.4E+38 ECU_ADDRESS 0xfe4c9f98 /* @ECU_Address@SwcIn_RRCR_7.RRCR_7_Ri5ObjYDirV@ */ /end MEASUREMENT
/begin MEASUREMENT SwcIn_RRCR_7.RRCR_7_Ri5ObjYDirVStdDe "" FLOAT32_IEEE autosar_swc_val_CM_RRCR_7_Ri5ObjYDirVStdDe_986_dt 0 0 -3.4E+38 3.4E+38 ECU_ADDRESS 0xfe4c9fb4 /* @ECU_Address@SwcIn_RRCR_7.RRCR_7_Ri5ObjYDirVStdDe@ */ /end MEASUREMENT
/begin MEASUREMENT SwcIn_RRCR_7.RRCR_7_RollgCntr "" UBYTE autosar_swc_val_CM_RRCR_7_RollgCntr_986_dt 0 0 0 255 ECU_ADDRESS 0xfe4c9f7a /* @ECU_Address@SwcIn_RRCR_7.RRCR_7_RollgCntr@ */ /end MEASUREMENT
/begin MEASUREMENT SwcIn_RRCR_8.RRCR_8_CRC "" UWORD autosar_swc_val_CM_RRCR_8_CRC_990_dt 0 0 0 65535 ECU_ADDRESS 0xfe4cbac4 /* @ECU_Address@SwcIn_RRCR_8.RRCR_8_CRC@ */ /end MEASUREMENT
/begin MEASUREMENT SwcIn_RRCR_8.RRCR_8_RollgCntr "" UBYTE autosar_swc_val_CM_RRCR_8_RollgCntr_990_dt 0 0 0 255 ECU_ADDRESS 0xfe4cbac6 /* @ECU_Address@SwcIn_RRCR_8.RRCR_8_RollgCntr@ */ /end MEASUREMENT
/begin MEASUREMENT SwcIn_RRCR_8.RRCR_8_TiStampLaten "" UWORD autosar_swc_val_CM_RRCR_8_TiStampLaten_990_dt 0 0 0 65535 ECU_ADDRESS 0xfe4cbac8 /* @ECU_Address@SwcIn_RRCR_8.RRCR_8_TiStampLaten@ */ /end MEASUREMENT
/begin MEASUREMENT SwcIn_RZCU_2.LHRDoorLockSts "" UBYTE autosar_swc_val_CM_LHRDoorLockSts_699_dt 0 0 0 255 ECU_ADDRESS 0xfe4cbc6f /* @ECU_Address@SwcIn_RZCU_2.LHRDoorLockSts@ */ /end MEASUREMENT
/begin MEASUREMENT SwcIn_RZCU_2.LHRdoorSts "" UBYTE autosar_swc_val_CM_LHRdoorSts_699_dt 0 0 0 255 ECU_ADDRESS 0xfe4cbc6d /* @ECU_Address@SwcIn_RZCU_2.LHRdoorSts@ */ /end MEASUREMENT
/begin MEASUREMENT SwcIn_RZCU_2.RZCU_2_CRC "" UBYTE autosar_swc_val_CM_RZCU_2_CRC_699_dt 0 0 0 255 ECU_ADDRESS 0xfe4cbc6a /* @ECU_Address@SwcIn_RZCU_2.RZCU_2_CRC@ */ /end MEASUREMENT
/begin MEASUREMENT SwcIn_RZCU_2.RZCU_2_Resd "" UBYTE autosar_swc_val_CM_RZCU_2_Resd_699_dt 0 0 0 255 ECU_ADDRESS 0xfe4cbc6c /* @ECU_Address@SwcIn_RZCU_2.RZCU_2_Resd@ */ /end MEASUREMENT
/begin MEASUREMENT SwcIn_RZCU_2.RZCU_2_RollgCntr "" UBYTE autosar_swc_val_CM_RZCU_2_RollgCntr_699_dt 0 0 0 255 ECU_ADDRESS 0xfe4cbc6b /* @ECU_Address@SwcIn_RZCU_2.RZCU_2_RollgCntr@ */ /end MEASUREMENT
/begin MEASUREMENT SwcIn_RZCU_2.TrunkLockSts "" UBYTE autosar_swc_val_CM_TrunkLockSts_699_dt 0 0 0 255 ECU_ADDRESS 0xfe4cbc70 /* @ECU_Address@SwcIn_RZCU_2.TrunkLockSts@ */ /end MEASUREMENT
/begin MEASUREMENT SwcIn_RZCU_2.TrunkSts "" UBYTE autosar_swc_val_CM_TrunkSts_699_dt 0 0 0 255 ECU_ADDRESS 0xfe4cbc6e /* @ECU_Address@SwcIn_RZCU_2.TrunkSts@ */ /end MEASUREMENT
/begin MEASUREMENT SwcIn_RZCU_7.RZCU_7_CRC "" UBYTE autosar_swc_val_CM_RZCU_7_CRC_1258_dt 0 0 0 255 ECU_ADDRESS 0xfe4cb924 /* @ECU_Address@SwcIn_RZCU_7.RZCU_7_CRC@ */ /end MEASUREMENT
/begin MEASUREMENT SwcIn_RZCU_7.RZCU_7_RollgCntr "" UBYTE autosar_swc_val_CM_RZCU_7_RollgCntr_1258_dt 0 0 0 255 ECU_ADDRESS 0xfe4cb925 /* @ECU_Address@SwcIn_RZCU_7.RZCU_7_RollgCntr@ */ /end MEASUREMENT
/begin MEASUREMENT SwcIn_RZCU_7.RZCU_RearWiperParkStatus "" UBYTE autosar_swc_val_CM_RZCU_RearWiperParkStatus_1258_dt 0 0 0 255 ECU_ADDRESS 0xfe4cb927 /* @ECU_Address@SwcIn_RZCU_7.RZCU_RearWiperParkStatus@ */ /end MEASUREMENT
/begin MEASUREMENT SwcIn_RZCU_7.RZCU_RearWiperWipingStatus "" UBYTE autosar_swc_val_CM_RZCU_RearWiperWipingStatus_1258_dt 0 0 0 255 ECU_ADDRESS 0xfe4cb926 /* @ECU_Address@SwcIn_RZCU_7.RZCU_RearWiperWipingStatus@ */ /end MEASUREMENT
/begin MEASUREMENT SwcIn_SAS_1.SAM_1_CRC "" UBYTE autosar_swc_val_CM_SAM_1_CRC_306_dt 0 0 0 255 ECU_ADDRESS 0xfe4cb928 /* @ECU_Address@SwcIn_SAS_1.SAM_1_CRC@ */ /end MEASUREMENT
/begin MEASUREMENT SwcIn_SAS_1.SAM_1_Resd "" UBYTE autosar_swc_val_CM_SAM_1_Resd_306_dt 0 0 0 255 ECU_ADDRESS 0xfe4cb92a /* @ECU_Address@SwcIn_SAS_1.SAM_1_Resd@ */ /end MEASUREMENT
/begin MEASUREMENT SwcIn_SAS_1.SAM_1_RollgCntr "" UBYTE autosar_swc_val_CM_SAM_1_RollgCntr_306_dt 0 0 0 255 ECU_ADDRESS 0xfe4cb929 /* @ECU_Address@SwcIn_SAS_1.SAM_1_RollgCntr@ */ /end MEASUREMENT
/begin MEASUREMENT SwcIn_SAS_1.SAM_1_SteeringAngle "" FLOAT32_IEEE autosar_swc_val_CM_SAM_1_SteeringAngle_306_dt 0 0 -3.4E+38 3.4E+38 ECU_ADDRESS 0xfe4cb92c /* @ECU_Address@SwcIn_SAS_1.SAM_1_SteeringAngle@ */ /end MEASUREMENT
/begin MEASUREMENT SwcIn_SAS_1.SAM_1_SteeringAngleSpeed "" UWORD autosar_swc_val_CM_SAM_1_SteeringAngleSpeed_306_dt 0 0 0 65535 ECU_ADDRESS 0xfe4cb930 /* @ECU_Address@SwcIn_SAS_1.SAM_1_SteeringAngleSpeed@ */ /end MEASUREMENT
/begin MEASUREMENT SwcIn_SAS_1.SAM_1_SteeringAngleSpeedVD "" UBYTE autosar_swc_val_CM_SAM_1_SteeringAngleSpeedVD_306_dt 0 0 0 255 ECU_ADDRESS 0xfe4cb933 /* @ECU_Address@SwcIn_SAS_1.SAM_1_SteeringAngleSpeedVD@ */ /end MEASUREMENT
/begin MEASUREMENT SwcIn_SAS_1.SAM_1_SteeringAngleVD "" UBYTE autosar_swc_val_CM_SAM_1_SteeringAngleVD_306_dt 0 0 0 255 ECU_ADDRESS 0xfe4cb932 /* @ECU_Address@SwcIn_SAS_1.SAM_1_SteeringAngleVD@ */ /end MEASUREMENT
/begin COMPU_METHOD autosar_swc_val_CM_ABS_ESP_1_ABSActive_152_dt "Q = V" IDENTICAL "%0.6" "" /end COMPU_METHOD
/begin COMPU_METHOD autosar_swc_val_CM_ABS_ESP_1_ABSFailSts_152_dt "Q = V" IDENTICAL "%0.6" "" /end COMPU_METHOD
/begin COMPU_METHOD autosar_swc_val_CM_ABS_ESP_1_EBDFailSts_152_dt "Q = V" IDENTICAL "%0.6" "" /end COMPU_METHOD
/begin COMPU_METHOD autosar_swc_val_CM_ABS_ESP_1_ESPSwitchStatus_152_dt "Q = V" IDENTICAL "%0.6" "" /end COMPU_METHOD
/begin COMPU_METHOD autosar_swc_val_CM_ABS_ESP_1_HDCCtrlSts_152_dt "Q = V" IDENTICAL "%0.6" "" /end COMPU_METHOD
/begin COMPU_METHOD autosar_swc_val_CM_ABS_ESP_1_HDCFailSts_152_dt "Q = V" IDENTICAL "%0.6" "" /end COMPU_METHOD
/begin COMPU_METHOD autosar_swc_val_CM_ABS_ESP_1_HHCFailSts_152_dt "Q = V" IDENTICAL "%0.6" "" /end COMPU_METHOD
/begin COMPU_METHOD autosar_swc_val_CM_ABS_ESP_1_TCSActive_152_dt "Q = V" IDENTICAL "%0.6" "" /end COMPU_METHOD
/begin COMPU_METHOD autosar_swc_val_CM_ABS_ESP_1_TCSFailSts_152_dt "Q = V" IDENTICAL "%0.6" "" /end COMPU_METHOD
/begin COMPU_METHOD autosar_swc_val_CM_ABS_ESP_1_VDCActive_152_dt "Q = V" IDENTICAL "%0.6" "" /end COMPU_METHOD
/begin COMPU_METHOD autosar_swc_val_CM_ABS_ESP_1_VDCFailSts_152_dt "Q = V" IDENTICAL "%0.6" "" /end COMPU_METHOD
/begin COMPU_METHOD autosar_swc_val_CM_ABS_ESP_1_VehicleSpeedVSOSig_152_dt "Q = V" IDENTICAL "%8.6" "" /end COMPU_METHOD
/begin COMPU_METHOD autosar_swc_val_CM_AEBdecActive_152_dt "Q = V" IDENTICAL "%0.6" "" /end COMPU_METHOD
/begin COMPU_METHOD autosar_swc_val_CM_AEBdecAvailable_152_dt "Q = V" IDENTICAL "%0.6" "" /end COMPU_METHOD
/begin COMPU_METHOD autosar_swc_val_CM_AVHFailSts_555_dt "Q = V" IDENTICAL "%0.6" "" /end COMPU_METHOD
/begin COMPU_METHOD autosar_swc_val_CM_AVHSts_555_dt "Q = V" IDENTICAL "%0.6" "" /end COMPU_METHOD
/begin COMPU_METHOD autosar_swc_val_CM_BLRequestController_152_dt "Q = V" IDENTICAL "%0.6" "" /end COMPU_METHOD
/begin COMPU_METHOD autosar_swc_val_CM_BrakeSystemType_152_dt "Q = V" IDENTICAL "%0.6" "" /end COMPU_METHOD
/begin COMPU_METHOD autosar_swc_val_CM_BrakesystemFailSts_1193_dt "Q = V" IDENTICAL "%0.6" "" /end COMPU_METHOD
/begin COMPU_METHOD autosar_swc_val_CM_CDDActive_555_dt "Q = V" IDENTICAL "%0.6" "" /end COMPU_METHOD
/begin COMPU_METHOD autosar_swc_val_CM_CDDAvailable_555_dt "Q = V" IDENTICAL "%0.6" "" /end COMPU_METHOD
/begin COMPU_METHOD autosar_swc_val_CM_CDPActive_152_dt "Q = V" IDENTICAL "%0.6" "" /end COMPU_METHOD
/begin COMPU_METHOD autosar_swc_val_CM_CDPFailSts_152_dt "Q = V" IDENTICAL "%0.6" "" /end COMPU_METHOD
/begin COMPU_METHOD autosar_swc_val_CM_DCFail_555_dt "Q = V" IDENTICAL "%0.6" "" /end COMPU_METHOD
/begin COMPU_METHOD autosar_swc_val_CM_DTCActive_555_dt "Q = V" IDENTICAL "%0.6" "" /end COMPU_METHOD
/begin COMPU_METHOD autosar_swc_val_CM_DTCAvailable_555_dt "Q = V" IDENTICAL "%0.6" "" /end COMPU_METHOD
/begin COMPU_METHOD autosar_swc_val_CM_DTC_Intervention_555_dt "Q = V" IDENTICAL "%0.6" "" /end COMPU_METHOD
/begin COMPU_METHOD autosar_swc_val_CM_ECDTempOff_555_dt "Q = V" IDENTICAL "%0.6" "" /end COMPU_METHOD
/begin COMPU_METHOD autosar_swc_val_CM_ESP1_VehicleSpeedVSOSigValidData_152_dt "Q = V" IDENTICAL "%0.6" "" /end COMPU_METHOD
/begin COMPU_METHOD autosar_swc_val_CM_HHCActive_152_dt "Q = V" IDENTICAL "%0.6" "" /end COMPU_METHOD
/begin COMPU_METHOD autosar_swc_val_CM_HLRequest_152_dt "Q = V" IDENTICAL "%0.6" "" /end COMPU_METHOD
/begin COMPU_METHOD autosar_swc_val_CM_IPB_1_MbRegenTargetWheelQ_152_dt "Q = V" IDENTICAL "%0.6" "" /end COMPU_METHOD
/begin COMPU_METHOD autosar_swc_val_CM_IPB_1_MbRegenTargetWheel_152_dt "Q = V" IDENTICAL "%0.6" "" /end COMPU_METHOD
/begin COMPU_METHOD autosar_swc_val_CM_IPB_InputRodStrokeStatus_555_dt "Q = V" IDENTICAL "%0.6" "" /end COMPU_METHOD
/begin COMPU_METHOD autosar_swc_val_CM_IPB_InputRodStroke_555_dt "Q = V" IDENTICAL "%8.6" "" /end COMPU_METHOD
/begin COMPU_METHOD autosar_swc_val_CM_IPB_PlungerPressureValidData_555_dt "Q = V" IDENTICAL "%0.6" "" /end COMPU_METHOD
/begin COMPU_METHOD autosar_swc_val_CM_IPB_PlungerPressure_555_dt "Q = V" IDENTICAL "%0.6" "" /end COMPU_METHOD
/begin COMPU_METHOD autosar_swc_val_CM_IPB_SimulatorPressureStatus_152_dt "Q = V" IDENTICAL "%0.6" "" /end COMPU_METHOD
/begin COMPU_METHOD autosar_swc_val_CM_IPB_SimulatorPressure_152_dt "Q = V" IDENTICAL "%0.6" "" /end COMPU_METHOD
/begin COMPU_METHOD autosar_swc_val_CM_LHFPulseCounterFailSts_587_dt "Q = V" IDENTICAL "%0.6" "" /end COMPU_METHOD
/begin COMPU_METHOD autosar_swc_val_CM_LHFPulseCounter_587_dt "Q = V" IDENTICAL "%0.6" "" /end COMPU_METHOD
/begin COMPU_METHOD autosar_swc_val_CM_LHFWheelDriveDirection_587_dt "Q = V" IDENTICAL "%0.6" "" /end COMPU_METHOD
/begin COMPU_METHOD autosar_swc_val_CM_LHFWheelSpeedRPM_587_dt "Q = V" IDENTICAL "%8.6" "" /end COMPU_METHOD
/begin COMPU_METHOD autosar_swc_val_CM_LHFWheelSpeedRawValidData_587_dt "Q = V" IDENTICAL "%0.6" "" /end COMPU_METHOD
/begin COMPU_METHOD autosar_swc_val_CM_LHFWheelSpeedRaw_587_dt "Q = V" IDENTICAL "%8.6" "" /end COMPU_METHOD
/begin COMPU_METHOD autosar_swc_val_CM_LHRDoorLockSts_699_dt "Q = V" IDENTICAL "%0.6" "" /end COMPU_METHOD
/begin COMPU_METHOD autosar_swc_val_CM_LHRPulseCounterFailSts_587_dt "Q = V" IDENTICAL "%0.6" "" /end COMPU_METHOD
/begin COMPU_METHOD autosar_swc_val_CM_LHRPulseCounter_587_dt "Q = V" IDENTICAL "%0.6" "" /end COMPU_METHOD
/begin COMPU_METHOD autosar_swc_val_CM_LHRWheelDriveDirection_587_dt "Q = V" IDENTICAL "%0.6" "" /end COMPU_METHOD
/begin COMPU_METHOD autosar_swc_val_CM_LHRWheelSpeedRPM_587_dt "Q = V" IDENTICAL "%8.6" "" /end COMPU_METHOD
/begin COMPU_METHOD autosar_swc_val_CM_LHRWheelSpeedRawValidData_587_dt "Q = V" IDENTICAL "%0.6" "" /end COMPU_METHOD
/begin COMPU_METHOD autosar_swc_val_CM_LHRWheelSpeedRaw_587_dt "Q = V" IDENTICAL "%8.6" "" /end COMPU_METHOD
/begin COMPU_METHOD autosar_swc_val_CM_LHRdoorSts_699_dt "Q = V" IDENTICAL "%0.6" "" /end COMPU_METHOD
/begin COMPU_METHOD autosar_swc_val_CM_MFS_2_CRC_864_dt "Q = V" IDENTICAL "%0.6" "" /end COMPU_METHOD
/begin COMPU_METHOD autosar_swc_val_CM_MFS_2_RollgCntr_864_dt "Q = V" IDENTICAL "%0.6" "" /end COMPU_METHOD
/begin COMPU_METHOD autosar_swc_val_CM_MFS_Cruise_Control_864_dt "Q = V" IDENTICAL "%0.6" "" /end COMPU_METHOD
/begin COMPU_METHOD autosar_swc_val_CM_MFS_LeRollrUpDwnAdjSteps_864_dt "Q = V" IDENTICAL "%0.6" "" /end COMPU_METHOD
/begin COMPU_METHOD autosar_swc_val_CM_MFS_LeftRollerMiddleKey_864_dt "Q = V" IDENTICAL "%0.6" "" /end COMPU_METHOD
/begin COMPU_METHOD autosar_swc_val_CM_MFS_LeftRoller_864_dt "Q = V" IDENTICAL "%0.6" "" /end COMPU_METHOD
/begin COMPU_METHOD autosar_swc_val_CM_MFS_RESPlus_864_dt "Q = V" IDENTICAL "%0.6" "" /end COMPU_METHOD
/begin COMPU_METHOD autosar_swc_val_CM_MFS_Rsp_Error_864_dt "Q = V" IDENTICAL "%0.6" "" /end COMPU_METHOD
/begin COMPU_METHOD autosar_swc_val_CM_MFS_SETMinus_864_dt "Q = V" IDENTICAL "%0.6" "" /end COMPU_METHOD
/begin COMPU_METHOD autosar_swc_val_CM_MFS_Time_Gap_Add_864_dt "Q = V" IDENTICAL "%0.6" "" /end COMPU_METHOD
/begin COMPU_METHOD autosar_swc_val_CM_MFS_Time_Gap_Reduce_864_dt "Q = V" IDENTICAL "%0.6" "" /end COMPU_METHOD
/begin COMPU_METHOD autosar_swc_val_CM_NoBrakeForce_555_dt "Q = V" IDENTICAL "%0.6" "" /end COMPU_METHOD
/begin COMPU_METHOD autosar_swc_val_CM_ONEBOX_1_CRC1_152_dt "Q = V" IDENTICAL "%0.6" "" /end COMPU_METHOD
/begin COMPU_METHOD autosar_swc_val_CM_ONEBOX_1_CRC2_152_dt "Q = V" IDENTICAL "%0.6" "" /end COMPU_METHOD
/begin COMPU_METHOD autosar_swc_val_CM_ONEBOX_1_Resd1_152_dt "Q = V" IDENTICAL "%0.6" "" /end COMPU_METHOD
/begin COMPU_METHOD autosar_swc_val_CM_ONEBOX_1_Resd2_152_dt "Q = V" IDENTICAL "%0.6" "" /end COMPU_METHOD
/begin COMPU_METHOD autosar_swc_val_CM_ONEBOX_1_RollgCntr1_152_dt "Q = V" IDENTICAL "%0.6" "" /end COMPU_METHOD
/begin COMPU_METHOD autosar_swc_val_CM_ONEBOX_1_RollgCntr2_152_dt "Q = V" IDENTICAL "%0.6" "" /end COMPU_METHOD
/begin COMPU_METHOD autosar_swc_val_CM_ONEBOX_2_G_CRC_1193_dt "Q = V" IDENTICAL "%0.6" "" /end COMPU_METHOD
/begin COMPU_METHOD autosar_swc_val_CM_ONEBOX_2_G_Resd_1193_dt "Q = V" IDENTICAL "%0.6" "" /end COMPU_METHOD
/begin COMPU_METHOD autosar_swc_val_CM_ONEBOX_2_G_RollgCntr_1193_dt "Q = V" IDENTICAL "%0.6" "" /end COMPU_METHOD
/begin COMPU_METHOD autosar_swc_val_CM_ONEBOX_3_CRC1_555_dt "Q = V" IDENTICAL "%0.6" "" /end COMPU_METHOD
/begin COMPU_METHOD autosar_swc_val_CM_ONEBOX_3_CRC2_555_dt "Q = V" IDENTICAL "%0.6" "" /end COMPU_METHOD
/begin COMPU_METHOD autosar_swc_val_CM_ONEBOX_3_CRC4_555_dt "Q = V" IDENTICAL "%0.6" "" /end COMPU_METHOD
/begin COMPU_METHOD autosar_swc_val_CM_ONEBOX_3_Resd1_555_dt "Q = V" IDENTICAL "%0.6" "" /end COMPU_METHOD
/begin COMPU_METHOD autosar_swc_val_CM_ONEBOX_3_Resd2_555_dt "Q = V" IDENTICAL "%0.6" "" /end COMPU_METHOD
/begin COMPU_METHOD autosar_swc_val_CM_ONEBOX_3_Resd4_555_dt "Q = V" IDENTICAL "%0.6" "" /end COMPU_METHOD
/begin COMPU_METHOD autosar_swc_val_CM_ONEBOX_3_RollgCntr1_555_dt "Q = V" IDENTICAL "%0.6" "" /end COMPU_METHOD
/begin COMPU_METHOD autosar_swc_val_CM_ONEBOX_3_RollgCntr2_555_dt "Q = V" IDENTICAL "%0.6" "" /end COMPU_METHOD
/begin COMPU_METHOD autosar_swc_val_CM_ONEBOX_3_RollgCntr4_555_dt "Q = V" IDENTICAL "%0.6" "" /end COMPU_METHOD
/begin COMPU_METHOD autosar_swc_val_CM_ONEBOX_4_CRC1_587_dt "Q = V" IDENTICAL "%0.6" "" /end COMPU_METHOD
/begin COMPU_METHOD autosar_swc_val_CM_ONEBOX_4_CRC2_587_dt "Q = V" IDENTICAL "%0.6" "" /end COMPU_METHOD
/begin COMPU_METHOD autosar_swc_val_CM_ONEBOX_4_CRC3_587_dt "Q = V" IDENTICAL "%0.6" "" /end COMPU_METHOD
/begin COMPU_METHOD autosar_swc_val_CM_ONEBOX_4_CRC4_587_dt "Q = V" IDENTICAL "%0.6" "" /end COMPU_METHOD
/begin COMPU_METHOD autosar_swc_val_CM_ONEBOX_4_Resd1_587_dt "Q = V" IDENTICAL "%0.6" "" /end COMPU_METHOD
/begin COMPU_METHOD autosar_swc_val_CM_ONEBOX_4_Resd2_587_dt "Q = V" IDENTICAL "%0.6" "" /end COMPU_METHOD
/begin COMPU_METHOD autosar_swc_val_CM_ONEBOX_4_Resd3_587_dt "Q = V" IDENTICAL "%0.6" "" /end COMPU_METHOD
/begin COMPU_METHOD autosar_swc_val_CM_ONEBOX_4_Resd4_587_dt "Q = V" IDENTICAL "%0.6" "" /end COMPU_METHOD
/begin COMPU_METHOD autosar_swc_val_CM_ONEBOX_4_RollgCntr1_587_dt "Q = V" IDENTICAL "%0.6" "" /end COMPU_METHOD
/begin COMPU_METHOD autosar_swc_val_CM_ONEBOX_4_RollgCntr2_587_dt "Q = V" IDENTICAL "%0.6" "" /end COMPU_METHOD
/begin COMPU_METHOD autosar_swc_val_CM_ONEBOX_4_RollgCntr3_587_dt "Q = V" IDENTICAL "%0.6" "" /end COMPU_METHOD
/begin COMPU_METHOD autosar_swc_val_CM_ONEBOX_4_RollgCntr4_587_dt "Q = V" IDENTICAL "%0.6" "" /end COMPU_METHOD
/begin COMPU_METHOD autosar_swc_val_CM_ONEBOX_5_APCFailureSts_335_dt "Q = V" IDENTICAL "%0.6" "" /end COMPU_METHOD
/begin COMPU_METHOD autosar_swc_val_CM_ONEBOX_5_APCStatus_335_dt "Q = V" IDENTICAL "%0.6" "" /end COMPU_METHOD
/begin COMPU_METHOD autosar_swc_val_CM_ONEBOX_5_AbaActSts_335_dt "Q = V" IDENTICAL "%0.6" "" /end COMPU_METHOD
/begin COMPU_METHOD autosar_swc_val_CM_ONEBOX_5_AbaAvlSts_335_dt "Q = V" IDENTICAL "%0.6" "" /end COMPU_METHOD
/begin COMPU_METHOD autosar_swc_val_CM_ONEBOX_5_AbaLvlSts_335_dt "Q = V" IDENTICAL "%0.6" "" /end COMPU_METHOD
/begin COMPU_METHOD autosar_swc_val_CM_ONEBOX_5_AbpActSts_335_dt "Q = V" IDENTICAL "%0.6" "" /end COMPU_METHOD
/begin COMPU_METHOD autosar_swc_val_CM_ONEBOX_5_AbpAvlSts_335_dt "Q = V" IDENTICAL "%0.6" "" /end COMPU_METHOD
/begin COMPU_METHOD autosar_swc_val_CM_ONEBOX_5_ApaAvl_335_dt "Q = V" IDENTICAL "%0.6" "" /end COMPU_METHOD
/begin COMPU_METHOD autosar_swc_val_CM_ONEBOX_5_AwbActSts_335_dt "Q = V" IDENTICAL "%0.6" "" /end COMPU_METHOD
/begin COMPU_METHOD autosar_swc_val_CM_ONEBOX_5_AwbAvlSts_335_dt "Q = V" IDENTICAL "%0.6" "" /end COMPU_METHOD
/begin COMPU_METHOD autosar_swc_val_CM_ONEBOX_5_CRC1_335_dt "Q = V" IDENTICAL "%0.6" "" /end COMPU_METHOD
/begin COMPU_METHOD autosar_swc_val_CM_ONEBOX_5_CddAdcActiveVehHld_335_dt "Q = V" IDENTICAL "%0.6" "" /end COMPU_METHOD
/begin COMPU_METHOD autosar_swc_val_CM_ONEBOX_5_CddApActiveVehHld_335_dt "Q = V" IDENTICAL "%0.6" "" /end COMPU_METHOD
/begin COMPU_METHOD autosar_swc_val_CM_ONEBOX_5_MebAvl_335_dt "Q = V" IDENTICAL "%0.6" "" /end COMPU_METHOD
/begin COMPU_METHOD autosar_swc_val_CM_ONEBOX_5_PilotParkBrkDecActSts_335_dt "Q = V" IDENTICAL "%0.6" "" /end COMPU_METHOD
/begin COMPU_METHOD autosar_swc_val_CM_ONEBOX_5_PilotParkBrkDecCtlAvl_335_dt "Q = V" IDENTICAL "%0.6" "" /end COMPU_METHOD
/begin COMPU_METHOD autosar_swc_val_CM_ONEBOX_5_Resd1_335_dt "Q = V" IDENTICAL "%0.6" "" /end COMPU_METHOD
/begin COMPU_METHOD autosar_swc_val_CM_ONEBOX_5_RollgCntr1_335_dt "Q = V" IDENTICAL "%0.6" "" /end COMPU_METHOD
/begin COMPU_METHOD autosar_swc_val_CM_ONEBOX_5_RpaAvl_335_dt "Q = V" IDENTICAL "%0.6" "" /end COMPU_METHOD
/begin COMPU_METHOD autosar_swc_val_CM_ONEBOX_5_SysBrkPVld_335_dt "Q = V" IDENTICAL "%0.6" "" /end COMPU_METHOD
/begin COMPU_METHOD autosar_swc_val_CM_ONEBOX_5_SysBrkP_335_dt "Q = V" IDENTICAL "%0.6" "" /end COMPU_METHOD
/begin COMPU_METHOD autosar_swc_val_CM_PPMID_1_HWSt_1208_dt "Q = V" IDENTICAL "%0.6" "" /end COMPU_METHOD
/begin COMPU_METHOD autosar_swc_val_CM_PPMID_1_PPMICounter_1208_dt "Q = V" IDENTICAL "%0.6" "" /end COMPU_METHOD
/begin COMPU_METHOD autosar_swc_val_CM_PPMID_1_PPMISt_1208_dt "Q = V" IDENTICAL "%0.6" "" /end COMPU_METHOD
/begin COMPU_METHOD autosar_swc_val_CM_PPMID_1_PPSt_1208_dt "Q = V" IDENTICAL "%0.6" "" /end COMPU_METHOD
/begin COMPU_METHOD autosar_swc_val_CM_RHFPulseCounterFailSts_587_dt "Q = V" IDENTICAL "%0.6" "" /end COMPU_METHOD
/begin COMPU_METHOD autosar_swc_val_CM_RHFPulseCounter_587_dt "Q = V" IDENTICAL "%0.6" "" /end COMPU_METHOD
/begin COMPU_METHOD autosar_swc_val_CM_RHFWheelDriveDirection_587_dt "Q = V" IDENTICAL "%0.6" "" /end COMPU_METHOD
/begin COMPU_METHOD autosar_swc_val_CM_RHFWheelSpeedRPM_587_dt "Q = V" IDENTICAL "%8.6" "" /end COMPU_METHOD
/begin COMPU_METHOD autosar_swc_val_CM_RHFWheelSpeedRawValidData_587_dt "Q = V" IDENTICAL "%0.6" "" /end COMPU_METHOD
/begin COMPU_METHOD autosar_swc_val_CM_RHFWheelSpeedRaw_587_dt "Q = V" IDENTICAL "%8.6" "" /end COMPU_METHOD
/begin COMPU_METHOD autosar_swc_val_CM_RHRPulseCounterFailSts_587_dt "Q = V" IDENTICAL "%0.6" "" /end COMPU_METHOD
/begin COMPU_METHOD autosar_swc_val_CM_RHRPulseCounter_587_dt "Q = V" IDENTICAL "%0.6" "" /end COMPU_METHOD
/begin COMPU_METHOD autosar_swc_val_CM_RHRWheelDriveDirection_587_dt "Q = V" IDENTICAL "%0.6" "" /end COMPU_METHOD
/begin COMPU_METHOD autosar_swc_val_CM_RHRWheelSpeedRPM_587_dt "Q = V" IDENTICAL "%8.6" "" /end COMPU_METHOD
/begin COMPU_METHOD autosar_swc_val_CM_RHRWheelSpeedRawValidData_587_dt "Q = V" IDENTICAL "%0.6" "" /end COMPU_METHOD
/begin COMPU_METHOD autosar_swc_val_CM_RHRWheelSpeedRaw_587_dt "Q = V" IDENTICAL "%8.6" "" /end COMPU_METHOD
/begin COMPU_METHOD autosar_swc_val_CM_RLCR_1_BSDWarn_1095_dt "Q = V" IDENTICAL "%0.6" "" /end COMPU_METHOD
/begin COMPU_METHOD autosar_swc_val_CM_RLCR_1_BlkSts_1095_dt "Q = V" IDENTICAL "%0.6" "" /end COMPU_METHOD
/begin COMPU_METHOD autosar_swc_val_CM_RLCR_1_CRC1_1095_dt "Q = V" IDENTICAL "%0.6" "" /end COMPU_METHOD
/begin COMPU_METHOD autosar_swc_val_CM_RLCR_1_DOWWarn_1095_dt "Q = V" IDENTICAL "%0.6" "" /end COMPU_METHOD
/begin COMPU_METHOD autosar_swc_val_CM_RLCR_1_DowLock_1095_dt "Q = V" IDENTICAL "%0.6" "" /end COMPU_METHOD
/begin COMPU_METHOD autosar_swc_val_CM_RLCR_1_ELK_CollisionFlagValid_1095_dt "Q = V" IDENTICAL "%0.6" "" /end COMPU_METHOD
/begin COMPU_METHOD autosar_swc_val_CM_RLCR_1_ELK_Collision_flag_1095_dt "Q = V" IDENTICAL "%0.6" "" /end COMPU_METHOD
/begin COMPU_METHOD autosar_swc_val_CM_RLCR_1_Resd1_1095_dt "Q = V" IDENTICAL "%0.6" "" /end COMPU_METHOD
/begin COMPU_METHOD autosar_swc_val_CM_RLCR_1_RollgCntr1_1095_dt "Q = V" IDENTICAL "%0.6" "" /end COMPU_METHOD
/begin COMPU_METHOD autosar_swc_val_CM_RLCR_1_SysSt_1095_dt "Q = V" IDENTICAL "%0.6" "" /end COMPU_METHOD
/begin COMPU_METHOD autosar_swc_val_CM_RLCR_2_BSDLCWONOFFSts_1104_dt "Q = V" IDENTICAL "%0.6" "" /end COMPU_METHOD
/begin COMPU_METHOD autosar_swc_val_CM_RLCR_2_CRC1_1104_dt "Q = V" IDENTICAL "%0.6" "" /end COMPU_METHOD
/begin COMPU_METHOD autosar_swc_val_CM_RLCR_2_DOWONOFFSts_1104_dt "Q = V" IDENTICAL "%0.6" "" /end COMPU_METHOD
/begin COMPU_METHOD autosar_swc_val_CM_RLCR_2_RCTARCTBONOFFSts_1104_dt "Q = V" IDENTICAL "%0.6" "" /end COMPU_METHOD
/begin COMPU_METHOD autosar_swc_val_CM_RLCR_2_RCTAWarn_1104_dt "Q = V" IDENTICAL "%0.6" "" /end COMPU_METHOD
/begin COMPU_METHOD autosar_swc_val_CM_RLCR_2_RCTBCtrlA_1104_dt "Q = V" IDENTICAL "%8.6" "" /end COMPU_METHOD
/begin COMPU_METHOD autosar_swc_val_CM_RLCR_2_RCTBReq_1104_dt "Q = V" IDENTICAL "%0.6" "" /end COMPU_METHOD
/begin COMPU_METHOD autosar_swc_val_CM_RLCR_2_RCTBWarn_1104_dt "Q = V" IDENTICAL "%0.6" "" /end COMPU_METHOD
/begin COMPU_METHOD autosar_swc_val_CM_RLCR_2_RCWONOFFSts_1104_dt "Q = V" IDENTICAL "%0.6" "" /end COMPU_METHOD
/begin COMPU_METHOD autosar_swc_val_CM_RLCR_2_RCWWarn_1104_dt "Q = V" IDENTICAL "%0.6" "" /end COMPU_METHOD
/begin COMPU_METHOD autosar_swc_val_CM_RLCR_2_Resd1_1104_dt "Q = V" IDENTICAL "%0.6" "" /end COMPU_METHOD
/begin COMPU_METHOD autosar_swc_val_CM_RLCR_2_RollgCntr1_1104_dt "Q = V" IDENTICAL "%0.6" "" /end COMPU_METHOD
/begin COMPU_METHOD autosar_swc_val_CM_RLCR_3_CRC_935_dt "Q = V" IDENTICAL "%0.6" "" /end COMPU_METHOD
/begin COMPU_METHOD autosar_swc_val_CM_RLCR_3_Le1HdTo_935_dt "Q = V" IDENTICAL "%8.6" "" /end COMPU_METHOD
/begin COMPU_METHOD autosar_swc_val_CM_RLCR_3_Le1ObjBoxLen_935_dt "Q = V" IDENTICAL "%8.6" "" /end COMPU_METHOD
/begin COMPU_METHOD autosar_swc_val_CM_RLCR_3_Le1ObjBoxWidth_935_dt "Q = V" IDENTICAL "%8.6" "" /end COMPU_METHOD
/begin COMPU_METHOD autosar_swc_val_CM_RLCR_3_Le1ObjConf_935_dt "Q = V" IDENTICAL "%0.6" "" /end COMPU_METHOD
/begin COMPU_METHOD autosar_swc_val_CM_RLCR_3_Le1ObjCoordXDstStdDe_935_dt "Q = V" IDENTICAL "%8.6" "" /end COMPU_METHOD
/begin COMPU_METHOD autosar_swc_val_CM_RLCR_3_Le1ObjCoordX_935_dt "Q = V" IDENTICAL "%8.6" "" /end COMPU_METHOD
/begin COMPU_METHOD autosar_swc_val_CM_RLCR_3_Le1ObjCoordYDstStdDe_935_dt "Q = V" IDENTICAL "%8.6" "" /end COMPU_METHOD
/begin COMPU_METHOD autosar_swc_val_CM_RLCR_3_Le1ObjCoordY_935_dt "Q = V" IDENTICAL "%8.6" "" /end COMPU_METHOD
/begin COMPU_METHOD autosar_swc_val_CM_RLCR_3_Le1ObjID_935_dt "Q = V" IDENTICAL "%0.6" "" /end COMPU_METHOD
/begin COMPU_METHOD autosar_swc_val_CM_RLCR_3_Le1ObjMtnChartc_935_dt "Q = V" IDENTICAL "%0.6" "" /end COMPU_METHOD
/begin COMPU_METHOD autosar_swc_val_CM_RLCR_3_Le1ObjNrOffocst_935_dt "Q = V" IDENTICAL "%0.6" "" /end COMPU_METHOD
/begin COMPU_METHOD autosar_swc_val_CM_RLCR_3_Le1ObjTrackSt_935_dt "Q = V" IDENTICAL "%0.6" "" /end COMPU_METHOD
/begin COMPU_METHOD autosar_swc_val_CM_RLCR_3_Le1ObjTyp_935_dt "Q = V" IDENTICAL "%0.6" "" /end COMPU_METHOD
/begin COMPU_METHOD autosar_swc_val_CM_RLCR_3_Le1ObjXDirAV_935_dt "Q = V" IDENTICAL "%8.6" "" /end COMPU_METHOD
/begin COMPU_METHOD autosar_swc_val_CM_RLCR_3_Le1ObjXDirVStdDe_935_dt "Q = V" IDENTICAL "%8.6" "" /end COMPU_METHOD
/begin COMPU_METHOD autosar_swc_val_CM_RLCR_3_Le1ObjXDirV_935_dt "Q = V" IDENTICAL "%8.6" "" /end COMPU_METHOD
/begin COMPU_METHOD autosar_swc_val_CM_RLCR_3_Le1ObjYDirVStdDe_935_dt "Q = V" IDENTICAL "%8.6" "" /end COMPU_METHOD
/begin COMPU_METHOD autosar_swc_val_CM_RLCR_3_Le1ObjYDirV_935_dt "Q = V" IDENTICAL "%8.6" "" /end COMPU_METHOD
/begin COMPU_METHOD autosar_swc_val_CM_RLCR_3_RollgCntr_935_dt "Q = V" IDENTICAL "%0.6" "" /end COMPU_METHOD
/begin COMPU_METHOD autosar_swc_val_CM_RLCR_4_CRC_937_dt "Q = V" IDENTICAL "%0.6" "" /end COMPU_METHOD
/begin COMPU_METHOD autosar_swc_val_CM_RLCR_4_Le2HdTo_937_dt "Q = V" IDENTICAL "%8.6" "" /end COMPU_METHOD
/begin COMPU_METHOD autosar_swc_val_CM_RLCR_4_Le2ObjBoxLen_937_dt "Q = V" IDENTICAL "%8.6" "" /end COMPU_METHOD
/begin COMPU_METHOD autosar_swc_val_CM_RLCR_4_Le2ObjBoxWidth_937_dt "Q = V" IDENTICAL "%8.6" "" /end COMPU_METHOD
/begin COMPU_METHOD autosar_swc_val_CM_RLCR_4_Le2ObjConf_937_dt "Q = V" IDENTICAL "%0.6" "" /end COMPU_METHOD
/begin COMPU_METHOD autosar_swc_val_CM_RLCR_4_Le2ObjCoordXDstStdDe_937_dt "Q = V" IDENTICAL "%8.6" "" /end COMPU_METHOD
/begin COMPU_METHOD autosar_swc_val_CM_RLCR_4_Le2ObjCoordX_937_dt "Q = V" IDENTICAL "%8.6" "" /end COMPU_METHOD
/begin COMPU_METHOD autosar_swc_val_CM_RLCR_4_Le2ObjCoordYDstStdDe_937_dt "Q = V" IDENTICAL "%8.6" "" /end COMPU_METHOD
/begin COMPU_METHOD autosar_swc_val_CM_RLCR_4_Le2ObjCoordY_937_dt "Q = V" IDENTICAL "%8.6" "" /end COMPU_METHOD
/begin COMPU_METHOD autosar_swc_val_CM_RLCR_4_Le2ObjID_937_dt "Q = V" IDENTICAL "%0.6" "" /end COMPU_METHOD
/begin COMPU_METHOD autosar_swc_val_CM_RLCR_4_Le2ObjMtnChartc_937_dt "Q = V" IDENTICAL "%0.6" "" /end COMPU_METHOD
/begin COMPU_METHOD autosar_swc_val_CM_RLCR_4_Le2ObjNrOffocst_937_dt "Q = V" IDENTICAL "%0.6" "" /end COMPU_METHOD
/begin COMPU_METHOD autosar_swc_val_CM_RLCR_4_Le2ObjTrackSt_937_dt "Q = V" IDENTICAL "%0.6" "" /end COMPU_METHOD
/begin COMPU_METHOD autosar_swc_val_CM_RLCR_4_Le2ObjTyp_937_dt "Q = V" IDENTICAL "%0.6" "" /end COMPU_METHOD
/begin COMPU_METHOD autosar_swc_val_CM_RLCR_4_Le2ObjXDirAV_937_dt "Q = V" IDENTICAL "%8.6" "" /end COMPU_METHOD
/begin COMPU_METHOD autosar_swc_val_CM_RLCR_4_Le2ObjXDirVStdDe_937_dt "Q = V" IDENTICAL "%8.6" "" /end COMPU_METHOD
/begin COMPU_METHOD autosar_swc_val_CM_RLCR_4_Le2ObjXDirV_937_dt "Q = V" IDENTICAL "%8.6" "" /end COMPU_METHOD
/begin COMPU_METHOD autosar_swc_val_CM_RLCR_4_Le2ObjYDirVStdDe_937_dt "Q = V" IDENTICAL "%8.6" "" /end COMPU_METHOD
/begin COMPU_METHOD autosar_swc_val_CM_RLCR_4_Le2ObjYDirV_937_dt "Q = V" IDENTICAL "%8.6" "" /end COMPU_METHOD
/begin COMPU_METHOD autosar_swc_val_CM_RLCR_4_RollgCntr_937_dt "Q = V" IDENTICAL "%0.6" "" /end COMPU_METHOD
/begin COMPU_METHOD autosar_swc_val_CM_RLCR_5_CRC_941_dt "Q = V" IDENTICAL "%0.6" "" /end COMPU_METHOD
/begin COMPU_METHOD autosar_swc_val_CM_RLCR_5_Le3HdTo_941_dt "Q = V" IDENTICAL "%8.6" "" /end COMPU_METHOD
/begin COMPU_METHOD autosar_swc_val_CM_RLCR_5_Le3ObjBoxLen_941_dt "Q = V" IDENTICAL "%8.6" "" /end COMPU_METHOD
/begin COMPU_METHOD autosar_swc_val_CM_RLCR_5_Le3ObjBoxWidth_941_dt "Q = V" IDENTICAL "%8.6" "" /end COMPU_METHOD
/begin COMPU_METHOD autosar_swc_val_CM_RLCR_5_Le3ObjConf_941_dt "Q = V" IDENTICAL "%0.6" "" /end COMPU_METHOD
/begin COMPU_METHOD autosar_swc_val_CM_RLCR_5_Le3ObjCoordXDstStdDe_941_dt "Q = V" IDENTICAL "%8.6" "" /end COMPU_METHOD
/begin COMPU_METHOD autosar_swc_val_CM_RLCR_5_Le3ObjCoordX_941_dt "Q = V" IDENTICAL "%8.6" "" /end COMPU_METHOD
/begin COMPU_METHOD autosar_swc_val_CM_RLCR_5_Le3ObjCoordYDstStdDe_941_dt "Q = V" IDENTICAL "%8.6" "" /end COMPU_METHOD
/begin COMPU_METHOD autosar_swc_val_CM_RLCR_5_Le3ObjCoordY_941_dt "Q = V" IDENTICAL "%8.6" "" /end COMPU_METHOD
/begin COMPU_METHOD autosar_swc_val_CM_RLCR_5_Le3ObjID_941_dt "Q = V" IDENTICAL "%0.6" "" /end COMPU_METHOD
/begin COMPU_METHOD autosar_swc_val_CM_RLCR_5_Le3ObjMtnChartc_941_dt "Q = V" IDENTICAL "%0.6" "" /end COMPU_METHOD
/begin COMPU_METHOD autosar_swc_val_CM_RLCR_5_Le3ObjNrOffocst_941_dt "Q = V" IDENTICAL "%0.6" "" /end COMPU_METHOD
/begin COMPU_METHOD autosar_swc_val_CM_RLCR_5_Le3ObjTrackSt_941_dt "Q = V" IDENTICAL "%0.6" "" /end COMPU_METHOD
/begin COMPU_METHOD autosar_swc_val_CM_RLCR_5_Le3ObjTyp_941_dt "Q = V" IDENTICAL "%0.6" "" /end COMPU_METHOD
/begin COMPU_METHOD autosar_swc_val_CM_RLCR_5_Le3ObjXDirAV_941_dt "Q = V" IDENTICAL "%8.6" "" /end COMPU_METHOD
/begin COMPU_METHOD autosar_swc_val_CM_RLCR_5_Le3ObjXDirVStdDe_941_dt "Q = V" IDENTICAL "%8.6" "" /end COMPU_METHOD
/begin COMPU_METHOD autosar_swc_val_CM_RLCR_5_Le3ObjXDirV_941_dt "Q = V" IDENTICAL "%8.6" "" /end COMPU_METHOD
/begin COMPU_METHOD autosar_swc_val_CM_RLCR_5_Le3ObjYDirVStdDe_941_dt "Q = V" IDENTICAL "%8.6" "" /end COMPU_METHOD
/begin COMPU_METHOD autosar_swc_val_CM_RLCR_5_Le3ObjYDirV_941_dt "Q = V" IDENTICAL "%8.6" "" /end COMPU_METHOD
/begin COMPU_METHOD autosar_swc_val_CM_RLCR_5_RollgCntr_941_dt "Q = V" IDENTICAL "%0.6" "" /end COMPU_METHOD
/begin COMPU_METHOD autosar_swc_val_CM_RLCR_6_CRC_946_dt "Q = V" IDENTICAL "%0.6" "" /end COMPU_METHOD
/begin COMPU_METHOD autosar_swc_val_CM_RLCR_6_Le4HdTo_946_dt "Q = V" IDENTICAL "%8.6" "" /end COMPU_METHOD
/begin COMPU_METHOD autosar_swc_val_CM_RLCR_6_Le4ObjBoxLen_946_dt "Q = V" IDENTICAL "%8.6" "" /end COMPU_METHOD
/begin COMPU_METHOD autosar_swc_val_CM_RLCR_6_Le4ObjBoxWidth_946_dt "Q = V" IDENTICAL "%8.6" "" /end COMPU_METHOD
/begin COMPU_METHOD autosar_swc_val_CM_RLCR_6_Le4ObjConf_946_dt "Q = V" IDENTICAL "%0.6" "" /end COMPU_METHOD
/begin COMPU_METHOD autosar_swc_val_CM_RLCR_6_Le4ObjCoordXDstStdDe_946_dt "Q = V" IDENTICAL "%8.6" "" /end COMPU_METHOD
/begin COMPU_METHOD autosar_swc_val_CM_RLCR_6_Le4ObjCoordX_946_dt "Q = V" IDENTICAL "%8.6" "" /end COMPU_METHOD
/begin COMPU_METHOD autosar_swc_val_CM_RLCR_6_Le4ObjCoordYDstStdDe_946_dt "Q = V" IDENTICAL "%8.6" "" /end COMPU_METHOD
/begin COMPU_METHOD autosar_swc_val_CM_RLCR_6_Le4ObjCoordY_946_dt "Q = V" IDENTICAL "%8.6" "" /end COMPU_METHOD
/begin COMPU_METHOD autosar_swc_val_CM_RLCR_6_Le4ObjID_946_dt "Q = V" IDENTICAL "%0.6" "" /end COMPU_METHOD
/begin COMPU_METHOD autosar_swc_val_CM_RLCR_6_Le4ObjMtnChartc_946_dt "Q = V" IDENTICAL "%0.6" "" /end COMPU_METHOD
/begin COMPU_METHOD autosar_swc_val_CM_RLCR_6_Le4ObjNrOffocst_946_dt "Q = V" IDENTICAL "%0.6" "" /end COMPU_METHOD
/begin COMPU_METHOD autosar_swc_val_CM_RLCR_6_Le4ObjTrackSt_946_dt "Q = V" IDENTICAL "%0.6" "" /end COMPU_METHOD
/begin COMPU_METHOD autosar_swc_val_CM_RLCR_6_Le4ObjTyp_946_dt "Q = V" IDENTICAL "%0.6" "" /end COMPU_METHOD
/begin COMPU_METHOD autosar_swc_val_CM_RLCR_6_Le4ObjXDirAV_946_dt "Q = V" IDENTICAL "%8.6" "" /end COMPU_METHOD
/begin COMPU_METHOD autosar_swc_val_CM_RLCR_6_Le4ObjXDirVStdDe_946_dt "Q = V" IDENTICAL "%8.6" "" /end COMPU_METHOD
/begin COMPU_METHOD autosar_swc_val_CM_RLCR_6_Le4ObjXDirV_946_dt "Q = V" IDENTICAL "%8.6" "" /end COMPU_METHOD
/begin COMPU_METHOD autosar_swc_val_CM_RLCR_6_Le4ObjYDirVStdDe_946_dt "Q = V" IDENTICAL "%8.6" "" /end COMPU_METHOD
/begin COMPU_METHOD autosar_swc_val_CM_RLCR_6_Le4ObjYDirV_946_dt "Q = V" IDENTICAL "%8.6" "" /end COMPU_METHOD
/begin COMPU_METHOD autosar_swc_val_CM_RLCR_6_RollgCntr_946_dt "Q = V" IDENTICAL "%0.6" "" /end COMPU_METHOD
/begin COMPU_METHOD autosar_swc_val_CM_RLCR_7_CRC_948_dt "Q = V" IDENTICAL "%0.6" "" /end COMPU_METHOD
/begin COMPU_METHOD autosar_swc_val_CM_RLCR_7_Le5HdTo_948_dt "Q = V" IDENTICAL "%8.6" "" /end COMPU_METHOD
/begin COMPU_METHOD autosar_swc_val_CM_RLCR_7_Le5ObjBoxLen_948_dt "Q = V" IDENTICAL "%8.6" "" /end COMPU_METHOD
/begin COMPU_METHOD autosar_swc_val_CM_RLCR_7_Le5ObjBoxWidth_948_dt "Q = V" IDENTICAL "%8.6" "" /end COMPU_METHOD
/begin COMPU_METHOD autosar_swc_val_CM_RLCR_7_Le5ObjConf_948_dt "Q = V" IDENTICAL "%0.6" "" /end COMPU_METHOD
/begin COMPU_METHOD autosar_swc_val_CM_RLCR_7_Le5ObjCoordXDstStdDe_948_dt "Q = V" IDENTICAL "%8.6" "" /end COMPU_METHOD
/begin COMPU_METHOD autosar_swc_val_CM_RLCR_7_Le5ObjCoordX_948_dt "Q = V" IDENTICAL "%8.6" "" /end COMPU_METHOD
/begin COMPU_METHOD autosar_swc_val_CM_RLCR_7_Le5ObjCoordYDstStdDe_948_dt "Q = V" IDENTICAL "%8.6" "" /end COMPU_METHOD
/begin COMPU_METHOD autosar_swc_val_CM_RLCR_7_Le5ObjCoordY_948_dt "Q = V" IDENTICAL "%8.6" "" /end COMPU_METHOD
/begin COMPU_METHOD autosar_swc_val_CM_RLCR_7_Le5ObjID_948_dt "Q = V" IDENTICAL "%0.6" "" /end COMPU_METHOD
/begin COMPU_METHOD autosar_swc_val_CM_RLCR_7_Le5ObjMtnChartc_948_dt "Q = V" IDENTICAL "%0.6" "" /end COMPU_METHOD
/begin COMPU_METHOD autosar_swc_val_CM_RLCR_7_Le5ObjNrOffocst_948_dt "Q = V" IDENTICAL "%0.6" "" /end COMPU_METHOD
/begin COMPU_METHOD autosar_swc_val_CM_RLCR_7_Le5ObjTrackSt_948_dt "Q = V" IDENTICAL "%0.6" "" /end COMPU_METHOD
/begin COMPU_METHOD autosar_swc_val_CM_RLCR_7_Le5ObjTyp_948_dt "Q = V" IDENTICAL "%0.6" "" /end COMPU_METHOD
/begin COMPU_METHOD autosar_swc_val_CM_RLCR_7_Le5ObjXDirAV_948_dt "Q = V" IDENTICAL "%8.6" "" /end COMPU_METHOD
/begin COMPU_METHOD autosar_swc_val_CM_RLCR_7_Le5ObjXDirVStdDe_948_dt "Q = V" IDENTICAL "%8.6" "" /end COMPU_METHOD
/begin COMPU_METHOD autosar_swc_val_CM_RLCR_7_Le5ObjXDirV_948_dt "Q = V" IDENTICAL "%8.6" "" /end COMPU_METHOD
/begin COMPU_METHOD autosar_swc_val_CM_RLCR_7_Le5ObjYDirVStdDe_948_dt "Q = V" IDENTICAL "%8.6" "" /end COMPU_METHOD
/begin COMPU_METHOD autosar_swc_val_CM_RLCR_7_Le5ObjYDirV_948_dt "Q = V" IDENTICAL "%8.6" "" /end COMPU_METHOD
/begin COMPU_METHOD autosar_swc_val_CM_RLCR_7_RollgCntr_948_dt "Q = V" IDENTICAL "%0.6" "" /end COMPU_METHOD
/begin COMPU_METHOD autosar_swc_val_CM_RLCR_8_CRC_953_dt "Q = V" IDENTICAL "%0.6" "" /end COMPU_METHOD
/begin COMPU_METHOD autosar_swc_val_CM_RLCR_8_RollgCntr_953_dt "Q = V" IDENTICAL "%0.6" "" /end COMPU_METHOD
/begin COMPU_METHOD autosar_swc_val_CM_RLCR_8_TiStampLaten_953_dt "Q = V" IDENTICAL "%0.6" "" /end COMPU_METHOD
/begin COMPU_METHOD autosar_swc_val_CM_RRCR_1_BSDWarn_1267_dt "Q = V" IDENTICAL "%0.6" "" /end COMPU_METHOD
/begin COMPU_METHOD autosar_swc_val_CM_RRCR_1_BlkSts_1267_dt "Q = V" IDENTICAL "%0.6" "" /end COMPU_METHOD
/begin COMPU_METHOD autosar_swc_val_CM_RRCR_1_CRC1_1267_dt "Q = V" IDENTICAL "%0.6" "" /end COMPU_METHOD
/begin COMPU_METHOD autosar_swc_val_CM_RRCR_1_DOWWarn_1267_dt "Q = V" IDENTICAL "%0.6" "" /end COMPU_METHOD
/begin COMPU_METHOD autosar_swc_val_CM_RRCR_1_DowLock_1267_dt "Q = V" IDENTICAL "%0.6" "" /end COMPU_METHOD
/begin COMPU_METHOD autosar_swc_val_CM_RRCR_1_ELK_CollisionFlagValid_1267_dt "Q = V" IDENTICAL "%0.6" "" /end COMPU_METHOD
/begin COMPU_METHOD autosar_swc_val_CM_RRCR_1_ELK_Collision_flag_1267_dt "Q = V" IDENTICAL "%0.6" "" /end COMPU_METHOD
/begin COMPU_METHOD autosar_swc_val_CM_RRCR_1_Resd1_1267_dt "Q = V" IDENTICAL "%0.6" "" /end COMPU_METHOD
/begin COMPU_METHOD autosar_swc_val_CM_RRCR_1_RollgCntr1_1267_dt "Q = V" IDENTICAL "%0.6" "" /end COMPU_METHOD
/begin COMPU_METHOD autosar_swc_val_CM_RRCR_1_SysSt_1267_dt "Q = V" IDENTICAL "%0.6" "" /end COMPU_METHOD
/begin COMPU_METHOD autosar_swc_val_CM_RRCR_3_CRC_959_dt "Q = V" IDENTICAL "%0.6" "" /end COMPU_METHOD
/begin COMPU_METHOD autosar_swc_val_CM_RRCR_3_Ri1HdTo_959_dt "Q = V" IDENTICAL "%8.6" "" /end COMPU_METHOD
/begin COMPU_METHOD autosar_swc_val_CM_RRCR_3_Ri1ObjBoxLen_959_dt "Q = V" IDENTICAL "%8.6" "" /end COMPU_METHOD
/begin COMPU_METHOD autosar_swc_val_CM_RRCR_3_Ri1ObjBoxWidth_959_dt "Q = V" IDENTICAL "%8.6" "" /end COMPU_METHOD
/begin COMPU_METHOD autosar_swc_val_CM_RRCR_3_Ri1ObjConf_959_dt "Q = V" IDENTICAL "%0.6" "" /end COMPU_METHOD
/begin COMPU_METHOD autosar_swc_val_CM_RRCR_3_Ri1ObjCoordXDstStdDe_959_dt "Q = V" IDENTICAL "%8.6" "" /end COMPU_METHOD
/begin COMPU_METHOD autosar_swc_val_CM_RRCR_3_Ri1ObjCoordX_959_dt "Q = V" IDENTICAL "%8.6" "" /end COMPU_METHOD
/begin COMPU_METHOD autosar_swc_val_CM_RRCR_3_Ri1ObjCoordYDstStdDe_959_dt "Q = V" IDENTICAL "%8.6" "" /end COMPU_METHOD
/begin COMPU_METHOD autosar_swc_val_CM_RRCR_3_Ri1ObjCoordY_959_dt "Q = V" IDENTICAL "%8.6" "" /end COMPU_METHOD
/begin COMPU_METHOD autosar_swc_val_CM_RRCR_3_Ri1ObjID_959_dt "Q = V" IDENTICAL "%0.6" "" /end COMPU_METHOD
/begin COMPU_METHOD autosar_swc_val_CM_RRCR_3_Ri1ObjMtnChartc_959_dt "Q = V" IDENTICAL "%0.6" "" /end COMPU_METHOD
/begin COMPU_METHOD autosar_swc_val_CM_RRCR_3_Ri1ObjNrOffocst_959_dt "Q = V" IDENTICAL "%0.6" "" /end COMPU_METHOD
/begin COMPU_METHOD autosar_swc_val_CM_RRCR_3_Ri1ObjTrackSt_959_dt "Q = V" IDENTICAL "%0.6" "" /end COMPU_METHOD
/begin COMPU_METHOD autosar_swc_val_CM_RRCR_3_Ri1ObjTyp_959_dt "Q = V" IDENTICAL "%0.6" "" /end COMPU_METHOD
/begin COMPU_METHOD autosar_swc_val_CM_RRCR_3_Ri1ObjXDirAV_959_dt "Q = V" IDENTICAL "%8.6" "" /end COMPU_METHOD
/begin COMPU_METHOD autosar_swc_val_CM_RRCR_3_Ri1ObjXDirVStdDe_959_dt "Q = V" IDENTICAL "%8.6" "" /end COMPU_METHOD
/begin COMPU_METHOD autosar_swc_val_CM_RRCR_3_Ri1ObjXDirV_959_dt "Q = V" IDENTICAL "%8.6" "" /end COMPU_METHOD
/begin COMPU_METHOD autosar_swc_val_CM_RRCR_3_Ri1ObjYDirVStdDe_959_dt "Q = V" IDENTICAL "%8.6" "" /end COMPU_METHOD
/begin COMPU_METHOD autosar_swc_val_CM_RRCR_3_Ri1ObjYDirV_959_dt "Q = V" IDENTICAL "%8.6" "" /end COMPU_METHOD
/begin COMPU_METHOD autosar_swc_val_CM_RRCR_3_RollgCntr_959_dt "Q = V" IDENTICAL "%0.6" "" /end COMPU_METHOD
/begin COMPU_METHOD autosar_swc_val_CM_RRCR_4_CRC_969_dt "Q = V" IDENTICAL "%0.6" "" /end COMPU_METHOD
/begin COMPU_METHOD autosar_swc_val_CM_RRCR_4_Ri2HdTo_969_dt "Q = V" IDENTICAL "%8.6" "" /end COMPU_METHOD
/begin COMPU_METHOD autosar_swc_val_CM_RRCR_4_Ri2ObjBoxLen_969_dt "Q = V" IDENTICAL "%8.6" "" /end COMPU_METHOD
/begin COMPU_METHOD autosar_swc_val_CM_RRCR_4_Ri2ObjBoxWidth_969_dt "Q = V" IDENTICAL "%8.6" "" /end COMPU_METHOD
/begin COMPU_METHOD autosar_swc_val_CM_RRCR_4_Ri2ObjConf_969_dt "Q = V" IDENTICAL "%0.6" "" /end COMPU_METHOD
/begin COMPU_METHOD autosar_swc_val_CM_RRCR_4_Ri2ObjCoordXDstStdDe_969_dt "Q = V" IDENTICAL "%8.6" "" /end COMPU_METHOD
/begin COMPU_METHOD autosar_swc_val_CM_RRCR_4_Ri2ObjCoordX_969_dt "Q = V" IDENTICAL "%8.6" "" /end COMPU_METHOD
/begin COMPU_METHOD autosar_swc_val_CM_RRCR_4_Ri2ObjCoordYDstStdDe_969_dt "Q = V" IDENTICAL "%8.6" "" /end COMPU_METHOD
/begin COMPU_METHOD autosar_swc_val_CM_RRCR_4_Ri2ObjCoordY_969_dt "Q = V" IDENTICAL "%8.6" "" /end COMPU_METHOD
/begin COMPU_METHOD autosar_swc_val_CM_RRCR_4_Ri2ObjID_969_dt "Q = V" IDENTICAL "%0.6" "" /end COMPU_METHOD
/begin COMPU_METHOD autosar_swc_val_CM_RRCR_4_Ri2ObjMtnChartc_969_dt "Q = V" IDENTICAL "%0.6" "" /end COMPU_METHOD
/begin COMPU_METHOD autosar_swc_val_CM_RRCR_4_Ri2ObjNrOffocst_969_dt "Q = V" IDENTICAL "%0.6" "" /end COMPU_METHOD
/begin COMPU_METHOD autosar_swc_val_CM_RRCR_4_Ri2ObjTrackSt_969_dt "Q = V" IDENTICAL "%0.6" "" /end COMPU_METHOD
/begin COMPU_METHOD autosar_swc_val_CM_RRCR_4_Ri2ObjTyp_969_dt "Q = V" IDENTICAL "%0.6" "" /end COMPU_METHOD
/begin COMPU_METHOD autosar_swc_val_CM_RRCR_4_Ri2ObjXDirAV_969_dt "Q = V" IDENTICAL "%8.6" "" /end COMPU_METHOD
/begin COMPU_METHOD autosar_swc_val_CM_RRCR_4_Ri2ObjXDirVStdDe_969_dt "Q = V" IDENTICAL "%8.6" "" /end COMPU_METHOD
/begin COMPU_METHOD autosar_swc_val_CM_RRCR_4_Ri2ObjXDirV_969_dt "Q = V" IDENTICAL "%8.6" "" /end COMPU_METHOD
/begin COMPU_METHOD autosar_swc_val_CM_RRCR_4_Ri2ObjYDirVStdDe_969_dt "Q = V" IDENTICAL "%8.6" "" /end COMPU_METHOD
/begin COMPU_METHOD autosar_swc_val_CM_RRCR_4_Ri2ObjYDirV_969_dt "Q = V" IDENTICAL "%8.6" "" /end COMPU_METHOD
/begin COMPU_METHOD autosar_swc_val_CM_RRCR_4_RollgCntr_969_dt "Q = V" IDENTICAL "%0.6" "" /end COMPU_METHOD
/begin COMPU_METHOD autosar_swc_val_CM_RRCR_5_CRC_976_dt "Q = V" IDENTICAL "%0.6" "" /end COMPU_METHOD
/begin COMPU_METHOD autosar_swc_val_CM_RRCR_5_Ri3HdTo_976_dt "Q = V" IDENTICAL "%8.6" "" /end COMPU_METHOD
/begin COMPU_METHOD autosar_swc_val_CM_RRCR_5_Ri3ObjBoxLen_976_dt "Q = V" IDENTICAL "%8.6" "" /end COMPU_METHOD
/begin COMPU_METHOD autosar_swc_val_CM_RRCR_5_Ri3ObjBoxWidth_976_dt "Q = V" IDENTICAL "%8.6" "" /end COMPU_METHOD
/begin COMPU_METHOD autosar_swc_val_CM_RRCR_5_Ri3ObjConf_976_dt "Q = V" IDENTICAL "%0.6" "" /end COMPU_METHOD
/begin COMPU_METHOD autosar_swc_val_CM_RRCR_5_Ri3ObjCoordXDstStdDe_976_dt "Q = V" IDENTICAL "%8.6" "" /end COMPU_METHOD
/begin COMPU_METHOD autosar_swc_val_CM_RRCR_5_Ri3ObjCoordX_976_dt "Q = V" IDENTICAL "%8.6" "" /end COMPU_METHOD
/begin COMPU_METHOD autosar_swc_val_CM_RRCR_5_Ri3ObjCoordYDstStdDe_976_dt "Q = V" IDENTICAL "%8.6" "" /end COMPU_METHOD
/begin COMPU_METHOD autosar_swc_val_CM_RRCR_5_Ri3ObjCoordY_976_dt "Q = V" IDENTICAL "%8.6" "" /end COMPU_METHOD
/begin COMPU_METHOD autosar_swc_val_CM_RRCR_5_Ri3ObjID_976_dt "Q = V" IDENTICAL "%0.6" "" /end COMPU_METHOD
/begin COMPU_METHOD autosar_swc_val_CM_RRCR_5_Ri3ObjMtnChartc_976_dt "Q = V" IDENTICAL "%0.6" "" /end COMPU_METHOD
/begin COMPU_METHOD autosar_swc_val_CM_RRCR_5_Ri3ObjNrOffocst_976_dt "Q = V" IDENTICAL "%0.6" "" /end COMPU_METHOD
/begin COMPU_METHOD autosar_swc_val_CM_RRCR_5_Ri3ObjTrackSt_976_dt "Q = V" IDENTICAL "%0.6" "" /end COMPU_METHOD
/begin COMPU_METHOD autosar_swc_val_CM_RRCR_5_Ri3ObjTyp_976_dt "Q = V" IDENTICAL "%0.6" "" /end COMPU_METHOD
/begin COMPU_METHOD autosar_swc_val_CM_RRCR_5_Ri3ObjXDirAV_976_dt "Q = V" IDENTICAL "%8.6" "" /end COMPU_METHOD
/begin COMPU_METHOD autosar_swc_val_CM_RRCR_5_Ri3ObjXDirVStdDe_976_dt "Q = V" IDENTICAL "%8.6" "" /end COMPU_METHOD
/begin COMPU_METHOD autosar_swc_val_CM_RRCR_5_Ri3ObjXDirV_976_dt "Q = V" IDENTICAL "%8.6" "" /end COMPU_METHOD
/begin COMPU_METHOD autosar_swc_val_CM_RRCR_5_Ri3ObjYDirVStdDe_976_dt "Q = V" IDENTICAL "%8.6" "" /end COMPU_METHOD
/begin COMPU_METHOD autosar_swc_val_CM_RRCR_5_Ri3ObjYDirV_976_dt "Q = V" IDENTICAL "%8.6" "" /end COMPU_METHOD
/begin COMPU_METHOD autosar_swc_val_CM_RRCR_5_RollgCntr_976_dt "Q = V" IDENTICAL "%0.6" "" /end COMPU_METHOD
/begin COMPU_METHOD autosar_swc_val_CM_RRCR_6_CRC_984_dt "Q = V" IDENTICAL "%0.6" "" /end COMPU_METHOD
/begin COMPU_METHOD autosar_swc_val_CM_RRCR_6_Ri4HdTo_984_dt "Q = V" IDENTICAL "%8.6" "" /end COMPU_METHOD
/begin COMPU_METHOD autosar_swc_val_CM_RRCR_6_Ri4ObjBoxLen_984_dt "Q = V" IDENTICAL "%8.6" "" /end COMPU_METHOD
/begin COMPU_METHOD autosar_swc_val_CM_RRCR_6_Ri4ObjBoxWidth_984_dt "Q = V" IDENTICAL "%8.6" "" /end COMPU_METHOD
/begin COMPU_METHOD autosar_swc_val_CM_RRCR_6_Ri4ObjConf_984_dt "Q = V" IDENTICAL "%0.6" "" /end COMPU_METHOD
/begin COMPU_METHOD autosar_swc_val_CM_RRCR_6_Ri4ObjCoordXDstStdDe_984_dt "Q = V" IDENTICAL "%8.6" "" /end COMPU_METHOD
/begin COMPU_METHOD autosar_swc_val_CM_RRCR_6_Ri4ObjCoordX_984_dt "Q = V" IDENTICAL "%8.6" "" /end COMPU_METHOD
/begin COMPU_METHOD autosar_swc_val_CM_RRCR_6_Ri4ObjCoordYDstStdDe_984_dt "Q = V" IDENTICAL "%8.6" "" /end COMPU_METHOD
/begin COMPU_METHOD autosar_swc_val_CM_RRCR_6_Ri4ObjCoordY_984_dt "Q = V" IDENTICAL "%8.6" "" /end COMPU_METHOD
/begin COMPU_METHOD autosar_swc_val_CM_RRCR_6_Ri4ObjID_984_dt "Q = V" IDENTICAL "%0.6" "" /end COMPU_METHOD
/begin COMPU_METHOD autosar_swc_val_CM_RRCR_6_Ri4ObjMtnChartc_984_dt "Q = V" IDENTICAL "%0.6" "" /end COMPU_METHOD
/begin COMPU_METHOD autosar_swc_val_CM_RRCR_6_Ri4ObjNrOffocst_984_dt "Q = V" IDENTICAL "%0.6" "" /end COMPU_METHOD
/begin COMPU_METHOD autosar_swc_val_CM_RRCR_6_Ri4ObjTrackSt_984_dt "Q = V" IDENTICAL "%0.6" "" /end COMPU_METHOD
/begin COMPU_METHOD autosar_swc_val_CM_RRCR_6_Ri4ObjTyp_984_dt "Q = V" IDENTICAL "%0.6" "" /end COMPU_METHOD
/begin COMPU_METHOD autosar_swc_val_CM_RRCR_6_Ri4ObjXDirAV_984_dt "Q = V" IDENTICAL "%8.6" "" /end COMPU_METHOD
/begin COMPU_METHOD autosar_swc_val_CM_RRCR_6_Ri4ObjXDirVStdDe_984_dt "Q = V" IDENTICAL "%8.6" "" /end COMPU_METHOD
/begin COMPU_METHOD autosar_swc_val_CM_RRCR_6_Ri4ObjXDirV_984_dt "Q = V" IDENTICAL "%8.6" "" /end COMPU_METHOD
/begin COMPU_METHOD autosar_swc_val_CM_RRCR_6_Ri4ObjYDirVStdDe_984_dt "Q = V" IDENTICAL "%8.6" "" /end COMPU_METHOD
/begin COMPU_METHOD autosar_swc_val_CM_RRCR_6_Ri4ObjYDirV_984_dt "Q = V" IDENTICAL "%8.6" "" /end COMPU_METHOD
/begin COMPU_METHOD autosar_swc_val_CM_RRCR_6_RollgCntr_984_dt "Q = V" IDENTICAL "%0.6" "" /end COMPU_METHOD
/begin COMPU_METHOD autosar_swc_val_CM_RRCR_7_CRC_986_dt "Q = V" IDENTICAL "%0.6" "" /end COMPU_METHOD
/begin COMPU_METHOD autosar_swc_val_CM_RRCR_7_Ri5HdTo_986_dt "Q = V" IDENTICAL "%8.6" "" /end COMPU_METHOD
/begin COMPU_METHOD autosar_swc_val_CM_RRCR_7_Ri5ObjBoxLen_986_dt "Q = V" IDENTICAL "%8.6" "" /end COMPU_METHOD
/begin COMPU_METHOD autosar_swc_val_CM_RRCR_7_Ri5ObjBoxWidth_986_dt "Q = V" IDENTICAL "%8.6" "" /end COMPU_METHOD
/begin COMPU_METHOD autosar_swc_val_CM_RRCR_7_Ri5ObjConf_986_dt "Q = V" IDENTICAL "%0.6" "" /end COMPU_METHOD
/begin COMPU_METHOD autosar_swc_val_CM_RRCR_7_Ri5ObjCoordXDstStdDe_986_dt "Q = V" IDENTICAL "%8.6" "" /end COMPU_METHOD
/begin COMPU_METHOD autosar_swc_val_CM_RRCR_7_Ri5ObjCoordX_986_dt "Q = V" IDENTICAL "%8.6" "" /end COMPU_METHOD
/begin COMPU_METHOD autosar_swc_val_CM_RRCR_7_Ri5ObjCoordYDstStdDe_986_dt "Q = V" IDENTICAL "%8.6" "" /end COMPU_METHOD
/begin COMPU_METHOD autosar_swc_val_CM_RRCR_7_Ri5ObjCoordY_986_dt "Q = V" IDENTICAL "%8.6" "" /end COMPU_METHOD
/begin COMPU_METHOD autosar_swc_val_CM_RRCR_7_Ri5ObjID_986_dt "Q = V" IDENTICAL "%0.6" "" /end COMPU_METHOD
/begin COMPU_METHOD autosar_swc_val_CM_RRCR_7_Ri5ObjMtnChartc_986_dt "Q = V" IDENTICAL "%0.6" "" /end COMPU_METHOD
/begin COMPU_METHOD autosar_swc_val_CM_RRCR_7_Ri5ObjNrOffocst_986_dt "Q = V" IDENTICAL "%0.6" "" /end COMPU_METHOD
/begin COMPU_METHOD autosar_swc_val_CM_RRCR_7_Ri5ObjTrackSt_986_dt "Q = V" IDENTICAL "%0.6" "" /end COMPU_METHOD
/begin COMPU_METHOD autosar_swc_val_CM_RRCR_7_Ri5ObjTyp_986_dt "Q = V" IDENTICAL "%0.6" "" /end COMPU_METHOD
/begin COMPU_METHOD autosar_swc_val_CM_RRCR_7_Ri5ObjXDirAV_986_dt "Q = V" IDENTICAL "%8.6" "" /end COMPU_METHOD
/begin COMPU_METHOD autosar_swc_val_CM_RRCR_7_Ri5ObjXDirVStdDe_986_dt "Q = V" IDENTICAL "%8.6" "" /end COMPU_METHOD
/begin COMPU_METHOD autosar_swc_val_CM_RRCR_7_Ri5ObjXDirV_986_dt "Q = V" IDENTICAL "%8.6" "" /end COMPU_METHOD
/begin COMPU_METHOD autosar_swc_val_CM_RRCR_7_Ri5ObjYDirVStdDe_986_dt "Q = V" IDENTICAL "%8.6" "" /end COMPU_METHOD
/begin COMPU_METHOD autosar_swc_val_CM_RRCR_7_Ri5ObjYDirV_986_dt "Q = V" IDENTICAL "%8.6" "" /end COMPU_METHOD
/begin COMPU_METHOD autosar_swc_val_CM_RRCR_7_RollgCntr_986_dt "Q = V" IDENTICAL "%0.6" "" /end COMPU_METHOD
/begin COMPU_METHOD autosar_swc_val_CM_RRCR_8_CRC_990_dt "Q = V" IDENTICAL "%0.6" "" /end COMPU_METHOD
/begin COMPU_METHOD autosar_swc_val_CM_RRCR_8_RollgCntr_990_dt "Q = V" IDENTICAL "%0.6" "" /end COMPU_METHOD
/begin COMPU_METHOD autosar_swc_val_CM_RRCR_8_TiStampLaten_990_dt "Q = V" IDENTICAL "%0.6" "" /end COMPU_METHOD
/begin COMPU_METHOD autosar_swc_val_CM_RZCU_2_CRC_699_dt "Q = V" IDENTICAL "%0.6" "" /end COMPU_METHOD
/begin COMPU_METHOD autosar_swc_val_CM_RZCU_2_Resd_699_dt "Q = V" IDENTICAL "%0.6" "" /end COMPU_METHOD
/begin COMPU_METHOD autosar_swc_val_CM_RZCU_2_RollgCntr_699_dt "Q = V" IDENTICAL "%0.6" "" /end COMPU_METHOD
/begin COMPU_METHOD autosar_swc_val_CM_RZCU_7_CRC_1258_dt "Q = V" IDENTICAL "%0.6" "" /end COMPU_METHOD
/begin COMPU_METHOD autosar_swc_val_CM_RZCU_7_RollgCntr_1258_dt "Q = V" IDENTICAL "%0.6" "" /end COMPU_METHOD
/begin COMPU_METHOD autosar_swc_val_CM_RZCU_RearWiperParkStatus_1258_dt "Q = V" IDENTICAL "%0.6" "" /end COMPU_METHOD
/begin COMPU_METHOD autosar_swc_val_CM_RZCU_RearWiperWipingStatus_1258_dt "Q = V" IDENTICAL "%0.6" "" /end COMPU_METHOD
/begin COMPU_METHOD autosar_swc_val_CM_Reserved_EDCActive_555_dt "Q = V" IDENTICAL "%0.6" "" /end COMPU_METHOD
/begin COMPU_METHOD autosar_swc_val_CM_Reserved_ESPLampInformation_555_dt "Q = V" IDENTICAL "%0.6" "" /end COMPU_METHOD
/begin COMPU_METHOD autosar_swc_val_CM_SAM_1_CRC_306_dt "Q = V" IDENTICAL "%0.6" "" /end COMPU_METHOD
/begin COMPU_METHOD autosar_swc_val_CM_SAM_1_Resd_306_dt "Q = V" IDENTICAL "%0.6" "" /end COMPU_METHOD
/begin COMPU_METHOD autosar_swc_val_CM_SAM_1_RollgCntr_306_dt "Q = V" IDENTICAL "%0.6" "" /end COMPU_METHOD
/begin COMPU_METHOD autosar_swc_val_CM_SAM_1_SteeringAngleSpeedVD_306_dt "Q = V" IDENTICAL "%0.6" "" /end COMPU_METHOD
/begin COMPU_METHOD autosar_swc_val_CM_SAM_1_SteeringAngleSpeed_306_dt "Q = V" IDENTICAL "%0.6" "" /end COMPU_METHOD
/begin COMPU_METHOD autosar_swc_val_CM_SAM_1_SteeringAngleVD_306_dt "Q = V" IDENTICAL "%0.6" "" /end COMPU_METHOD
/begin COMPU_METHOD autosar_swc_val_CM_SAM_1_SteeringAngle_306_dt "Q = V" IDENTICAL "%8.6" "" /end COMPU_METHOD
/begin COMPU_METHOD autosar_swc_val_CM_SCMActive_555_dt "Q = V" IDENTICAL "%0.6" "" /end COMPU_METHOD
/begin COMPU_METHOD autosar_swc_val_CM_SCMAvalable_555_dt "Q = V" IDENTICAL "%0.6" "" /end COMPU_METHOD
/begin COMPU_METHOD autosar_swc_val_CM_SwitchOffCruiseControl_152_dt "Q = V" IDENTICAL "%0.6" "" /end COMPU_METHOD
/begin COMPU_METHOD autosar_swc_val_CM_TrunkLockSts_699_dt "Q = V" IDENTICAL "%0.6" "" /end COMPU_METHOD
/begin COMPU_METHOD autosar_swc_val_CM_TrunkSts_699_dt "Q = V" IDENTICAL "%0.6" "" /end COMPU_METHOD
/begin COMPU_METHOD autosar_swc_val_CM_VehicleStandstill_555_dt "Q = V" IDENTICAL "%0.6" "" /end COMPU_METHOD
/begin COMPU_METHOD autosar_swc_val_CM_WheelBrakeForce_555_dt "Q = V" IDENTICAL "%0.6" "" /end COMPU_METHOD
/begin COMPU_METHOD autosar_swc_val_CM_double "Q = V" IDENTICAL "%15.10" "" /end COMPU_METHOD
/begin COMPU_METHOD autosar_swc_val_CM_single "Q = V" IDENTICAL "%8.6" "" /end COMPU_METHOD
/begin COMPU_METHOD autosar_swc_val_CM_uint16 "Q = V" IDENTICAL "%5.0" "" /end COMPU_METHOD
/begin COMPU_METHOD autosar_swc_val_CM_uint32 "Q = V" IDENTICAL "%10.0" "" /end COMPU_METHOD
/begin COMPU_METHOD autosar_swc_val_CM_uint64 "Q = V" IDENTICAL "%20.0" "" /end COMPU_METHOD
/begin COMPU_METHOD autosar_swc_val_CM_uint8 "Q = V" IDENTICAL "%3.0" "" /end COMPU_METHOD
/begin GROUP SwcIn_J3_LANE.Left_Road_Edge ""
 /begin REF_MEASUREMENT SwcIn_J3_LANE.Left_Road_Edge.LaneConfidence SwcIn_J3_LANE.Left_Road_Edge.LaneMeasuringStatus SwcIn_J3_LANE.Left_Road_Edge.LaneTypeClass SwcIn_J3_LANE.Left_Road_Edge.LaneMarkColor SwcIn_J3_LANE.Left_Road_Edge.LaneQuality SwcIn_J3_LANE.Left_Road_Edge.ObstacleFlag SwcIn_J3_LANE.Left_Road_Edge.LaneExtraNearPointType SwcIn_J3_LANE.Left_Road_Edge.LaneExtraFarPointType SwcIn_J3_LANE.Left_Road_Edge.LaneParsingConfidence SwcIn_J3_LANE.Left_Road_Edge.Stopline_Relevancy SwcIn_J3_LANE.Left_Road_Edge.LaneTrackID SwcIn_J3_LANE.Left_Road_Edge.LaneWidthMarking SwcIn_J3_LANE.Left_Road_Edge.LaneViewRangeStart SwcIn_J3_LANE.Left_Road_Edge.LaneViewRangeEnd SwcIn_J3_LANE.Left_Road_Edge.LaneModelC0 SwcIn_J3_LANE.Left_Road_Edge.LaneModelC1 SwcIn_J3_LANE.Left_Road_Edge.LaneModelC2 SwcIn_J3_LANE.Left_Road_Edge.LaneModelC3 SwcIn_J3_LANE.Left_Road_Edge.LaneTLC SwcIn_J3_LANE.Left_Road_Edge.LaneExtraFarPointPosX SwcIn_J3_LANE.Left_Road_Edge.LaneExtraFarPointPosY SwcIn_J3_LANE.Left_Road_Edge.LaneExtraNearPointPosX SwcIn_J3_LANE.Left_Road_Edge.LaneExtraNearPointPosY /end REF_MEASUREMENT
/end GROUP
/begin GROUP SwcIn_J3_LANE.LinePoints "" /begin REF_MEASUREMENT SwcIn_J3_LANE.LinePoints.timestamp /end REF_MEASUREMENT /end GROUP
/begin GROUP SwcIn_J3_LANE.LinePoints.linepoints[0] "" /begin REF_MEASUREMENT SwcIn_J3_LANE.LinePoints.linepoints[0].id /end REF_MEASUREMENT /end GROUP
/begin GROUP SwcIn_J3_LANE.LinePoints.linepoints[0].point[0] ""
 /begin REF_MEASUREMENT SwcIn_J3_LANE.LinePoints.linepoints[0].point[0].point_x SwcIn_J3_LANE.LinePoints.linepoints[0].point[0].point_y /end REF_MEASUREMENT
/end GROUP
/begin GROUP SwcIn_J3_LANE.Right_Cone_Road_Edge ""
 /begin REF_MEASUREMENT SwcIn_J3_LANE.Right_Cone_Road_Edge.ConeRoadEdgeConfidence SwcIn_J3_LANE.Right_Cone_Road_Edge.ConeRoadEdgeMeasuringStatus SwcIn_J3_LANE.Right_Cone_Road_Edge.ConeRoadEdgeTypeClass SwcIn_J3_LANE.Right_Cone_Road_Edge.ConeRoadEdgeQuality SwcIn_J3_LANE.Right_Cone_Road_Edge.ConeRoadEdgeParsingConfidence SwcIn_J3_LANE.Right_Cone_Road_Edge.ConeRoadEdgeTrackID SwcIn_J3_LANE.Right_Cone_Road_Edge.ConeRoadEdgeViewRangeStart SwcIn_J3_LANE.Right_Cone_Road_Edge.ConeRoadEdgeViewRangeEnd SwcIn_J3_LANE.Right_Cone_Road_Edge.ConeRoadEdgeModelC0 SwcIn_J3_LANE.Right_Cone_Road_Edge.ConeRoadEdgeModelC1 SwcIn_J3_LANE.Right_Cone_Road_Edge.ConeRoadEdgeModelC2 SwcIn_J3_LANE.Right_Cone_Road_Edge.ConeRoadEdgeModelC3 SwcIn_J3_LANE.Right_Cone_Road_Edge.ConeRoadEdgeTLC /end REF_MEASUREMENT
/end GROUP
/begin GROUP SwcIn_J3_LANE.Right_LKA_Lane ""
 /begin REF_MEASUREMENT SwcIn_J3_LANE.Right_LKA_Lane.LaneConfidence SwcIn_J3_LANE.Right_LKA_Lane.LaneMeasuringStatus SwcIn_J3_LANE.Right_LKA_Lane.LaneTypeClass SwcIn_J3_LANE.Right_LKA_Lane.LaneMarkColor SwcIn_J3_LANE.Right_LKA_Lane.LaneQuality SwcIn_J3_LANE.Right_LKA_Lane.LaneCrossing SwcIn_J3_LANE.Right_LKA_Lane.ObstacleFlag SwcIn_J3_LANE.Right_LKA_Lane.LaneExtraNearPointType SwcIn_J3_LANE.Right_LKA_Lane.LaneExtraFarPointType SwcIn_J3_LANE.Right_LKA_Lane.LaneParsingConfidence SwcIn_J3_LANE.Right_LKA_Lane.Stopline_Relevancy SwcIn_J3_LANE.Right_LKA_Lane.LaneTrackID SwcIn_J3_LANE.Right_LKA_Lane.LaneWidthMarking SwcIn_J3_LANE.Right_LKA_Lane.LaneViewRangeStart SwcIn_J3_LANE.Right_LKA_Lane.LaneViewRangeEnd SwcIn_J3_LANE.Right_LKA_Lane.LaneModelC0 SwcIn_J3_LANE.Right_LKA_Lane.LaneModelC1 SwcIn_J3_LANE.Right_LKA_Lane.LaneModelC2 SwcIn_J3_LANE.Right_LKA_Lane.LaneModelC3 SwcIn_J3_LANE.Right_LKA_Lane.LaneTLC SwcIn_J3_LANE.Right_LKA_Lane.LaneExtraFarPointPosX SwcIn_J3_LANE.Right_LKA_Lane.LaneExtraFarPointPosY SwcIn_J3_LANE.Right_LKA_Lane.LaneExtraNearPointPosX SwcIn_J3_LANE.Right_LKA_Lane.LaneExtraNearPointPosY /end REF_MEASUREMENT
/end GROUP
/begin GROUP SwcIn_J3_LANE.Right_Next_Lane ""
 /begin REF_MEASUREMENT SwcIn_J3_LANE.Right_Next_Lane.LaneConfidence SwcIn_J3_LANE.Right_Next_Lane.LaneMeasuringStatus SwcIn_J3_LANE.Right_Next_Lane.LaneTypeClass SwcIn_J3_LANE.Right_Next_Lane.LaneMarkColor SwcIn_J3_LANE.Right_Next_Lane.LaneQuality SwcIn_J3_LANE.Right_Next_Lane.ObstacleFlag SwcIn_J3_LANE.Right_Next_Lane.LaneExtraNearPointType SwcIn_J3_LANE.Right_Next_Lane.LaneExtraFarPointType SwcIn_J3_LANE.Right_Next_Lane.LaneParsingConfidence SwcIn_J3_LANE.Right_Next_Lane.LaneTrackID SwcIn_J3_LANE.Right_Next_Lane.LaneWidthMarking SwcIn_J3_LANE.Right_Next_Lane.LaneViewRangeStart SwcIn_J3_LANE.Right_Next_Lane.LaneViewRangeEnd SwcIn_J3_LANE.Right_Next_Lane.LaneModelC0 SwcIn_J3_LANE.Right_Next_Lane.LaneModelC1 SwcIn_J3_LANE.Right_Next_Lane.LaneModelC2 SwcIn_J3_LANE.Right_Next_Lane.LaneModelC3 SwcIn_J3_LANE.Right_Next_Lane.LaneExtraFarPointPosX SwcIn_J3_LANE.Right_Next_Lane.LaneExtraFarPointPosY SwcIn_J3_LANE.Right_Next_Lane.LaneExtraNearPointPosX SwcIn_J3_LANE.Right_Next_Lane.LaneExtraNearPointPosY /end REF_MEASUREMENT
/end GROUP
/begin GROUP SwcIn_J3_LANE.Right_Out_Lane ""
 /begin REF_MEASUREMENT SwcIn_J3_LANE.Right_Out_Lane.LaneConfidence SwcIn_J3_LANE.Right_Out_Lane.LaneMeasuringStatus SwcIn_J3_LANE.Right_Out_Lane.LaneTypeClass SwcIn_J3_LANE.Right_Out_Lane.LaneMarkColor SwcIn_J3_LANE.Right_Out_Lane.LaneQuality SwcIn_J3_LANE.Right_Out_Lane.LaneCrossing SwcIn_J3_LANE.Right_Out_Lane.ObstacleFlag SwcIn_J3_LANE.Right_Out_Lane.LaneExtraNearPointType SwcIn_J3_LANE.Right_Out_Lane.LaneExtraFarPointType SwcIn_J3_LANE.Right_Out_Lane.LaneParsingConfidence SwcIn_J3_LANE.Right_Out_Lane.Stopline_Relevancy SwcIn_J3_LANE.Right_Out_Lane.LaneTrackID SwcIn_J3_LANE.Right_Out_Lane.LaneWidthMarking SwcIn_J3_LANE.Right_Out_Lane.LaneViewRangeStart SwcIn_J3_LANE.Right_Out_Lane.LaneViewRangeEnd SwcIn_J3_LANE.Right_Out_Lane.LaneModelC0 SwcIn_J3_LANE.Right_Out_Lane.LaneModelC1 SwcIn_J3_LANE.Right_Out_Lane.LaneModelC2 SwcIn_J3_LANE.Right_Out_Lane.LaneModelC3 SwcIn_J3_LANE.Right_Out_Lane.LaneTLC SwcIn_J3_LANE.Right_Out_Lane.LaneExtraFarPointPosX SwcIn_J3_LANE.Right_Out_Lane.LaneExtraFarPointPosY SwcIn_J3_LANE.Right_Out_Lane.LaneExtraNearPointPosX SwcIn_J3_LANE.Right_Out_Lane.LaneExtraNearPointPosY /end REF_MEASUREMENT
/end GROUP
/begin GROUP SwcIn_J3_LANE.Right_Road_Edge ""
 /begin REF_MEASUREMENT SwcIn_J3_LANE.Right_Road_Edge.LaneConfidence SwcIn_J3_LANE.Right_Road_Edge.LaneMeasuringStatus SwcIn_J3_LANE.Right_Road_Edge.LaneTypeClass SwcIn_J3_LANE.Right_Road_Edge.LaneMarkColor SwcIn_J3_LANE.Right_Road_Edge.LaneQuality SwcIn_J3_LANE.Right_Road_Edge.ObstacleFlag SwcIn_J3_LANE.Right_Road_Edge.LaneExtraNearPointType SwcIn_J3_LANE.Right_Road_Edge.LaneExtraFarPointType SwcIn_J3_LANE.Right_Road_Edge.LaneParsingConfidence SwcIn_J3_LANE.Right_Road_Edge.Stopline_Relevancy SwcIn_J3_LANE.Right_Road_Edge.LaneTrackID SwcIn_J3_LANE.Right_Road_Edge.LaneWidthMarking SwcIn_J3_LANE.Right_Road_Edge.LaneViewRangeStart SwcIn_J3_LANE.Right_Road_Edge.LaneViewRangeEnd SwcIn_J3_LANE.Right_Road_Edge.LaneModelC0 SwcIn_J3_LANE.Right_Road_Edge.LaneModelC1 SwcIn_J3_LANE.Right_Road_Edge.LaneModelC2 SwcIn_J3_LANE.Right_Road_Edge.LaneModelC3 SwcIn_J3_LANE.Right_Road_Edge.LaneTLC SwcIn_J3_LANE.Right_Road_Edge.LaneExtraFarPointPosX SwcIn_J3_LANE.Right_Road_Edge.LaneExtraFarPointPosY SwcIn_J3_LANE.Right_Road_Edge.LaneExtraNearPointPosX SwcIn_J3_LANE.Right_Road_Edge.LaneExtraNearPointPosY /end REF_MEASUREMENT
/end GROUP
/begin GROUP SwcIn_J3_LANE.Road_Information ""
 /begin SUB_GROUP SwcIn_J3_LANE.Road_Information.CrossWalkBox SwcIn_J3_LANE.Road_Information.CrossWalkCoor /end SUB_GROUP
 /begin REF_MEASUREMENT SwcIn_J3_LANE.Road_Information.RoadType SwcIn_J3_LANE.Road_Information.CurrentWeather SwcIn_J3_LANE.Road_Information.CurrentTime SwcIn_J3_LANE.Road_Information.LightType SwcIn_J3_LANE.Road_Information.DisStoplineValid SwcIn_J3_LANE.Road_Information.ProtocolMajorVersion SwcIn_J3_LANE.Road_Information.ProtocolMinorVersion SwcIn_J3_LANE.Road_Information.TerrainType SwcIn_J3_LANE.Road_Information.CrossWalkValid SwcIn_J3_LANE.Road_Information.DisStopline /end REF_MEASUREMENT
/end GROUP
/begin GROUP SwcIn_J3_LANE.Road_Information.CrossWalkBox ""
 /begin REF_MEASUREMENT SwcIn_J3_LANE.Road_Information.CrossWalkBox.corner_x_vec SwcIn_J3_LANE.Road_Information.CrossWalkBox.corner_y_vec /end REF_MEASUREMENT
/end GROUP
/begin GROUP SwcIn_J3_LANE.Road_Information.CrossWalkCoor ""
 /begin REF_MEASUREMENT SwcIn_J3_LANE.Road_Information.CrossWalkCoor.x SwcIn_J3_LANE.Road_Information.CrossWalkCoor.y SwcIn_J3_LANE.Road_Information.CrossWalkCoor.mod /end REF_MEASUREMENT
/end GROUP
/begin GROUP SwcIn_MFS_2 ""
 /begin REF_MEASUREMENT SwcIn_MFS_2.MFS_2_CRC SwcIn_MFS_2.MFS_2_RollgCntr SwcIn_MFS_2.MFS_Cruise_Control SwcIn_MFS_2.MFS_RESPlus SwcIn_MFS_2.MFS_SETMinus SwcIn_MFS_2.MFS_Time_Gap_Reduce SwcIn_MFS_2.MFS_Time_Gap_Add SwcIn_MFS_2.MFS_Rsp_Error SwcIn_MFS_2.MFS_LeftRoller SwcIn_MFS_2.MFS_LeftRollerMiddleKey SwcIn_MFS_2.MFS_LeRollrUpDwnAdjSteps /end REF_MEASUREMENT
/end GROUP
/begin GROUP SwcIn_ONEBOX_1 ""
 /begin REF_MEASUREMENT SwcIn_ONEBOX_1.ONEBOX_1_CRC1 SwcIn_ONEBOX_1.ONEBOX_1_RollgCntr1 SwcIn_ONEBOX_1.ONEBOX_1_Resd1 SwcIn_ONEBOX_1.ABS_ESP_1_VehicleSpeedVSOSig SwcIn_ONEBOX_1.ESP1_VehicleSpeedVSOSigValidData SwcIn_ONEBOX_1.ABS_ESP_1_EBDFailSts SwcIn_ONEBOX_1.ABS_ESP_1_ABSFailSts SwcIn_ONEBOX_1.IPB_SimulatorPressure SwcIn_ONEBOX_1.IPB_SimulatorPressureStatus SwcIn_ONEBOX_1.ABS_ESP_1_ABSActive SwcIn_ONEBOX_1.ABS_ESP_1_VDCFailSts SwcIn_ONEBOX_1.ABS_ESP_1_VDCActive SwcIn_ONEBOX_1.ABS_ESP_1_TCSFailSts SwcIn_ONEBOX_1.ABS_ESP_1_TCSActive SwcIn_ONEBOX_1.BrakeSystemType SwcIn_ONEBOX_1.ABS_ESP_1_HHCFailSts SwcIn_ONEBOX_1.HHCActive SwcIn_ONEBOX_1.ABS_ESP_1_HDCCtrlSts SwcIn_ONEBOX_1.ABS_ESP_1_HDCFailSts SwcIn_ONEBOX_1.HLRequest SwcIn_ONEBOX_1.ABS_ESP_1_ESPSwitchStatus SwcIn_ONEBOX_1.BLRequestController SwcIn_ONEBOX_1.SwitchOffCruiseControl SwcIn_ONEBOX_1.ONEBOX_1_CRC2 SwcIn_ONEBOX_1.ONEBOX_1_RollgCntr2 SwcIn_ONEBOX_1.ONEBOX_1_Resd2 SwcIn_ONEBOX_1.IPB_1_MbRegenTargetWheel SwcIn_ONEBOX_1.IPB_1_MbRegenTargetWheelQ SwcIn_ONEBOX_1.AEBdecActive SwcIn_ONEBOX_1.AEBdecAvailable SwcIn_ONEBOX_1.CDPActive SwcIn_ONEBOX_1.CDPFailSts /end REF_MEASUREMENT
/end GROUP
/begin GROUP SwcIn_ONEBOX_2_G ""
 /begin REF_MEASUREMENT SwcIn_ONEBOX_2_G.ONEBOX_2_G_CRC SwcIn_ONEBOX_2_G.ONEBOX_2_G_RollgCntr SwcIn_ONEBOX_2_G.ONEBOX_2_G_Resd SwcIn_ONEBOX_2_G.BrakesystemFailSts /end REF_MEASUREMENT
/end GROUP
/begin GROUP SwcIn_ONEBOX_3 ""
 /begin REF_MEASUREMENT SwcIn_ONEBOX_3.ONEBOX_3_CRC1 SwcIn_ONEBOX_3.ONEBOX_3_RollgCntr1 SwcIn_ONEBOX_3.ONEBOX_3_Resd1 SwcIn_ONEBOX_3.AVHSts SwcIn_ONEBOX_3.VehicleStandstill SwcIn_ONEBOX_3.NoBrakeForce SwcIn_ONEBOX_3.AVHFailSts SwcIn_ONEBOX_3.Reserved_EDCActive SwcIn_ONEBOX_3.ECDTempOff SwcIn_ONEBOX_3.DCFail SwcIn_ONEBOX_3.CDDActive SwcIn_ONEBOX_3.CDDAvailable SwcIn_ONEBOX_3.Reserved_ESPLampInformation SwcIn_ONEBOX_3.ONEBOX_3_CRC2 SwcIn_ONEBOX_3.ONEBOX_3_RollgCntr2 SwcIn_ONEBOX_3.ONEBOX_3_Resd2 SwcIn_ONEBOX_3.WheelBrakeForce SwcIn_ONEBOX_3.ONEBOX_3_CRC4 SwcIn_ONEBOX_3.ONEBOX_3_RollgCntr4 SwcIn_ONEBOX_3.ONEBOX_3_Resd4 SwcIn_ONEBOX_3.IPB_PlungerPressureValidData SwcIn_ONEBOX_3.IPB_InputRodStrokeStatus SwcIn_ONEBOX_3.SCMActive SwcIn_ONEBOX_3.SCMAvalable SwcIn_ONEBOX_3.IPB_PlungerPressure SwcIn_ONEBOX_3.IPB_InputRodStroke SwcIn_ONEBOX_3.DTC_Intervention SwcIn_ONEBOX_3.DTCAvailable SwcIn_ONEBOX_3.DTCActive /end REF_MEASUREMENT
/end GROUP
/begin GROUP SwcIn_ONEBOX_4 ""
 /begin REF_MEASUREMENT SwcIn_ONEBOX_4.ONEBOX_4_CRC1 SwcIn_ONEBOX_4.ONEBOX_4_RollgCntr1 SwcIn_ONEBOX_4.ONEBOX_4_Resd1 SwcIn_ONEBOX_4.LHFWheelSpeedRPM SwcIn_ONEBOX_4.RHFWheelSpeedRPM SwcIn_ONEBOX_4.LHRWheelSpeedRPM SwcIn_ONEBOX_4.ONEBOX_4_CRC2 SwcIn_ONEBOX_4.ONEBOX_4_RollgCntr2 SwcIn_ONEBOX_4.ONEBOX_4_Resd2 SwcIn_ONEBOX_4.RHRWheelSpeedRPM SwcIn_ONEBOX_4.LHRPulseCounterFailSts SwcIn_ONEBOX_4.LHRPulseCounter SwcIn_ONEBOX_4.RHRPulseCounterFailSts SwcIn_ONEBOX_4.RHRPulseCounter SwcIn_ONEBOX_4.ONEBOX_4_CRC3 SwcIn_ONEBOX_4.ONEBOX_4_RollgCntr3 SwcIn_ONEBOX_4.ONEBOX_4_Resd3 SwcIn_ONEBOX_4.RHFPulseCounterFailSts SwcIn_ONEBOX_4.RHFPulseCounter SwcIn_ONEBOX_4.LHFPulseCounterFailSts SwcIn_ONEBOX_4.LHFPulseCounter SwcIn_ONEBOX_4.LHFWheelSpeedRaw SwcIn_ONEBOX_4.LHFWheelDriveDirection SwcIn_ONEBOX_4.LHFWheelSpeedRawValidData SwcIn_ONEBOX_4.ONEBOX_4_CRC4 SwcIn_ONEBOX_4.ONEBOX_4_RollgCntr4 SwcIn_ONEBOX_4.ONEBOX_4_Resd4 SwcIn_ONEBOX_4.RHFWheelSpeedRaw SwcIn_ONEBOX_4.RHFWheelDriveDirection SwcIn_ONEBOX_4.RHFWheelSpeedRawValidData SwcIn_ONEBOX_4.LHRWheelSpeedRaw SwcIn_ONEBOX_4.LHRWheelDriveDirection SwcIn_ONEBOX_4.LHRWheelSpeedRawValidData SwcIn_ONEBOX_4.RHRWheelSpeedRaw SwcIn_ONEBOX_4.RHRWheelDriveDirection SwcIn_ONEBOX_4.RHRWheelSpeedRawValidData /end REF_MEASUREMENT
/end GROUP
/begin GROUP SwcIn_ONEBOX_5 ""
 /begin REF_MEASUREMENT SwcIn_ONEBOX_5.ONEBOX_5_CRC1 SwcIn_ONEBOX_5.ONEBOX_5_RollgCntr1 SwcIn_ONEBOX_5.ONEBOX_5_Resd1 SwcIn_ONEBOX_5.ONEBOX_5_PilotParkBrkDecCtlAvl SwcIn_ONEBOX_5.ONEBOX_5_PilotParkBrkDecActSts SwcIn_ONEBOX_5.ONEBOX_5_CddAdcActiveVehHld SwcIn_ONEBOX_5.ONEBOX_5_APCFailureSts SwcIn_ONEBOX_5.ONEBOX_5_APCStatus SwcIn_ONEBOX_5.ONEBOX_5_ApaAvl SwcIn_ONEBOX_5.ONEBOX_5_RpaAvl SwcIn_ONEBOX_5.ONEBOX_5_MebAvl SwcIn_ONEBOX_5.ONEBOX_5_CddApActiveVehHld SwcIn_ONEBOX_5.ONEBOX_5_SysBrkP SwcIn_ONEBOX_5.ONEBOX_5_SysBrkPVld SwcIn_ONEBOX_5.ONEBOX_5_AbpActSts SwcIn_ONEBOX_5.ONEBOX_5_AbpAvlSts SwcIn_ONEBOX_5.ONEBOX_5_AwbActSts SwcIn_ONEBOX_5.ONEBOX_5_AwbAvlSts SwcIn_ONEBOX_5.ONEBOX_5_AbaActSts SwcIn_ONEBOX_5.ONEBOX_5_AbaAvlSts SwcIn_ONEBOX_5.ONEBOX_5_AbaLvlSts /end REF_MEASUREMENT
/end GROUP
/begin GROUP SwcIn_PPMID_1 ""
 /begin REF_MEASUREMENT SwcIn_PPMID_1.PPMID_1_HWSt SwcIn_PPMID_1.PPMID_1_PPSt SwcIn_PPMID_1.PPMID_1_PPMICounter SwcIn_PPMID_1.PPMID_1_PPMISt /end REF_MEASUREMENT
/end GROUP
/begin GROUP SwcIn_RLCR_1 ""
 /begin REF_MEASUREMENT SwcIn_RLCR_1.RLCR_1_CRC1 SwcIn_RLCR_1.RLCR_1_RollgCntr1 SwcIn_RLCR_1.RLCR_1_Resd1 SwcIn_RLCR_1.RLCR_1_SysSt SwcIn_RLCR_1.RLCR_1_BlkSts SwcIn_RLCR_1.RLCR_1_BSDWarn SwcIn_RLCR_1.RLCR_1_DOWWarn SwcIn_RLCR_1.RLCR_1_DowLock SwcIn_RLCR_1.RLCR_1_ELK_Collision_flag SwcIn_RLCR_1.RLCR_1_ELK_CollisionFlagValid /end REF_MEASUREMENT
/end GROUP
/begin GROUP SwcIn_RLCR_2 ""
 /begin REF_MEASUREMENT SwcIn_RLCR_2.RLCR_2_CRC1 SwcIn_RLCR_2.RLCR_2_RollgCntr1 SwcIn_RLCR_2.RLCR_2_Resd1 SwcIn_RLCR_2.RLCR_2_RCWWarn SwcIn_RLCR_2.RLCR_2_RCTAWarn SwcIn_RLCR_2.RLCR_2_RCTBWarn SwcIn_RLCR_2.RLCR_2_RCTBReq SwcIn_RLCR_2.RLCR_2_RCTBCtrlA SwcIn_RLCR_2.RLCR_2_BSDLCWONOFFSts SwcIn_RLCR_2.RLCR_2_DOWONOFFSts SwcIn_RLCR_2.RLCR_2_RCWONOFFSts SwcIn_RLCR_2.RLCR_2_RCTARCTBONOFFSts /end REF_MEASUREMENT
/end GROUP
/begin GROUP SwcIn_RLCR_3 ""
 /begin REF_MEASUREMENT SwcIn_RLCR_3.RLCR_3_CRC SwcIn_RLCR_3.RLCR_3_RollgCntr SwcIn_RLCR_3.RLCR_3_Le1ObjBoxLen SwcIn_RLCR_3.RLCR_3_Le1ObjBoxWidth SwcIn_RLCR_3.RLCR_3_Le1HdTo SwcIn_RLCR_3.RLCR_3_Le1ObjID SwcIn_RLCR_3.RLCR_3_Le1ObjCoordY SwcIn_RLCR_3.RLCR_3_Le1ObjCoordX SwcIn_RLCR_3.RLCR_3_Le1ObjXDirAV SwcIn_RLCR_3.RLCR_3_Le1ObjYDirV SwcIn_RLCR_3.RLCR_3_Le1ObjXDirV SwcIn_RLCR_3.RLCR_3_Le1ObjMtnChartc SwcIn_RLCR_3.RLCR_3_Le1ObjTyp SwcIn_RLCR_3.RLCR_3_Le1ObjConf SwcIn_RLCR_3.RLCR_3_Le1ObjNrOffocst SwcIn_RLCR_3.RLCR_3_Le1ObjTrackSt SwcIn_RLCR_3.RLCR_3_Le1ObjCoordXDstStdDe SwcIn_RLCR_3.RLCR_3_Le1ObjCoordYDstStdDe SwcIn_RLCR_3.RLCR_3_Le1ObjXDirVStdDe SwcIn_RLCR_3.RLCR_3_Le1ObjYDirVStdDe /end REF_MEASUREMENT
/end GROUP
/begin GROUP SwcIn_RLCR_4 ""
 /begin REF_MEASUREMENT SwcIn_RLCR_4.RLCR_4_CRC SwcIn_RLCR_4.RLCR_4_RollgCntr SwcIn_RLCR_4.RLCR_4_Le2ObjBoxLen SwcIn_RLCR_4.RLCR_4_Le2ObjBoxWidth SwcIn_RLCR_4.RLCR_4_Le2HdTo SwcIn_RLCR_4.RLCR_4_Le2ObjID SwcIn_RLCR_4.RLCR_4_Le2ObjCoordY SwcIn_RLCR_4.RLCR_4_Le2ObjCoordX SwcIn_RLCR_4.RLCR_4_Le2ObjXDirAV SwcIn_RLCR_4.RLCR_4_Le2ObjYDirV SwcIn_RLCR_4.RLCR_4_Le2ObjXDirV SwcIn_RLCR_4.RLCR_4_Le2ObjMtnChartc SwcIn_RLCR_4.RLCR_4_Le2ObjTyp SwcIn_RLCR_4.RLCR_4_Le2ObjConf SwcIn_RLCR_4.RLCR_4_Le2ObjNrOffocst SwcIn_RLCR_4.RLCR_4_Le2ObjTrackSt SwcIn_RLCR_4.RLCR_4_Le2ObjCoordXDstStdDe SwcIn_RLCR_4.RLCR_4_Le2ObjCoordYDstStdDe SwcIn_RLCR_4.RLCR_4_Le2ObjXDirVStdDe SwcIn_RLCR_4.RLCR_4_Le2ObjYDirVStdDe /end REF_MEASUREMENT
/end GROUP
/begin GROUP SwcIn_RLCR_5 ""
 /begin REF_MEASUREMENT SwcIn_RLCR_5.RLCR_5_CRC SwcIn_RLCR_5.RLCR_5_RollgCntr SwcIn_RLCR_5.RLCR_5_Le3ObjBoxLen SwcIn_RLCR_5.RLCR_5_Le3ObjBoxWidth SwcIn_RLCR_5.RLCR_5_Le3HdTo SwcIn_RLCR_5.RLCR_5_Le3ObjID SwcIn_RLCR_5.RLCR_5_Le3ObjCoordY SwcIn_RLCR_5.RLCR_5_Le3ObjCoordX SwcIn_RLCR_5.RLCR_5_Le3ObjXDirAV SwcIn_RLCR_5.RLCR_5_Le3ObjYDirV SwcIn_RLCR_5.RLCR_5_Le3ObjXDirV SwcIn_RLCR_5.RLCR_5_Le3ObjMtnChartc SwcIn_RLCR_5.RLCR_5_Le3ObjTyp SwcIn_RLCR_5.RLCR_5_Le3ObjConf SwcIn_RLCR_5.RLCR_5_Le3ObjNrOffocst SwcIn_RLCR_5.RLCR_5_Le3ObjTrackSt SwcIn_RLCR_5.RLCR_5_Le3ObjCoordXDstStdDe SwcIn_RLCR_5.RLCR_5_Le3ObjCoordYDstStdDe SwcIn_RLCR_5.RLCR_5_Le3ObjXDirVStdDe SwcIn_RLCR_5.RLCR_5_Le3ObjYDirVStdDe /end REF_MEASUREMENT
/end GROUP
/begin GROUP SwcIn_RLCR_6 ""
 /begin REF_MEASUREMENT SwcIn_RLCR_6.RLCR_6_CRC SwcIn_RLCR_6.RLCR_6_RollgCntr SwcIn_RLCR_6.RLCR_6_Le4ObjBoxLen SwcIn_RLCR_6.RLCR_6_Le4ObjBoxWidth SwcIn_RLCR_6.RLCR_6_Le4HdTo SwcIn_RLCR_6.RLCR_6_Le4ObjID SwcIn_RLCR_6.RLCR_6_Le4ObjCoordY SwcIn_RLCR_6.RLCR_6_Le4ObjCoordX SwcIn_RLCR_6.RLCR_6_Le4ObjXDirAV SwcIn_RLCR_6.RLCR_6_Le4ObjYDirV SwcIn_RLCR_6.RLCR_6_Le4ObjXDirV SwcIn_RLCR_6.RLCR_6_Le4ObjMtnChartc SwcIn_RLCR_6.RLCR_6_Le4ObjTyp SwcIn_RLCR_6.RLCR_6_Le4ObjConf SwcIn_RLCR_6.RLCR_6_Le4ObjNrOffocst SwcIn_RLCR_6.RLCR_6_Le4ObjTrackSt SwcIn_RLCR_6.RLCR_6_Le4ObjCoordXDstStdDe SwcIn_RLCR_6.RLCR_6_Le4ObjCoordYDstStdDe SwcIn_RLCR_6.RLCR_6_Le4ObjXDirVStdDe SwcIn_RLCR_6.RLCR_6_Le4ObjYDirVStdDe /end REF_MEASUREMENT
/end GROUP
/begin GROUP SwcIn_RLCR_7 ""
 /begin REF_MEASUREMENT SwcIn_RLCR_7.RLCR_7_CRC SwcIn_RLCR_7.RLCR_7_RollgCntr SwcIn_RLCR_7.RLCR_7_Le5ObjBoxLen SwcIn_RLCR_7.RLCR_7_Le5ObjBoxWidth SwcIn_RLCR_7.RLCR_7_Le5HdTo SwcIn_RLCR_7.RLCR_7_Le5ObjID SwcIn_RLCR_7.RLCR_7_Le5ObjCoordY SwcIn_RLCR_7.RLCR_7_Le5ObjCoordX SwcIn_RLCR_7.RLCR_7_Le5ObjXDirAV SwcIn_RLCR_7.RLCR_7_Le5ObjYDirV SwcIn_RLCR_7.RLCR_7_Le5ObjXDirV SwcIn_RLCR_7.RLCR_7_Le5ObjMtnChartc SwcIn_RLCR_7.RLCR_7_Le5ObjTyp SwcIn_RLCR_7.RLCR_7_Le5ObjConf SwcIn_RLCR_7.RLCR_7_Le5ObjNrOffocst SwcIn_RLCR_7.RLCR_7_Le5ObjTrackSt SwcIn_RLCR_7.RLCR_7_Le5ObjCoordXDstStdDe SwcIn_RLCR_7.RLCR_7_Le5ObjCoordYDstStdDe SwcIn_RLCR_7.RLCR_7_Le5ObjXDirVStdDe SwcIn_RLCR_7.RLCR_7_Le5ObjYDirVStdDe /end REF_MEASUREMENT
/end GROUP
/begin GROUP SwcIn_RLCR_8 ""
 /begin REF_MEASUREMENT SwcIn_RLCR_8.RLCR_8_CRC SwcIn_RLCR_8.RLCR_8_RollgCntr SwcIn_RLCR_8.RLCR_8_TiStampLaten /end REF_MEASUREMENT
/end GROUP
/begin GROUP SwcIn_RRCR_1 ""
 /begin REF_MEASUREMENT SwcIn_RRCR_1.RRCR_1_CRC1 SwcIn_RRCR_1.RRCR_1_RollgCntr1 SwcIn_RRCR_1.RRCR_1_Resd1 SwcIn_RRCR_1.RRCR_1_SysSt SwcIn_RRCR_1.RRCR_1_BlkSts SwcIn_RRCR_1.RRCR_1_BSDWarn SwcIn_RRCR_1.RRCR_1_DOWWarn SwcIn_RRCR_1.RRCR_1_DowLock SwcIn_RRCR_1.RRCR_1_ELK_Collision_flag SwcIn_RRCR_1.RRCR_1_ELK_CollisionFlagValid /end REF_MEASUREMENT
/end GROUP
/begin GROUP SwcIn_RRCR_3 ""
 /begin REF_MEASUREMENT SwcIn_RRCR_3.RRCR_3_CRC SwcIn_RRCR_3.RRCR_3_RollgCntr SwcIn_RRCR_3.RRCR_3_Ri1ObjBoxLen SwcIn_RRCR_3.RRCR_3_Ri1ObjBoxWidth SwcIn_RRCR_3.RRCR_3_Ri1HdTo SwcIn_RRCR_3.RRCR_3_Ri1ObjID SwcIn_RRCR_3.RRCR_3_Ri1ObjCoordY SwcIn_RRCR_3.RRCR_3_Ri1ObjCoordX SwcIn_RRCR_3.RRCR_3_Ri1ObjXDirAV SwcIn_RRCR_3.RRCR_3_Ri1ObjYDirV SwcIn_RRCR_3.RRCR_3_Ri1ObjXDirV SwcIn_RRCR_3.RRCR_3_Ri1ObjMtnChartc SwcIn_RRCR_3.RRCR_3_Ri1ObjTyp SwcIn_RRCR_3.RRCR_3_Ri1ObjConf SwcIn_RRCR_3.RRCR_3_Ri1ObjNrOffocst SwcIn_RRCR_3.RRCR_3_Ri1ObjTrackSt SwcIn_RRCR_3.RRCR_3_Ri1ObjCoordXDstStdDe SwcIn_RRCR_3.RRCR_3_Ri1ObjCoordYDstStdDe SwcIn_RRCR_3.RRCR_3_Ri1ObjXDirVStdDe SwcIn_RRCR_3.RRCR_3_Ri1ObjYDirVStdDe /end REF_MEASUREMENT
/end GROUP
/begin GROUP SwcIn_RRCR_4 ""
 /begin REF_MEASUREMENT SwcIn_RRCR_4.RRCR_4_CRC SwcIn_RRCR_4.RRCR_4_RollgCntr SwcIn_RRCR_4.RRCR_4_Ri2ObjBoxLen SwcIn_RRCR_4.RRCR_4_Ri2ObjBoxWidth SwcIn_RRCR_4.RRCR_4_Ri2HdTo SwcIn_RRCR_4.RRCR_4_Ri2ObjID SwcIn_RRCR_4.RRCR_4_Ri2ObjCoordY SwcIn_RRCR_4.RRCR_4_Ri2ObjCoordX SwcIn_RRCR_4.RRCR_4_Ri2ObjXDirAV SwcIn_RRCR_4.RRCR_4_Ri2ObjYDirV SwcIn_RRCR_4.RRCR_4_Ri2ObjXDirV SwcIn_RRCR_4.RRCR_4_Ri2ObjMtnChartc SwcIn_RRCR_4.RRCR_4_Ri2ObjTyp SwcIn_RRCR_4.RRCR_4_Ri2ObjConf SwcIn_RRCR_4.RRCR_4_Ri2ObjNrOffocst SwcIn_RRCR_4.RRCR_4_Ri2ObjTrackSt SwcIn_RRCR_4.RRCR_4_Ri2ObjCoordXDstStdDe SwcIn_RRCR_4.RRCR_4_Ri2ObjCoordYDstStdDe SwcIn_RRCR_4.RRCR_4_Ri2ObjXDirVStdDe SwcIn_RRCR_4.RRCR_4_Ri2ObjYDirVStdDe /end REF_MEASUREMENT
/end GROUP
/begin GROUP SwcIn_RRCR_5 ""
 /begin REF_MEASUREMENT SwcIn_RRCR_5.RRCR_5_CRC SwcIn_RRCR_5.RRCR_5_RollgCntr SwcIn_RRCR_5.RRCR_5_Ri3ObjBoxLen SwcIn_RRCR_5.RRCR_5_Ri3ObjBoxWidth SwcIn_RRCR_5.RRCR_5_Ri3HdTo SwcIn_RRCR_5.RRCR_5_Ri3ObjID SwcIn_RRCR_5.RRCR_5_Ri3ObjCoordY SwcIn_RRCR_5.RRCR_5_Ri3ObjCoordX SwcIn_RRCR_5.RRCR_5_Ri3ObjXDirAV SwcIn_RRCR_5.RRCR_5_Ri3ObjYDirV SwcIn_RRCR_5.RRCR_5_Ri3ObjXDirV SwcIn_RRCR_5.RRCR_5_Ri3ObjMtnChartc SwcIn_RRCR_5.RRCR_5_Ri3ObjTyp SwcIn_RRCR_5.RRCR_5_Ri3ObjConf SwcIn_RRCR_5.RRCR_5_Ri3ObjNrOffocst SwcIn_RRCR_5.RRCR_5_Ri3ObjTrackSt SwcIn_RRCR_5.RRCR_5_Ri3ObjCoordXDstStdDe SwcIn_RRCR_5.RRCR_5_Ri3ObjCoordYDstStdDe SwcIn_RRCR_5.RRCR_5_Ri3ObjXDirVStdDe SwcIn_RRCR_5.RRCR_5_Ri3ObjYDirVStdDe /end REF_MEASUREMENT
/end GROUP
/begin GROUP SwcIn_RRCR_6 ""
 /begin REF_MEASUREMENT SwcIn_RRCR_6.RRCR_6_CRC SwcIn_RRCR_6.RRCR_6_RollgCntr SwcIn_RRCR_6.RRCR_6_Ri4ObjBoxLen SwcIn_RRCR_6.RRCR_6_Ri4ObjBoxWidth SwcIn_RRCR_6.RRCR_6_Ri4HdTo SwcIn_RRCR_6.RRCR_6_Ri4ObjID SwcIn_RRCR_6.RRCR_6_Ri4ObjCoordY SwcIn_RRCR_6.RRCR_6_Ri4ObjCoordX SwcIn_RRCR_6.RRCR_6_Ri4ObjXDirAV SwcIn_RRCR_6.RRCR_6_Ri4ObjYDirV SwcIn_RRCR_6.RRCR_6_Ri4ObjXDirV SwcIn_RRCR_6.RRCR_6_Ri4ObjMtnChartc SwcIn_RRCR_6.RRCR_6_Ri4ObjTyp SwcIn_RRCR_6.RRCR_6_Ri4ObjConf SwcIn_RRCR_6.RRCR_6_Ri4ObjNrOffocst SwcIn_RRCR_6.RRCR_6_Ri4ObjTrackSt SwcIn_RRCR_6.RRCR_6_Ri4ObjCoordXDstStdDe SwcIn_RRCR_6.RRCR_6_Ri4ObjCoordYDstStdDe SwcIn_RRCR_6.RRCR_6_Ri4ObjXDirVStdDe SwcIn_RRCR_6.RRCR_6_Ri4ObjYDirVStdDe /end REF_MEASUREMENT
/end GROUP
/begin GROUP SwcIn_RRCR_7 ""
 /begin REF_MEASUREMENT SwcIn_RRCR_7.RRCR_7_CRC SwcIn_RRCR_7.RRCR_7_RollgCntr SwcIn_RRCR_7.RRCR_7_Ri5ObjBoxLen SwcIn_RRCR_7.RRCR_7_Ri5ObjBoxWidth SwcIn_RRCR_7.RRCR_7_Ri5HdTo SwcIn_RRCR_7.RRCR_7_Ri5ObjID SwcIn_RRCR_7.RRCR_7_Ri5ObjCoordY SwcIn_RRCR_7.RRCR_7_Ri5ObjCoordX SwcIn_RRCR_7.RRCR_7_Ri5ObjXDirAV SwcIn_RRCR_7.RRCR_7_Ri5ObjYDirV SwcIn_RRCR_7.RRCR_7_Ri5ObjXDirV SwcIn_RRCR_7.RRCR_7_Ri5ObjMtnChartc SwcIn_RRCR_7.RRCR_7_Ri5ObjTyp SwcIn_RRCR_7.RRCR_7_Ri5ObjConf SwcIn_RRCR_7.RRCR_7_Ri5ObjNrOffocst SwcIn_RRCR_7.RRCR_7_Ri5ObjTrackSt SwcIn_RRCR_7.RRCR_7_Ri5ObjCoordXDstStdDe SwcIn_RRCR_7.RRCR_7_Ri5ObjCoordYDstStdDe SwcIn_RRCR_7.RRCR_7_Ri5ObjXDirVStdDe SwcIn_RRCR_7.RRCR_7_Ri5ObjYDirVStdDe /end REF_MEASUREMENT
/end GROUP
/begin GROUP SwcIn_RRCR_8 ""
 /begin REF_MEASUREMENT SwcIn_RRCR_8.RRCR_8_CRC SwcIn_RRCR_8.RRCR_8_RollgCntr SwcIn_RRCR_8.RRCR_8_TiStampLaten /end REF_MEASUREMENT
/end GROUP
/begin GROUP SwcIn_RZCU_2 ""
 /begin REF_MEASUREMENT SwcIn_RZCU_2.RZCU_2_CRC SwcIn_RZCU_2.RZCU_2_RollgCntr SwcIn_RZCU_2.RZCU_2_Resd SwcIn_RZCU_2.LHRdoorSts SwcIn_RZCU_2.TrunkSts SwcIn_RZCU_2.LHRDoorLockSts SwcIn_RZCU_2.TrunkLockSts /end REF_MEASUREMENT
/end GROUP
/begin GROUP SwcIn_RZCU_7 ""
 /begin REF_MEASUREMENT SwcIn_RZCU_7.RZCU_7_CRC SwcIn_RZCU_7.RZCU_7_RollgCntr SwcIn_RZCU_7.RZCU_RearWiperWipingStatus SwcIn_RZCU_7.RZCU_RearWiperParkStatus /end REF_MEASUREMENT
/end GROUP
/begin GROUP SwcIn_SAS_1 ""
 /begin REF_MEASUREMENT SwcIn_SAS_1.SAM_1_CRC SwcIn_SAS_1.SAM_1_RollgCntr SwcIn_SAS_1.SAM_1_Resd SwcIn_SAS_1.SAM_1_SteeringAngle SwcIn_SAS_1.SAM_1_SteeringAngleSpeed SwcIn_SAS_1.SAM_1_SteeringAngleVD SwcIn_SAS_1.SAM_1_SteeringAngleSpeedVD /end REF_MEASUREMENT
/end GROUP
/begin GROUP SwcIn_SysIn_HMI_ADASSetting ""
 /begin SUB_GROUP SwcIn_SysIn_HMI_ADASSetting.ADASSettingInfo SwcIn_SysIn_HMI_ADASSetting.ADASSettingInfo_2 /end SUB_GROUP
/end GROUP
/end MODULE
/end PROJECT
