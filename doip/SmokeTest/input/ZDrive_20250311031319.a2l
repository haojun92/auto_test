ASAP2_VERSION 1 71
/begin PROJECT ProjectName ""
/begin MODULE ModuleName ""
/begin MOD_COMMON "" BYTE_ORDER MSB_LAST ALIGNMENT_BYTE 1 ALIGNMENT_WORD 1 ALIGNMENT_LONG 1 ALIGNMENT_INT64 1 ALIGNMENT_FLOAT16_IEEE 1 ALIGNMENT_FLOAT32_IEEE 1 ALIGNMENT_FLOAT64_IEEE 1 /end MOD_COMMON
/begin RECORD_LAYOUT __A_UINT64_Z FNC_VALUES 1 A_UINT64 ROW_DIR DIRECT /end RECORD_LAYOUT
/begin MEASUREMENT SwcOut_EVM_CIPV[4].size.higth "" FLOAT32_IEEE autosar_swc_tos_CM_single 0 0 -3.4E+38 3.4E+38 ECU_ADDRESS 0xfe4b04e4 /* @ECU_Address@SwcOut_EVM_CIPV[4].size.higth@ */ /end MEASUREMENT
/begin MEASUREMENT SwcOut_EVM_CIPV[4].size.length "" FLOAT32_IEEE autosar_swc_tos_CM_single 0 0 -3.4E+38 3.4E+38 ECU_ADDRESS 0xfe4b04dc /* @ECU_Address@SwcOut_EVM_CIPV[4].size.length@ */ /end MEASUREMENT
/begin MEASUREMENT SwcOut_EVM_CIPV[4].size.width "" FLOAT32_IEEE autosar_swc_tos_CM_single 0 0 -3.4E+38 3.4E+38 ECU_ADDRESS 0xfe4b04e0 /* @ECU_Address@SwcOut_EVM_CIPV[4].size.width@ */ /end MEASUREMENT
/begin MEASUREMENT SwcOut_EVM_CIPV[4].velocity_gnd.mod "" FLOAT32_IEEE autosar_swc_tos_CM_single 0 0 -3.4E+38 3.4E+38 ECU_ADDRESS 0xfe4b04f0 /* @ECU_Address@SwcOut_EVM_CIPV[4].velocity_gnd.mod@ */ /end MEASUREMENT
/begin MEASUREMENT SwcOut_EVM_CIPV[4].velocity_gnd.x "" FLOAT32_IEEE autosar_swc_tos_CM_single 0 0 -3.4E+38 3.4E+38 ECU_ADDRESS 0xfe4b04e8 /* @ECU_Address@SwcOut_EVM_CIPV[4].velocity_gnd.x@ */ /end MEASUREMENT
/begin MEASUREMENT SwcOut_EVM_CIPV[4].velocity_gnd.y "" FLOAT32_IEEE autosar_swc_tos_CM_single 0 0 -3.4E+38 3.4E+38 ECU_ADDRESS 0xfe4b04ec /* @ECU_Address@SwcOut_EVM_CIPV[4].velocity_gnd.y@ */ /end MEASUREMENT
/begin MEASUREMENT SwcOut_EVM_CIPV[4].velocity_gnd_sl.mod "" FLOAT32_IEEE autosar_swc_tos_CM_single 0 0 -3.4E+38 3.4E+38 ECU_ADDRESS 0xfe4b0508 /* @ECU_Address@SwcOut_EVM_CIPV[4].velocity_gnd_sl.mod@ */ /end MEASUREMENT
/begin MEASUREMENT SwcOut_EVM_CIPV[4].velocity_gnd_sl.x "" FLOAT32_IEEE autosar_swc_tos_CM_single 0 0 -3.4E+38 3.4E+38 ECU_ADDRESS 0xfe4b0500 /* @ECU_Address@SwcOut_EVM_CIPV[4].velocity_gnd_sl.x@ */ /end MEASUREMENT
/begin MEASUREMENT SwcOut_EVM_CIPV[4].velocity_gnd_sl.y "" FLOAT32_IEEE autosar_swc_tos_CM_single 0 0 -3.4E+38 3.4E+38 ECU_ADDRESS 0xfe4b0504 /* @ECU_Address@SwcOut_EVM_CIPV[4].velocity_gnd_sl.y@ */ /end MEASUREMENT
/begin MEASUREMENT SwcOut_EVM_CIPV[5].accel_gnd.mod "" FLOAT32_IEEE autosar_swc_tos_CM_single 0 0 -3.4E+38 3.4E+38 ECU_ADDRESS 0xfe4b057c /* @ECU_Address@SwcOut_EVM_CIPV[5].accel_gnd.mod@ */ /end MEASUREMENT
/begin MEASUREMENT SwcOut_EVM_CIPV[5].accel_gnd.x "" FLOAT32_IEEE autosar_swc_tos_CM_single 0 0 -3.4E+38 3.4E+38 ECU_ADDRESS 0xfe4b0574 /* @ECU_Address@SwcOut_EVM_CIPV[5].accel_gnd.x@ */ /end MEASUREMENT
/begin MEASUREMENT SwcOut_EVM_CIPV[5].accel_gnd.y "" FLOAT32_IEEE autosar_swc_tos_CM_single 0 0 -3.4E+38 3.4E+38 ECU_ADDRESS 0xfe4b0578 /* @ECU_Address@SwcOut_EVM_CIPV[5].accel_gnd.y@ */ /end MEASUREMENT
/begin MEASUREMENT SwcOut_EVM_CIPV[5].accel_gnd_sl.mod "" FLOAT32_IEEE autosar_swc_tos_CM_single 0 0 -3.4E+38 3.4E+38 ECU_ADDRESS 0xfe4b0594 /* @ECU_Address@SwcOut_EVM_CIPV[5].accel_gnd_sl.mod@ */ /end MEASUREMENT
/begin MEASUREMENT SwcOut_EVM_CIPV[5].accel_gnd_sl.x "" FLOAT32_IEEE autosar_swc_tos_CM_single 0 0 -3.4E+38 3.4E+38 ECU_ADDRESS 0xfe4b058c /* @ECU_Address@SwcOut_EVM_CIPV[5].accel_gnd_sl.x@ */ /end MEASUREMENT
/begin MEASUREMENT SwcOut_EVM_CIPV[5].accel_gnd_sl.y "" FLOAT32_IEEE autosar_swc_tos_CM_single 0 0 -3.4E+38 3.4E+38 ECU_ADDRESS 0xfe4b0590 /* @ECU_Address@SwcOut_EVM_CIPV[5].accel_gnd_sl.y@ */ /end MEASUREMENT
/begin MEASUREMENT SwcOut_EVM_CIPV[5].box.corner_x_vec "" FLOAT32_IEEE autosar_swc_tos_CM_single 0 0 -3.4E+38 3.4E+38 LAYOUT COLUMN_DIR MATRIX_DIM 4 ECU_ADDRESS 0xfe4b0524 /* @ECU_Address@SwcOut_EVM_CIPV[5].box.corner_x_vec@ */ /end MEASUREMENT
/begin MEASUREMENT SwcOut_EVM_CIPV[5].box.corner_y_vec "" FLOAT32_IEEE autosar_swc_tos_CM_single 0 0 -3.4E+38 3.4E+38 LAYOUT COLUMN_DIR MATRIX_DIM 4 ECU_ADDRESS 0xfe4b0534 /* @ECU_Address@SwcOut_EVM_CIPV[5].box.corner_y_vec@ */ /end MEASUREMENT
/begin MEASUREMENT SwcOut_EVM_CIPV[5].class_type "" UBYTE autosar_swc_tos_CM_uint8 0 0 0 255 ECU_ADDRESS 0xfe4b051a /* @ECU_Address@SwcOut_EVM_CIPV[5].class_type@ */ /end MEASUREMENT
/begin MEASUREMENT SwcOut_EVM_CIPV[5].cut_type "" UBYTE autosar_swc_tos_CM_uint8 0 0 0 255 ECU_ADDRESS 0xfe4b051b /* @ECU_Address@SwcOut_EVM_CIPV[5].cut_type@ */ /end MEASUREMENT
/begin MEASUREMENT SwcOut_EVM_CIPV[5].fus_type "" UBYTE autosar_swc_tos_CM_uint8 0 0 0 255 ECU_ADDRESS 0xfe4b0519 /* @ECU_Address@SwcOut_EVM_CIPV[5].fus_type@ */ /end MEASUREMENT
/begin MEASUREMENT SwcOut_EVM_CIPV[5].id "" ULONG autosar_swc_tos_CM_uint32 0 0 0 4294967295 ECU_ADDRESS 0xfe4b0520 /* @ECU_Address@SwcOut_EVM_CIPV[5].id@ */ /end MEASUREMENT
/begin MEASUREMENT SwcOut_EVM_CIPV[5].meas_state "" UBYTE autosar_swc_tos_CM_uint8 0 0 0 255 ECU_ADDRESS 0xfe4b0518 /* @ECU_Address@SwcOut_EVM_CIPV[5].meas_state@ */ /end MEASUREMENT
/begin MEASUREMENT SwcOut_EVM_CIPV[5].position.heading_angle "" FLOAT32_IEEE autosar_swc_tos_CM_single 0 0 -3.4E+38 3.4E+38 ECU_ADDRESS 0xfe4b054c /* @ECU_Address@SwcOut_EVM_CIPV[5].position.heading_angle@ */ /end MEASUREMENT
/begin MEASUREMENT SwcOut_EVM_CIPV[5].position.x "" FLOAT32_IEEE autosar_swc_tos_CM_single 0 0 -3.4E+38 3.4E+38 ECU_ADDRESS 0xfe4b0544 /* @ECU_Address@SwcOut_EVM_CIPV[5].position.x@ */ /end MEASUREMENT
/begin MEASUREMENT SwcOut_EVM_CIPV[5].position.y "" FLOAT32_IEEE autosar_swc_tos_CM_single 0 0 -3.4E+38 3.4E+38 ECU_ADDRESS 0xfe4b0548 /* @ECU_Address@SwcOut_EVM_CIPV[5].position.y@ */ /end MEASUREMENT
/begin MEASUREMENT SwcOut_EVM_CIPV[5].position_sl.heading_angle "" FLOAT32_IEEE autosar_swc_tos_CM_single 0 0 -3.4E+38 3.4E+38 ECU_ADDRESS 0xfe4b0558 /* @ECU_Address@SwcOut_EVM_CIPV[5].position_sl.heading_angle@ */ /end MEASUREMENT
/begin MEASUREMENT SwcOut_EVM_CIPV[5].position_sl.x "" FLOAT32_IEEE autosar_swc_tos_CM_single 0 0 -3.4E+38 3.4E+38 ECU_ADDRESS 0xfe4b0550 /* @ECU_Address@SwcOut_EVM_CIPV[5].position_sl.x@ */ /end MEASUREMENT
/begin MEASUREMENT SwcOut_EVM_CIPV[5].position_sl.y "" FLOAT32_IEEE autosar_swc_tos_CM_single 0 0 -3.4E+38 3.4E+38 ECU_ADDRESS 0xfe4b0554 /* @ECU_Address@SwcOut_EVM_CIPV[5].position_sl.y@ */ /end MEASUREMENT
/begin MEASUREMENT SwcOut_EVM_CIPV[5].ref_lane_id "" UBYTE autosar_swc_tos_CM_uint8 0 0 0 255 ECU_ADDRESS 0xfe4b051c /* @ECU_Address@SwcOut_EVM_CIPV[5].ref_lane_id@ */ /end MEASUREMENT
/begin MEASUREMENT SwcOut_EVM_CIPV[5].size.higth "" FLOAT32_IEEE autosar_swc_tos_CM_single 0 0 -3.4E+38 3.4E+38 ECU_ADDRESS 0xfe4b0564 /* @ECU_Address@SwcOut_EVM_CIPV[5].size.higth@ */ /end MEASUREMENT
/begin MEASUREMENT SwcOut_EVM_CIPV[5].size.length "" FLOAT32_IEEE autosar_swc_tos_CM_single 0 0 -3.4E+38 3.4E+38 ECU_ADDRESS 0xfe4b055c /* @ECU_Address@SwcOut_EVM_CIPV[5].size.length@ */ /end MEASUREMENT
/begin MEASUREMENT SwcOut_EVM_CIPV[5].size.width "" FLOAT32_IEEE autosar_swc_tos_CM_single 0 0 -3.4E+38 3.4E+38 ECU_ADDRESS 0xfe4b0560 /* @ECU_Address@SwcOut_EVM_CIPV[5].size.width@ */ /end MEASUREMENT
/begin MEASUREMENT SwcOut_EVM_CIPV[5].velocity_gnd.mod "" FLOAT32_IEEE autosar_swc_tos_CM_single 0 0 -3.4E+38 3.4E+38 ECU_ADDRESS 0xfe4b0570 /* @ECU_Address@SwcOut_EVM_CIPV[5].velocity_gnd.mod@ */ /end MEASUREMENT
/begin MEASUREMENT SwcOut_EVM_CIPV[5].velocity_gnd.x "" FLOAT32_IEEE autosar_swc_tos_CM_single 0 0 -3.4E+38 3.4E+38 ECU_ADDRESS 0xfe4b0568 /* @ECU_Address@SwcOut_EVM_CIPV[5].velocity_gnd.x@ */ /end MEASUREMENT
/begin MEASUREMENT SwcOut_EVM_CIPV[5].velocity_gnd.y "" FLOAT32_IEEE autosar_swc_tos_CM_single 0 0 -3.4E+38 3.4E+38 ECU_ADDRESS 0xfe4b056c /* @ECU_Address@SwcOut_EVM_CIPV[5].velocity_gnd.y@ */ /end MEASUREMENT
/begin MEASUREMENT SwcOut_EVM_CIPV[5].velocity_gnd_sl.mod "" FLOAT32_IEEE autosar_swc_tos_CM_single 0 0 -3.4E+38 3.4E+38 ECU_ADDRESS 0xfe4b0588 /* @ECU_Address@SwcOut_EVM_CIPV[5].velocity_gnd_sl.mod@ */ /end MEASUREMENT
/begin MEASUREMENT SwcOut_EVM_CIPV[5].velocity_gnd_sl.x "" FLOAT32_IEEE autosar_swc_tos_CM_single 0 0 -3.4E+38 3.4E+38 ECU_ADDRESS 0xfe4b0580 /* @ECU_Address@SwcOut_EVM_CIPV[5].velocity_gnd_sl.x@ */ /end MEASUREMENT
/begin MEASUREMENT SwcOut_EVM_CIPV[5].velocity_gnd_sl.y "" FLOAT32_IEEE autosar_swc_tos_CM_single 0 0 -3.4E+38 3.4E+38 ECU_ADDRESS 0xfe4b0584 /* @ECU_Address@SwcOut_EVM_CIPV[5].velocity_gnd_sl.y@ */ /end MEASUREMENT
/begin MEASUREMENT SwcOut_EVM_CIPV[6].accel_gnd.mod "" FLOAT32_IEEE autosar_swc_tos_CM_single 0 0 -3.4E+38 3.4E+38 ECU_ADDRESS 0xfe4b05fc /* @ECU_Address@SwcOut_EVM_CIPV[6].accel_gnd.mod@ */ /end MEASUREMENT
/begin MEASUREMENT SwcOut_EVM_CIPV[6].accel_gnd.x "" FLOAT32_IEEE autosar_swc_tos_CM_single 0 0 -3.4E+38 3.4E+38 ECU_ADDRESS 0xfe4b05f4 /* @ECU_Address@SwcOut_EVM_CIPV[6].accel_gnd.x@ */ /end MEASUREMENT
/begin MEASUREMENT SwcOut_EVM_CIPV[6].accel_gnd.y "" FLOAT32_IEEE autosar_swc_tos_CM_single 0 0 -3.4E+38 3.4E+38 ECU_ADDRESS 0xfe4b05f8 /* @ECU_Address@SwcOut_EVM_CIPV[6].accel_gnd.y@ */ /end MEASUREMENT
/begin MEASUREMENT SwcOut_EVM_CIPV[6].accel_gnd_sl.mod "" FLOAT32_IEEE autosar_swc_tos_CM_single 0 0 -3.4E+38 3.4E+38 ECU_ADDRESS 0xfe4b0614 /* @ECU_Address@SwcOut_EVM_CIPV[6].accel_gnd_sl.mod@ */ /end MEASUREMENT
/begin MEASUREMENT SwcOut_EVM_CIPV[6].accel_gnd_sl.x "" FLOAT32_IEEE autosar_swc_tos_CM_single 0 0 -3.4E+38 3.4E+38 ECU_ADDRESS 0xfe4b060c /* @ECU_Address@SwcOut_EVM_CIPV[6].accel_gnd_sl.x@ */ /end MEASUREMENT
/begin MEASUREMENT SwcOut_EVM_CIPV[6].accel_gnd_sl.y "" FLOAT32_IEEE autosar_swc_tos_CM_single 0 0 -3.4E+38 3.4E+38 ECU_ADDRESS 0xfe4b0610 /* @ECU_Address@SwcOut_EVM_CIPV[6].accel_gnd_sl.y@ */ /end MEASUREMENT
/begin MEASUREMENT SwcOut_EVM_CIPV[6].box.corner_x_vec "" FLOAT32_IEEE autosar_swc_tos_CM_single 0 0 -3.4E+38 3.4E+38 LAYOUT COLUMN_DIR MATRIX_DIM 4 ECU_ADDRESS 0xfe4b05a4 /* @ECU_Address@SwcOut_EVM_CIPV[6].box.corner_x_vec@ */ /end MEASUREMENT
/begin MEASUREMENT SwcOut_EVM_CIPV[6].box.corner_y_vec "" FLOAT32_IEEE autosar_swc_tos_CM_single 0 0 -3.4E+38 3.4E+38 LAYOUT COLUMN_DIR MATRIX_DIM 4 ECU_ADDRESS 0xfe4b05b4 /* @ECU_Address@SwcOut_EVM_CIPV[6].box.corner_y_vec@ */ /end MEASUREMENT
/begin MEASUREMENT SwcOut_EVM_CIPV[6].class_type "" UBYTE autosar_swc_tos_CM_uint8 0 0 0 255 ECU_ADDRESS 0xfe4b059a /* @ECU_Address@SwcOut_EVM_CIPV[6].class_type@ */ /end MEASUREMENT
/begin MEASUREMENT SwcOut_EVM_CIPV[6].cut_type "" UBYTE autosar_swc_tos_CM_uint8 0 0 0 255 ECU_ADDRESS 0xfe4b059b /* @ECU_Address@SwcOut_EVM_CIPV[6].cut_type@ */ /end MEASUREMENT
/begin MEASUREMENT SwcOut_EVM_CIPV[6].fus_type "" UBYTE autosar_swc_tos_CM_uint8 0 0 0 255 ECU_ADDRESS 0xfe4b0599 /* @ECU_Address@SwcOut_EVM_CIPV[6].fus_type@ */ /end MEASUREMENT
/begin MEASUREMENT SwcOut_EVM_CIPV[6].id "" ULONG autosar_swc_tos_CM_uint32 0 0 0 4294967295 ECU_ADDRESS 0xfe4b05a0 /* @ECU_Address@SwcOut_EVM_CIPV[6].id@ */ /end MEASUREMENT
/begin MEASUREMENT SwcOut_EVM_CIPV[6].meas_state "" UBYTE autosar_swc_tos_CM_uint8 0 0 0 255 ECU_ADDRESS 0xfe4b0598 /* @ECU_Address@SwcOut_EVM_CIPV[6].meas_state@ */ /end MEASUREMENT
/begin MEASUREMENT SwcOut_EVM_CIPV[6].position.heading_angle "" FLOAT32_IEEE autosar_swc_tos_CM_single 0 0 -3.4E+38 3.4E+38 ECU_ADDRESS 0xfe4b05cc /* @ECU_Address@SwcOut_EVM_CIPV[6].position.heading_angle@ */ /end MEASUREMENT
/begin MEASUREMENT SwcOut_EVM_CIPV[6].position.x "" FLOAT32_IEEE autosar_swc_tos_CM_single 0 0 -3.4E+38 3.4E+38 ECU_ADDRESS 0xfe4b05c4 /* @ECU_Address@SwcOut_EVM_CIPV[6].position.x@ */ /end MEASUREMENT
/begin MEASUREMENT SwcOut_EVM_CIPV[6].position.y "" FLOAT32_IEEE autosar_swc_tos_CM_single 0 0 -3.4E+38 3.4E+38 ECU_ADDRESS 0xfe4b05c8 /* @ECU_Address@SwcOut_EVM_CIPV[6].position.y@ */ /end MEASUREMENT
/begin MEASUREMENT SwcOut_EVM_CIPV[6].position_sl.heading_angle "" FLOAT32_IEEE autosar_swc_tos_CM_single 0 0 -3.4E+38 3.4E+38 ECU_ADDRESS 0xfe4b05d8 /* @ECU_Address@SwcOut_EVM_CIPV[6].position_sl.heading_angle@ */ /end MEASUREMENT
/begin MEASUREMENT SwcOut_EVM_CIPV[6].position_sl.x "" FLOAT32_IEEE autosar_swc_tos_CM_single 0 0 -3.4E+38 3.4E+38 ECU_ADDRESS 0xfe4b05d0 /* @ECU_Address@SwcOut_EVM_CIPV[6].position_sl.x@ */ /end MEASUREMENT
/begin MEASUREMENT SwcOut_EVM_CIPV[6].position_sl.y "" FLOAT32_IEEE autosar_swc_tos_CM_single 0 0 -3.4E+38 3.4E+38 ECU_ADDRESS 0xfe4b05d4 /* @ECU_Address@SwcOut_EVM_CIPV[6].position_sl.y@ */ /end MEASUREMENT
/begin MEASUREMENT SwcOut_EVM_CIPV[6].ref_lane_id "" UBYTE autosar_swc_tos_CM_uint8 0 0 0 255 ECU_ADDRESS 0xfe4b059c /* @ECU_Address@SwcOut_EVM_CIPV[6].ref_lane_id@ */ /end MEASUREMENT
/begin MEASUREMENT SwcOut_EVM_CIPV[6].size.higth "" FLOAT32_IEEE autosar_swc_tos_CM_single 0 0 -3.4E+38 3.4E+38 ECU_ADDRESS 0xfe4b05e4 /* @ECU_Address@SwcOut_EVM_CIPV[6].size.higth@ */ /end MEASUREMENT
/begin MEASUREMENT SwcOut_EVM_CIPV[6].size.length "" FLOAT32_IEEE autosar_swc_tos_CM_single 0 0 -3.4E+38 3.4E+38 ECU_ADDRESS 0xfe4b05dc /* @ECU_Address@SwcOut_EVM_CIPV[6].size.length@ */ /end MEASUREMENT
/begin MEASUREMENT SwcOut_EVM_CIPV[6].size.width "" FLOAT32_IEEE autosar_swc_tos_CM_single 0 0 -3.4E+38 3.4E+38 ECU_ADDRESS 0xfe4b05e0 /* @ECU_Address@SwcOut_EVM_CIPV[6].size.width@ */ /end MEASUREMENT
/begin MEASUREMENT SwcOut_EVM_CIPV[6].velocity_gnd.mod "" FLOAT32_IEEE autosar_swc_tos_CM_single 0 0 -3.4E+38 3.4E+38 ECU_ADDRESS 0xfe4b05f0 /* @ECU_Address@SwcOut_EVM_CIPV[6].velocity_gnd.mod@ */ /end MEASUREMENT
/begin MEASUREMENT SwcOut_EVM_CIPV[6].velocity_gnd.x "" FLOAT32_IEEE autosar_swc_tos_CM_single 0 0 -3.4E+38 3.4E+38 ECU_ADDRESS 0xfe4b05e8 /* @ECU_Address@SwcOut_EVM_CIPV[6].velocity_gnd.x@ */ /end MEASUREMENT
/begin MEASUREMENT SwcOut_EVM_CIPV[6].velocity_gnd.y "" FLOAT32_IEEE autosar_swc_tos_CM_single 0 0 -3.4E+38 3.4E+38 ECU_ADDRESS 0xfe4b05ec /* @ECU_Address@SwcOut_EVM_CIPV[6].velocity_gnd.y@ */ /end MEASUREMENT
/begin MEASUREMENT SwcOut_EVM_CIPV[6].velocity_gnd_sl.mod "" FLOAT32_IEEE autosar_swc_tos_CM_single 0 0 -3.4E+38 3.4E+38 ECU_ADDRESS 0xfe4b0608 /* @ECU_Address@SwcOut_EVM_CIPV[6].velocity_gnd_sl.mod@ */ /end MEASUREMENT
/begin MEASUREMENT SwcOut_EVM_CIPV[6].velocity_gnd_sl.x "" FLOAT32_IEEE autosar_swc_tos_CM_single 0 0 -3.4E+38 3.4E+38 ECU_ADDRESS 0xfe4b0600 /* @ECU_Address@SwcOut_EVM_CIPV[6].velocity_gnd_sl.x@ */ /end MEASUREMENT
/begin MEASUREMENT SwcOut_EVM_CIPV[6].velocity_gnd_sl.y "" FLOAT32_IEEE autosar_swc_tos_CM_single 0 0 -3.4E+38 3.4E+38 ECU_ADDRESS 0xfe4b0604 /* @ECU_Address@SwcOut_EVM_CIPV[6].velocity_gnd_sl.y@ */ /end MEASUREMENT
/begin MEASUREMENT SwcOut_EVM_CIPV[7].accel_gnd.mod "" FLOAT32_IEEE autosar_swc_tos_CM_single 0 0 -3.4E+38 3.4E+38 ECU_ADDRESS 0xfe4b067c /* @ECU_Address@SwcOut_EVM_CIPV[7].accel_gnd.mod@ */ /end MEASUREMENT
/begin MEASUREMENT SwcOut_EVM_CIPV[7].accel_gnd.x "" FLOAT32_IEEE autosar_swc_tos_CM_single 0 0 -3.4E+38 3.4E+38 ECU_ADDRESS 0xfe4b0674 /* @ECU_Address@SwcOut_EVM_CIPV[7].accel_gnd.x@ */ /end MEASUREMENT
/begin MEASUREMENT SwcOut_EVM_CIPV[7].accel_gnd.y "" FLOAT32_IEEE autosar_swc_tos_CM_single 0 0 -3.4E+38 3.4E+38 ECU_ADDRESS 0xfe4b0678 /* @ECU_Address@SwcOut_EVM_CIPV[7].accel_gnd.y@ */ /end MEASUREMENT
/begin MEASUREMENT SwcOut_EVM_CIPV[7].accel_gnd_sl.mod "" FLOAT32_IEEE autosar_swc_tos_CM_single 0 0 -3.4E+38 3.4E+38 ECU_ADDRESS 0xfe4b0694 /* @ECU_Address@SwcOut_EVM_CIPV[7].accel_gnd_sl.mod@ */ /end MEASUREMENT
/begin MEASUREMENT SwcOut_EVM_CIPV[7].accel_gnd_sl.x "" FLOAT32_IEEE autosar_swc_tos_CM_single 0 0 -3.4E+38 3.4E+38 ECU_ADDRESS 0xfe4b068c /* @ECU_Address@SwcOut_EVM_CIPV[7].accel_gnd_sl.x@ */ /end MEASUREMENT
/begin MEASUREMENT SwcOut_EVM_CIPV[7].accel_gnd_sl.y "" FLOAT32_IEEE autosar_swc_tos_CM_single 0 0 -3.4E+38 3.4E+38 ECU_ADDRESS 0xfe4b0690 /* @ECU_Address@SwcOut_EVM_CIPV[7].accel_gnd_sl.y@ */ /end MEASUREMENT
/begin MEASUREMENT SwcOut_EVM_CIPV[7].box.corner_x_vec "" FLOAT32_IEEE autosar_swc_tos_CM_single 0 0 -3.4E+38 3.4E+38 LAYOUT COLUMN_DIR MATRIX_DIM 4 ECU_ADDRESS 0xfe4b0624 /* @ECU_Address@SwcOut_EVM_CIPV[7].box.corner_x_vec@ */ /end MEASUREMENT
/begin MEASUREMENT SwcOut_EVM_CIPV[7].box.corner_y_vec "" FLOAT32_IEEE autosar_swc_tos_CM_single 0 0 -3.4E+38 3.4E+38 LAYOUT COLUMN_DIR MATRIX_DIM 4 ECU_ADDRESS 0xfe4b0634 /* @ECU_Address@SwcOut_EVM_CIPV[7].box.corner_y_vec@ */ /end MEASUREMENT
/begin MEASUREMENT SwcOut_EVM_CIPV[7].class_type "" UBYTE autosar_swc_tos_CM_uint8 0 0 0 255 ECU_ADDRESS 0xfe4b061a /* @ECU_Address@SwcOut_EVM_CIPV[7].class_type@ */ /end MEASUREMENT
/begin MEASUREMENT SwcOut_EVM_CIPV[7].cut_type "" UBYTE autosar_swc_tos_CM_uint8 0 0 0 255 ECU_ADDRESS 0xfe4b061b /* @ECU_Address@SwcOut_EVM_CIPV[7].cut_type@ */ /end MEASUREMENT
/begin MEASUREMENT SwcOut_EVM_CIPV[7].fus_type "" UBYTE autosar_swc_tos_CM_uint8 0 0 0 255 ECU_ADDRESS 0xfe4b0619 /* @ECU_Address@SwcOut_EVM_CIPV[7].fus_type@ */ /end MEASUREMENT
/begin MEASUREMENT SwcOut_EVM_CIPV[7].id "" ULONG autosar_swc_tos_CM_uint32 0 0 0 4294967295 ECU_ADDRESS 0xfe4b0620 /* @ECU_Address@SwcOut_EVM_CIPV[7].id@ */ /end MEASUREMENT
/begin MEASUREMENT SwcOut_EVM_CIPV[7].meas_state "" UBYTE autosar_swc_tos_CM_uint8 0 0 0 255 ECU_ADDRESS 0xfe4b0618 /* @ECU_Address@SwcOut_EVM_CIPV[7].meas_state@ */ /end MEASUREMENT
/begin MEASUREMENT SwcOut_EVM_CIPV[7].position.heading_angle "" FLOAT32_IEEE autosar_swc_tos_CM_single 0 0 -3.4E+38 3.4E+38 ECU_ADDRESS 0xfe4b064c /* @ECU_Address@SwcOut_EVM_CIPV[7].position.heading_angle@ */ /end MEASUREMENT
/begin MEASUREMENT SwcOut_EVM_CIPV[7].position.x "" FLOAT32_IEEE autosar_swc_tos_CM_single 0 0 -3.4E+38 3.4E+38 ECU_ADDRESS 0xfe4b0644 /* @ECU_Address@SwcOut_EVM_CIPV[7].position.x@ */ /end MEASUREMENT
/begin MEASUREMENT SwcOut_EVM_CIPV[7].position.y "" FLOAT32_IEEE autosar_swc_tos_CM_single 0 0 -3.4E+38 3.4E+38 ECU_ADDRESS 0xfe4b0648 /* @ECU_Address@SwcOut_EVM_CIPV[7].position.y@ */ /end MEASUREMENT
/begin MEASUREMENT SwcOut_EVM_CIPV[7].position_sl.heading_angle "" FLOAT32_IEEE autosar_swc_tos_CM_single 0 0 -3.4E+38 3.4E+38 ECU_ADDRESS 0xfe4b0658 /* @ECU_Address@SwcOut_EVM_CIPV[7].position_sl.heading_angle@ */ /end MEASUREMENT
/begin MEASUREMENT SwcOut_EVM_CIPV[7].position_sl.x "" FLOAT32_IEEE autosar_swc_tos_CM_single 0 0 -3.4E+38 3.4E+38 ECU_ADDRESS 0xfe4b0650 /* @ECU_Address@SwcOut_EVM_CIPV[7].position_sl.x@ */ /end MEASUREMENT
/begin MEASUREMENT SwcOut_EVM_CIPV[7].position_sl.y "" FLOAT32_IEEE autosar_swc_tos_CM_single 0 0 -3.4E+38 3.4E+38 ECU_ADDRESS 0xfe4b0654 /* @ECU_Address@SwcOut_EVM_CIPV[7].position_sl.y@ */ /end MEASUREMENT
/begin MEASUREMENT SwcOut_EVM_CIPV[7].ref_lane_id "" UBYTE autosar_swc_tos_CM_uint8 0 0 0 255 ECU_ADDRESS 0xfe4b061c /* @ECU_Address@SwcOut_EVM_CIPV[7].ref_lane_id@ */ /end MEASUREMENT
/begin MEASUREMENT SwcOut_EVM_CIPV[7].size.higth "" FLOAT32_IEEE autosar_swc_tos_CM_single 0 0 -3.4E+38 3.4E+38 ECU_ADDRESS 0xfe4b0664 /* @ECU_Address@SwcOut_EVM_CIPV[7].size.higth@ */ /end MEASUREMENT
/begin MEASUREMENT SwcOut_EVM_CIPV[7].size.length "" FLOAT32_IEEE autosar_swc_tos_CM_single 0 0 -3.4E+38 3.4E+38 ECU_ADDRESS 0xfe4b065c /* @ECU_Address@SwcOut_EVM_CIPV[7].size.length@ */ /end MEASUREMENT
/begin MEASUREMENT SwcOut_EVM_CIPV[7].size.width "" FLOAT32_IEEE autosar_swc_tos_CM_single 0 0 -3.4E+38 3.4E+38 ECU_ADDRESS 0xfe4b0660 /* @ECU_Address@SwcOut_EVM_CIPV[7].size.width@ */ /end MEASUREMENT
/begin MEASUREMENT SwcOut_EVM_CIPV[7].velocity_gnd.mod "" FLOAT32_IEEE autosar_swc_tos_CM_single 0 0 -3.4E+38 3.4E+38 ECU_ADDRESS 0xfe4b0670 /* @ECU_Address@SwcOut_EVM_CIPV[7].velocity_gnd.mod@ */ /end MEASUREMENT
/begin MEASUREMENT SwcOut_EVM_CIPV[7].velocity_gnd.x "" FLOAT32_IEEE autosar_swc_tos_CM_single 0 0 -3.4E+38 3.4E+38 ECU_ADDRESS 0xfe4b0668 /* @ECU_Address@SwcOut_EVM_CIPV[7].velocity_gnd.x@ */ /end MEASUREMENT
/begin MEASUREMENT SwcOut_EVM_CIPV[7].velocity_gnd.y "" FLOAT32_IEEE autosar_swc_tos_CM_single 0 0 -3.4E+38 3.4E+38 ECU_ADDRESS 0xfe4b066c /* @ECU_Address@SwcOut_EVM_CIPV[7].velocity_gnd.y@ */ /end MEASUREMENT
/begin MEASUREMENT SwcOut_EVM_CIPV[7].velocity_gnd_sl.mod "" FLOAT32_IEEE autosar_swc_tos_CM_single 0 0 -3.4E+38 3.4E+38 ECU_ADDRESS 0xfe4b0688 /* @ECU_Address@SwcOut_EVM_CIPV[7].velocity_gnd_sl.mod@ */ /end MEASUREMENT
/begin MEASUREMENT SwcOut_EVM_CIPV[7].velocity_gnd_sl.x "" FLOAT32_IEEE autosar_swc_tos_CM_single 0 0 -3.4E+38 3.4E+38 ECU_ADDRESS 0xfe4b0680 /* @ECU_Address@SwcOut_EVM_CIPV[7].velocity_gnd_sl.x@ */ /end MEASUREMENT
/begin MEASUREMENT SwcOut_EVM_CIPV[7].velocity_gnd_sl.y "" FLOAT32_IEEE autosar_swc_tos_CM_single 0 0 -3.4E+38 3.4E+38 ECU_ADDRESS 0xfe4b0684 /* @ECU_Address@SwcOut_EVM_CIPV[7].velocity_gnd_sl.y@ */ /end MEASUREMENT
/begin MEASUREMENT SwcOut_EVM_CIPV[8].accel_gnd.mod "" FLOAT32_IEEE autosar_swc_tos_CM_single 0 0 -3.4E+38 3.4E+38 ECU_ADDRESS 0xfe4b06fc /* @ECU_Address@SwcOut_EVM_CIPV[8].accel_gnd.mod@ */ /end MEASUREMENT
/begin MEASUREMENT SwcOut_EVM_CIPV[8].accel_gnd.x "" FLOAT32_IEEE autosar_swc_tos_CM_single 0 0 -3.4E+38 3.4E+38 ECU_ADDRESS 0xfe4b06f4 /* @ECU_Address@SwcOut_EVM_CIPV[8].accel_gnd.x@ */ /end MEASUREMENT
/begin MEASUREMENT SwcOut_EVM_CIPV[8].accel_gnd.y "" FLOAT32_IEEE autosar_swc_tos_CM_single 0 0 -3.4E+38 3.4E+38 ECU_ADDRESS 0xfe4b06f8 /* @ECU_Address@SwcOut_EVM_CIPV[8].accel_gnd.y@ */ /end MEASUREMENT
/begin MEASUREMENT SwcOut_EVM_CIPV[8].accel_gnd_sl.mod "" FLOAT32_IEEE autosar_swc_tos_CM_single 0 0 -3.4E+38 3.4E+38 ECU_ADDRESS 0xfe4b0714 /* @ECU_Address@SwcOut_EVM_CIPV[8].accel_gnd_sl.mod@ */ /end MEASUREMENT
/begin MEASUREMENT SwcOut_EVM_CIPV[8].accel_gnd_sl.x "" FLOAT32_IEEE autosar_swc_tos_CM_single 0 0 -3.4E+38 3.4E+38 ECU_ADDRESS 0xfe4b070c /* @ECU_Address@SwcOut_EVM_CIPV[8].accel_gnd_sl.x@ */ /end MEASUREMENT
/begin MEASUREMENT SwcOut_EVM_CIPV[8].accel_gnd_sl.y "" FLOAT32_IEEE autosar_swc_tos_CM_single 0 0 -3.4E+38 3.4E+38 ECU_ADDRESS 0xfe4b0710 /* @ECU_Address@SwcOut_EVM_CIPV[8].accel_gnd_sl.y@ */ /end MEASUREMENT
/begin MEASUREMENT SwcOut_EVM_CIPV[8].box.corner_x_vec "" FLOAT32_IEEE autosar_swc_tos_CM_single 0 0 -3.4E+38 3.4E+38 LAYOUT COLUMN_DIR MATRIX_DIM 4 ECU_ADDRESS 0xfe4b06a4 /* @ECU_Address@SwcOut_EVM_CIPV[8].box.corner_x_vec@ */ /end MEASUREMENT
/begin MEASUREMENT SwcOut_EVM_CIPV[8].box.corner_y_vec "" FLOAT32_IEEE autosar_swc_tos_CM_single 0 0 -3.4E+38 3.4E+38 LAYOUT COLUMN_DIR MATRIX_DIM 4 ECU_ADDRESS 0xfe4b06b4 /* @ECU_Address@SwcOut_EVM_CIPV[8].box.corner_y_vec@ */ /end MEASUREMENT
/begin MEASUREMENT SwcOut_EVM_CIPV[8].class_type "" UBYTE autosar_swc_tos_CM_uint8 0 0 0 255 ECU_ADDRESS 0xfe4b069a /* @ECU_Address@SwcOut_EVM_CIPV[8].class_type@ */ /end MEASUREMENT
/begin MEASUREMENT SwcOut_EVM_CIPV[8].cut_type "" UBYTE autosar_swc_tos_CM_uint8 0 0 0 255 ECU_ADDRESS 0xfe4b069b /* @ECU_Address@SwcOut_EVM_CIPV[8].cut_type@ */ /end MEASUREMENT
/begin MEASUREMENT SwcOut_EVM_CIPV[8].fus_type "" UBYTE autosar_swc_tos_CM_uint8 0 0 0 255 ECU_ADDRESS 0xfe4b0699 /* @ECU_Address@SwcOut_EVM_CIPV[8].fus_type@ */ /end MEASUREMENT
/begin MEASUREMENT SwcOut_EVM_CIPV[8].id "" ULONG autosar_swc_tos_CM_uint32 0 0 0 4294967295 ECU_ADDRESS 0xfe4b06a0 /* @ECU_Address@SwcOut_EVM_CIPV[8].id@ */ /end MEASUREMENT
/begin MEASUREMENT SwcOut_EVM_CIPV[8].meas_state "" UBYTE autosar_swc_tos_CM_uint8 0 0 0 255 ECU_ADDRESS 0xfe4b0698 /* @ECU_Address@SwcOut_EVM_CIPV[8].meas_state@ */ /end MEASUREMENT
/begin MEASUREMENT SwcOut_EVM_CIPV[8].position.heading_angle "" FLOAT32_IEEE autosar_swc_tos_CM_single 0 0 -3.4E+38 3.4E+38 ECU_ADDRESS 0xfe4b06cc /* @ECU_Address@SwcOut_EVM_CIPV[8].position.heading_angle@ */ /end MEASUREMENT
/begin MEASUREMENT SwcOut_EVM_CIPV[8].position.x "" FLOAT32_IEEE autosar_swc_tos_CM_single 0 0 -3.4E+38 3.4E+38 ECU_ADDRESS 0xfe4b06c4 /* @ECU_Address@SwcOut_EVM_CIPV[8].position.x@ */ /end MEASUREMENT
/begin MEASUREMENT SwcOut_EVM_CIPV[8].position.y "" FLOAT32_IEEE autosar_swc_tos_CM_single 0 0 -3.4E+38 3.4E+38 ECU_ADDRESS 0xfe4b06c8 /* @ECU_Address@SwcOut_EVM_CIPV[8].position.y@ */ /end MEASUREMENT
/begin MEASUREMENT SwcOut_EVM_CIPV[8].position_sl.heading_angle "" FLOAT32_IEEE autosar_swc_tos_CM_single 0 0 -3.4E+38 3.4E+38 ECU_ADDRESS 0xfe4b06d8 /* @ECU_Address@SwcOut_EVM_CIPV[8].position_sl.heading_angle@ */ /end MEASUREMENT
/begin MEASUREMENT SwcOut_EVM_CIPV[8].position_sl.x "" FLOAT32_IEEE autosar_swc_tos_CM_single 0 0 -3.4E+38 3.4E+38 ECU_ADDRESS 0xfe4b06d0 /* @ECU_Address@SwcOut_EVM_CIPV[8].position_sl.x@ */ /end MEASUREMENT
/begin MEASUREMENT SwcOut_EVM_CIPV[8].position_sl.y "" FLOAT32_IEEE autosar_swc_tos_CM_single 0 0 -3.4E+38 3.4E+38 ECU_ADDRESS 0xfe4b06d4 /* @ECU_Address@SwcOut_EVM_CIPV[8].position_sl.y@ */ /end MEASUREMENT
/begin MEASUREMENT SwcOut_EVM_CIPV[8].ref_lane_id "" UBYTE autosar_swc_tos_CM_uint8 0 0 0 255 ECU_ADDRESS 0xfe4b069c /* @ECU_Address@SwcOut_EVM_CIPV[8].ref_lane_id@ */ /end MEASUREMENT
/begin MEASUREMENT SwcOut_EVM_CIPV[8].size.higth "" FLOAT32_IEEE autosar_swc_tos_CM_single 0 0 -3.4E+38 3.4E+38 ECU_ADDRESS 0xfe4b06e4 /* @ECU_Address@SwcOut_EVM_CIPV[8].size.higth@ */ /end MEASUREMENT
/begin MEASUREMENT SwcOut_EVM_CIPV[8].size.length "" FLOAT32_IEEE autosar_swc_tos_CM_single 0 0 -3.4E+38 3.4E+38 ECU_ADDRESS 0xfe4b06dc /* @ECU_Address@SwcOut_EVM_CIPV[8].size.length@ */ /end MEASUREMENT
/begin MEASUREMENT SwcOut_EVM_CIPV[8].size.width "" FLOAT32_IEEE autosar_swc_tos_CM_single 0 0 -3.4E+38 3.4E+38 ECU_ADDRESS 0xfe4b06e0 /* @ECU_Address@SwcOut_EVM_CIPV[8].size.width@ */ /end MEASUREMENT
/begin MEASUREMENT SwcOut_EVM_CIPV[8].velocity_gnd.mod "" FLOAT32_IEEE autosar_swc_tos_CM_single 0 0 -3.4E+38 3.4E+38 ECU_ADDRESS 0xfe4b06f0 /* @ECU_Address@SwcOut_EVM_CIPV[8].velocity_gnd.mod@ */ /end MEASUREMENT
/begin MEASUREMENT SwcOut_EVM_CIPV[8].velocity_gnd.x "" FLOAT32_IEEE autosar_swc_tos_CM_single 0 0 -3.4E+38 3.4E+38 ECU_ADDRESS 0xfe4b06e8 /* @ECU_Address@SwcOut_EVM_CIPV[8].velocity_gnd.x@ */ /end MEASUREMENT
/begin MEASUREMENT SwcOut_EVM_CIPV[8].velocity_gnd.y "" FLOAT32_IEEE autosar_swc_tos_CM_single 0 0 -3.4E+38 3.4E+38 ECU_ADDRESS 0xfe4b06ec /* @ECU_Address@SwcOut_EVM_CIPV[8].velocity_gnd.y@ */ /end MEASUREMENT
/begin MEASUREMENT SwcOut_EVM_CIPV[8].velocity_gnd_sl.mod "" FLOAT32_IEEE autosar_swc_tos_CM_single 0 0 -3.4E+38 3.4E+38 ECU_ADDRESS 0xfe4b0708 /* @ECU_Address@SwcOut_EVM_CIPV[8].velocity_gnd_sl.mod@ */ /end MEASUREMENT
/begin MEASUREMENT SwcOut_EVM_CIPV[8].velocity_gnd_sl.x "" FLOAT32_IEEE autosar_swc_tos_CM_single 0 0 -3.4E+38 3.4E+38 ECU_ADDRESS 0xfe4b0700 /* @ECU_Address@SwcOut_EVM_CIPV[8].velocity_gnd_sl.x@ */ /end MEASUREMENT
/begin MEASUREMENT SwcOut_EVM_CIPV[8].velocity_gnd_sl.y "" FLOAT32_IEEE autosar_swc_tos_CM_single 0 0 -3.4E+38 3.4E+38 ECU_ADDRESS 0xfe4b0704 /* @ECU_Address@SwcOut_EVM_CIPV[8].velocity_gnd_sl.y@ */ /end MEASUREMENT
/begin MEASUREMENT SwcOut_EVM_CIPV[9].accel_gnd.mod "" FLOAT32_IEEE autosar_swc_tos_CM_single 0 0 -3.4E+38 3.4E+38 ECU_ADDRESS 0xfe4b077c /* @ECU_Address@SwcOut_EVM_CIPV[9].accel_gnd.mod@ */ /end MEASUREMENT
/begin MEASUREMENT SwcOut_EVM_CIPV[9].accel_gnd.x "" FLOAT32_IEEE autosar_swc_tos_CM_single 0 0 -3.4E+38 3.4E+38 ECU_ADDRESS 0xfe4b0774 /* @ECU_Address@SwcOut_EVM_CIPV[9].accel_gnd.x@ */ /end MEASUREMENT
/begin MEASUREMENT SwcOut_EVM_CIPV[9].accel_gnd.y "" FLOAT32_IEEE autosar_swc_tos_CM_single 0 0 -3.4E+38 3.4E+38 ECU_ADDRESS 0xfe4b0778 /* @ECU_Address@SwcOut_EVM_CIPV[9].accel_gnd.y@ */ /end MEASUREMENT
/begin MEASUREMENT SwcOut_EVM_CIPV[9].accel_gnd_sl.mod "" FLOAT32_IEEE autosar_swc_tos_CM_single 0 0 -3.4E+38 3.4E+38 ECU_ADDRESS 0xfe4b0794 /* @ECU_Address@SwcOut_EVM_CIPV[9].accel_gnd_sl.mod@ */ /end MEASUREMENT
/begin MEASUREMENT SwcOut_EVM_CIPV[9].accel_gnd_sl.x "" FLOAT32_IEEE autosar_swc_tos_CM_single 0 0 -3.4E+38 3.4E+38 ECU_ADDRESS 0xfe4b078c /* @ECU_Address@SwcOut_EVM_CIPV[9].accel_gnd_sl.x@ */ /end MEASUREMENT
/begin MEASUREMENT SwcOut_EVM_CIPV[9].accel_gnd_sl.y "" FLOAT32_IEEE autosar_swc_tos_CM_single 0 0 -3.4E+38 3.4E+38 ECU_ADDRESS 0xfe4b0790 /* @ECU_Address@SwcOut_EVM_CIPV[9].accel_gnd_sl.y@ */ /end MEASUREMENT
/begin MEASUREMENT SwcOut_EVM_CIPV[9].box.corner_x_vec "" FLOAT32_IEEE autosar_swc_tos_CM_single 0 0 -3.4E+38 3.4E+38 LAYOUT COLUMN_DIR MATRIX_DIM 4 ECU_ADDRESS 0xfe4b0724 /* @ECU_Address@SwcOut_EVM_CIPV[9].box.corner_x_vec@ */ /end MEASUREMENT
/begin MEASUREMENT SwcOut_EVM_CIPV[9].box.corner_y_vec "" FLOAT32_IEEE autosar_swc_tos_CM_single 0 0 -3.4E+38 3.4E+38 LAYOUT COLUMN_DIR MATRIX_DIM 4 ECU_ADDRESS 0xfe4b0734 /* @ECU_Address@SwcOut_EVM_CIPV[9].box.corner_y_vec@ */ /end MEASUREMENT
/begin MEASUREMENT SwcOut_EVM_CIPV[9].class_type "" UBYTE autosar_swc_tos_CM_uint8 0 0 0 255 ECU_ADDRESS 0xfe4b071a /* @ECU_Address@SwcOut_EVM_CIPV[9].class_type@ */ /end MEASUREMENT
/begin MEASUREMENT SwcOut_EVM_CIPV[9].cut_type "" UBYTE autosar_swc_tos_CM_uint8 0 0 0 255 ECU_ADDRESS 0xfe4b071b /* @ECU_Address@SwcOut_EVM_CIPV[9].cut_type@ */ /end MEASUREMENT
/begin MEASUREMENT SwcOut_EVM_CIPV[9].fus_type "" UBYTE autosar_swc_tos_CM_uint8 0 0 0 255 ECU_ADDRESS 0xfe4b0719 /* @ECU_Address@SwcOut_EVM_CIPV[9].fus_type@ */ /end MEASUREMENT
/begin MEASUREMENT SwcOut_EVM_CIPV[9].id "" ULONG autosar_swc_tos_CM_uint32 0 0 0 4294967295 ECU_ADDRESS 0xfe4b0720 /* @ECU_Address@SwcOut_EVM_CIPV[9].id@ */ /end MEASUREMENT
/begin MEASUREMENT SwcOut_EVM_CIPV[9].meas_state "" UBYTE autosar_swc_tos_CM_uint8 0 0 0 255 ECU_ADDRESS 0xfe4b0718 /* @ECU_Address@SwcOut_EVM_CIPV[9].meas_state@ */ /end MEASUREMENT
/begin MEASUREMENT SwcOut_EVM_CIPV[9].position.heading_angle "" FLOAT32_IEEE autosar_swc_tos_CM_single 0 0 -3.4E+38 3.4E+38 ECU_ADDRESS 0xfe4b074c /* @ECU_Address@SwcOut_EVM_CIPV[9].position.heading_angle@ */ /end MEASUREMENT
/begin MEASUREMENT SwcOut_EVM_CIPV[9].position.x "" FLOAT32_IEEE autosar_swc_tos_CM_single 0 0 -3.4E+38 3.4E+38 ECU_ADDRESS 0xfe4b0744 /* @ECU_Address@SwcOut_EVM_CIPV[9].position.x@ */ /end MEASUREMENT
/begin MEASUREMENT SwcOut_EVM_CIPV[9].position.y "" FLOAT32_IEEE autosar_swc_tos_CM_single 0 0 -3.4E+38 3.4E+38 ECU_ADDRESS 0xfe4b0748 /* @ECU_Address@SwcOut_EVM_CIPV[9].position.y@ */ /end MEASUREMENT
/begin MEASUREMENT SwcOut_EVM_CIPV[9].position_sl.heading_angle "" FLOAT32_IEEE autosar_swc_tos_CM_single 0 0 -3.4E+38 3.4E+38 ECU_ADDRESS 0xfe4b0758 /* @ECU_Address@SwcOut_EVM_CIPV[9].position_sl.heading_angle@ */ /end MEASUREMENT
/begin MEASUREMENT SwcOut_EVM_CIPV[9].position_sl.x "" FLOAT32_IEEE autosar_swc_tos_CM_single 0 0 -3.4E+38 3.4E+38 ECU_ADDRESS 0xfe4b0750 /* @ECU_Address@SwcOut_EVM_CIPV[9].position_sl.x@ */ /end MEASUREMENT
/begin MEASUREMENT SwcOut_EVM_CIPV[9].position_sl.y "" FLOAT32_IEEE autosar_swc_tos_CM_single 0 0 -3.4E+38 3.4E+38 ECU_ADDRESS 0xfe4b0754 /* @ECU_Address@SwcOut_EVM_CIPV[9].position_sl.y@ */ /end MEASUREMENT
/begin MEASUREMENT SwcOut_EVM_CIPV[9].ref_lane_id "" UBYTE autosar_swc_tos_CM_uint8 0 0 0 255 ECU_ADDRESS 0xfe4b071c /* @ECU_Address@SwcOut_EVM_CIPV[9].ref_lane_id@ */ /end MEASUREMENT
/begin MEASUREMENT SwcOut_EVM_CIPV[9].size.higth "" FLOAT32_IEEE autosar_swc_tos_CM_single 0 0 -3.4E+38 3.4E+38 ECU_ADDRESS 0xfe4b0764 /* @ECU_Address@SwcOut_EVM_CIPV[9].size.higth@ */ /end MEASUREMENT
/begin MEASUREMENT SwcOut_EVM_CIPV[9].size.length "" FLOAT32_IEEE autosar_swc_tos_CM_single 0 0 -3.4E+38 3.4E+38 ECU_ADDRESS 0xfe4b075c /* @ECU_Address@SwcOut_EVM_CIPV[9].size.length@ */ /end MEASUREMENT
/begin MEASUREMENT SwcOut_EVM_CIPV[9].size.width "" FLOAT32_IEEE autosar_swc_tos_CM_single 0 0 -3.4E+38 3.4E+38 ECU_ADDRESS 0xfe4b0760 /* @ECU_Address@SwcOut_EVM_CIPV[9].size.width@ */ /end MEASUREMENT
/begin MEASUREMENT SwcOut_EVM_CIPV[9].velocity_gnd.mod "" FLOAT32_IEEE autosar_swc_tos_CM_single 0 0 -3.4E+38 3.4E+38 ECU_ADDRESS 0xfe4b0770 /* @ECU_Address@SwcOut_EVM_CIPV[9].velocity_gnd.mod@ */ /end MEASUREMENT
/begin MEASUREMENT SwcOut_EVM_CIPV[9].velocity_gnd.x "" FLOAT32_IEEE autosar_swc_tos_CM_single 0 0 -3.4E+38 3.4E+38 ECU_ADDRESS 0xfe4b0768 /* @ECU_Address@SwcOut_EVM_CIPV[9].velocity_gnd.x@ */ /end MEASUREMENT
/begin MEASUREMENT SwcOut_EVM_CIPV[9].velocity_gnd.y "" FLOAT32_IEEE autosar_swc_tos_CM_single 0 0 -3.4E+38 3.4E+38 ECU_ADDRESS 0xfe4b076c /* @ECU_Address@SwcOut_EVM_CIPV[9].velocity_gnd.y@ */ /end MEASUREMENT
/begin MEASUREMENT SwcOut_EVM_CIPV[9].velocity_gnd_sl.mod "" FLOAT32_IEEE autosar_swc_tos_CM_single 0 0 -3.4E+38 3.4E+38 ECU_ADDRESS 0xfe4b0788 /* @ECU_Address@SwcOut_EVM_CIPV[9].velocity_gnd_sl.mod@ */ /end MEASUREMENT
/begin MEASUREMENT SwcOut_EVM_CIPV[9].velocity_gnd_sl.x "" FLOAT32_IEEE autosar_swc_tos_CM_single 0 0 -3.4E+38 3.4E+38 ECU_ADDRESS 0xfe4b0780 /* @ECU_Address@SwcOut_EVM_CIPV[9].velocity_gnd_sl.x@ */ /end MEASUREMENT
/begin MEASUREMENT SwcOut_EVM_CIPV[9].velocity_gnd_sl.y "" FLOAT32_IEEE autosar_swc_tos_CM_single 0 0 -3.4E+38 3.4E+38 ECU_ADDRESS 0xfe4b0784 /* @ECU_Address@SwcOut_EVM_CIPV[9].velocity_gnd_sl.y@ */ /end MEASUREMENT
/begin MEASUREMENT SwcOut_EVM_CIPV_TRAJ.id "" UBYTE autosar_swc_tos_CM_uint8 0 0 0 255 ECU_ADDRESS 0xfe4b4628 /* @ECU_Address@SwcOut_EVM_CIPV_TRAJ.id@ */ /end MEASUREMENT
/begin MEASUREMENT SwcOut_EVM_CIPV_TRAJ.obj_width "" FLOAT32_IEEE autosar_swc_tos_CM_single 0 0 -3.4E+38 3.4E+38 ECU_ADDRESS 0xfe4b462c /* @ECU_Address@SwcOut_EVM_CIPV_TRAJ.obj_width@ */ /end MEASUREMENT
/begin MEASUREMENT SwcOut_EVM_CIPV_TRAJ.ref_obj_id "" ULONG autosar_swc_tos_CM_uint32 0 0 0 4294967295 ECU_ADDRESS 0xfe4b4630 /* @ECU_Address@SwcOut_EVM_CIPV_TRAJ.ref_obj_id@ */ /end MEASUREMENT
/begin MEASUREMENT SwcOut_EVM_CIPV_TRAJ.same_team_obj_num "" UBYTE autosar_swc_tos_CM_uint8 0 0 0 255 ECU_ADDRESS 0xfe4b4629 /* @ECU_Address@SwcOut_EVM_CIPV_TRAJ.same_team_obj_num@ */ /end MEASUREMENT
/begin MEASUREMENT SwcOut_EVM_CIPV_TRAJ.traj_refline.calc_state "" UBYTE autosar_swc_tos_CM_uint8 0 0 0 255 ECU_ADDRESS 0xfe4b4635 /* @ECU_Address@SwcOut_EVM_CIPV_TRAJ.traj_refline.calc_state@ */ /end MEASUREMENT
/begin MEASUREMENT SwcOut_EVM_CIPV_TRAJ.traj_refline.curve.end "" FLOAT32_IEEE autosar_swc_tos_CM_single 0 0 -3.4E+38 3.4E+38 ECU_ADDRESS 0xfe4b4640 /* @ECU_Address@SwcOut_EVM_CIPV_TRAJ.traj_refline.curve.end@ */ /end MEASUREMENT
/begin MEASUREMENT SwcOut_EVM_CIPV_TRAJ.traj_refline.curve.poly_vec "" FLOAT32_IEEE autosar_swc_tos_CM_single 0 0 -3.4E+38 3.4E+38 LAYOUT COLUMN_DIR MATRIX_DIM 6 ECU_ADDRESS 0xfe4b4644 /* @ECU_Address@SwcOut_EVM_CIPV_TRAJ.traj_refline.curve.poly_vec@ */ /end MEASUREMENT
/begin MEASUREMENT SwcOut_EVM_CIPV_TRAJ.traj_refline.curve.start "" FLOAT32_IEEE autosar_swc_tos_CM_single 0 0 -3.4E+38 3.4E+38 ECU_ADDRESS 0xfe4b463c /* @ECU_Address@SwcOut_EVM_CIPV_TRAJ.traj_refline.curve.start@ */ /end MEASUREMENT
/begin MEASUREMENT SwcOut_EVM_CIPV_TRAJ.traj_refline.id "" ULONG autosar_swc_tos_CM_uint32 0 0 0 4294967295 ECU_ADDRESS 0xfe4b4638 /* @ECU_Address@SwcOut_EVM_CIPV_TRAJ.traj_refline.id@ */ /end MEASUREMENT
/begin MEASUREMENT SwcOut_EVM_CIPV_TRAJ.traj_refline.ref_source "" UBYTE autosar_swc_tos_CM_uint8 0 0 0 255 ECU_ADDRESS 0xfe4b4634 /* @ECU_Address@SwcOut_EVM_CIPV_TRAJ.traj_refline.ref_source@ */ /end MEASUREMENT
/begin MEASUREMENT SwcOut_EVM_LANE_MAXSPD[0].lane_id "" UBYTE autosar_swc_tos_CM_uint8 0 0 0 255 ECU_ADDRESS 0xfe4b0798 /* @ECU_Address@SwcOut_EVM_LANE_MAXSPD[0].lane_id@ */ /end MEASUREMENT
/begin MEASUREMENT SwcOut_EVM_LANE_MAXSPD[0].max_spd_high_assumed "" FLOAT32_IEEE autosar_swc_tos_CM_single 0 0 -3.4E+38 3.4E+38 ECU_ADDRESS 0xfe4b079c /* @ECU_Address@SwcOut_EVM_LANE_MAXSPD[0].max_spd_high_assumed@ */ /end MEASUREMENT
/begin MEASUREMENT SwcOut_EVM_LANE_MAXSPD[0].max_spd_low_assumed "" FLOAT32_IEEE autosar_swc_tos_CM_single 0 0 -3.4E+38 3.4E+38 ECU_ADDRESS 0xfe4b07a0 /* @ECU_Address@SwcOut_EVM_LANE_MAXSPD[0].max_spd_low_assumed@ */ /end MEASUREMENT
/begin MEASUREMENT SwcOut_EVM_LANE_MAXSPD[0].spd_block_dis "" FLOAT32_IEEE autosar_swc_tos_CM_single 0 0 -3.4E+38 3.4E+38 ECU_ADDRESS 0xfe4b07a4 /* @ECU_Address@SwcOut_EVM_LANE_MAXSPD[0].spd_block_dis@ */ /end MEASUREMENT
/begin MEASUREMENT SwcOut_EVM_LANE_MAXSPD[1].lane_id "" UBYTE autosar_swc_tos_CM_uint8 0 0 0 255 ECU_ADDRESS 0xfe4b07a8 /* @ECU_Address@SwcOut_EVM_LANE_MAXSPD[1].lane_id@ */ /end MEASUREMENT
/begin MEASUREMENT SwcOut_EVM_LANE_MAXSPD[1].max_spd_high_assumed "" FLOAT32_IEEE autosar_swc_tos_CM_single 0 0 -3.4E+38 3.4E+38 ECU_ADDRESS 0xfe4b07ac /* @ECU_Address@SwcOut_EVM_LANE_MAXSPD[1].max_spd_high_assumed@ */ /end MEASUREMENT
/begin MEASUREMENT SwcOut_EVM_LANE_MAXSPD[1].max_spd_low_assumed "" FLOAT32_IEEE autosar_swc_tos_CM_single 0 0 -3.4E+38 3.4E+38 ECU_ADDRESS 0xfe4b07b0 /* @ECU_Address@SwcOut_EVM_LANE_MAXSPD[1].max_spd_low_assumed@ */ /end MEASUREMENT
/begin MEASUREMENT SwcOut_EVM_LANE_MAXSPD[1].spd_block_dis "" FLOAT32_IEEE autosar_swc_tos_CM_single 0 0 -3.4E+38 3.4E+38 ECU_ADDRESS 0xfe4b07b4 /* @ECU_Address@SwcOut_EVM_LANE_MAXSPD[1].spd_block_dis@ */ /end MEASUREMENT
/begin MEASUREMENT SwcOut_EVM_LANE_MAXSPD[2].lane_id "" UBYTE autosar_swc_tos_CM_uint8 0 0 0 255 ECU_ADDRESS 0xfe4b07b8 /* @ECU_Address@SwcOut_EVM_LANE_MAXSPD[2].lane_id@ */ /end MEASUREMENT
/begin MEASUREMENT SwcOut_EVM_LANE_MAXSPD[2].max_spd_high_assumed "" FLOAT32_IEEE autosar_swc_tos_CM_single 0 0 -3.4E+38 3.4E+38 ECU_ADDRESS 0xfe4b07bc /* @ECU_Address@SwcOut_EVM_LANE_MAXSPD[2].max_spd_high_assumed@ */ /end MEASUREMENT
/begin MEASUREMENT SwcOut_EVM_LANE_MAXSPD[2].max_spd_low_assumed "" FLOAT32_IEEE autosar_swc_tos_CM_single 0 0 -3.4E+38 3.4E+38 ECU_ADDRESS 0xfe4b07c0 /* @ECU_Address@SwcOut_EVM_LANE_MAXSPD[2].max_spd_low_assumed@ */ /end MEASUREMENT
/begin MEASUREMENT SwcOut_EVM_LANE_MAXSPD[2].spd_block_dis "" FLOAT32_IEEE autosar_swc_tos_CM_single 0 0 -3.4E+38 3.4E+38 ECU_ADDRESS 0xfe4b07c4 /* @ECU_Address@SwcOut_EVM_LANE_MAXSPD[2].spd_block_dis@ */ /end MEASUREMENT
/begin MEASUREMENT SwcOut_EVM_LANE_NUDGE.nudge_dx "" FLOAT32_IEEE autosar_swc_tos_CM_single 0 0 -3.4E+38 3.4E+38 ECU_ADDRESS 0xfe4b4664 /* @ECU_Address@SwcOut_EVM_LANE_NUDGE.nudge_dx@ */ /end MEASUREMENT
/begin MEASUREMENT SwcOut_EVM_LANE_NUDGE.nudge_offset "" FLOAT32_IEEE autosar_swc_tos_CM_single 0 0 -3.4E+38 3.4E+38 ECU_ADDRESS 0xfe4b4668 /* @ECU_Address@SwcOut_EVM_LANE_NUDGE.nudge_offset@ */ /end MEASUREMENT
/begin MEASUREMENT SwcOut_EVM_LANE_NUDGE.nudge_speed_limit "" FLOAT32_IEEE autosar_swc_tos_CM_single 0 0 -3.4E+38 3.4E+38 ECU_ADDRESS 0xfe4b466c /* @ECU_Address@SwcOut_EVM_LANE_NUDGE.nudge_speed_limit@ */ /end MEASUREMENT
/begin MEASUREMENT SwcOut_EVM_LANE_NUDGE.nudge_type "" UBYTE autosar_swc_tos_CM_uint8 0 0 0 255 ECU_ADDRESS 0xfe4b465c /* @ECU_Address@SwcOut_EVM_LANE_NUDGE.nudge_type@ */ /end MEASUREMENT
/begin MEASUREMENT SwcOut_EVM_LANE_NUDGE.obj_id "" ULONG autosar_swc_tos_CM_uint32 0 0 0 4294967295 ECU_ADDRESS 0xfe4b4674 /* @ECU_Address@SwcOut_EVM_LANE_NUDGE.obj_id@ */ /end MEASUREMENT
/begin MEASUREMENT SwcOut_EVM_LANE_NUDGE.ref_lane_id "" FLOAT32_IEEE autosar_swc_tos_CM_single 0 0 -3.4E+38 3.4E+38 ECU_ADDRESS 0xfe4b4660 /* @ECU_Address@SwcOut_EVM_LANE_NUDGE.ref_lane_id@ */ /end MEASUREMENT
/begin MEASUREMENT SwcOut_EVM_LANE_NUDGE.reserved "" FLOAT32_IEEE autosar_swc_tos_CM_single 0 0 -3.4E+38 3.4E+38 ECU_ADDRESS 0xfe4b4670 /* @ECU_Address@SwcOut_EVM_LANE_NUDGE.reserved@ */ /end MEASUREMENT
/begin MEASUREMENT SwcOut_EVM_TRAFFIC_SCEN.traffic_scene "" UBYTE autosar_swc_tos_CM_uint8 0 0 0 255 ECU_ADDRESS 0xfe4b4900 /* @ECU_Address@SwcOut_EVM_TRAFFIC_SCEN.traffic_scene@ */ /end MEASUREMENT
/begin MEASUREMENT SwcOut_EVM_TRAFFIC_SCEN.trucks_around "" UBYTE autosar_swc_tos_CM_uint8 0 0 0 255 ECU_ADDRESS 0xfe4b4901 /* @ECU_Address@SwcOut_EVM_TRAFFIC_SCEN.trucks_around@ */ /end MEASUREMENT
/begin MEASUREMENT SwcOut_EVM_VT_LANE.id "" UBYTE autosar_swc_tos_CM_uint8 0 0 0 255 ECU_ADDRESS 0xfe4b4678 /* @ECU_Address@SwcOut_EVM_VT_LANE.id@ */ /end MEASUREMENT
/begin MEASUREMENT SwcOut_EVM_VT_LANE.team_obj_total_num "" UBYTE autosar_swc_tos_CM_uint8 0 0 0 255 ECU_ADDRESS 0xfe4b4679 /* @ECU_Address@SwcOut_EVM_VT_LANE.team_obj_total_num@ */ /end MEASUREMENT
/begin MEASUREMENT SwcOut_EVM_VT_LANE.traj_refline.calc_state "" UBYTE autosar_swc_tos_CM_uint8 0 0 0 255 ECU_ADDRESS 0xfe4b467d /* @ECU_Address@SwcOut_EVM_VT_LANE.traj_refline.calc_state@ */ /end MEASUREMENT
/begin MEASUREMENT SwcOut_EVM_VT_LANE.traj_refline.curve.end "" FLOAT32_IEEE autosar_swc_tos_CM_single 0 0 -3.4E+38 3.4E+38 ECU_ADDRESS 0xfe4b4688 /* @ECU_Address@SwcOut_EVM_VT_LANE.traj_refline.curve.end@ */ /end MEASUREMENT
/begin MEASUREMENT SwcOut_EVM_VT_LANE.traj_refline.curve.poly_vec "" FLOAT32_IEEE autosar_swc_tos_CM_single 0 0 -3.4E+38 3.4E+38 LAYOUT COLUMN_DIR MATRIX_DIM 6 ECU_ADDRESS 0xfe4b468c /* @ECU_Address@SwcOut_EVM_VT_LANE.traj_refline.curve.poly_vec@ */ /end MEASUREMENT
/begin MEASUREMENT SwcOut_EVM_VT_LANE.traj_refline.curve.start "" FLOAT32_IEEE autosar_swc_tos_CM_single 0 0 -3.4E+38 3.4E+38 ECU_ADDRESS 0xfe4b4684 /* @ECU_Address@SwcOut_EVM_VT_LANE.traj_refline.curve.start@ */ /end MEASUREMENT
/begin MEASUREMENT SwcOut_EVM_VT_LANE.traj_refline.id "" ULONG autosar_swc_tos_CM_uint32 0 0 0 4294967295 ECU_ADDRESS 0xfe4b4680 /* @ECU_Address@SwcOut_EVM_VT_LANE.traj_refline.id@ */ /end MEASUREMENT
/begin MEASUREMENT SwcOut_EVM_VT_LANE.traj_refline.ref_source "" UBYTE autosar_swc_tos_CM_uint8 0 0 0 255 ECU_ADDRESS 0xfe4b467c /* @ECU_Address@SwcOut_EVM_VT_LANE.traj_refline.ref_source@ */ /end MEASUREMENT
/begin MEASUREMENT SwcOut_TOS_ACCP0.Object_Hight "" FLOAT32_IEEE autosar_swc_tos_CM_single 0 0 -3.4E+38 3.4E+38 ECU_ADDRESS 0xfe4b0804 /* @ECU_Address@SwcOut_TOS_ACCP0.Object_Hight@ */ /end MEASUREMENT
/begin MEASUREMENT SwcOut_TOS_ACCP0.Object_Length "" FLOAT32_IEEE autosar_swc_tos_CM_single 0 0 -3.4E+38 3.4E+38 ECU_ADDRESS 0xfe4b07fc /* @ECU_Address@SwcOut_TOS_ACCP0.Object_Length@ */ /end MEASUREMENT
/begin MEASUREMENT SwcOut_TOS_ACCP0.Object_Width "" FLOAT32_IEEE autosar_swc_tos_CM_single 0 0 -3.4E+38 3.4E+38 ECU_ADDRESS 0xfe4b0800 /* @ECU_Address@SwcOut_TOS_ACCP0.Object_Width@ */ /end MEASUREMENT
/begin MEASUREMENT SwcOut_TOS_ACCP0.age "" A_UINT64 autosar_swc_tos_CM_uint64 0 0 0 18446744073709551615 ECU_ADDRESS 0xfe4b0810 /* @ECU_Address@SwcOut_TOS_ACCP0.age@ */ /end MEASUREMENT
/begin MEASUREMENT SwcOut_TOS_ACCP0.axAbs "" FLOAT32_IEEE autosar_swc_tos_CM_single 0 0 -3.4E+38 3.4E+38 ECU_ADDRESS 0xfe4b07e8 /* @ECU_Address@SwcOut_TOS_ACCP0.axAbs@ */ /end MEASUREMENT
/begin MEASUREMENT SwcOut_TOS_ACCP0.ayAbs "" FLOAT32_IEEE autosar_swc_tos_CM_single 0 0 -3.4E+38 3.4E+38 ECU_ADDRESS 0xfe4b07ec /* @ECU_Address@SwcOut_TOS_ACCP0.ayAbs@ */ /end MEASUREMENT
/begin MEASUREMENT SwcOut_TOS_ACCP0.brakeIntention "" UBYTE autosar_swc_tos_CM_boolean 0 0 0 1 ECU_ADDRESS 0xfe4b07ca /* @ECU_Address@SwcOut_TOS_ACCP0.brakeIntention@ */ /end MEASUREMENT
/begin MEASUREMENT SwcOut_TOS_ACCP0.cutInflg "" UBYTE autosar_swc_tos_CM_boolean 0 0 0 1 ECU_ADDRESS 0xfe4b07c9 /* @ECU_Address@SwcOut_TOS_ACCP0.cutInflg@ */ /end MEASUREMENT
/begin MEASUREMENT SwcOut_TOS_ACCP0.dx "" FLOAT32_IEEE autosar_swc_tos_CM_single 0 0 -3.4E+38 3.4E+38 ECU_ADDRESS 0xfe4b07d0 /* @ECU_Address@SwcOut_TOS_ACCP0.dx@ */ /end MEASUREMENT
/begin MEASUREMENT SwcOut_TOS_ACCP0.dy "" FLOAT32_IEEE autosar_swc_tos_CM_single 0 0 -3.4E+38 3.4E+38 ECU_ADDRESS 0xfe4b07d4 /* @ECU_Address@SwcOut_TOS_ACCP0.dy@ */ /end MEASUREMENT
/begin MEASUREMENT SwcOut_TOS_ACCP0.fu_type "" UWORD autosar_swc_tos_CM_uint16 0 0 0 65535 ECU_ADDRESS 0xfe4b07ce /* @ECU_Address@SwcOut_TOS_ACCP0.fu_type@ */ /end MEASUREMENT
/begin MEASUREMENT SwcOut_TOS_ACCP0.headingAngle "" FLOAT32_IEEE autosar_swc_tos_CM_single 0 0 -3.4E+38 3.4E+38 ECU_ADDRESS 0xfe4b07f8 /* @ECU_Address@SwcOut_TOS_ACCP0.headingAngle@ */ /end MEASUREMENT
/begin MEASUREMENT SwcOut_TOS_ACCP0.id "" ULONG autosar_swc_tos_CM_uint32 0 0 0 4294967295 ECU_ADDRESS 0xfe4b0808 /* @ECU_Address@SwcOut_TOS_ACCP0.id@ */ /end MEASUREMENT
/begin MEASUREMENT SwcOut_TOS_ACCP0.movingState "" UBYTE autosar_swc_tos_CM_uint8 0 0 0 255 ECU_ADDRESS 0xfe4b07cb /* @ECU_Address@SwcOut_TOS_ACCP0.movingState@ */ /end MEASUREMENT
/begin MEASUREMENT SwcOut_TOS_ACCP0.objExist "" FLOAT32_IEEE autosar_swc_tos_CM_single 0 0 -3.4E+38 3.4E+38 ECU_ADDRESS 0xfe4b07f4 /* @ECU_Address@SwcOut_TOS_ACCP0.objExist@ */ /end MEASUREMENT
/begin MEASUREMENT SwcOut_TOS_ACCP0.orientation "" UBYTE autosar_swc_tos_CM_uint8 0 0 0 255 ECU_ADDRESS 0xfe4b07cc /* @ECU_Address@SwcOut_TOS_ACCP0.orientation@ */ /end MEASUREMENT
/begin MEASUREMENT SwcOut_TOS_ACCP0.range "" FLOAT32_IEEE autosar_swc_tos_CM_single 0 0 -3.4E+38 3.4E+38 ECU_ADDRESS 0xfe4b07f0 /* @ECU_Address@SwcOut_TOS_ACCP0.range@ */ /end MEASUREMENT
/begin MEASUREMENT SwcOut_TOS_ACCP0.targetExist "" UBYTE autosar_swc_tos_CM_boolean 0 0 0 1 ECU_ADDRESS 0xfe4b07c8 /* @ECU_Address@SwcOut_TOS_ACCP0.targetExist@ */ /end MEASUREMENT
/begin MEASUREMENT SwcOut_TOS_ACCP0.type "" UBYTE autosar_swc_tos_CM_uint8 0 0 0 255 ECU_ADDRESS 0xfe4b07cd /* @ECU_Address@SwcOut_TOS_ACCP0.type@ */ /end MEASUREMENT
/begin MEASUREMENT SwcOut_TOS_ACCP0.vxAbs "" FLOAT32_IEEE autosar_swc_tos_CM_single 0 0 -3.4E+38 3.4E+38 ECU_ADDRESS 0xfe4b07e0 /* @ECU_Address@SwcOut_TOS_ACCP0.vxAbs@ */ /end MEASUREMENT
/begin MEASUREMENT SwcOut_TOS_ACCP0.vxRel "" FLOAT32_IEEE autosar_swc_tos_CM_single 0 0 -3.4E+38 3.4E+38 ECU_ADDRESS 0xfe4b07d8 /* @ECU_Address@SwcOut_TOS_ACCP0.vxRel@ */ /end MEASUREMENT
/begin MEASUREMENT SwcOut_TOS_ACCP0.vyAbs "" FLOAT32_IEEE autosar_swc_tos_CM_single 0 0 -3.4E+38 3.4E+38 ECU_ADDRESS 0xfe4b07e4 /* @ECU_Address@SwcOut_TOS_ACCP0.vyAbs@ */ /end MEASUREMENT
/begin MEASUREMENT SwcOut_TOS_ACCP0.vyRel "" FLOAT32_IEEE autosar_swc_tos_CM_single 0 0 -3.4E+38 3.4E+38 ECU_ADDRESS 0xfe4b07dc /* @ECU_Address@SwcOut_TOS_ACCP0.vyRel@ */ /end MEASUREMENT
/begin MEASUREMENT SwcOut_TOS_ACCP1.Object_Hight "" FLOAT32_IEEE autosar_swc_tos_CM_single 0 0 -3.4E+38 3.4E+38 ECU_ADDRESS 0xfe4b0854 /* @ECU_Address@SwcOut_TOS_ACCP1.Object_Hight@ */ /end MEASUREMENT
/begin MEASUREMENT SwcOut_TOS_ACCP1.Object_Length "" FLOAT32_IEEE autosar_swc_tos_CM_single 0 0 -3.4E+38 3.4E+38 ECU_ADDRESS 0xfe4b084c /* @ECU_Address@SwcOut_TOS_ACCP1.Object_Length@ */ /end MEASUREMENT
/begin MEASUREMENT SwcOut_TOS_ACCP1.Object_Width "" FLOAT32_IEEE autosar_swc_tos_CM_single 0 0 -3.4E+38 3.4E+38 ECU_ADDRESS 0xfe4b0850 /* @ECU_Address@SwcOut_TOS_ACCP1.Object_Width@ */ /end MEASUREMENT
/begin MEASUREMENT SwcOut_TOS_ACCP1.age "" A_UINT64 autosar_swc_tos_CM_uint64 0 0 0 18446744073709551615 ECU_ADDRESS 0xfe4b0860 /* @ECU_Address@SwcOut_TOS_ACCP1.age@ */ /end MEASUREMENT
/begin MEASUREMENT SwcOut_TOS_ACCP1.axAbs "" FLOAT32_IEEE autosar_swc_tos_CM_single 0 0 -3.4E+38 3.4E+38 ECU_ADDRESS 0xfe4b0838 /* @ECU_Address@SwcOut_TOS_ACCP1.axAbs@ */ /end MEASUREMENT
/begin MEASUREMENT SwcOut_TOS_ACCP1.ayAbs "" FLOAT32_IEEE autosar_swc_tos_CM_single 0 0 -3.4E+38 3.4E+38 ECU_ADDRESS 0xfe4b083c /* @ECU_Address@SwcOut_TOS_ACCP1.ayAbs@ */ /end MEASUREMENT
/begin MEASUREMENT SwcOut_TOS_ACCP1.brakeIntention "" UBYTE autosar_swc_tos_CM_boolean 0 0 0 1 ECU_ADDRESS 0xfe4b081a /* @ECU_Address@SwcOut_TOS_ACCP1.brakeIntention@ */ /end MEASUREMENT
/begin MEASUREMENT SwcOut_TOS_ACCP1.cutInflg "" UBYTE autosar_swc_tos_CM_boolean 0 0 0 1 ECU_ADDRESS 0xfe4b0819 /* @ECU_Address@SwcOut_TOS_ACCP1.cutInflg@ */ /end MEASUREMENT
/begin MEASUREMENT SwcOut_TOS_ACCP1.dx "" FLOAT32_IEEE autosar_swc_tos_CM_single 0 0 -3.4E+38 3.4E+38 ECU_ADDRESS 0xfe4b0820 /* @ECU_Address@SwcOut_TOS_ACCP1.dx@ */ /end MEASUREMENT
/begin MEASUREMENT SwcOut_TOS_ACCP1.dy "" FLOAT32_IEEE autosar_swc_tos_CM_single 0 0 -3.4E+38 3.4E+38 ECU_ADDRESS 0xfe4b0824 /* @ECU_Address@SwcOut_TOS_ACCP1.dy@ */ /end MEASUREMENT
/begin MEASUREMENT SwcOut_TOS_ACCP1.fu_type "" UWORD autosar_swc_tos_CM_uint16 0 0 0 65535 ECU_ADDRESS 0xfe4b081e /* @ECU_Address@SwcOut_TOS_ACCP1.fu_type@ */ /end MEASUREMENT
/begin MEASUREMENT SwcOut_TOS_ACCP1.headingAngle "" FLOAT32_IEEE autosar_swc_tos_CM_single 0 0 -3.4E+38 3.4E+38 ECU_ADDRESS 0xfe4b0848 /* @ECU_Address@SwcOut_TOS_ACCP1.headingAngle@ */ /end MEASUREMENT
/begin MEASUREMENT SwcOut_TOS_ACCP1.id "" ULONG autosar_swc_tos_CM_uint32 0 0 0 4294967295 ECU_ADDRESS 0xfe4b0858 /* @ECU_Address@SwcOut_TOS_ACCP1.id@ */ /end MEASUREMENT
/begin MEASUREMENT SwcOut_TOS_ACCP1.movingState "" UBYTE autosar_swc_tos_CM_uint8 0 0 0 255 ECU_ADDRESS 0xfe4b081b /* @ECU_Address@SwcOut_TOS_ACCP1.movingState@ */ /end MEASUREMENT
/begin MEASUREMENT SwcOut_TOS_ACCP1.objExist "" FLOAT32_IEEE autosar_swc_tos_CM_single 0 0 -3.4E+38 3.4E+38 ECU_ADDRESS 0xfe4b0844 /* @ECU_Address@SwcOut_TOS_ACCP1.objExist@ */ /end MEASUREMENT
/begin MEASUREMENT SwcOut_TOS_ACCP1.orientation "" UBYTE autosar_swc_tos_CM_uint8 0 0 0 255 ECU_ADDRESS 0xfe4b081c /* @ECU_Address@SwcOut_TOS_ACCP1.orientation@ */ /end MEASUREMENT
/begin MEASUREMENT SwcOut_TOS_ACCP1.range "" FLOAT32_IEEE autosar_swc_tos_CM_single 0 0 -3.4E+38 3.4E+38 ECU_ADDRESS 0xfe4b0840 /* @ECU_Address@SwcOut_TOS_ACCP1.range@ */ /end MEASUREMENT
/begin MEASUREMENT SwcOut_TOS_ACCP1.targetExist "" UBYTE autosar_swc_tos_CM_boolean 0 0 0 1 ECU_ADDRESS 0xfe4b0818 /* @ECU_Address@SwcOut_TOS_ACCP1.targetExist@ */ /end MEASUREMENT
/begin MEASUREMENT SwcOut_TOS_ACCP1.type "" UBYTE autosar_swc_tos_CM_uint8 0 0 0 255 ECU_ADDRESS 0xfe4b081d /* @ECU_Address@SwcOut_TOS_ACCP1.type@ */ /end MEASUREMENT
/begin MEASUREMENT SwcOut_TOS_ACCP1.vxAbs "" FLOAT32_IEEE autosar_swc_tos_CM_single 0 0 -3.4E+38 3.4E+38 ECU_ADDRESS 0xfe4b0830 /* @ECU_Address@SwcOut_TOS_ACCP1.vxAbs@ */ /end MEASUREMENT
/begin MEASUREMENT SwcOut_TOS_ACCP1.vxRel "" FLOAT32_IEEE autosar_swc_tos_CM_single 0 0 -3.4E+38 3.4E+38 ECU_ADDRESS 0xfe4b0828 /* @ECU_Address@SwcOut_TOS_ACCP1.vxRel@ */ /end MEASUREMENT
/begin MEASUREMENT SwcOut_TOS_ACCP1.vyAbs "" FLOAT32_IEEE autosar_swc_tos_CM_single 0 0 -3.4E+38 3.4E+38 ECU_ADDRESS 0xfe4b0834 /* @ECU_Address@SwcOut_TOS_ACCP1.vyAbs@ */ /end MEASUREMENT
/begin MEASUREMENT SwcOut_TOS_ACCP1.vyRel "" FLOAT32_IEEE autosar_swc_tos_CM_single 0 0 -3.4E+38 3.4E+38 ECU_ADDRESS 0xfe4b082c /* @ECU_Address@SwcOut_TOS_ACCP1.vyRel@ */ /end MEASUREMENT
/begin MEASUREMENT SwcOut_TOS_ACCP2.Object_Hight "" FLOAT32_IEEE autosar_swc_tos_CM_single 0 0 -3.4E+38 3.4E+38 ECU_ADDRESS 0xfe4b08a4 /* @ECU_Address@SwcOut_TOS_ACCP2.Object_Hight@ */ /end MEASUREMENT
/begin MEASUREMENT SwcOut_TOS_ACCP2.Object_Length "" FLOAT32_IEEE autosar_swc_tos_CM_single 0 0 -3.4E+38 3.4E+38 ECU_ADDRESS 0xfe4b089c /* @ECU_Address@SwcOut_TOS_ACCP2.Object_Length@ */ /end MEASUREMENT
/begin MEASUREMENT SwcOut_TOS_ACCP2.Object_Width "" FLOAT32_IEEE autosar_swc_tos_CM_single 0 0 -3.4E+38 3.4E+38 ECU_ADDRESS 0xfe4b08a0 /* @ECU_Address@SwcOut_TOS_ACCP2.Object_Width@ */ /end MEASUREMENT
/begin MEASUREMENT SwcOut_TOS_ACCP2.age "" A_UINT64 autosar_swc_tos_CM_uint64 0 0 0 18446744073709551615 ECU_ADDRESS 0xfe4b08b0 /* @ECU_Address@SwcOut_TOS_ACCP2.age@ */ /end MEASUREMENT
/begin MEASUREMENT SwcOut_TOS_ACCP2.axAbs "" FLOAT32_IEEE autosar_swc_tos_CM_single 0 0 -3.4E+38 3.4E+38 ECU_ADDRESS 0xfe4b0888 /* @ECU_Address@SwcOut_TOS_ACCP2.axAbs@ */ /end MEASUREMENT
/begin MEASUREMENT SwcOut_TOS_ACCP2.ayAbs "" FLOAT32_IEEE autosar_swc_tos_CM_single 0 0 -3.4E+38 3.4E+38 ECU_ADDRESS 0xfe4b088c /* @ECU_Address@SwcOut_TOS_ACCP2.ayAbs@ */ /end MEASUREMENT
/begin MEASUREMENT SwcOut_TOS_ACCP2.brakeIntention "" UBYTE autosar_swc_tos_CM_boolean 0 0 0 1 ECU_ADDRESS 0xfe4b086a /* @ECU_Address@SwcOut_TOS_ACCP2.brakeIntention@ */ /end MEASUREMENT
/begin MEASUREMENT SwcOut_TOS_ACCP2.cutInflg "" UBYTE autosar_swc_tos_CM_boolean 0 0 0 1 ECU_ADDRESS 0xfe4b0869 /* @ECU_Address@SwcOut_TOS_ACCP2.cutInflg@ */ /end MEASUREMENT
/begin MEASUREMENT SwcOut_TOS_ACCP2.dx "" FLOAT32_IEEE autosar_swc_tos_CM_single 0 0 -3.4E+38 3.4E+38 ECU_ADDRESS 0xfe4b0870 /* @ECU_Address@SwcOut_TOS_ACCP2.dx@ */ /end MEASUREMENT
/begin MEASUREMENT SwcOut_TOS_ACCP2.dy "" FLOAT32_IEEE autosar_swc_tos_CM_single 0 0 -3.4E+38 3.4E+38 ECU_ADDRESS 0xfe4b0874 /* @ECU_Address@SwcOut_TOS_ACCP2.dy@ */ /end MEASUREMENT
/begin MEASUREMENT SwcOut_TOS_ACCP2.fu_type "" UWORD autosar_swc_tos_CM_uint16 0 0 0 65535 ECU_ADDRESS 0xfe4b086e /* @ECU_Address@SwcOut_TOS_ACCP2.fu_type@ */ /end MEASUREMENT
/begin MEASUREMENT SwcOut_TOS_ACCP2.headingAngle "" FLOAT32_IEEE autosar_swc_tos_CM_single 0 0 -3.4E+38 3.4E+38 ECU_ADDRESS 0xfe4b0898 /* @ECU_Address@SwcOut_TOS_ACCP2.headingAngle@ */ /end MEASUREMENT
/begin MEASUREMENT SwcOut_TOS_ACCP2.id "" ULONG autosar_swc_tos_CM_uint32 0 0 0 4294967295 ECU_ADDRESS 0xfe4b08a8 /* @ECU_Address@SwcOut_TOS_ACCP2.id@ */ /end MEASUREMENT
/begin MEASUREMENT SwcOut_TOS_ACCP2.movingState "" UBYTE autosar_swc_tos_CM_uint8 0 0 0 255 ECU_ADDRESS 0xfe4b086b /* @ECU_Address@SwcOut_TOS_ACCP2.movingState@ */ /end MEASUREMENT
/begin MEASUREMENT SwcOut_TOS_ACCP2.objExist "" FLOAT32_IEEE autosar_swc_tos_CM_single 0 0 -3.4E+38 3.4E+38 ECU_ADDRESS 0xfe4b0894 /* @ECU_Address@SwcOut_TOS_ACCP2.objExist@ */ /end MEASUREMENT
/begin MEASUREMENT SwcOut_TOS_ACCP2.orientation "" UBYTE autosar_swc_tos_CM_uint8 0 0 0 255 ECU_ADDRESS 0xfe4b086c /* @ECU_Address@SwcOut_TOS_ACCP2.orientation@ */ /end MEASUREMENT
/begin MEASUREMENT SwcOut_TOS_ACCP2.range "" FLOAT32_IEEE autosar_swc_tos_CM_single 0 0 -3.4E+38 3.4E+38 ECU_ADDRESS 0xfe4b0890 /* @ECU_Address@SwcOut_TOS_ACCP2.range@ */ /end MEASUREMENT
/begin MEASUREMENT SwcOut_TOS_ACCP2.targetExist "" UBYTE autosar_swc_tos_CM_boolean 0 0 0 1 ECU_ADDRESS 0xfe4b0868 /* @ECU_Address@SwcOut_TOS_ACCP2.targetExist@ */ /end MEASUREMENT
/begin MEASUREMENT SwcOut_TOS_ACCP2.type "" UBYTE autosar_swc_tos_CM_uint8 0 0 0 255 ECU_ADDRESS 0xfe4b086d /* @ECU_Address@SwcOut_TOS_ACCP2.type@ */ /end MEASUREMENT
/begin MEASUREMENT SwcOut_TOS_ACCP2.vxAbs "" FLOAT32_IEEE autosar_swc_tos_CM_single 0 0 -3.4E+38 3.4E+38 ECU_ADDRESS 0xfe4b0880 /* @ECU_Address@SwcOut_TOS_ACCP2.vxAbs@ */ /end MEASUREMENT
/begin MEASUREMENT SwcOut_TOS_ACCP2.vxRel "" FLOAT32_IEEE autosar_swc_tos_CM_single 0 0 -3.4E+38 3.4E+38 ECU_ADDRESS 0xfe4b0878 /* @ECU_Address@SwcOut_TOS_ACCP2.vxRel@ */ /end MEASUREMENT
/begin MEASUREMENT SwcOut_TOS_ACCP2.vyAbs "" FLOAT32_IEEE autosar_swc_tos_CM_single 0 0 -3.4E+38 3.4E+38 ECU_ADDRESS 0xfe4b0884 /* @ECU_Address@SwcOut_TOS_ACCP2.vyAbs@ */ /end MEASUREMENT
/begin MEASUREMENT SwcOut_TOS_ACCP2.vyRel "" FLOAT32_IEEE autosar_swc_tos_CM_single 0 0 -3.4E+38 3.4E+38 ECU_ADDRESS 0xfe4b087c /* @ECU_Address@SwcOut_TOS_ACCP2.vyRel@ */ /end MEASUREMENT
/begin MEASUREMENT SwcOut_TOS_ACCP3.Object_Hight "" FLOAT32_IEEE autosar_swc_tos_CM_single 0 0 -3.4E+38 3.4E+38 ECU_ADDRESS 0xfe4b08f4 /* @ECU_Address@SwcOut_TOS_ACCP3.Object_Hight@ */ /end MEASUREMENT
/begin MEASUREMENT SwcOut_TOS_ACCP3.Object_Length "" FLOAT32_IEEE autosar_swc_tos_CM_single 0 0 -3.4E+38 3.4E+38 ECU_ADDRESS 0xfe4b08ec /* @ECU_Address@SwcOut_TOS_ACCP3.Object_Length@ */ /end MEASUREMENT
/begin MEASUREMENT SwcOut_TOS_ACCP3.Object_Width "" FLOAT32_IEEE autosar_swc_tos_CM_single 0 0 -3.4E+38 3.4E+38 ECU_ADDRESS 0xfe4b08f0 /* @ECU_Address@SwcOut_TOS_ACCP3.Object_Width@ */ /end MEASUREMENT
/begin MEASUREMENT SwcOut_TOS_ACCP3.age "" A_UINT64 autosar_swc_tos_CM_uint64 0 0 0 18446744073709551615 ECU_ADDRESS 0xfe4b0900 /* @ECU_Address@SwcOut_TOS_ACCP3.age@ */ /end MEASUREMENT
/begin MEASUREMENT SwcOut_TOS_ACCP3.axAbs "" FLOAT32_IEEE autosar_swc_tos_CM_single 0 0 -3.4E+38 3.4E+38 ECU_ADDRESS 0xfe4b08d8 /* @ECU_Address@SwcOut_TOS_ACCP3.axAbs@ */ /end MEASUREMENT
/begin MEASUREMENT SwcOut_TOS_ACCP3.ayAbs "" FLOAT32_IEEE autosar_swc_tos_CM_single 0 0 -3.4E+38 3.4E+38 ECU_ADDRESS 0xfe4b08dc /* @ECU_Address@SwcOut_TOS_ACCP3.ayAbs@ */ /end MEASUREMENT
/begin MEASUREMENT SwcOut_TOS_ACCP3.brakeIntention "" UBYTE autosar_swc_tos_CM_boolean 0 0 0 1 ECU_ADDRESS 0xfe4b08ba /* @ECU_Address@SwcOut_TOS_ACCP3.brakeIntention@ */ /end MEASUREMENT
/begin MEASUREMENT SwcOut_TOS_ACCP3.cutInflg "" UBYTE autosar_swc_tos_CM_boolean 0 0 0 1 ECU_ADDRESS 0xfe4b08b9 /* @ECU_Address@SwcOut_TOS_ACCP3.cutInflg@ */ /end MEASUREMENT
/begin MEASUREMENT SwcOut_TOS_ACCP3.dx "" FLOAT32_IEEE autosar_swc_tos_CM_single 0 0 -3.4E+38 3.4E+38 ECU_ADDRESS 0xfe4b08c0 /* @ECU_Address@SwcOut_TOS_ACCP3.dx@ */ /end MEASUREMENT
/begin MEASUREMENT SwcOut_TOS_ACCP3.dy "" FLOAT32_IEEE autosar_swc_tos_CM_single 0 0 -3.4E+38 3.4E+38 ECU_ADDRESS 0xfe4b08c4 /* @ECU_Address@SwcOut_TOS_ACCP3.dy@ */ /end MEASUREMENT
/begin MEASUREMENT SwcOut_TOS_ACCP3.fu_type "" UWORD autosar_swc_tos_CM_uint16 0 0 0 65535 ECU_ADDRESS 0xfe4b08be /* @ECU_Address@SwcOut_TOS_ACCP3.fu_type@ */ /end MEASUREMENT
/begin MEASUREMENT SwcOut_TOS_ACCP3.headingAngle "" FLOAT32_IEEE autosar_swc_tos_CM_single 0 0 -3.4E+38 3.4E+38 ECU_ADDRESS 0xfe4b08e8 /* @ECU_Address@SwcOut_TOS_ACCP3.headingAngle@ */ /end MEASUREMENT
/begin MEASUREMENT SwcOut_TOS_ACCP3.id "" ULONG autosar_swc_tos_CM_uint32 0 0 0 4294967295 ECU_ADDRESS 0xfe4b08f8 /* @ECU_Address@SwcOut_TOS_ACCP3.id@ */ /end MEASUREMENT
/begin MEASUREMENT SwcOut_TOS_ACCP3.movingState "" UBYTE autosar_swc_tos_CM_uint8 0 0 0 255 ECU_ADDRESS 0xfe4b08bb /* @ECU_Address@SwcOut_TOS_ACCP3.movingState@ */ /end MEASUREMENT
/begin MEASUREMENT SwcOut_TOS_ACCP3.objExist "" FLOAT32_IEEE autosar_swc_tos_CM_single 0 0 -3.4E+38 3.4E+38 ECU_ADDRESS 0xfe4b08e4 /* @ECU_Address@SwcOut_TOS_ACCP3.objExist@ */ /end MEASUREMENT
/begin MEASUREMENT SwcOut_TOS_ACCP3.orientation "" UBYTE autosar_swc_tos_CM_uint8 0 0 0 255 ECU_ADDRESS 0xfe4b08bc /* @ECU_Address@SwcOut_TOS_ACCP3.orientation@ */ /end MEASUREMENT
/begin MEASUREMENT SwcOut_TOS_ACCP3.range "" FLOAT32_IEEE autosar_swc_tos_CM_single 0 0 -3.4E+38 3.4E+38 ECU_ADDRESS 0xfe4b08e0 /* @ECU_Address@SwcOut_TOS_ACCP3.range@ */ /end MEASUREMENT
/begin MEASUREMENT SwcOut_TOS_ACCP3.targetExist "" UBYTE autosar_swc_tos_CM_boolean 0 0 0 1 ECU_ADDRESS 0xfe4b08b8 /* @ECU_Address@SwcOut_TOS_ACCP3.targetExist@ */ /end MEASUREMENT
/begin MEASUREMENT SwcOut_TOS_ACCP3.type "" UBYTE autosar_swc_tos_CM_uint8 0 0 0 255 ECU_ADDRESS 0xfe4b08bd /* @ECU_Address@SwcOut_TOS_ACCP3.type@ */ /end MEASUREMENT
/begin MEASUREMENT SwcOut_TOS_ACCP3.vxAbs "" FLOAT32_IEEE autosar_swc_tos_CM_single 0 0 -3.4E+38 3.4E+38 ECU_ADDRESS 0xfe4b08d0 /* @ECU_Address@SwcOut_TOS_ACCP3.vxAbs@ */ /end MEASUREMENT
/begin MEASUREMENT SwcOut_TOS_ACCP3.vxRel "" FLOAT32_IEEE autosar_swc_tos_CM_single 0 0 -3.4E+38 3.4E+38 ECU_ADDRESS 0xfe4b08c8 /* @ECU_Address@SwcOut_TOS_ACCP3.vxRel@ */ /end MEASUREMENT
/begin MEASUREMENT SwcOut_TOS_ACCP3.vyAbs "" FLOAT32_IEEE autosar_swc_tos_CM_single 0 0 -3.4E+38 3.4E+38 ECU_ADDRESS 0xfe4b08d4 /* @ECU_Address@SwcOut_TOS_ACCP3.vyAbs@ */ /end MEASUREMENT
/begin MEASUREMENT SwcOut_TOS_ACCP3.vyRel "" FLOAT32_IEEE autosar_swc_tos_CM_single 0 0 -3.4E+38 3.4E+38 ECU_ADDRESS 0xfe4b08cc /* @ECU_Address@SwcOut_TOS_ACCP3.vyRel@ */ /end MEASUREMENT
/begin MEASUREMENT SwcOut_TOS_ACCP4.Object_Hight "" FLOAT32_IEEE autosar_swc_tos_CM_single 0 0 -3.4E+38 3.4E+38 ECU_ADDRESS 0xfe4b0944 /* @ECU_Address@SwcOut_TOS_ACCP4.Object_Hight@ */ /end MEASUREMENT
/begin MEASUREMENT SwcOut_TOS_ACCP4.Object_Length "" FLOAT32_IEEE autosar_swc_tos_CM_single 0 0 -3.4E+38 3.4E+38 ECU_ADDRESS 0xfe4b093c /* @ECU_Address@SwcOut_TOS_ACCP4.Object_Length@ */ /end MEASUREMENT
/begin MEASUREMENT SwcOut_TOS_ACCP4.Object_Width "" FLOAT32_IEEE autosar_swc_tos_CM_single 0 0 -3.4E+38 3.4E+38 ECU_ADDRESS 0xfe4b0940 /* @ECU_Address@SwcOut_TOS_ACCP4.Object_Width@ */ /end MEASUREMENT
/begin MEASUREMENT SwcOut_TOS_ACCP4.age "" A_UINT64 autosar_swc_tos_CM_uint64 0 0 0 18446744073709551615 ECU_ADDRESS 0xfe4b0950 /* @ECU_Address@SwcOut_TOS_ACCP4.age@ */ /end MEASUREMENT
/begin MEASUREMENT SwcOut_TOS_ACCP4.axAbs "" FLOAT32_IEEE autosar_swc_tos_CM_single 0 0 -3.4E+38 3.4E+38 ECU_ADDRESS 0xfe4b0928 /* @ECU_Address@SwcOut_TOS_ACCP4.axAbs@ */ /end MEASUREMENT
/begin MEASUREMENT SwcOut_TOS_ACCP4.ayAbs "" FLOAT32_IEEE autosar_swc_tos_CM_single 0 0 -3.4E+38 3.4E+38 ECU_ADDRESS 0xfe4b092c /* @ECU_Address@SwcOut_TOS_ACCP4.ayAbs@ */ /end MEASUREMENT
/begin MEASUREMENT SwcOut_TOS_ACCP4.brakeIntention "" UBYTE autosar_swc_tos_CM_boolean 0 0 0 1 ECU_ADDRESS 0xfe4b090a /* @ECU_Address@SwcOut_TOS_ACCP4.brakeIntention@ */ /end MEASUREMENT
/begin MEASUREMENT SwcOut_TOS_ACCP4.cutInflg "" UBYTE autosar_swc_tos_CM_boolean 0 0 0 1 ECU_ADDRESS 0xfe4b0909 /* @ECU_Address@SwcOut_TOS_ACCP4.cutInflg@ */ /end MEASUREMENT
/begin MEASUREMENT SwcOut_TOS_ACCP4.dx "" FLOAT32_IEEE autosar_swc_tos_CM_single 0 0 -3.4E+38 3.4E+38 ECU_ADDRESS 0xfe4b0910 /* @ECU_Address@SwcOut_TOS_ACCP4.dx@ */ /end MEASUREMENT
/begin MEASUREMENT SwcOut_TOS_ACCP4.dy "" FLOAT32_IEEE autosar_swc_tos_CM_single 0 0 -3.4E+38 3.4E+38 ECU_ADDRESS 0xfe4b0914 /* @ECU_Address@SwcOut_TOS_ACCP4.dy@ */ /end MEASUREMENT
/begin MEASUREMENT SwcOut_TOS_ACCP4.fu_type "" UWORD autosar_swc_tos_CM_uint16 0 0 0 65535 ECU_ADDRESS 0xfe4b090e /* @ECU_Address@SwcOut_TOS_ACCP4.fu_type@ */ /end MEASUREMENT
/begin MEASUREMENT SwcOut_TOS_ACCP4.headingAngle "" FLOAT32_IEEE autosar_swc_tos_CM_single 0 0 -3.4E+38 3.4E+38 ECU_ADDRESS 0xfe4b0938 /* @ECU_Address@SwcOut_TOS_ACCP4.headingAngle@ */ /end MEASUREMENT
/begin MEASUREMENT SwcOut_TOS_ACCP4.id "" ULONG autosar_swc_tos_CM_uint32 0 0 0 4294967295 ECU_ADDRESS 0xfe4b0948 /* @ECU_Address@SwcOut_TOS_ACCP4.id@ */ /end MEASUREMENT
/begin MEASUREMENT SwcOut_TOS_ACCP4.movingState "" UBYTE autosar_swc_tos_CM_uint8 0 0 0 255 ECU_ADDRESS 0xfe4b090b /* @ECU_Address@SwcOut_TOS_ACCP4.movingState@ */ /end MEASUREMENT
/begin MEASUREMENT SwcOut_TOS_ACCP4.objExist "" FLOAT32_IEEE autosar_swc_tos_CM_single 0 0 -3.4E+38 3.4E+38 ECU_ADDRESS 0xfe4b0934 /* @ECU_Address@SwcOut_TOS_ACCP4.objExist@ */ /end MEASUREMENT
/begin MEASUREMENT SwcOut_TOS_ACCP4.orientation "" UBYTE autosar_swc_tos_CM_uint8 0 0 0 255 ECU_ADDRESS 0xfe4b090c /* @ECU_Address@SwcOut_TOS_ACCP4.orientation@ */ /end MEASUREMENT
/begin MEASUREMENT SwcOut_TOS_ACCP4.range "" FLOAT32_IEEE autosar_swc_tos_CM_single 0 0 -3.4E+38 3.4E+38 ECU_ADDRESS 0xfe4b0930 /* @ECU_Address@SwcOut_TOS_ACCP4.range@ */ /end MEASUREMENT
/begin MEASUREMENT SwcOut_TOS_ACCP4.targetExist "" UBYTE autosar_swc_tos_CM_boolean 0 0 0 1 ECU_ADDRESS 0xfe4b0908 /* @ECU_Address@SwcOut_TOS_ACCP4.targetExist@ */ /end MEASUREMENT
/begin MEASUREMENT SwcOut_TOS_ACCP4.type "" UBYTE autosar_swc_tos_CM_uint8 0 0 0 255 ECU_ADDRESS 0xfe4b090d /* @ECU_Address@SwcOut_TOS_ACCP4.type@ */ /end MEASUREMENT
/begin MEASUREMENT SwcOut_TOS_ACCP4.vxAbs "" FLOAT32_IEEE autosar_swc_tos_CM_single 0 0 -3.4E+38 3.4E+38 ECU_ADDRESS 0xfe4b0920 /* @ECU_Address@SwcOut_TOS_ACCP4.vxAbs@ */ /end MEASUREMENT
/begin MEASUREMENT SwcOut_TOS_ACCP4.vxRel "" FLOAT32_IEEE autosar_swc_tos_CM_single 0 0 -3.4E+38 3.4E+38 ECU_ADDRESS 0xfe4b0918 /* @ECU_Address@SwcOut_TOS_ACCP4.vxRel@ */ /end MEASUREMENT
/begin MEASUREMENT SwcOut_TOS_ACCP4.vyAbs "" FLOAT32_IEEE autosar_swc_tos_CM_single 0 0 -3.4E+38 3.4E+38 ECU_ADDRESS 0xfe4b0924 /* @ECU_Address@SwcOut_TOS_ACCP4.vyAbs@ */ /end MEASUREMENT
/begin MEASUREMENT SwcOut_TOS_ACCP4.vyRel "" FLOAT32_IEEE autosar_swc_tos_CM_single 0 0 -3.4E+38 3.4E+38 ECU_ADDRESS 0xfe4b091c /* @ECU_Address@SwcOut_TOS_ACCP4.vyRel@ */ /end MEASUREMENT
/begin MEASUREMENT SwcOut_TOS_ACCP5.Object_Hight "" FLOAT32_IEEE autosar_swc_tos_CM_single 0 0 -3.4E+38 3.4E+38 ECU_ADDRESS 0xfe4b0994 /* @ECU_Address@SwcOut_TOS_ACCP5.Object_Hight@ */ /end MEASUREMENT
/begin MEASUREMENT SwcOut_TOS_ACCP5.Object_Length "" FLOAT32_IEEE autosar_swc_tos_CM_single 0 0 -3.4E+38 3.4E+38 ECU_ADDRESS 0xfe4b098c /* @ECU_Address@SwcOut_TOS_ACCP5.Object_Length@ */ /end MEASUREMENT
/begin MEASUREMENT SwcOut_TOS_ACCP5.Object_Width "" FLOAT32_IEEE autosar_swc_tos_CM_single 0 0 -3.4E+38 3.4E+38 ECU_ADDRESS 0xfe4b0990 /* @ECU_Address@SwcOut_TOS_ACCP5.Object_Width@ */ /end MEASUREMENT
/begin MEASUREMENT SwcOut_TOS_ACCP5.age "" A_UINT64 autosar_swc_tos_CM_uint64 0 0 0 18446744073709551615 ECU_ADDRESS 0xfe4b09a0 /* @ECU_Address@SwcOut_TOS_ACCP5.age@ */ /end MEASUREMENT
/begin MEASUREMENT SwcOut_TOS_ACCP5.axAbs "" FLOAT32_IEEE autosar_swc_tos_CM_single 0 0 -3.4E+38 3.4E+38 ECU_ADDRESS 0xfe4b0978 /* @ECU_Address@SwcOut_TOS_ACCP5.axAbs@ */ /end MEASUREMENT
/begin MEASUREMENT SwcOut_TOS_ACCP5.ayAbs "" FLOAT32_IEEE autosar_swc_tos_CM_single 0 0 -3.4E+38 3.4E+38 ECU_ADDRESS 0xfe4b097c /* @ECU_Address@SwcOut_TOS_ACCP5.ayAbs@ */ /end MEASUREMENT
/begin MEASUREMENT SwcOut_TOS_ACCP5.brakeIntention "" UBYTE autosar_swc_tos_CM_boolean 0 0 0 1 ECU_ADDRESS 0xfe4b095a /* @ECU_Address@SwcOut_TOS_ACCP5.brakeIntention@ */ /end MEASUREMENT
/begin MEASUREMENT SwcOut_TOS_ACCP5.cutInflg "" UBYTE autosar_swc_tos_CM_boolean 0 0 0 1 ECU_ADDRESS 0xfe4b0959 /* @ECU_Address@SwcOut_TOS_ACCP5.cutInflg@ */ /end MEASUREMENT
/begin MEASUREMENT SwcOut_TOS_ACCP5.dx "" FLOAT32_IEEE autosar_swc_tos_CM_single 0 0 -3.4E+38 3.4E+38 ECU_ADDRESS 0xfe4b0960 /* @ECU_Address@SwcOut_TOS_ACCP5.dx@ */ /end MEASUREMENT
/begin MEASUREMENT SwcOut_TOS_ACCP5.dy "" FLOAT32_IEEE autosar_swc_tos_CM_single 0 0 -3.4E+38 3.4E+38 ECU_ADDRESS 0xfe4b0964 /* @ECU_Address@SwcOut_TOS_ACCP5.dy@ */ /end MEASUREMENT
/begin MEASUREMENT SwcOut_TOS_ACCP5.fu_type "" UWORD autosar_swc_tos_CM_uint16 0 0 0 65535 ECU_ADDRESS 0xfe4b095e /* @ECU_Address@SwcOut_TOS_ACCP5.fu_type@ */ /end MEASUREMENT
/begin MEASUREMENT SwcOut_TOS_ACCP5.headingAngle "" FLOAT32_IEEE autosar_swc_tos_CM_single 0 0 -3.4E+38 3.4E+38 ECU_ADDRESS 0xfe4b0988 /* @ECU_Address@SwcOut_TOS_ACCP5.headingAngle@ */ /end MEASUREMENT
/begin MEASUREMENT SwcOut_TOS_ACCP5.id "" ULONG autosar_swc_tos_CM_uint32 0 0 0 4294967295 ECU_ADDRESS 0xfe4b0998 /* @ECU_Address@SwcOut_TOS_ACCP5.id@ */ /end MEASUREMENT
/begin MEASUREMENT SwcOut_TOS_ACCP5.movingState "" UBYTE autosar_swc_tos_CM_uint8 0 0 0 255 ECU_ADDRESS 0xfe4b095b /* @ECU_Address@SwcOut_TOS_ACCP5.movingState@ */ /end MEASUREMENT
/begin MEASUREMENT SwcOut_TOS_ACCP5.objExist "" FLOAT32_IEEE autosar_swc_tos_CM_single 0 0 -3.4E+38 3.4E+38 ECU_ADDRESS 0xfe4b0984 /* @ECU_Address@SwcOut_TOS_ACCP5.objExist@ */ /end MEASUREMENT
/begin MEASUREMENT SwcOut_TOS_ACCP5.orientation "" UBYTE autosar_swc_tos_CM_uint8 0 0 0 255 ECU_ADDRESS 0xfe4b095c /* @ECU_Address@SwcOut_TOS_ACCP5.orientation@ */ /end MEASUREMENT
/begin MEASUREMENT SwcOut_TOS_ACCP5.range "" FLOAT32_IEEE autosar_swc_tos_CM_single 0 0 -3.4E+38 3.4E+38 ECU_ADDRESS 0xfe4b0980 /* @ECU_Address@SwcOut_TOS_ACCP5.range@ */ /end MEASUREMENT
/begin MEASUREMENT SwcOut_TOS_ACCP5.targetExist "" UBYTE autosar_swc_tos_CM_boolean 0 0 0 1 ECU_ADDRESS 0xfe4b0958 /* @ECU_Address@SwcOut_TOS_ACCP5.targetExist@ */ /end MEASUREMENT
/begin MEASUREMENT SwcOut_TOS_ACCP5.type "" UBYTE autosar_swc_tos_CM_uint8 0 0 0 255 ECU_ADDRESS 0xfe4b095d /* @ECU_Address@SwcOut_TOS_ACCP5.type@ */ /end MEASUREMENT
/begin MEASUREMENT SwcOut_TOS_ACCP5.vxAbs "" FLOAT32_IEEE autosar_swc_tos_CM_single 0 0 -3.4E+38 3.4E+38 ECU_ADDRESS 0xfe4b0970 /* @ECU_Address@SwcOut_TOS_ACCP5.vxAbs@ */ /end MEASUREMENT
/begin MEASUREMENT SwcOut_TOS_ACCP5.vxRel "" FLOAT32_IEEE autosar_swc_tos_CM_single 0 0 -3.4E+38 3.4E+38 ECU_ADDRESS 0xfe4b0968 /* @ECU_Address@SwcOut_TOS_ACCP5.vxRel@ */ /end MEASUREMENT
/begin MEASUREMENT SwcOut_TOS_ACCP5.vyAbs "" FLOAT32_IEEE autosar_swc_tos_CM_single 0 0 -3.4E+38 3.4E+38 ECU_ADDRESS 0xfe4b0974 /* @ECU_Address@SwcOut_TOS_ACCP5.vyAbs@ */ /end MEASUREMENT
/begin MEASUREMENT SwcOut_TOS_ACCP5.vyRel "" FLOAT32_IEEE autosar_swc_tos_CM_single 0 0 -3.4E+38 3.4E+38 ECU_ADDRESS 0xfe4b096c /* @ECU_Address@SwcOut_TOS_ACCP5.vyRel@ */ /end MEASUREMENT
/begin MEASUREMENT SwcOut_TOS_ACCP6.Object_Hight "" FLOAT32_IEEE autosar_swc_tos_CM_single 0 0 -3.4E+38 3.4E+38 ECU_ADDRESS 0xfe4b09e4 /* @ECU_Address@SwcOut_TOS_ACCP6.Object_Hight@ */ /end MEASUREMENT
/begin MEASUREMENT SwcOut_TOS_ACCP6.Object_Length "" FLOAT32_IEEE autosar_swc_tos_CM_single 0 0 -3.4E+38 3.4E+38 ECU_ADDRESS 0xfe4b09dc /* @ECU_Address@SwcOut_TOS_ACCP6.Object_Length@ */ /end MEASUREMENT
/begin MEASUREMENT SwcOut_TOS_ACCP6.Object_Width "" FLOAT32_IEEE autosar_swc_tos_CM_single 0 0 -3.4E+38 3.4E+38 ECU_ADDRESS 0xfe4b09e0 /* @ECU_Address@SwcOut_TOS_ACCP6.Object_Width@ */ /end MEASUREMENT
/begin MEASUREMENT SwcOut_TOS_ACCP6.age "" A_UINT64 autosar_swc_tos_CM_uint64 0 0 0 18446744073709551615 ECU_ADDRESS 0xfe4b09f0 /* @ECU_Address@SwcOut_TOS_ACCP6.age@ */ /end MEASUREMENT
/begin MEASUREMENT SwcOut_TOS_ACCP6.axAbs "" FLOAT32_IEEE autosar_swc_tos_CM_single 0 0 -3.4E+38 3.4E+38 ECU_ADDRESS 0xfe4b09c8 /* @ECU_Address@SwcOut_TOS_ACCP6.axAbs@ */ /end MEASUREMENT
/begin MEASUREMENT SwcOut_TOS_ACCP6.ayAbs "" FLOAT32_IEEE autosar_swc_tos_CM_single 0 0 -3.4E+38 3.4E+38 ECU_ADDRESS 0xfe4b09cc /* @ECU_Address@SwcOut_TOS_ACCP6.ayAbs@ */ /end MEASUREMENT
/begin MEASUREMENT SwcOut_TOS_ACCP6.brakeIntention "" UBYTE autosar_swc_tos_CM_boolean 0 0 0 1 ECU_ADDRESS 0xfe4b09aa /* @ECU_Address@SwcOut_TOS_ACCP6.brakeIntention@ */ /end MEASUREMENT
/begin MEASUREMENT SwcOut_TOS_ACCP6.cutInflg "" UBYTE autosar_swc_tos_CM_boolean 0 0 0 1 ECU_ADDRESS 0xfe4b09a9 /* @ECU_Address@SwcOut_TOS_ACCP6.cutInflg@ */ /end MEASUREMENT
/begin MEASUREMENT SwcOut_TOS_ACCP6.dx "" FLOAT32_IEEE autosar_swc_tos_CM_single 0 0 -3.4E+38 3.4E+38 ECU_ADDRESS 0xfe4b09b0 /* @ECU_Address@SwcOut_TOS_ACCP6.dx@ */ /end MEASUREMENT
/begin MEASUREMENT SwcOut_TOS_ACCP6.dy "" FLOAT32_IEEE autosar_swc_tos_CM_single 0 0 -3.4E+38 3.4E+38 ECU_ADDRESS 0xfe4b09b4 /* @ECU_Address@SwcOut_TOS_ACCP6.dy@ */ /end MEASUREMENT
/begin MEASUREMENT SwcOut_TOS_ACCP6.fu_type "" UWORD autosar_swc_tos_CM_uint16 0 0 0 65535 ECU_ADDRESS 0xfe4b09ae /* @ECU_Address@SwcOut_TOS_ACCP6.fu_type@ */ /end MEASUREMENT
/begin MEASUREMENT SwcOut_TOS_ACCP6.headingAngle "" FLOAT32_IEEE autosar_swc_tos_CM_single 0 0 -3.4E+38 3.4E+38 ECU_ADDRESS 0xfe4b09d8 /* @ECU_Address@SwcOut_TOS_ACCP6.headingAngle@ */ /end MEASUREMENT
/begin MEASUREMENT SwcOut_TOS_ACCP6.id "" ULONG autosar_swc_tos_CM_uint32 0 0 0 4294967295 ECU_ADDRESS 0xfe4b09e8 /* @ECU_Address@SwcOut_TOS_ACCP6.id@ */ /end MEASUREMENT
/begin MEASUREMENT SwcOut_TOS_ACCP6.movingState "" UBYTE autosar_swc_tos_CM_uint8 0 0 0 255 ECU_ADDRESS 0xfe4b09ab /* @ECU_Address@SwcOut_TOS_ACCP6.movingState@ */ /end MEASUREMENT
/begin MEASUREMENT SwcOut_TOS_ACCP6.objExist "" FLOAT32_IEEE autosar_swc_tos_CM_single 0 0 -3.4E+38 3.4E+38 ECU_ADDRESS 0xfe4b09d4 /* @ECU_Address@SwcOut_TOS_ACCP6.objExist@ */ /end MEASUREMENT
/begin MEASUREMENT SwcOut_TOS_ACCP6.orientation "" UBYTE autosar_swc_tos_CM_uint8 0 0 0 255 ECU_ADDRESS 0xfe4b09ac /* @ECU_Address@SwcOut_TOS_ACCP6.orientation@ */ /end MEASUREMENT
/begin MEASUREMENT SwcOut_TOS_ACCP6.range "" FLOAT32_IEEE autosar_swc_tos_CM_single 0 0 -3.4E+38 3.4E+38 ECU_ADDRESS 0xfe4b09d0 /* @ECU_Address@SwcOut_TOS_ACCP6.range@ */ /end MEASUREMENT
/begin MEASUREMENT SwcOut_TOS_ACCP6.targetExist "" UBYTE autosar_swc_tos_CM_boolean 0 0 0 1 ECU_ADDRESS 0xfe4b09a8 /* @ECU_Address@SwcOut_TOS_ACCP6.targetExist@ */ /end MEASUREMENT
/begin MEASUREMENT SwcOut_TOS_ACCP6.type "" UBYTE autosar_swc_tos_CM_uint8 0 0 0 255 ECU_ADDRESS 0xfe4b09ad /* @ECU_Address@SwcOut_TOS_ACCP6.type@ */ /end MEASUREMENT
/begin MEASUREMENT SwcOut_TOS_ACCP6.vxAbs "" FLOAT32_IEEE autosar_swc_tos_CM_single 0 0 -3.4E+38 3.4E+38 ECU_ADDRESS 0xfe4b09c0 /* @ECU_Address@SwcOut_TOS_ACCP6.vxAbs@ */ /end MEASUREMENT
/begin MEASUREMENT SwcOut_TOS_ACCP6.vxRel "" FLOAT32_IEEE autosar_swc_tos_CM_single 0 0 -3.4E+38 3.4E+38 ECU_ADDRESS 0xfe4b09b8 /* @ECU_Address@SwcOut_TOS_ACCP6.vxRel@ */ /end MEASUREMENT
/begin MEASUREMENT SwcOut_TOS_ACCP6.vyAbs "" FLOAT32_IEEE autosar_swc_tos_CM_single 0 0 -3.4E+38 3.4E+38 ECU_ADDRESS 0xfe4b09c4 /* @ECU_Address@SwcOut_TOS_ACCP6.vyAbs@ */ /end MEASUREMENT
/begin MEASUREMENT SwcOut_TOS_ACCP6.vyRel "" FLOAT32_IEEE autosar_swc_tos_CM_single 0 0 -3.4E+38 3.4E+38 ECU_ADDRESS 0xfe4b09bc /* @ECU_Address@SwcOut_TOS_ACCP6.vyRel@ */ /end MEASUREMENT
/begin MEASUREMENT SwcOut_TOS_ACCP7.Object_Hight "" FLOAT32_IEEE autosar_swc_tos_CM_single 0 0 -3.4E+38 3.4E+38 ECU_ADDRESS 0xfe4b0a34 /* @ECU_Address@SwcOut_TOS_ACCP7.Object_Hight@ */ /end MEASUREMENT
/begin MEASUREMENT SwcOut_TOS_ACCP7.Object_Length "" FLOAT32_IEEE autosar_swc_tos_CM_single 0 0 -3.4E+38 3.4E+38 ECU_ADDRESS 0xfe4b0a2c /* @ECU_Address@SwcOut_TOS_ACCP7.Object_Length@ */ /end MEASUREMENT
/begin MEASUREMENT SwcOut_TOS_ACCP7.Object_Width "" FLOAT32_IEEE autosar_swc_tos_CM_single 0 0 -3.4E+38 3.4E+38 ECU_ADDRESS 0xfe4b0a30 /* @ECU_Address@SwcOut_TOS_ACCP7.Object_Width@ */ /end MEASUREMENT
/begin MEASUREMENT SwcOut_TOS_ACCP7.age "" A_UINT64 autosar_swc_tos_CM_uint64 0 0 0 18446744073709551615 ECU_ADDRESS 0xfe4b0a40 /* @ECU_Address@SwcOut_TOS_ACCP7.age@ */ /end MEASUREMENT
/begin MEASUREMENT SwcOut_TOS_ACCP7.axAbs "" FLOAT32_IEEE autosar_swc_tos_CM_single 0 0 -3.4E+38 3.4E+38 ECU_ADDRESS 0xfe4b0a18 /* @ECU_Address@SwcOut_TOS_ACCP7.axAbs@ */ /end MEASUREMENT
/begin MEASUREMENT SwcOut_TOS_ACCP7.ayAbs "" FLOAT32_IEEE autosar_swc_tos_CM_single 0 0 -3.4E+38 3.4E+38 ECU_ADDRESS 0xfe4b0a1c /* @ECU_Address@SwcOut_TOS_ACCP7.ayAbs@ */ /end MEASUREMENT
/begin MEASUREMENT SwcOut_TOS_ACCP7.brakeIntention "" UBYTE autosar_swc_tos_CM_boolean 0 0 0 1 ECU_ADDRESS 0xfe4b09fa /* @ECU_Address@SwcOut_TOS_ACCP7.brakeIntention@ */ /end MEASUREMENT
/begin MEASUREMENT SwcOut_TOS_ACCP7.cutInflg "" UBYTE autosar_swc_tos_CM_boolean 0 0 0 1 ECU_ADDRESS 0xfe4b09f9 /* @ECU_Address@SwcOut_TOS_ACCP7.cutInflg@ */ /end MEASUREMENT
/begin MEASUREMENT SwcOut_TOS_ACCP7.dx "" FLOAT32_IEEE autosar_swc_tos_CM_single 0 0 -3.4E+38 3.4E+38 ECU_ADDRESS 0xfe4b0a00 /* @ECU_Address@SwcOut_TOS_ACCP7.dx@ */ /end MEASUREMENT
/begin MEASUREMENT SwcOut_TOS_ACCP7.dy "" FLOAT32_IEEE autosar_swc_tos_CM_single 0 0 -3.4E+38 3.4E+38 ECU_ADDRESS 0xfe4b0a04 /* @ECU_Address@SwcOut_TOS_ACCP7.dy@ */ /end MEASUREMENT
/begin MEASUREMENT SwcOut_TOS_ACCP7.fu_type "" UWORD autosar_swc_tos_CM_uint16 0 0 0 65535 ECU_ADDRESS 0xfe4b09fe /* @ECU_Address@SwcOut_TOS_ACCP7.fu_type@ */ /end MEASUREMENT
/begin MEASUREMENT SwcOut_TOS_ACCP7.headingAngle "" FLOAT32_IEEE autosar_swc_tos_CM_single 0 0 -3.4E+38 3.4E+38 ECU_ADDRESS 0xfe4b0a28 /* @ECU_Address@SwcOut_TOS_ACCP7.headingAngle@ */ /end MEASUREMENT
/begin MEASUREMENT SwcOut_TOS_ACCP7.id "" ULONG autosar_swc_tos_CM_uint32 0 0 0 4294967295 ECU_ADDRESS 0xfe4b0a38 /* @ECU_Address@SwcOut_TOS_ACCP7.id@ */ /end MEASUREMENT
/begin MEASUREMENT SwcOut_TOS_ACCP7.movingState "" UBYTE autosar_swc_tos_CM_uint8 0 0 0 255 ECU_ADDRESS 0xfe4b09fb /* @ECU_Address@SwcOut_TOS_ACCP7.movingState@ */ /end MEASUREMENT
/begin MEASUREMENT SwcOut_TOS_ACCP7.objExist "" FLOAT32_IEEE autosar_swc_tos_CM_single 0 0 -3.4E+38 3.4E+38 ECU_ADDRESS 0xfe4b0a24 /* @ECU_Address@SwcOut_TOS_ACCP7.objExist@ */ /end MEASUREMENT
/begin MEASUREMENT SwcOut_TOS_ACCP7.orientation "" UBYTE autosar_swc_tos_CM_uint8 0 0 0 255 ECU_ADDRESS 0xfe4b09fc /* @ECU_Address@SwcOut_TOS_ACCP7.orientation@ */ /end MEASUREMENT
/begin MEASUREMENT SwcOut_TOS_ACCP7.range "" FLOAT32_IEEE autosar_swc_tos_CM_single 0 0 -3.4E+38 3.4E+38 ECU_ADDRESS 0xfe4b0a20 /* @ECU_Address@SwcOut_TOS_ACCP7.range@ */ /end MEASUREMENT
/begin MEASUREMENT SwcOut_TOS_ACCP7.targetExist "" UBYTE autosar_swc_tos_CM_boolean 0 0 0 1 ECU_ADDRESS 0xfe4b09f8 /* @ECU_Address@SwcOut_TOS_ACCP7.targetExist@ */ /end MEASUREMENT
/begin MEASUREMENT SwcOut_TOS_ACCP7.type "" UBYTE autosar_swc_tos_CM_uint8 0 0 0 255 ECU_ADDRESS 0xfe4b09fd /* @ECU_Address@SwcOut_TOS_ACCP7.type@ */ /end MEASUREMENT
/begin MEASUREMENT SwcOut_TOS_ACCP7.vxAbs "" FLOAT32_IEEE autosar_swc_tos_CM_single 0 0 -3.4E+38 3.4E+38 ECU_ADDRESS 0xfe4b0a10 /* @ECU_Address@SwcOut_TOS_ACCP7.vxAbs@ */ /end MEASUREMENT
/begin MEASUREMENT SwcOut_TOS_ACCP7.vxRel "" FLOAT32_IEEE autosar_swc_tos_CM_single 0 0 -3.4E+38 3.4E+38 ECU_ADDRESS 0xfe4b0a08 /* @ECU_Address@SwcOut_TOS_ACCP7.vxRel@ */ /end MEASUREMENT
/begin MEASUREMENT SwcOut_TOS_ACCP7.vyAbs "" FLOAT32_IEEE autosar_swc_tos_CM_single 0 0 -3.4E+38 3.4E+38 ECU_ADDRESS 0xfe4b0a14 /* @ECU_Address@SwcOut_TOS_ACCP7.vyAbs@ */ /end MEASUREMENT
/begin MEASUREMENT SwcOut_TOS_ACCP7.vyRel "" FLOAT32_IEEE autosar_swc_tos_CM_single 0 0 -3.4E+38 3.4E+38 ECU_ADDRESS 0xfe4b0a0c /* @ECU_Address@SwcOut_TOS_ACCP7.vyRel@ */ /end MEASUREMENT
/begin MEASUREMENT SwcOut_TOS_ACCP8.Object_Hight "" FLOAT32_IEEE autosar_swc_tos_CM_single 0 0 -3.4E+38 3.4E+38 ECU_ADDRESS 0xfe4b0a84 /* @ECU_Address@SwcOut_TOS_ACCP8.Object_Hight@ */ /end MEASUREMENT
/begin MEASUREMENT SwcOut_TOS_ACCP8.Object_Length "" FLOAT32_IEEE autosar_swc_tos_CM_single 0 0 -3.4E+38 3.4E+38 ECU_ADDRESS 0xfe4b0a7c /* @ECU_Address@SwcOut_TOS_ACCP8.Object_Length@ */ /end MEASUREMENT
/begin MEASUREMENT SwcOut_TOS_ACCP8.Object_Width "" FLOAT32_IEEE autosar_swc_tos_CM_single 0 0 -3.4E+38 3.4E+38 ECU_ADDRESS 0xfe4b0a80 /* @ECU_Address@SwcOut_TOS_ACCP8.Object_Width@ */ /end MEASUREMENT
/begin MEASUREMENT SwcOut_TOS_ACCP8.age "" A_UINT64 autosar_swc_tos_CM_uint64 0 0 0 18446744073709551615 ECU_ADDRESS 0xfe4b0a90 /* @ECU_Address@SwcOut_TOS_ACCP8.age@ */ /end MEASUREMENT
/begin MEASUREMENT SwcOut_TOS_ACCP8.axAbs "" FLOAT32_IEEE autosar_swc_tos_CM_single 0 0 -3.4E+38 3.4E+38 ECU_ADDRESS 0xfe4b0a68 /* @ECU_Address@SwcOut_TOS_ACCP8.axAbs@ */ /end MEASUREMENT
/begin MEASUREMENT SwcOut_TOS_ACCP8.ayAbs "" FLOAT32_IEEE autosar_swc_tos_CM_single 0 0 -3.4E+38 3.4E+38 ECU_ADDRESS 0xfe4b0a6c /* @ECU_Address@SwcOut_TOS_ACCP8.ayAbs@ */ /end MEASUREMENT
/begin MEASUREMENT SwcOut_TOS_ACCP8.brakeIntention "" UBYTE autosar_swc_tos_CM_boolean 0 0 0 1 ECU_ADDRESS 0xfe4b0a4a /* @ECU_Address@SwcOut_TOS_ACCP8.brakeIntention@ */ /end MEASUREMENT
/begin MEASUREMENT SwcOut_TOS_ACCP8.cutInflg "" UBYTE autosar_swc_tos_CM_boolean 0 0 0 1 ECU_ADDRESS 0xfe4b0a49 /* @ECU_Address@SwcOut_TOS_ACCP8.cutInflg@ */ /end MEASUREMENT
/begin MEASUREMENT SwcOut_TOS_ACCP8.dx "" FLOAT32_IEEE autosar_swc_tos_CM_single 0 0 -3.4E+38 3.4E+38 ECU_ADDRESS 0xfe4b0a50 /* @ECU_Address@SwcOut_TOS_ACCP8.dx@ */ /end MEASUREMENT
/begin MEASUREMENT SwcOut_TOS_ACCP8.dy "" FLOAT32_IEEE autosar_swc_tos_CM_single 0 0 -3.4E+38 3.4E+38 ECU_ADDRESS 0xfe4b0a54 /* @ECU_Address@SwcOut_TOS_ACCP8.dy@ */ /end MEASUREMENT
/begin MEASUREMENT SwcOut_TOS_ACCP8.fu_type "" UWORD autosar_swc_tos_CM_uint16 0 0 0 65535 ECU_ADDRESS 0xfe4b0a4e /* @ECU_Address@SwcOut_TOS_ACCP8.fu_type@ */ /end MEASUREMENT
/begin MEASUREMENT SwcOut_TOS_ACCP8.headingAngle "" FLOAT32_IEEE autosar_swc_tos_CM_single 0 0 -3.4E+38 3.4E+38 ECU_ADDRESS 0xfe4b0a78 /* @ECU_Address@SwcOut_TOS_ACCP8.headingAngle@ */ /end MEASUREMENT
/begin MEASUREMENT SwcOut_TOS_ACCP8.id "" ULONG autosar_swc_tos_CM_uint32 0 0 0 4294967295 ECU_ADDRESS 0xfe4b0a88 /* @ECU_Address@SwcOut_TOS_ACCP8.id@ */ /end MEASUREMENT
/begin MEASUREMENT SwcOut_TOS_ACCP8.movingState "" UBYTE autosar_swc_tos_CM_uint8 0 0 0 255 ECU_ADDRESS 0xfe4b0a4b /* @ECU_Address@SwcOut_TOS_ACCP8.movingState@ */ /end MEASUREMENT
/begin MEASUREMENT SwcOut_TOS_ACCP8.objExist "" FLOAT32_IEEE autosar_swc_tos_CM_single 0 0 -3.4E+38 3.4E+38 ECU_ADDRESS 0xfe4b0a74 /* @ECU_Address@SwcOut_TOS_ACCP8.objExist@ */ /end MEASUREMENT
/begin MEASUREMENT SwcOut_TOS_ACCP8.orientation "" UBYTE autosar_swc_tos_CM_uint8 0 0 0 255 ECU_ADDRESS 0xfe4b0a4c /* @ECU_Address@SwcOut_TOS_ACCP8.orientation@ */ /end MEASUREMENT
/begin MEASUREMENT SwcOut_TOS_ACCP8.range "" FLOAT32_IEEE autosar_swc_tos_CM_single 0 0 -3.4E+38 3.4E+38 ECU_ADDRESS 0xfe4b0a70 /* @ECU_Address@SwcOut_TOS_ACCP8.range@ */ /end MEASUREMENT
/begin MEASUREMENT SwcOut_TOS_ACCP8.targetExist "" UBYTE autosar_swc_tos_CM_boolean 0 0 0 1 ECU_ADDRESS 0xfe4b0a48 /* @ECU_Address@SwcOut_TOS_ACCP8.targetExist@ */ /end MEASUREMENT
/begin MEASUREMENT SwcOut_TOS_ACCP8.type "" UBYTE autosar_swc_tos_CM_uint8 0 0 0 255 ECU_ADDRESS 0xfe4b0a4d /* @ECU_Address@SwcOut_TOS_ACCP8.type@ */ /end MEASUREMENT
/begin MEASUREMENT SwcOut_TOS_ACCP8.vxAbs "" FLOAT32_IEEE autosar_swc_tos_CM_single 0 0 -3.4E+38 3.4E+38 ECU_ADDRESS 0xfe4b0a60 /* @ECU_Address@SwcOut_TOS_ACCP8.vxAbs@ */ /end MEASUREMENT
/begin MEASUREMENT SwcOut_TOS_ACCP8.vxRel "" FLOAT32_IEEE autosar_swc_tos_CM_single 0 0 -3.4E+38 3.4E+38 ECU_ADDRESS 0xfe4b0a58 /* @ECU_Address@SwcOut_TOS_ACCP8.vxRel@ */ /end MEASUREMENT
/begin MEASUREMENT SwcOut_TOS_ACCP8.vyAbs "" FLOAT32_IEEE autosar_swc_tos_CM_single 0 0 -3.4E+38 3.4E+38 ECU_ADDRESS 0xfe4b0a64 /* @ECU_Address@SwcOut_TOS_ACCP8.vyAbs@ */ /end MEASUREMENT
/begin MEASUREMENT SwcOut_TOS_ACCP8.vyRel "" FLOAT32_IEEE autosar_swc_tos_CM_single 0 0 -3.4E+38 3.4E+38 ECU_ADDRESS 0xfe4b0a5c /* @ECU_Address@SwcOut_TOS_ACCP8.vyRel@ */ /end MEASUREMENT
/begin MEASUREMENT SwcOut_TOS_AEB[0].CllsnMtgtnByBrkgPrimQly "" UBYTE autosar_swc_tos_CM_uint8 0 0 0 255 ECU_ADDRESS 0xfe4b0aa0 /* @ECU_Address@SwcOut_TOS_AEB[0].CllsnMtgtnByBrkgPrimQly@ */ /end MEASUREMENT
/begin MEASUREMENT SwcOut_TOS_AEB[0].CllsnMtgtnByBrkgSecQly "" UBYTE autosar_swc_tos_CM_uint8 0 0 0 255 ECU_ADDRESS 0xfe4b0aa1 /* @ECU_Address@SwcOut_TOS_AEB[0].CllsnMtgtnByBrkgSecQly@ */ /end MEASUREMENT
/begin MEASUREMENT SwcOut_TOS_AEB[0].CllsnWarnFwdQly "" UBYTE autosar_swc_tos_CM_uint8 0 0 0 255 ECU_ADDRESS 0xfe4b0aa2 /* @ECU_Address@SwcOut_TOS_AEB[0].CllsnWarnFwdQly@ */ /end MEASUREMENT
/begin MEASUREMENT SwcOut_TOS_AEB[0].LeftLane_flag "" UBYTE autosar_swc_tos_CM_boolean 0 0 0 1 ECU_ADDRESS 0xfe4b0a98 /* @ECU_Address@SwcOut_TOS_AEB[0].LeftLane_flag@ */ /end MEASUREMENT
/begin MEASUREMENT SwcOut_TOS_AEB[0].Object_AX "" FLOAT32_IEEE autosar_swc_tos_CM_single 0 0 -3.4E+38 3.4E+38 ECU_ADDRESS 0xfe4b0ae4 /* @ECU_Address@SwcOut_TOS_AEB[0].Object_AX@ */ /end MEASUREMENT
/begin MEASUREMENT SwcOut_TOS_AEB[0].Object_AY "" FLOAT32_IEEE autosar_swc_tos_CM_single 0 0 -3.4E+38 3.4E+38 ECU_ADDRESS 0xfe4b0ae8 /* @ECU_Address@SwcOut_TOS_AEB[0].Object_AY@ */ /end MEASUREMENT
/begin MEASUREMENT SwcOut_TOS_AEB[0].Object_Abs_AX "" FLOAT32_IEEE autosar_swc_tos_CM_single 0 0 -3.4E+38 3.4E+38 ECU_ADDRESS 0xfe4b0aec /* @ECU_Address@SwcOut_TOS_AEB[0].Object_Abs_AX@ */ /end MEASUREMENT
/begin MEASUREMENT SwcOut_TOS_AEB[0].Object_Abs_AY "" FLOAT32_IEEE autosar_swc_tos_CM_single 0 0 -3.4E+38 3.4E+38 ECU_ADDRESS 0xfe4b0af0 /* @ECU_Address@SwcOut_TOS_AEB[0].Object_Abs_AY@ */ /end MEASUREMENT
/begin MEASUREMENT SwcOut_TOS_AEB[0].Object_Abs_SPEED "" FLOAT32_IEEE autosar_swc_tos_CM_single 0 0 -3.4E+38 3.4E+38 ECU_ADDRESS 0xfe4b0ad8 /* @ECU_Address@SwcOut_TOS_AEB[0].Object_Abs_SPEED@ */ /end MEASUREMENT
/begin MEASUREMENT SwcOut_TOS_AEB[0].Object_Abs_VX "" FLOAT32_IEEE autosar_swc_tos_CM_single 0 0 -3.4E+38 3.4E+38 ECU_ADDRESS 0xfe4b0adc /* @ECU_Address@SwcOut_TOS_AEB[0].Object_Abs_VX@ */ /end MEASUREMENT
/begin MEASUREMENT SwcOut_TOS_AEB[0].Object_Abs_VY "" FLOAT32_IEEE autosar_swc_tos_CM_single 0 0 -3.4E+38 3.4E+38 ECU_ADDRESS 0xfe4b0ae0 /* @ECU_Address@SwcOut_TOS_AEB[0].Object_Abs_VY@ */ /end MEASUREMENT
/begin MEASUREMENT SwcOut_TOS_AEB[0].Object_Age "" A_UINT64 autosar_swc_tos_CM_uint64 0 0 0 18446744073709551615 ECU_ADDRESS 0xfe4b0b20 /* @ECU_Address@SwcOut_TOS_AEB[0].Object_Age@ */ /end MEASUREMENT
/begin MEASUREMENT SwcOut_TOS_AEB[0].Object_DX "" FLOAT32_IEEE autosar_swc_tos_CM_single 0 0 -3.4E+38 3.4E+38 ECU_ADDRESS 0xfe4b0ac0 /* @ECU_Address@SwcOut_TOS_AEB[0].Object_DX@ */ /end MEASUREMENT
/begin MEASUREMENT SwcOut_TOS_AEB[0].Object_DY "" FLOAT32_IEEE autosar_swc_tos_CM_single 0 0 -3.4E+38 3.4E+38 ECU_ADDRESS 0xfe4b0ac4 /* @ECU_Address@SwcOut_TOS_AEB[0].Object_DY@ */ /end MEASUREMENT
/begin MEASUREMENT SwcOut_TOS_AEB[0].Object_Fus_Type "" UWORD autosar_swc_tos_CM_uint16 0 0 0 65535 ECU_ADDRESS 0xfe4b0aa4 /* @ECU_Address@SwcOut_TOS_AEB[0].Object_Fus_Type@ */ /end MEASUREMENT
/begin MEASUREMENT SwcOut_TOS_AEB[0].Object_HeadingAngle "" FLOAT32_IEEE autosar_swc_tos_CM_single 0 0 -3.4E+38 3.4E+38 ECU_ADDRESS 0xfe4b0ab8 /* @ECU_Address@SwcOut_TOS_AEB[0].Object_HeadingAngle@ */ /end MEASUREMENT
/begin MEASUREMENT SwcOut_TOS_AEB[0].Object_Hight "" FLOAT32_IEEE autosar_swc_tos_CM_single 0 0 -3.4E+38 3.4E+38 ECU_ADDRESS 0xfe4b0ab4 /* @ECU_Address@SwcOut_TOS_AEB[0].Object_Hight@ */ /end MEASUREMENT
/begin MEASUREMENT SwcOut_TOS_AEB[0].Object_ID "" ULONG autosar_swc_tos_CM_uint32 0 0 0 4294967295 ECU_ADDRESS 0xfe4b0b14 /* @ECU_Address@SwcOut_TOS_AEB[0].Object_ID@ */ /end MEASUREMENT
/begin MEASUREMENT SwcOut_TOS_AEB[0].Object_Length "" FLOAT32_IEEE autosar_swc_tos_CM_single 0 0 -3.4E+38 3.4E+38 ECU_ADDRESS 0xfe4b0aac /* @ECU_Address@SwcOut_TOS_AEB[0].Object_Length@ */ /end MEASUREMENT
/begin MEASUREMENT SwcOut_TOS_AEB[0].Object_MovingState "" UBYTE autosar_swc_tos_CM_uint8 0 0 0 255 ECU_ADDRESS 0xfe4b0a9c /* @ECU_Address@SwcOut_TOS_AEB[0].Object_MovingState@ */ /end MEASUREMENT
/begin MEASUREMENT SwcOut_TOS_AEB[0].Object_Orientation "" UBYTE autosar_swc_tos_CM_uint8 0 0 0 255 ECU_ADDRESS 0xfe4b0a9d /* @ECU_Address@SwcOut_TOS_AEB[0].Object_Orientation@ */ /end MEASUREMENT
/begin MEASUREMENT SwcOut_TOS_AEB[0].Object_RangeX "" FLOAT32_IEEE autosar_swc_tos_CM_single 0 0 -3.4E+38 3.4E+38 ECU_ADDRESS 0xfe4b0ac8 /* @ECU_Address@SwcOut_TOS_AEB[0].Object_RangeX@ */ /end MEASUREMENT
/begin MEASUREMENT SwcOut_TOS_AEB[0].Object_RangeY "" FLOAT32_IEEE autosar_swc_tos_CM_single 0 0 -3.4E+38 3.4E+38 ECU_ADDRESS 0xfe4b0acc /* @ECU_Address@SwcOut_TOS_AEB[0].Object_RangeY@ */ /end MEASUREMENT
/begin MEASUREMENT SwcOut_TOS_AEB[0].Object_Turn_Signal "" UBYTE autosar_swc_tos_CM_uint8 0 0 0 255 ECU_ADDRESS 0xfe4b0a9e /* @ECU_Address@SwcOut_TOS_AEB[0].Object_Turn_Signal@ */ /end MEASUREMENT
/begin MEASUREMENT SwcOut_TOS_AEB[0].Object_Type "" UBYTE autosar_swc_tos_CM_uint8 0 0 0 255 ECU_ADDRESS 0xfe4b0a9b /* @ECU_Address@SwcOut_TOS_AEB[0].Object_Type@ */ /end MEASUREMENT
/begin MEASUREMENT SwcOut_TOS_AEB[0].Object_VX "" FLOAT32_IEEE autosar_swc_tos_CM_single 0 0 -3.4E+38 3.4E+38 ECU_ADDRESS 0xfe4b0ad0 /* @ECU_Address@SwcOut_TOS_AEB[0].Object_VX@ */ /end MEASUREMENT
/begin MEASUREMENT SwcOut_TOS_AEB[0].Object_VY "" FLOAT32_IEEE autosar_swc_tos_CM_single 0 0 -3.4E+38 3.4E+38 ECU_ADDRESS 0xfe4b0ad4 /* @ECU_Address@SwcOut_TOS_AEB[0].Object_VY@ */ /end MEASUREMENT
/begin MEASUREMENT SwcOut_TOS_AEB[0].Object_Width "" FLOAT32_IEEE autosar_swc_tos_CM_single 0 0 -3.4E+38 3.4E+38 ECU_ADDRESS 0xfe4b0ab0 /* @ECU_Address@SwcOut_TOS_AEB[0].Object_Width@ */ /end MEASUREMENT
/begin MEASUREMENT SwcOut_TOS_AEB[0].Object_YawAngle "" FLOAT32_IEEE autosar_swc_tos_CM_single 0 0 -3.4E+38 3.4E+38 ECU_ADDRESS 0xfe4b0abc /* @ECU_Address@SwcOut_TOS_AEB[0].Object_YawAngle@ */ /end MEASUREMENT
/begin MEASUREMENT SwcOut_TOS_AEB[0].RightLane_flag "" UBYTE autosar_swc_tos_CM_boolean 0 0 0 1 ECU_ADDRESS 0xfe4b0a9a /* @ECU_Address@SwcOut_TOS_AEB[0].RightLane_flag@ */ /end MEASUREMENT
/begin MEASUREMENT SwcOut_TOS_AEB[0].SameLane_flag "" UBYTE autosar_swc_tos_CM_boolean 0 0 0 1 ECU_ADDRESS 0xfe4b0a99 /* @ECU_Address@SwcOut_TOS_AEB[0].SameLane_flag@ */ /end MEASUREMENT
/begin MEASUREMENT SwcOut_TOS_AEB[0].Sceniaro_Flag "" UBYTE autosar_swc_tos_CM_uint8 0 0 0 255 ECU_ADDRESS 0xfe4b0a9f /* @ECU_Address@SwcOut_TOS_AEB[0].Sceniaro_Flag@ */ /end MEASUREMENT
/begin MEASUREMENT SwcOut_TOS_AEB[0].TimeStamp "" A_UINT64 autosar_swc_tos_CM_uint64 0 0 0 18446744073709551615 ECU_ADDRESS 0xfe4b0b28 /* @ECU_Address@SwcOut_TOS_AEB[0].TimeStamp@ */ /end MEASUREMENT
/begin MEASUREMENT SwcOut_TOS_AEB[0].camID "" ULONG autosar_swc_tos_CM_uint32 0 0 0 4294967295 ECU_ADDRESS 0xfe4b0b18 /* @ECU_Address@SwcOut_TOS_AEB[0].camID@ */ /end MEASUREMENT
/begin MEASUREMENT SwcOut_TOS_AEB[0].corner_left_front_x "" FLOAT32_IEEE autosar_swc_tos_CM_single 0 0 -3.4E+38 3.4E+38 ECU_ADDRESS 0xfe4b0af4 /* @ECU_Address@SwcOut_TOS_AEB[0].corner_left_front_x@ */ /end MEASUREMENT
/begin MEASUREMENT SwcOut_TOS_AEB[0].corner_left_front_y "" FLOAT32_IEEE autosar_swc_tos_CM_single 0 0 -3.4E+38 3.4E+38 ECU_ADDRESS 0xfe4b0af8 /* @ECU_Address@SwcOut_TOS_AEB[0].corner_left_front_y@ */ /end MEASUREMENT
/begin MEASUREMENT SwcOut_TOS_AEB[0].corner_left_rear_x "" FLOAT32_IEEE autosar_swc_tos_CM_single 0 0 -3.4E+38 3.4E+38 ECU_ADDRESS 0xfe4b0b04 /* @ECU_Address@SwcOut_TOS_AEB[0].corner_left_rear_x@ */ /end MEASUREMENT
/begin MEASUREMENT SwcOut_TOS_AEB[0].corner_left_rear_y "" FLOAT32_IEEE autosar_swc_tos_CM_single 0 0 -3.4E+38 3.4E+38 ECU_ADDRESS 0xfe4b0b08 /* @ECU_Address@SwcOut_TOS_AEB[0].corner_left_rear_y@ */ /end MEASUREMENT
/begin MEASUREMENT SwcOut_TOS_AEB[0].corner_right_front_x "" FLOAT32_IEEE autosar_swc_tos_CM_single 0 0 -3.4E+38 3.4E+38 ECU_ADDRESS 0xfe4b0afc /* @ECU_Address@SwcOut_TOS_AEB[0].corner_right_front_x@ */ /end MEASUREMENT
/begin MEASUREMENT SwcOut_TOS_AEB[0].corner_right_front_y "" FLOAT32_IEEE autosar_swc_tos_CM_single 0 0 -3.4E+38 3.4E+38 ECU_ADDRESS 0xfe4b0b00 /* @ECU_Address@SwcOut_TOS_AEB[0].corner_right_front_y@ */ /end MEASUREMENT
/begin MEASUREMENT SwcOut_TOS_AEB[0].corner_right_rear_x "" FLOAT32_IEEE autosar_swc_tos_CM_single 0 0 -3.4E+38 3.4E+38 ECU_ADDRESS 0xfe4b0b0c /* @ECU_Address@SwcOut_TOS_AEB[0].corner_right_rear_x@ */ /end MEASUREMENT
/begin MEASUREMENT SwcOut_TOS_AEB[0].corner_right_rear_y "" FLOAT32_IEEE autosar_swc_tos_CM_single 0 0 -3.4E+38 3.4E+38 ECU_ADDRESS 0xfe4b0b10 /* @ECU_Address@SwcOut_TOS_AEB[0].corner_right_rear_y@ */ /end MEASUREMENT
/begin MEASUREMENT SwcOut_TOS_AEB[0].pro_flag "" SLONG autosar_swc_tos_CM_int32 0 0 -2147483648 2147483647 ECU_ADDRESS 0xfe4b0aa8 /* @ECU_Address@SwcOut_TOS_AEB[0].pro_flag@ */ /end MEASUREMENT
/begin MEASUREMENT SwcOut_TOS_AEB[0].ramp "" UBYTE autosar_swc_tos_CM_uint8 0 0 0 255 ECU_ADDRESS 0xfe4b0aa3 /* @ECU_Address@SwcOut_TOS_AEB[0].ramp@ */ /end MEASUREMENT
/begin MEASUREMENT SwcOut_TOS_AEB[10].CllsnMtgtnByBrkgPrimQly "" UBYTE autosar_swc_tos_CM_uint8 0 0 0 255 ECU_ADDRESS 0xfe4b1090 /* @ECU_Address@SwcOut_TOS_AEB[10].CllsnMtgtnByBrkgPrimQly@ */ /end MEASUREMENT
/begin MEASUREMENT SwcOut_TOS_AEB[10].CllsnMtgtnByBrkgSecQly "" UBYTE autosar_swc_tos_CM_uint8 0 0 0 255 ECU_ADDRESS 0xfe4b1091 /* @ECU_Address@SwcOut_TOS_AEB[10].CllsnMtgtnByBrkgSecQly@ */ /end MEASUREMENT
/begin MEASUREMENT SwcOut_TOS_AEB[10].CllsnWarnFwdQly "" UBYTE autosar_swc_tos_CM_uint8 0 0 0 255 ECU_ADDRESS 0xfe4b1092 /* @ECU_Address@SwcOut_TOS_AEB[10].CllsnWarnFwdQly@ */ /end MEASUREMENT
/begin MEASUREMENT SwcOut_TOS_AEB[10].LeftLane_flag "" UBYTE autosar_swc_tos_CM_boolean 0 0 0 1 ECU_ADDRESS 0xfe4b1088 /* @ECU_Address@SwcOut_TOS_AEB[10].LeftLane_flag@ */ /end MEASUREMENT
/begin MEASUREMENT SwcOut_TOS_AEB[10].Object_AX "" FLOAT32_IEEE autosar_swc_tos_CM_single 0 0 -3.4E+38 3.4E+38 ECU_ADDRESS 0xfe4b10d4 /* @ECU_Address@SwcOut_TOS_AEB[10].Object_AX@ */ /end MEASUREMENT
/begin MEASUREMENT SwcOut_TOS_AEB[10].Object_AY "" FLOAT32_IEEE autosar_swc_tos_CM_single 0 0 -3.4E+38 3.4E+38 ECU_ADDRESS 0xfe4b10d8 /* @ECU_Address@SwcOut_TOS_AEB[10].Object_AY@ */ /end MEASUREMENT
/begin MEASUREMENT SwcOut_TOS_AEB[10].Object_Abs_AX "" FLOAT32_IEEE autosar_swc_tos_CM_single 0 0 -3.4E+38 3.4E+38 ECU_ADDRESS 0xfe4b10dc /* @ECU_Address@SwcOut_TOS_AEB[10].Object_Abs_AX@ */ /end MEASUREMENT
/begin MEASUREMENT SwcOut_TOS_AEB[10].Object_Abs_AY "" FLOAT32_IEEE autosar_swc_tos_CM_single 0 0 -3.4E+38 3.4E+38 ECU_ADDRESS 0xfe4b10e0 /* @ECU_Address@SwcOut_TOS_AEB[10].Object_Abs_AY@ */ /end MEASUREMENT
/begin MEASUREMENT SwcOut_TOS_AEB[10].Object_Abs_SPEED "" FLOAT32_IEEE autosar_swc_tos_CM_single 0 0 -3.4E+38 3.4E+38 ECU_ADDRESS 0xfe4b10c8 /* @ECU_Address@SwcOut_TOS_AEB[10].Object_Abs_SPEED@ */ /end MEASUREMENT
/begin MEASUREMENT SwcOut_TOS_AEB[10].Object_Abs_VX "" FLOAT32_IEEE autosar_swc_tos_CM_single 0 0 -3.4E+38 3.4E+38 ECU_ADDRESS 0xfe4b10cc /* @ECU_Address@SwcOut_TOS_AEB[10].Object_Abs_VX@ */ /end MEASUREMENT
/begin MEASUREMENT SwcOut_TOS_AEB[10].Object_Abs_VY "" FLOAT32_IEEE autosar_swc_tos_CM_single 0 0 -3.4E+38 3.4E+38 ECU_ADDRESS 0xfe4b10d0 /* @ECU_Address@SwcOut_TOS_AEB[10].Object_Abs_VY@ */ /end MEASUREMENT
/begin MEASUREMENT SwcOut_TOS_AEB[10].Object_Age "" A_UINT64 autosar_swc_tos_CM_uint64 0 0 0 18446744073709551615 ECU_ADDRESS 0xfe4b1110 /* @ECU_Address@SwcOut_TOS_AEB[10].Object_Age@ */ /end MEASUREMENT
/begin MEASUREMENT SwcOut_TOS_AEB[10].Object_DX "" FLOAT32_IEEE autosar_swc_tos_CM_single 0 0 -3.4E+38 3.4E+38 ECU_ADDRESS 0xfe4b10b0 /* @ECU_Address@SwcOut_TOS_AEB[10].Object_DX@ */ /end MEASUREMENT
/begin MEASUREMENT SwcOut_TOS_AEB[10].Object_DY "" FLOAT32_IEEE autosar_swc_tos_CM_single 0 0 -3.4E+38 3.4E+38 ECU_ADDRESS 0xfe4b10b4 /* @ECU_Address@SwcOut_TOS_AEB[10].Object_DY@ */ /end MEASUREMENT
/begin MEASUREMENT SwcOut_TOS_AEB[10].Object_Fus_Type "" UWORD autosar_swc_tos_CM_uint16 0 0 0 65535 ECU_ADDRESS 0xfe4b1094 /* @ECU_Address@SwcOut_TOS_AEB[10].Object_Fus_Type@ */ /end MEASUREMENT
/begin MEASUREMENT SwcOut_TOS_AEB[10].Object_HeadingAngle "" FLOAT32_IEEE autosar_swc_tos_CM_single 0 0 -3.4E+38 3.4E+38 ECU_ADDRESS 0xfe4b10a8 /* @ECU_Address@SwcOut_TOS_AEB[10].Object_HeadingAngle@ */ /end MEASUREMENT
/begin MEASUREMENT SwcOut_TOS_AEB[10].Object_Hight "" FLOAT32_IEEE autosar_swc_tos_CM_single 0 0 -3.4E+38 3.4E+38 ECU_ADDRESS 0xfe4b10a4 /* @ECU_Address@SwcOut_TOS_AEB[10].Object_Hight@ */ /end MEASUREMENT
/begin MEASUREMENT SwcOut_TOS_AEB[10].Object_ID "" ULONG autosar_swc_tos_CM_uint32 0 0 0 4294967295 ECU_ADDRESS 0xfe4b1104 /* @ECU_Address@SwcOut_TOS_AEB[10].Object_ID@ */ /end MEASUREMENT
/begin MEASUREMENT SwcOut_TOS_AEB[10].Object_Length "" FLOAT32_IEEE autosar_swc_tos_CM_single 0 0 -3.4E+38 3.4E+38 ECU_ADDRESS 0xfe4b109c /* @ECU_Address@SwcOut_TOS_AEB[10].Object_Length@ */ /end MEASUREMENT
/begin MEASUREMENT SwcOut_TOS_AEB[10].Object_MovingState "" UBYTE autosar_swc_tos_CM_uint8 0 0 0 255 ECU_ADDRESS 0xfe4b108c /* @ECU_Address@SwcOut_TOS_AEB[10].Object_MovingState@ */ /end MEASUREMENT
/begin MEASUREMENT SwcOut_TOS_AEB[10].Object_Orientation "" UBYTE autosar_swc_tos_CM_uint8 0 0 0 255 ECU_ADDRESS 0xfe4b108d /* @ECU_Address@SwcOut_TOS_AEB[10].Object_Orientation@ */ /end MEASUREMENT
/begin MEASUREMENT SwcOut_TOS_AEB[10].Object_RangeX "" FLOAT32_IEEE autosar_swc_tos_CM_single 0 0 -3.4E+38 3.4E+38 ECU_ADDRESS 0xfe4b10b8 /* @ECU_Address@SwcOut_TOS_AEB[10].Object_RangeX@ */ /end MEASUREMENT
/begin MEASUREMENT SwcOut_TOS_AEB[10].Object_RangeY "" FLOAT32_IEEE autosar_swc_tos_CM_single 0 0 -3.4E+38 3.4E+38 ECU_ADDRESS 0xfe4b10bc /* @ECU_Address@SwcOut_TOS_AEB[10].Object_RangeY@ */ /end MEASUREMENT
/begin MEASUREMENT SwcOut_TOS_AEB[10].Object_Turn_Signal "" UBYTE autosar_swc_tos_CM_uint8 0 0 0 255 ECU_ADDRESS 0xfe4b108e /* @ECU_Address@SwcOut_TOS_AEB[10].Object_Turn_Signal@ */ /end MEASUREMENT
/begin MEASUREMENT SwcOut_TOS_AEB[10].Object_Type "" UBYTE autosar_swc_tos_CM_uint8 0 0 0 255 ECU_ADDRESS 0xfe4b108b /* @ECU_Address@SwcOut_TOS_AEB[10].Object_Type@ */ /end MEASUREMENT
/begin MEASUREMENT SwcOut_TOS_AEB[10].Object_VX "" FLOAT32_IEEE autosar_swc_tos_CM_single 0 0 -3.4E+38 3.4E+38 ECU_ADDRESS 0xfe4b10c0 /* @ECU_Address@SwcOut_TOS_AEB[10].Object_VX@ */ /end MEASUREMENT
/begin MEASUREMENT SwcOut_TOS_AEB[10].Object_VY "" FLOAT32_IEEE autosar_swc_tos_CM_single 0 0 -3.4E+38 3.4E+38 ECU_ADDRESS 0xfe4b10c4 /* @ECU_Address@SwcOut_TOS_AEB[10].Object_VY@ */ /end MEASUREMENT
/begin MEASUREMENT SwcOut_TOS_AEB[10].Object_Width "" FLOAT32_IEEE autosar_swc_tos_CM_single 0 0 -3.4E+38 3.4E+38 ECU_ADDRESS 0xfe4b10a0 /* @ECU_Address@SwcOut_TOS_AEB[10].Object_Width@ */ /end MEASUREMENT
/begin MEASUREMENT SwcOut_TOS_AEB[10].Object_YawAngle "" FLOAT32_IEEE autosar_swc_tos_CM_single 0 0 -3.4E+38 3.4E+38 ECU_ADDRESS 0xfe4b10ac /* @ECU_Address@SwcOut_TOS_AEB[10].Object_YawAngle@ */ /end MEASUREMENT
/begin MEASUREMENT SwcOut_TOS_AEB[10].RightLane_flag "" UBYTE autosar_swc_tos_CM_boolean 0 0 0 1 ECU_ADDRESS 0xfe4b108a /* @ECU_Address@SwcOut_TOS_AEB[10].RightLane_flag@ */ /end MEASUREMENT
/begin MEASUREMENT SwcOut_TOS_AEB[10].SameLane_flag "" UBYTE autosar_swc_tos_CM_boolean 0 0 0 1 ECU_ADDRESS 0xfe4b1089 /* @ECU_Address@SwcOut_TOS_AEB[10].SameLane_flag@ */ /end MEASUREMENT
/begin MEASUREMENT SwcOut_TOS_AEB[10].Sceniaro_Flag "" UBYTE autosar_swc_tos_CM_uint8 0 0 0 255 ECU_ADDRESS 0xfe4b108f /* @ECU_Address@SwcOut_TOS_AEB[10].Sceniaro_Flag@ */ /end MEASUREMENT
/begin MEASUREMENT SwcOut_TOS_AEB[10].TimeStamp "" A_UINT64 autosar_swc_tos_CM_uint64 0 0 0 18446744073709551615 ECU_ADDRESS 0xfe4b1118 /* @ECU_Address@SwcOut_TOS_AEB[10].TimeStamp@ */ /end MEASUREMENT
/begin MEASUREMENT SwcOut_TOS_AEB[10].camID "" ULONG autosar_swc_tos_CM_uint32 0 0 0 4294967295 ECU_ADDRESS 0xfe4b1108 /* @ECU_Address@SwcOut_TOS_AEB[10].camID@ */ /end MEASUREMENT
/begin MEASUREMENT SwcOut_TOS_AEB[10].corner_left_front_x "" FLOAT32_IEEE autosar_swc_tos_CM_single 0 0 -3.4E+38 3.4E+38 ECU_ADDRESS 0xfe4b10e4 /* @ECU_Address@SwcOut_TOS_AEB[10].corner_left_front_x@ */ /end MEASUREMENT
/begin MEASUREMENT SwcOut_TOS_AEB[10].corner_left_front_y "" FLOAT32_IEEE autosar_swc_tos_CM_single 0 0 -3.4E+38 3.4E+38 ECU_ADDRESS 0xfe4b10e8 /* @ECU_Address@SwcOut_TOS_AEB[10].corner_left_front_y@ */ /end MEASUREMENT
/begin MEASUREMENT SwcOut_TOS_AEB[10].corner_left_rear_x "" FLOAT32_IEEE autosar_swc_tos_CM_single 0 0 -3.4E+38 3.4E+38 ECU_ADDRESS 0xfe4b10f4 /* @ECU_Address@SwcOut_TOS_AEB[10].corner_left_rear_x@ */ /end MEASUREMENT
/begin MEASUREMENT SwcOut_TOS_AEB[10].corner_left_rear_y "" FLOAT32_IEEE autosar_swc_tos_CM_single 0 0 -3.4E+38 3.4E+38 ECU_ADDRESS 0xfe4b10f8 /* @ECU_Address@SwcOut_TOS_AEB[10].corner_left_rear_y@ */ /end MEASUREMENT
/begin MEASUREMENT SwcOut_TOS_AEB[10].corner_right_front_x "" FLOAT32_IEEE autosar_swc_tos_CM_single 0 0 -3.4E+38 3.4E+38 ECU_ADDRESS 0xfe4b10ec /* @ECU_Address@SwcOut_TOS_AEB[10].corner_right_front_x@ */ /end MEASUREMENT
/begin MEASUREMENT SwcOut_TOS_AEB[10].corner_right_front_y "" FLOAT32_IEEE autosar_swc_tos_CM_single 0 0 -3.4E+38 3.4E+38 ECU_ADDRESS 0xfe4b10f0 /* @ECU_Address@SwcOut_TOS_AEB[10].corner_right_front_y@ */ /end MEASUREMENT
/begin MEASUREMENT SwcOut_TOS_AEB[10].corner_right_rear_x "" FLOAT32_IEEE autosar_swc_tos_CM_single 0 0 -3.4E+38 3.4E+38 ECU_ADDRESS 0xfe4b10fc /* @ECU_Address@SwcOut_TOS_AEB[10].corner_right_rear_x@ */ /end MEASUREMENT
/begin MEASUREMENT SwcOut_TOS_AEB[10].corner_right_rear_y "" FLOAT32_IEEE autosar_swc_tos_CM_single 0 0 -3.4E+38 3.4E+38 ECU_ADDRESS 0xfe4b1100 /* @ECU_Address@SwcOut_TOS_AEB[10].corner_right_rear_y@ */ /end MEASUREMENT
/begin MEASUREMENT SwcOut_TOS_AEB[10].pro_flag "" SLONG autosar_swc_tos_CM_int32 0 0 -2147483648 2147483647 ECU_ADDRESS 0xfe4b1098 /* @ECU_Address@SwcOut_TOS_AEB[10].pro_flag@ */ /end MEASUREMENT
/begin MEASUREMENT SwcOut_TOS_AEB[10].ramp "" UBYTE autosar_swc_tos_CM_uint8 0 0 0 255 ECU_ADDRESS 0xfe4b1093 /* @ECU_Address@SwcOut_TOS_AEB[10].ramp@ */ /end MEASUREMENT
/begin MEASUREMENT SwcOut_TOS_AEB[11].CllsnMtgtnByBrkgPrimQly "" UBYTE autosar_swc_tos_CM_uint8 0 0 0 255 ECU_ADDRESS 0xfe4b1128 /* @ECU_Address@SwcOut_TOS_AEB[11].CllsnMtgtnByBrkgPrimQly@ */ /end MEASUREMENT
/begin MEASUREMENT SwcOut_TOS_AEB[11].CllsnMtgtnByBrkgSecQly "" UBYTE autosar_swc_tos_CM_uint8 0 0 0 255 ECU_ADDRESS 0xfe4b1129 /* @ECU_Address@SwcOut_TOS_AEB[11].CllsnMtgtnByBrkgSecQly@ */ /end MEASUREMENT
/begin MEASUREMENT SwcOut_TOS_AEB[11].CllsnWarnFwdQly "" UBYTE autosar_swc_tos_CM_uint8 0 0 0 255 ECU_ADDRESS 0xfe4b112a /* @ECU_Address@SwcOut_TOS_AEB[11].CllsnWarnFwdQly@ */ /end MEASUREMENT
/begin MEASUREMENT SwcOut_TOS_AEB[11].LeftLane_flag "" UBYTE autosar_swc_tos_CM_boolean 0 0 0 1 ECU_ADDRESS 0xfe4b1120 /* @ECU_Address@SwcOut_TOS_AEB[11].LeftLane_flag@ */ /end MEASUREMENT
/begin MEASUREMENT SwcOut_TOS_AEB[11].Object_AX "" FLOAT32_IEEE autosar_swc_tos_CM_single 0 0 -3.4E+38 3.4E+38 ECU_ADDRESS 0xfe4b116c /* @ECU_Address@SwcOut_TOS_AEB[11].Object_AX@ */ /end MEASUREMENT
/begin MEASUREMENT SwcOut_TOS_AEB[11].Object_AY "" FLOAT32_IEEE autosar_swc_tos_CM_single 0 0 -3.4E+38 3.4E+38 ECU_ADDRESS 0xfe4b1170 /* @ECU_Address@SwcOut_TOS_AEB[11].Object_AY@ */ /end MEASUREMENT
/begin MEASUREMENT SwcOut_TOS_AEB[11].Object_Abs_AX "" FLOAT32_IEEE autosar_swc_tos_CM_single 0 0 -3.4E+38 3.4E+38 ECU_ADDRESS 0xfe4b1174 /* @ECU_Address@SwcOut_TOS_AEB[11].Object_Abs_AX@ */ /end MEASUREMENT
/begin MEASUREMENT SwcOut_TOS_AEB[11].Object_Abs_AY "" FLOAT32_IEEE autosar_swc_tos_CM_single 0 0 -3.4E+38 3.4E+38 ECU_ADDRESS 0xfe4b1178 /* @ECU_Address@SwcOut_TOS_AEB[11].Object_Abs_AY@ */ /end MEASUREMENT
/begin MEASUREMENT SwcOut_TOS_AEB[11].Object_Abs_SPEED "" FLOAT32_IEEE autosar_swc_tos_CM_single 0 0 -3.4E+38 3.4E+38 ECU_ADDRESS 0xfe4b1160 /* @ECU_Address@SwcOut_TOS_AEB[11].Object_Abs_SPEED@ */ /end MEASUREMENT
/begin MEASUREMENT SwcOut_TOS_AEB[11].Object_Abs_VX "" FLOAT32_IEEE autosar_swc_tos_CM_single 0 0 -3.4E+38 3.4E+38 ECU_ADDRESS 0xfe4b1164 /* @ECU_Address@SwcOut_TOS_AEB[11].Object_Abs_VX@ */ /end MEASUREMENT
/begin MEASUREMENT SwcOut_TOS_AEB[11].Object_Abs_VY "" FLOAT32_IEEE autosar_swc_tos_CM_single 0 0 -3.4E+38 3.4E+38 ECU_ADDRESS 0xfe4b1168 /* @ECU_Address@SwcOut_TOS_AEB[11].Object_Abs_VY@ */ /end MEASUREMENT
/begin MEASUREMENT SwcOut_TOS_AEB[11].Object_Age "" A_UINT64 autosar_swc_tos_CM_uint64 0 0 0 18446744073709551615 ECU_ADDRESS 0xfe4b11a8 /* @ECU_Address@SwcOut_TOS_AEB[11].Object_Age@ */ /end MEASUREMENT
/begin MEASUREMENT SwcOut_TOS_AEB[11].Object_DX "" FLOAT32_IEEE autosar_swc_tos_CM_single 0 0 -3.4E+38 3.4E+38 ECU_ADDRESS 0xfe4b1148 /* @ECU_Address@SwcOut_TOS_AEB[11].Object_DX@ */ /end MEASUREMENT
/begin MEASUREMENT SwcOut_TOS_AEB[11].Object_DY "" FLOAT32_IEEE autosar_swc_tos_CM_single 0 0 -3.4E+38 3.4E+38 ECU_ADDRESS 0xfe4b114c /* @ECU_Address@SwcOut_TOS_AEB[11].Object_DY@ */ /end MEASUREMENT
/begin MEASUREMENT SwcOut_TOS_AEB[11].Object_Fus_Type "" UWORD autosar_swc_tos_CM_uint16 0 0 0 65535 ECU_ADDRESS 0xfe4b112c /* @ECU_Address@SwcOut_TOS_AEB[11].Object_Fus_Type@ */ /end MEASUREMENT
/begin MEASUREMENT SwcOut_TOS_AEB[11].Object_HeadingAngle "" FLOAT32_IEEE autosar_swc_tos_CM_single 0 0 -3.4E+38 3.4E+38 ECU_ADDRESS 0xfe4b1140 /* @ECU_Address@SwcOut_TOS_AEB[11].Object_HeadingAngle@ */ /end MEASUREMENT
/begin MEASUREMENT SwcOut_TOS_AEB[11].Object_Hight "" FLOAT32_IEEE autosar_swc_tos_CM_single 0 0 -3.4E+38 3.4E+38 ECU_ADDRESS 0xfe4b113c /* @ECU_Address@SwcOut_TOS_AEB[11].Object_Hight@ */ /end MEASUREMENT
/begin MEASUREMENT SwcOut_TOS_AEB[11].Object_ID "" ULONG autosar_swc_tos_CM_uint32 0 0 0 4294967295 ECU_ADDRESS 0xfe4b119c /* @ECU_Address@SwcOut_TOS_AEB[11].Object_ID@ */ /end MEASUREMENT
/begin MEASUREMENT SwcOut_TOS_AEB[11].Object_Length "" FLOAT32_IEEE autosar_swc_tos_CM_single 0 0 -3.4E+38 3.4E+38 ECU_ADDRESS 0xfe4b1134 /* @ECU_Address@SwcOut_TOS_AEB[11].Object_Length@ */ /end MEASUREMENT
/begin MEASUREMENT SwcOut_TOS_AEB[11].Object_MovingState "" UBYTE autosar_swc_tos_CM_uint8 0 0 0 255 ECU_ADDRESS 0xfe4b1124 /* @ECU_Address@SwcOut_TOS_AEB[11].Object_MovingState@ */ /end MEASUREMENT
/begin MEASUREMENT SwcOut_TOS_AEB[11].Object_Orientation "" UBYTE autosar_swc_tos_CM_uint8 0 0 0 255 ECU_ADDRESS 0xfe4b1125 /* @ECU_Address@SwcOut_TOS_AEB[11].Object_Orientation@ */ /end MEASUREMENT
/begin MEASUREMENT SwcOut_TOS_AEB[11].Object_RangeX "" FLOAT32_IEEE autosar_swc_tos_CM_single 0 0 -3.4E+38 3.4E+38 ECU_ADDRESS 0xfe4b1150 /* @ECU_Address@SwcOut_TOS_AEB[11].Object_RangeX@ */ /end MEASUREMENT
/begin MEASUREMENT SwcOut_TOS_AEB[11].Object_RangeY "" FLOAT32_IEEE autosar_swc_tos_CM_single 0 0 -3.4E+38 3.4E+38 ECU_ADDRESS 0xfe4b1154 /* @ECU_Address@SwcOut_TOS_AEB[11].Object_RangeY@ */ /end MEASUREMENT
/begin MEASUREMENT SwcOut_TOS_AEB[11].Object_Turn_Signal "" UBYTE autosar_swc_tos_CM_uint8 0 0 0 255 ECU_ADDRESS 0xfe4b1126 /* @ECU_Address@SwcOut_TOS_AEB[11].Object_Turn_Signal@ */ /end MEASUREMENT
/begin MEASUREMENT SwcOut_TOS_AEB[11].Object_Type "" UBYTE autosar_swc_tos_CM_uint8 0 0 0 255 ECU_ADDRESS 0xfe4b1123 /* @ECU_Address@SwcOut_TOS_AEB[11].Object_Type@ */ /end MEASUREMENT
/begin MEASUREMENT SwcOut_TOS_AEB[11].Object_VX "" FLOAT32_IEEE autosar_swc_tos_CM_single 0 0 -3.4E+38 3.4E+38 ECU_ADDRESS 0xfe4b1158 /* @ECU_Address@SwcOut_TOS_AEB[11].Object_VX@ */ /end MEASUREMENT
/begin MEASUREMENT SwcOut_TOS_AEB[11].Object_VY "" FLOAT32_IEEE autosar_swc_tos_CM_single 0 0 -3.4E+38 3.4E+38 ECU_ADDRESS 0xfe4b115c /* @ECU_Address@SwcOut_TOS_AEB[11].Object_VY@ */ /end MEASUREMENT
/begin MEASUREMENT SwcOut_TOS_AEB[11].Object_Width "" FLOAT32_IEEE autosar_swc_tos_CM_single 0 0 -3.4E+38 3.4E+38 ECU_ADDRESS 0xfe4b1138 /* @ECU_Address@SwcOut_TOS_AEB[11].Object_Width@ */ /end MEASUREMENT
/begin MEASUREMENT SwcOut_TOS_AEB[11].Object_YawAngle "" FLOAT32_IEEE autosar_swc_tos_CM_single 0 0 -3.4E+38 3.4E+38 ECU_ADDRESS 0xfe4b1144 /* @ECU_Address@SwcOut_TOS_AEB[11].Object_YawAngle@ */ /end MEASUREMENT
/begin MEASUREMENT SwcOut_TOS_AEB[11].RightLane_flag "" UBYTE autosar_swc_tos_CM_boolean 0 0 0 1 ECU_ADDRESS 0xfe4b1122 /* @ECU_Address@SwcOut_TOS_AEB[11].RightLane_flag@ */ /end MEASUREMENT
/begin MEASUREMENT SwcOut_TOS_AEB[11].SameLane_flag "" UBYTE autosar_swc_tos_CM_boolean 0 0 0 1 ECU_ADDRESS 0xfe4b1121 /* @ECU_Address@SwcOut_TOS_AEB[11].SameLane_flag@ */ /end MEASUREMENT
/begin MEASUREMENT SwcOut_TOS_AEB[11].Sceniaro_Flag "" UBYTE autosar_swc_tos_CM_uint8 0 0 0 255 ECU_ADDRESS 0xfe4b1127 /* @ECU_Address@SwcOut_TOS_AEB[11].Sceniaro_Flag@ */ /end MEASUREMENT
/begin MEASUREMENT SwcOut_TOS_AEB[11].TimeStamp "" A_UINT64 autosar_swc_tos_CM_uint64 0 0 0 18446744073709551615 ECU_ADDRESS 0xfe4b11b0 /* @ECU_Address@SwcOut_TOS_AEB[11].TimeStamp@ */ /end MEASUREMENT
/begin MEASUREMENT SwcOut_TOS_AEB[11].camID "" ULONG autosar_swc_tos_CM_uint32 0 0 0 4294967295 ECU_ADDRESS 0xfe4b11a0 /* @ECU_Address@SwcOut_TOS_AEB[11].camID@ */ /end MEASUREMENT
/begin MEASUREMENT SwcOut_TOS_AEB[11].corner_left_front_x "" FLOAT32_IEEE autosar_swc_tos_CM_single 0 0 -3.4E+38 3.4E+38 ECU_ADDRESS 0xfe4b117c /* @ECU_Address@SwcOut_TOS_AEB[11].corner_left_front_x@ */ /end MEASUREMENT
/begin MEASUREMENT SwcOut_TOS_AEB[11].corner_left_front_y "" FLOAT32_IEEE autosar_swc_tos_CM_single 0 0 -3.4E+38 3.4E+38 ECU_ADDRESS 0xfe4b1180 /* @ECU_Address@SwcOut_TOS_AEB[11].corner_left_front_y@ */ /end MEASUREMENT
/begin MEASUREMENT SwcOut_TOS_AEB[11].corner_left_rear_x "" FLOAT32_IEEE autosar_swc_tos_CM_single 0 0 -3.4E+38 3.4E+38 ECU_ADDRESS 0xfe4b118c /* @ECU_Address@SwcOut_TOS_AEB[11].corner_left_rear_x@ */ /end MEASUREMENT
/begin MEASUREMENT SwcOut_TOS_AEB[11].corner_left_rear_y "" FLOAT32_IEEE autosar_swc_tos_CM_single 0 0 -3.4E+38 3.4E+38 ECU_ADDRESS 0xfe4b1190 /* @ECU_Address@SwcOut_TOS_AEB[11].corner_left_rear_y@ */ /end MEASUREMENT
/begin MEASUREMENT SwcOut_TOS_AEB[11].corner_right_front_x "" FLOAT32_IEEE autosar_swc_tos_CM_single 0 0 -3.4E+38 3.4E+38 ECU_ADDRESS 0xfe4b1184 /* @ECU_Address@SwcOut_TOS_AEB[11].corner_right_front_x@ */ /end MEASUREMENT
/begin MEASUREMENT SwcOut_TOS_AEB[11].corner_right_front_y "" FLOAT32_IEEE autosar_swc_tos_CM_single 0 0 -3.4E+38 3.4E+38 ECU_ADDRESS 0xfe4b1188 /* @ECU_Address@SwcOut_TOS_AEB[11].corner_right_front_y@ */ /end MEASUREMENT
/begin MEASUREMENT SwcOut_TOS_AEB[11].corner_right_rear_x "" FLOAT32_IEEE autosar_swc_tos_CM_single 0 0 -3.4E+38 3.4E+38 ECU_ADDRESS 0xfe4b1194 /* @ECU_Address@SwcOut_TOS_AEB[11].corner_right_rear_x@ */ /end MEASUREMENT
/begin MEASUREMENT SwcOut_TOS_AEB[11].corner_right_rear_y "" FLOAT32_IEEE autosar_swc_tos_CM_single 0 0 -3.4E+38 3.4E+38 ECU_ADDRESS 0xfe4b1198 /* @ECU_Address@SwcOut_TOS_AEB[11].corner_right_rear_y@ */ /end MEASUREMENT
/begin MEASUREMENT SwcOut_TOS_AEB[11].pro_flag "" SLONG autosar_swc_tos_CM_int32 0 0 -2147483648 2147483647 ECU_ADDRESS 0xfe4b1130 /* @ECU_Address@SwcOut_TOS_AEB[11].pro_flag@ */ /end MEASUREMENT
/begin MEASUREMENT SwcOut_TOS_AEB[11].ramp "" UBYTE autosar_swc_tos_CM_uint8 0 0 0 255 ECU_ADDRESS 0xfe4b112b /* @ECU_Address@SwcOut_TOS_AEB[11].ramp@ */ /end MEASUREMENT
/begin MEASUREMENT SwcOut_TOS_AEB[12].CllsnMtgtnByBrkgPrimQly "" UBYTE autosar_swc_tos_CM_uint8 0 0 0 255 ECU_ADDRESS 0xfe4b11c0 /* @ECU_Address@SwcOut_TOS_AEB[12].CllsnMtgtnByBrkgPrimQly@ */ /end MEASUREMENT
/begin MEASUREMENT SwcOut_TOS_AEB[12].CllsnMtgtnByBrkgSecQly "" UBYTE autosar_swc_tos_CM_uint8 0 0 0 255 ECU_ADDRESS 0xfe4b11c1 /* @ECU_Address@SwcOut_TOS_AEB[12].CllsnMtgtnByBrkgSecQly@ */ /end MEASUREMENT
/begin MEASUREMENT SwcOut_TOS_AEB[12].CllsnWarnFwdQly "" UBYTE autosar_swc_tos_CM_uint8 0 0 0 255 ECU_ADDRESS 0xfe4b11c2 /* @ECU_Address@SwcOut_TOS_AEB[12].CllsnWarnFwdQly@ */ /end MEASUREMENT
/begin MEASUREMENT SwcOut_TOS_AEB[12].LeftLane_flag "" UBYTE autosar_swc_tos_CM_boolean 0 0 0 1 ECU_ADDRESS 0xfe4b11b8 /* @ECU_Address@SwcOut_TOS_AEB[12].LeftLane_flag@ */ /end MEASUREMENT
/begin MEASUREMENT SwcOut_TOS_AEB[12].Object_AX "" FLOAT32_IEEE autosar_swc_tos_CM_single 0 0 -3.4E+38 3.4E+38 ECU_ADDRESS 0xfe4b1204 /* @ECU_Address@SwcOut_TOS_AEB[12].Object_AX@ */ /end MEASUREMENT
/begin MEASUREMENT SwcOut_TOS_AEB[12].Object_AY "" FLOAT32_IEEE autosar_swc_tos_CM_single 0 0 -3.4E+38 3.4E+38 ECU_ADDRESS 0xfe4b1208 /* @ECU_Address@SwcOut_TOS_AEB[12].Object_AY@ */ /end MEASUREMENT
/begin MEASUREMENT SwcOut_TOS_AEB[12].Object_Abs_AX "" FLOAT32_IEEE autosar_swc_tos_CM_single 0 0 -3.4E+38 3.4E+38 ECU_ADDRESS 0xfe4b120c /* @ECU_Address@SwcOut_TOS_AEB[12].Object_Abs_AX@ */ /end MEASUREMENT
/begin MEASUREMENT SwcOut_TOS_AEB[12].Object_Abs_AY "" FLOAT32_IEEE autosar_swc_tos_CM_single 0 0 -3.4E+38 3.4E+38 ECU_ADDRESS 0xfe4b1210 /* @ECU_Address@SwcOut_TOS_AEB[12].Object_Abs_AY@ */ /end MEASUREMENT
/begin MEASUREMENT SwcOut_TOS_AEB[12].Object_Abs_SPEED "" FLOAT32_IEEE autosar_swc_tos_CM_single 0 0 -3.4E+38 3.4E+38 ECU_ADDRESS 0xfe4b11f8 /* @ECU_Address@SwcOut_TOS_AEB[12].Object_Abs_SPEED@ */ /end MEASUREMENT
/begin MEASUREMENT SwcOut_TOS_AEB[12].Object_Abs_VX "" FLOAT32_IEEE autosar_swc_tos_CM_single 0 0 -3.4E+38 3.4E+38 ECU_ADDRESS 0xfe4b11fc /* @ECU_Address@SwcOut_TOS_AEB[12].Object_Abs_VX@ */ /end MEASUREMENT
/begin MEASUREMENT SwcOut_TOS_AEB[12].Object_Abs_VY "" FLOAT32_IEEE autosar_swc_tos_CM_single 0 0 -3.4E+38 3.4E+38 ECU_ADDRESS 0xfe4b1200 /* @ECU_Address@SwcOut_TOS_AEB[12].Object_Abs_VY@ */ /end MEASUREMENT
/begin MEASUREMENT SwcOut_TOS_AEB[12].Object_Age "" A_UINT64 autosar_swc_tos_CM_uint64 0 0 0 18446744073709551615 ECU_ADDRESS 0xfe4b1240 /* @ECU_Address@SwcOut_TOS_AEB[12].Object_Age@ */ /end MEASUREMENT
/begin MEASUREMENT SwcOut_TOS_AEB[12].Object_DX "" FLOAT32_IEEE autosar_swc_tos_CM_single 0 0 -3.4E+38 3.4E+38 ECU_ADDRESS 0xfe4b11e0 /* @ECU_Address@SwcOut_TOS_AEB[12].Object_DX@ */ /end MEASUREMENT
/begin MEASUREMENT SwcOut_TOS_AEB[12].Object_DY "" FLOAT32_IEEE autosar_swc_tos_CM_single 0 0 -3.4E+38 3.4E+38 ECU_ADDRESS 0xfe4b11e4 /* @ECU_Address@SwcOut_TOS_AEB[12].Object_DY@ */ /end MEASUREMENT
/begin MEASUREMENT SwcOut_TOS_AEB[12].Object_Fus_Type "" UWORD autosar_swc_tos_CM_uint16 0 0 0 65535 ECU_ADDRESS 0xfe4b11c4 /* @ECU_Address@SwcOut_TOS_AEB[12].Object_Fus_Type@ */ /end MEASUREMENT
/begin MEASUREMENT SwcOut_TOS_AEB[12].Object_HeadingAngle "" FLOAT32_IEEE autosar_swc_tos_CM_single 0 0 -3.4E+38 3.4E+38 ECU_ADDRESS 0xfe4b11d8 /* @ECU_Address@SwcOut_TOS_AEB[12].Object_HeadingAngle@ */ /end MEASUREMENT
/begin MEASUREMENT SwcOut_TOS_AEB[12].Object_Hight "" FLOAT32_IEEE autosar_swc_tos_CM_single 0 0 -3.4E+38 3.4E+38 ECU_ADDRESS 0xfe4b11d4 /* @ECU_Address@SwcOut_TOS_AEB[12].Object_Hight@ */ /end MEASUREMENT
/begin MEASUREMENT SwcOut_TOS_AEB[12].Object_ID "" ULONG autosar_swc_tos_CM_uint32 0 0 0 4294967295 ECU_ADDRESS 0xfe4b1234 /* @ECU_Address@SwcOut_TOS_AEB[12].Object_ID@ */ /end MEASUREMENT
/begin MEASUREMENT SwcOut_TOS_AEB[12].Object_Length "" FLOAT32_IEEE autosar_swc_tos_CM_single 0 0 -3.4E+38 3.4E+38 ECU_ADDRESS 0xfe4b11cc /* @ECU_Address@SwcOut_TOS_AEB[12].Object_Length@ */ /end MEASUREMENT
/begin MEASUREMENT SwcOut_TOS_AEB[12].Object_MovingState "" UBYTE autosar_swc_tos_CM_uint8 0 0 0 255 ECU_ADDRESS 0xfe4b11bc /* @ECU_Address@SwcOut_TOS_AEB[12].Object_MovingState@ */ /end MEASUREMENT
/begin MEASUREMENT SwcOut_TOS_AEB[12].Object_Orientation "" UBYTE autosar_swc_tos_CM_uint8 0 0 0 255 ECU_ADDRESS 0xfe4b11bd /* @ECU_Address@SwcOut_TOS_AEB[12].Object_Orientation@ */ /end MEASUREMENT
/begin MEASUREMENT SwcOut_TOS_AEB[12].Object_RangeX "" FLOAT32_IEEE autosar_swc_tos_CM_single 0 0 -3.4E+38 3.4E+38 ECU_ADDRESS 0xfe4b11e8 /* @ECU_Address@SwcOut_TOS_AEB[12].Object_RangeX@ */ /end MEASUREMENT
/begin MEASUREMENT SwcOut_TOS_AEB[12].Object_RangeY "" FLOAT32_IEEE autosar_swc_tos_CM_single 0 0 -3.4E+38 3.4E+38 ECU_ADDRESS 0xfe4b11ec /* @ECU_Address@SwcOut_TOS_AEB[12].Object_RangeY@ */ /end MEASUREMENT
/begin MEASUREMENT SwcOut_TOS_AEB[12].Object_Turn_Signal "" UBYTE autosar_swc_tos_CM_uint8 0 0 0 255 ECU_ADDRESS 0xfe4b11be /* @ECU_Address@SwcOut_TOS_AEB[12].Object_Turn_Signal@ */ /end MEASUREMENT
/begin MEASUREMENT SwcOut_TOS_AEB[12].Object_Type "" UBYTE autosar_swc_tos_CM_uint8 0 0 0 255 ECU_ADDRESS 0xfe4b11bb /* @ECU_Address@SwcOut_TOS_AEB[12].Object_Type@ */ /end MEASUREMENT
/begin MEASUREMENT SwcOut_TOS_AEB[12].Object_VX "" FLOAT32_IEEE autosar_swc_tos_CM_single 0 0 -3.4E+38 3.4E+38 ECU_ADDRESS 0xfe4b11f0 /* @ECU_Address@SwcOut_TOS_AEB[12].Object_VX@ */ /end MEASUREMENT
/begin MEASUREMENT SwcOut_TOS_AEB[12].Object_VY "" FLOAT32_IEEE autosar_swc_tos_CM_single 0 0 -3.4E+38 3.4E+38 ECU_ADDRESS 0xfe4b11f4 /* @ECU_Address@SwcOut_TOS_AEB[12].Object_VY@ */ /end MEASUREMENT
/begin MEASUREMENT SwcOut_TOS_AEB[12].Object_Width "" FLOAT32_IEEE autosar_swc_tos_CM_single 0 0 -3.4E+38 3.4E+38 ECU_ADDRESS 0xfe4b11d0 /* @ECU_Address@SwcOut_TOS_AEB[12].Object_Width@ */ /end MEASUREMENT
/begin MEASUREMENT SwcOut_TOS_AEB[12].Object_YawAngle "" FLOAT32_IEEE autosar_swc_tos_CM_single 0 0 -3.4E+38 3.4E+38 ECU_ADDRESS 0xfe4b11dc /* @ECU_Address@SwcOut_TOS_AEB[12].Object_YawAngle@ */ /end MEASUREMENT
/begin MEASUREMENT SwcOut_TOS_AEB[12].RightLane_flag "" UBYTE autosar_swc_tos_CM_boolean 0 0 0 1 ECU_ADDRESS 0xfe4b11ba /* @ECU_Address@SwcOut_TOS_AEB[12].RightLane_flag@ */ /end MEASUREMENT
/begin MEASUREMENT SwcOut_TOS_AEB[12].SameLane_flag "" UBYTE autosar_swc_tos_CM_boolean 0 0 0 1 ECU_ADDRESS 0xfe4b11b9 /* @ECU_Address@SwcOut_TOS_AEB[12].SameLane_flag@ */ /end MEASUREMENT
/begin MEASUREMENT SwcOut_TOS_AEB[12].Sceniaro_Flag "" UBYTE autosar_swc_tos_CM_uint8 0 0 0 255 ECU_ADDRESS 0xfe4b11bf /* @ECU_Address@SwcOut_TOS_AEB[12].Sceniaro_Flag@ */ /end MEASUREMENT
/begin MEASUREMENT SwcOut_TOS_AEB[12].TimeStamp "" A_UINT64 autosar_swc_tos_CM_uint64 0 0 0 18446744073709551615 ECU_ADDRESS 0xfe4b1248 /* @ECU_Address@SwcOut_TOS_AEB[12].TimeStamp@ */ /end MEASUREMENT
/begin MEASUREMENT SwcOut_TOS_AEB[12].camID "" ULONG autosar_swc_tos_CM_uint32 0 0 0 4294967295 ECU_ADDRESS 0xfe4b1238 /* @ECU_Address@SwcOut_TOS_AEB[12].camID@ */ /end MEASUREMENT
/begin MEASUREMENT SwcOut_TOS_AEB[12].corner_left_front_x "" FLOAT32_IEEE autosar_swc_tos_CM_single 0 0 -3.4E+38 3.4E+38 ECU_ADDRESS 0xfe4b1214 /* @ECU_Address@SwcOut_TOS_AEB[12].corner_left_front_x@ */ /end MEASUREMENT
/begin MEASUREMENT SwcOut_TOS_AEB[12].corner_left_front_y "" FLOAT32_IEEE autosar_swc_tos_CM_single 0 0 -3.4E+38 3.4E+38 ECU_ADDRESS 0xfe4b1218 /* @ECU_Address@SwcOut_TOS_AEB[12].corner_left_front_y@ */ /end MEASUREMENT
/begin MEASUREMENT SwcOut_TOS_AEB[12].corner_left_rear_x "" FLOAT32_IEEE autosar_swc_tos_CM_single 0 0 -3.4E+38 3.4E+38 ECU_ADDRESS 0xfe4b1224 /* @ECU_Address@SwcOut_TOS_AEB[12].corner_left_rear_x@ */ /end MEASUREMENT
/begin MEASUREMENT SwcOut_TOS_AEB[12].corner_left_rear_y "" FLOAT32_IEEE autosar_swc_tos_CM_single 0 0 -3.4E+38 3.4E+38 ECU_ADDRESS 0xfe4b1228 /* @ECU_Address@SwcOut_TOS_AEB[12].corner_left_rear_y@ */ /end MEASUREMENT
/begin MEASUREMENT SwcOut_TOS_AEB[12].corner_right_front_x "" FLOAT32_IEEE autosar_swc_tos_CM_single 0 0 -3.4E+38 3.4E+38 ECU_ADDRESS 0xfe4b121c /* @ECU_Address@SwcOut_TOS_AEB[12].corner_right_front_x@ */ /end MEASUREMENT
/begin MEASUREMENT SwcOut_TOS_AEB[12].corner_right_front_y "" FLOAT32_IEEE autosar_swc_tos_CM_single 0 0 -3.4E+38 3.4E+38 ECU_ADDRESS 0xfe4b1220 /* @ECU_Address@SwcOut_TOS_AEB[12].corner_right_front_y@ */ /end MEASUREMENT
/begin MEASUREMENT SwcOut_TOS_AEB[12].corner_right_rear_x "" FLOAT32_IEEE autosar_swc_tos_CM_single 0 0 -3.4E+38 3.4E+38 ECU_ADDRESS 0xfe4b122c /* @ECU_Address@SwcOut_TOS_AEB[12].corner_right_rear_x@ */ /end MEASUREMENT
/begin MEASUREMENT SwcOut_TOS_AEB[12].corner_right_rear_y "" FLOAT32_IEEE autosar_swc_tos_CM_single 0 0 -3.4E+38 3.4E+38 ECU_ADDRESS 0xfe4b1230 /* @ECU_Address@SwcOut_TOS_AEB[12].corner_right_rear_y@ */ /end MEASUREMENT
/begin MEASUREMENT SwcOut_TOS_AEB[12].pro_flag "" SLONG autosar_swc_tos_CM_int32 0 0 -2147483648 2147483647 ECU_ADDRESS 0xfe4b11c8 /* @ECU_Address@SwcOut_TOS_AEB[12].pro_flag@ */ /end MEASUREMENT
/begin MEASUREMENT SwcOut_TOS_AEB[12].ramp "" UBYTE autosar_swc_tos_CM_uint8 0 0 0 255 ECU_ADDRESS 0xfe4b11c3 /* @ECU_Address@SwcOut_TOS_AEB[12].ramp@ */ /end MEASUREMENT
/begin MEASUREMENT SwcOut_TOS_AEB[13].CllsnMtgtnByBrkgPrimQly "" UBYTE autosar_swc_tos_CM_uint8 0 0 0 255 ECU_ADDRESS 0xfe4b1258 /* @ECU_Address@SwcOut_TOS_AEB[13].CllsnMtgtnByBrkgPrimQly@ */ /end MEASUREMENT
/begin MEASUREMENT SwcOut_TOS_AEB[13].CllsnMtgtnByBrkgSecQly "" UBYTE autosar_swc_tos_CM_uint8 0 0 0 255 ECU_ADDRESS 0xfe4b1259 /* @ECU_Address@SwcOut_TOS_AEB[13].CllsnMtgtnByBrkgSecQly@ */ /end MEASUREMENT
/begin MEASUREMENT SwcOut_TOS_AEB[13].CllsnWarnFwdQly "" UBYTE autosar_swc_tos_CM_uint8 0 0 0 255 ECU_ADDRESS 0xfe4b125a /* @ECU_Address@SwcOut_TOS_AEB[13].CllsnWarnFwdQly@ */ /end MEASUREMENT
/begin MEASUREMENT SwcOut_TOS_AEB[13].LeftLane_flag "" UBYTE autosar_swc_tos_CM_boolean 0 0 0 1 ECU_ADDRESS 0xfe4b1250 /* @ECU_Address@SwcOut_TOS_AEB[13].LeftLane_flag@ */ /end MEASUREMENT
/begin MEASUREMENT SwcOut_TOS_AEB[13].Object_AX "" FLOAT32_IEEE autosar_swc_tos_CM_single 0 0 -3.4E+38 3.4E+38 ECU_ADDRESS 0xfe4b129c /* @ECU_Address@SwcOut_TOS_AEB[13].Object_AX@ */ /end MEASUREMENT
/begin MEASUREMENT SwcOut_TOS_AEB[13].Object_AY "" FLOAT32_IEEE autosar_swc_tos_CM_single 0 0 -3.4E+38 3.4E+38 ECU_ADDRESS 0xfe4b12a0 /* @ECU_Address@SwcOut_TOS_AEB[13].Object_AY@ */ /end MEASUREMENT
/begin MEASUREMENT SwcOut_TOS_AEB[13].Object_Abs_AX "" FLOAT32_IEEE autosar_swc_tos_CM_single 0 0 -3.4E+38 3.4E+38 ECU_ADDRESS 0xfe4b12a4 /* @ECU_Address@SwcOut_TOS_AEB[13].Object_Abs_AX@ */ /end MEASUREMENT
/begin MEASUREMENT SwcOut_TOS_AEB[13].Object_Abs_AY "" FLOAT32_IEEE autosar_swc_tos_CM_single 0 0 -3.4E+38 3.4E+38 ECU_ADDRESS 0xfe4b12a8 /* @ECU_Address@SwcOut_TOS_AEB[13].Object_Abs_AY@ */ /end MEASUREMENT
/begin MEASUREMENT SwcOut_TOS_AEB[13].Object_Abs_SPEED "" FLOAT32_IEEE autosar_swc_tos_CM_single 0 0 -3.4E+38 3.4E+38 ECU_ADDRESS 0xfe4b1290 /* @ECU_Address@SwcOut_TOS_AEB[13].Object_Abs_SPEED@ */ /end MEASUREMENT
/begin MEASUREMENT SwcOut_TOS_AEB[13].Object_Abs_VX "" FLOAT32_IEEE autosar_swc_tos_CM_single 0 0 -3.4E+38 3.4E+38 ECU_ADDRESS 0xfe4b1294 /* @ECU_Address@SwcOut_TOS_AEB[13].Object_Abs_VX@ */ /end MEASUREMENT
/begin MEASUREMENT SwcOut_TOS_AEB[13].Object_Abs_VY "" FLOAT32_IEEE autosar_swc_tos_CM_single 0 0 -3.4E+38 3.4E+38 ECU_ADDRESS 0xfe4b1298 /* @ECU_Address@SwcOut_TOS_AEB[13].Object_Abs_VY@ */ /end MEASUREMENT
/begin MEASUREMENT SwcOut_TOS_AEB[13].Object_Age "" A_UINT64 autosar_swc_tos_CM_uint64 0 0 0 18446744073709551615 ECU_ADDRESS 0xfe4b12d8 /* @ECU_Address@SwcOut_TOS_AEB[13].Object_Age@ */ /end MEASUREMENT
/begin MEASUREMENT SwcOut_TOS_AEB[13].Object_DX "" FLOAT32_IEEE autosar_swc_tos_CM_single 0 0 -3.4E+38 3.4E+38 ECU_ADDRESS 0xfe4b1278 /* @ECU_Address@SwcOut_TOS_AEB[13].Object_DX@ */ /end MEASUREMENT
/begin MEASUREMENT SwcOut_TOS_AEB[13].Object_DY "" FLOAT32_IEEE autosar_swc_tos_CM_single 0 0 -3.4E+38 3.4E+38 ECU_ADDRESS 0xfe4b127c /* @ECU_Address@SwcOut_TOS_AEB[13].Object_DY@ */ /end MEASUREMENT
/begin MEASUREMENT SwcOut_TOS_AEB[13].Object_Fus_Type "" UWORD autosar_swc_tos_CM_uint16 0 0 0 65535 ECU_ADDRESS 0xfe4b125c /* @ECU_Address@SwcOut_TOS_AEB[13].Object_Fus_Type@ */ /end MEASUREMENT
/begin MEASUREMENT SwcOut_TOS_AEB[13].Object_HeadingAngle "" FLOAT32_IEEE autosar_swc_tos_CM_single 0 0 -3.4E+38 3.4E+38 ECU_ADDRESS 0xfe4b1270 /* @ECU_Address@SwcOut_TOS_AEB[13].Object_HeadingAngle@ */ /end MEASUREMENT
/begin MEASUREMENT SwcOut_TOS_AEB[13].Object_Hight "" FLOAT32_IEEE autosar_swc_tos_CM_single 0 0 -3.4E+38 3.4E+38 ECU_ADDRESS 0xfe4b126c /* @ECU_Address@SwcOut_TOS_AEB[13].Object_Hight@ */ /end MEASUREMENT
/begin MEASUREMENT SwcOut_TOS_AEB[13].Object_ID "" ULONG autosar_swc_tos_CM_uint32 0 0 0 4294967295 ECU_ADDRESS 0xfe4b12cc /* @ECU_Address@SwcOut_TOS_AEB[13].Object_ID@ */ /end MEASUREMENT
/begin MEASUREMENT SwcOut_TOS_AEB[13].Object_Length "" FLOAT32_IEEE autosar_swc_tos_CM_single 0 0 -3.4E+38 3.4E+38 ECU_ADDRESS 0xfe4b1264 /* @ECU_Address@SwcOut_TOS_AEB[13].Object_Length@ */ /end MEASUREMENT
/begin MEASUREMENT SwcOut_TOS_AEB[13].Object_MovingState "" UBYTE autosar_swc_tos_CM_uint8 0 0 0 255 ECU_ADDRESS 0xfe4b1254 /* @ECU_Address@SwcOut_TOS_AEB[13].Object_MovingState@ */ /end MEASUREMENT
/begin MEASUREMENT SwcOut_TOS_AEB[13].Object_Orientation "" UBYTE autosar_swc_tos_CM_uint8 0 0 0 255 ECU_ADDRESS 0xfe4b1255 /* @ECU_Address@SwcOut_TOS_AEB[13].Object_Orientation@ */ /end MEASUREMENT
/begin MEASUREMENT SwcOut_TOS_AEB[13].Object_RangeX "" FLOAT32_IEEE autosar_swc_tos_CM_single 0 0 -3.4E+38 3.4E+38 ECU_ADDRESS 0xfe4b1280 /* @ECU_Address@SwcOut_TOS_AEB[13].Object_RangeX@ */ /end MEASUREMENT
/begin MEASUREMENT SwcOut_TOS_AEB[13].Object_RangeY "" FLOAT32_IEEE autosar_swc_tos_CM_single 0 0 -3.4E+38 3.4E+38 ECU_ADDRESS 0xfe4b1284 /* @ECU_Address@SwcOut_TOS_AEB[13].Object_RangeY@ */ /end MEASUREMENT
/begin MEASUREMENT SwcOut_TOS_AEB[13].Object_Turn_Signal "" UBYTE autosar_swc_tos_CM_uint8 0 0 0 255 ECU_ADDRESS 0xfe4b1256 /* @ECU_Address@SwcOut_TOS_AEB[13].Object_Turn_Signal@ */ /end MEASUREMENT
/begin MEASUREMENT SwcOut_TOS_AEB[13].Object_Type "" UBYTE autosar_swc_tos_CM_uint8 0 0 0 255 ECU_ADDRESS 0xfe4b1253 /* @ECU_Address@SwcOut_TOS_AEB[13].Object_Type@ */ /end MEASUREMENT
/begin MEASUREMENT SwcOut_TOS_AEB[13].Object_VX "" FLOAT32_IEEE autosar_swc_tos_CM_single 0 0 -3.4E+38 3.4E+38 ECU_ADDRESS 0xfe4b1288 /* @ECU_Address@SwcOut_TOS_AEB[13].Object_VX@ */ /end MEASUREMENT
/begin MEASUREMENT SwcOut_TOS_AEB[13].Object_VY "" FLOAT32_IEEE autosar_swc_tos_CM_single 0 0 -3.4E+38 3.4E+38 ECU_ADDRESS 0xfe4b128c /* @ECU_Address@SwcOut_TOS_AEB[13].Object_VY@ */ /end MEASUREMENT
/begin MEASUREMENT SwcOut_TOS_AEB[13].Object_Width "" FLOAT32_IEEE autosar_swc_tos_CM_single 0 0 -3.4E+38 3.4E+38 ECU_ADDRESS 0xfe4b1268 /* @ECU_Address@SwcOut_TOS_AEB[13].Object_Width@ */ /end MEASUREMENT
/begin MEASUREMENT SwcOut_TOS_AEB[13].Object_YawAngle "" FLOAT32_IEEE autosar_swc_tos_CM_single 0 0 -3.4E+38 3.4E+38 ECU_ADDRESS 0xfe4b1274 /* @ECU_Address@SwcOut_TOS_AEB[13].Object_YawAngle@ */ /end MEASUREMENT
/begin MEASUREMENT SwcOut_TOS_AEB[13].RightLane_flag "" UBYTE autosar_swc_tos_CM_boolean 0 0 0 1 ECU_ADDRESS 0xfe4b1252 /* @ECU_Address@SwcOut_TOS_AEB[13].RightLane_flag@ */ /end MEASUREMENT
/begin MEASUREMENT SwcOut_TOS_AEB[13].SameLane_flag "" UBYTE autosar_swc_tos_CM_boolean 0 0 0 1 ECU_ADDRESS 0xfe4b1251 /* @ECU_Address@SwcOut_TOS_AEB[13].SameLane_flag@ */ /end MEASUREMENT
/begin MEASUREMENT SwcOut_TOS_AEB[13].Sceniaro_Flag "" UBYTE autosar_swc_tos_CM_uint8 0 0 0 255 ECU_ADDRESS 0xfe4b1257 /* @ECU_Address@SwcOut_TOS_AEB[13].Sceniaro_Flag@ */ /end MEASUREMENT
/begin MEASUREMENT SwcOut_TOS_AEB[13].TimeStamp "" A_UINT64 autosar_swc_tos_CM_uint64 0 0 0 18446744073709551615 ECU_ADDRESS 0xfe4b12e0 /* @ECU_Address@SwcOut_TOS_AEB[13].TimeStamp@ */ /end MEASUREMENT
/begin MEASUREMENT SwcOut_TOS_AEB[13].camID "" ULONG autosar_swc_tos_CM_uint32 0 0 0 4294967295 ECU_ADDRESS 0xfe4b12d0 /* @ECU_Address@SwcOut_TOS_AEB[13].camID@ */ /end MEASUREMENT
/begin MEASUREMENT SwcOut_TOS_AEB[13].corner_left_front_x "" FLOAT32_IEEE autosar_swc_tos_CM_single 0 0 -3.4E+38 3.4E+38 ECU_ADDRESS 0xfe4b12ac /* @ECU_Address@SwcOut_TOS_AEB[13].corner_left_front_x@ */ /end MEASUREMENT
/begin MEASUREMENT SwcOut_TOS_AEB[13].corner_left_front_y "" FLOAT32_IEEE autosar_swc_tos_CM_single 0 0 -3.4E+38 3.4E+38 ECU_ADDRESS 0xfe4b12b0 /* @ECU_Address@SwcOut_TOS_AEB[13].corner_left_front_y@ */ /end MEASUREMENT
/begin MEASUREMENT SwcOut_TOS_AEB[13].corner_left_rear_x "" FLOAT32_IEEE autosar_swc_tos_CM_single 0 0 -3.4E+38 3.4E+38 ECU_ADDRESS 0xfe4b12bc /* @ECU_Address@SwcOut_TOS_AEB[13].corner_left_rear_x@ */ /end MEASUREMENT
/begin MEASUREMENT SwcOut_TOS_AEB[13].corner_left_rear_y "" FLOAT32_IEEE autosar_swc_tos_CM_single 0 0 -3.4E+38 3.4E+38 ECU_ADDRESS 0xfe4b12c0 /* @ECU_Address@SwcOut_TOS_AEB[13].corner_left_rear_y@ */ /end MEASUREMENT
/begin MEASUREMENT SwcOut_TOS_AEB[13].corner_right_front_x "" FLOAT32_IEEE autosar_swc_tos_CM_single 0 0 -3.4E+38 3.4E+38 ECU_ADDRESS 0xfe4b12b4 /* @ECU_Address@SwcOut_TOS_AEB[13].corner_right_front_x@ */ /end MEASUREMENT
/begin MEASUREMENT SwcOut_TOS_AEB[13].corner_right_front_y "" FLOAT32_IEEE autosar_swc_tos_CM_single 0 0 -3.4E+38 3.4E+38 ECU_ADDRESS 0xfe4b12b8 /* @ECU_Address@SwcOut_TOS_AEB[13].corner_right_front_y@ */ /end MEASUREMENT
/begin MEASUREMENT SwcOut_TOS_AEB[13].corner_right_rear_x "" FLOAT32_IEEE autosar_swc_tos_CM_single 0 0 -3.4E+38 3.4E+38 ECU_ADDRESS 0xfe4b12c4 /* @ECU_Address@SwcOut_TOS_AEB[13].corner_right_rear_x@ */ /end MEASUREMENT
/begin MEASUREMENT SwcOut_TOS_AEB[13].corner_right_rear_y "" FLOAT32_IEEE autosar_swc_tos_CM_single 0 0 -3.4E+38 3.4E+38 ECU_ADDRESS 0xfe4b12c8 /* @ECU_Address@SwcOut_TOS_AEB[13].corner_right_rear_y@ */ /end MEASUREMENT
/begin MEASUREMENT SwcOut_TOS_AEB[13].pro_flag "" SLONG autosar_swc_tos_CM_int32 0 0 -2147483648 2147483647 ECU_ADDRESS 0xfe4b1260 /* @ECU_Address@SwcOut_TOS_AEB[13].pro_flag@ */ /end MEASUREMENT
/begin MEASUREMENT SwcOut_TOS_AEB[13].ramp "" UBYTE autosar_swc_tos_CM_uint8 0 0 0 255 ECU_ADDRESS 0xfe4b125b /* @ECU_Address@SwcOut_TOS_AEB[13].ramp@ */ /end MEASUREMENT
/begin MEASUREMENT SwcOut_TOS_AEB[14].CllsnMtgtnByBrkgPrimQly "" UBYTE autosar_swc_tos_CM_uint8 0 0 0 255 ECU_ADDRESS 0xfe4b12f0 /* @ECU_Address@SwcOut_TOS_AEB[14].CllsnMtgtnByBrkgPrimQly@ */ /end MEASUREMENT
/begin MEASUREMENT SwcOut_TOS_AEB[14].CllsnMtgtnByBrkgSecQly "" UBYTE autosar_swc_tos_CM_uint8 0 0 0 255 ECU_ADDRESS 0xfe4b12f1 /* @ECU_Address@SwcOut_TOS_AEB[14].CllsnMtgtnByBrkgSecQly@ */ /end MEASUREMENT
/begin MEASUREMENT SwcOut_TOS_AEB[14].CllsnWarnFwdQly "" UBYTE autosar_swc_tos_CM_uint8 0 0 0 255 ECU_ADDRESS 0xfe4b12f2 /* @ECU_Address@SwcOut_TOS_AEB[14].CllsnWarnFwdQly@ */ /end MEASUREMENT
/begin MEASUREMENT SwcOut_TOS_AEB[14].LeftLane_flag "" UBYTE autosar_swc_tos_CM_boolean 0 0 0 1 ECU_ADDRESS 0xfe4b12e8 /* @ECU_Address@SwcOut_TOS_AEB[14].LeftLane_flag@ */ /end MEASUREMENT
/begin MEASUREMENT SwcOut_TOS_AEB[14].Object_AX "" FLOAT32_IEEE autosar_swc_tos_CM_single 0 0 -3.4E+38 3.4E+38 ECU_ADDRESS 0xfe4b1334 /* @ECU_Address@SwcOut_TOS_AEB[14].Object_AX@ */ /end MEASUREMENT
/begin MEASUREMENT SwcOut_TOS_AEB[14].Object_AY "" FLOAT32_IEEE autosar_swc_tos_CM_single 0 0 -3.4E+38 3.4E+38 ECU_ADDRESS 0xfe4b1338 /* @ECU_Address@SwcOut_TOS_AEB[14].Object_AY@ */ /end MEASUREMENT
/begin MEASUREMENT SwcOut_TOS_AEB[14].Object_Abs_AX "" FLOAT32_IEEE autosar_swc_tos_CM_single 0 0 -3.4E+38 3.4E+38 ECU_ADDRESS 0xfe4b133c /* @ECU_Address@SwcOut_TOS_AEB[14].Object_Abs_AX@ */ /end MEASUREMENT
/begin MEASUREMENT SwcOut_TOS_AEB[14].Object_Abs_AY "" FLOAT32_IEEE autosar_swc_tos_CM_single 0 0 -3.4E+38 3.4E+38 ECU_ADDRESS 0xfe4b1340 /* @ECU_Address@SwcOut_TOS_AEB[14].Object_Abs_AY@ */ /end MEASUREMENT
/begin MEASUREMENT SwcOut_TOS_AEB[14].Object_Abs_SPEED "" FLOAT32_IEEE autosar_swc_tos_CM_single 0 0 -3.4E+38 3.4E+38 ECU_ADDRESS 0xfe4b1328 /* @ECU_Address@SwcOut_TOS_AEB[14].Object_Abs_SPEED@ */ /end MEASUREMENT
/begin MEASUREMENT SwcOut_TOS_AEB[14].Object_Abs_VX "" FLOAT32_IEEE autosar_swc_tos_CM_single 0 0 -3.4E+38 3.4E+38 ECU_ADDRESS 0xfe4b132c /* @ECU_Address@SwcOut_TOS_AEB[14].Object_Abs_VX@ */ /end MEASUREMENT
/begin MEASUREMENT SwcOut_TOS_AEB[14].Object_Abs_VY "" FLOAT32_IEEE autosar_swc_tos_CM_single 0 0 -3.4E+38 3.4E+38 ECU_ADDRESS 0xfe4b1330 /* @ECU_Address@SwcOut_TOS_AEB[14].Object_Abs_VY@ */ /end MEASUREMENT
/begin MEASUREMENT SwcOut_TOS_AEB[14].Object_Age "" A_UINT64 autosar_swc_tos_CM_uint64 0 0 0 18446744073709551615 ECU_ADDRESS 0xfe4b1370 /* @ECU_Address@SwcOut_TOS_AEB[14].Object_Age@ */ /end MEASUREMENT
/begin MEASUREMENT SwcOut_TOS_AEB[14].Object_DX "" FLOAT32_IEEE autosar_swc_tos_CM_single 0 0 -3.4E+38 3.4E+38 ECU_ADDRESS 0xfe4b1310 /* @ECU_Address@SwcOut_TOS_AEB[14].Object_DX@ */ /end MEASUREMENT
/begin MEASUREMENT SwcOut_TOS_AEB[14].Object_DY "" FLOAT32_IEEE autosar_swc_tos_CM_single 0 0 -3.4E+38 3.4E+38 ECU_ADDRESS 0xfe4b1314 /* @ECU_Address@SwcOut_TOS_AEB[14].Object_DY@ */ /end MEASUREMENT
/begin MEASUREMENT SwcOut_TOS_AEB[14].Object_Fus_Type "" UWORD autosar_swc_tos_CM_uint16 0 0 0 65535 ECU_ADDRESS 0xfe4b12f4 /* @ECU_Address@SwcOut_TOS_AEB[14].Object_Fus_Type@ */ /end MEASUREMENT
/begin MEASUREMENT SwcOut_TOS_AEB[14].Object_HeadingAngle "" FLOAT32_IEEE autosar_swc_tos_CM_single 0 0 -3.4E+38 3.4E+38 ECU_ADDRESS 0xfe4b1308 /* @ECU_Address@SwcOut_TOS_AEB[14].Object_HeadingAngle@ */ /end MEASUREMENT
/begin MEASUREMENT SwcOut_TOS_AEB[14].Object_Hight "" FLOAT32_IEEE autosar_swc_tos_CM_single 0 0 -3.4E+38 3.4E+38 ECU_ADDRESS 0xfe4b1304 /* @ECU_Address@SwcOut_TOS_AEB[14].Object_Hight@ */ /end MEASUREMENT
/begin MEASUREMENT SwcOut_TOS_AEB[14].Object_ID "" ULONG autosar_swc_tos_CM_uint32 0 0 0 4294967295 ECU_ADDRESS 0xfe4b1364 /* @ECU_Address@SwcOut_TOS_AEB[14].Object_ID@ */ /end MEASUREMENT
/begin MEASUREMENT SwcOut_TOS_AEB[14].Object_Length "" FLOAT32_IEEE autosar_swc_tos_CM_single 0 0 -3.4E+38 3.4E+38 ECU_ADDRESS 0xfe4b12fc /* @ECU_Address@SwcOut_TOS_AEB[14].Object_Length@ */ /end MEASUREMENT
/begin MEASUREMENT SwcOut_TOS_AEB[14].Object_MovingState "" UBYTE autosar_swc_tos_CM_uint8 0 0 0 255 ECU_ADDRESS 0xfe4b12ec /* @ECU_Address@SwcOut_TOS_AEB[14].Object_MovingState@ */ /end MEASUREMENT
/begin MEASUREMENT SwcOut_TOS_AEB[14].Object_Orientation "" UBYTE autosar_swc_tos_CM_uint8 0 0 0 255 ECU_ADDRESS 0xfe4b12ed /* @ECU_Address@SwcOut_TOS_AEB[14].Object_Orientation@ */ /end MEASUREMENT
/begin MEASUREMENT SwcOut_TOS_AEB[14].Object_RangeX "" FLOAT32_IEEE autosar_swc_tos_CM_single 0 0 -3.4E+38 3.4E+38 ECU_ADDRESS 0xfe4b1318 /* @ECU_Address@SwcOut_TOS_AEB[14].Object_RangeX@ */ /end MEASUREMENT
/begin MEASUREMENT SwcOut_TOS_AEB[14].Object_RangeY "" FLOAT32_IEEE autosar_swc_tos_CM_single 0 0 -3.4E+38 3.4E+38 ECU_ADDRESS 0xfe4b131c /* @ECU_Address@SwcOut_TOS_AEB[14].Object_RangeY@ */ /end MEASUREMENT
/begin MEASUREMENT SwcOut_TOS_AEB[14].Object_Turn_Signal "" UBYTE autosar_swc_tos_CM_uint8 0 0 0 255 ECU_ADDRESS 0xfe4b12ee /* @ECU_Address@SwcOut_TOS_AEB[14].Object_Turn_Signal@ */ /end MEASUREMENT
/begin MEASUREMENT SwcOut_TOS_AEB[14].Object_Type "" UBYTE autosar_swc_tos_CM_uint8 0 0 0 255 ECU_ADDRESS 0xfe4b12eb /* @ECU_Address@SwcOut_TOS_AEB[14].Object_Type@ */ /end MEASUREMENT
/begin MEASUREMENT SwcOut_TOS_AEB[14].Object_VX "" FLOAT32_IEEE autosar_swc_tos_CM_single 0 0 -3.4E+38 3.4E+38 ECU_ADDRESS 0xfe4b1320 /* @ECU_Address@SwcOut_TOS_AEB[14].Object_VX@ */ /end MEASUREMENT
/begin MEASUREMENT SwcOut_TOS_AEB[14].Object_VY "" FLOAT32_IEEE autosar_swc_tos_CM_single 0 0 -3.4E+38 3.4E+38 ECU_ADDRESS 0xfe4b1324 /* @ECU_Address@SwcOut_TOS_AEB[14].Object_VY@ */ /end MEASUREMENT
/begin MEASUREMENT SwcOut_TOS_AEB[14].Object_Width "" FLOAT32_IEEE autosar_swc_tos_CM_single 0 0 -3.4E+38 3.4E+38 ECU_ADDRESS 0xfe4b1300 /* @ECU_Address@SwcOut_TOS_AEB[14].Object_Width@ */ /end MEASUREMENT
/begin MEASUREMENT SwcOut_TOS_AEB[14].Object_YawAngle "" FLOAT32_IEEE autosar_swc_tos_CM_single 0 0 -3.4E+38 3.4E+38 ECU_ADDRESS 0xfe4b130c /* @ECU_Address@SwcOut_TOS_AEB[14].Object_YawAngle@ */ /end MEASUREMENT
/begin MEASUREMENT SwcOut_TOS_AEB[14].RightLane_flag "" UBYTE autosar_swc_tos_CM_boolean 0 0 0 1 ECU_ADDRESS 0xfe4b12ea /* @ECU_Address@SwcOut_TOS_AEB[14].RightLane_flag@ */ /end MEASUREMENT
/begin MEASUREMENT SwcOut_TOS_AEB[14].SameLane_flag "" UBYTE autosar_swc_tos_CM_boolean 0 0 0 1 ECU_ADDRESS 0xfe4b12e9 /* @ECU_Address@SwcOut_TOS_AEB[14].SameLane_flag@ */ /end MEASUREMENT
/begin MEASUREMENT SwcOut_TOS_AEB[14].Sceniaro_Flag "" UBYTE autosar_swc_tos_CM_uint8 0 0 0 255 ECU_ADDRESS 0xfe4b12ef /* @ECU_Address@SwcOut_TOS_AEB[14].Sceniaro_Flag@ */ /end MEASUREMENT
/begin MEASUREMENT SwcOut_TOS_AEB[14].TimeStamp "" A_UINT64 autosar_swc_tos_CM_uint64 0 0 0 18446744073709551615 ECU_ADDRESS 0xfe4b1378 /* @ECU_Address@SwcOut_TOS_AEB[14].TimeStamp@ */ /end MEASUREMENT
/begin MEASUREMENT SwcOut_TOS_AEB[14].camID "" ULONG autosar_swc_tos_CM_uint32 0 0 0 4294967295 ECU_ADDRESS 0xfe4b1368 /* @ECU_Address@SwcOut_TOS_AEB[14].camID@ */ /end MEASUREMENT
/begin MEASUREMENT SwcOut_TOS_AEB[14].corner_left_front_x "" FLOAT32_IEEE autosar_swc_tos_CM_single 0 0 -3.4E+38 3.4E+38 ECU_ADDRESS 0xfe4b1344 /* @ECU_Address@SwcOut_TOS_AEB[14].corner_left_front_x@ */ /end MEASUREMENT
/begin MEASUREMENT SwcOut_TOS_AEB[14].corner_left_front_y "" FLOAT32_IEEE autosar_swc_tos_CM_single 0 0 -3.4E+38 3.4E+38 ECU_ADDRESS 0xfe4b1348 /* @ECU_Address@SwcOut_TOS_AEB[14].corner_left_front_y@ */ /end MEASUREMENT
/begin MEASUREMENT SwcOut_TOS_AEB[14].corner_left_rear_x "" FLOAT32_IEEE autosar_swc_tos_CM_single 0 0 -3.4E+38 3.4E+38 ECU_ADDRESS 0xfe4b1354 /* @ECU_Address@SwcOut_TOS_AEB[14].corner_left_rear_x@ */ /end MEASUREMENT
/begin MEASUREMENT SwcOut_TOS_AEB[14].corner_left_rear_y "" FLOAT32_IEEE autosar_swc_tos_CM_single 0 0 -3.4E+38 3.4E+38 ECU_ADDRESS 0xfe4b1358 /* @ECU_Address@SwcOut_TOS_AEB[14].corner_left_rear_y@ */ /end MEASUREMENT
/begin MEASUREMENT SwcOut_TOS_AEB[14].corner_right_front_x "" FLOAT32_IEEE autosar_swc_tos_CM_single 0 0 -3.4E+38 3.4E+38 ECU_ADDRESS 0xfe4b134c /* @ECU_Address@SwcOut_TOS_AEB[14].corner_right_front_x@ */ /end MEASUREMENT
/begin MEASUREMENT SwcOut_TOS_AEB[14].corner_right_front_y "" FLOAT32_IEEE autosar_swc_tos_CM_single 0 0 -3.4E+38 3.4E+38 ECU_ADDRESS 0xfe4b1350 /* @ECU_Address@SwcOut_TOS_AEB[14].corner_right_front_y@ */ /end MEASUREMENT
/begin MEASUREMENT SwcOut_TOS_AEB[14].corner_right_rear_x "" FLOAT32_IEEE autosar_swc_tos_CM_single 0 0 -3.4E+38 3.4E+38 ECU_ADDRESS 0xfe4b135c /* @ECU_Address@SwcOut_TOS_AEB[14].corner_right_rear_x@ */ /end MEASUREMENT
/begin MEASUREMENT SwcOut_TOS_AEB[14].corner_right_rear_y "" FLOAT32_IEEE autosar_swc_tos_CM_single 0 0 -3.4E+38 3.4E+38 ECU_ADDRESS 0xfe4b1360 /* @ECU_Address@SwcOut_TOS_AEB[14].corner_right_rear_y@ */ /end MEASUREMENT
/begin MEASUREMENT SwcOut_TOS_AEB[14].pro_flag "" SLONG autosar_swc_tos_CM_int32 0 0 -2147483648 2147483647 ECU_ADDRESS 0xfe4b12f8 /* @ECU_Address@SwcOut_TOS_AEB[14].pro_flag@ */ /end MEASUREMENT
/begin MEASUREMENT SwcOut_TOS_AEB[14].ramp "" UBYTE autosar_swc_tos_CM_uint8 0 0 0 255 ECU_ADDRESS 0xfe4b12f3 /* @ECU_Address@SwcOut_TOS_AEB[14].ramp@ */ /end MEASUREMENT
/begin MEASUREMENT SwcOut_TOS_AEB[15].CllsnMtgtnByBrkgPrimQly "" UBYTE autosar_swc_tos_CM_uint8 0 0 0 255 ECU_ADDRESS 0xfe4b1388 /* @ECU_Address@SwcOut_TOS_AEB[15].CllsnMtgtnByBrkgPrimQly@ */ /end MEASUREMENT
/begin MEASUREMENT SwcOut_TOS_AEB[15].CllsnMtgtnByBrkgSecQly "" UBYTE autosar_swc_tos_CM_uint8 0 0 0 255 ECU_ADDRESS 0xfe4b1389 /* @ECU_Address@SwcOut_TOS_AEB[15].CllsnMtgtnByBrkgSecQly@ */ /end MEASUREMENT
/begin MEASUREMENT SwcOut_TOS_AEB[15].CllsnWarnFwdQly "" UBYTE autosar_swc_tos_CM_uint8 0 0 0 255 ECU_ADDRESS 0xfe4b138a /* @ECU_Address@SwcOut_TOS_AEB[15].CllsnWarnFwdQly@ */ /end MEASUREMENT
/begin MEASUREMENT SwcOut_TOS_AEB[15].LeftLane_flag "" UBYTE autosar_swc_tos_CM_boolean 0 0 0 1 ECU_ADDRESS 0xfe4b1380 /* @ECU_Address@SwcOut_TOS_AEB[15].LeftLane_flag@ */ /end MEASUREMENT
/begin MEASUREMENT SwcOut_TOS_AEB[15].Object_AX "" FLOAT32_IEEE autosar_swc_tos_CM_single 0 0 -3.4E+38 3.4E+38 ECU_ADDRESS 0xfe4b13cc /* @ECU_Address@SwcOut_TOS_AEB[15].Object_AX@ */ /end MEASUREMENT
/begin MEASUREMENT SwcOut_TOS_AEB[15].Object_AY "" FLOAT32_IEEE autosar_swc_tos_CM_single 0 0 -3.4E+38 3.4E+38 ECU_ADDRESS 0xfe4b13d0 /* @ECU_Address@SwcOut_TOS_AEB[15].Object_AY@ */ /end MEASUREMENT
/begin MEASUREMENT SwcOut_TOS_AEB[15].Object_Abs_AX "" FLOAT32_IEEE autosar_swc_tos_CM_single 0 0 -3.4E+38 3.4E+38 ECU_ADDRESS 0xfe4b13d4 /* @ECU_Address@SwcOut_TOS_AEB[15].Object_Abs_AX@ */ /end MEASUREMENT
/begin MEASUREMENT SwcOut_TOS_AEB[15].Object_Abs_AY "" FLOAT32_IEEE autosar_swc_tos_CM_single 0 0 -3.4E+38 3.4E+38 ECU_ADDRESS 0xfe4b13d8 /* @ECU_Address@SwcOut_TOS_AEB[15].Object_Abs_AY@ */ /end MEASUREMENT
/begin MEASUREMENT SwcOut_TOS_AEB[15].Object_Abs_SPEED "" FLOAT32_IEEE autosar_swc_tos_CM_single 0 0 -3.4E+38 3.4E+38 ECU_ADDRESS 0xfe4b13c0 /* @ECU_Address@SwcOut_TOS_AEB[15].Object_Abs_SPEED@ */ /end MEASUREMENT
/begin MEASUREMENT SwcOut_TOS_AEB[15].Object_Abs_VX "" FLOAT32_IEEE autosar_swc_tos_CM_single 0 0 -3.4E+38 3.4E+38 ECU_ADDRESS 0xfe4b13c4 /* @ECU_Address@SwcOut_TOS_AEB[15].Object_Abs_VX@ */ /end MEASUREMENT
/begin MEASUREMENT SwcOut_TOS_AEB[15].Object_Abs_VY "" FLOAT32_IEEE autosar_swc_tos_CM_single 0 0 -3.4E+38 3.4E+38 ECU_ADDRESS 0xfe4b13c8 /* @ECU_Address@SwcOut_TOS_AEB[15].Object_Abs_VY@ */ /end MEASUREMENT
/begin MEASUREMENT SwcOut_TOS_AEB[15].Object_Age "" A_UINT64 autosar_swc_tos_CM_uint64 0 0 0 18446744073709551615 ECU_ADDRESS 0xfe4b1408 /* @ECU_Address@SwcOut_TOS_AEB[15].Object_Age@ */ /end MEASUREMENT
/begin MEASUREMENT SwcOut_TOS_AEB[15].Object_DX "" FLOAT32_IEEE autosar_swc_tos_CM_single 0 0 -3.4E+38 3.4E+38 ECU_ADDRESS 0xfe4b13a8 /* @ECU_Address@SwcOut_TOS_AEB[15].Object_DX@ */ /end MEASUREMENT
/begin MEASUREMENT SwcOut_TOS_AEB[15].Object_DY "" FLOAT32_IEEE autosar_swc_tos_CM_single 0 0 -3.4E+38 3.4E+38 ECU_ADDRESS 0xfe4b13ac /* @ECU_Address@SwcOut_TOS_AEB[15].Object_DY@ */ /end MEASUREMENT
/begin MEASUREMENT SwcOut_TOS_AEB[15].Object_Fus_Type "" UWORD autosar_swc_tos_CM_uint16 0 0 0 65535 ECU_ADDRESS 0xfe4b138c /* @ECU_Address@SwcOut_TOS_AEB[15].Object_Fus_Type@ */ /end MEASUREMENT
/begin MEASUREMENT SwcOut_TOS_AEB[15].Object_HeadingAngle "" FLOAT32_IEEE autosar_swc_tos_CM_single 0 0 -3.4E+38 3.4E+38 ECU_ADDRESS 0xfe4b13a0 /* @ECU_Address@SwcOut_TOS_AEB[15].Object_HeadingAngle@ */ /end MEASUREMENT
/begin MEASUREMENT SwcOut_TOS_AEB[15].Object_Hight "" FLOAT32_IEEE autosar_swc_tos_CM_single 0 0 -3.4E+38 3.4E+38 ECU_ADDRESS 0xfe4b139c /* @ECU_Address@SwcOut_TOS_AEB[15].Object_Hight@ */ /end MEASUREMENT
/begin MEASUREMENT SwcOut_TOS_AEB[15].Object_ID "" ULONG autosar_swc_tos_CM_uint32 0 0 0 4294967295 ECU_ADDRESS 0xfe4b13fc /* @ECU_Address@SwcOut_TOS_AEB[15].Object_ID@ */ /end MEASUREMENT
/begin MEASUREMENT SwcOut_TOS_AEB[15].Object_Length "" FLOAT32_IEEE autosar_swc_tos_CM_single 0 0 -3.4E+38 3.4E+38 ECU_ADDRESS 0xfe4b1394 /* @ECU_Address@SwcOut_TOS_AEB[15].Object_Length@ */ /end MEASUREMENT
/begin MEASUREMENT SwcOut_TOS_AEB[15].Object_MovingState "" UBYTE autosar_swc_tos_CM_uint8 0 0 0 255 ECU_ADDRESS 0xfe4b1384 /* @ECU_Address@SwcOut_TOS_AEB[15].Object_MovingState@ */ /end MEASUREMENT
/begin MEASUREMENT SwcOut_TOS_AEB[15].Object_Orientation "" UBYTE autosar_swc_tos_CM_uint8 0 0 0 255 ECU_ADDRESS 0xfe4b1385 /* @ECU_Address@SwcOut_TOS_AEB[15].Object_Orientation@ */ /end MEASUREMENT
/begin MEASUREMENT SwcOut_TOS_AEB[15].Object_RangeX "" FLOAT32_IEEE autosar_swc_tos_CM_single 0 0 -3.4E+38 3.4E+38 ECU_ADDRESS 0xfe4b13b0 /* @ECU_Address@SwcOut_TOS_AEB[15].Object_RangeX@ */ /end MEASUREMENT
/begin MEASUREMENT SwcOut_TOS_AEB[15].Object_RangeY "" FLOAT32_IEEE autosar_swc_tos_CM_single 0 0 -3.4E+38 3.4E+38 ECU_ADDRESS 0xfe4b13b4 /* @ECU_Address@SwcOut_TOS_AEB[15].Object_RangeY@ */ /end MEASUREMENT
/begin MEASUREMENT SwcOut_TOS_AEB[15].Object_Turn_Signal "" UBYTE autosar_swc_tos_CM_uint8 0 0 0 255 ECU_ADDRESS 0xfe4b1386 /* @ECU_Address@SwcOut_TOS_AEB[15].Object_Turn_Signal@ */ /end MEASUREMENT
/begin MEASUREMENT SwcOut_TOS_AEB[15].Object_Type "" UBYTE autosar_swc_tos_CM_uint8 0 0 0 255 ECU_ADDRESS 0xfe4b1383 /* @ECU_Address@SwcOut_TOS_AEB[15].Object_Type@ */ /end MEASUREMENT
/begin MEASUREMENT SwcOut_TOS_AEB[15].Object_VX "" FLOAT32_IEEE autosar_swc_tos_CM_single 0 0 -3.4E+38 3.4E+38 ECU_ADDRESS 0xfe4b13b8 /* @ECU_Address@SwcOut_TOS_AEB[15].Object_VX@ */ /end MEASUREMENT
/begin MEASUREMENT SwcOut_TOS_AEB[15].Object_VY "" FLOAT32_IEEE autosar_swc_tos_CM_single 0 0 -3.4E+38 3.4E+38 ECU_ADDRESS 0xfe4b13bc /* @ECU_Address@SwcOut_TOS_AEB[15].Object_VY@ */ /end MEASUREMENT
/begin MEASUREMENT SwcOut_TOS_AEB[15].Object_Width "" FLOAT32_IEEE autosar_swc_tos_CM_single 0 0 -3.4E+38 3.4E+38 ECU_ADDRESS 0xfe4b1398 /* @ECU_Address@SwcOut_TOS_AEB[15].Object_Width@ */ /end MEASUREMENT
/begin MEASUREMENT SwcOut_TOS_AEB[15].Object_YawAngle "" FLOAT32_IEEE autosar_swc_tos_CM_single 0 0 -3.4E+38 3.4E+38 ECU_ADDRESS 0xfe4b13a4 /* @ECU_Address@SwcOut_TOS_AEB[15].Object_YawAngle@ */ /end MEASUREMENT
/begin MEASUREMENT SwcOut_TOS_AEB[15].RightLane_flag "" UBYTE autosar_swc_tos_CM_boolean 0 0 0 1 ECU_ADDRESS 0xfe4b1382 /* @ECU_Address@SwcOut_TOS_AEB[15].RightLane_flag@ */ /end MEASUREMENT
/begin MEASUREMENT SwcOut_TOS_AEB[15].SameLane_flag "" UBYTE autosar_swc_tos_CM_boolean 0 0 0 1 ECU_ADDRESS 0xfe4b1381 /* @ECU_Address@SwcOut_TOS_AEB[15].SameLane_flag@ */ /end MEASUREMENT
/begin MEASUREMENT SwcOut_TOS_AEB[15].Sceniaro_Flag "" UBYTE autosar_swc_tos_CM_uint8 0 0 0 255 ECU_ADDRESS 0xfe4b1387 /* @ECU_Address@SwcOut_TOS_AEB[15].Sceniaro_Flag@ */ /end MEASUREMENT
/begin MEASUREMENT SwcOut_TOS_AEB[15].TimeStamp "" A_UINT64 autosar_swc_tos_CM_uint64 0 0 0 18446744073709551615 ECU_ADDRESS 0xfe4b1410 /* @ECU_Address@SwcOut_TOS_AEB[15].TimeStamp@ */ /end MEASUREMENT
/begin MEASUREMENT SwcOut_TOS_AEB[15].camID "" ULONG autosar_swc_tos_CM_uint32 0 0 0 4294967295 ECU_ADDRESS 0xfe4b1400 /* @ECU_Address@SwcOut_TOS_AEB[15].camID@ */ /end MEASUREMENT
/begin MEASUREMENT SwcOut_TOS_AEB[15].corner_left_front_x "" FLOAT32_IEEE autosar_swc_tos_CM_single 0 0 -3.4E+38 3.4E+38 ECU_ADDRESS 0xfe4b13dc /* @ECU_Address@SwcOut_TOS_AEB[15].corner_left_front_x@ */ /end MEASUREMENT
/begin MEASUREMENT SwcOut_TOS_AEB[15].corner_left_front_y "" FLOAT32_IEEE autosar_swc_tos_CM_single 0 0 -3.4E+38 3.4E+38 ECU_ADDRESS 0xfe4b13e0 /* @ECU_Address@SwcOut_TOS_AEB[15].corner_left_front_y@ */ /end MEASUREMENT
/begin MEASUREMENT SwcOut_TOS_AEB[15].corner_left_rear_x "" FLOAT32_IEEE autosar_swc_tos_CM_single 0 0 -3.4E+38 3.4E+38 ECU_ADDRESS 0xfe4b13ec /* @ECU_Address@SwcOut_TOS_AEB[15].corner_left_rear_x@ */ /end MEASUREMENT
/begin MEASUREMENT SwcOut_TOS_AEB[15].corner_left_rear_y "" FLOAT32_IEEE autosar_swc_tos_CM_single 0 0 -3.4E+38 3.4E+38 ECU_ADDRESS 0xfe4b13f0 /* @ECU_Address@SwcOut_TOS_AEB[15].corner_left_rear_y@ */ /end MEASUREMENT
/begin MEASUREMENT SwcOut_TOS_AEB[15].corner_right_front_x "" FLOAT32_IEEE autosar_swc_tos_CM_single 0 0 -3.4E+38 3.4E+38 ECU_ADDRESS 0xfe4b13e4 /* @ECU_Address@SwcOut_TOS_AEB[15].corner_right_front_x@ */ /end MEASUREMENT
/begin MEASUREMENT SwcOut_TOS_AEB[15].corner_right_front_y "" FLOAT32_IEEE autosar_swc_tos_CM_single 0 0 -3.4E+38 3.4E+38 ECU_ADDRESS 0xfe4b13e8 /* @ECU_Address@SwcOut_TOS_AEB[15].corner_right_front_y@ */ /end MEASUREMENT
/begin MEASUREMENT SwcOut_TOS_AEB[15].corner_right_rear_x "" FLOAT32_IEEE autosar_swc_tos_CM_single 0 0 -3.4E+38 3.4E+38 ECU_ADDRESS 0xfe4b13f4 /* @ECU_Address@SwcOut_TOS_AEB[15].corner_right_rear_x@ */ /end MEASUREMENT
/begin MEASUREMENT SwcOut_TOS_AEB[15].corner_right_rear_y "" FLOAT32_IEEE autosar_swc_tos_CM_single 0 0 -3.4E+38 3.4E+38 ECU_ADDRESS 0xfe4b13f8 /* @ECU_Address@SwcOut_TOS_AEB[15].corner_right_rear_y@ */ /end MEASUREMENT
/begin MEASUREMENT SwcOut_TOS_AEB[15].pro_flag "" SLONG autosar_swc_tos_CM_int32 0 0 -2147483648 2147483647 ECU_ADDRESS 0xfe4b1390 /* @ECU_Address@SwcOut_TOS_AEB[15].pro_flag@ */ /end MEASUREMENT
/begin MEASUREMENT SwcOut_TOS_AEB[15].ramp "" UBYTE autosar_swc_tos_CM_uint8 0 0 0 255 ECU_ADDRESS 0xfe4b138b /* @ECU_Address@SwcOut_TOS_AEB[15].ramp@ */ /end MEASUREMENT
/begin MEASUREMENT SwcOut_TOS_AEB[16].CllsnMtgtnByBrkgPrimQly "" UBYTE autosar_swc_tos_CM_uint8 0 0 0 255 ECU_ADDRESS 0xfe4b1420 /* @ECU_Address@SwcOut_TOS_AEB[16].CllsnMtgtnByBrkgPrimQly@ */ /end MEASUREMENT
/begin MEASUREMENT SwcOut_TOS_AEB[16].CllsnMtgtnByBrkgSecQly "" UBYTE autosar_swc_tos_CM_uint8 0 0 0 255 ECU_ADDRESS 0xfe4b1421 /* @ECU_Address@SwcOut_TOS_AEB[16].CllsnMtgtnByBrkgSecQly@ */ /end MEASUREMENT
/begin MEASUREMENT SwcOut_TOS_AEB[16].CllsnWarnFwdQly "" UBYTE autosar_swc_tos_CM_uint8 0 0 0 255 ECU_ADDRESS 0xfe4b1422 /* @ECU_Address@SwcOut_TOS_AEB[16].CllsnWarnFwdQly@ */ /end MEASUREMENT
/begin MEASUREMENT SwcOut_TOS_AEB[16].LeftLane_flag "" UBYTE autosar_swc_tos_CM_boolean 0 0 0 1 ECU_ADDRESS 0xfe4b1418 /* @ECU_Address@SwcOut_TOS_AEB[16].LeftLane_flag@ */ /end MEASUREMENT
/begin MEASUREMENT SwcOut_TOS_AEB[16].Object_AX "" FLOAT32_IEEE autosar_swc_tos_CM_single 0 0 -3.4E+38 3.4E+38 ECU_ADDRESS 0xfe4b1464 /* @ECU_Address@SwcOut_TOS_AEB[16].Object_AX@ */ /end MEASUREMENT
/begin MEASUREMENT SwcOut_TOS_AEB[16].Object_AY "" FLOAT32_IEEE autosar_swc_tos_CM_single 0 0 -3.4E+38 3.4E+38 ECU_ADDRESS 0xfe4b1468 /* @ECU_Address@SwcOut_TOS_AEB[16].Object_AY@ */ /end MEASUREMENT
/begin MEASUREMENT SwcOut_TOS_AEB[16].Object_Abs_AX "" FLOAT32_IEEE autosar_swc_tos_CM_single 0 0 -3.4E+38 3.4E+38 ECU_ADDRESS 0xfe4b146c /* @ECU_Address@SwcOut_TOS_AEB[16].Object_Abs_AX@ */ /end MEASUREMENT
/begin MEASUREMENT SwcOut_TOS_AEB[16].Object_Abs_AY "" FLOAT32_IEEE autosar_swc_tos_CM_single 0 0 -3.4E+38 3.4E+38 ECU_ADDRESS 0xfe4b1470 /* @ECU_Address@SwcOut_TOS_AEB[16].Object_Abs_AY@ */ /end MEASUREMENT
/begin MEASUREMENT SwcOut_TOS_AEB[16].Object_Abs_SPEED "" FLOAT32_IEEE autosar_swc_tos_CM_single 0 0 -3.4E+38 3.4E+38 ECU_ADDRESS 0xfe4b1458 /* @ECU_Address@SwcOut_TOS_AEB[16].Object_Abs_SPEED@ */ /end MEASUREMENT
/begin MEASUREMENT SwcOut_TOS_AEB[16].Object_Abs_VX "" FLOAT32_IEEE autosar_swc_tos_CM_single 0 0 -3.4E+38 3.4E+38 ECU_ADDRESS 0xfe4b145c /* @ECU_Address@SwcOut_TOS_AEB[16].Object_Abs_VX@ */ /end MEASUREMENT
/begin MEASUREMENT SwcOut_TOS_AEB[16].Object_Abs_VY "" FLOAT32_IEEE autosar_swc_tos_CM_single 0 0 -3.4E+38 3.4E+38 ECU_ADDRESS 0xfe4b1460 /* @ECU_Address@SwcOut_TOS_AEB[16].Object_Abs_VY@ */ /end MEASUREMENT
/begin MEASUREMENT SwcOut_TOS_AEB[16].Object_Age "" A_UINT64 autosar_swc_tos_CM_uint64 0 0 0 18446744073709551615 ECU_ADDRESS 0xfe4b14a0 /* @ECU_Address@SwcOut_TOS_AEB[16].Object_Age@ */ /end MEASUREMENT
/begin MEASUREMENT SwcOut_TOS_AEB[16].Object_DX "" FLOAT32_IEEE autosar_swc_tos_CM_single 0 0 -3.4E+38 3.4E+38 ECU_ADDRESS 0xfe4b1440 /* @ECU_Address@SwcOut_TOS_AEB[16].Object_DX@ */ /end MEASUREMENT
/begin MEASUREMENT SwcOut_TOS_AEB[16].Object_DY "" FLOAT32_IEEE autosar_swc_tos_CM_single 0 0 -3.4E+38 3.4E+38 ECU_ADDRESS 0xfe4b1444 /* @ECU_Address@SwcOut_TOS_AEB[16].Object_DY@ */ /end MEASUREMENT
/begin MEASUREMENT SwcOut_TOS_AEB[16].Object_Fus_Type "" UWORD autosar_swc_tos_CM_uint16 0 0 0 65535 ECU_ADDRESS 0xfe4b1424 /* @ECU_Address@SwcOut_TOS_AEB[16].Object_Fus_Type@ */ /end MEASUREMENT
/begin MEASUREMENT SwcOut_TOS_AEB[16].Object_HeadingAngle "" FLOAT32_IEEE autosar_swc_tos_CM_single 0 0 -3.4E+38 3.4E+38 ECU_ADDRESS 0xfe4b1438 /* @ECU_Address@SwcOut_TOS_AEB[16].Object_HeadingAngle@ */ /end MEASUREMENT
/begin MEASUREMENT SwcOut_TOS_AEB[16].Object_Hight "" FLOAT32_IEEE autosar_swc_tos_CM_single 0 0 -3.4E+38 3.4E+38 ECU_ADDRESS 0xfe4b1434 /* @ECU_Address@SwcOut_TOS_AEB[16].Object_Hight@ */ /end MEASUREMENT
/begin MEASUREMENT SwcOut_TOS_AEB[16].Object_ID "" ULONG autosar_swc_tos_CM_uint32 0 0 0 4294967295 ECU_ADDRESS 0xfe4b1494 /* @ECU_Address@SwcOut_TOS_AEB[16].Object_ID@ */ /end MEASUREMENT
/begin MEASUREMENT SwcOut_TOS_AEB[16].Object_Length "" FLOAT32_IEEE autosar_swc_tos_CM_single 0 0 -3.4E+38 3.4E+38 ECU_ADDRESS 0xfe4b142c /* @ECU_Address@SwcOut_TOS_AEB[16].Object_Length@ */ /end MEASUREMENT
/begin MEASUREMENT SwcOut_TOS_AEB[16].Object_MovingState "" UBYTE autosar_swc_tos_CM_uint8 0 0 0 255 ECU_ADDRESS 0xfe4b141c /* @ECU_Address@SwcOut_TOS_AEB[16].Object_MovingState@ */ /end MEASUREMENT
/begin MEASUREMENT SwcOut_TOS_AEB[16].Object_Orientation "" UBYTE autosar_swc_tos_CM_uint8 0 0 0 255 ECU_ADDRESS 0xfe4b141d /* @ECU_Address@SwcOut_TOS_AEB[16].Object_Orientation@ */ /end MEASUREMENT
/begin MEASUREMENT SwcOut_TOS_AEB[16].Object_RangeX "" FLOAT32_IEEE autosar_swc_tos_CM_single 0 0 -3.4E+38 3.4E+38 ECU_ADDRESS 0xfe4b1448 /* @ECU_Address@SwcOut_TOS_AEB[16].Object_RangeX@ */ /end MEASUREMENT
/begin MEASUREMENT SwcOut_TOS_AEB[16].Object_RangeY "" FLOAT32_IEEE autosar_swc_tos_CM_single 0 0 -3.4E+38 3.4E+38 ECU_ADDRESS 0xfe4b144c /* @ECU_Address@SwcOut_TOS_AEB[16].Object_RangeY@ */ /end MEASUREMENT
/begin MEASUREMENT SwcOut_TOS_AEB[16].Object_Turn_Signal "" UBYTE autosar_swc_tos_CM_uint8 0 0 0 255 ECU_ADDRESS 0xfe4b141e /* @ECU_Address@SwcOut_TOS_AEB[16].Object_Turn_Signal@ */ /end MEASUREMENT
/begin MEASUREMENT SwcOut_TOS_AEB[16].Object_Type "" UBYTE autosar_swc_tos_CM_uint8 0 0 0 255 ECU_ADDRESS 0xfe4b141b /* @ECU_Address@SwcOut_TOS_AEB[16].Object_Type@ */ /end MEASUREMENT
/begin MEASUREMENT SwcOut_TOS_AEB[16].Object_VX "" FLOAT32_IEEE autosar_swc_tos_CM_single 0 0 -3.4E+38 3.4E+38 ECU_ADDRESS 0xfe4b1450 /* @ECU_Address@SwcOut_TOS_AEB[16].Object_VX@ */ /end MEASUREMENT
/begin MEASUREMENT SwcOut_TOS_AEB[16].Object_VY "" FLOAT32_IEEE autosar_swc_tos_CM_single 0 0 -3.4E+38 3.4E+38 ECU_ADDRESS 0xfe4b1454 /* @ECU_Address@SwcOut_TOS_AEB[16].Object_VY@ */ /end MEASUREMENT
/begin MEASUREMENT SwcOut_TOS_AEB[16].Object_Width "" FLOAT32_IEEE autosar_swc_tos_CM_single 0 0 -3.4E+38 3.4E+38 ECU_ADDRESS 0xfe4b1430 /* @ECU_Address@SwcOut_TOS_AEB[16].Object_Width@ */ /end MEASUREMENT
/begin MEASUREMENT SwcOut_TOS_AEB[16].Object_YawAngle "" FLOAT32_IEEE autosar_swc_tos_CM_single 0 0 -3.4E+38 3.4E+38 ECU_ADDRESS 0xfe4b143c /* @ECU_Address@SwcOut_TOS_AEB[16].Object_YawAngle@ */ /end MEASUREMENT
/begin MEASUREMENT SwcOut_TOS_AEB[16].RightLane_flag "" UBYTE autosar_swc_tos_CM_boolean 0 0 0 1 ECU_ADDRESS 0xfe4b141a /* @ECU_Address@SwcOut_TOS_AEB[16].RightLane_flag@ */ /end MEASUREMENT
/begin MEASUREMENT SwcOut_TOS_AEB[16].SameLane_flag "" UBYTE autosar_swc_tos_CM_boolean 0 0 0 1 ECU_ADDRESS 0xfe4b1419 /* @ECU_Address@SwcOut_TOS_AEB[16].SameLane_flag@ */ /end MEASUREMENT
/begin MEASUREMENT SwcOut_TOS_AEB[16].Sceniaro_Flag "" UBYTE autosar_swc_tos_CM_uint8 0 0 0 255 ECU_ADDRESS 0xfe4b141f /* @ECU_Address@SwcOut_TOS_AEB[16].Sceniaro_Flag@ */ /end MEASUREMENT
/begin MEASUREMENT SwcOut_TOS_AEB[16].TimeStamp "" A_UINT64 autosar_swc_tos_CM_uint64 0 0 0 18446744073709551615 ECU_ADDRESS 0xfe4b14a8 /* @ECU_Address@SwcOut_TOS_AEB[16].TimeStamp@ */ /end MEASUREMENT
/begin MEASUREMENT SwcOut_TOS_AEB[16].camID "" ULONG autosar_swc_tos_CM_uint32 0 0 0 4294967295 ECU_ADDRESS 0xfe4b1498 /* @ECU_Address@SwcOut_TOS_AEB[16].camID@ */ /end MEASUREMENT
/begin MEASUREMENT SwcOut_TOS_AEB[16].corner_left_front_x "" FLOAT32_IEEE autosar_swc_tos_CM_single 0 0 -3.4E+38 3.4E+38 ECU_ADDRESS 0xfe4b1474 /* @ECU_Address@SwcOut_TOS_AEB[16].corner_left_front_x@ */ /end MEASUREMENT
/begin MEASUREMENT SwcOut_TOS_AEB[16].corner_left_front_y "" FLOAT32_IEEE autosar_swc_tos_CM_single 0 0 -3.4E+38 3.4E+38 ECU_ADDRESS 0xfe4b1478 /* @ECU_Address@SwcOut_TOS_AEB[16].corner_left_front_y@ */ /end MEASUREMENT
/begin MEASUREMENT SwcOut_TOS_AEB[16].corner_left_rear_x "" FLOAT32_IEEE autosar_swc_tos_CM_single 0 0 -3.4E+38 3.4E+38 ECU_ADDRESS 0xfe4b1484 /* @ECU_Address@SwcOut_TOS_AEB[16].corner_left_rear_x@ */ /end MEASUREMENT
/begin MEASUREMENT SwcOut_TOS_AEB[16].corner_left_rear_y "" FLOAT32_IEEE autosar_swc_tos_CM_single 0 0 -3.4E+38 3.4E+38 ECU_ADDRESS 0xfe4b1488 /* @ECU_Address@SwcOut_TOS_AEB[16].corner_left_rear_y@ */ /end MEASUREMENT
/begin MEASUREMENT SwcOut_TOS_AEB[16].corner_right_front_x "" FLOAT32_IEEE autosar_swc_tos_CM_single 0 0 -3.4E+38 3.4E+38 ECU_ADDRESS 0xfe4b147c /* @ECU_Address@SwcOut_TOS_AEB[16].corner_right_front_x@ */ /end MEASUREMENT
/begin MEASUREMENT SwcOut_TOS_AEB[16].corner_right_front_y "" FLOAT32_IEEE autosar_swc_tos_CM_single 0 0 -3.4E+38 3.4E+38 ECU_ADDRESS 0xfe4b1480 /* @ECU_Address@SwcOut_TOS_AEB[16].corner_right_front_y@ */ /end MEASUREMENT
/begin MEASUREMENT SwcOut_TOS_AEB[16].corner_right_rear_x "" FLOAT32_IEEE autosar_swc_tos_CM_single 0 0 -3.4E+38 3.4E+38 ECU_ADDRESS 0xfe4b148c /* @ECU_Address@SwcOut_TOS_AEB[16].corner_right_rear_x@ */ /end MEASUREMENT
/begin MEASUREMENT SwcOut_TOS_AEB[16].corner_right_rear_y "" FLOAT32_IEEE autosar_swc_tos_CM_single 0 0 -3.4E+38 3.4E+38 ECU_ADDRESS 0xfe4b1490 /* @ECU_Address@SwcOut_TOS_AEB[16].corner_right_rear_y@ */ /end MEASUREMENT
/begin MEASUREMENT SwcOut_TOS_AEB[16].pro_flag "" SLONG autosar_swc_tos_CM_int32 0 0 -2147483648 2147483647 ECU_ADDRESS 0xfe4b1428 /* @ECU_Address@SwcOut_TOS_AEB[16].pro_flag@ */ /end MEASUREMENT
/begin MEASUREMENT SwcOut_TOS_AEB[16].ramp "" UBYTE autosar_swc_tos_CM_uint8 0 0 0 255 ECU_ADDRESS 0xfe4b1423 /* @ECU_Address@SwcOut_TOS_AEB[16].ramp@ */ /end MEASUREMENT
/begin COMPU_METHOD autosar_swc_tos_CM_boolean "Q = V" IDENTICAL "%1.0" "" /end COMPU_METHOD
/begin COMPU_METHOD autosar_swc_tos_CM_int32 "Q = V" IDENTICAL "%10.0" "" /end COMPU_METHOD
/begin COMPU_METHOD autosar_swc_tos_CM_single "Q = V" IDENTICAL "%8.6" "" /end COMPU_METHOD
/begin COMPU_METHOD autosar_swc_tos_CM_uint16 "Q = V" IDENTICAL "%5.0" "" /end COMPU_METHOD
/begin COMPU_METHOD autosar_swc_tos_CM_uint32 "Q = V" IDENTICAL "%10.0" "" /end COMPU_METHOD
/begin COMPU_METHOD autosar_swc_tos_CM_uint64 "Q = V" IDENTICAL "%20.0" "" /end COMPU_METHOD
/begin COMPU_METHOD autosar_swc_tos_CM_uint8 "Q = V" IDENTICAL "%3.0" "" /end COMPU_METHOD
/begin GROUP SwcOut_EVM_CIPV[4].size ""
 /begin REF_MEASUREMENT SwcOut_EVM_CIPV[4].size.length SwcOut_EVM_CIPV[4].size.width SwcOut_EVM_CIPV[4].size.higth /end REF_MEASUREMENT
/end GROUP
/begin GROUP SwcOut_EVM_CIPV[4].velocity_gnd ""
 /begin REF_MEASUREMENT SwcOut_EVM_CIPV[4].velocity_gnd.x SwcOut_EVM_CIPV[4].velocity_gnd.y SwcOut_EVM_CIPV[4].velocity_gnd.mod /end REF_MEASUREMENT
/end GROUP
/begin GROUP SwcOut_EVM_CIPV[4].velocity_gnd_sl ""
 /begin REF_MEASUREMENT SwcOut_EVM_CIPV[4].velocity_gnd_sl.x SwcOut_EVM_CIPV[4].velocity_gnd_sl.y SwcOut_EVM_CIPV[4].velocity_gnd_sl.mod /end REF_MEASUREMENT
/end GROUP
/begin GROUP SwcOut_EVM_CIPV[5] ""
 /begin SUB_GROUP SwcOut_EVM_CIPV[5].box SwcOut_EVM_CIPV[5].position SwcOut_EVM_CIPV[5].position_sl SwcOut_EVM_CIPV[5].size SwcOut_EVM_CIPV[5].velocity_gnd SwcOut_EVM_CIPV[5].accel_gnd SwcOut_EVM_CIPV[5].velocity_gnd_sl SwcOut_EVM_CIPV[5].accel_gnd_sl /end SUB_GROUP
 /begin REF_MEASUREMENT SwcOut_EVM_CIPV[5].meas_state SwcOut_EVM_CIPV[5].fus_type SwcOut_EVM_CIPV[5].class_type SwcOut_EVM_CIPV[5].cut_type SwcOut_EVM_CIPV[5].ref_lane_id SwcOut_EVM_CIPV[5].id /end REF_MEASUREMENT
/end GROUP
/begin GROUP SwcOut_EVM_CIPV[5].accel_gnd ""
 /begin REF_MEASUREMENT SwcOut_EVM_CIPV[5].accel_gnd.x SwcOut_EVM_CIPV[5].accel_gnd.y SwcOut_EVM_CIPV[5].accel_gnd.mod /end REF_MEASUREMENT
/end GROUP
/begin GROUP SwcOut_EVM_CIPV[5].accel_gnd_sl ""
 /begin REF_MEASUREMENT SwcOut_EVM_CIPV[5].accel_gnd_sl.x SwcOut_EVM_CIPV[5].accel_gnd_sl.y SwcOut_EVM_CIPV[5].accel_gnd_sl.mod /end REF_MEASUREMENT
/end GROUP
/begin GROUP SwcOut_EVM_CIPV[5].box ""
 /begin REF_MEASUREMENT SwcOut_EVM_CIPV[5].box.corner_x_vec SwcOut_EVM_CIPV[5].box.corner_y_vec /end REF_MEASUREMENT
/end GROUP
/begin GROUP SwcOut_EVM_CIPV[5].position ""
 /begin REF_MEASUREMENT SwcOut_EVM_CIPV[5].position.x SwcOut_EVM_CIPV[5].position.y SwcOut_EVM_CIPV[5].position.heading_angle /end REF_MEASUREMENT
/end GROUP
/begin GROUP SwcOut_EVM_CIPV[5].position_sl ""
 /begin REF_MEASUREMENT SwcOut_EVM_CIPV[5].position_sl.x SwcOut_EVM_CIPV[5].position_sl.y SwcOut_EVM_CIPV[5].position_sl.heading_angle /end REF_MEASUREMENT
/end GROUP
/begin GROUP SwcOut_EVM_CIPV[5].size ""
 /begin REF_MEASUREMENT SwcOut_EVM_CIPV[5].size.length SwcOut_EVM_CIPV[5].size.width SwcOut_EVM_CIPV[5].size.higth /end REF_MEASUREMENT
/end GROUP
/begin GROUP SwcOut_EVM_CIPV[5].velocity_gnd ""
 /begin REF_MEASUREMENT SwcOut_EVM_CIPV[5].velocity_gnd.x SwcOut_EVM_CIPV[5].velocity_gnd.y SwcOut_EVM_CIPV[5].velocity_gnd.mod /end REF_MEASUREMENT
/end GROUP
/begin GROUP SwcOut_EVM_CIPV[5].velocity_gnd_sl ""
 /begin REF_MEASUREMENT SwcOut_EVM_CIPV[5].velocity_gnd_sl.x SwcOut_EVM_CIPV[5].velocity_gnd_sl.y SwcOut_EVM_CIPV[5].velocity_gnd_sl.mod /end REF_MEASUREMENT
/end GROUP
/begin GROUP SwcOut_EVM_CIPV[6] ""
 /begin SUB_GROUP SwcOut_EVM_CIPV[6].box SwcOut_EVM_CIPV[6].position SwcOut_EVM_CIPV[6].position_sl SwcOut_EVM_CIPV[6].size SwcOut_EVM_CIPV[6].velocity_gnd SwcOut_EVM_CIPV[6].accel_gnd SwcOut_EVM_CIPV[6].velocity_gnd_sl SwcOut_EVM_CIPV[6].accel_gnd_sl /end SUB_GROUP
 /begin REF_MEASUREMENT SwcOut_EVM_CIPV[6].meas_state SwcOut_EVM_CIPV[6].fus_type SwcOut_EVM_CIPV[6].class_type SwcOut_EVM_CIPV[6].cut_type SwcOut_EVM_CIPV[6].ref_lane_id SwcOut_EVM_CIPV[6].id /end REF_MEASUREMENT
/end GROUP
/begin GROUP SwcOut_EVM_CIPV[6].accel_gnd ""
 /begin REF_MEASUREMENT SwcOut_EVM_CIPV[6].accel_gnd.x SwcOut_EVM_CIPV[6].accel_gnd.y SwcOut_EVM_CIPV[6].accel_gnd.mod /end REF_MEASUREMENT
/end GROUP
/begin GROUP SwcOut_EVM_CIPV[6].accel_gnd_sl ""
 /begin REF_MEASUREMENT SwcOut_EVM_CIPV[6].accel_gnd_sl.x SwcOut_EVM_CIPV[6].accel_gnd_sl.y SwcOut_EVM_CIPV[6].accel_gnd_sl.mod /end REF_MEASUREMENT
/end GROUP
/begin GROUP SwcOut_EVM_CIPV[6].box ""
 /begin REF_MEASUREMENT SwcOut_EVM_CIPV[6].box.corner_x_vec SwcOut_EVM_CIPV[6].box.corner_y_vec /end REF_MEASUREMENT
/end GROUP
/begin GROUP SwcOut_EVM_CIPV[6].position ""
 /begin REF_MEASUREMENT SwcOut_EVM_CIPV[6].position.x SwcOut_EVM_CIPV[6].position.y SwcOut_EVM_CIPV[6].position.heading_angle /end REF_MEASUREMENT
/end GROUP
/begin GROUP SwcOut_EVM_CIPV[6].position_sl ""
 /begin REF_MEASUREMENT SwcOut_EVM_CIPV[6].position_sl.x SwcOut_EVM_CIPV[6].position_sl.y SwcOut_EVM_CIPV[6].position_sl.heading_angle /end REF_MEASUREMENT
/end GROUP
/begin GROUP SwcOut_EVM_CIPV[6].size ""
 /begin REF_MEASUREMENT SwcOut_EVM_CIPV[6].size.length SwcOut_EVM_CIPV[6].size.width SwcOut_EVM_CIPV[6].size.higth /end REF_MEASUREMENT
/end GROUP
/begin GROUP SwcOut_EVM_CIPV[6].velocity_gnd ""
 /begin REF_MEASUREMENT SwcOut_EVM_CIPV[6].velocity_gnd.x SwcOut_EVM_CIPV[6].velocity_gnd.y SwcOut_EVM_CIPV[6].velocity_gnd.mod /end REF_MEASUREMENT
/end GROUP
/begin GROUP SwcOut_EVM_CIPV[6].velocity_gnd_sl ""
 /begin REF_MEASUREMENT SwcOut_EVM_CIPV[6].velocity_gnd_sl.x SwcOut_EVM_CIPV[6].velocity_gnd_sl.y SwcOut_EVM_CIPV[6].velocity_gnd_sl.mod /end REF_MEASUREMENT
/end GROUP
/begin GROUP SwcOut_EVM_CIPV[7] ""
 /begin SUB_GROUP SwcOut_EVM_CIPV[7].box SwcOut_EVM_CIPV[7].position SwcOut_EVM_CIPV[7].position_sl SwcOut_EVM_CIPV[7].size SwcOut_EVM_CIPV[7].velocity_gnd SwcOut_EVM_CIPV[7].accel_gnd SwcOut_EVM_CIPV[7].velocity_gnd_sl SwcOut_EVM_CIPV[7].accel_gnd_sl /end SUB_GROUP
 /begin REF_MEASUREMENT SwcOut_EVM_CIPV[7].meas_state SwcOut_EVM_CIPV[7].fus_type SwcOut_EVM_CIPV[7].class_type SwcOut_EVM_CIPV[7].cut_type SwcOut_EVM_CIPV[7].ref_lane_id SwcOut_EVM_CIPV[7].id /end REF_MEASUREMENT
/end GROUP
/begin GROUP SwcOut_EVM_CIPV[7].accel_gnd ""
 /begin REF_MEASUREMENT SwcOut_EVM_CIPV[7].accel_gnd.x SwcOut_EVM_CIPV[7].accel_gnd.y SwcOut_EVM_CIPV[7].accel_gnd.mod /end REF_MEASUREMENT
/end GROUP
/begin GROUP SwcOut_EVM_CIPV[7].accel_gnd_sl ""
 /begin REF_MEASUREMENT SwcOut_EVM_CIPV[7].accel_gnd_sl.x SwcOut_EVM_CIPV[7].accel_gnd_sl.y SwcOut_EVM_CIPV[7].accel_gnd_sl.mod /end REF_MEASUREMENT
/end GROUP
/begin GROUP SwcOut_EVM_CIPV[7].box ""
 /begin REF_MEASUREMENT SwcOut_EVM_CIPV[7].box.corner_x_vec SwcOut_EVM_CIPV[7].box.corner_y_vec /end REF_MEASUREMENT
/end GROUP
/begin GROUP SwcOut_EVM_CIPV[7].position ""
 /begin REF_MEASUREMENT SwcOut_EVM_CIPV[7].position.x SwcOut_EVM_CIPV[7].position.y SwcOut_EVM_CIPV[7].position.heading_angle /end REF_MEASUREMENT
/end GROUP
/begin GROUP SwcOut_EVM_CIPV[7].position_sl ""
 /begin REF_MEASUREMENT SwcOut_EVM_CIPV[7].position_sl.x SwcOut_EVM_CIPV[7].position_sl.y SwcOut_EVM_CIPV[7].position_sl.heading_angle /end REF_MEASUREMENT
/end GROUP
/begin GROUP SwcOut_EVM_CIPV[7].size ""
 /begin REF_MEASUREMENT SwcOut_EVM_CIPV[7].size.length SwcOut_EVM_CIPV[7].size.width SwcOut_EVM_CIPV[7].size.higth /end REF_MEASUREMENT
/end GROUP
/begin GROUP SwcOut_EVM_CIPV[7].velocity_gnd ""
 /begin REF_MEASUREMENT SwcOut_EVM_CIPV[7].velocity_gnd.x SwcOut_EVM_CIPV[7].velocity_gnd.y SwcOut_EVM_CIPV[7].velocity_gnd.mod /end REF_MEASUREMENT
/end GROUP
/begin GROUP SwcOut_EVM_CIPV[7].velocity_gnd_sl ""
 /begin REF_MEASUREMENT SwcOut_EVM_CIPV[7].velocity_gnd_sl.x SwcOut_EVM_CIPV[7].velocity_gnd_sl.y SwcOut_EVM_CIPV[7].velocity_gnd_sl.mod /end REF_MEASUREMENT
/end GROUP
/begin GROUP SwcOut_EVM_CIPV[8] ""
 /begin SUB_GROUP SwcOut_EVM_CIPV[8].box SwcOut_EVM_CIPV[8].position SwcOut_EVM_CIPV[8].position_sl SwcOut_EVM_CIPV[8].size SwcOut_EVM_CIPV[8].velocity_gnd SwcOut_EVM_CIPV[8].accel_gnd SwcOut_EVM_CIPV[8].velocity_gnd_sl SwcOut_EVM_CIPV[8].accel_gnd_sl /end SUB_GROUP
 /begin REF_MEASUREMENT SwcOut_EVM_CIPV[8].meas_state SwcOut_EVM_CIPV[8].fus_type SwcOut_EVM_CIPV[8].class_type SwcOut_EVM_CIPV[8].cut_type SwcOut_EVM_CIPV[8].ref_lane_id SwcOut_EVM_CIPV[8].id /end REF_MEASUREMENT
/end GROUP
/begin GROUP SwcOut_EVM_CIPV[8].accel_gnd ""
 /begin REF_MEASUREMENT SwcOut_EVM_CIPV[8].accel_gnd.x SwcOut_EVM_CIPV[8].accel_gnd.y SwcOut_EVM_CIPV[8].accel_gnd.mod /end REF_MEASUREMENT
/end GROUP
/begin GROUP SwcOut_EVM_CIPV[8].accel_gnd_sl ""
 /begin REF_MEASUREMENT SwcOut_EVM_CIPV[8].accel_gnd_sl.x SwcOut_EVM_CIPV[8].accel_gnd_sl.y SwcOut_EVM_CIPV[8].accel_gnd_sl.mod /end REF_MEASUREMENT
/end GROUP
/begin GROUP SwcOut_EVM_CIPV[8].box ""
 /begin REF_MEASUREMENT SwcOut_EVM_CIPV[8].box.corner_x_vec SwcOut_EVM_CIPV[8].box.corner_y_vec /end REF_MEASUREMENT
/end GROUP
/begin GROUP SwcOut_EVM_CIPV[8].position ""
 /begin REF_MEASUREMENT SwcOut_EVM_CIPV[8].position.x SwcOut_EVM_CIPV[8].position.y SwcOut_EVM_CIPV[8].position.heading_angle /end REF_MEASUREMENT
/end GROUP
/begin GROUP SwcOut_EVM_CIPV[8].position_sl ""
 /begin REF_MEASUREMENT SwcOut_EVM_CIPV[8].position_sl.x SwcOut_EVM_CIPV[8].position_sl.y SwcOut_EVM_CIPV[8].position_sl.heading_angle /end REF_MEASUREMENT
/end GROUP
/begin GROUP SwcOut_EVM_CIPV[8].size ""
 /begin REF_MEASUREMENT SwcOut_EVM_CIPV[8].size.length SwcOut_EVM_CIPV[8].size.width SwcOut_EVM_CIPV[8].size.higth /end REF_MEASUREMENT
/end GROUP
/begin GROUP SwcOut_EVM_CIPV[8].velocity_gnd ""
 /begin REF_MEASUREMENT SwcOut_EVM_CIPV[8].velocity_gnd.x SwcOut_EVM_CIPV[8].velocity_gnd.y SwcOut_EVM_CIPV[8].velocity_gnd.mod /end REF_MEASUREMENT
/end GROUP
/begin GROUP SwcOut_EVM_CIPV[8].velocity_gnd_sl ""
 /begin REF_MEASUREMENT SwcOut_EVM_CIPV[8].velocity_gnd_sl.x SwcOut_EVM_CIPV[8].velocity_gnd_sl.y SwcOut_EVM_CIPV[8].velocity_gnd_sl.mod /end REF_MEASUREMENT
/end GROUP
/begin GROUP SwcOut_EVM_CIPV[9] ""
 /begin SUB_GROUP SwcOut_EVM_CIPV[9].box SwcOut_EVM_CIPV[9].position SwcOut_EVM_CIPV[9].position_sl SwcOut_EVM_CIPV[9].size SwcOut_EVM_CIPV[9].velocity_gnd SwcOut_EVM_CIPV[9].accel_gnd SwcOut_EVM_CIPV[9].velocity_gnd_sl SwcOut_EVM_CIPV[9].accel_gnd_sl /end SUB_GROUP
 /begin REF_MEASUREMENT SwcOut_EVM_CIPV[9].meas_state SwcOut_EVM_CIPV[9].fus_type SwcOut_EVM_CIPV[9].class_type SwcOut_EVM_CIPV[9].cut_type SwcOut_EVM_CIPV[9].ref_lane_id SwcOut_EVM_CIPV[9].id /end REF_MEASUREMENT
/end GROUP
/begin GROUP SwcOut_EVM_CIPV[9].accel_gnd ""
 /begin REF_MEASUREMENT SwcOut_EVM_CIPV[9].accel_gnd.x SwcOut_EVM_CIPV[9].accel_gnd.y SwcOut_EVM_CIPV[9].accel_gnd.mod /end REF_MEASUREMENT
/end GROUP
/begin GROUP SwcOut_EVM_CIPV[9].accel_gnd_sl ""
 /begin REF_MEASUREMENT SwcOut_EVM_CIPV[9].accel_gnd_sl.x SwcOut_EVM_CIPV[9].accel_gnd_sl.y SwcOut_EVM_CIPV[9].accel_gnd_sl.mod /end REF_MEASUREMENT
/end GROUP
/begin GROUP SwcOut_EVM_CIPV[9].box ""
 /begin REF_MEASUREMENT SwcOut_EVM_CIPV[9].box.corner_x_vec SwcOut_EVM_CIPV[9].box.corner_y_vec /end REF_MEASUREMENT
/end GROUP
/begin GROUP SwcOut_EVM_CIPV[9].position ""
 /begin REF_MEASUREMENT SwcOut_EVM_CIPV[9].position.x SwcOut_EVM_CIPV[9].position.y SwcOut_EVM_CIPV[9].position.heading_angle /end REF_MEASUREMENT
/end GROUP
/begin GROUP SwcOut_EVM_CIPV[9].position_sl ""
 /begin REF_MEASUREMENT SwcOut_EVM_CIPV[9].position_sl.x SwcOut_EVM_CIPV[9].position_sl.y SwcOut_EVM_CIPV[9].position_sl.heading_angle /end REF_MEASUREMENT
/end GROUP
/begin GROUP SwcOut_EVM_CIPV[9].size ""
 /begin REF_MEASUREMENT SwcOut_EVM_CIPV[9].size.length SwcOut_EVM_CIPV[9].size.width SwcOut_EVM_CIPV[9].size.higth /end REF_MEASUREMENT
/end GROUP
/begin GROUP SwcOut_EVM_CIPV[9].velocity_gnd ""
 /begin REF_MEASUREMENT SwcOut_EVM_CIPV[9].velocity_gnd.x SwcOut_EVM_CIPV[9].velocity_gnd.y SwcOut_EVM_CIPV[9].velocity_gnd.mod /end REF_MEASUREMENT
/end GROUP
/begin GROUP SwcOut_EVM_CIPV[9].velocity_gnd_sl ""
 /begin REF_MEASUREMENT SwcOut_EVM_CIPV[9].velocity_gnd_sl.x SwcOut_EVM_CIPV[9].velocity_gnd_sl.y SwcOut_EVM_CIPV[9].velocity_gnd_sl.mod /end REF_MEASUREMENT
/end GROUP
/begin GROUP SwcOut_EVM_CIPV_TRAJ "" /begin SUB_GROUP SwcOut_EVM_CIPV_TRAJ.traj_refline /end SUB_GROUP
 /begin REF_MEASUREMENT SwcOut_EVM_CIPV_TRAJ.id SwcOut_EVM_CIPV_TRAJ.same_team_obj_num SwcOut_EVM_CIPV_TRAJ.obj_width SwcOut_EVM_CIPV_TRAJ.ref_obj_id /end REF_MEASUREMENT
/end GROUP
/begin GROUP SwcOut_EVM_CIPV_TRAJ.traj_refline "" /begin SUB_GROUP SwcOut_EVM_CIPV_TRAJ.traj_refline.curve /end SUB_GROUP
 /begin REF_MEASUREMENT SwcOut_EVM_CIPV_TRAJ.traj_refline.ref_source SwcOut_EVM_CIPV_TRAJ.traj_refline.calc_state SwcOut_EVM_CIPV_TRAJ.traj_refline.id /end REF_MEASUREMENT
/end GROUP
/begin GROUP SwcOut_EVM_CIPV_TRAJ.traj_refline.curve ""
 /begin REF_MEASUREMENT SwcOut_EVM_CIPV_TRAJ.traj_refline.curve.start SwcOut_EVM_CIPV_TRAJ.traj_refline.curve.end SwcOut_EVM_CIPV_TRAJ.traj_refline.curve.poly_vec /end REF_MEASUREMENT
/end GROUP
/begin GROUP SwcOut_EVM_LANE_MAXSPD[0] ""
 /begin REF_MEASUREMENT SwcOut_EVM_LANE_MAXSPD[0].lane_id SwcOut_EVM_LANE_MAXSPD[0].max_spd_high_assumed SwcOut_EVM_LANE_MAXSPD[0].max_spd_low_assumed SwcOut_EVM_LANE_MAXSPD[0].spd_block_dis /end REF_MEASUREMENT
/end GROUP
/begin GROUP SwcOut_EVM_LANE_MAXSPD[1] ""
 /begin REF_MEASUREMENT SwcOut_EVM_LANE_MAXSPD[1].lane_id SwcOut_EVM_LANE_MAXSPD[1].max_spd_high_assumed SwcOut_EVM_LANE_MAXSPD[1].max_spd_low_assumed SwcOut_EVM_LANE_MAXSPD[1].spd_block_dis /end REF_MEASUREMENT
/end GROUP
/begin GROUP SwcOut_EVM_LANE_MAXSPD[2] ""
 /begin REF_MEASUREMENT SwcOut_EVM_LANE_MAXSPD[2].lane_id SwcOut_EVM_LANE_MAXSPD[2].max_spd_high_assumed SwcOut_EVM_LANE_MAXSPD[2].max_spd_low_assumed SwcOut_EVM_LANE_MAXSPD[2].spd_block_dis /end REF_MEASUREMENT
/end GROUP
/begin GROUP SwcOut_EVM_LANE_NUDGE ""
 /begin REF_MEASUREMENT SwcOut_EVM_LANE_NUDGE.nudge_type SwcOut_EVM_LANE_NUDGE.ref_lane_id SwcOut_EVM_LANE_NUDGE.nudge_dx SwcOut_EVM_LANE_NUDGE.nudge_offset SwcOut_EVM_LANE_NUDGE.nudge_speed_limit SwcOut_EVM_LANE_NUDGE.reserved SwcOut_EVM_LANE_NUDGE.obj_id /end REF_MEASUREMENT
/end GROUP
/begin GROUP SwcOut_EVM_TRAFFIC_SCEN ""
 /begin REF_MEASUREMENT SwcOut_EVM_TRAFFIC_SCEN.traffic_scene SwcOut_EVM_TRAFFIC_SCEN.trucks_around /end REF_MEASUREMENT
/end GROUP
/begin GROUP SwcOut_EVM_VT_LANE "" /begin SUB_GROUP SwcOut_EVM_VT_LANE.traj_refline /end SUB_GROUP
 /begin REF_MEASUREMENT SwcOut_EVM_VT_LANE.id SwcOut_EVM_VT_LANE.team_obj_total_num /end REF_MEASUREMENT
/end GROUP
/begin GROUP SwcOut_EVM_VT_LANE.traj_refline "" /begin SUB_GROUP SwcOut_EVM_VT_LANE.traj_refline.curve /end SUB_GROUP
 /begin REF_MEASUREMENT SwcOut_EVM_VT_LANE.traj_refline.ref_source SwcOut_EVM_VT_LANE.traj_refline.calc_state SwcOut_EVM_VT_LANE.traj_refline.id /end REF_MEASUREMENT
/end GROUP
/begin GROUP SwcOut_EVM_VT_LANE.traj_refline.curve ""
 /begin REF_MEASUREMENT SwcOut_EVM_VT_LANE.traj_refline.curve.start SwcOut_EVM_VT_LANE.traj_refline.curve.end SwcOut_EVM_VT_LANE.traj_refline.curve.poly_vec /end REF_MEASUREMENT
/end GROUP
/begin GROUP SwcOut_TOS_ACCP0 ""
 /begin REF_MEASUREMENT SwcOut_TOS_ACCP0.targetExist SwcOut_TOS_ACCP0.cutInflg SwcOut_TOS_ACCP0.brakeIntention SwcOut_TOS_ACCP0.movingState SwcOut_TOS_ACCP0.orientation SwcOut_TOS_ACCP0.type SwcOut_TOS_ACCP0.fu_type SwcOut_TOS_ACCP0.dx SwcOut_TOS_ACCP0.dy SwcOut_TOS_ACCP0.vxRel SwcOut_TOS_ACCP0.vyRel SwcOut_TOS_ACCP0.vxAbs SwcOut_TOS_ACCP0.vyAbs SwcOut_TOS_ACCP0.axAbs SwcOut_TOS_ACCP0.ayAbs SwcOut_TOS_ACCP0.range SwcOut_TOS_ACCP0.objExist SwcOut_TOS_ACCP0.headingAngle SwcOut_TOS_ACCP0.Object_Length SwcOut_TOS_ACCP0.Object_Width SwcOut_TOS_ACCP0.Object_Hight SwcOut_TOS_ACCP0.id SwcOut_TOS_ACCP0.age /end REF_MEASUREMENT
/end GROUP
/begin GROUP SwcOut_TOS_ACCP1 ""
 /begin REF_MEASUREMENT SwcOut_TOS_ACCP1.targetExist SwcOut_TOS_ACCP1.cutInflg SwcOut_TOS_ACCP1.brakeIntention SwcOut_TOS_ACCP1.movingState SwcOut_TOS_ACCP1.orientation SwcOut_TOS_ACCP1.type SwcOut_TOS_ACCP1.fu_type SwcOut_TOS_ACCP1.dx SwcOut_TOS_ACCP1.dy SwcOut_TOS_ACCP1.vxRel SwcOut_TOS_ACCP1.vyRel SwcOut_TOS_ACCP1.vxAbs SwcOut_TOS_ACCP1.vyAbs SwcOut_TOS_ACCP1.axAbs SwcOut_TOS_ACCP1.ayAbs SwcOut_TOS_ACCP1.range SwcOut_TOS_ACCP1.objExist SwcOut_TOS_ACCP1.headingAngle SwcOut_TOS_ACCP1.Object_Length SwcOut_TOS_ACCP1.Object_Width SwcOut_TOS_ACCP1.Object_Hight SwcOut_TOS_ACCP1.id SwcOut_TOS_ACCP1.age /end REF_MEASUREMENT
/end GROUP
/begin GROUP SwcOut_TOS_ACCP2 ""
 /begin REF_MEASUREMENT SwcOut_TOS_ACCP2.targetExist SwcOut_TOS_ACCP2.cutInflg SwcOut_TOS_ACCP2.brakeIntention SwcOut_TOS_ACCP2.movingState SwcOut_TOS_ACCP2.orientation SwcOut_TOS_ACCP2.type SwcOut_TOS_ACCP2.fu_type SwcOut_TOS_ACCP2.dx SwcOut_TOS_ACCP2.dy SwcOut_TOS_ACCP2.vxRel SwcOut_TOS_ACCP2.vyRel SwcOut_TOS_ACCP2.vxAbs SwcOut_TOS_ACCP2.vyAbs SwcOut_TOS_ACCP2.axAbs SwcOut_TOS_ACCP2.ayAbs SwcOut_TOS_ACCP2.range SwcOut_TOS_ACCP2.objExist SwcOut_TOS_ACCP2.headingAngle SwcOut_TOS_ACCP2.Object_Length SwcOut_TOS_ACCP2.Object_Width SwcOut_TOS_ACCP2.Object_Hight SwcOut_TOS_ACCP2.id SwcOut_TOS_ACCP2.age /end REF_MEASUREMENT
/end GROUP
/begin GROUP SwcOut_TOS_ACCP3 ""
 /begin REF_MEASUREMENT SwcOut_TOS_ACCP3.targetExist SwcOut_TOS_ACCP3.cutInflg SwcOut_TOS_ACCP3.brakeIntention SwcOut_TOS_ACCP3.movingState SwcOut_TOS_ACCP3.orientation SwcOut_TOS_ACCP3.type SwcOut_TOS_ACCP3.fu_type SwcOut_TOS_ACCP3.dx SwcOut_TOS_ACCP3.dy SwcOut_TOS_ACCP3.vxRel SwcOut_TOS_ACCP3.vyRel SwcOut_TOS_ACCP3.vxAbs SwcOut_TOS_ACCP3.vyAbs SwcOut_TOS_ACCP3.axAbs SwcOut_TOS_ACCP3.ayAbs SwcOut_TOS_ACCP3.range SwcOut_TOS_ACCP3.objExist SwcOut_TOS_ACCP3.headingAngle SwcOut_TOS_ACCP3.Object_Length SwcOut_TOS_ACCP3.Object_Width SwcOut_TOS_ACCP3.Object_Hight SwcOut_TOS_ACCP3.id SwcOut_TOS_ACCP3.age /end REF_MEASUREMENT
/end GROUP
/begin GROUP SwcOut_TOS_ACCP4 ""
 /begin REF_MEASUREMENT SwcOut_TOS_ACCP4.targetExist SwcOut_TOS_ACCP4.cutInflg SwcOut_TOS_ACCP4.brakeIntention SwcOut_TOS_ACCP4.movingState SwcOut_TOS_ACCP4.orientation SwcOut_TOS_ACCP4.type SwcOut_TOS_ACCP4.fu_type SwcOut_TOS_ACCP4.dx SwcOut_TOS_ACCP4.dy SwcOut_TOS_ACCP4.vxRel SwcOut_TOS_ACCP4.vyRel SwcOut_TOS_ACCP4.vxAbs SwcOut_TOS_ACCP4.vyAbs SwcOut_TOS_ACCP4.axAbs SwcOut_TOS_ACCP4.ayAbs SwcOut_TOS_ACCP4.range SwcOut_TOS_ACCP4.objExist SwcOut_TOS_ACCP4.headingAngle SwcOut_TOS_ACCP4.Object_Length SwcOut_TOS_ACCP4.Object_Width SwcOut_TOS_ACCP4.Object_Hight SwcOut_TOS_ACCP4.id SwcOut_TOS_ACCP4.age /end REF_MEASUREMENT
/end GROUP
/begin GROUP SwcOut_TOS_ACCP5 ""
 /begin REF_MEASUREMENT SwcOut_TOS_ACCP5.targetExist SwcOut_TOS_ACCP5.cutInflg SwcOut_TOS_ACCP5.brakeIntention SwcOut_TOS_ACCP5.movingState SwcOut_TOS_ACCP5.orientation SwcOut_TOS_ACCP5.type SwcOut_TOS_ACCP5.fu_type SwcOut_TOS_ACCP5.dx SwcOut_TOS_ACCP5.dy SwcOut_TOS_ACCP5.vxRel SwcOut_TOS_ACCP5.vyRel SwcOut_TOS_ACCP5.vxAbs SwcOut_TOS_ACCP5.vyAbs SwcOut_TOS_ACCP5.axAbs SwcOut_TOS_ACCP5.ayAbs SwcOut_TOS_ACCP5.range SwcOut_TOS_ACCP5.objExist SwcOut_TOS_ACCP5.headingAngle SwcOut_TOS_ACCP5.Object_Length SwcOut_TOS_ACCP5.Object_Width SwcOut_TOS_ACCP5.Object_Hight SwcOut_TOS_ACCP5.id SwcOut_TOS_ACCP5.age /end REF_MEASUREMENT
/end GROUP
/begin GROUP SwcOut_TOS_ACCP6 ""
 /begin REF_MEASUREMENT SwcOut_TOS_ACCP6.targetExist SwcOut_TOS_ACCP6.cutInflg SwcOut_TOS_ACCP6.brakeIntention SwcOut_TOS_ACCP6.movingState SwcOut_TOS_ACCP6.orientation SwcOut_TOS_ACCP6.type SwcOut_TOS_ACCP6.fu_type SwcOut_TOS_ACCP6.dx SwcOut_TOS_ACCP6.dy SwcOut_TOS_ACCP6.vxRel SwcOut_TOS_ACCP6.vyRel SwcOut_TOS_ACCP6.vxAbs SwcOut_TOS_ACCP6.vyAbs SwcOut_TOS_ACCP6.axAbs SwcOut_TOS_ACCP6.ayAbs SwcOut_TOS_ACCP6.range SwcOut_TOS_ACCP6.objExist SwcOut_TOS_ACCP6.headingAngle SwcOut_TOS_ACCP6.Object_Length SwcOut_TOS_ACCP6.Object_Width SwcOut_TOS_ACCP6.Object_Hight SwcOut_TOS_ACCP6.id SwcOut_TOS_ACCP6.age /end REF_MEASUREMENT
/end GROUP
/begin GROUP SwcOut_TOS_ACCP7 ""
 /begin REF_MEASUREMENT SwcOut_TOS_ACCP7.targetExist SwcOut_TOS_ACCP7.cutInflg SwcOut_TOS_ACCP7.brakeIntention SwcOut_TOS_ACCP7.movingState SwcOut_TOS_ACCP7.orientation SwcOut_TOS_ACCP7.type SwcOut_TOS_ACCP7.fu_type SwcOut_TOS_ACCP7.dx SwcOut_TOS_ACCP7.dy SwcOut_TOS_ACCP7.vxRel SwcOut_TOS_ACCP7.vyRel SwcOut_TOS_ACCP7.vxAbs SwcOut_TOS_ACCP7.vyAbs SwcOut_TOS_ACCP7.axAbs SwcOut_TOS_ACCP7.ayAbs SwcOut_TOS_ACCP7.range SwcOut_TOS_ACCP7.objExist SwcOut_TOS_ACCP7.headingAngle SwcOut_TOS_ACCP7.Object_Length SwcOut_TOS_ACCP7.Object_Width SwcOut_TOS_ACCP7.Object_Hight SwcOut_TOS_ACCP7.id SwcOut_TOS_ACCP7.age /end REF_MEASUREMENT
/end GROUP
/begin GROUP SwcOut_TOS_ACCP8 ""
 /begin REF_MEASUREMENT SwcOut_TOS_ACCP8.targetExist SwcOut_TOS_ACCP8.cutInflg SwcOut_TOS_ACCP8.brakeIntention SwcOut_TOS_ACCP8.movingState SwcOut_TOS_ACCP8.orientation SwcOut_TOS_ACCP8.type SwcOut_TOS_ACCP8.fu_type SwcOut_TOS_ACCP8.dx SwcOut_TOS_ACCP8.dy SwcOut_TOS_ACCP8.vxRel SwcOut_TOS_ACCP8.vyRel SwcOut_TOS_ACCP8.vxAbs SwcOut_TOS_ACCP8.vyAbs SwcOut_TOS_ACCP8.axAbs SwcOut_TOS_ACCP8.ayAbs SwcOut_TOS_ACCP8.range SwcOut_TOS_ACCP8.objExist SwcOut_TOS_ACCP8.headingAngle SwcOut_TOS_ACCP8.Object_Length SwcOut_TOS_ACCP8.Object_Width SwcOut_TOS_ACCP8.Object_Hight SwcOut_TOS_ACCP8.id SwcOut_TOS_ACCP8.age /end REF_MEASUREMENT
/end GROUP
/begin GROUP SwcOut_TOS_AEB[0] ""
 /begin REF_MEASUREMENT SwcOut_TOS_AEB[0].LeftLane_flag SwcOut_TOS_AEB[0].SameLane_flag SwcOut_TOS_AEB[0].RightLane_flag SwcOut_TOS_AEB[0].Object_Type SwcOut_TOS_AEB[0].Object_MovingState SwcOut_TOS_AEB[0].Object_Orientation SwcOut_TOS_AEB[0].Object_Turn_Signal SwcOut_TOS_AEB[0].Sceniaro_Flag SwcOut_TOS_AEB[0].CllsnMtgtnByBrkgPrimQly SwcOut_TOS_AEB[0].CllsnMtgtnByBrkgSecQly SwcOut_TOS_AEB[0].CllsnWarnFwdQly SwcOut_TOS_AEB[0].ramp SwcOut_TOS_AEB[0].Object_Fus_Type SwcOut_TOS_AEB[0].pro_flag SwcOut_TOS_AEB[0].Object_Length SwcOut_TOS_AEB[0].Object_Width SwcOut_TOS_AEB[0].Object_Hight SwcOut_TOS_AEB[0].Object_HeadingAngle SwcOut_TOS_AEB[0].Object_YawAngle SwcOut_TOS_AEB[0].Object_DX SwcOut_TOS_AEB[0].Object_DY SwcOut_TOS_AEB[0].Object_RangeX SwcOut_TOS_AEB[0].Object_RangeY SwcOut_TOS_AEB[0].Object_VX SwcOut_TOS_AEB[0].Object_VY SwcOut_TOS_AEB[0].Object_Abs_SPEED SwcOut_TOS_AEB[0].Object_Abs_VX SwcOut_TOS_AEB[0].Object_Abs_VY SwcOut_TOS_AEB[0].Object_AX SwcOut_TOS_AEB[0].Object_AY SwcOut_TOS_AEB[0].Object_Abs_AX SwcOut_TOS_AEB[0].Object_Abs_AY SwcOut_TOS_AEB[0].corner_left_front_x SwcOut_TOS_AEB[0].corner_left_front_y SwcOut_TOS_AEB[0].corner_right_front_x SwcOut_TOS_AEB[0].corner_right_front_y SwcOut_TOS_AEB[0].corner_left_rear_x SwcOut_TOS_AEB[0].corner_left_rear_y SwcOut_TOS_AEB[0].corner_right_rear_x SwcOut_TOS_AEB[0].corner_right_rear_y SwcOut_TOS_AEB[0].Object_ID SwcOut_TOS_AEB[0].camID SwcOut_TOS_AEB[0].Object_Age SwcOut_TOS_AEB[0].TimeStamp /end REF_MEASUREMENT
/end GROUP
/begin GROUP SwcOut_TOS_AEB[10] ""
 /begin REF_MEASUREMENT SwcOut_TOS_AEB[10].LeftLane_flag SwcOut_TOS_AEB[10].SameLane_flag SwcOut_TOS_AEB[10].RightLane_flag SwcOut_TOS_AEB[10].Object_Type SwcOut_TOS_AEB[10].Object_MovingState SwcOut_TOS_AEB[10].Object_Orientation SwcOut_TOS_AEB[10].Object_Turn_Signal SwcOut_TOS_AEB[10].Sceniaro_Flag SwcOut_TOS_AEB[10].CllsnMtgtnByBrkgPrimQly SwcOut_TOS_AEB[10].CllsnMtgtnByBrkgSecQly SwcOut_TOS_AEB[10].CllsnWarnFwdQly SwcOut_TOS_AEB[10].ramp SwcOut_TOS_AEB[10].Object_Fus_Type SwcOut_TOS_AEB[10].pro_flag SwcOut_TOS_AEB[10].Object_Length SwcOut_TOS_AEB[10].Object_Width SwcOut_TOS_AEB[10].Object_Hight SwcOut_TOS_AEB[10].Object_HeadingAngle SwcOut_TOS_AEB[10].Object_YawAngle SwcOut_TOS_AEB[10].Object_DX SwcOut_TOS_AEB[10].Object_DY SwcOut_TOS_AEB[10].Object_RangeX SwcOut_TOS_AEB[10].Object_RangeY SwcOut_TOS_AEB[10].Object_VX SwcOut_TOS_AEB[10].Object_VY SwcOut_TOS_AEB[10].Object_Abs_SPEED SwcOut_TOS_AEB[10].Object_Abs_VX SwcOut_TOS_AEB[10].Object_Abs_VY SwcOut_TOS_AEB[10].Object_AX SwcOut_TOS_AEB[10].Object_AY SwcOut_TOS_AEB[10].Object_Abs_AX SwcOut_TOS_AEB[10].Object_Abs_AY SwcOut_TOS_AEB[10].corner_left_front_x SwcOut_TOS_AEB[10].corner_left_front_y SwcOut_TOS_AEB[10].corner_right_front_x SwcOut_TOS_AEB[10].corner_right_front_y SwcOut_TOS_AEB[10].corner_left_rear_x SwcOut_TOS_AEB[10].corner_left_rear_y SwcOut_TOS_AEB[10].corner_right_rear_x SwcOut_TOS_AEB[10].corner_right_rear_y SwcOut_TOS_AEB[10].Object_ID SwcOut_TOS_AEB[10].camID SwcOut_TOS_AEB[10].Object_Age SwcOut_TOS_AEB[10].TimeStamp /end REF_MEASUREMENT
/end GROUP
/begin GROUP SwcOut_TOS_AEB[11] ""
 /begin REF_MEASUREMENT SwcOut_TOS_AEB[11].LeftLane_flag SwcOut_TOS_AEB[11].SameLane_flag SwcOut_TOS_AEB[11].RightLane_flag SwcOut_TOS_AEB[11].Object_Type SwcOut_TOS_AEB[11].Object_MovingState SwcOut_TOS_AEB[11].Object_Orientation SwcOut_TOS_AEB[11].Object_Turn_Signal SwcOut_TOS_AEB[11].Sceniaro_Flag SwcOut_TOS_AEB[11].CllsnMtgtnByBrkgPrimQly SwcOut_TOS_AEB[11].CllsnMtgtnByBrkgSecQly SwcOut_TOS_AEB[11].CllsnWarnFwdQly SwcOut_TOS_AEB[11].ramp SwcOut_TOS_AEB[11].Object_Fus_Type SwcOut_TOS_AEB[11].pro_flag SwcOut_TOS_AEB[11].Object_Length SwcOut_TOS_AEB[11].Object_Width SwcOut_TOS_AEB[11].Object_Hight SwcOut_TOS_AEB[11].Object_HeadingAngle SwcOut_TOS_AEB[11].Object_YawAngle SwcOut_TOS_AEB[11].Object_DX SwcOut_TOS_AEB[11].Object_DY SwcOut_TOS_AEB[11].Object_RangeX SwcOut_TOS_AEB[11].Object_RangeY SwcOut_TOS_AEB[11].Object_VX SwcOut_TOS_AEB[11].Object_VY SwcOut_TOS_AEB[11].Object_Abs_SPEED SwcOut_TOS_AEB[11].Object_Abs_VX SwcOut_TOS_AEB[11].Object_Abs_VY SwcOut_TOS_AEB[11].Object_AX SwcOut_TOS_AEB[11].Object_AY SwcOut_TOS_AEB[11].Object_Abs_AX SwcOut_TOS_AEB[11].Object_Abs_AY SwcOut_TOS_AEB[11].corner_left_front_x SwcOut_TOS_AEB[11].corner_left_front_y SwcOut_TOS_AEB[11].corner_right_front_x SwcOut_TOS_AEB[11].corner_right_front_y SwcOut_TOS_AEB[11].corner_left_rear_x SwcOut_TOS_AEB[11].corner_left_rear_y SwcOut_TOS_AEB[11].corner_right_rear_x SwcOut_TOS_AEB[11].corner_right_rear_y SwcOut_TOS_AEB[11].Object_ID SwcOut_TOS_AEB[11].camID SwcOut_TOS_AEB[11].Object_Age SwcOut_TOS_AEB[11].TimeStamp /end REF_MEASUREMENT
/end GROUP
/begin GROUP SwcOut_TOS_AEB[12] ""
 /begin REF_MEASUREMENT SwcOut_TOS_AEB[12].LeftLane_flag SwcOut_TOS_AEB[12].SameLane_flag SwcOut_TOS_AEB[12].RightLane_flag SwcOut_TOS_AEB[12].Object_Type SwcOut_TOS_AEB[12].Object_MovingState SwcOut_TOS_AEB[12].Object_Orientation SwcOut_TOS_AEB[12].Object_Turn_Signal SwcOut_TOS_AEB[12].Sceniaro_Flag SwcOut_TOS_AEB[12].CllsnMtgtnByBrkgPrimQly SwcOut_TOS_AEB[12].CllsnMtgtnByBrkgSecQly SwcOut_TOS_AEB[12].CllsnWarnFwdQly SwcOut_TOS_AEB[12].ramp SwcOut_TOS_AEB[12].Object_Fus_Type SwcOut_TOS_AEB[12].pro_flag SwcOut_TOS_AEB[12].Object_Length SwcOut_TOS_AEB[12].Object_Width SwcOut_TOS_AEB[12].Object_Hight SwcOut_TOS_AEB[12].Object_HeadingAngle SwcOut_TOS_AEB[12].Object_YawAngle SwcOut_TOS_AEB[12].Object_DX SwcOut_TOS_AEB[12].Object_DY SwcOut_TOS_AEB[12].Object_RangeX SwcOut_TOS_AEB[12].Object_RangeY SwcOut_TOS_AEB[12].Object_VX SwcOut_TOS_AEB[12].Object_VY SwcOut_TOS_AEB[12].Object_Abs_SPEED SwcOut_TOS_AEB[12].Object_Abs_VX SwcOut_TOS_AEB[12].Object_Abs_VY SwcOut_TOS_AEB[12].Object_AX SwcOut_TOS_AEB[12].Object_AY SwcOut_TOS_AEB[12].Object_Abs_AX SwcOut_TOS_AEB[12].Object_Abs_AY SwcOut_TOS_AEB[12].corner_left_front_x SwcOut_TOS_AEB[12].corner_left_front_y SwcOut_TOS_AEB[12].corner_right_front_x SwcOut_TOS_AEB[12].corner_right_front_y SwcOut_TOS_AEB[12].corner_left_rear_x SwcOut_TOS_AEB[12].corner_left_rear_y SwcOut_TOS_AEB[12].corner_right_rear_x SwcOut_TOS_AEB[12].corner_right_rear_y SwcOut_TOS_AEB[12].Object_ID SwcOut_TOS_AEB[12].camID SwcOut_TOS_AEB[12].Object_Age SwcOut_TOS_AEB[12].TimeStamp /end REF_MEASUREMENT
/end GROUP
/begin GROUP SwcOut_TOS_AEB[13] ""
 /begin REF_MEASUREMENT SwcOut_TOS_AEB[13].LeftLane_flag SwcOut_TOS_AEB[13].SameLane_flag SwcOut_TOS_AEB[13].RightLane_flag SwcOut_TOS_AEB[13].Object_Type SwcOut_TOS_AEB[13].Object_MovingState SwcOut_TOS_AEB[13].Object_Orientation SwcOut_TOS_AEB[13].Object_Turn_Signal SwcOut_TOS_AEB[13].Sceniaro_Flag SwcOut_TOS_AEB[13].CllsnMtgtnByBrkgPrimQly SwcOut_TOS_AEB[13].CllsnMtgtnByBrkgSecQly SwcOut_TOS_AEB[13].CllsnWarnFwdQly SwcOut_TOS_AEB[13].ramp SwcOut_TOS_AEB[13].Object_Fus_Type SwcOut_TOS_AEB[13].pro_flag SwcOut_TOS_AEB[13].Object_Length SwcOut_TOS_AEB[13].Object_Width SwcOut_TOS_AEB[13].Object_Hight SwcOut_TOS_AEB[13].Object_HeadingAngle SwcOut_TOS_AEB[13].Object_YawAngle SwcOut_TOS_AEB[13].Object_DX SwcOut_TOS_AEB[13].Object_DY SwcOut_TOS_AEB[13].Object_RangeX SwcOut_TOS_AEB[13].Object_RangeY SwcOut_TOS_AEB[13].Object_VX SwcOut_TOS_AEB[13].Object_VY SwcOut_TOS_AEB[13].Object_Abs_SPEED SwcOut_TOS_AEB[13].Object_Abs_VX SwcOut_TOS_AEB[13].Object_Abs_VY SwcOut_TOS_AEB[13].Object_AX SwcOut_TOS_AEB[13].Object_AY SwcOut_TOS_AEB[13].Object_Abs_AX SwcOut_TOS_AEB[13].Object_Abs_AY SwcOut_TOS_AEB[13].corner_left_front_x SwcOut_TOS_AEB[13].corner_left_front_y SwcOut_TOS_AEB[13].corner_right_front_x SwcOut_TOS_AEB[13].corner_right_front_y SwcOut_TOS_AEB[13].corner_left_rear_x SwcOut_TOS_AEB[13].corner_left_rear_y SwcOut_TOS_AEB[13].corner_right_rear_x SwcOut_TOS_AEB[13].corner_right_rear_y SwcOut_TOS_AEB[13].Object_ID SwcOut_TOS_AEB[13].camID SwcOut_TOS_AEB[13].Object_Age SwcOut_TOS_AEB[13].TimeStamp /end REF_MEASUREMENT
/end GROUP
/begin GROUP SwcOut_TOS_AEB[14] ""
 /begin REF_MEASUREMENT SwcOut_TOS_AEB[14].LeftLane_flag SwcOut_TOS_AEB[14].SameLane_flag SwcOut_TOS_AEB[14].RightLane_flag SwcOut_TOS_AEB[14].Object_Type SwcOut_TOS_AEB[14].Object_MovingState SwcOut_TOS_AEB[14].Object_Orientation SwcOut_TOS_AEB[14].Object_Turn_Signal SwcOut_TOS_AEB[14].Sceniaro_Flag SwcOut_TOS_AEB[14].CllsnMtgtnByBrkgPrimQly SwcOut_TOS_AEB[14].CllsnMtgtnByBrkgSecQly SwcOut_TOS_AEB[14].CllsnWarnFwdQly SwcOut_TOS_AEB[14].ramp SwcOut_TOS_AEB[14].Object_Fus_Type SwcOut_TOS_AEB[14].pro_flag SwcOut_TOS_AEB[14].Object_Length SwcOut_TOS_AEB[14].Object_Width SwcOut_TOS_AEB[14].Object_Hight SwcOut_TOS_AEB[14].Object_HeadingAngle SwcOut_TOS_AEB[14].Object_YawAngle SwcOut_TOS_AEB[14].Object_DX SwcOut_TOS_AEB[14].Object_DY SwcOut_TOS_AEB[14].Object_RangeX SwcOut_TOS_AEB[14].Object_RangeY SwcOut_TOS_AEB[14].Object_VX SwcOut_TOS_AEB[14].Object_VY SwcOut_TOS_AEB[14].Object_Abs_SPEED SwcOut_TOS_AEB[14].Object_Abs_VX SwcOut_TOS_AEB[14].Object_Abs_VY SwcOut_TOS_AEB[14].Object_AX SwcOut_TOS_AEB[14].Object_AY SwcOut_TOS_AEB[14].Object_Abs_AX SwcOut_TOS_AEB[14].Object_Abs_AY SwcOut_TOS_AEB[14].corner_left_front_x SwcOut_TOS_AEB[14].corner_left_front_y SwcOut_TOS_AEB[14].corner_right_front_x SwcOut_TOS_AEB[14].corner_right_front_y SwcOut_TOS_AEB[14].corner_left_rear_x SwcOut_TOS_AEB[14].corner_left_rear_y SwcOut_TOS_AEB[14].corner_right_rear_x SwcOut_TOS_AEB[14].corner_right_rear_y SwcOut_TOS_AEB[14].Object_ID SwcOut_TOS_AEB[14].camID SwcOut_TOS_AEB[14].Object_Age SwcOut_TOS_AEB[14].TimeStamp /end REF_MEASUREMENT
/end GROUP
/begin GROUP SwcOut_TOS_AEB[15] ""
 /begin REF_MEASUREMENT SwcOut_TOS_AEB[15].LeftLane_flag SwcOut_TOS_AEB[15].SameLane_flag SwcOut_TOS_AEB[15].RightLane_flag SwcOut_TOS_AEB[15].Object_Type SwcOut_TOS_AEB[15].Object_MovingState SwcOut_TOS_AEB[15].Object_Orientation SwcOut_TOS_AEB[15].Object_Turn_Signal SwcOut_TOS_AEB[15].Sceniaro_Flag SwcOut_TOS_AEB[15].CllsnMtgtnByBrkgPrimQly SwcOut_TOS_AEB[15].CllsnMtgtnByBrkgSecQly SwcOut_TOS_AEB[15].CllsnWarnFwdQly SwcOut_TOS_AEB[15].ramp SwcOut_TOS_AEB[15].Object_Fus_Type SwcOut_TOS_AEB[15].pro_flag SwcOut_TOS_AEB[15].Object_Length SwcOut_TOS_AEB[15].Object_Width SwcOut_TOS_AEB[15].Object_Hight SwcOut_TOS_AEB[15].Object_HeadingAngle SwcOut_TOS_AEB[15].Object_YawAngle SwcOut_TOS_AEB[15].Object_DX SwcOut_TOS_AEB[15].Object_DY SwcOut_TOS_AEB[15].Object_RangeX SwcOut_TOS_AEB[15].Object_RangeY SwcOut_TOS_AEB[15].Object_VX SwcOut_TOS_AEB[15].Object_VY SwcOut_TOS_AEB[15].Object_Abs_SPEED SwcOut_TOS_AEB[15].Object_Abs_VX SwcOut_TOS_AEB[15].Object_Abs_VY SwcOut_TOS_AEB[15].Object_AX SwcOut_TOS_AEB[15].Object_AY SwcOut_TOS_AEB[15].Object_Abs_AX SwcOut_TOS_AEB[15].Object_Abs_AY SwcOut_TOS_AEB[15].corner_left_front_x SwcOut_TOS_AEB[15].corner_left_front_y SwcOut_TOS_AEB[15].corner_right_front_x SwcOut_TOS_AEB[15].corner_right_front_y SwcOut_TOS_AEB[15].corner_left_rear_x SwcOut_TOS_AEB[15].corner_left_rear_y SwcOut_TOS_AEB[15].corner_right_rear_x SwcOut_TOS_AEB[15].corner_right_rear_y SwcOut_TOS_AEB[15].Object_ID SwcOut_TOS_AEB[15].camID SwcOut_TOS_AEB[15].Object_Age SwcOut_TOS_AEB[15].TimeStamp /end REF_MEASUREMENT
/end GROUP
/begin GROUP SwcOut_TOS_AEB[16] ""
 /begin REF_MEASUREMENT SwcOut_TOS_AEB[16].LeftLane_flag SwcOut_TOS_AEB[16].SameLane_flag SwcOut_TOS_AEB[16].RightLane_flag SwcOut_TOS_AEB[16].Object_Type SwcOut_TOS_AEB[16].Object_MovingState SwcOut_TOS_AEB[16].Object_Orientation SwcOut_TOS_AEB[16].Object_Turn_Signal SwcOut_TOS_AEB[16].Sceniaro_Flag SwcOut_TOS_AEB[16].CllsnMtgtnByBrkgPrimQly SwcOut_TOS_AEB[16].CllsnMtgtnByBrkgSecQly SwcOut_TOS_AEB[16].CllsnWarnFwdQly SwcOut_TOS_AEB[16].ramp SwcOut_TOS_AEB[16].Object_Fus_Type SwcOut_TOS_AEB[16].pro_flag SwcOut_TOS_AEB[16].Object_Length SwcOut_TOS_AEB[16].Object_Width SwcOut_TOS_AEB[16].Object_Hight SwcOut_TOS_AEB[16].Object_HeadingAngle SwcOut_TOS_AEB[16].Object_YawAngle SwcOut_TOS_AEB[16].Object_DX SwcOut_TOS_AEB[16].Object_DY SwcOut_TOS_AEB[16].Object_RangeX SwcOut_TOS_AEB[16].Object_RangeY SwcOut_TOS_AEB[16].Object_VX SwcOut_TOS_AEB[16].Object_VY SwcOut_TOS_AEB[16].Object_Abs_SPEED SwcOut_TOS_AEB[16].Object_Abs_VX SwcOut_TOS_AEB[16].Object_Abs_VY SwcOut_TOS_AEB[16].Object_AX SwcOut_TOS_AEB[16].Object_AY SwcOut_TOS_AEB[16].Object_Abs_AX SwcOut_TOS_AEB[16].Object_Abs_AY SwcOut_TOS_AEB[16].corner_left_front_x SwcOut_TOS_AEB[16].corner_left_front_y SwcOut_TOS_AEB[16].corner_right_front_x SwcOut_TOS_AEB[16].corner_right_front_y SwcOut_TOS_AEB[16].corner_left_rear_x SwcOut_TOS_AEB[16].corner_left_rear_y SwcOut_TOS_AEB[16].corner_right_rear_x SwcOut_TOS_AEB[16].corner_right_rear_y SwcOut_TOS_AEB[16].Object_ID SwcOut_TOS_AEB[16].camID SwcOut_TOS_AEB[16].Object_Age SwcOut_TOS_AEB[16].TimeStamp /end REF_MEASUREMENT
/end GROUP
/end MODULE
/end PROJECT
