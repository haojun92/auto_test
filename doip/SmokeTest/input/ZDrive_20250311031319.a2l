ASAP2_VERSION 1 71
/begin PROJECT ProjectName ""
/begin MODULE ModuleName ""
/begin MOD_COMMON "" BYTE_ORDER MSB_LAST ALIGNMENT_BYTE 1 ALIGNMENT_WORD 1 ALIGNMENT_LONG 1 ALIGNMENT_INT64 1 ALIGNMENT_FLOAT16_IEEE 1 ALIGNMENT_FLOAT32_IEEE 1 ALIGNMENT_FLOAT64_IEEE 1 /end MOD_COMMON
/begin RECORD_LAYOUT __ULONG_S FNC_VALUES 1 ULONG COLUMN_DIR DIRECT /end RECORD_LAYOUT
/begin MEASUREMENT autosar_swc_aeb_rtARID_DEF.ObjData_i[4].Offsets.OffsLatInPathCloseEdge "" FLOAT32_IEEE autosar_swc_aeb_CM_single 0 0 -3.4E+38 3.4E+38 ECU_ADDRESS 0xfe4a52dc /* @ECU_Address@autosar_swc_aeb_rtARID_DEF.ObjData_i[4].Offsets.OffsLatInPathCloseEdge@ */ /end MEASUREMENT
/begin MEASUREMENT autosar_swc_aeb_rtARID_DEF.ObjData_i[4].Offsets.OffsLatInPathFarEdge "" FLOAT32_IEEE autosar_swc_aeb_CM_single 0 0 -3.4E+38 3.4E+38 ECU_ADDRESS 0xfe4a52e0 /* @ECU_Address@autosar_swc_aeb_rtARID_DEF.ObjData_i[4].Offsets.OffsLatInPathFarEdge@ */ /end MEASUREMENT
/begin MEASUREMENT autosar_swc_aeb_rtARID_DEF.ObjData_i[4].Offsets.OffsLatInPathPrimaryTarget "" FLOAT32_IEEE autosar_swc_aeb_CM_single 0 0 -3.4E+38 3.4E+38 ECU_ADDRESS 0xfe4a52d8 /* @ECU_Address@autosar_swc_aeb_rtARID_DEF.ObjData_i[4].Offsets.OffsLatInPathPrimaryTarget@ */ /end MEASUREMENT
/begin MEASUREMENT autosar_swc_aeb_rtARID_DEF.ObjData_i[4].Offsets.OffsLatIntersection "" FLOAT32_IEEE autosar_swc_aeb_CM_single 0 0 -3.4E+38 3.4E+38 ECU_ADDRESS 0xfe4a52e4 /* @ECU_Address@autosar_swc_aeb_rtARID_DEF.ObjData_i[4].Offsets.OffsLatIntersection@ */ /end MEASUREMENT
/begin MEASUREMENT autosar_swc_aeb_rtARID_DEF.ObjData_i[4].Offsets.OffsLatLongPred "" FLOAT32_IEEE autosar_swc_aeb_CM_single 0 0 -3.4E+38 3.4E+38 ECU_ADDRESS 0xfe4a52c8 /* @ECU_Address@autosar_swc_aeb_rtARID_DEF.ObjData_i[4].Offsets.OffsLatLongPred@ */ /end MEASUREMENT
/begin MEASUREMENT autosar_swc_aeb_rtARID_DEF.ObjData_i[4].Offsets.OffsLatManoeuvre "" FLOAT32_IEEE autosar_swc_aeb_CM_single 0 0 -3.4E+38 3.4E+38 ECU_ADDRESS 0xfe4a52d4 /* @ECU_Address@autosar_swc_aeb_rtARID_DEF.ObjData_i[4].Offsets.OffsLatManoeuvre@ */ /end MEASUREMENT
/begin MEASUREMENT autosar_swc_aeb_rtARID_DEF.ObjData_i[4].Offsets.OffsLatMplTar "" FLOAT32_IEEE autosar_swc_aeb_CM_single 0 0 -3.4E+38 3.4E+38 ECU_ADDRESS 0xfe4a52e8 /* @ECU_Address@autosar_swc_aeb_rtARID_DEF.ObjData_i[4].Offsets.OffsLatMplTar@ */ /end MEASUREMENT
/begin MEASUREMENT autosar_swc_aeb_rtARID_DEF.ObjData_i[4].Offsets.OffsLatShortPred "" FLOAT32_IEEE autosar_swc_aeb_CM_single 0 0 -3.4E+38 3.4E+38 ECU_ADDRESS 0xfe4a52d0 /* @ECU_Address@autosar_swc_aeb_rtARID_DEF.ObjData_i[4].Offsets.OffsLatShortPred@ */ /end MEASUREMENT
/begin MEASUREMENT autosar_swc_aeb_rtARID_DEF.ObjData_i[4].Offsets.OffsLgtLongPred "" FLOAT32_IEEE autosar_swc_aeb_CM_single 0 0 -3.4E+38 3.4E+38 ECU_ADDRESS 0xfe4a52c4 /* @ECU_Address@autosar_swc_aeb_rtARID_DEF.ObjData_i[4].Offsets.OffsLgtLongPred@ */ /end MEASUREMENT
/begin MEASUREMENT autosar_swc_aeb_rtARID_DEF.ObjData_i[4].Offsets.OffsLgtShortPred "" FLOAT32_IEEE autosar_swc_aeb_CM_single 0 0 -3.4E+38 3.4E+38 ECU_ADDRESS 0xfe4a52cc /* @ECU_Address@autosar_swc_aeb_rtARID_DEF.ObjData_i[4].Offsets.OffsLgtShortPred@ */ /end MEASUREMENT
/begin MEASUREMENT autosar_swc_aeb_rtARID_DEF.ObjData_i[4].ShortPredTime.A "" FLOAT32_IEEE autosar_swc_aeb_CM_single 0 0 -3.4E+38 3.4E+38 ECU_ADDRESS 0xfe4a5324 /* @ECU_Address@autosar_swc_aeb_rtARID_DEF.ObjData_i[4].ShortPredTime.A@ */ /end MEASUREMENT
/begin MEASUREMENT autosar_swc_aeb_rtARID_DEF.ObjData_i[4].ShortPredTime.ALat "" FLOAT32_IEEE autosar_swc_aeb_CM_single 0 0 -3.4E+38 3.4E+38 ECU_ADDRESS 0xfe4a5320 /* @ECU_Address@autosar_swc_aeb_rtARID_DEF.ObjData_i[4].ShortPredTime.ALat@ */ /end MEASUREMENT
/begin MEASUREMENT autosar_swc_aeb_rtARID_DEF.ObjData_i[4].ShortPredTime.ALgt "" FLOAT32_IEEE autosar_swc_aeb_CM_single 0 0 -3.4E+38 3.4E+38 ECU_ADDRESS 0xfe4a531c /* @ECU_Address@autosar_swc_aeb_rtARID_DEF.ObjData_i[4].ShortPredTime.ALgt@ */ /end MEASUREMENT
/begin MEASUREMENT autosar_swc_aeb_rtARID_DEF.ObjData_i[4].ShortPredTime.Crvt "" FLOAT32_IEEE autosar_swc_aeb_CM_single 0 0 -3.4E+38 3.4E+38 ECU_ADDRESS 0xfe4a5328 /* @ECU_Address@autosar_swc_aeb_rtARID_DEF.ObjData_i[4].ShortPredTime.Crvt@ */ /end MEASUREMENT
/begin MEASUREMENT autosar_swc_aeb_rtARID_DEF.ObjData_i[4].ShortPredTime.InPath "" UBYTE autosar_swc_aeb_CM_logical 0 0 0 1 ECU_ADDRESS 0xfe4a5319 /* @ECU_Address@autosar_swc_aeb_rtARID_DEF.ObjData_i[4].ShortPredTime.InPath@ */ /end MEASUREMENT
/begin MEASUREMENT autosar_swc_aeb_rtARID_DEF.ObjData_i[4].ShortPredTime.ObjOnCmngAndBrkg "" UBYTE autosar_swc_aeb_CM_logical 0 0 0 1 ECU_ADDRESS 0xfe4a531a /* @ECU_Address@autosar_swc_aeb_rtARID_DEF.ObjData_i[4].ShortPredTime.ObjOnCmngAndBrkg@ */ /end MEASUREMENT
/begin MEASUREMENT autosar_swc_aeb_rtARID_DEF.ObjData_i[4].ShortPredTime.TTMSelected "" UBYTE autosar_swc_aeb_CM_logical 0 0 0 1 ECU_ADDRESS 0xfe4a5318 /* @ECU_Address@autosar_swc_aeb_rtARID_DEF.ObjData_i[4].ShortPredTime.TTMSelected@ */ /end MEASUREMENT
/begin MEASUREMENT autosar_swc_aeb_rtARID_DEF.ObjData_i[4].ShortPredTime.TimeToMiddleLgt "" FLOAT32_IEEE autosar_swc_aeb_CM_single 0 0 -3.4E+38 3.4E+38 ECU_ADDRESS 0xfe4a5310 /* @ECU_Address@autosar_swc_aeb_rtARID_DEF.ObjData_i[4].ShortPredTime.TimeToMiddleLgt@ */ /end MEASUREMENT
/begin MEASUREMENT autosar_swc_aeb_rtARID_DEF.ObjData_i[4].ShortPredTime.TimeToPassLgt "" FLOAT32_IEEE autosar_swc_aeb_CM_single 0 0 -3.4E+38 3.4E+38 ECU_ADDRESS 0xfe4a5314 /* @ECU_Address@autosar_swc_aeb_rtARID_DEF.ObjData_i[4].ShortPredTime.TimeToPassLgt@ */ /end MEASUREMENT
/begin MEASUREMENT autosar_swc_aeb_rtARID_DEF.ObjData_i[4].ShortPredTime.TimeToReachLgt "" FLOAT32_IEEE autosar_swc_aeb_CM_single 0 0 -3.4E+38 3.4E+38 ECU_ADDRESS 0xfe4a530c /* @ECU_Address@autosar_swc_aeb_rtARID_DEF.ObjData_i[4].ShortPredTime.TimeToReachLgt@ */ /end MEASUREMENT
/begin MEASUREMENT autosar_swc_aeb_rtARID_DEF.ObjData_i[5].BoundingBox.CosRotation "" FLOAT32_IEEE autosar_swc_aeb_CM_single 0 0 -3.4E+38 3.4E+38 ECU_ADDRESS 0xfe4a5348 /* @ECU_Address@autosar_swc_aeb_rtARID_DEF.ObjData_i[5].BoundingBox.CosRotation@ */ /end MEASUREMENT
/begin MEASUREMENT autosar_swc_aeb_rtARID_DEF.ObjData_i[5].BoundingBox.LengthSideLat "" FLOAT32_IEEE autosar_swc_aeb_CM_single 0 0 -3.4E+38 3.4E+38 ECU_ADDRESS 0xfe4a533c /* @ECU_Address@autosar_swc_aeb_rtARID_DEF.ObjData_i[5].BoundingBox.LengthSideLat@ */ /end MEASUREMENT
/begin MEASUREMENT autosar_swc_aeb_rtARID_DEF.ObjData_i[5].BoundingBox.LengthSideLgt "" FLOAT32_IEEE autosar_swc_aeb_CM_single 0 0 -3.4E+38 3.4E+38 ECU_ADDRESS 0xfe4a5340 /* @ECU_Address@autosar_swc_aeb_rtARID_DEF.ObjData_i[5].BoundingBox.LengthSideLgt@ */ /end MEASUREMENT
/begin MEASUREMENT autosar_swc_aeb_rtARID_DEF.ObjData_i[5].BoundingBox.RotationAngle "" FLOAT32_IEEE autosar_swc_aeb_CM_single 0 0 -3.4E+38 3.4E+38 ECU_ADDRESS 0xfe4a534c /* @ECU_Address@autosar_swc_aeb_rtARID_DEF.ObjData_i[5].BoundingBox.RotationAngle@ */ /end MEASUREMENT
/begin MEASUREMENT autosar_swc_aeb_rtARID_DEF.ObjData_i[5].BoundingBox.SinRotation "" FLOAT32_IEEE autosar_swc_aeb_CM_single 0 0 -3.4E+38 3.4E+38 ECU_ADDRESS 0xfe4a5344 /* @ECU_Address@autosar_swc_aeb_rtARID_DEF.ObjData_i[5].BoundingBox.SinRotation@ */ /end MEASUREMENT
/begin MEASUREMENT autosar_swc_aeb_rtARID_DEF.ObjData_i[5].Idn "" ULONG autosar_swc_aeb_CM_uint32 0 0 0 4294967295 ECU_ADDRESS 0xfe4a53bc /* @ECU_Address@autosar_swc_aeb_rtARID_DEF.ObjData_i[5].Idn@ */ /end MEASUREMENT
/begin MEASUREMENT autosar_swc_aeb_rtARID_DEF.ObjData_i[5].InPathAtCurrentPosition "" UBYTE autosar_swc_aeb_CM_logical 0 0 0 1 ECU_ADDRESS 0xfe4a5350 /* @ECU_Address@autosar_swc_aeb_rtARID_DEF.ObjData_i[5].InPathAtCurrentPosition@ */ /end MEASUREMENT
/begin MEASUREMENT autosar_swc_aeb_rtARID_DEF.ObjData_i[5].LongPredTime.A "" FLOAT32_IEEE autosar_swc_aeb_CM_single 0 0 -3.4E+38 3.4E+38 ECU_ADDRESS 0xfe4a5394 /* @ECU_Address@autosar_swc_aeb_rtARID_DEF.ObjData_i[5].LongPredTime.A@ */ /end MEASUREMENT
/begin MEASUREMENT autosar_swc_aeb_rtARID_DEF.ObjData_i[5].LongPredTime.ALat "" FLOAT32_IEEE autosar_swc_aeb_CM_single 0 0 -3.4E+38 3.4E+38 ECU_ADDRESS 0xfe4a5390 /* @ECU_Address@autosar_swc_aeb_rtARID_DEF.ObjData_i[5].LongPredTime.ALat@ */ /end MEASUREMENT
/begin MEASUREMENT autosar_swc_aeb_rtARID_DEF.ObjData_i[5].LongPredTime.ALgt "" FLOAT32_IEEE autosar_swc_aeb_CM_single 0 0 -3.4E+38 3.4E+38 ECU_ADDRESS 0xfe4a538c /* @ECU_Address@autosar_swc_aeb_rtARID_DEF.ObjData_i[5].LongPredTime.ALgt@ */ /end MEASUREMENT
/begin MEASUREMENT autosar_swc_aeb_rtARID_DEF.ObjData_i[5].LongPredTime.Crvt "" FLOAT32_IEEE autosar_swc_aeb_CM_single 0 0 -3.4E+38 3.4E+38 ECU_ADDRESS 0xfe4a5398 /* @ECU_Address@autosar_swc_aeb_rtARID_DEF.ObjData_i[5].LongPredTime.Crvt@ */ /end MEASUREMENT
/begin MEASUREMENT autosar_swc_aeb_rtARID_DEF.ObjData_i[5].LongPredTime.InPath "" UBYTE autosar_swc_aeb_CM_logical 0 0 0 1 ECU_ADDRESS 0xfe4a5389 /* @ECU_Address@autosar_swc_aeb_rtARID_DEF.ObjData_i[5].LongPredTime.InPath@ */ /end MEASUREMENT
/begin MEASUREMENT autosar_swc_aeb_rtARID_DEF.ObjData_i[5].LongPredTime.ObjOnCmngAndBrkg "" UBYTE autosar_swc_aeb_CM_logical 0 0 0 1 ECU_ADDRESS 0xfe4a538a /* @ECU_Address@autosar_swc_aeb_rtARID_DEF.ObjData_i[5].LongPredTime.ObjOnCmngAndBrkg@ */ /end MEASUREMENT
/begin MEASUREMENT autosar_swc_aeb_rtARID_DEF.ObjData_i[5].LongPredTime.TTMSelected "" UBYTE autosar_swc_aeb_CM_logical 0 0 0 1 ECU_ADDRESS 0xfe4a5388 /* @ECU_Address@autosar_swc_aeb_rtARID_DEF.ObjData_i[5].LongPredTime.TTMSelected@ */ /end MEASUREMENT
/begin MEASUREMENT autosar_swc_aeb_rtARID_DEF.ObjData_i[5].LongPredTime.TimeToMiddleLgt "" FLOAT32_IEEE autosar_swc_aeb_CM_single 0 0 -3.4E+38 3.4E+38 ECU_ADDRESS 0xfe4a5380 /* @ECU_Address@autosar_swc_aeb_rtARID_DEF.ObjData_i[5].LongPredTime.TimeToMiddleLgt@ */ /end MEASUREMENT
/begin MEASUREMENT autosar_swc_aeb_rtARID_DEF.ObjData_i[5].LongPredTime.TimeToPassLgt "" FLOAT32_IEEE autosar_swc_aeb_CM_single 0 0 -3.4E+38 3.4E+38 ECU_ADDRESS 0xfe4a5384 /* @ECU_Address@autosar_swc_aeb_rtARID_DEF.ObjData_i[5].LongPredTime.TimeToPassLgt@ */ /end MEASUREMENT
/begin MEASUREMENT autosar_swc_aeb_rtARID_DEF.ObjData_i[5].LongPredTime.TimeToReachLgt "" FLOAT32_IEEE autosar_swc_aeb_CM_single 0 0 -3.4E+38 3.4E+38 ECU_ADDRESS 0xfe4a537c /* @ECU_Address@autosar_swc_aeb_rtARID_DEF.ObjData_i[5].LongPredTime.TimeToReachLgt@ */ /end MEASUREMENT
/begin MEASUREMENT autosar_swc_aeb_rtARID_DEF.ObjData_i[5].MotionType.AbsHeading "" FLOAT32_IEEE autosar_swc_aeb_CM_single 0 0 -3.4E+38 3.4E+38 ECU_ADDRESS 0xfe4a5338 /* @ECU_Address@autosar_swc_aeb_rtARID_DEF.ObjData_i[5].MotionType.AbsHeading@ */ /end MEASUREMENT
/begin MEASUREMENT autosar_swc_aeb_rtARID_DEF.ObjData_i[5].MotionType.CurvedMotion "" UBYTE autosar_swc_aeb_CM_logical 0 0 0 1 ECU_ADDRESS 0xfe4a5336 /* @ECU_Address@autosar_swc_aeb_rtARID_DEF.ObjData_i[5].MotionType.CurvedMotion@ */ /end MEASUREMENT
/begin MEASUREMENT autosar_swc_aeb_rtARID_DEF.ObjData_i[5].MotionType.MovingOncoming "" UBYTE autosar_swc_aeb_CM_logical 0 0 0 1 ECU_ADDRESS 0xfe4a5331 /* @ECU_Address@autosar_swc_aeb_rtARID_DEF.ObjData_i[5].MotionType.MovingOncoming@ */ /end MEASUREMENT
/begin MEASUREMENT autosar_swc_aeb_rtARID_DEF.ObjData_i[5].MotionType.ObjectIsMotorVehicle "Object type is Car, Truck, Motorcycle or Vehicle Of Unkown Class." UBYTE autosar_swc_aeb_CM_logical 0 0 0 1 ECU_ADDRESS 0xfe4a5335 /* @ECU_Address@autosar_swc_aeb_rtARID_DEF.ObjData_i[5].MotionType.ObjectIsMotorVehicle@ */ /end MEASUREMENT
/begin MEASUREMENT autosar_swc_aeb_rtARID_DEF.ObjData_i[5].MotionType.ObjectIsVehicle "" UBYTE autosar_swc_aeb_CM_logical 0 0 0 1 ECU_ADDRESS 0xfe4a5334 /* @ECU_Address@autosar_swc_aeb_rtARID_DEF.ObjData_i[5].MotionType.ObjectIsVehicle@ */ /end MEASUREMENT
/begin MEASUREMENT autosar_swc_aeb_rtARID_DEF.ObjData_i[5].MotionType.ParallellVehicleLongPred "" UBYTE autosar_swc_aeb_CM_logical 0 0 0 1 ECU_ADDRESS 0xfe4a5332 /* @ECU_Address@autosar_swc_aeb_rtARID_DEF.ObjData_i[5].MotionType.ParallellVehicleLongPred@ */ /end MEASUREMENT
/begin MEASUREMENT autosar_swc_aeb_rtARID_DEF.ObjData_i[5].MotionType.ParallellVehicleShortPred "" UBYTE autosar_swc_aeb_CM_logical 0 0 0 1 ECU_ADDRESS 0xfe4a5333 /* @ECU_Address@autosar_swc_aeb_rtARID_DEF.ObjData_i[5].MotionType.ParallellVehicleShortPred@ */ /end MEASUREMENT
/begin MEASUREMENT autosar_swc_aeb_rtARID_DEF.ObjData_i[5].MotionType.SideIsClosest "" UBYTE autosar_swc_aeb_CM_logical 0 0 0 1 ECU_ADDRESS 0xfe4a5337 /* @ECU_Address@autosar_swc_aeb_rtARID_DEF.ObjData_i[5].MotionType.SideIsClosest@ */ /end MEASUREMENT
/begin MEASUREMENT autosar_swc_aeb_rtARID_DEF.ObjData_i[5].MotionType.Stationary "" UBYTE autosar_swc_aeb_CM_logical 0 0 0 1 ECU_ADDRESS 0xfe4a5330 /* @ECU_Address@autosar_swc_aeb_rtARID_DEF.ObjData_i[5].MotionType.Stationary@ */ /end MEASUREMENT
/begin MEASUREMENT autosar_swc_aeb_rtARID_DEF.ObjData_i[5].Offsets.OffsLatInPathCloseEdge "" FLOAT32_IEEE autosar_swc_aeb_CM_single 0 0 -3.4E+38 3.4E+38 ECU_ADDRESS 0xfe4a536c /* @ECU_Address@autosar_swc_aeb_rtARID_DEF.ObjData_i[5].Offsets.OffsLatInPathCloseEdge@ */ /end MEASUREMENT
/begin MEASUREMENT autosar_swc_aeb_rtARID_DEF.ObjData_i[5].Offsets.OffsLatInPathFarEdge "" FLOAT32_IEEE autosar_swc_aeb_CM_single 0 0 -3.4E+38 3.4E+38 ECU_ADDRESS 0xfe4a5370 /* @ECU_Address@autosar_swc_aeb_rtARID_DEF.ObjData_i[5].Offsets.OffsLatInPathFarEdge@ */ /end MEASUREMENT
/begin MEASUREMENT autosar_swc_aeb_rtARID_DEF.ObjData_i[5].Offsets.OffsLatInPathPrimaryTarget "" FLOAT32_IEEE autosar_swc_aeb_CM_single 0 0 -3.4E+38 3.4E+38 ECU_ADDRESS 0xfe4a5368 /* @ECU_Address@autosar_swc_aeb_rtARID_DEF.ObjData_i[5].Offsets.OffsLatInPathPrimaryTarget@ */ /end MEASUREMENT
/begin MEASUREMENT autosar_swc_aeb_rtARID_DEF.ObjData_i[5].Offsets.OffsLatIntersection "" FLOAT32_IEEE autosar_swc_aeb_CM_single 0 0 -3.4E+38 3.4E+38 ECU_ADDRESS 0xfe4a5374 /* @ECU_Address@autosar_swc_aeb_rtARID_DEF.ObjData_i[5].Offsets.OffsLatIntersection@ */ /end MEASUREMENT
/begin MEASUREMENT autosar_swc_aeb_rtARID_DEF.ObjData_i[5].Offsets.OffsLatLongPred "" FLOAT32_IEEE autosar_swc_aeb_CM_single 0 0 -3.4E+38 3.4E+38 ECU_ADDRESS 0xfe4a5358 /* @ECU_Address@autosar_swc_aeb_rtARID_DEF.ObjData_i[5].Offsets.OffsLatLongPred@ */ /end MEASUREMENT
/begin MEASUREMENT autosar_swc_aeb_rtARID_DEF.ObjData_i[5].Offsets.OffsLatManoeuvre "" FLOAT32_IEEE autosar_swc_aeb_CM_single 0 0 -3.4E+38 3.4E+38 ECU_ADDRESS 0xfe4a5364 /* @ECU_Address@autosar_swc_aeb_rtARID_DEF.ObjData_i[5].Offsets.OffsLatManoeuvre@ */ /end MEASUREMENT
/begin MEASUREMENT autosar_swc_aeb_rtARID_DEF.ObjData_i[5].Offsets.OffsLatMplTar "" FLOAT32_IEEE autosar_swc_aeb_CM_single 0 0 -3.4E+38 3.4E+38 ECU_ADDRESS 0xfe4a5378 /* @ECU_Address@autosar_swc_aeb_rtARID_DEF.ObjData_i[5].Offsets.OffsLatMplTar@ */ /end MEASUREMENT
/begin MEASUREMENT autosar_swc_aeb_rtARID_DEF.ObjData_i[5].Offsets.OffsLatShortPred "" FLOAT32_IEEE autosar_swc_aeb_CM_single 0 0 -3.4E+38 3.4E+38 ECU_ADDRESS 0xfe4a5360 /* @ECU_Address@autosar_swc_aeb_rtARID_DEF.ObjData_i[5].Offsets.OffsLatShortPred@ */ /end MEASUREMENT
/begin MEASUREMENT autosar_swc_aeb_rtARID_DEF.ObjData_i[5].Offsets.OffsLgtLongPred "" FLOAT32_IEEE autosar_swc_aeb_CM_single 0 0 -3.4E+38 3.4E+38 ECU_ADDRESS 0xfe4a5354 /* @ECU_Address@autosar_swc_aeb_rtARID_DEF.ObjData_i[5].Offsets.OffsLgtLongPred@ */ /end MEASUREMENT
/begin MEASUREMENT autosar_swc_aeb_rtARID_DEF.ObjData_i[5].Offsets.OffsLgtShortPred "" FLOAT32_IEEE autosar_swc_aeb_CM_single 0 0 -3.4E+38 3.4E+38 ECU_ADDRESS 0xfe4a535c /* @ECU_Address@autosar_swc_aeb_rtARID_DEF.ObjData_i[5].Offsets.OffsLgtShortPred@ */ /end MEASUREMENT
/begin MEASUREMENT autosar_swc_aeb_rtARID_DEF.ObjData_i[5].PredictionValid "" UBYTE autosar_swc_aeb_CM_logical 0 0 0 1 ECU_ADDRESS 0xfe4a5351 /* @ECU_Address@autosar_swc_aeb_rtARID_DEF.ObjData_i[5].PredictionValid@ */ /end MEASUREMENT
/begin MEASUREMENT autosar_swc_aeb_rtARID_DEF.ObjData_i[5].ShortPredTime.A "" FLOAT32_IEEE autosar_swc_aeb_CM_single 0 0 -3.4E+38 3.4E+38 ECU_ADDRESS 0xfe4a53b4 /* @ECU_Address@autosar_swc_aeb_rtARID_DEF.ObjData_i[5].ShortPredTime.A@ */ /end MEASUREMENT
/begin MEASUREMENT autosar_swc_aeb_rtARID_DEF.ObjData_i[5].ShortPredTime.ALat "" FLOAT32_IEEE autosar_swc_aeb_CM_single 0 0 -3.4E+38 3.4E+38 ECU_ADDRESS 0xfe4a53b0 /* @ECU_Address@autosar_swc_aeb_rtARID_DEF.ObjData_i[5].ShortPredTime.ALat@ */ /end MEASUREMENT
/begin MEASUREMENT autosar_swc_aeb_rtARID_DEF.ObjData_i[5].ShortPredTime.ALgt "" FLOAT32_IEEE autosar_swc_aeb_CM_single 0 0 -3.4E+38 3.4E+38 ECU_ADDRESS 0xfe4a53ac /* @ECU_Address@autosar_swc_aeb_rtARID_DEF.ObjData_i[5].ShortPredTime.ALgt@ */ /end MEASUREMENT
/begin MEASUREMENT autosar_swc_aeb_rtARID_DEF.ObjData_i[5].ShortPredTime.Crvt "" FLOAT32_IEEE autosar_swc_aeb_CM_single 0 0 -3.4E+38 3.4E+38 ECU_ADDRESS 0xfe4a53b8 /* @ECU_Address@autosar_swc_aeb_rtARID_DEF.ObjData_i[5].ShortPredTime.Crvt@ */ /end MEASUREMENT
/begin MEASUREMENT autosar_swc_aeb_rtARID_DEF.ObjData_i[5].ShortPredTime.InPath "" UBYTE autosar_swc_aeb_CM_logical 0 0 0 1 ECU_ADDRESS 0xfe4a53a9 /* @ECU_Address@autosar_swc_aeb_rtARID_DEF.ObjData_i[5].ShortPredTime.InPath@ */ /end MEASUREMENT
/begin MEASUREMENT autosar_swc_aeb_rtARID_DEF.ObjData_i[5].ShortPredTime.ObjOnCmngAndBrkg "" UBYTE autosar_swc_aeb_CM_logical 0 0 0 1 ECU_ADDRESS 0xfe4a53aa /* @ECU_Address@autosar_swc_aeb_rtARID_DEF.ObjData_i[5].ShortPredTime.ObjOnCmngAndBrkg@ */ /end MEASUREMENT
/begin MEASUREMENT autosar_swc_aeb_rtARID_DEF.ObjData_i[5].ShortPredTime.TTMSelected "" UBYTE autosar_swc_aeb_CM_logical 0 0 0 1 ECU_ADDRESS 0xfe4a53a8 /* @ECU_Address@autosar_swc_aeb_rtARID_DEF.ObjData_i[5].ShortPredTime.TTMSelected@ */ /end MEASUREMENT
/begin MEASUREMENT autosar_swc_aeb_rtARID_DEF.ObjData_i[5].ShortPredTime.TimeToMiddleLgt "" FLOAT32_IEEE autosar_swc_aeb_CM_single 0 0 -3.4E+38 3.4E+38 ECU_ADDRESS 0xfe4a53a0 /* @ECU_Address@autosar_swc_aeb_rtARID_DEF.ObjData_i[5].ShortPredTime.TimeToMiddleLgt@ */ /end MEASUREMENT
/begin MEASUREMENT autosar_swc_aeb_rtARID_DEF.ObjData_i[5].ShortPredTime.TimeToPassLgt "" FLOAT32_IEEE autosar_swc_aeb_CM_single 0 0 -3.4E+38 3.4E+38 ECU_ADDRESS 0xfe4a53a4 /* @ECU_Address@autosar_swc_aeb_rtARID_DEF.ObjData_i[5].ShortPredTime.TimeToPassLgt@ */ /end MEASUREMENT
/begin MEASUREMENT autosar_swc_aeb_rtARID_DEF.ObjData_i[5].ShortPredTime.TimeToReachLgt "" FLOAT32_IEEE autosar_swc_aeb_CM_single 0 0 -3.4E+38 3.4E+38 ECU_ADDRESS 0xfe4a539c /* @ECU_Address@autosar_swc_aeb_rtARID_DEF.ObjData_i[5].ShortPredTime.TimeToReachLgt@ */ /end MEASUREMENT
/begin MEASUREMENT autosar_swc_aeb_rtARID_DEF.ObjData_i[6].BoundingBox.CosRotation "" FLOAT32_IEEE autosar_swc_aeb_CM_single 0 0 -3.4E+38 3.4E+38 ECU_ADDRESS 0xfe4a53d8 /* @ECU_Address@autosar_swc_aeb_rtARID_DEF.ObjData_i[6].BoundingBox.CosRotation@ */ /end MEASUREMENT
/begin MEASUREMENT autosar_swc_aeb_rtARID_DEF.ObjData_i[6].BoundingBox.LengthSideLat "" FLOAT32_IEEE autosar_swc_aeb_CM_single 0 0 -3.4E+38 3.4E+38 ECU_ADDRESS 0xfe4a53cc /* @ECU_Address@autosar_swc_aeb_rtARID_DEF.ObjData_i[6].BoundingBox.LengthSideLat@ */ /end MEASUREMENT
/begin MEASUREMENT autosar_swc_aeb_rtARID_DEF.ObjData_i[6].BoundingBox.LengthSideLgt "" FLOAT32_IEEE autosar_swc_aeb_CM_single 0 0 -3.4E+38 3.4E+38 ECU_ADDRESS 0xfe4a53d0 /* @ECU_Address@autosar_swc_aeb_rtARID_DEF.ObjData_i[6].BoundingBox.LengthSideLgt@ */ /end MEASUREMENT
/begin MEASUREMENT autosar_swc_aeb_rtARID_DEF.ObjData_i[6].BoundingBox.RotationAngle "" FLOAT32_IEEE autosar_swc_aeb_CM_single 0 0 -3.4E+38 3.4E+38 ECU_ADDRESS 0xfe4a53dc /* @ECU_Address@autosar_swc_aeb_rtARID_DEF.ObjData_i[6].BoundingBox.RotationAngle@ */ /end MEASUREMENT
/begin MEASUREMENT autosar_swc_aeb_rtARID_DEF.ObjData_i[6].BoundingBox.SinRotation "" FLOAT32_IEEE autosar_swc_aeb_CM_single 0 0 -3.4E+38 3.4E+38 ECU_ADDRESS 0xfe4a53d4 /* @ECU_Address@autosar_swc_aeb_rtARID_DEF.ObjData_i[6].BoundingBox.SinRotation@ */ /end MEASUREMENT
/begin MEASUREMENT autosar_swc_aeb_rtARID_DEF.ObjData_i[6].Idn "" ULONG autosar_swc_aeb_CM_uint32 0 0 0 4294967295 ECU_ADDRESS 0xfe4a544c /* @ECU_Address@autosar_swc_aeb_rtARID_DEF.ObjData_i[6].Idn@ */ /end MEASUREMENT
/begin MEASUREMENT autosar_swc_aeb_rtARID_DEF.ObjData_i[6].InPathAtCurrentPosition "" UBYTE autosar_swc_aeb_CM_logical 0 0 0 1 ECU_ADDRESS 0xfe4a53e0 /* @ECU_Address@autosar_swc_aeb_rtARID_DEF.ObjData_i[6].InPathAtCurrentPosition@ */ /end MEASUREMENT
/begin MEASUREMENT autosar_swc_aeb_rtARID_DEF.ObjData_i[6].LongPredTime.A "" FLOAT32_IEEE autosar_swc_aeb_CM_single 0 0 -3.4E+38 3.4E+38 ECU_ADDRESS 0xfe4a5424 /* @ECU_Address@autosar_swc_aeb_rtARID_DEF.ObjData_i[6].LongPredTime.A@ */ /end MEASUREMENT
/begin MEASUREMENT autosar_swc_aeb_rtARID_DEF.ObjData_i[6].LongPredTime.ALat "" FLOAT32_IEEE autosar_swc_aeb_CM_single 0 0 -3.4E+38 3.4E+38 ECU_ADDRESS 0xfe4a5420 /* @ECU_Address@autosar_swc_aeb_rtARID_DEF.ObjData_i[6].LongPredTime.ALat@ */ /end MEASUREMENT
/begin MEASUREMENT autosar_swc_aeb_rtARID_DEF.ObjData_i[6].LongPredTime.ALgt "" FLOAT32_IEEE autosar_swc_aeb_CM_single 0 0 -3.4E+38 3.4E+38 ECU_ADDRESS 0xfe4a541c /* @ECU_Address@autosar_swc_aeb_rtARID_DEF.ObjData_i[6].LongPredTime.ALgt@ */ /end MEASUREMENT
/begin MEASUREMENT autosar_swc_aeb_rtARID_DEF.ObjData_i[6].LongPredTime.Crvt "" FLOAT32_IEEE autosar_swc_aeb_CM_single 0 0 -3.4E+38 3.4E+38 ECU_ADDRESS 0xfe4a5428 /* @ECU_Address@autosar_swc_aeb_rtARID_DEF.ObjData_i[6].LongPredTime.Crvt@ */ /end MEASUREMENT
/begin MEASUREMENT autosar_swc_aeb_rtARID_DEF.ObjData_i[6].LongPredTime.InPath "" UBYTE autosar_swc_aeb_CM_logical 0 0 0 1 ECU_ADDRESS 0xfe4a5419 /* @ECU_Address@autosar_swc_aeb_rtARID_DEF.ObjData_i[6].LongPredTime.InPath@ */ /end MEASUREMENT
/begin MEASUREMENT autosar_swc_aeb_rtARID_DEF.ObjData_i[6].LongPredTime.ObjOnCmngAndBrkg "" UBYTE autosar_swc_aeb_CM_logical 0 0 0 1 ECU_ADDRESS 0xfe4a541a /* @ECU_Address@autosar_swc_aeb_rtARID_DEF.ObjData_i[6].LongPredTime.ObjOnCmngAndBrkg@ */ /end MEASUREMENT
/begin MEASUREMENT autosar_swc_aeb_rtARID_DEF.ObjData_i[6].LongPredTime.TTMSelected "" UBYTE autosar_swc_aeb_CM_logical 0 0 0 1 ECU_ADDRESS 0xfe4a5418 /* @ECU_Address@autosar_swc_aeb_rtARID_DEF.ObjData_i[6].LongPredTime.TTMSelected@ */ /end MEASUREMENT
/begin MEASUREMENT autosar_swc_aeb_rtARID_DEF.ObjData_i[6].LongPredTime.TimeToMiddleLgt "" FLOAT32_IEEE autosar_swc_aeb_CM_single 0 0 -3.4E+38 3.4E+38 ECU_ADDRESS 0xfe4a5410 /* @ECU_Address@autosar_swc_aeb_rtARID_DEF.ObjData_i[6].LongPredTime.TimeToMiddleLgt@ */ /end MEASUREMENT
/begin MEASUREMENT autosar_swc_aeb_rtARID_DEF.ObjData_i[6].LongPredTime.TimeToPassLgt "" FLOAT32_IEEE autosar_swc_aeb_CM_single 0 0 -3.4E+38 3.4E+38 ECU_ADDRESS 0xfe4a5414 /* @ECU_Address@autosar_swc_aeb_rtARID_DEF.ObjData_i[6].LongPredTime.TimeToPassLgt@ */ /end MEASUREMENT
/begin MEASUREMENT autosar_swc_aeb_rtARID_DEF.ObjData_i[6].LongPredTime.TimeToReachLgt "" FLOAT32_IEEE autosar_swc_aeb_CM_single 0 0 -3.4E+38 3.4E+38 ECU_ADDRESS 0xfe4a540c /* @ECU_Address@autosar_swc_aeb_rtARID_DEF.ObjData_i[6].LongPredTime.TimeToReachLgt@ */ /end MEASUREMENT
/begin MEASUREMENT autosar_swc_aeb_rtARID_DEF.ObjData_i[6].MotionType.AbsHeading "" FLOAT32_IEEE autosar_swc_aeb_CM_single 0 0 -3.4E+38 3.4E+38 ECU_ADDRESS 0xfe4a53c8 /* @ECU_Address@autosar_swc_aeb_rtARID_DEF.ObjData_i[6].MotionType.AbsHeading@ */ /end MEASUREMENT
/begin MEASUREMENT autosar_swc_aeb_rtARID_DEF.ObjData_i[6].MotionType.CurvedMotion "" UBYTE autosar_swc_aeb_CM_logical 0 0 0 1 ECU_ADDRESS 0xfe4a53c6 /* @ECU_Address@autosar_swc_aeb_rtARID_DEF.ObjData_i[6].MotionType.CurvedMotion@ */ /end MEASUREMENT
/begin MEASUREMENT autosar_swc_aeb_rtARID_DEF.ObjData_i[6].MotionType.MovingOncoming "" UBYTE autosar_swc_aeb_CM_logical 0 0 0 1 ECU_ADDRESS 0xfe4a53c1 /* @ECU_Address@autosar_swc_aeb_rtARID_DEF.ObjData_i[6].MotionType.MovingOncoming@ */ /end MEASUREMENT
/begin MEASUREMENT autosar_swc_aeb_rtARID_DEF.ObjData_i[6].MotionType.ObjectIsMotorVehicle "Object type is Car, Truck, Motorcycle or Vehicle Of Unkown Class." UBYTE autosar_swc_aeb_CM_logical 0 0 0 1 ECU_ADDRESS 0xfe4a53c5 /* @ECU_Address@autosar_swc_aeb_rtARID_DEF.ObjData_i[6].MotionType.ObjectIsMotorVehicle@ */ /end MEASUREMENT
/begin MEASUREMENT autosar_swc_aeb_rtARID_DEF.ObjData_i[6].MotionType.ObjectIsVehicle "" UBYTE autosar_swc_aeb_CM_logical 0 0 0 1 ECU_ADDRESS 0xfe4a53c4 /* @ECU_Address@autosar_swc_aeb_rtARID_DEF.ObjData_i[6].MotionType.ObjectIsVehicle@ */ /end MEASUREMENT
/begin MEASUREMENT autosar_swc_aeb_rtARID_DEF.ObjData_i[6].MotionType.ParallellVehicleLongPred "" UBYTE autosar_swc_aeb_CM_logical 0 0 0 1 ECU_ADDRESS 0xfe4a53c2 /* @ECU_Address@autosar_swc_aeb_rtARID_DEF.ObjData_i[6].MotionType.ParallellVehicleLongPred@ */ /end MEASUREMENT
/begin MEASUREMENT autosar_swc_aeb_rtARID_DEF.ObjData_i[6].MotionType.ParallellVehicleShortPred "" UBYTE autosar_swc_aeb_CM_logical 0 0 0 1 ECU_ADDRESS 0xfe4a53c3 /* @ECU_Address@autosar_swc_aeb_rtARID_DEF.ObjData_i[6].MotionType.ParallellVehicleShortPred@ */ /end MEASUREMENT
/begin MEASUREMENT autosar_swc_aeb_rtARID_DEF.ObjData_i[6].MotionType.SideIsClosest "" UBYTE autosar_swc_aeb_CM_logical 0 0 0 1 ECU_ADDRESS 0xfe4a53c7 /* @ECU_Address@autosar_swc_aeb_rtARID_DEF.ObjData_i[6].MotionType.SideIsClosest@ */ /end MEASUREMENT
/begin MEASUREMENT autosar_swc_aeb_rtARID_DEF.ObjData_i[6].MotionType.Stationary "" UBYTE autosar_swc_aeb_CM_logical 0 0 0 1 ECU_ADDRESS 0xfe4a53c0 /* @ECU_Address@autosar_swc_aeb_rtARID_DEF.ObjData_i[6].MotionType.Stationary@ */ /end MEASUREMENT
/begin MEASUREMENT autosar_swc_aeb_rtARID_DEF.ObjData_i[6].Offsets.OffsLatInPathCloseEdge "" FLOAT32_IEEE autosar_swc_aeb_CM_single 0 0 -3.4E+38 3.4E+38 ECU_ADDRESS 0xfe4a53fc /* @ECU_Address@autosar_swc_aeb_rtARID_DEF.ObjData_i[6].Offsets.OffsLatInPathCloseEdge@ */ /end MEASUREMENT
/begin MEASUREMENT autosar_swc_aeb_rtARID_DEF.ObjData_i[6].Offsets.OffsLatInPathFarEdge "" FLOAT32_IEEE autosar_swc_aeb_CM_single 0 0 -3.4E+38 3.4E+38 ECU_ADDRESS 0xfe4a5400 /* @ECU_Address@autosar_swc_aeb_rtARID_DEF.ObjData_i[6].Offsets.OffsLatInPathFarEdge@ */ /end MEASUREMENT
/begin MEASUREMENT autosar_swc_aeb_rtARID_DEF.ObjData_i[6].Offsets.OffsLatInPathPrimaryTarget "" FLOAT32_IEEE autosar_swc_aeb_CM_single 0 0 -3.4E+38 3.4E+38 ECU_ADDRESS 0xfe4a53f8 /* @ECU_Address@autosar_swc_aeb_rtARID_DEF.ObjData_i[6].Offsets.OffsLatInPathPrimaryTarget@ */ /end MEASUREMENT
/begin MEASUREMENT autosar_swc_aeb_rtARID_DEF.ObjData_i[6].Offsets.OffsLatIntersection "" FLOAT32_IEEE autosar_swc_aeb_CM_single 0 0 -3.4E+38 3.4E+38 ECU_ADDRESS 0xfe4a5404 /* @ECU_Address@autosar_swc_aeb_rtARID_DEF.ObjData_i[6].Offsets.OffsLatIntersection@ */ /end MEASUREMENT
/begin MEASUREMENT autosar_swc_aeb_rtARID_DEF.ObjData_i[6].Offsets.OffsLatLongPred "" FLOAT32_IEEE autosar_swc_aeb_CM_single 0 0 -3.4E+38 3.4E+38 ECU_ADDRESS 0xfe4a53e8 /* @ECU_Address@autosar_swc_aeb_rtARID_DEF.ObjData_i[6].Offsets.OffsLatLongPred@ */ /end MEASUREMENT
/begin MEASUREMENT autosar_swc_aeb_rtARID_DEF.ObjData_i[6].Offsets.OffsLatManoeuvre "" FLOAT32_IEEE autosar_swc_aeb_CM_single 0 0 -3.4E+38 3.4E+38 ECU_ADDRESS 0xfe4a53f4 /* @ECU_Address@autosar_swc_aeb_rtARID_DEF.ObjData_i[6].Offsets.OffsLatManoeuvre@ */ /end MEASUREMENT
/begin MEASUREMENT autosar_swc_aeb_rtARID_DEF.ObjData_i[6].Offsets.OffsLatMplTar "" FLOAT32_IEEE autosar_swc_aeb_CM_single 0 0 -3.4E+38 3.4E+38 ECU_ADDRESS 0xfe4a5408 /* @ECU_Address@autosar_swc_aeb_rtARID_DEF.ObjData_i[6].Offsets.OffsLatMplTar@ */ /end MEASUREMENT
/begin MEASUREMENT autosar_swc_aeb_rtARID_DEF.ObjData_i[6].Offsets.OffsLatShortPred "" FLOAT32_IEEE autosar_swc_aeb_CM_single 0 0 -3.4E+38 3.4E+38 ECU_ADDRESS 0xfe4a53f0 /* @ECU_Address@autosar_swc_aeb_rtARID_DEF.ObjData_i[6].Offsets.OffsLatShortPred@ */ /end MEASUREMENT
/begin MEASUREMENT autosar_swc_aeb_rtARID_DEF.ObjData_i[6].Offsets.OffsLgtLongPred "" FLOAT32_IEEE autosar_swc_aeb_CM_single 0 0 -3.4E+38 3.4E+38 ECU_ADDRESS 0xfe4a53e4 /* @ECU_Address@autosar_swc_aeb_rtARID_DEF.ObjData_i[6].Offsets.OffsLgtLongPred@ */ /end MEASUREMENT
/begin MEASUREMENT autosar_swc_aeb_rtARID_DEF.ObjData_i[6].Offsets.OffsLgtShortPred "" FLOAT32_IEEE autosar_swc_aeb_CM_single 0 0 -3.4E+38 3.4E+38 ECU_ADDRESS 0xfe4a53ec /* @ECU_Address@autosar_swc_aeb_rtARID_DEF.ObjData_i[6].Offsets.OffsLgtShortPred@ */ /end MEASUREMENT
/begin MEASUREMENT autosar_swc_aeb_rtARID_DEF.ObjData_i[6].PredictionValid "" UBYTE autosar_swc_aeb_CM_logical 0 0 0 1 ECU_ADDRESS 0xfe4a53e1 /* @ECU_Address@autosar_swc_aeb_rtARID_DEF.ObjData_i[6].PredictionValid@ */ /end MEASUREMENT
/begin MEASUREMENT autosar_swc_aeb_rtARID_DEF.ObjData_i[6].ShortPredTime.A "" FLOAT32_IEEE autosar_swc_aeb_CM_single 0 0 -3.4E+38 3.4E+38 ECU_ADDRESS 0xfe4a5444 /* @ECU_Address@autosar_swc_aeb_rtARID_DEF.ObjData_i[6].ShortPredTime.A@ */ /end MEASUREMENT
/begin MEASUREMENT autosar_swc_aeb_rtARID_DEF.ObjData_i[6].ShortPredTime.ALat "" FLOAT32_IEEE autosar_swc_aeb_CM_single 0 0 -3.4E+38 3.4E+38 ECU_ADDRESS 0xfe4a5440 /* @ECU_Address@autosar_swc_aeb_rtARID_DEF.ObjData_i[6].ShortPredTime.ALat@ */ /end MEASUREMENT
/begin MEASUREMENT autosar_swc_aeb_rtARID_DEF.ObjData_i[6].ShortPredTime.ALgt "" FLOAT32_IEEE autosar_swc_aeb_CM_single 0 0 -3.4E+38 3.4E+38 ECU_ADDRESS 0xfe4a543c /* @ECU_Address@autosar_swc_aeb_rtARID_DEF.ObjData_i[6].ShortPredTime.ALgt@ */ /end MEASUREMENT
/begin MEASUREMENT autosar_swc_aeb_rtARID_DEF.ObjData_i[6].ShortPredTime.Crvt "" FLOAT32_IEEE autosar_swc_aeb_CM_single 0 0 -3.4E+38 3.4E+38 ECU_ADDRESS 0xfe4a5448 /* @ECU_Address@autosar_swc_aeb_rtARID_DEF.ObjData_i[6].ShortPredTime.Crvt@ */ /end MEASUREMENT
/begin MEASUREMENT autosar_swc_aeb_rtARID_DEF.ObjData_i[6].ShortPredTime.InPath "" UBYTE autosar_swc_aeb_CM_logical 0 0 0 1 ECU_ADDRESS 0xfe4a5439 /* @ECU_Address@autosar_swc_aeb_rtARID_DEF.ObjData_i[6].ShortPredTime.InPath@ */ /end MEASUREMENT
/begin MEASUREMENT autosar_swc_aeb_rtARID_DEF.ObjData_i[6].ShortPredTime.ObjOnCmngAndBrkg "" UBYTE autosar_swc_aeb_CM_logical 0 0 0 1 ECU_ADDRESS 0xfe4a543a /* @ECU_Address@autosar_swc_aeb_rtARID_DEF.ObjData_i[6].ShortPredTime.ObjOnCmngAndBrkg@ */ /end MEASUREMENT
/begin MEASUREMENT autosar_swc_aeb_rtARID_DEF.ObjData_i[6].ShortPredTime.TTMSelected "" UBYTE autosar_swc_aeb_CM_logical 0 0 0 1 ECU_ADDRESS 0xfe4a5438 /* @ECU_Address@autosar_swc_aeb_rtARID_DEF.ObjData_i[6].ShortPredTime.TTMSelected@ */ /end MEASUREMENT
/begin MEASUREMENT autosar_swc_aeb_rtARID_DEF.ObjData_i[6].ShortPredTime.TimeToMiddleLgt "" FLOAT32_IEEE autosar_swc_aeb_CM_single 0 0 -3.4E+38 3.4E+38 ECU_ADDRESS 0xfe4a5430 /* @ECU_Address@autosar_swc_aeb_rtARID_DEF.ObjData_i[6].ShortPredTime.TimeToMiddleLgt@ */ /end MEASUREMENT
/begin MEASUREMENT autosar_swc_aeb_rtARID_DEF.ObjData_i[6].ShortPredTime.TimeToPassLgt "" FLOAT32_IEEE autosar_swc_aeb_CM_single 0 0 -3.4E+38 3.4E+38 ECU_ADDRESS 0xfe4a5434 /* @ECU_Address@autosar_swc_aeb_rtARID_DEF.ObjData_i[6].ShortPredTime.TimeToPassLgt@ */ /end MEASUREMENT
/begin MEASUREMENT autosar_swc_aeb_rtARID_DEF.ObjData_i[6].ShortPredTime.TimeToReachLgt "" FLOAT32_IEEE autosar_swc_aeb_CM_single 0 0 -3.4E+38 3.4E+38 ECU_ADDRESS 0xfe4a542c /* @ECU_Address@autosar_swc_aeb_rtARID_DEF.ObjData_i[6].ShortPredTime.TimeToReachLgt@ */ /end MEASUREMENT
/begin MEASUREMENT autosar_swc_aeb_rtARID_DEF.ObjData_i[7].BoundingBox.CosRotation "" FLOAT32_IEEE autosar_swc_aeb_CM_single 0 0 -3.4E+38 3.4E+38 ECU_ADDRESS 0xfe4a5468 /* @ECU_Address@autosar_swc_aeb_rtARID_DEF.ObjData_i[7].BoundingBox.CosRotation@ */ /end MEASUREMENT
/begin MEASUREMENT autosar_swc_aeb_rtARID_DEF.ObjData_i[7].BoundingBox.LengthSideLat "" FLOAT32_IEEE autosar_swc_aeb_CM_single 0 0 -3.4E+38 3.4E+38 ECU_ADDRESS 0xfe4a545c /* @ECU_Address@autosar_swc_aeb_rtARID_DEF.ObjData_i[7].BoundingBox.LengthSideLat@ */ /end MEASUREMENT
/begin MEASUREMENT autosar_swc_aeb_rtARID_DEF.ObjData_i[7].BoundingBox.LengthSideLgt "" FLOAT32_IEEE autosar_swc_aeb_CM_single 0 0 -3.4E+38 3.4E+38 ECU_ADDRESS 0xfe4a5460 /* @ECU_Address@autosar_swc_aeb_rtARID_DEF.ObjData_i[7].BoundingBox.LengthSideLgt@ */ /end MEASUREMENT
/begin MEASUREMENT autosar_swc_aeb_rtARID_DEF.ObjData_i[7].BoundingBox.RotationAngle "" FLOAT32_IEEE autosar_swc_aeb_CM_single 0 0 -3.4E+38 3.4E+38 ECU_ADDRESS 0xfe4a546c /* @ECU_Address@autosar_swc_aeb_rtARID_DEF.ObjData_i[7].BoundingBox.RotationAngle@ */ /end MEASUREMENT
/begin MEASUREMENT autosar_swc_aeb_rtARID_DEF.ObjData_i[7].BoundingBox.SinRotation "" FLOAT32_IEEE autosar_swc_aeb_CM_single 0 0 -3.4E+38 3.4E+38 ECU_ADDRESS 0xfe4a5464 /* @ECU_Address@autosar_swc_aeb_rtARID_DEF.ObjData_i[7].BoundingBox.SinRotation@ */ /end MEASUREMENT
/begin MEASUREMENT autosar_swc_aeb_rtARID_DEF.ObjData_i[7].Idn "" ULONG autosar_swc_aeb_CM_uint32 0 0 0 4294967295 ECU_ADDRESS 0xfe4a54dc /* @ECU_Address@autosar_swc_aeb_rtARID_DEF.ObjData_i[7].Idn@ */ /end MEASUREMENT
/begin MEASUREMENT autosar_swc_aeb_rtARID_DEF.ObjData_i[7].InPathAtCurrentPosition "" UBYTE autosar_swc_aeb_CM_logical 0 0 0 1 ECU_ADDRESS 0xfe4a5470 /* @ECU_Address@autosar_swc_aeb_rtARID_DEF.ObjData_i[7].InPathAtCurrentPosition@ */ /end MEASUREMENT
/begin MEASUREMENT autosar_swc_aeb_rtARID_DEF.ObjData_i[7].LongPredTime.A "" FLOAT32_IEEE autosar_swc_aeb_CM_single 0 0 -3.4E+38 3.4E+38 ECU_ADDRESS 0xfe4a54b4 /* @ECU_Address@autosar_swc_aeb_rtARID_DEF.ObjData_i[7].LongPredTime.A@ */ /end MEASUREMENT
/begin MEASUREMENT autosar_swc_aeb_rtARID_DEF.ObjData_i[7].LongPredTime.ALat "" FLOAT32_IEEE autosar_swc_aeb_CM_single 0 0 -3.4E+38 3.4E+38 ECU_ADDRESS 0xfe4a54b0 /* @ECU_Address@autosar_swc_aeb_rtARID_DEF.ObjData_i[7].LongPredTime.ALat@ */ /end MEASUREMENT
/begin MEASUREMENT autosar_swc_aeb_rtARID_DEF.ObjData_i[7].LongPredTime.ALgt "" FLOAT32_IEEE autosar_swc_aeb_CM_single 0 0 -3.4E+38 3.4E+38 ECU_ADDRESS 0xfe4a54ac /* @ECU_Address@autosar_swc_aeb_rtARID_DEF.ObjData_i[7].LongPredTime.ALgt@ */ /end MEASUREMENT
/begin MEASUREMENT autosar_swc_aeb_rtARID_DEF.ObjData_i[7].LongPredTime.Crvt "" FLOAT32_IEEE autosar_swc_aeb_CM_single 0 0 -3.4E+38 3.4E+38 ECU_ADDRESS 0xfe4a54b8 /* @ECU_Address@autosar_swc_aeb_rtARID_DEF.ObjData_i[7].LongPredTime.Crvt@ */ /end MEASUREMENT
/begin MEASUREMENT autosar_swc_aeb_rtARID_DEF.ObjData_i[7].LongPredTime.InPath "" UBYTE autosar_swc_aeb_CM_logical 0 0 0 1 ECU_ADDRESS 0xfe4a54a9 /* @ECU_Address@autosar_swc_aeb_rtARID_DEF.ObjData_i[7].LongPredTime.InPath@ */ /end MEASUREMENT
/begin MEASUREMENT autosar_swc_aeb_rtARID_DEF.ObjData_i[7].LongPredTime.ObjOnCmngAndBrkg "" UBYTE autosar_swc_aeb_CM_logical 0 0 0 1 ECU_ADDRESS 0xfe4a54aa /* @ECU_Address@autosar_swc_aeb_rtARID_DEF.ObjData_i[7].LongPredTime.ObjOnCmngAndBrkg@ */ /end MEASUREMENT
/begin MEASUREMENT autosar_swc_aeb_rtARID_DEF.ObjData_i[7].LongPredTime.TTMSelected "" UBYTE autosar_swc_aeb_CM_logical 0 0 0 1 ECU_ADDRESS 0xfe4a54a8 /* @ECU_Address@autosar_swc_aeb_rtARID_DEF.ObjData_i[7].LongPredTime.TTMSelected@ */ /end MEASUREMENT
/begin MEASUREMENT autosar_swc_aeb_rtARID_DEF.ObjData_i[7].LongPredTime.TimeToMiddleLgt "" FLOAT32_IEEE autosar_swc_aeb_CM_single 0 0 -3.4E+38 3.4E+38 ECU_ADDRESS 0xfe4a54a0 /* @ECU_Address@autosar_swc_aeb_rtARID_DEF.ObjData_i[7].LongPredTime.TimeToMiddleLgt@ */ /end MEASUREMENT
/begin MEASUREMENT autosar_swc_aeb_rtARID_DEF.ObjData_i[7].LongPredTime.TimeToPassLgt "" FLOAT32_IEEE autosar_swc_aeb_CM_single 0 0 -3.4E+38 3.4E+38 ECU_ADDRESS 0xfe4a54a4 /* @ECU_Address@autosar_swc_aeb_rtARID_DEF.ObjData_i[7].LongPredTime.TimeToPassLgt@ */ /end MEASUREMENT
/begin MEASUREMENT autosar_swc_aeb_rtARID_DEF.ObjData_i[7].LongPredTime.TimeToReachLgt "" FLOAT32_IEEE autosar_swc_aeb_CM_single 0 0 -3.4E+38 3.4E+38 ECU_ADDRESS 0xfe4a549c /* @ECU_Address@autosar_swc_aeb_rtARID_DEF.ObjData_i[7].LongPredTime.TimeToReachLgt@ */ /end MEASUREMENT
/begin MEASUREMENT autosar_swc_aeb_rtARID_DEF.ObjData_i[7].MotionType.AbsHeading "" FLOAT32_IEEE autosar_swc_aeb_CM_single 0 0 -3.4E+38 3.4E+38 ECU_ADDRESS 0xfe4a5458 /* @ECU_Address@autosar_swc_aeb_rtARID_DEF.ObjData_i[7].MotionType.AbsHeading@ */ /end MEASUREMENT
/begin MEASUREMENT autosar_swc_aeb_rtARID_DEF.ObjData_i[7].MotionType.CurvedMotion "" UBYTE autosar_swc_aeb_CM_logical 0 0 0 1 ECU_ADDRESS 0xfe4a5456 /* @ECU_Address@autosar_swc_aeb_rtARID_DEF.ObjData_i[7].MotionType.CurvedMotion@ */ /end MEASUREMENT
/begin MEASUREMENT autosar_swc_aeb_rtARID_DEF.ObjData_i[7].MotionType.MovingOncoming "" UBYTE autosar_swc_aeb_CM_logical 0 0 0 1 ECU_ADDRESS 0xfe4a5451 /* @ECU_Address@autosar_swc_aeb_rtARID_DEF.ObjData_i[7].MotionType.MovingOncoming@ */ /end MEASUREMENT
/begin MEASUREMENT autosar_swc_aeb_rtARID_DEF.ObjData_i[7].MotionType.ObjectIsMotorVehicle "Object type is Car, Truck, Motorcycle or Vehicle Of Unkown Class." UBYTE autosar_swc_aeb_CM_logical 0 0 0 1 ECU_ADDRESS 0xfe4a5455 /* @ECU_Address@autosar_swc_aeb_rtARID_DEF.ObjData_i[7].MotionType.ObjectIsMotorVehicle@ */ /end MEASUREMENT
/begin MEASUREMENT autosar_swc_aeb_rtARID_DEF.ObjData_i[7].MotionType.ObjectIsVehicle "" UBYTE autosar_swc_aeb_CM_logical 0 0 0 1 ECU_ADDRESS 0xfe4a5454 /* @ECU_Address@autosar_swc_aeb_rtARID_DEF.ObjData_i[7].MotionType.ObjectIsVehicle@ */ /end MEASUREMENT
/begin MEASUREMENT autosar_swc_aeb_rtARID_DEF.ObjData_i[7].MotionType.ParallellVehicleLongPred "" UBYTE autosar_swc_aeb_CM_logical 0 0 0 1 ECU_ADDRESS 0xfe4a5452 /* @ECU_Address@autosar_swc_aeb_rtARID_DEF.ObjData_i[7].MotionType.ParallellVehicleLongPred@ */ /end MEASUREMENT
/begin MEASUREMENT autosar_swc_aeb_rtARID_DEF.ObjData_i[7].MotionType.ParallellVehicleShortPred "" UBYTE autosar_swc_aeb_CM_logical 0 0 0 1 ECU_ADDRESS 0xfe4a5453 /* @ECU_Address@autosar_swc_aeb_rtARID_DEF.ObjData_i[7].MotionType.ParallellVehicleShortPred@ */ /end MEASUREMENT
/begin MEASUREMENT autosar_swc_aeb_rtARID_DEF.ObjData_i[7].MotionType.SideIsClosest "" UBYTE autosar_swc_aeb_CM_logical 0 0 0 1 ECU_ADDRESS 0xfe4a5457 /* @ECU_Address@autosar_swc_aeb_rtARID_DEF.ObjData_i[7].MotionType.SideIsClosest@ */ /end MEASUREMENT
/begin MEASUREMENT autosar_swc_aeb_rtARID_DEF.ObjData_i[7].MotionType.Stationary "" UBYTE autosar_swc_aeb_CM_logical 0 0 0 1 ECU_ADDRESS 0xfe4a5450 /* @ECU_Address@autosar_swc_aeb_rtARID_DEF.ObjData_i[7].MotionType.Stationary@ */ /end MEASUREMENT
/begin MEASUREMENT autosar_swc_aeb_rtARID_DEF.ObjData_i[7].Offsets.OffsLatInPathCloseEdge "" FLOAT32_IEEE autosar_swc_aeb_CM_single 0 0 -3.4E+38 3.4E+38 ECU_ADDRESS 0xfe4a548c /* @ECU_Address@autosar_swc_aeb_rtARID_DEF.ObjData_i[7].Offsets.OffsLatInPathCloseEdge@ */ /end MEASUREMENT
/begin MEASUREMENT autosar_swc_aeb_rtARID_DEF.ObjData_i[7].Offsets.OffsLatInPathFarEdge "" FLOAT32_IEEE autosar_swc_aeb_CM_single 0 0 -3.4E+38 3.4E+38 ECU_ADDRESS 0xfe4a5490 /* @ECU_Address@autosar_swc_aeb_rtARID_DEF.ObjData_i[7].Offsets.OffsLatInPathFarEdge@ */ /end MEASUREMENT
/begin MEASUREMENT autosar_swc_aeb_rtARID_DEF.ObjData_i[7].Offsets.OffsLatInPathPrimaryTarget "" FLOAT32_IEEE autosar_swc_aeb_CM_single 0 0 -3.4E+38 3.4E+38 ECU_ADDRESS 0xfe4a5488 /* @ECU_Address@autosar_swc_aeb_rtARID_DEF.ObjData_i[7].Offsets.OffsLatInPathPrimaryTarget@ */ /end MEASUREMENT
/begin MEASUREMENT autosar_swc_aeb_rtARID_DEF.ObjData_i[7].Offsets.OffsLatIntersection "" FLOAT32_IEEE autosar_swc_aeb_CM_single 0 0 -3.4E+38 3.4E+38 ECU_ADDRESS 0xfe4a5494 /* @ECU_Address@autosar_swc_aeb_rtARID_DEF.ObjData_i[7].Offsets.OffsLatIntersection@ */ /end MEASUREMENT
/begin MEASUREMENT autosar_swc_aeb_rtARID_DEF.ObjData_i[7].Offsets.OffsLatLongPred "" FLOAT32_IEEE autosar_swc_aeb_CM_single 0 0 -3.4E+38 3.4E+38 ECU_ADDRESS 0xfe4a5478 /* @ECU_Address@autosar_swc_aeb_rtARID_DEF.ObjData_i[7].Offsets.OffsLatLongPred@ */ /end MEASUREMENT
/begin MEASUREMENT autosar_swc_aeb_rtARID_DEF.ObjData_i[7].Offsets.OffsLatManoeuvre "" FLOAT32_IEEE autosar_swc_aeb_CM_single 0 0 -3.4E+38 3.4E+38 ECU_ADDRESS 0xfe4a5484 /* @ECU_Address@autosar_swc_aeb_rtARID_DEF.ObjData_i[7].Offsets.OffsLatManoeuvre@ */ /end MEASUREMENT
/begin MEASUREMENT autosar_swc_aeb_rtARID_DEF.ObjData_i[7].Offsets.OffsLatMplTar "" FLOAT32_IEEE autosar_swc_aeb_CM_single 0 0 -3.4E+38 3.4E+38 ECU_ADDRESS 0xfe4a5498 /* @ECU_Address@autosar_swc_aeb_rtARID_DEF.ObjData_i[7].Offsets.OffsLatMplTar@ */ /end MEASUREMENT
/begin MEASUREMENT autosar_swc_aeb_rtARID_DEF.ObjData_i[7].Offsets.OffsLatShortPred "" FLOAT32_IEEE autosar_swc_aeb_CM_single 0 0 -3.4E+38 3.4E+38 ECU_ADDRESS 0xfe4a5480 /* @ECU_Address@autosar_swc_aeb_rtARID_DEF.ObjData_i[7].Offsets.OffsLatShortPred@ */ /end MEASUREMENT
/begin MEASUREMENT autosar_swc_aeb_rtARID_DEF.ObjData_i[7].Offsets.OffsLgtLongPred "" FLOAT32_IEEE autosar_swc_aeb_CM_single 0 0 -3.4E+38 3.4E+38 ECU_ADDRESS 0xfe4a5474 /* @ECU_Address@autosar_swc_aeb_rtARID_DEF.ObjData_i[7].Offsets.OffsLgtLongPred@ */ /end MEASUREMENT
/begin MEASUREMENT autosar_swc_aeb_rtARID_DEF.ObjData_i[7].Offsets.OffsLgtShortPred "" FLOAT32_IEEE autosar_swc_aeb_CM_single 0 0 -3.4E+38 3.4E+38 ECU_ADDRESS 0xfe4a547c /* @ECU_Address@autosar_swc_aeb_rtARID_DEF.ObjData_i[7].Offsets.OffsLgtShortPred@ */ /end MEASUREMENT
/begin MEASUREMENT autosar_swc_aeb_rtARID_DEF.ObjData_i[7].PredictionValid "" UBYTE autosar_swc_aeb_CM_logical 0 0 0 1 ECU_ADDRESS 0xfe4a5471 /* @ECU_Address@autosar_swc_aeb_rtARID_DEF.ObjData_i[7].PredictionValid@ */ /end MEASUREMENT
/begin MEASUREMENT autosar_swc_aeb_rtARID_DEF.ObjData_i[7].ShortPredTime.A "" FLOAT32_IEEE autosar_swc_aeb_CM_single 0 0 -3.4E+38 3.4E+38 ECU_ADDRESS 0xfe4a54d4 /* @ECU_Address@autosar_swc_aeb_rtARID_DEF.ObjData_i[7].ShortPredTime.A@ */ /end MEASUREMENT
/begin MEASUREMENT autosar_swc_aeb_rtARID_DEF.ObjData_i[7].ShortPredTime.ALat "" FLOAT32_IEEE autosar_swc_aeb_CM_single 0 0 -3.4E+38 3.4E+38 ECU_ADDRESS 0xfe4a54d0 /* @ECU_Address@autosar_swc_aeb_rtARID_DEF.ObjData_i[7].ShortPredTime.ALat@ */ /end MEASUREMENT
/begin MEASUREMENT autosar_swc_aeb_rtARID_DEF.ObjData_i[7].ShortPredTime.ALgt "" FLOAT32_IEEE autosar_swc_aeb_CM_single 0 0 -3.4E+38 3.4E+38 ECU_ADDRESS 0xfe4a54cc /* @ECU_Address@autosar_swc_aeb_rtARID_DEF.ObjData_i[7].ShortPredTime.ALgt@ */ /end MEASUREMENT
/begin MEASUREMENT autosar_swc_aeb_rtARID_DEF.ObjData_i[7].ShortPredTime.Crvt "" FLOAT32_IEEE autosar_swc_aeb_CM_single 0 0 -3.4E+38 3.4E+38 ECU_ADDRESS 0xfe4a54d8 /* @ECU_Address@autosar_swc_aeb_rtARID_DEF.ObjData_i[7].ShortPredTime.Crvt@ */ /end MEASUREMENT
/begin MEASUREMENT autosar_swc_aeb_rtARID_DEF.ObjData_i[7].ShortPredTime.InPath "" UBYTE autosar_swc_aeb_CM_logical 0 0 0 1 ECU_ADDRESS 0xfe4a54c9 /* @ECU_Address@autosar_swc_aeb_rtARID_DEF.ObjData_i[7].ShortPredTime.InPath@ */ /end MEASUREMENT
/begin MEASUREMENT autosar_swc_aeb_rtARID_DEF.ObjData_i[7].ShortPredTime.ObjOnCmngAndBrkg "" UBYTE autosar_swc_aeb_CM_logical 0 0 0 1 ECU_ADDRESS 0xfe4a54ca /* @ECU_Address@autosar_swc_aeb_rtARID_DEF.ObjData_i[7].ShortPredTime.ObjOnCmngAndBrkg@ */ /end MEASUREMENT
/begin MEASUREMENT autosar_swc_aeb_rtARID_DEF.ObjData_i[7].ShortPredTime.TTMSelected "" UBYTE autosar_swc_aeb_CM_logical 0 0 0 1 ECU_ADDRESS 0xfe4a54c8 /* @ECU_Address@autosar_swc_aeb_rtARID_DEF.ObjData_i[7].ShortPredTime.TTMSelected@ */ /end MEASUREMENT
/begin MEASUREMENT autosar_swc_aeb_rtARID_DEF.ObjData_i[7].ShortPredTime.TimeToMiddleLgt "" FLOAT32_IEEE autosar_swc_aeb_CM_single 0 0 -3.4E+38 3.4E+38 ECU_ADDRESS 0xfe4a54c0 /* @ECU_Address@autosar_swc_aeb_rtARID_DEF.ObjData_i[7].ShortPredTime.TimeToMiddleLgt@ */ /end MEASUREMENT
/begin MEASUREMENT autosar_swc_aeb_rtARID_DEF.ObjData_i[7].ShortPredTime.TimeToPassLgt "" FLOAT32_IEEE autosar_swc_aeb_CM_single 0 0 -3.4E+38 3.4E+38 ECU_ADDRESS 0xfe4a54c4 /* @ECU_Address@autosar_swc_aeb_rtARID_DEF.ObjData_i[7].ShortPredTime.TimeToPassLgt@ */ /end MEASUREMENT
/begin MEASUREMENT autosar_swc_aeb_rtARID_DEF.ObjData_i[7].ShortPredTime.TimeToReachLgt "" FLOAT32_IEEE autosar_swc_aeb_CM_single 0 0 -3.4E+38 3.4E+38 ECU_ADDRESS 0xfe4a54bc /* @ECU_Address@autosar_swc_aeb_rtARID_DEF.ObjData_i[7].ShortPredTime.TimeToReachLgt@ */ /end MEASUREMENT
/begin MEASUREMENT autosar_swc_aeb_rtARID_DEF.ObjData_i[8].BoundingBox.CosRotation "" FLOAT32_IEEE autosar_swc_aeb_CM_single 0 0 -3.4E+38 3.4E+38 ECU_ADDRESS 0xfe4a54f8 /* @ECU_Address@autosar_swc_aeb_rtARID_DEF.ObjData_i[8].BoundingBox.CosRotation@ */ /end MEASUREMENT
/begin MEASUREMENT autosar_swc_aeb_rtARID_DEF.ObjData_i[8].BoundingBox.LengthSideLat "" FLOAT32_IEEE autosar_swc_aeb_CM_single 0 0 -3.4E+38 3.4E+38 ECU_ADDRESS 0xfe4a54ec /* @ECU_Address@autosar_swc_aeb_rtARID_DEF.ObjData_i[8].BoundingBox.LengthSideLat@ */ /end MEASUREMENT
/begin MEASUREMENT autosar_swc_aeb_rtARID_DEF.ObjData_i[8].BoundingBox.LengthSideLgt "" FLOAT32_IEEE autosar_swc_aeb_CM_single 0 0 -3.4E+38 3.4E+38 ECU_ADDRESS 0xfe4a54f0 /* @ECU_Address@autosar_swc_aeb_rtARID_DEF.ObjData_i[8].BoundingBox.LengthSideLgt@ */ /end MEASUREMENT
/begin MEASUREMENT autosar_swc_aeb_rtARID_DEF.ObjData_i[8].BoundingBox.RotationAngle "" FLOAT32_IEEE autosar_swc_aeb_CM_single 0 0 -3.4E+38 3.4E+38 ECU_ADDRESS 0xfe4a54fc /* @ECU_Address@autosar_swc_aeb_rtARID_DEF.ObjData_i[8].BoundingBox.RotationAngle@ */ /end MEASUREMENT
/begin MEASUREMENT autosar_swc_aeb_rtARID_DEF.ObjData_i[8].BoundingBox.SinRotation "" FLOAT32_IEEE autosar_swc_aeb_CM_single 0 0 -3.4E+38 3.4E+38 ECU_ADDRESS 0xfe4a54f4 /* @ECU_Address@autosar_swc_aeb_rtARID_DEF.ObjData_i[8].BoundingBox.SinRotation@ */ /end MEASUREMENT
/begin MEASUREMENT autosar_swc_aeb_rtARID_DEF.ObjData_i[8].Idn "" ULONG autosar_swc_aeb_CM_uint32 0 0 0 4294967295 ECU_ADDRESS 0xfe4a556c /* @ECU_Address@autosar_swc_aeb_rtARID_DEF.ObjData_i[8].Idn@ */ /end MEASUREMENT
/begin MEASUREMENT autosar_swc_aeb_rtARID_DEF.ObjData_i[8].InPathAtCurrentPosition "" UBYTE autosar_swc_aeb_CM_logical 0 0 0 1 ECU_ADDRESS 0xfe4a5500 /* @ECU_Address@autosar_swc_aeb_rtARID_DEF.ObjData_i[8].InPathAtCurrentPosition@ */ /end MEASUREMENT
/begin MEASUREMENT autosar_swc_aeb_rtARID_DEF.ObjData_i[8].LongPredTime.A "" FLOAT32_IEEE autosar_swc_aeb_CM_single 0 0 -3.4E+38 3.4E+38 ECU_ADDRESS 0xfe4a5544 /* @ECU_Address@autosar_swc_aeb_rtARID_DEF.ObjData_i[8].LongPredTime.A@ */ /end MEASUREMENT
/begin MEASUREMENT autosar_swc_aeb_rtARID_DEF.ObjData_i[8].LongPredTime.ALat "" FLOAT32_IEEE autosar_swc_aeb_CM_single 0 0 -3.4E+38 3.4E+38 ECU_ADDRESS 0xfe4a5540 /* @ECU_Address@autosar_swc_aeb_rtARID_DEF.ObjData_i[8].LongPredTime.ALat@ */ /end MEASUREMENT
/begin MEASUREMENT autosar_swc_aeb_rtARID_DEF.ObjData_i[8].LongPredTime.ALgt "" FLOAT32_IEEE autosar_swc_aeb_CM_single 0 0 -3.4E+38 3.4E+38 ECU_ADDRESS 0xfe4a553c /* @ECU_Address@autosar_swc_aeb_rtARID_DEF.ObjData_i[8].LongPredTime.ALgt@ */ /end MEASUREMENT
/begin MEASUREMENT autosar_swc_aeb_rtARID_DEF.ObjData_i[8].LongPredTime.Crvt "" FLOAT32_IEEE autosar_swc_aeb_CM_single 0 0 -3.4E+38 3.4E+38 ECU_ADDRESS 0xfe4a5548 /* @ECU_Address@autosar_swc_aeb_rtARID_DEF.ObjData_i[8].LongPredTime.Crvt@ */ /end MEASUREMENT
/begin MEASUREMENT autosar_swc_aeb_rtARID_DEF.ObjData_i[8].LongPredTime.InPath "" UBYTE autosar_swc_aeb_CM_logical 0 0 0 1 ECU_ADDRESS 0xfe4a5539 /* @ECU_Address@autosar_swc_aeb_rtARID_DEF.ObjData_i[8].LongPredTime.InPath@ */ /end MEASUREMENT
/begin MEASUREMENT autosar_swc_aeb_rtARID_DEF.ObjData_i[8].LongPredTime.ObjOnCmngAndBrkg "" UBYTE autosar_swc_aeb_CM_logical 0 0 0 1 ECU_ADDRESS 0xfe4a553a /* @ECU_Address@autosar_swc_aeb_rtARID_DEF.ObjData_i[8].LongPredTime.ObjOnCmngAndBrkg@ */ /end MEASUREMENT
/begin MEASUREMENT autosar_swc_aeb_rtARID_DEF.ObjData_i[8].LongPredTime.TTMSelected "" UBYTE autosar_swc_aeb_CM_logical 0 0 0 1 ECU_ADDRESS 0xfe4a5538 /* @ECU_Address@autosar_swc_aeb_rtARID_DEF.ObjData_i[8].LongPredTime.TTMSelected@ */ /end MEASUREMENT
/begin MEASUREMENT autosar_swc_aeb_rtARID_DEF.ObjData_i[8].LongPredTime.TimeToMiddleLgt "" FLOAT32_IEEE autosar_swc_aeb_CM_single 0 0 -3.4E+38 3.4E+38 ECU_ADDRESS 0xfe4a5530 /* @ECU_Address@autosar_swc_aeb_rtARID_DEF.ObjData_i[8].LongPredTime.TimeToMiddleLgt@ */ /end MEASUREMENT
/begin MEASUREMENT autosar_swc_aeb_rtARID_DEF.ObjData_i[8].LongPredTime.TimeToPassLgt "" FLOAT32_IEEE autosar_swc_aeb_CM_single 0 0 -3.4E+38 3.4E+38 ECU_ADDRESS 0xfe4a5534 /* @ECU_Address@autosar_swc_aeb_rtARID_DEF.ObjData_i[8].LongPredTime.TimeToPassLgt@ */ /end MEASUREMENT
/begin MEASUREMENT autosar_swc_aeb_rtARID_DEF.ObjData_i[8].LongPredTime.TimeToReachLgt "" FLOAT32_IEEE autosar_swc_aeb_CM_single 0 0 -3.4E+38 3.4E+38 ECU_ADDRESS 0xfe4a552c /* @ECU_Address@autosar_swc_aeb_rtARID_DEF.ObjData_i[8].LongPredTime.TimeToReachLgt@ */ /end MEASUREMENT
/begin MEASUREMENT autosar_swc_aeb_rtARID_DEF.ObjData_i[8].MotionType.AbsHeading "" FLOAT32_IEEE autosar_swc_aeb_CM_single 0 0 -3.4E+38 3.4E+38 ECU_ADDRESS 0xfe4a54e8 /* @ECU_Address@autosar_swc_aeb_rtARID_DEF.ObjData_i[8].MotionType.AbsHeading@ */ /end MEASUREMENT
/begin MEASUREMENT autosar_swc_aeb_rtARID_DEF.ObjData_i[8].MotionType.CurvedMotion "" UBYTE autosar_swc_aeb_CM_logical 0 0 0 1 ECU_ADDRESS 0xfe4a54e6 /* @ECU_Address@autosar_swc_aeb_rtARID_DEF.ObjData_i[8].MotionType.CurvedMotion@ */ /end MEASUREMENT
/begin MEASUREMENT autosar_swc_aeb_rtARID_DEF.ObjData_i[8].MotionType.MovingOncoming "" UBYTE autosar_swc_aeb_CM_logical 0 0 0 1 ECU_ADDRESS 0xfe4a54e1 /* @ECU_Address@autosar_swc_aeb_rtARID_DEF.ObjData_i[8].MotionType.MovingOncoming@ */ /end MEASUREMENT
/begin MEASUREMENT autosar_swc_aeb_rtARID_DEF.ObjData_i[8].MotionType.ObjectIsMotorVehicle "Object type is Car, Truck, Motorcycle or Vehicle Of Unkown Class." UBYTE autosar_swc_aeb_CM_logical 0 0 0 1 ECU_ADDRESS 0xfe4a54e5 /* @ECU_Address@autosar_swc_aeb_rtARID_DEF.ObjData_i[8].MotionType.ObjectIsMotorVehicle@ */ /end MEASUREMENT
/begin MEASUREMENT autosar_swc_aeb_rtARID_DEF.ObjData_i[8].MotionType.ObjectIsVehicle "" UBYTE autosar_swc_aeb_CM_logical 0 0 0 1 ECU_ADDRESS 0xfe4a54e4 /* @ECU_Address@autosar_swc_aeb_rtARID_DEF.ObjData_i[8].MotionType.ObjectIsVehicle@ */ /end MEASUREMENT
/begin MEASUREMENT autosar_swc_aeb_rtARID_DEF.ObjData_i[8].MotionType.ParallellVehicleLongPred "" UBYTE autosar_swc_aeb_CM_logical 0 0 0 1 ECU_ADDRESS 0xfe4a54e2 /* @ECU_Address@autosar_swc_aeb_rtARID_DEF.ObjData_i[8].MotionType.ParallellVehicleLongPred@ */ /end MEASUREMENT
/begin MEASUREMENT autosar_swc_aeb_rtARID_DEF.ObjData_i[8].MotionType.ParallellVehicleShortPred "" UBYTE autosar_swc_aeb_CM_logical 0 0 0 1 ECU_ADDRESS 0xfe4a54e3 /* @ECU_Address@autosar_swc_aeb_rtARID_DEF.ObjData_i[8].MotionType.ParallellVehicleShortPred@ */ /end MEASUREMENT
/begin MEASUREMENT autosar_swc_aeb_rtARID_DEF.ObjData_i[8].MotionType.SideIsClosest "" UBYTE autosar_swc_aeb_CM_logical 0 0 0 1 ECU_ADDRESS 0xfe4a54e7 /* @ECU_Address@autosar_swc_aeb_rtARID_DEF.ObjData_i[8].MotionType.SideIsClosest@ */ /end MEASUREMENT
/begin MEASUREMENT autosar_swc_aeb_rtARID_DEF.ObjData_i[8].MotionType.Stationary "" UBYTE autosar_swc_aeb_CM_logical 0 0 0 1 ECU_ADDRESS 0xfe4a54e0 /* @ECU_Address@autosar_swc_aeb_rtARID_DEF.ObjData_i[8].MotionType.Stationary@ */ /end MEASUREMENT
/begin MEASUREMENT autosar_swc_aeb_rtARID_DEF.ObjData_i[8].Offsets.OffsLatInPathCloseEdge "" FLOAT32_IEEE autosar_swc_aeb_CM_single 0 0 -3.4E+38 3.4E+38 ECU_ADDRESS 0xfe4a551c /* @ECU_Address@autosar_swc_aeb_rtARID_DEF.ObjData_i[8].Offsets.OffsLatInPathCloseEdge@ */ /end MEASUREMENT
/begin MEASUREMENT autosar_swc_aeb_rtARID_DEF.ObjData_i[8].Offsets.OffsLatInPathFarEdge "" FLOAT32_IEEE autosar_swc_aeb_CM_single 0 0 -3.4E+38 3.4E+38 ECU_ADDRESS 0xfe4a5520 /* @ECU_Address@autosar_swc_aeb_rtARID_DEF.ObjData_i[8].Offsets.OffsLatInPathFarEdge@ */ /end MEASUREMENT
/begin MEASUREMENT autosar_swc_aeb_rtARID_DEF.ObjData_i[8].Offsets.OffsLatInPathPrimaryTarget "" FLOAT32_IEEE autosar_swc_aeb_CM_single 0 0 -3.4E+38 3.4E+38 ECU_ADDRESS 0xfe4a5518 /* @ECU_Address@autosar_swc_aeb_rtARID_DEF.ObjData_i[8].Offsets.OffsLatInPathPrimaryTarget@ */ /end MEASUREMENT
/begin MEASUREMENT autosar_swc_aeb_rtARID_DEF.ObjData_i[8].Offsets.OffsLatIntersection "" FLOAT32_IEEE autosar_swc_aeb_CM_single 0 0 -3.4E+38 3.4E+38 ECU_ADDRESS 0xfe4a5524 /* @ECU_Address@autosar_swc_aeb_rtARID_DEF.ObjData_i[8].Offsets.OffsLatIntersection@ */ /end MEASUREMENT
/begin MEASUREMENT autosar_swc_aeb_rtARID_DEF.ObjData_i[8].Offsets.OffsLatLongPred "" FLOAT32_IEEE autosar_swc_aeb_CM_single 0 0 -3.4E+38 3.4E+38 ECU_ADDRESS 0xfe4a5508 /* @ECU_Address@autosar_swc_aeb_rtARID_DEF.ObjData_i[8].Offsets.OffsLatLongPred@ */ /end MEASUREMENT
/begin MEASUREMENT autosar_swc_aeb_rtARID_DEF.ObjData_i[8].Offsets.OffsLatManoeuvre "" FLOAT32_IEEE autosar_swc_aeb_CM_single 0 0 -3.4E+38 3.4E+38 ECU_ADDRESS 0xfe4a5514 /* @ECU_Address@autosar_swc_aeb_rtARID_DEF.ObjData_i[8].Offsets.OffsLatManoeuvre@ */ /end MEASUREMENT
/begin MEASUREMENT autosar_swc_aeb_rtARID_DEF.ObjData_i[8].Offsets.OffsLatMplTar "" FLOAT32_IEEE autosar_swc_aeb_CM_single 0 0 -3.4E+38 3.4E+38 ECU_ADDRESS 0xfe4a5528 /* @ECU_Address@autosar_swc_aeb_rtARID_DEF.ObjData_i[8].Offsets.OffsLatMplTar@ */ /end MEASUREMENT
/begin MEASUREMENT autosar_swc_aeb_rtARID_DEF.ObjData_i[8].Offsets.OffsLatShortPred "" FLOAT32_IEEE autosar_swc_aeb_CM_single 0 0 -3.4E+38 3.4E+38 ECU_ADDRESS 0xfe4a5510 /* @ECU_Address@autosar_swc_aeb_rtARID_DEF.ObjData_i[8].Offsets.OffsLatShortPred@ */ /end MEASUREMENT
/begin MEASUREMENT autosar_swc_aeb_rtARID_DEF.ObjData_i[8].Offsets.OffsLgtLongPred "" FLOAT32_IEEE autosar_swc_aeb_CM_single 0 0 -3.4E+38 3.4E+38 ECU_ADDRESS 0xfe4a5504 /* @ECU_Address@autosar_swc_aeb_rtARID_DEF.ObjData_i[8].Offsets.OffsLgtLongPred@ */ /end MEASUREMENT
/begin MEASUREMENT autosar_swc_aeb_rtARID_DEF.ObjData_i[8].Offsets.OffsLgtShortPred "" FLOAT32_IEEE autosar_swc_aeb_CM_single 0 0 -3.4E+38 3.4E+38 ECU_ADDRESS 0xfe4a550c /* @ECU_Address@autosar_swc_aeb_rtARID_DEF.ObjData_i[8].Offsets.OffsLgtShortPred@ */ /end MEASUREMENT
/begin MEASUREMENT autosar_swc_aeb_rtARID_DEF.ObjData_i[8].PredictionValid "" UBYTE autosar_swc_aeb_CM_logical 0 0 0 1 ECU_ADDRESS 0xfe4a5501 /* @ECU_Address@autosar_swc_aeb_rtARID_DEF.ObjData_i[8].PredictionValid@ */ /end MEASUREMENT
/begin MEASUREMENT autosar_swc_aeb_rtARID_DEF.ObjData_i[8].ShortPredTime.A "" FLOAT32_IEEE autosar_swc_aeb_CM_single 0 0 -3.4E+38 3.4E+38 ECU_ADDRESS 0xfe4a5564 /* @ECU_Address@autosar_swc_aeb_rtARID_DEF.ObjData_i[8].ShortPredTime.A@ */ /end MEASUREMENT
/begin MEASUREMENT autosar_swc_aeb_rtARID_DEF.ObjData_i[8].ShortPredTime.ALat "" FLOAT32_IEEE autosar_swc_aeb_CM_single 0 0 -3.4E+38 3.4E+38 ECU_ADDRESS 0xfe4a5560 /* @ECU_Address@autosar_swc_aeb_rtARID_DEF.ObjData_i[8].ShortPredTime.ALat@ */ /end MEASUREMENT
/begin MEASUREMENT autosar_swc_aeb_rtARID_DEF.ObjData_i[8].ShortPredTime.ALgt "" FLOAT32_IEEE autosar_swc_aeb_CM_single 0 0 -3.4E+38 3.4E+38 ECU_ADDRESS 0xfe4a555c /* @ECU_Address@autosar_swc_aeb_rtARID_DEF.ObjData_i[8].ShortPredTime.ALgt@ */ /end MEASUREMENT
/begin MEASUREMENT autosar_swc_aeb_rtARID_DEF.ObjData_i[8].ShortPredTime.Crvt "" FLOAT32_IEEE autosar_swc_aeb_CM_single 0 0 -3.4E+38 3.4E+38 ECU_ADDRESS 0xfe4a5568 /* @ECU_Address@autosar_swc_aeb_rtARID_DEF.ObjData_i[8].ShortPredTime.Crvt@ */ /end MEASUREMENT
/begin MEASUREMENT autosar_swc_aeb_rtARID_DEF.ObjData_i[8].ShortPredTime.InPath "" UBYTE autosar_swc_aeb_CM_logical 0 0 0 1 ECU_ADDRESS 0xfe4a5559 /* @ECU_Address@autosar_swc_aeb_rtARID_DEF.ObjData_i[8].ShortPredTime.InPath@ */ /end MEASUREMENT
/begin MEASUREMENT autosar_swc_aeb_rtARID_DEF.ObjData_i[8].ShortPredTime.ObjOnCmngAndBrkg "" UBYTE autosar_swc_aeb_CM_logical 0 0 0 1 ECU_ADDRESS 0xfe4a555a /* @ECU_Address@autosar_swc_aeb_rtARID_DEF.ObjData_i[8].ShortPredTime.ObjOnCmngAndBrkg@ */ /end MEASUREMENT
/begin MEASUREMENT autosar_swc_aeb_rtARID_DEF.ObjData_i[8].ShortPredTime.TTMSelected "" UBYTE autosar_swc_aeb_CM_logical 0 0 0 1 ECU_ADDRESS 0xfe4a5558 /* @ECU_Address@autosar_swc_aeb_rtARID_DEF.ObjData_i[8].ShortPredTime.TTMSelected@ */ /end MEASUREMENT
/begin MEASUREMENT autosar_swc_aeb_rtARID_DEF.ObjData_i[8].ShortPredTime.TimeToMiddleLgt "" FLOAT32_IEEE autosar_swc_aeb_CM_single 0 0 -3.4E+38 3.4E+38 ECU_ADDRESS 0xfe4a5550 /* @ECU_Address@autosar_swc_aeb_rtARID_DEF.ObjData_i[8].ShortPredTime.TimeToMiddleLgt@ */ /end MEASUREMENT
/begin MEASUREMENT autosar_swc_aeb_rtARID_DEF.ObjData_i[8].ShortPredTime.TimeToPassLgt "" FLOAT32_IEEE autosar_swc_aeb_CM_single 0 0 -3.4E+38 3.4E+38 ECU_ADDRESS 0xfe4a5554 /* @ECU_Address@autosar_swc_aeb_rtARID_DEF.ObjData_i[8].ShortPredTime.TimeToPassLgt@ */ /end MEASUREMENT
/begin MEASUREMENT autosar_swc_aeb_rtARID_DEF.ObjData_i[8].ShortPredTime.TimeToReachLgt "" FLOAT32_IEEE autosar_swc_aeb_CM_single 0 0 -3.4E+38 3.4E+38 ECU_ADDRESS 0xfe4a554c /* @ECU_Address@autosar_swc_aeb_rtARID_DEF.ObjData_i[8].ShortPredTime.TimeToReachLgt@ */ /end MEASUREMENT
/begin MEASUREMENT autosar_swc_aeb_rtARID_DEF.ObjData_i[9].BoundingBox.CosRotation "" FLOAT32_IEEE autosar_swc_aeb_CM_single 0 0 -3.4E+38 3.4E+38 ECU_ADDRESS 0xfe4a5588 /* @ECU_Address@autosar_swc_aeb_rtARID_DEF.ObjData_i[9].BoundingBox.CosRotation@ */ /end MEASUREMENT
/begin MEASUREMENT autosar_swc_aeb_rtARID_DEF.ObjData_i[9].BoundingBox.LengthSideLat "" FLOAT32_IEEE autosar_swc_aeb_CM_single 0 0 -3.4E+38 3.4E+38 ECU_ADDRESS 0xfe4a557c /* @ECU_Address@autosar_swc_aeb_rtARID_DEF.ObjData_i[9].BoundingBox.LengthSideLat@ */ /end MEASUREMENT
/begin MEASUREMENT autosar_swc_aeb_rtARID_DEF.ObjData_i[9].BoundingBox.LengthSideLgt "" FLOAT32_IEEE autosar_swc_aeb_CM_single 0 0 -3.4E+38 3.4E+38 ECU_ADDRESS 0xfe4a5580 /* @ECU_Address@autosar_swc_aeb_rtARID_DEF.ObjData_i[9].BoundingBox.LengthSideLgt@ */ /end MEASUREMENT
/begin MEASUREMENT autosar_swc_aeb_rtARID_DEF.ObjData_i[9].BoundingBox.RotationAngle "" FLOAT32_IEEE autosar_swc_aeb_CM_single 0 0 -3.4E+38 3.4E+38 ECU_ADDRESS 0xfe4a558c /* @ECU_Address@autosar_swc_aeb_rtARID_DEF.ObjData_i[9].BoundingBox.RotationAngle@ */ /end MEASUREMENT
/begin MEASUREMENT autosar_swc_aeb_rtARID_DEF.ObjData_i[9].BoundingBox.SinRotation "" FLOAT32_IEEE autosar_swc_aeb_CM_single 0 0 -3.4E+38 3.4E+38 ECU_ADDRESS 0xfe4a5584 /* @ECU_Address@autosar_swc_aeb_rtARID_DEF.ObjData_i[9].BoundingBox.SinRotation@ */ /end MEASUREMENT
/begin MEASUREMENT autosar_swc_aeb_rtARID_DEF.ObjData_i[9].Idn "" ULONG autosar_swc_aeb_CM_uint32 0 0 0 4294967295 ECU_ADDRESS 0xfe4a55fc /* @ECU_Address@autosar_swc_aeb_rtARID_DEF.ObjData_i[9].Idn@ */ /end MEASUREMENT
/begin MEASUREMENT autosar_swc_aeb_rtARID_DEF.ObjData_i[9].InPathAtCurrentPosition "" UBYTE autosar_swc_aeb_CM_logical 0 0 0 1 ECU_ADDRESS 0xfe4a5590 /* @ECU_Address@autosar_swc_aeb_rtARID_DEF.ObjData_i[9].InPathAtCurrentPosition@ */ /end MEASUREMENT
/begin MEASUREMENT autosar_swc_aeb_rtARID_DEF.ObjData_i[9].LongPredTime.A "" FLOAT32_IEEE autosar_swc_aeb_CM_single 0 0 -3.4E+38 3.4E+38 ECU_ADDRESS 0xfe4a55d4 /* @ECU_Address@autosar_swc_aeb_rtARID_DEF.ObjData_i[9].LongPredTime.A@ */ /end MEASUREMENT
/begin MEASUREMENT autosar_swc_aeb_rtARID_DEF.ObjData_i[9].LongPredTime.ALat "" FLOAT32_IEEE autosar_swc_aeb_CM_single 0 0 -3.4E+38 3.4E+38 ECU_ADDRESS 0xfe4a55d0 /* @ECU_Address@autosar_swc_aeb_rtARID_DEF.ObjData_i[9].LongPredTime.ALat@ */ /end MEASUREMENT
/begin MEASUREMENT autosar_swc_aeb_rtARID_DEF.ObjData_i[9].LongPredTime.ALgt "" FLOAT32_IEEE autosar_swc_aeb_CM_single 0 0 -3.4E+38 3.4E+38 ECU_ADDRESS 0xfe4a55cc /* @ECU_Address@autosar_swc_aeb_rtARID_DEF.ObjData_i[9].LongPredTime.ALgt@ */ /end MEASUREMENT
/begin MEASUREMENT autosar_swc_aeb_rtARID_DEF.ObjData_i[9].LongPredTime.Crvt "" FLOAT32_IEEE autosar_swc_aeb_CM_single 0 0 -3.4E+38 3.4E+38 ECU_ADDRESS 0xfe4a55d8 /* @ECU_Address@autosar_swc_aeb_rtARID_DEF.ObjData_i[9].LongPredTime.Crvt@ */ /end MEASUREMENT
/begin MEASUREMENT autosar_swc_aeb_rtARID_DEF.ObjData_i[9].LongPredTime.InPath "" UBYTE autosar_swc_aeb_CM_logical 0 0 0 1 ECU_ADDRESS 0xfe4a55c9 /* @ECU_Address@autosar_swc_aeb_rtARID_DEF.ObjData_i[9].LongPredTime.InPath@ */ /end MEASUREMENT
/begin MEASUREMENT autosar_swc_aeb_rtARID_DEF.ObjData_i[9].LongPredTime.ObjOnCmngAndBrkg "" UBYTE autosar_swc_aeb_CM_logical 0 0 0 1 ECU_ADDRESS 0xfe4a55ca /* @ECU_Address@autosar_swc_aeb_rtARID_DEF.ObjData_i[9].LongPredTime.ObjOnCmngAndBrkg@ */ /end MEASUREMENT
/begin MEASUREMENT autosar_swc_aeb_rtARID_DEF.ObjData_i[9].LongPredTime.TTMSelected "" UBYTE autosar_swc_aeb_CM_logical 0 0 0 1 ECU_ADDRESS 0xfe4a55c8 /* @ECU_Address@autosar_swc_aeb_rtARID_DEF.ObjData_i[9].LongPredTime.TTMSelected@ */ /end MEASUREMENT
/begin MEASUREMENT autosar_swc_aeb_rtARID_DEF.ObjData_i[9].LongPredTime.TimeToMiddleLgt "" FLOAT32_IEEE autosar_swc_aeb_CM_single 0 0 -3.4E+38 3.4E+38 ECU_ADDRESS 0xfe4a55c0 /* @ECU_Address@autosar_swc_aeb_rtARID_DEF.ObjData_i[9].LongPredTime.TimeToMiddleLgt@ */ /end MEASUREMENT
/begin MEASUREMENT autosar_swc_aeb_rtARID_DEF.ObjData_i[9].LongPredTime.TimeToPassLgt "" FLOAT32_IEEE autosar_swc_aeb_CM_single 0 0 -3.4E+38 3.4E+38 ECU_ADDRESS 0xfe4a55c4 /* @ECU_Address@autosar_swc_aeb_rtARID_DEF.ObjData_i[9].LongPredTime.TimeToPassLgt@ */ /end MEASUREMENT
/begin MEASUREMENT autosar_swc_aeb_rtARID_DEF.ObjData_i[9].LongPredTime.TimeToReachLgt "" FLOAT32_IEEE autosar_swc_aeb_CM_single 0 0 -3.4E+38 3.4E+38 ECU_ADDRESS 0xfe4a55bc /* @ECU_Address@autosar_swc_aeb_rtARID_DEF.ObjData_i[9].LongPredTime.TimeToReachLgt@ */ /end MEASUREMENT
/begin MEASUREMENT autosar_swc_aeb_rtARID_DEF.ObjData_i[9].MotionType.AbsHeading "" FLOAT32_IEEE autosar_swc_aeb_CM_single 0 0 -3.4E+38 3.4E+38 ECU_ADDRESS 0xfe4a5578 /* @ECU_Address@autosar_swc_aeb_rtARID_DEF.ObjData_i[9].MotionType.AbsHeading@ */ /end MEASUREMENT
/begin MEASUREMENT autosar_swc_aeb_rtARID_DEF.ObjData_i[9].MotionType.CurvedMotion "" UBYTE autosar_swc_aeb_CM_logical 0 0 0 1 ECU_ADDRESS 0xfe4a5576 /* @ECU_Address@autosar_swc_aeb_rtARID_DEF.ObjData_i[9].MotionType.CurvedMotion@ */ /end MEASUREMENT
/begin MEASUREMENT autosar_swc_aeb_rtARID_DEF.ObjData_i[9].MotionType.MovingOncoming "" UBYTE autosar_swc_aeb_CM_logical 0 0 0 1 ECU_ADDRESS 0xfe4a5571 /* @ECU_Address@autosar_swc_aeb_rtARID_DEF.ObjData_i[9].MotionType.MovingOncoming@ */ /end MEASUREMENT
/begin MEASUREMENT autosar_swc_aeb_rtARID_DEF.ObjData_i[9].MotionType.ObjectIsMotorVehicle "Object type is Car, Truck, Motorcycle or Vehicle Of Unkown Class." UBYTE autosar_swc_aeb_CM_logical 0 0 0 1 ECU_ADDRESS 0xfe4a5575 /* @ECU_Address@autosar_swc_aeb_rtARID_DEF.ObjData_i[9].MotionType.ObjectIsMotorVehicle@ */ /end MEASUREMENT
/begin MEASUREMENT autosar_swc_aeb_rtARID_DEF.ObjData_i[9].MotionType.ObjectIsVehicle "" UBYTE autosar_swc_aeb_CM_logical 0 0 0 1 ECU_ADDRESS 0xfe4a5574 /* @ECU_Address@autosar_swc_aeb_rtARID_DEF.ObjData_i[9].MotionType.ObjectIsVehicle@ */ /end MEASUREMENT
/begin MEASUREMENT autosar_swc_aeb_rtARID_DEF.ObjData_i[9].MotionType.ParallellVehicleLongPred "" UBYTE autosar_swc_aeb_CM_logical 0 0 0 1 ECU_ADDRESS 0xfe4a5572 /* @ECU_Address@autosar_swc_aeb_rtARID_DEF.ObjData_i[9].MotionType.ParallellVehicleLongPred@ */ /end MEASUREMENT
/begin MEASUREMENT autosar_swc_aeb_rtARID_DEF.ObjData_i[9].MotionType.ParallellVehicleShortPred "" UBYTE autosar_swc_aeb_CM_logical 0 0 0 1 ECU_ADDRESS 0xfe4a5573 /* @ECU_Address@autosar_swc_aeb_rtARID_DEF.ObjData_i[9].MotionType.ParallellVehicleShortPred@ */ /end MEASUREMENT
/begin MEASUREMENT autosar_swc_aeb_rtARID_DEF.ObjData_i[9].MotionType.SideIsClosest "" UBYTE autosar_swc_aeb_CM_logical 0 0 0 1 ECU_ADDRESS 0xfe4a5577 /* @ECU_Address@autosar_swc_aeb_rtARID_DEF.ObjData_i[9].MotionType.SideIsClosest@ */ /end MEASUREMENT
/begin MEASUREMENT autosar_swc_aeb_rtARID_DEF.ObjData_i[9].MotionType.Stationary "" UBYTE autosar_swc_aeb_CM_logical 0 0 0 1 ECU_ADDRESS 0xfe4a5570 /* @ECU_Address@autosar_swc_aeb_rtARID_DEF.ObjData_i[9].MotionType.Stationary@ */ /end MEASUREMENT
/begin MEASUREMENT autosar_swc_aeb_rtARID_DEF.ObjData_i[9].Offsets.OffsLatInPathCloseEdge "" FLOAT32_IEEE autosar_swc_aeb_CM_single 0 0 -3.4E+38 3.4E+38 ECU_ADDRESS 0xfe4a55ac /* @ECU_Address@autosar_swc_aeb_rtARID_DEF.ObjData_i[9].Offsets.OffsLatInPathCloseEdge@ */ /end MEASUREMENT
/begin MEASUREMENT autosar_swc_aeb_rtARID_DEF.ObjData_i[9].Offsets.OffsLatInPathFarEdge "" FLOAT32_IEEE autosar_swc_aeb_CM_single 0 0 -3.4E+38 3.4E+38 ECU_ADDRESS 0xfe4a55b0 /* @ECU_Address@autosar_swc_aeb_rtARID_DEF.ObjData_i[9].Offsets.OffsLatInPathFarEdge@ */ /end MEASUREMENT
/begin MEASUREMENT autosar_swc_aeb_rtARID_DEF.ObjData_i[9].Offsets.OffsLatInPathPrimaryTarget "" FLOAT32_IEEE autosar_swc_aeb_CM_single 0 0 -3.4E+38 3.4E+38 ECU_ADDRESS 0xfe4a55a8 /* @ECU_Address@autosar_swc_aeb_rtARID_DEF.ObjData_i[9].Offsets.OffsLatInPathPrimaryTarget@ */ /end MEASUREMENT
/begin MEASUREMENT autosar_swc_aeb_rtARID_DEF.ObjData_i[9].Offsets.OffsLatIntersection "" FLOAT32_IEEE autosar_swc_aeb_CM_single 0 0 -3.4E+38 3.4E+38 ECU_ADDRESS 0xfe4a55b4 /* @ECU_Address@autosar_swc_aeb_rtARID_DEF.ObjData_i[9].Offsets.OffsLatIntersection@ */ /end MEASUREMENT
/begin MEASUREMENT autosar_swc_aeb_rtARID_DEF.ObjData_i[9].Offsets.OffsLatLongPred "" FLOAT32_IEEE autosar_swc_aeb_CM_single 0 0 -3.4E+38 3.4E+38 ECU_ADDRESS 0xfe4a5598 /* @ECU_Address@autosar_swc_aeb_rtARID_DEF.ObjData_i[9].Offsets.OffsLatLongPred@ */ /end MEASUREMENT
/begin MEASUREMENT autosar_swc_aeb_rtARID_DEF.ObjData_i[9].Offsets.OffsLatManoeuvre "" FLOAT32_IEEE autosar_swc_aeb_CM_single 0 0 -3.4E+38 3.4E+38 ECU_ADDRESS 0xfe4a55a4 /* @ECU_Address@autosar_swc_aeb_rtARID_DEF.ObjData_i[9].Offsets.OffsLatManoeuvre@ */ /end MEASUREMENT
/begin MEASUREMENT autosar_swc_aeb_rtARID_DEF.ObjData_i[9].Offsets.OffsLatMplTar "" FLOAT32_IEEE autosar_swc_aeb_CM_single 0 0 -3.4E+38 3.4E+38 ECU_ADDRESS 0xfe4a55b8 /* @ECU_Address@autosar_swc_aeb_rtARID_DEF.ObjData_i[9].Offsets.OffsLatMplTar@ */ /end MEASUREMENT
/begin MEASUREMENT autosar_swc_aeb_rtARID_DEF.ObjData_i[9].Offsets.OffsLatShortPred "" FLOAT32_IEEE autosar_swc_aeb_CM_single 0 0 -3.4E+38 3.4E+38 ECU_ADDRESS 0xfe4a55a0 /* @ECU_Address@autosar_swc_aeb_rtARID_DEF.ObjData_i[9].Offsets.OffsLatShortPred@ */ /end MEASUREMENT
/begin MEASUREMENT autosar_swc_aeb_rtARID_DEF.ObjData_i[9].Offsets.OffsLgtLongPred "" FLOAT32_IEEE autosar_swc_aeb_CM_single 0 0 -3.4E+38 3.4E+38 ECU_ADDRESS 0xfe4a5594 /* @ECU_Address@autosar_swc_aeb_rtARID_DEF.ObjData_i[9].Offsets.OffsLgtLongPred@ */ /end MEASUREMENT
/begin MEASUREMENT autosar_swc_aeb_rtARID_DEF.ObjData_i[9].Offsets.OffsLgtShortPred "" FLOAT32_IEEE autosar_swc_aeb_CM_single 0 0 -3.4E+38 3.4E+38 ECU_ADDRESS 0xfe4a559c /* @ECU_Address@autosar_swc_aeb_rtARID_DEF.ObjData_i[9].Offsets.OffsLgtShortPred@ */ /end MEASUREMENT
/begin MEASUREMENT autosar_swc_aeb_rtARID_DEF.ObjData_i[9].PredictionValid "" UBYTE autosar_swc_aeb_CM_logical 0 0 0 1 ECU_ADDRESS 0xfe4a5591 /* @ECU_Address@autosar_swc_aeb_rtARID_DEF.ObjData_i[9].PredictionValid@ */ /end MEASUREMENT
/begin MEASUREMENT autosar_swc_aeb_rtARID_DEF.ObjData_i[9].ShortPredTime.A "" FLOAT32_IEEE autosar_swc_aeb_CM_single 0 0 -3.4E+38 3.4E+38 ECU_ADDRESS 0xfe4a55f4 /* @ECU_Address@autosar_swc_aeb_rtARID_DEF.ObjData_i[9].ShortPredTime.A@ */ /end MEASUREMENT
/begin MEASUREMENT autosar_swc_aeb_rtARID_DEF.ObjData_i[9].ShortPredTime.ALat "" FLOAT32_IEEE autosar_swc_aeb_CM_single 0 0 -3.4E+38 3.4E+38 ECU_ADDRESS 0xfe4a55f0 /* @ECU_Address@autosar_swc_aeb_rtARID_DEF.ObjData_i[9].ShortPredTime.ALat@ */ /end MEASUREMENT
/begin MEASUREMENT autosar_swc_aeb_rtARID_DEF.ObjData_i[9].ShortPredTime.ALgt "" FLOAT32_IEEE autosar_swc_aeb_CM_single 0 0 -3.4E+38 3.4E+38 ECU_ADDRESS 0xfe4a55ec /* @ECU_Address@autosar_swc_aeb_rtARID_DEF.ObjData_i[9].ShortPredTime.ALgt@ */ /end MEASUREMENT
/begin MEASUREMENT autosar_swc_aeb_rtARID_DEF.ObjData_i[9].ShortPredTime.Crvt "" FLOAT32_IEEE autosar_swc_aeb_CM_single 0 0 -3.4E+38 3.4E+38 ECU_ADDRESS 0xfe4a55f8 /* @ECU_Address@autosar_swc_aeb_rtARID_DEF.ObjData_i[9].ShortPredTime.Crvt@ */ /end MEASUREMENT
/begin MEASUREMENT autosar_swc_aeb_rtARID_DEF.ObjData_i[9].ShortPredTime.InPath "" UBYTE autosar_swc_aeb_CM_logical 0 0 0 1 ECU_ADDRESS 0xfe4a55e9 /* @ECU_Address@autosar_swc_aeb_rtARID_DEF.ObjData_i[9].ShortPredTime.InPath@ */ /end MEASUREMENT
/begin MEASUREMENT autosar_swc_aeb_rtARID_DEF.ObjData_i[9].ShortPredTime.ObjOnCmngAndBrkg "" UBYTE autosar_swc_aeb_CM_logical 0 0 0 1 ECU_ADDRESS 0xfe4a55ea /* @ECU_Address@autosar_swc_aeb_rtARID_DEF.ObjData_i[9].ShortPredTime.ObjOnCmngAndBrkg@ */ /end MEASUREMENT
/begin MEASUREMENT autosar_swc_aeb_rtARID_DEF.ObjData_i[9].ShortPredTime.TTMSelected "" UBYTE autosar_swc_aeb_CM_logical 0 0 0 1 ECU_ADDRESS 0xfe4a55e8 /* @ECU_Address@autosar_swc_aeb_rtARID_DEF.ObjData_i[9].ShortPredTime.TTMSelected@ */ /end MEASUREMENT
/begin MEASUREMENT autosar_swc_aeb_rtARID_DEF.ObjData_i[9].ShortPredTime.TimeToMiddleLgt "" FLOAT32_IEEE autosar_swc_aeb_CM_single 0 0 -3.4E+38 3.4E+38 ECU_ADDRESS 0xfe4a55e0 /* @ECU_Address@autosar_swc_aeb_rtARID_DEF.ObjData_i[9].ShortPredTime.TimeToMiddleLgt@ */ /end MEASUREMENT
/begin MEASUREMENT autosar_swc_aeb_rtARID_DEF.ObjData_i[9].ShortPredTime.TimeToPassLgt "" FLOAT32_IEEE autosar_swc_aeb_CM_single 0 0 -3.4E+38 3.4E+38 ECU_ADDRESS 0xfe4a55e4 /* @ECU_Address@autosar_swc_aeb_rtARID_DEF.ObjData_i[9].ShortPredTime.TimeToPassLgt@ */ /end MEASUREMENT
/begin MEASUREMENT autosar_swc_aeb_rtARID_DEF.ObjData_i[9].ShortPredTime.TimeToReachLgt "" FLOAT32_IEEE autosar_swc_aeb_CM_single 0 0 -3.4E+38 3.4E+38 ECU_ADDRESS 0xfe4a55dc /* @ECU_Address@autosar_swc_aeb_rtARID_DEF.ObjData_i[9].ShortPredTime.TimeToReachLgt@ */ /end MEASUREMENT
/begin MEASUREMENT autosar_swc_aeb_rtARID_DEF.ObjPrimaryTarget.Estimn.A "" FLOAT32_IEEE autosar_swc_aeb_CM_single 0 0 -100.000000 100.000000 ECU_ADDRESS 0xfe4a9d14 /* @ECU_Address@autosar_swc_aeb_rtARID_DEF.ObjPrimaryTarget.Estimn.A@ */ /end MEASUREMENT
/begin MEASUREMENT autosar_swc_aeb_rtARID_DEF.ObjPrimaryTarget.Estimn.ALat "" FLOAT32_IEEE autosar_swc_aeb_CM_single 0 0 -100.000000 100.000000 ECU_ADDRESS 0xfe4a9d1c /* @ECU_Address@autosar_swc_aeb_rtARID_DEF.ObjPrimaryTarget.Estimn.ALat@ */ /end MEASUREMENT
/begin MEASUREMENT autosar_swc_aeb_rtARID_DEF.ObjPrimaryTarget.Estimn.ALgt "" FLOAT32_IEEE autosar_swc_aeb_CM_single 0 0 -100.000000 100.000000 ECU_ADDRESS 0xfe4a9d18 /* @ECU_Address@autosar_swc_aeb_rtARID_DEF.ObjPrimaryTarget.Estimn.ALgt@ */ /end MEASUREMENT
/begin MEASUREMENT autosar_swc_aeb_rtARID_DEF.ObjPrimaryTarget.Estimn.AgDir "" FLOAT32_IEEE autosar_swc_aeb_CM_single 0 0 -6.300000 6.300000 ECU_ADDRESS 0xfe4a9d20 /* @ECU_Address@autosar_swc_aeb_rtARID_DEF.ObjPrimaryTarget.Estimn.AgDir@ */ /end MEASUREMENT
/begin MEASUREMENT autosar_swc_aeb_rtARID_DEF.ObjPrimaryTarget.Estimn.Crvt "" FLOAT32_IEEE autosar_swc_aeb_CM_single 0 0 -100.000000 100.000000 ECU_ADDRESS 0xfe4a9d24 /* @ECU_Address@autosar_swc_aeb_rtARID_DEF.ObjPrimaryTarget.Estimn.Crvt@ */ /end MEASUREMENT
/begin MEASUREMENT autosar_swc_aeb_rtARID_DEF.ObjPrimaryTarget.Estimn.PosnLat "" FLOAT32_IEEE autosar_swc_aeb_CM_single 0 0 -1000.000000 1000.000000 ECU_ADDRESS 0xfe4a9d04 /* @ECU_Address@autosar_swc_aeb_rtARID_DEF.ObjPrimaryTarget.Estimn.PosnLat@ */ /end MEASUREMENT
/begin MEASUREMENT autosar_swc_aeb_rtARID_DEF.ObjPrimaryTarget.Estimn.PosnLgt "" FLOAT32_IEEE autosar_swc_aeb_CM_single 0 0 -100.000000 1000.000000 ECU_ADDRESS 0xfe4a9d00 /* @ECU_Address@autosar_swc_aeb_rtARID_DEF.ObjPrimaryTarget.Estimn.PosnLgt@ */ /end MEASUREMENT
/begin MEASUREMENT autosar_swc_aeb_rtARID_DEF.ObjPrimaryTarget.Estimn.Spd "" FLOAT32_IEEE autosar_swc_aeb_CM_single 0 0 -100.000000 100.000000 ECU_ADDRESS 0xfe4a9d08 /* @ECU_Address@autosar_swc_aeb_rtARID_DEF.ObjPrimaryTarget.Estimn.Spd@ */ /end MEASUREMENT
/begin MEASUREMENT autosar_swc_aeb_rtARID_DEF.ObjPrimaryTarget.Estimn.VLat "" FLOAT32_IEEE autosar_swc_aeb_CM_single 0 0 -100.000000 100.000000 ECU_ADDRESS 0xfe4a9d10 /* @ECU_Address@autosar_swc_aeb_rtARID_DEF.ObjPrimaryTarget.Estimn.VLat@ */ /end MEASUREMENT
/begin MEASUREMENT autosar_swc_aeb_rtARID_DEF.ObjPrimaryTarget.Estimn.VLgt "" FLOAT32_IEEE autosar_swc_aeb_CM_single 0 0 -100.000000 100.000000 ECU_ADDRESS 0xfe4a9d0c /* @ECU_Address@autosar_swc_aeb_rtARID_DEF.ObjPrimaryTarget.Estimn.VLgt@ */ /end MEASUREMENT
/begin MEASUREMENT autosar_swc_aeb_rtARID_DEF.ObjPrimaryTarget.Info.DstLatFromMidOfLaneSelf "" FLOAT32_IEEE autosar_swc_aeb_CM_single 0 0 -100.000000 100.000000 ECU_ADDRESS 0xfe4a9d50 /* @ECU_Address@autosar_swc_aeb_rtARID_DEF.ObjPrimaryTarget.Info.DstLatFromMidOfLaneSelf@ */ /end MEASUREMENT
/begin MEASUREMENT autosar_swc_aeb_rtARID_DEF.ObjPrimaryTarget.Info.Hei "" FLOAT32_IEEE autosar_swc_aeb_CM_single 0 0 0.000000 100.000000 ECU_ADDRESS 0xfe4a9d34 /* @ECU_Address@autosar_swc_aeb_rtARID_DEF.ObjPrimaryTarget.Info.Hei@ */ /end MEASUREMENT
/begin MEASUREMENT autosar_swc_aeb_rtARID_DEF.ObjPrimaryTarget.Info.IndcrBrkLi "" SLONG autosar_swc_aeb_CM_LiSts1Vcc 0 0 0 2 ECU_ADDRESS 0xfe4a9d40 /* @ECU_Address@autosar_swc_aeb_rtARID_DEF.ObjPrimaryTarget.Info.IndcrBrkLi@ */ /end MEASUREMENT
/begin MEASUREMENT autosar_swc_aeb_rtARID_DEF.ObjPrimaryTarget.Info.IndcrHzrdLi "" SLONG autosar_swc_aeb_CM_LiSts1Vcc 0 0 0 2 ECU_ADDRESS 0xfe4a9d44 /* @ECU_Address@autosar_swc_aeb_rtARID_DEF.ObjPrimaryTarget.Info.IndcrHzrdLi@ */ /end MEASUREMENT
/begin MEASUREMENT autosar_swc_aeb_rtARID_DEF.ObjPrimaryTarget.Info.IndcrTurn "" SLONG autosar_swc_aeb_CM_IndcrTurn1Vcc 0 0 0 3 ECU_ADDRESS 0xfe4a9d3c /* @ECU_Address@autosar_swc_aeb_rtARID_DEF.ObjPrimaryTarget.Info.IndcrTurn@ */ /end MEASUREMENT
/begin MEASUREMENT autosar_swc_aeb_rtARID_DEF.ObjPrimaryTarget.Info.Length "" FLOAT32_IEEE autosar_swc_aeb_CM_single 0 0 -3.4E+38 3.4E+38 ECU_ADDRESS 0xfe4a9d30 /* @ECU_Address@autosar_swc_aeb_rtARID_DEF.ObjPrimaryTarget.Info.Length@ */ /end MEASUREMENT
/begin MEASUREMENT autosar_swc_aeb_rtARID_DEF.ObjPrimaryTarget.Info.MtnPat "" SLONG autosar_swc_aeb_CM_ObjMtnPat1Vcc 0 0 0 4 ECU_ADDRESS 0xfe4a9d48 /* @ECU_Address@autosar_swc_aeb_rtARID_DEF.ObjPrimaryTarget.Info.MtnPat@ */ /end MEASUREMENT
/begin MEASUREMENT autosar_swc_aeb_rtARID_DEF.ObjPrimaryTarget.Info.MtnPatHist "" SLONG autosar_swc_aeb_CM_ObjMtnPatHist1Vcc 0 0 0 3 ECU_ADDRESS 0xfe4a9d4c /* @ECU_Address@autosar_swc_aeb_rtARID_DEF.ObjPrimaryTarget.Info.MtnPatHist@ */ /end MEASUREMENT
/begin MEASUREMENT autosar_swc_aeb_rtARID_DEF.ObjPrimaryTarget.Info.SideNear "" SLONG autosar_swc_aeb_CM_Side1Vcc 0 0 0 4 ECU_ADDRESS 0xfe4a9d38 /* @ECU_Address@autosar_swc_aeb_rtARID_DEF.ObjPrimaryTarget.Info.SideNear@ */ /end MEASUREMENT
/begin MEASUREMENT autosar_swc_aeb_rtARID_DEF.ObjPrimaryTarget.Info.Typ "" SLONG autosar_swc_aeb_CM_ObjClassn3Vcc 0 0 0 10 ECU_ADDRESS 0xfe4a9d28 /* @ECU_Address@autosar_swc_aeb_rtARID_DEF.ObjPrimaryTarget.Info.Typ@ */ /end MEASUREMENT
/begin MEASUREMENT autosar_swc_aeb_rtARID_DEF.ObjPrimaryTarget.Info.Width "" FLOAT32_IEEE autosar_swc_aeb_CM_single 0 0 0.000000 100.000000 ECU_ADDRESS 0xfe4a9d2c /* @ECU_Address@autosar_swc_aeb_rtARID_DEF.ObjPrimaryTarget.Info.Width@ */ /end MEASUREMENT
/begin MEASUREMENT autosar_swc_aeb_rtARID_DEF.ObjPrimaryTarget.Ppty.AStdDe "" FLOAT32_IEEE autosar_swc_aeb_CM_single 0 0 -100.000000 100.000000 ECU_ADDRESS 0xfe4a9d94 /* @ECU_Address@autosar_swc_aeb_rtARID_DEF.ObjPrimaryTarget.Ppty.AStdDe@ */ /end MEASUREMENT
/begin MEASUREMENT autosar_swc_aeb_rtARID_DEF.ObjPrimaryTarget.Ppty.AgDirStdDe "" FLOAT32_IEEE autosar_swc_aeb_CM_single 0 0 -100.000000 100.000000 ECU_ADDRESS 0xfe4a9d8c /* @ECU_Address@autosar_swc_aeb_rtARID_DEF.ObjPrimaryTarget.Ppty.AgDirStdDe@ */ /end MEASUREMENT
/begin MEASUREMENT autosar_swc_aeb_rtARID_DEF.ObjPrimaryTarget.Ppty.CllsnMtgtnByBrkgPrimQly "" SLONG autosar_swc_aeb_CM_Relbl4Vcc 0 0 0 3 ECU_ADDRESS 0xfe4a9d6c /* @ECU_Address@autosar_swc_aeb_rtARID_DEF.ObjPrimaryTarget.Ppty.CllsnMtgtnByBrkgPrimQly@ */ /end MEASUREMENT
/begin MEASUREMENT autosar_swc_aeb_rtARID_DEF.ObjPrimaryTarget.Ppty.CllsnMtgtnByBrkgSecQly "" SLONG autosar_swc_aeb_CM_Relbl1Vcc 0 0 0 1 ECU_ADDRESS 0xfe4a9d70 /* @ECU_Address@autosar_swc_aeb_rtARID_DEF.ObjPrimaryTarget.Ppty.CllsnMtgtnByBrkgSecQly@ */ /end MEASUREMENT
/begin MEASUREMENT autosar_swc_aeb_rtARID_DEF.ObjPrimaryTarget.Ppty.CllsnWarnFwdQly "" SLONG autosar_swc_aeb_CM_Relbl1Vcc 0 0 0 1 ECU_ADDRESS 0xfe4a9d74 /* @ECU_Address@autosar_swc_aeb_rtARID_DEF.ObjPrimaryTarget.Ppty.CllsnWarnFwdQly@ */ /end MEASUREMENT
/begin MEASUREMENT autosar_swc_aeb_rtARID_DEF.ObjPrimaryTarget.Ppty.DstLatFromMidOfLaneSelfQly "" SLONG autosar_swc_aeb_CM_Relbl3Vcc 0 0 0 4 ECU_ADDRESS 0xfe4a9d7c /* @ECU_Address@autosar_swc_aeb_rtARID_DEF.ObjPrimaryTarget.Ppty.DstLatFromMidOfLaneSelfQly@ */ /end MEASUREMENT
/begin MEASUREMENT autosar_swc_aeb_rtARID_DEF.ObjPrimaryTarget.Ppty.EmgyLaneKeepAidPosnQly "" SLONG autosar_swc_aeb_CM_ObjPpty1VccEmgyLaneKeepAidPosnQly0 0 0 0 2 ECU_ADDRESS 0xfe4a9d80 /* @ECU_Address@autosar_swc_aeb_rtARID_DEF.ObjPrimaryTarget.Ppty.EmgyLaneKeepAidPosnQly@ */ /end MEASUREMENT
/begin MEASUREMENT autosar_swc_aeb_rtARID_DEF.ObjPrimaryTarget.Ppty.FusnSrc "" UBYTE autosar_swc_aeb_CM_uint8 0 0 0.000000 2.000000 ECU_ADDRESS 0xfe4a9d98 /* @ECU_Address@autosar_swc_aeb_rtARID_DEF.ObjPrimaryTarget.Ppty.FusnSrc@ */ /end MEASUREMENT
/begin MEASUREMENT autosar_swc_aeb_rtARID_DEF.ObjPrimaryTarget.Ppty.Idn "" ULONG autosar_swc_aeb_CM_uint32 0 0 0.000000 32.000000 ECU_ADDRESS 0xfe4a9d58 /* @ECU_Address@autosar_swc_aeb_rtARID_DEF.ObjPrimaryTarget.Ppty.Idn@ */ /end MEASUREMENT
/begin MEASUREMENT autosar_swc_aeb_rtARID_DEF.ObjPrimaryTarget.Ppty.MdlOfMtn "" SLONG autosar_swc_aeb_CM_ObjPpty1VccMdlOfMtn0 0 0 0 1 ECU_ADDRESS 0xfe4a9d64 /* @ECU_Address@autosar_swc_aeb_rtARID_DEF.ObjPrimaryTarget.Ppty.MdlOfMtn@ */ /end MEASUREMENT
/begin MEASUREMENT autosar_swc_aeb_rtARID_DEF.ObjPrimaryTarget.Ppty.Object_Age "" A_UINT64 autosar_swc_aeb_CM_uint64 0 0 0 18446744073709551615 ECU_ADDRESS 0xfe4a9da0 /* @ECU_Address@autosar_swc_aeb_rtARID_DEF.ObjPrimaryTarget.Ppty.Object_Age@ */ /end MEASUREMENT
/begin MEASUREMENT autosar_swc_aeb_rtARID_DEF.ObjPrimaryTarget.Ppty.PosnLatStdDe "" FLOAT32_IEEE autosar_swc_aeb_CM_single 0 0 -100.000000 100.000000 ECU_ADDRESS 0xfe4a9d88 /* @ECU_Address@autosar_swc_aeb_rtARID_DEF.ObjPrimaryTarget.Ppty.PosnLatStdDe@ */ /end MEASUREMENT
/begin MEASUREMENT autosar_swc_aeb_rtARID_DEF.ObjPrimaryTarget.Ppty.PosnLgtStdDe "" FLOAT32_IEEE autosar_swc_aeb_CM_single 0 0 -100.000000 100.000000 ECU_ADDRESS 0xfe4a9d84 /* @ECU_Address@autosar_swc_aeb_rtARID_DEF.ObjPrimaryTarget.Ppty.PosnLgtStdDe@ */ /end MEASUREMENT
/begin MEASUREMENT autosar_swc_aeb_rtARID_DEF.ObjPrimaryTarget.Ppty.SpdStdDe "" FLOAT32_IEEE autosar_swc_aeb_CM_single 0 0 -100.000000 100.000000 ECU_ADDRESS 0xfe4a9d90 /* @ECU_Address@autosar_swc_aeb_rtARID_DEF.ObjPrimaryTarget.Ppty.SpdStdDe@ */ /end MEASUREMENT
/begin MEASUREMENT autosar_swc_aeb_rtARID_DEF.ObjPrimaryTarget.Ppty.Sts "" SLONG autosar_swc_aeb_CM_SnsrDataSts1Vcc 0 0 0 6 ECU_ADDRESS 0xfe4a9d60 /* @ECU_Address@autosar_swc_aeb_rtARID_DEF.ObjPrimaryTarget.Ppty.Sts@ */ /end MEASUREMENT
/begin MEASUREMENT autosar_swc_aeb_rtARID_DEF.ObjPrimaryTarget.Ppty.TrfcJamAssiQly "" SLONG autosar_swc_aeb_CM_ObjPpty1VccTrfcJamAssiQly0 0 0 0 2 ECU_ADDRESS 0xfe4a9d78 /* @ECU_Address@autosar_swc_aeb_rtARID_DEF.ObjPrimaryTarget.Ppty.TrfcJamAssiQly@ */ /end MEASUREMENT
/begin MEASUREMENT autosar_swc_aeb_rtARID_DEF.ObjPrimaryTarget.Ppty.TrfcSceno "" SLONG autosar_swc_aeb_CM_ObjPpty1VccTrfcSceno0 0 0 0 1 ECU_ADDRESS 0xfe4a9d68 /* @ECU_Address@autosar_swc_aeb_rtARID_DEF.ObjPrimaryTarget.Ppty.TrfcSceno@ */ /end MEASUREMENT
/begin MEASUREMENT autosar_swc_aeb_rtARID_DEF.ObjPrimaryTarget.Ppty.VisnId "" ULONG autosar_swc_aeb_CM_uint32 0 0 0.000000 15.000000 ECU_ADDRESS 0xfe4a9d5c /* @ECU_Address@autosar_swc_aeb_rtARID_DEF.ObjPrimaryTarget.Ppty.VisnId@ */ /end MEASUREMENT
/begin MEASUREMENT autosar_swc_aeb_rtARID_DEF.ObjPrimaryTarget_b.Estimn.A "" FLOAT32_IEEE autosar_swc_aeb_CM_single 0 0 -100.000000 100.000000 ECU_ADDRESS 0xfe4a9dbc /* @ECU_Address@autosar_swc_aeb_rtARID_DEF.ObjPrimaryTarget_b.Estimn.A@ */ /end MEASUREMENT
/begin MEASUREMENT autosar_swc_aeb_rtARID_DEF.ObjPrimaryTarget_b.Estimn.ALat "" FLOAT32_IEEE autosar_swc_aeb_CM_single 0 0 -100.000000 100.000000 ECU_ADDRESS 0xfe4a9dc4 /* @ECU_Address@autosar_swc_aeb_rtARID_DEF.ObjPrimaryTarget_b.Estimn.ALat@ */ /end MEASUREMENT
/begin MEASUREMENT autosar_swc_aeb_rtARID_DEF.ObjPrimaryTarget_b.Estimn.ALgt "" FLOAT32_IEEE autosar_swc_aeb_CM_single 0 0 -100.000000 100.000000 ECU_ADDRESS 0xfe4a9dc0 /* @ECU_Address@autosar_swc_aeb_rtARID_DEF.ObjPrimaryTarget_b.Estimn.ALgt@ */ /end MEASUREMENT
/begin MEASUREMENT autosar_swc_aeb_rtARID_DEF.ObjPrimaryTarget_b.Estimn.AgDir "" FLOAT32_IEEE autosar_swc_aeb_CM_single 0 0 -6.300000 6.300000 ECU_ADDRESS 0xfe4a9dc8 /* @ECU_Address@autosar_swc_aeb_rtARID_DEF.ObjPrimaryTarget_b.Estimn.AgDir@ */ /end MEASUREMENT
/begin MEASUREMENT autosar_swc_aeb_rtARID_DEF.ObjPrimaryTarget_b.Estimn.Crvt "" FLOAT32_IEEE autosar_swc_aeb_CM_single 0 0 -100.000000 100.000000 ECU_ADDRESS 0xfe4a9dcc /* @ECU_Address@autosar_swc_aeb_rtARID_DEF.ObjPrimaryTarget_b.Estimn.Crvt@ */ /end MEASUREMENT
/begin MEASUREMENT autosar_swc_aeb_rtARID_DEF.ObjPrimaryTarget_b.Estimn.PosnLat "" FLOAT32_IEEE autosar_swc_aeb_CM_single 0 0 -1000.000000 1000.000000 ECU_ADDRESS 0xfe4a9dac /* @ECU_Address@autosar_swc_aeb_rtARID_DEF.ObjPrimaryTarget_b.Estimn.PosnLat@ */ /end MEASUREMENT
/begin MEASUREMENT autosar_swc_aeb_rtARID_DEF.ObjPrimaryTarget_b.Estimn.PosnLgt "" FLOAT32_IEEE autosar_swc_aeb_CM_single 0 0 -100.000000 1000.000000 ECU_ADDRESS 0xfe4a9da8 /* @ECU_Address@autosar_swc_aeb_rtARID_DEF.ObjPrimaryTarget_b.Estimn.PosnLgt@ */ /end MEASUREMENT
/begin MEASUREMENT autosar_swc_aeb_rtARID_DEF.ObjPrimaryTarget_b.Estimn.Spd "" FLOAT32_IEEE autosar_swc_aeb_CM_single 0 0 -100.000000 100.000000 ECU_ADDRESS 0xfe4a9db0 /* @ECU_Address@autosar_swc_aeb_rtARID_DEF.ObjPrimaryTarget_b.Estimn.Spd@ */ /end MEASUREMENT
/begin MEASUREMENT autosar_swc_aeb_rtARID_DEF.ObjPrimaryTarget_b.Estimn.VLat "" FLOAT32_IEEE autosar_swc_aeb_CM_single 0 0 -100.000000 100.000000 ECU_ADDRESS 0xfe4a9db8 /* @ECU_Address@autosar_swc_aeb_rtARID_DEF.ObjPrimaryTarget_b.Estimn.VLat@ */ /end MEASUREMENT
/begin MEASUREMENT autosar_swc_aeb_rtARID_DEF.ObjPrimaryTarget_b.Estimn.VLgt "" FLOAT32_IEEE autosar_swc_aeb_CM_single 0 0 -100.000000 100.000000 ECU_ADDRESS 0xfe4a9db4 /* @ECU_Address@autosar_swc_aeb_rtARID_DEF.ObjPrimaryTarget_b.Estimn.VLgt@ */ /end MEASUREMENT
/begin MEASUREMENT autosar_swc_aeb_rtARID_DEF.ObjPrimaryTarget_b.Info.DstLatFromMidOfLaneSelf "" FLOAT32_IEEE autosar_swc_aeb_CM_single 0 0 -100.000000 100.000000 ECU_ADDRESS 0xfe4a9df8 /* @ECU_Address@autosar_swc_aeb_rtARID_DEF.ObjPrimaryTarget_b.Info.DstLatFromMidOfLaneSelf@ */ /end MEASUREMENT
/begin MEASUREMENT autosar_swc_aeb_rtARID_DEF.ObjPrimaryTarget_b.Info.Hei "" FLOAT32_IEEE autosar_swc_aeb_CM_single 0 0 0.000000 100.000000 ECU_ADDRESS 0xfe4a9ddc /* @ECU_Address@autosar_swc_aeb_rtARID_DEF.ObjPrimaryTarget_b.Info.Hei@ */ /end MEASUREMENT
/begin MEASUREMENT autosar_swc_aeb_rtARID_DEF.ObjPrimaryTarget_b.Info.IndcrBrkLi "" SLONG autosar_swc_aeb_CM_LiSts1Vcc 0 0 0 2 ECU_ADDRESS 0xfe4a9de8 /* @ECU_Address@autosar_swc_aeb_rtARID_DEF.ObjPrimaryTarget_b.Info.IndcrBrkLi@ */ /end MEASUREMENT
/begin MEASUREMENT autosar_swc_aeb_rtARID_DEF.ObjPrimaryTarget_b.Info.IndcrHzrdLi "" SLONG autosar_swc_aeb_CM_LiSts1Vcc 0 0 0 2 ECU_ADDRESS 0xfe4a9dec /* @ECU_Address@autosar_swc_aeb_rtARID_DEF.ObjPrimaryTarget_b.Info.IndcrHzrdLi@ */ /end MEASUREMENT
/begin MEASUREMENT autosar_swc_aeb_rtARID_DEF.ObjPrimaryTarget_b.Info.IndcrTurn "" SLONG autosar_swc_aeb_CM_IndcrTurn1Vcc 0 0 0 3 ECU_ADDRESS 0xfe4a9de4 /* @ECU_Address@autosar_swc_aeb_rtARID_DEF.ObjPrimaryTarget_b.Info.IndcrTurn@ */ /end MEASUREMENT
/begin MEASUREMENT autosar_swc_aeb_rtARID_DEF.ObjPrimaryTarget_b.Info.Length "" FLOAT32_IEEE autosar_swc_aeb_CM_single 0 0 -3.4E+38 3.4E+38 ECU_ADDRESS 0xfe4a9dd8 /* @ECU_Address@autosar_swc_aeb_rtARID_DEF.ObjPrimaryTarget_b.Info.Length@ */ /end MEASUREMENT
/begin MEASUREMENT autosar_swc_aeb_rtARID_DEF.ObjPrimaryTarget_b.Info.MtnPat "" SLONG autosar_swc_aeb_CM_ObjMtnPat1Vcc 0 0 0 4 ECU_ADDRESS 0xfe4a9df0 /* @ECU_Address@autosar_swc_aeb_rtARID_DEF.ObjPrimaryTarget_b.Info.MtnPat@ */ /end MEASUREMENT
/begin MEASUREMENT autosar_swc_aeb_rtARID_DEF.ObjPrimaryTarget_b.Info.MtnPatHist "" SLONG autosar_swc_aeb_CM_ObjMtnPatHist1Vcc 0 0 0 3 ECU_ADDRESS 0xfe4a9df4 /* @ECU_Address@autosar_swc_aeb_rtARID_DEF.ObjPrimaryTarget_b.Info.MtnPatHist@ */ /end MEASUREMENT
/begin MEASUREMENT autosar_swc_aeb_rtARID_DEF.ObjPrimaryTarget_b.Info.SideNear "" SLONG autosar_swc_aeb_CM_Side1Vcc 0 0 0 4 ECU_ADDRESS 0xfe4a9de0 /* @ECU_Address@autosar_swc_aeb_rtARID_DEF.ObjPrimaryTarget_b.Info.SideNear@ */ /end MEASUREMENT
/begin MEASUREMENT autosar_swc_aeb_rtARID_DEF.ObjPrimaryTarget_b.Info.Typ "" SLONG autosar_swc_aeb_CM_ObjClassn3Vcc 0 0 0 10 ECU_ADDRESS 0xfe4a9dd0 /* @ECU_Address@autosar_swc_aeb_rtARID_DEF.ObjPrimaryTarget_b.Info.Typ@ */ /end MEASUREMENT
/begin MEASUREMENT autosar_swc_aeb_rtARID_DEF.ObjPrimaryTarget_b.Info.Width "" FLOAT32_IEEE autosar_swc_aeb_CM_single 0 0 0.000000 100.000000 ECU_ADDRESS 0xfe4a9dd4 /* @ECU_Address@autosar_swc_aeb_rtARID_DEF.ObjPrimaryTarget_b.Info.Width@ */ /end MEASUREMENT
/begin MEASUREMENT autosar_swc_aeb_rtARID_DEF.ObjPrimaryTarget_b.Ppty.AStdDe "" FLOAT32_IEEE autosar_swc_aeb_CM_single 0 0 -100.000000 100.000000 ECU_ADDRESS 0xfe4a9e3c /* @ECU_Address@autosar_swc_aeb_rtARID_DEF.ObjPrimaryTarget_b.Ppty.AStdDe@ */ /end MEASUREMENT
/begin MEASUREMENT autosar_swc_aeb_rtARID_DEF.ObjPrimaryTarget_b.Ppty.AgDirStdDe "" FLOAT32_IEEE autosar_swc_aeb_CM_single 0 0 -100.000000 100.000000 ECU_ADDRESS 0xfe4a9e34 /* @ECU_Address@autosar_swc_aeb_rtARID_DEF.ObjPrimaryTarget_b.Ppty.AgDirStdDe@ */ /end MEASUREMENT
/begin MEASUREMENT autosar_swc_aeb_rtARID_DEF.ObjPrimaryTarget_b.Ppty.CllsnMtgtnByBrkgPrimQly "" SLONG autosar_swc_aeb_CM_Relbl4Vcc 0 0 0 3 ECU_ADDRESS 0xfe4a9e14 /* @ECU_Address@autosar_swc_aeb_rtARID_DEF.ObjPrimaryTarget_b.Ppty.CllsnMtgtnByBrkgPrimQly@ */ /end MEASUREMENT
/begin MEASUREMENT autosar_swc_aeb_rtARID_DEF.ObjPrimaryTarget_b.Ppty.CllsnMtgtnByBrkgSecQly "" SLONG autosar_swc_aeb_CM_Relbl1Vcc 0 0 0 1 ECU_ADDRESS 0xfe4a9e18 /* @ECU_Address@autosar_swc_aeb_rtARID_DEF.ObjPrimaryTarget_b.Ppty.CllsnMtgtnByBrkgSecQly@ */ /end MEASUREMENT
/begin MEASUREMENT autosar_swc_aeb_rtARID_DEF.ObjPrimaryTarget_b.Ppty.CllsnWarnFwdQly "" SLONG autosar_swc_aeb_CM_Relbl1Vcc 0 0 0 1 ECU_ADDRESS 0xfe4a9e1c /* @ECU_Address@autosar_swc_aeb_rtARID_DEF.ObjPrimaryTarget_b.Ppty.CllsnWarnFwdQly@ */ /end MEASUREMENT
/begin MEASUREMENT autosar_swc_aeb_rtARID_DEF.ObjPrimaryTarget_b.Ppty.DstLatFromMidOfLaneSelfQly "" SLONG autosar_swc_aeb_CM_Relbl3Vcc 0 0 0 4 ECU_ADDRESS 0xfe4a9e24 /* @ECU_Address@autosar_swc_aeb_rtARID_DEF.ObjPrimaryTarget_b.Ppty.DstLatFromMidOfLaneSelfQly@ */ /end MEASUREMENT
/begin MEASUREMENT autosar_swc_aeb_rtARID_DEF.ObjPrimaryTarget_b.Ppty.EmgyLaneKeepAidPosnQly "" SLONG autosar_swc_aeb_CM_ObjPpty1VccEmgyLaneKeepAidPosnQly0 0 0 0 2 ECU_ADDRESS 0xfe4a9e28 /* @ECU_Address@autosar_swc_aeb_rtARID_DEF.ObjPrimaryTarget_b.Ppty.EmgyLaneKeepAidPosnQly@ */ /end MEASUREMENT
/begin MEASUREMENT autosar_swc_aeb_rtARID_DEF.ObjPrimaryTarget_b.Ppty.FusnSrc "" UBYTE autosar_swc_aeb_CM_uint8 0 0 0.000000 2.000000 ECU_ADDRESS 0xfe4a9e40 /* @ECU_Address@autosar_swc_aeb_rtARID_DEF.ObjPrimaryTarget_b.Ppty.FusnSrc@ */ /end MEASUREMENT
/begin MEASUREMENT autosar_swc_aeb_rtARID_DEF.ObjPrimaryTarget_b.Ppty.Idn "" ULONG autosar_swc_aeb_CM_uint32 0 0 0.000000 32.000000 ECU_ADDRESS 0xfe4a9e00 /* @ECU_Address@autosar_swc_aeb_rtARID_DEF.ObjPrimaryTarget_b.Ppty.Idn@ */ /end MEASUREMENT
/begin MEASUREMENT autosar_swc_aeb_rtARID_DEF.ObjPrimaryTarget_b.Ppty.MdlOfMtn "" SLONG autosar_swc_aeb_CM_ObjPpty1VccMdlOfMtn0 0 0 0 1 ECU_ADDRESS 0xfe4a9e0c /* @ECU_Address@autosar_swc_aeb_rtARID_DEF.ObjPrimaryTarget_b.Ppty.MdlOfMtn@ */ /end MEASUREMENT
/begin MEASUREMENT autosar_swc_aeb_rtARID_DEF.ObjPrimaryTarget_b.Ppty.Object_Age "" A_UINT64 autosar_swc_aeb_CM_uint64 0 0 0 18446744073709551615 ECU_ADDRESS 0xfe4a9e48 /* @ECU_Address@autosar_swc_aeb_rtARID_DEF.ObjPrimaryTarget_b.Ppty.Object_Age@ */ /end MEASUREMENT
/begin MEASUREMENT autosar_swc_aeb_rtARID_DEF.ObjPrimaryTarget_b.Ppty.PosnLatStdDe "" FLOAT32_IEEE autosar_swc_aeb_CM_single 0 0 -100.000000 100.000000 ECU_ADDRESS 0xfe4a9e30 /* @ECU_Address@autosar_swc_aeb_rtARID_DEF.ObjPrimaryTarget_b.Ppty.PosnLatStdDe@ */ /end MEASUREMENT
/begin MEASUREMENT autosar_swc_aeb_rtARID_DEF.ObjPrimaryTarget_b.Ppty.PosnLgtStdDe "" FLOAT32_IEEE autosar_swc_aeb_CM_single 0 0 -100.000000 100.000000 ECU_ADDRESS 0xfe4a9e2c /* @ECU_Address@autosar_swc_aeb_rtARID_DEF.ObjPrimaryTarget_b.Ppty.PosnLgtStdDe@ */ /end MEASUREMENT
/begin MEASUREMENT autosar_swc_aeb_rtARID_DEF.ObjPrimaryTarget_b.Ppty.SpdStdDe "" FLOAT32_IEEE autosar_swc_aeb_CM_single 0 0 -100.000000 100.000000 ECU_ADDRESS 0xfe4a9e38 /* @ECU_Address@autosar_swc_aeb_rtARID_DEF.ObjPrimaryTarget_b.Ppty.SpdStdDe@ */ /end MEASUREMENT
/begin MEASUREMENT autosar_swc_aeb_rtARID_DEF.ObjPrimaryTarget_b.Ppty.Sts "" SLONG autosar_swc_aeb_CM_SnsrDataSts1Vcc 0 0 0 6 ECU_ADDRESS 0xfe4a9e08 /* @ECU_Address@autosar_swc_aeb_rtARID_DEF.ObjPrimaryTarget_b.Ppty.Sts@ */ /end MEASUREMENT
/begin MEASUREMENT autosar_swc_aeb_rtARID_DEF.ObjPrimaryTarget_b.Ppty.TrfcJamAssiQly "" SLONG autosar_swc_aeb_CM_ObjPpty1VccTrfcJamAssiQly0 0 0 0 2 ECU_ADDRESS 0xfe4a9e20 /* @ECU_Address@autosar_swc_aeb_rtARID_DEF.ObjPrimaryTarget_b.Ppty.TrfcJamAssiQly@ */ /end MEASUREMENT
/begin MEASUREMENT autosar_swc_aeb_rtARID_DEF.ObjPrimaryTarget_b.Ppty.TrfcSceno "" SLONG autosar_swc_aeb_CM_ObjPpty1VccTrfcSceno0 0 0 0 1 ECU_ADDRESS 0xfe4a9e10 /* @ECU_Address@autosar_swc_aeb_rtARID_DEF.ObjPrimaryTarget_b.Ppty.TrfcSceno@ */ /end MEASUREMENT
/begin MEASUREMENT autosar_swc_aeb_rtARID_DEF.ObjPrimaryTarget_b.Ppty.VisnId "" ULONG autosar_swc_aeb_CM_uint32 0 0 0.000000 15.000000 ECU_ADDRESS 0xfe4a9e04 /* @ECU_Address@autosar_swc_aeb_rtARID_DEF.ObjPrimaryTarget_b.Ppty.VisnId@ */ /end MEASUREMENT
/begin MEASUREMENT autosar_swc_aeb_rtARID_DEF.PahEstimn[0].CtrlAryLat "" FLOAT32_IEEE autosar_swc_aeb_CM_single 0 0 -50.000000 50.000000 LAYOUT COLUMN_DIR MATRIX_DIM 4 ECU_ADDRESS 0xfe4a9f70 /* @ECU_Address@autosar_swc_aeb_rtARID_DEF.PahEstimn[0].CtrlAryLat@ */ /end MEASUREMENT
/begin MEASUREMENT autosar_swc_aeb_rtARID_DEF.PahEstimn[0].CtrlAryLgt "" FLOAT32_IEEE autosar_swc_aeb_CM_single 0 0 0.000000 400.000000 LAYOUT COLUMN_DIR MATRIX_DIM 4 ECU_ADDRESS 0xfe4a9f80 /* @ECU_Address@autosar_swc_aeb_rtARID_DEF.PahEstimn[0].CtrlAryLgt@ */ /end MEASUREMENT
/begin MEASUREMENT autosar_swc_aeb_rtARID_DEF.PahEstimn[0].TiAry "" FLOAT32_IEEE autosar_swc_aeb_CM_single 0 0 0.000000 6.000000 LAYOUT COLUMN_DIR MATRIX_DIM 2 ECU_ADDRESS 0xfe4a9f90 /* @ECU_Address@autosar_swc_aeb_rtARID_DEF.PahEstimn[0].TiAry@ */ /end MEASUREMENT
/begin MEASUREMENT autosar_swc_aeb_rtARID_DEF.PahEstimn[1].CtrlAryLat "" FLOAT32_IEEE autosar_swc_aeb_CM_single 0 0 -50.000000 50.000000 LAYOUT COLUMN_DIR MATRIX_DIM 4 ECU_ADDRESS 0xfe4a9f98 /* @ECU_Address@autosar_swc_aeb_rtARID_DEF.PahEstimn[1].CtrlAryLat@ */ /end MEASUREMENT
/begin MEASUREMENT autosar_swc_aeb_rtARID_DEF.PahEstimn[1].CtrlAryLgt "" FLOAT32_IEEE autosar_swc_aeb_CM_single 0 0 0.000000 400.000000 LAYOUT COLUMN_DIR MATRIX_DIM 4 ECU_ADDRESS 0xfe4a9fa8 /* @ECU_Address@autosar_swc_aeb_rtARID_DEF.PahEstimn[1].CtrlAryLgt@ */ /end MEASUREMENT
/begin MEASUREMENT autosar_swc_aeb_rtARID_DEF.PahEstimn[1].TiAry "" FLOAT32_IEEE autosar_swc_aeb_CM_single 0 0 0.000000 6.000000 LAYOUT COLUMN_DIR MATRIX_DIM 2 ECU_ADDRESS 0xfe4a9fb8 /* @ECU_Address@autosar_swc_aeb_rtARID_DEF.PahEstimn[1].TiAry@ */ /end MEASUREMENT
/begin MEASUREMENT autosar_swc_aeb_rtARID_DEF.PahEstimn[2].CtrlAryLat "" FLOAT32_IEEE autosar_swc_aeb_CM_single 0 0 -50.000000 50.000000 LAYOUT COLUMN_DIR MATRIX_DIM 4 ECU_ADDRESS 0xfe4a9fc0 /* @ECU_Address@autosar_swc_aeb_rtARID_DEF.PahEstimn[2].CtrlAryLat@ */ /end MEASUREMENT
/begin MEASUREMENT autosar_swc_aeb_rtARID_DEF.PahEstimn[2].CtrlAryLgt "" FLOAT32_IEEE autosar_swc_aeb_CM_single 0 0 0.000000 400.000000 LAYOUT COLUMN_DIR MATRIX_DIM 4 ECU_ADDRESS 0xfe4a9fd0 /* @ECU_Address@autosar_swc_aeb_rtARID_DEF.PahEstimn[2].CtrlAryLgt@ */ /end MEASUREMENT
/begin MEASUREMENT autosar_swc_aeb_rtARID_DEF.PahEstimn[2].TiAry "" FLOAT32_IEEE autosar_swc_aeb_CM_single 0 0 0.000000 6.000000 LAYOUT COLUMN_DIR MATRIX_DIM 2 ECU_ADDRESS 0xfe4a9fe0 /* @ECU_Address@autosar_swc_aeb_rtARID_DEF.PahEstimn[2].TiAry@ */ /end MEASUREMENT
/begin MEASUREMENT autosar_swc_aeb_rtARID_DEF.PahEstimn[3].CtrlAryLat "" FLOAT32_IEEE autosar_swc_aeb_CM_single 0 0 -50.000000 50.000000 LAYOUT COLUMN_DIR MATRIX_DIM 4 ECU_ADDRESS 0xfe4a9fe8 /* @ECU_Address@autosar_swc_aeb_rtARID_DEF.PahEstimn[3].CtrlAryLat@ */ /end MEASUREMENT
/begin MEASUREMENT autosar_swc_aeb_rtARID_DEF.PahEstimn[3].CtrlAryLgt "" FLOAT32_IEEE autosar_swc_aeb_CM_single 0 0 0.000000 400.000000 LAYOUT COLUMN_DIR MATRIX_DIM 4 ECU_ADDRESS 0xfe4a9ff8 /* @ECU_Address@autosar_swc_aeb_rtARID_DEF.PahEstimn[3].CtrlAryLgt@ */ /end MEASUREMENT
/begin MEASUREMENT autosar_swc_aeb_rtARID_DEF.PahEstimn[3].TiAry "" FLOAT32_IEEE autosar_swc_aeb_CM_single 0 0 0.000000 6.000000 LAYOUT COLUMN_DIR MATRIX_DIM 2 ECU_ADDRESS 0xfe4aa008 /* @ECU_Address@autosar_swc_aeb_rtARID_DEF.PahEstimn[3].TiAry@ */ /end MEASUREMENT
/begin MEASUREMENT autosar_swc_aeb_rtARID_DEF.PahEstimn_g[0].CtrlAryLat "" FLOAT32_IEEE autosar_swc_aeb_CM_single 0 0 -50.000000 50.000000 LAYOUT COLUMN_DIR MATRIX_DIM 4 ECU_ADDRESS 0xfe4aa010 /* @ECU_Address@autosar_swc_aeb_rtARID_DEF.PahEstimn_g[0].CtrlAryLat@ */ /end MEASUREMENT
/begin MEASUREMENT autosar_swc_aeb_rtARID_DEF.PahEstimn_g[0].CtrlAryLgt "" FLOAT32_IEEE autosar_swc_aeb_CM_single 0 0 0.000000 400.000000 LAYOUT COLUMN_DIR MATRIX_DIM 4 ECU_ADDRESS 0xfe4aa020 /* @ECU_Address@autosar_swc_aeb_rtARID_DEF.PahEstimn_g[0].CtrlAryLgt@ */ /end MEASUREMENT
/begin MEASUREMENT autosar_swc_aeb_rtARID_DEF.PahEstimn_g[0].TiAry "" FLOAT32_IEEE autosar_swc_aeb_CM_single 0 0 0.000000 6.000000 LAYOUT COLUMN_DIR MATRIX_DIM 2 ECU_ADDRESS 0xfe4aa030 /* @ECU_Address@autosar_swc_aeb_rtARID_DEF.PahEstimn_g[0].TiAry@ */ /end MEASUREMENT
/begin MEASUREMENT autosar_swc_aeb_rtARID_DEF.PahEstimn_g[1].CtrlAryLat "" FLOAT32_IEEE autosar_swc_aeb_CM_single 0 0 -50.000000 50.000000 LAYOUT COLUMN_DIR MATRIX_DIM 4 ECU_ADDRESS 0xfe4aa038 /* @ECU_Address@autosar_swc_aeb_rtARID_DEF.PahEstimn_g[1].CtrlAryLat@ */ /end MEASUREMENT
/begin MEASUREMENT autosar_swc_aeb_rtARID_DEF.PahEstimn_g[1].CtrlAryLgt "" FLOAT32_IEEE autosar_swc_aeb_CM_single 0 0 0.000000 400.000000 LAYOUT COLUMN_DIR MATRIX_DIM 4 ECU_ADDRESS 0xfe4aa048 /* @ECU_Address@autosar_swc_aeb_rtARID_DEF.PahEstimn_g[1].CtrlAryLgt@ */ /end MEASUREMENT
/begin MEASUREMENT autosar_swc_aeb_rtARID_DEF.PahEstimn_g[1].TiAry "" FLOAT32_IEEE autosar_swc_aeb_CM_single 0 0 0.000000 6.000000 LAYOUT COLUMN_DIR MATRIX_DIM 2 ECU_ADDRESS 0xfe4aa058 /* @ECU_Address@autosar_swc_aeb_rtARID_DEF.PahEstimn_g[1].TiAry@ */ /end MEASUREMENT
/begin MEASUREMENT autosar_swc_aeb_rtARID_DEF.PahEstimn_g[2].CtrlAryLat "" FLOAT32_IEEE autosar_swc_aeb_CM_single 0 0 -50.000000 50.000000 LAYOUT COLUMN_DIR MATRIX_DIM 4 ECU_ADDRESS 0xfe4aa060 /* @ECU_Address@autosar_swc_aeb_rtARID_DEF.PahEstimn_g[2].CtrlAryLat@ */ /end MEASUREMENT
/begin MEASUREMENT autosar_swc_aeb_rtARID_DEF.PahEstimn_g[2].CtrlAryLgt "" FLOAT32_IEEE autosar_swc_aeb_CM_single 0 0 0.000000 400.000000 LAYOUT COLUMN_DIR MATRIX_DIM 4 ECU_ADDRESS 0xfe4aa070 /* @ECU_Address@autosar_swc_aeb_rtARID_DEF.PahEstimn_g[2].CtrlAryLgt@ */ /end MEASUREMENT
/begin MEASUREMENT autosar_swc_aeb_rtARID_DEF.PahEstimn_g[2].TiAry "" FLOAT32_IEEE autosar_swc_aeb_CM_single 0 0 0.000000 6.000000 LAYOUT COLUMN_DIR MATRIX_DIM 2 ECU_ADDRESS 0xfe4aa080 /* @ECU_Address@autosar_swc_aeb_rtARID_DEF.PahEstimn_g[2].TiAry@ */ /end MEASUREMENT
/begin MEASUREMENT autosar_swc_aeb_rtARID_DEF.PahEstimn_g[3].CtrlAryLat "" FLOAT32_IEEE autosar_swc_aeb_CM_single 0 0 -50.000000 50.000000 LAYOUT COLUMN_DIR MATRIX_DIM 4 ECU_ADDRESS 0xfe4aa088 /* @ECU_Address@autosar_swc_aeb_rtARID_DEF.PahEstimn_g[3].CtrlAryLat@ */ /end MEASUREMENT
/begin MEASUREMENT autosar_swc_aeb_rtARID_DEF.PahEstimn_g[3].CtrlAryLgt "" FLOAT32_IEEE autosar_swc_aeb_CM_single 0 0 0.000000 400.000000 LAYOUT COLUMN_DIR MATRIX_DIM 4 ECU_ADDRESS 0xfe4aa098 /* @ECU_Address@autosar_swc_aeb_rtARID_DEF.PahEstimn_g[3].CtrlAryLgt@ */ /end MEASUREMENT
/begin MEASUREMENT autosar_swc_aeb_rtARID_DEF.PahEstimn_g[3].TiAry "" FLOAT32_IEEE autosar_swc_aeb_CM_single 0 0 0.000000 6.000000 LAYOUT COLUMN_DIR MATRIX_DIM 2 ECU_ADDRESS 0xfe4aa0a8 /* @ECU_Address@autosar_swc_aeb_rtARID_DEF.PahEstimn_g[3].TiAry@ */ /end MEASUREMENT
/begin MEASUREMENT autosar_swc_aeb_rtARID_DEF.UnitDelay2_DSTATE.ALatAbsltCmft "" FLOAT32_IEEE autosar_swc_aeb_CM_single 0 0 -3.4E+38 3.4E+38 ECU_ADDRESS 0xfe4aa218 /* @ECU_Address@autosar_swc_aeb_rtARID_DEF.UnitDelay2_DSTATE.ALatAbsltCmft@ */ /end MEASUREMENT
/begin MEASUREMENT autosar_swc_aeb_rtARID_DEF.UnitDelay2_DSTATE.ALatAbsltMax "" FLOAT32_IEEE autosar_swc_aeb_CM_single 0 0 -3.4E+38 3.4E+38 ECU_ADDRESS 0xfe4aa21c /* @ECU_Address@autosar_swc_aeb_rtARID_DEF.UnitDelay2_DSTATE.ALatAbsltMax@ */ /end MEASUREMENT
/begin MEASUREMENT autosar_swc_aeb_rtARID_DEF.UnitDelay2_DSTATE.ALgtNegCmft "" FLOAT32_IEEE autosar_swc_aeb_CM_single 0 0 -3.4E+38 3.4E+38 ECU_ADDRESS 0xfe4aa220 /* @ECU_Address@autosar_swc_aeb_rtARID_DEF.UnitDelay2_DSTATE.ALgtNegCmft@ */ /end MEASUREMENT
/begin MEASUREMENT autosar_swc_aeb_rtARID_DEF.UnitDelay2_DSTATE.ALgtNegMeasd "" FLOAT32_IEEE autosar_swc_aeb_CM_single 0 0 -3.4E+38 3.4E+38 ECU_ADDRESS 0xfe4aa224 /* @ECU_Address@autosar_swc_aeb_rtARID_DEF.UnitDelay2_DSTATE.ALgtNegMeasd@ */ /end MEASUREMENT
/begin MEASUREMENT autosar_swc_aeb_rtARID_DEF.UnitDelay2_DSTATE.ALgtNegMin "" FLOAT32_IEEE autosar_swc_aeb_CM_single 0 0 -3.4E+38 3.4E+38 ECU_ADDRESS 0xfe4aa228 /* @ECU_Address@autosar_swc_aeb_rtARID_DEF.UnitDelay2_DSTATE.ALgtNegMin@ */ /end MEASUREMENT
/begin MEASUREMENT autosar_swc_aeb_rtARID_DEF.UnitDelay2_DSTATE.ALgtPosCmft "" FLOAT32_IEEE autosar_swc_aeb_CM_single 0 0 -3.4E+38 3.4E+38 ECU_ADDRESS 0xfe4aa22c /* @ECU_Address@autosar_swc_aeb_rtARID_DEF.UnitDelay2_DSTATE.ALgtPosCmft@ */ /end MEASUREMENT
/begin MEASUREMENT autosar_swc_aeb_rtARID_DEF.UnitDelay2_DSTATE.ALgtPosMax "" FLOAT32_IEEE autosar_swc_aeb_CM_single 0 0 -3.4E+38 3.4E+38 ECU_ADDRESS 0xfe4aa230 /* @ECU_Address@autosar_swc_aeb_rtARID_DEF.UnitDelay2_DSTATE.ALgtPosMax@ */ /end MEASUREMENT
/begin MEASUREMENT autosar_swc_aeb_rtARID_DEF.UnitDelay2_DSTATE.CrvtAbsltCmft "" FLOAT32_IEEE autosar_swc_aeb_CM_single 0 0 -3.4E+38 3.4E+38 ECU_ADDRESS 0xfe4aa234 /* @ECU_Address@autosar_swc_aeb_rtARID_DEF.UnitDelay2_DSTATE.CrvtAbsltCmft@ */ /end MEASUREMENT
/begin MEASUREMENT autosar_swc_aeb_rtARID_DEF.UnitDelay2_DSTATE.CrvtAbsltMax "" FLOAT32_IEEE autosar_swc_aeb_CM_single 0 0 -3.4E+38 3.4E+38 ECU_ADDRESS 0xfe4aa238 /* @ECU_Address@autosar_swc_aeb_rtARID_DEF.UnitDelay2_DSTATE.CrvtAbsltMax@ */ /end MEASUREMENT
/begin MEASUREMENT autosar_swc_aeb_rtARID_DEF.UnitDelay2_DSTATE.CrvtRateAbsltCmft "" FLOAT32_IEEE autosar_swc_aeb_CM_single 0 0 -3.4E+38 3.4E+38 ECU_ADDRESS 0xfe4aa23c /* @ECU_Address@autosar_swc_aeb_rtARID_DEF.UnitDelay2_DSTATE.CrvtRateAbsltCmft@ */ /end MEASUREMENT
/begin MEASUREMENT autosar_swc_aeb_rtARID_DEF.UnitDelay2_DSTATE.CrvtRateAbsltMax "" FLOAT32_IEEE autosar_swc_aeb_CM_single 0 0 -3.4E+38 3.4E+38 ECU_ADDRESS 0xfe4aa240 /* @ECU_Address@autosar_swc_aeb_rtARID_DEF.UnitDelay2_DSTATE.CrvtRateAbsltMax@ */ /end MEASUREMENT
/begin MEASUREMENT autosar_swc_aeb_rtARID_DEF.UnitDelay2_DSTATE.JerkLatAbsltCmft "" FLOAT32_IEEE autosar_swc_aeb_CM_single 0 0 -3.4E+38 3.4E+38 ECU_ADDRESS 0xfe4aa244 /* @ECU_Address@autosar_swc_aeb_rtARID_DEF.UnitDelay2_DSTATE.JerkLatAbsltCmft@ */ /end MEASUREMENT
/begin MEASUREMENT autosar_swc_aeb_rtARID_DEF.UnitDelay2_DSTATE.JerkLatAbsltMax "" FLOAT32_IEEE autosar_swc_aeb_CM_single 0 0 -3.4E+38 3.4E+38 ECU_ADDRESS 0xfe4aa248 /* @ECU_Address@autosar_swc_aeb_rtARID_DEF.UnitDelay2_DSTATE.JerkLatAbsltMax@ */ /end MEASUREMENT
/begin MEASUREMENT autosar_swc_aeb_rtARID_DEF.UnitDelay2_DSTATE.JerkLgtNegCmft "" FLOAT32_IEEE autosar_swc_aeb_CM_single 0 0 -3.4E+38 3.4E+38 ECU_ADDRESS 0xfe4aa24c /* @ECU_Address@autosar_swc_aeb_rtARID_DEF.UnitDelay2_DSTATE.JerkLgtNegCmft@ */ /end MEASUREMENT
/begin MEASUREMENT autosar_swc_aeb_rtARID_DEF.UnitDelay2_DSTATE.JerkLgtNegMeasd "" FLOAT32_IEEE autosar_swc_aeb_CM_single 0 0 -3.4E+38 3.4E+38 ECU_ADDRESS 0xfe4aa250 /* @ECU_Address@autosar_swc_aeb_rtARID_DEF.UnitDelay2_DSTATE.JerkLgtNegMeasd@ */ /end MEASUREMENT
/begin MEASUREMENT autosar_swc_aeb_rtARID_DEF.UnitDelay2_DSTATE.JerkLgtNegMin "" FLOAT32_IEEE autosar_swc_aeb_CM_single 0 0 -3.4E+38 3.4E+38 ECU_ADDRESS 0xfe4aa254 /* @ECU_Address@autosar_swc_aeb_rtARID_DEF.UnitDelay2_DSTATE.JerkLgtNegMin@ */ /end MEASUREMENT
/begin MEASUREMENT autosar_swc_aeb_rtARID_DEF.UnitDelay2_DSTATE.JerkLgtPosCmft "" FLOAT32_IEEE autosar_swc_aeb_CM_single 0 0 -3.4E+38 3.4E+38 ECU_ADDRESS 0xfe4aa258 /* @ECU_Address@autosar_swc_aeb_rtARID_DEF.UnitDelay2_DSTATE.JerkLgtPosCmft@ */ /end MEASUREMENT
/begin MEASUREMENT autosar_swc_aeb_rtARID_DEF.UnitDelay2_DSTATE.JerkLgtPosMax "" FLOAT32_IEEE autosar_swc_aeb_CM_single 0 0 -3.4E+38 3.4E+38 ECU_ADDRESS 0xfe4aa25c /* @ECU_Address@autosar_swc_aeb_rtARID_DEF.UnitDelay2_DSTATE.JerkLgtPosMax@ */ /end MEASUREMENT
/begin MEASUREMENT autosar_swc_aeb_rtARID_DEF.UnitDelay3_DSTATE.ALatRqrdMplTar "" FLOAT32_IEEE autosar_swc_aeb_CM_single 0 0 -3.4E+38 3.4E+38 ECU_ADDRESS 0xfe4aa1bc /* @ECU_Address@autosar_swc_aeb_rtARID_DEF.UnitDelay3_DSTATE.ALatRqrdMplTar@ */ /end MEASUREMENT
/begin MEASUREMENT autosar_swc_aeb_rtARID_DEF.UnitDelay3_DSTATE.ALatRqrdMplTarQly "" SLONG autosar_swc_aeb_CM_Relbl1Vcc 0 0 0 1 ECU_ADDRESS 0xfe4aa1c0 /* @ECU_Address@autosar_swc_aeb_rtARID_DEF.UnitDelay3_DSTATE.ALatRqrdMplTarQly@ */ /end MEASUREMENT
/begin MEASUREMENT autosar_swc_aeb_rtARID_DEF.UnitDelay3_DSTATE.ANegLgtRqrdForPrimTarWarn "" FLOAT32_IEEE autosar_swc_aeb_CM_single 0 0 -3.4E+38 3.4E+38 ECU_ADDRESS 0xfe4aa1b8 /* @ECU_Address@autosar_swc_aeb_rtARID_DEF.UnitDelay3_DSTATE.ANegLgtRqrdForPrimTarWarn@ */ /end MEASUREMENT
/begin MEASUREMENT autosar_swc_aeb_rtARID_DEF.UnitDelay3_DSTATE.MtnRqrdIntv.ALatRqrd "" FLOAT32_IEEE autosar_swc_aeb_CM_single 0 0 -3.4E+38 3.4E+38 ECU_ADDRESS 0xfe4aa140 /* @ECU_Address@autosar_swc_aeb_rtARID_DEF.UnitDelay3_DSTATE.MtnRqrdIntv.ALatRqrd@ */ /end MEASUREMENT
/begin MEASUREMENT autosar_swc_aeb_rtARID_DEF.UnitDelay3_DSTATE.MtnRqrdIntv.ALatRqrdQly "" SLONG autosar_swc_aeb_CM_Relbl1Vcc 0 0 0 1 ECU_ADDRESS 0xfe4aa144 /* @ECU_Address@autosar_swc_aeb_rtARID_DEF.UnitDelay3_DSTATE.MtnRqrdIntv.ALatRqrdQly@ */ /end MEASUREMENT
/begin MEASUREMENT autosar_swc_aeb_rtARID_DEF.UnitDelay3_DSTATE.MtnRqrdIntv.ANegLgtRqrd "" FLOAT32_IEEE autosar_swc_aeb_CM_single 0 0 -3.4E+38 3.4E+38 ECU_ADDRESS 0xfe4aa14c /* @ECU_Address@autosar_swc_aeb_rtARID_DEF.UnitDelay3_DSTATE.MtnRqrdIntv.ANegLgtRqrd@ */ /end MEASUREMENT
/begin MEASUREMENT autosar_swc_aeb_rtARID_DEF.UnitDelay3_DSTATE.MtnRqrdIntv.APosLgtRqrd "" FLOAT32_IEEE autosar_swc_aeb_CM_single 0 0 -3.4E+38 3.4E+38 ECU_ADDRESS 0xfe4aa148 /* @ECU_Address@autosar_swc_aeb_rtARID_DEF.UnitDelay3_DSTATE.MtnRqrdIntv.APosLgtRqrd@ */ /end MEASUREMENT
/begin MEASUREMENT autosar_swc_aeb_rtARID_DEF.UnitDelay3_DSTATE.MtnRqrdIntv.CrvtRateRqrdLe "" FLOAT32_IEEE autosar_swc_aeb_CM_single 0 0 -3.4E+38 3.4E+38 ECU_ADDRESS 0xfe4aa154 /* @ECU_Address@autosar_swc_aeb_rtARID_DEF.UnitDelay3_DSTATE.MtnRqrdIntv.CrvtRateRqrdLe@ */ /end MEASUREMENT
/begin MEASUREMENT autosar_swc_aeb_rtARID_DEF.UnitDelay3_DSTATE.MtnRqrdIntv.CrvtRateRqrdRi "" FLOAT32_IEEE autosar_swc_aeb_CM_single 0 0 -3.4E+38 3.4E+38 ECU_ADDRESS 0xfe4aa158 /* @ECU_Address@autosar_swc_aeb_rtARID_DEF.UnitDelay3_DSTATE.MtnRqrdIntv.CrvtRateRqrdRi@ */ /end MEASUREMENT
/begin MEASUREMENT autosar_swc_aeb_rtARID_DEF.UnitDelay3_DSTATE.MtnRqrdIntv.CrvtRqrdLe "" FLOAT32_IEEE autosar_swc_aeb_CM_single 0 0 -3.4E+38 3.4E+38 ECU_ADDRESS 0xfe4aa15c /* @ECU_Address@autosar_swc_aeb_rtARID_DEF.UnitDelay3_DSTATE.MtnRqrdIntv.CrvtRqrdLe@ */ /end MEASUREMENT
/begin MEASUREMENT autosar_swc_aeb_rtARID_DEF.UnitDelay3_DSTATE.MtnRqrdIntv.CrvtRqrdRi "" FLOAT32_IEEE autosar_swc_aeb_CM_single 0 0 -3.4E+38 3.4E+38 ECU_ADDRESS 0xfe4aa160 /* @ECU_Address@autosar_swc_aeb_rtARID_DEF.UnitDelay3_DSTATE.MtnRqrdIntv.CrvtRqrdRi@ */ /end MEASUREMENT
/begin MEASUREMENT autosar_swc_aeb_rtARID_DEF.UnitDelay3_DSTATE.MtnRqrdIntv.JerkNegLgtRqrd "" FLOAT32_IEEE autosar_swc_aeb_CM_single 0 0 -3.4E+38 3.4E+38 ECU_ADDRESS 0xfe4aa150 /* @ECU_Address@autosar_swc_aeb_rtARID_DEF.UnitDelay3_DSTATE.MtnRqrdIntv.JerkNegLgtRqrd@ */ /end MEASUREMENT
/begin MEASUREMENT autosar_swc_aeb_rtARID_DEF.UnitDelay3_DSTATE.PrimTarIntv.ALat "" FLOAT32_IEEE autosar_swc_aeb_CM_single 0 0 -3.4E+38 3.4E+38 ECU_ADDRESS 0xfe4aa168 /* @ECU_Address@autosar_swc_aeb_rtARID_DEF.UnitDelay3_DSTATE.PrimTarIntv.ALat@ */ /end MEASUREMENT
/begin MEASUREMENT autosar_swc_aeb_rtARID_DEF.UnitDelay3_DSTATE.PrimTarIntv.ALgt "" FLOAT32_IEEE autosar_swc_aeb_CM_single 0 0 -3.4E+38 3.4E+38 ECU_ADDRESS 0xfe4aa16c /* @ECU_Address@autosar_swc_aeb_rtARID_DEF.UnitDelay3_DSTATE.PrimTarIntv.ALgt@ */ /end MEASUREMENT
/begin MEASUREMENT autosar_swc_aeb_rtARID_DEF.UnitDelay3_DSTATE.PrimTarIntv.Crvt "" FLOAT32_IEEE autosar_swc_aeb_CM_single 0 0 -3.4E+38 3.4E+38 ECU_ADDRESS 0xfe4aa174 /* @ECU_Address@autosar_swc_aeb_rtARID_DEF.UnitDelay3_DSTATE.PrimTarIntv.Crvt@ */ /end MEASUREMENT
/begin MEASUREMENT autosar_swc_aeb_rtARID_DEF.UnitDelay3_DSTATE.PrimTarIntv.Hei "" FLOAT32_IEEE autosar_swc_aeb_CM_single 0 0 -3.4E+38 3.4E+38 ECU_ADDRESS 0xfe4aa170 /* @ECU_Address@autosar_swc_aeb_rtARID_DEF.UnitDelay3_DSTATE.PrimTarIntv.Hei@ */ /end MEASUREMENT
/begin MEASUREMENT autosar_swc_aeb_rtARID_DEF.UnitDelay3_DSTATE.PrimTarIntv.Idn "" ULONG autosar_swc_aeb_CM_uint32 0 0 0 4294967295 ECU_ADDRESS 0xfe4aa178 /* @ECU_Address@autosar_swc_aeb_rtARID_DEF.UnitDelay3_DSTATE.PrimTarIntv.Idn@ */ /end MEASUREMENT
/begin MEASUREMENT autosar_swc_aeb_rtARID_DEF.UnitDelay3_DSTATE.PrimTarIntv.InPathPredict "" UBYTE autosar_swc_aeb_CM_logical 0 0 0 1 ECU_ADDRESS 0xfe4aa1ac /* @ECU_Address@autosar_swc_aeb_rtARID_DEF.UnitDelay3_DSTATE.PrimTarIntv.InPathPredict@ */ /end MEASUREMENT
/begin MEASUREMENT autosar_swc_aeb_rtARID_DEF.UnitDelay3_DSTATE.PrimTarIntv.MtnPat "" SLONG autosar_swc_aeb_CM_ObjMtnPat1Vcc 0 0 0 4 ECU_ADDRESS 0xfe4aa17c /* @ECU_Address@autosar_swc_aeb_rtARID_DEF.UnitDelay3_DSTATE.PrimTarIntv.MtnPat@ */ /end MEASUREMENT
/begin MEASUREMENT autosar_swc_aeb_rtARID_DEF.UnitDelay3_DSTATE.PrimTarIntv.MtnPatHist "" SLONG autosar_swc_aeb_CM_ObjMtnPatHist1Vcc 0 0 0 3 ECU_ADDRESS 0xfe4aa180 /* @ECU_Address@autosar_swc_aeb_rtARID_DEF.UnitDelay3_DSTATE.PrimTarIntv.MtnPatHist@ */ /end MEASUREMENT
/begin MEASUREMENT autosar_swc_aeb_rtARID_DEF.UnitDelay3_DSTATE.PrimTarIntv.ObjTyp "" SLONG autosar_swc_aeb_CM_ObjClassn3Vcc 0 0 0 10 ECU_ADDRESS 0xfe4aa184 /* @ECU_Address@autosar_swc_aeb_rtARID_DEF.UnitDelay3_DSTATE.PrimTarIntv.ObjTyp@ */ /end MEASUREMENT
/begin MEASUREMENT autosar_swc_aeb_rtARID_DEF.UnitDelay3_DSTATE.PrimTarIntv.Object_Age "" A_UINT64 autosar_swc_aeb_CM_uint64 0 0 0 18446744073709551615 ECU_ADDRESS 0xfe4aa1b0 /* @ECU_Address@autosar_swc_aeb_rtARID_DEF.UnitDelay3_DSTATE.PrimTarIntv.Object_Age@ */ /end MEASUREMENT
/begin MEASUREMENT autosar_swc_aeb_rtARID_DEF.UnitDelay3_DSTATE.PrimTarIntv.PosnLat "" FLOAT32_IEEE autosar_swc_aeb_CM_single 0 0 -3.4E+38 3.4E+38 ECU_ADDRESS 0xfe4aa188 /* @ECU_Address@autosar_swc_aeb_rtARID_DEF.UnitDelay3_DSTATE.PrimTarIntv.PosnLat@ */ /end MEASUREMENT
/begin MEASUREMENT autosar_swc_aeb_rtARID_DEF.UnitDelay3_DSTATE.PrimTarIntv.PosnLgt "" FLOAT32_IEEE autosar_swc_aeb_CM_single 0 0 -3.4E+38 3.4E+38 ECU_ADDRESS 0xfe4aa18c /* @ECU_Address@autosar_swc_aeb_rtARID_DEF.UnitDelay3_DSTATE.PrimTarIntv.PosnLgt@ */ /end MEASUREMENT
/begin MEASUREMENT autosar_swc_aeb_rtARID_DEF.UnitDelay3_DSTATE.PrimTarIntv.PrimTarInPahNow "" SLONG autosar_swc_aeb_CM_PrimTarIntv1VccPrimTarInPahNow0 0 0 0 1 ECU_ADDRESS 0xfe4aa1a8 /* @ECU_Address@autosar_swc_aeb_rtARID_DEF.UnitDelay3_DSTATE.PrimTarIntv.PrimTarInPahNow@ */ /end MEASUREMENT
/begin MEASUREMENT autosar_swc_aeb_rtARID_DEF.UnitDelay3_DSTATE.PrimTarIntv.QlyIntv "" SLONG autosar_swc_aeb_CM_CllsnMtgtnByBrkgPrimQlyVcc 0 0 0 3 ECU_ADDRESS 0xfe4aa190 /* @ECU_Address@autosar_swc_aeb_rtARID_DEF.UnitDelay3_DSTATE.PrimTarIntv.QlyIntv@ */ /end MEASUREMENT
/begin MEASUREMENT autosar_swc_aeb_rtARID_DEF.UnitDelay3_DSTATE.PrimTarIntv.TiToCllsn "" FLOAT32_IEEE autosar_swc_aeb_CM_single 0 0 -3.4E+38 3.4E+38 ECU_ADDRESS 0xfe4aa194 /* @ECU_Address@autosar_swc_aeb_rtARID_DEF.UnitDelay3_DSTATE.PrimTarIntv.TiToCllsn@ */ /end MEASUREMENT
/begin MEASUREMENT autosar_swc_aeb_rtARID_DEF.UnitDelay3_DSTATE.PrimTarIntv.VLat "" FLOAT32_IEEE autosar_swc_aeb_CM_single 0 0 -3.4E+38 3.4E+38 ECU_ADDRESS 0xfe4aa19c /* @ECU_Address@autosar_swc_aeb_rtARID_DEF.UnitDelay3_DSTATE.PrimTarIntv.VLat@ */ /end MEASUREMENT
/begin MEASUREMENT autosar_swc_aeb_rtARID_DEF.UnitDelay3_DSTATE.PrimTarIntv.VLgt "" FLOAT32_IEEE autosar_swc_aeb_CM_single 0 0 -3.4E+38 3.4E+38 ECU_ADDRESS 0xfe4aa1a0 /* @ECU_Address@autosar_swc_aeb_rtARID_DEF.UnitDelay3_DSTATE.PrimTarIntv.VLgt@ */ /end MEASUREMENT
/begin MEASUREMENT autosar_swc_aeb_rtARID_DEF.UnitDelay3_DSTATE.PrimTarIntv.VisnId "" ULONG autosar_swc_aeb_CM_uint32 0 0 0 4294967295 ECU_ADDRESS 0xfe4aa198 /* @ECU_Address@autosar_swc_aeb_rtARID_DEF.UnitDelay3_DSTATE.PrimTarIntv.VisnId@ */ /end MEASUREMENT
/begin MEASUREMENT autosar_swc_aeb_rtARID_DEF.UnitDelay3_DSTATE.PrimTarIntv.Width "" FLOAT32_IEEE autosar_swc_aeb_CM_single 0 0 -3.4E+38 3.4E+38 ECU_ADDRESS 0xfe4aa1a4 /* @ECU_Address@autosar_swc_aeb_rtARID_DEF.UnitDelay3_DSTATE.PrimTarIntv.Width@ */ /end MEASUREMENT
/begin MEASUREMENT autosar_swc_aeb_rtARID_DEF.UnitDelay4_DSTATE.MtnRqrdWarn.ALatRqrd "" FLOAT32_IEEE autosar_swc_aeb_CM_single 0 0 -3.4E+38 3.4E+38 ECU_ADDRESS 0xfe4aa1c8 /* @ECU_Address@autosar_swc_aeb_rtARID_DEF.UnitDelay4_DSTATE.MtnRqrdWarn.ALatRqrd@ */ /end MEASUREMENT
/begin MEASUREMENT autosar_swc_aeb_rtARID_DEF.UnitDelay4_DSTATE.MtnRqrdWarn.ALatRqrdQly "" SLONG autosar_swc_aeb_CM_Relbl1Vcc 0 0 0 1 ECU_ADDRESS 0xfe4aa1cc /* @ECU_Address@autosar_swc_aeb_rtARID_DEF.UnitDelay4_DSTATE.MtnRqrdWarn.ALatRqrdQly@ */ /end MEASUREMENT
/begin MEASUREMENT autosar_swc_aeb_rtARID_DEF.UnitDelay4_DSTATE.MtnRqrdWarn.ANegLgtRqrdForIntv "" FLOAT32_IEEE autosar_swc_aeb_CM_single 0 0 -3.4E+38 3.4E+38 ECU_ADDRESS 0xfe4aa1d4 /* @ECU_Address@autosar_swc_aeb_rtARID_DEF.UnitDelay4_DSTATE.MtnRqrdWarn.ANegLgtRqrdForIntv@ */ /end MEASUREMENT
/begin MEASUREMENT autosar_swc_aeb_rtARID_DEF.UnitDelay4_DSTATE.MtnRqrdWarn.ANegLgtRqrdForWarn "" FLOAT32_IEEE autosar_swc_aeb_CM_single 0 0 -3.4E+38 3.4E+38 ECU_ADDRESS 0xfe4aa1d0 /* @ECU_Address@autosar_swc_aeb_rtARID_DEF.UnitDelay4_DSTATE.MtnRqrdWarn.ANegLgtRqrdForWarn@ */ /end MEASUREMENT
/begin MEASUREMENT autosar_swc_aeb_rtARID_DEF.UnitDelay4_DSTATE.ObjALrgDetd "" SLONG autosar_swc_aeb_CM_CritLgtCdnForWarn0ObjALrgDetd0 0 0 0 1 ECU_ADDRESS 0xfe4aa210 /* @ECU_Address@autosar_swc_aeb_rtARID_DEF.UnitDelay4_DSTATE.ObjALrgDetd@ */ /end MEASUREMENT
/begin MEASUREMENT autosar_swc_aeb_rtARID_DEF.UnitDelay4_DSTATE.ObjALrgIdn "" UBYTE autosar_swc_aeb_CM_uint8 0 0 0 255 ECU_ADDRESS 0xfe4aa214 /* @ECU_Address@autosar_swc_aeb_rtARID_DEF.UnitDelay4_DSTATE.ObjALrgIdn@ */ /end MEASUREMENT
/begin MEASUREMENT autosar_swc_aeb_rtARID_DEF.UnitDelay4_DSTATE.PrimTarWarn.ALgt "" FLOAT32_IEEE autosar_swc_aeb_CM_single 0 0 -3.4E+38 3.4E+38 ECU_ADDRESS 0xfe4aa1dc /* @ECU_Address@autosar_swc_aeb_rtARID_DEF.UnitDelay4_DSTATE.PrimTarWarn.ALgt@ */ /end MEASUREMENT
/begin MEASUREMENT autosar_swc_aeb_rtARID_DEF.UnitDelay4_DSTATE.PrimTarWarn.Hei "" FLOAT32_IEEE autosar_swc_aeb_CM_single 0 0 -3.4E+38 3.4E+38 ECU_ADDRESS 0xfe4aa1e0 /* @ECU_Address@autosar_swc_aeb_rtARID_DEF.UnitDelay4_DSTATE.PrimTarWarn.Hei@ */ /end MEASUREMENT
/begin MEASUREMENT autosar_swc_aeb_rtARID_DEF.UnitDelay4_DSTATE.PrimTarWarn.Idn "" ULONG autosar_swc_aeb_CM_uint32 0 0 0 4294967295 ECU_ADDRESS 0xfe4aa1e4 /* @ECU_Address@autosar_swc_aeb_rtARID_DEF.UnitDelay4_DSTATE.PrimTarWarn.Idn@ */ /end MEASUREMENT
/begin MEASUREMENT autosar_swc_aeb_rtARID_DEF.UnitDelay4_DSTATE.PrimTarWarn.ObjTyp "" SLONG autosar_swc_aeb_CM_ObjClassn3Vcc 0 0 0 10 ECU_ADDRESS 0xfe4aa1e8 /* @ECU_Address@autosar_swc_aeb_rtARID_DEF.UnitDelay4_DSTATE.PrimTarWarn.ObjTyp@ */ /end MEASUREMENT
/begin MEASUREMENT autosar_swc_aeb_rtARID_DEF.UnitDelay4_DSTATE.PrimTarWarn.PinionSteerAgSpd "" FLOAT32_IEEE autosar_swc_aeb_CM_single 0 0 -3.4E+38 3.4E+38 ECU_ADDRESS 0xfe4aa1d8 /* @ECU_Address@autosar_swc_aeb_rtARID_DEF.UnitDelay4_DSTATE.PrimTarWarn.PinionSteerAgSpd@ */ /end MEASUREMENT
/begin MEASUREMENT autosar_swc_aeb_rtARID_DEF.UnitDelay4_DSTATE.PrimTarWarn.PosnLat "" FLOAT32_IEEE autosar_swc_aeb_CM_single 0 0 -3.4E+38 3.4E+38 ECU_ADDRESS 0xfe4aa1ec /* @ECU_Address@autosar_swc_aeb_rtARID_DEF.UnitDelay4_DSTATE.PrimTarWarn.PosnLat@ */ /end MEASUREMENT
/begin MEASUREMENT autosar_swc_aeb_rtARID_DEF.UnitDelay4_DSTATE.PrimTarWarn.PosnLgt "" FLOAT32_IEEE autosar_swc_aeb_CM_single 0 0 -3.4E+38 3.4E+38 ECU_ADDRESS 0xfe4aa1f0 /* @ECU_Address@autosar_swc_aeb_rtARID_DEF.UnitDelay4_DSTATE.PrimTarWarn.PosnLgt@ */ /end MEASUREMENT
/begin MEASUREMENT autosar_swc_aeb_rtARID_DEF.UnitDelay4_DSTATE.PrimTarWarn.PrimTarInPahNow "" SLONG autosar_swc_aeb_CM_PrimTarWarn1VccPrimTarInPahNow0 0 0 0 1 ECU_ADDRESS 0xfe4aa20c /* @ECU_Address@autosar_swc_aeb_rtARID_DEF.UnitDelay4_DSTATE.PrimTarWarn.PrimTarInPahNow@ */ /end MEASUREMENT
/begin MEASUREMENT autosar_swc_aeb_rtARID_DEF.UnitDelay4_DSTATE.PrimTarWarn.QlyWarn "" SLONG autosar_swc_aeb_CM_CllsnWarnFwdQlyVcc 0 0 0 1 ECU_ADDRESS 0xfe4aa1f4 /* @ECU_Address@autosar_swc_aeb_rtARID_DEF.UnitDelay4_DSTATE.PrimTarWarn.QlyWarn@ */ /end MEASUREMENT
/begin MEASUREMENT autosar_swc_aeb_rtARID_DEF.UnitDelay4_DSTATE.PrimTarWarn.TiToCllsn "" FLOAT32_IEEE autosar_swc_aeb_CM_single 0 0 -3.4E+38 3.4E+38 ECU_ADDRESS 0xfe4aa1f8 /* @ECU_Address@autosar_swc_aeb_rtARID_DEF.UnitDelay4_DSTATE.PrimTarWarn.TiToCllsn@ */ /end MEASUREMENT
/begin MEASUREMENT autosar_swc_aeb_rtARID_DEF.UnitDelay4_DSTATE.PrimTarWarn.VLat "" FLOAT32_IEEE autosar_swc_aeb_CM_single 0 0 -3.4E+38 3.4E+38 ECU_ADDRESS 0xfe4aa204 /* @ECU_Address@autosar_swc_aeb_rtARID_DEF.UnitDelay4_DSTATE.PrimTarWarn.VLat@ */ /end MEASUREMENT
/begin MEASUREMENT autosar_swc_aeb_rtARID_DEF.UnitDelay4_DSTATE.PrimTarWarn.VLgt "" FLOAT32_IEEE autosar_swc_aeb_CM_single 0 0 -3.4E+38 3.4E+38 ECU_ADDRESS 0xfe4aa200 /* @ECU_Address@autosar_swc_aeb_rtARID_DEF.UnitDelay4_DSTATE.PrimTarWarn.VLgt@ */ /end MEASUREMENT
/begin MEASUREMENT autosar_swc_aeb_rtARID_DEF.UnitDelay4_DSTATE.PrimTarWarn.VisnId "" ULONG autosar_swc_aeb_CM_uint32 0 0 0 4294967295 ECU_ADDRESS 0xfe4aa1fc /* @ECU_Address@autosar_swc_aeb_rtARID_DEF.UnitDelay4_DSTATE.PrimTarWarn.VisnId@ */ /end MEASUREMENT
/begin MEASUREMENT autosar_swc_aeb_rtARID_DEF.UnitDelay4_DSTATE.PrimTarWarn.Width "" FLOAT32_IEEE autosar_swc_aeb_CM_single 0 0 -3.4E+38 3.4E+38 ECU_ADDRESS 0xfe4aa208 /* @ECU_Address@autosar_swc_aeb_rtARID_DEF.UnitDelay4_DSTATE.PrimTarWarn.Width@ */ /end MEASUREMENT
/begin MEASUREMENT autosar_swc_aeb_rtARID_DEF.UnitDelay5_DSTATE.BltLvl "" SLONG autosar_swc_aeb_CM_AsyBltLvl1Vcc 0 0 0 2 ECU_ADDRESS 0xfe4aa2c0 /* @ECU_Address@autosar_swc_aeb_rtARID_DEF.UnitDelay5_DSTATE.BltLvl@ */ /end MEASUREMENT
/begin MEASUREMENT autosar_swc_aeb_rtARID_DEF.UnitDelay5_DSTATE.CllsnThreat "" SLONG autosar_swc_aeb_CM_ReqSts1Vcc 0 0 0 3 ECU_ADDRESS 0xfe4aa2c4 /* @ECU_Address@autosar_swc_aeb_rtARID_DEF.UnitDelay5_DSTATE.CllsnThreat@ */ /end MEASUREMENT
/begin MEASUREMENT autosar_swc_aeb_rtARID_DEF.UnitDelay5_DSTATE.CrsCnclReq "" SLONG autosar_swc_aeb_CM_OnOff1Vcc 0 0 0 1 ECU_ADDRESS 0xfe4aa2b8 /* @ECU_Address@autosar_swc_aeb_rtARID_DEF.UnitDelay5_DSTATE.CrsCnclReq@ */ /end MEASUREMENT
/begin MEASUREMENT autosar_swc_aeb_rtARID_DEF.UnitDelay5_DSTATE.DamprReq "" SLONG autosar_swc_aeb_CM_NoYes1Vcc 0 0 0 1 ECU_ADDRESS 0xfe4aa2ac /* @ECU_Address@autosar_swc_aeb_rtARID_DEF.UnitDelay5_DSTATE.DamprReq@ */ /end MEASUREMENT
/begin MEASUREMENT autosar_swc_aeb_rtARID_DEF.UnitDelay5_DSTATE.DecelEna "" SLONG autosar_swc_aeb_CM_OnOff1Vcc 0 0 0 1 ECU_ADDRESS 0xfe4aa2b0 /* @ECU_Address@autosar_swc_aeb_rtARID_DEF.UnitDelay5_DSTATE.DecelEna@ */ /end MEASUREMENT
/begin MEASUREMENT autosar_swc_aeb_rtARID_DEF.UnitDelay5_DSTATE.DecelReq "" FLOAT32_IEEE autosar_swc_aeb_CM_single 0 0 -3.4E+38 3.4E+38 ECU_ADDRESS 0xfe4aa2a8 /* @ECU_Address@autosar_swc_aeb_rtARID_DEF.UnitDelay5_DSTATE.DecelReq@ */ /end MEASUREMENT
/begin MEASUREMENT autosar_swc_aeb_rtARID_DEF.UnitDelay5_DSTATE.StandStillReq "" SLONG autosar_swc_aeb_CM_OnOff1Vcc 0 0 0 1 ECU_ADDRESS 0xfe4aa2bc /* @ECU_Address@autosar_swc_aeb_rtARID_DEF.UnitDelay5_DSTATE.StandStillReq@ */ /end MEASUREMENT
/begin MEASUREMENT autosar_swc_aeb_rtARID_DEF.UnitDelay5_DSTATE.SteerAsEna "" SLONG autosar_swc_aeb_CM_OnOff1 0 0 0 1 ECU_ADDRESS 0xfe4aa2b4 /* @ECU_Address@autosar_swc_aeb_rtARID_DEF.UnitDelay5_DSTATE.SteerAsEna@ */ /end MEASUREMENT
/begin MEASUREMENT autosar_swc_aeb_rtARID_DEF.UnitDelay5_DSTATE.SteerGainEna "" SLONG autosar_swc_aeb_CM_ActtnDataFromCllsnRednByBrkgCtrl1VccSteerGainEna0 0 0 0 1 ECU_ADDRESS 0xfe4aa2cc /* @ECU_Address@autosar_swc_aeb_rtARID_DEF.UnitDelay5_DSTATE.SteerGainEna@ */ /end MEASUREMENT
/begin MEASUREMENT autosar_swc_aeb_rtARID_DEF.UnitDelay5_DSTATE.SteerTqSgnReq "" SLONG autosar_swc_aeb_CM_TqAllwdPosAndNeg 0 0 0 3 ECU_ADDRESS 0xfe4aa2c8 /* @ECU_Address@autosar_swc_aeb_rtARID_DEF.UnitDelay5_DSTATE.SteerTqSgnReq@ */ /end MEASUREMENT
/begin MEASUREMENT autosar_swc_aeb_rtARID_DEF.UnitDelay6_DSTATE.BltLvl "" SLONG autosar_swc_aeb_CM_AsyBltLvl1Vcc 0 0 0 2 ECU_ADDRESS 0xfe4aa32c /* @ECU_Address@autosar_swc_aeb_rtARID_DEF.UnitDelay6_DSTATE.BltLvl@ */ /end MEASUREMENT
/begin MEASUREMENT autosar_swc_aeb_rtARID_DEF.UnitDelay6_DSTATE.BrkGainEna "" SLONG autosar_swc_aeb_CM_OnOff1Vcc 0 0 0 1 ECU_ADDRESS 0xfe4aa324 /* @ECU_Address@autosar_swc_aeb_rtARID_DEF.UnitDelay6_DSTATE.BrkGainEna@ */ /end MEASUREMENT
/begin MEASUREMENT autosar_swc_aeb_rtARID_DEF.UnitDelay6_DSTATE.BrkGainMaxDecel "" FLOAT32_IEEE autosar_swc_aeb_CM_single 0 0 -3.4E+38 3.4E+38 ECU_ADDRESS 0xfe4aa320 /* @ECU_Address@autosar_swc_aeb_rtARID_DEF.UnitDelay6_DSTATE.BrkGainMaxDecel@ */ /end MEASUREMENT
/begin MEASUREMENT autosar_swc_aeb_rtARID_DEF.UnitDelay6_DSTATE.BrkGainReq "" FLOAT32_IEEE autosar_swc_aeb_CM_single 0 0 -3.4E+38 3.4E+38 ECU_ADDRESS 0xfe4aa31c /* @ECU_Address@autosar_swc_aeb_rtARID_DEF.UnitDelay6_DSTATE.BrkGainReq@ */ /end MEASUREMENT
/begin MEASUREMENT autosar_swc_aeb_rtARID_DEF.UnitDelay6_DSTATE.CllsnThreat "" SLONG autosar_swc_aeb_CM_CllsnFwdWarnCtrlCllsnThreat1Vcc 0 0 0 1 ECU_ADDRESS 0xfe4aa328 /* @ECU_Address@autosar_swc_aeb_rtARID_DEF.UnitDelay6_DSTATE.CllsnThreat@ */ /end MEASUREMENT
/begin MEASUREMENT autosar_swc_aeb_rtARID_DEF.UnitDelay6_DSTATE.DecelEna "" SLONG autosar_swc_aeb_CM_OnOff1Vcc 0 0 0 1 ECU_ADDRESS 0xfe4aa318 /* @ECU_Address@autosar_swc_aeb_rtARID_DEF.UnitDelay6_DSTATE.DecelEna@ */ /end MEASUREMENT
/begin MEASUREMENT autosar_swc_aeb_rtARID_DEF.UnitDelay6_DSTATE.DecelReq "" FLOAT32_IEEE autosar_swc_aeb_CM_single 0 0 -3.4E+38 3.4E+38 ECU_ADDRESS 0xfe4aa314 /* @ECU_Address@autosar_swc_aeb_rtARID_DEF.UnitDelay6_DSTATE.DecelReq@ */ /end MEASUREMENT
/begin MEASUREMENT autosar_swc_aeb_rtARID_DEF.UnitDelay_DSTATE.ALatAbsltCmft "" FLOAT32_IEEE autosar_swc_aeb_CM_single 0 0 -3.4E+38 3.4E+38 ECU_ADDRESS 0xfe4aa260 /* @ECU_Address@autosar_swc_aeb_rtARID_DEF.UnitDelay_DSTATE.ALatAbsltCmft@ */ /end MEASUREMENT
/begin MEASUREMENT autosar_swc_aeb_rtARID_DEF.UnitDelay_DSTATE.ALatAbsltMax "" FLOAT32_IEEE autosar_swc_aeb_CM_single 0 0 -3.4E+38 3.4E+38 ECU_ADDRESS 0xfe4aa264 /* @ECU_Address@autosar_swc_aeb_rtARID_DEF.UnitDelay_DSTATE.ALatAbsltMax@ */ /end MEASUREMENT
/begin MEASUREMENT autosar_swc_aeb_rtARID_DEF.UnitDelay_DSTATE.ALgtNegCmft "" FLOAT32_IEEE autosar_swc_aeb_CM_single 0 0 -3.4E+38 3.4E+38 ECU_ADDRESS 0xfe4aa268 /* @ECU_Address@autosar_swc_aeb_rtARID_DEF.UnitDelay_DSTATE.ALgtNegCmft@ */ /end MEASUREMENT
/begin MEASUREMENT autosar_swc_aeb_rtARID_DEF.UnitDelay_DSTATE.ALgtNegMeasd "" FLOAT32_IEEE autosar_swc_aeb_CM_single 0 0 -3.4E+38 3.4E+38 ECU_ADDRESS 0xfe4aa26c /* @ECU_Address@autosar_swc_aeb_rtARID_DEF.UnitDelay_DSTATE.ALgtNegMeasd@ */ /end MEASUREMENT
/begin MEASUREMENT autosar_swc_aeb_rtARID_DEF.UnitDelay_DSTATE.ALgtNegMin "" FLOAT32_IEEE autosar_swc_aeb_CM_single 0 0 -3.4E+38 3.4E+38 ECU_ADDRESS 0xfe4aa270 /* @ECU_Address@autosar_swc_aeb_rtARID_DEF.UnitDelay_DSTATE.ALgtNegMin@ */ /end MEASUREMENT
/begin MEASUREMENT autosar_swc_aeb_rtARID_DEF.UnitDelay_DSTATE.ALgtPosCmft "" FLOAT32_IEEE autosar_swc_aeb_CM_single 0 0 -3.4E+38 3.4E+38 ECU_ADDRESS 0xfe4aa274 /* @ECU_Address@autosar_swc_aeb_rtARID_DEF.UnitDelay_DSTATE.ALgtPosCmft@ */ /end MEASUREMENT
/begin MEASUREMENT autosar_swc_aeb_rtARID_DEF.UnitDelay_DSTATE.ALgtPosMax "" FLOAT32_IEEE autosar_swc_aeb_CM_single 0 0 -3.4E+38 3.4E+38 ECU_ADDRESS 0xfe4aa278 /* @ECU_Address@autosar_swc_aeb_rtARID_DEF.UnitDelay_DSTATE.ALgtPosMax@ */ /end MEASUREMENT
/begin MEASUREMENT autosar_swc_aeb_rtARID_DEF.UnitDelay_DSTATE.CrvtAbsltCmft "" FLOAT32_IEEE autosar_swc_aeb_CM_single 0 0 -3.4E+38 3.4E+38 ECU_ADDRESS 0xfe4aa27c /* @ECU_Address@autosar_swc_aeb_rtARID_DEF.UnitDelay_DSTATE.CrvtAbsltCmft@ */ /end MEASUREMENT
/begin MEASUREMENT autosar_swc_aeb_rtARID_DEF.UnitDelay_DSTATE.CrvtAbsltMax "" FLOAT32_IEEE autosar_swc_aeb_CM_single 0 0 -3.4E+38 3.4E+38 ECU_ADDRESS 0xfe4aa280 /* @ECU_Address@autosar_swc_aeb_rtARID_DEF.UnitDelay_DSTATE.CrvtAbsltMax@ */ /end MEASUREMENT
/begin MEASUREMENT autosar_swc_aeb_rtARID_DEF.UnitDelay_DSTATE.CrvtRateAbsltCmft "" FLOAT32_IEEE autosar_swc_aeb_CM_single 0 0 -3.4E+38 3.4E+38 ECU_ADDRESS 0xfe4aa284 /* @ECU_Address@autosar_swc_aeb_rtARID_DEF.UnitDelay_DSTATE.CrvtRateAbsltCmft@ */ /end MEASUREMENT
/begin MEASUREMENT autosar_swc_aeb_rtARID_DEF.UnitDelay_DSTATE.CrvtRateAbsltMax "" FLOAT32_IEEE autosar_swc_aeb_CM_single 0 0 -3.4E+38 3.4E+38 ECU_ADDRESS 0xfe4aa288 /* @ECU_Address@autosar_swc_aeb_rtARID_DEF.UnitDelay_DSTATE.CrvtRateAbsltMax@ */ /end MEASUREMENT
/begin MEASUREMENT autosar_swc_aeb_rtARID_DEF.UnitDelay_DSTATE.JerkLatAbsltCmft "" FLOAT32_IEEE autosar_swc_aeb_CM_single 0 0 -3.4E+38 3.4E+38 ECU_ADDRESS 0xfe4aa28c /* @ECU_Address@autosar_swc_aeb_rtARID_DEF.UnitDelay_DSTATE.JerkLatAbsltCmft@ */ /end MEASUREMENT
/begin MEASUREMENT autosar_swc_aeb_rtARID_DEF.UnitDelay_DSTATE.JerkLatAbsltMax "" FLOAT32_IEEE autosar_swc_aeb_CM_single 0 0 -3.4E+38 3.4E+38 ECU_ADDRESS 0xfe4aa290 /* @ECU_Address@autosar_swc_aeb_rtARID_DEF.UnitDelay_DSTATE.JerkLatAbsltMax@ */ /end MEASUREMENT
/begin MEASUREMENT autosar_swc_aeb_rtARID_DEF.UnitDelay_DSTATE.JerkLgtNegCmft "" FLOAT32_IEEE autosar_swc_aeb_CM_single 0 0 -3.4E+38 3.4E+38 ECU_ADDRESS 0xfe4aa294 /* @ECU_Address@autosar_swc_aeb_rtARID_DEF.UnitDelay_DSTATE.JerkLgtNegCmft@ */ /end MEASUREMENT
/begin MEASUREMENT autosar_swc_aeb_rtARID_DEF.UnitDelay_DSTATE.JerkLgtNegMeasd "" FLOAT32_IEEE autosar_swc_aeb_CM_single 0 0 -3.4E+38 3.4E+38 ECU_ADDRESS 0xfe4aa298 /* @ECU_Address@autosar_swc_aeb_rtARID_DEF.UnitDelay_DSTATE.JerkLgtNegMeasd@ */ /end MEASUREMENT
/begin MEASUREMENT autosar_swc_aeb_rtARID_DEF.UnitDelay_DSTATE.JerkLgtNegMin "" FLOAT32_IEEE autosar_swc_aeb_CM_single 0 0 -3.4E+38 3.4E+38 ECU_ADDRESS 0xfe4aa29c /* @ECU_Address@autosar_swc_aeb_rtARID_DEF.UnitDelay_DSTATE.JerkLgtNegMin@ */ /end MEASUREMENT
/begin MEASUREMENT autosar_swc_aeb_rtARID_DEF.UnitDelay_DSTATE.JerkLgtPosCmft "" FLOAT32_IEEE autosar_swc_aeb_CM_single 0 0 -3.4E+38 3.4E+38 ECU_ADDRESS 0xfe4aa2a0 /* @ECU_Address@autosar_swc_aeb_rtARID_DEF.UnitDelay_DSTATE.JerkLgtPosCmft@ */ /end MEASUREMENT
/begin MEASUREMENT autosar_swc_aeb_rtARID_DEF.UnitDelay_DSTATE.JerkLgtPosMax "" FLOAT32_IEEE autosar_swc_aeb_CM_single 0 0 -3.4E+38 3.4E+38 ECU_ADDRESS 0xfe4aa2a4 /* @ECU_Address@autosar_swc_aeb_rtARID_DEF.UnitDelay_DSTATE.JerkLgtPosMax@ */ /end MEASUREMENT
/begin COMPU_METHOD autosar_swc_aeb_CM_ActtnDataFromCllsnRednByBrkgCtrl1VccSteerGainEna0 "Enumerated data type: ActtnDataFromCllsnRednByBrkgCtrl1VccSteerGainEna0" TAB_VERB "%0.6" "" COMPU_TAB_REF VTAB_FOR_autosar_swc_aeb_CM_ActtnDataFromCllsnRednByBrkgCtrl1VccSteerGainEna0 /end COMPU_METHOD
/begin COMPU_VTAB VTAB_FOR_autosar_swc_aeb_CM_ActtnDataFromCllsnRednByBrkgCtrl1VccSteerGainEna0 "Enumerated data type: ActtnDataFromCllsnRednByBrkgCtrl1VccSteerGainEna0" TAB_VERB 2 1 "ActtnDataFromCllsnRednByBrkgCtrl1VccSteerGainEna0_TRUE" 0 "ActtnDataFromCllsnRednByBrkgCtrl1VccSteerGainEna0_FALSE" /end COMPU_VTAB
/begin COMPU_METHOD autosar_swc_aeb_CM_AsyBltLvl1Vcc "Enumerated data type: AsyBltLvl1Vcc" TAB_VERB "%0.6" "" COMPU_TAB_REF VTAB_FOR_autosar_swc_aeb_CM_AsyBltLvl1Vcc /end COMPU_METHOD
/begin COMPU_VTAB VTAB_FOR_autosar_swc_aeb_CM_AsyBltLvl1Vcc "Enumerated data type: AsyBltLvl1Vcc" TAB_VERB 3 0 "AsyBltLvl1Vcc_NoActvn" 1 "AsyBltLvl1Vcc_ActvnFLo" 2 "AsyBltLvl1Vcc_ActvnFHi" /end COMPU_VTAB
/begin COMPU_METHOD autosar_swc_aeb_CM_CllsnFwdWarnCtrlCllsnThreat1Vcc "Enumerated data type: CllsnFwdWarnCtrlCllsnThreat1Vcc" TAB_VERB "%0.6" "" COMPU_TAB_REF VTAB_FOR_autosar_swc_aeb_CM_CllsnFwdWarnCtrlCllsnThreat1Vcc /end COMPU_METHOD
/begin COMPU_VTAB VTAB_FOR_autosar_swc_aeb_CM_CllsnFwdWarnCtrlCllsnThreat1Vcc "Enumerated data type: CllsnFwdWarnCtrlCllsnThreat1Vcc" TAB_VERB 2 0 "CllsnFwdWarnCtrlCllsnThreat1Vcc_Ukwn" 1 "CllsnFwdWarnCtrlCllsnThreat1Vcc_ThreatLo" /end COMPU_VTAB
/begin COMPU_METHOD autosar_swc_aeb_CM_CllsnMtgtnByBrkgPrimQlyVcc "Enumerated data type: CllsnMtgtnByBrkgPrimQlyVcc" TAB_VERB "%0.6" "" COMPU_TAB_REF VTAB_FOR_autosar_swc_aeb_CM_CllsnMtgtnByBrkgPrimQlyVcc /end COMPU_METHOD
/begin COMPU_VTAB VTAB_FOR_autosar_swc_aeb_CM_CllsnMtgtnByBrkgPrimQlyVcc "Enumerated data type: CllsnMtgtnByBrkgPrimQlyVcc" TAB_VERB 4 0 "CllsnMtgtnByBrkgPrimQlyVcc_NotRelbl" 1 "CllsnMtgtnByBrkgPrimQlyVcc_CoastRelbl" 2 "CllsnMtgtnByBrkgPrimQlyVcc_BrkSpprtRelbl" 3 "CllsnMtgtnByBrkgPrimQlyVcc_BrkgRelbl" /end COMPU_VTAB
/begin COMPU_METHOD autosar_swc_aeb_CM_CllsnWarnFwdQlyVcc "Enumerated data type: CllsnWarnFwdQlyVcc" TAB_VERB "%0.6" "" COMPU_TAB_REF VTAB_FOR_autosar_swc_aeb_CM_CllsnWarnFwdQlyVcc /end COMPU_METHOD
/begin COMPU_VTAB VTAB_FOR_autosar_swc_aeb_CM_CllsnWarnFwdQlyVcc "Enumerated data type: CllsnWarnFwdQlyVcc" TAB_VERB 2 0 "CllsnWarnFwdQlyVcc_NotRelbl" 1 "CllsnWarnFwdQlyVcc_Relbl" /end COMPU_VTAB
/begin COMPU_METHOD autosar_swc_aeb_CM_CritLgtCdnForWarn0ObjALrgDetd0 "Enumerated data type: CritLgtCdnForWarn0ObjALrgDetd0" TAB_VERB "%0.6" "" COMPU_TAB_REF VTAB_FOR_autosar_swc_aeb_CM_CritLgtCdnForWarn0ObjALrgDetd0 /end COMPU_METHOD
/begin COMPU_VTAB VTAB_FOR_autosar_swc_aeb_CM_CritLgtCdnForWarn0ObjALrgDetd0 "Enumerated data type: CritLgtCdnForWarn0ObjALrgDetd0" TAB_VERB 2 1 "CritLgtCdnForWarn0ObjALrgDetd0_TRUE" 0 "CritLgtCdnForWarn0ObjALrgDetd0_FALSE" /end COMPU_VTAB
/begin COMPU_METHOD autosar_swc_aeb_CM_IndcrTurn1Vcc "Enumerated data type: IndcrTurn1Vcc" TAB_VERB "%0.6" "" COMPU_TAB_REF VTAB_FOR_autosar_swc_aeb_CM_IndcrTurn1Vcc /end COMPU_METHOD
/begin COMPU_VTAB VTAB_FOR_autosar_swc_aeb_CM_IndcrTurn1Vcc "Enumerated data type: IndcrTurn1Vcc" TAB_VERB 4 0 "IndcrTurn1Vcc_NoIndcn" 1 "IndcrTurn1Vcc_Le" 2 "IndcrTurn1Vcc_Ri" 3 "IndcrTurn1Vcc_Ukwn" /end COMPU_VTAB
/begin COMPU_METHOD autosar_swc_aeb_CM_LiSts1Vcc "Enumerated data type: LiSts1Vcc" TAB_VERB "%0.6" "" COMPU_TAB_REF VTAB_FOR_autosar_swc_aeb_CM_LiSts1Vcc /end COMPU_METHOD
/begin COMPU_VTAB VTAB_FOR_autosar_swc_aeb_CM_LiSts1Vcc "Enumerated data type: LiSts1Vcc" TAB_VERB 3 0 "LiSts1Vcc_Ukwn" 1 "LiSts1Vcc_Off" 2 "LiSts1Vcc_On" /end COMPU_VTAB
/begin COMPU_METHOD autosar_swc_aeb_CM_NoYes1Vcc "Enumerated data type: NoYes1Vcc" TAB_VERB "%0.6" "" COMPU_TAB_REF VTAB_FOR_autosar_swc_aeb_CM_NoYes1Vcc /end COMPU_METHOD
/begin COMPU_VTAB VTAB_FOR_autosar_swc_aeb_CM_NoYes1Vcc "Enumerated data type: NoYes1Vcc" TAB_VERB 2 0 "NoYes1Vcc_No" 1 "NoYes1Vcc_Yes" /end COMPU_VTAB
/begin COMPU_METHOD autosar_swc_aeb_CM_ObjClassn3Vcc "Enumerated data type: ObjClassn3Vcc" TAB_VERB "%0.6" "" COMPU_TAB_REF VTAB_FOR_autosar_swc_aeb_CM_ObjClassn3Vcc /end COMPU_METHOD
/begin COMPU_VTAB VTAB_FOR_autosar_swc_aeb_CM_ObjClassn3Vcc "Enumerated data type: ObjClassn3Vcc" TAB_VERB 9 0 "ObjClassn3Vcc_UkwnClass" 1 "ObjClassn3Vcc_Car" 2 "ObjClassn3Vcc_Motorcycle" 3 "ObjClassn3Vcc_Truck" 4 "ObjClassn3Vcc_Ped" 7 "ObjClassn3Vcc_Anim" 8 "ObjClassn3Vcc_ObjGen" 9 "ObjClassn3Vcc_Bicycle" 10 "ObjClassn3Vcc_VehOfUkwnClass" /end COMPU_VTAB
/begin COMPU_METHOD autosar_swc_aeb_CM_ObjMtnPat1Vcc "Enumerated data type: ObjMtnPat1Vcc" TAB_VERB "%0.6" "" COMPU_TAB_REF VTAB_FOR_autosar_swc_aeb_CM_ObjMtnPat1Vcc /end COMPU_METHOD
/begin COMPU_VTAB VTAB_FOR_autosar_swc_aeb_CM_ObjMtnPat1Vcc "Enumerated data type: ObjMtnPat1Vcc" TAB_VERB 5 0 "ObjMtnPat1Vcc_Ukwn" 1 "ObjMtnPat1Vcc_Staty" 2 "ObjMtnPat1Vcc_MovgFromSelf" 3 "ObjMtnPat1Vcc_MovgToSelf" 4 "ObjMtnPat1Vcc_MovgToAndStaty" /end COMPU_VTAB
/begin COMPU_METHOD autosar_swc_aeb_CM_ObjMtnPatHist1Vcc "Enumerated data type: ObjMtnPatHist1Vcc" TAB_VERB "%0.6" "" COMPU_TAB_REF VTAB_FOR_autosar_swc_aeb_CM_ObjMtnPatHist1Vcc /end COMPU_METHOD
/begin COMPU_VTAB VTAB_FOR_autosar_swc_aeb_CM_ObjMtnPatHist1Vcc "Enumerated data type: ObjMtnPatHist1Vcc" TAB_VERB 4 0 "ObjMtnPatHist1Vcc_Ukwn" 1 "ObjMtnPatHist1Vcc_NotMovg" 2 "ObjMtnPatHist1Vcc_PrevMovmtFromSelf" 3 "ObjMtnPatHist1Vcc_PrevMovmtToSelf" /end COMPU_VTAB
/begin COMPU_METHOD autosar_swc_aeb_CM_ObjPpty1VccEmgyLaneKeepAidPosnQly0 "Enumerated data type: ObjPpty1VccEmgyLaneKeepAidPosnQly0" TAB_VERB "%0.6" "" COMPU_TAB_REF VTAB_FOR_autosar_swc_aeb_CM_ObjPpty1VccEmgyLaneKeepAidPosnQly0 /end COMPU_METHOD
/begin COMPU_VTAB VTAB_FOR_autosar_swc_aeb_CM_ObjPpty1VccEmgyLaneKeepAidPosnQly0 "Enumerated data type: ObjPpty1VccEmgyLaneKeepAidPosnQly0" TAB_VERB 3 0 "ObjPpty1VccEmgyLaneKeepAidPosnQly0_NotRelbl" 1 "ObjPpty1VccEmgyLaneKeepAidPosnQly0_Relbl" 2 "ObjPpty1VccEmgyLaneKeepAidPosnQly0_HighRelbl" /end COMPU_VTAB
/begin COMPU_METHOD autosar_swc_aeb_CM_ObjPpty1VccMdlOfMtn0 "Enumerated data type: ObjPpty1VccMdlOfMtn0" TAB_VERB "%0.6" "" COMPU_TAB_REF VTAB_FOR_autosar_swc_aeb_CM_ObjPpty1VccMdlOfMtn0 /end COMPU_METHOD
/begin COMPU_VTAB VTAB_FOR_autosar_swc_aeb_CM_ObjPpty1VccMdlOfMtn0 "Enumerated data type: ObjPpty1VccMdlOfMtn0" TAB_VERB 2 0 "ObjPpty1VccMdlOfMtn0_MdlACon" 1 "ObjPpty1VccMdlOfMtn0_MdlBicycle" /end COMPU_VTAB
/begin COMPU_METHOD autosar_swc_aeb_CM_ObjPpty1VccTrfcJamAssiQly0 "Enumerated data type: ObjPpty1VccTrfcJamAssiQly0" TAB_VERB "%0.6" "" COMPU_TAB_REF VTAB_FOR_autosar_swc_aeb_CM_ObjPpty1VccTrfcJamAssiQly0 /end COMPU_METHOD
/begin COMPU_VTAB VTAB_FOR_autosar_swc_aeb_CM_ObjPpty1VccTrfcJamAssiQly0 "Enumerated data type: ObjPpty1VccTrfcJamAssiQly0" TAB_VERB 3 0 "ObjPpty1VccTrfcJamAssiQly0_NotRelbl" 1 "ObjPpty1VccTrfcJamAssiQly0_Relbl" 2 "ObjPpty1VccTrfcJamAssiQly0_HighRelbl" /end COMPU_VTAB
/begin COMPU_METHOD autosar_swc_aeb_CM_ObjPpty1VccTrfcSceno0 "Enumerated data type: ObjPpty1VccTrfcSceno0" TAB_VERB "%0.6" "" COMPU_TAB_REF VTAB_FOR_autosar_swc_aeb_CM_ObjPpty1VccTrfcSceno0 /end COMPU_METHOD
/begin COMPU_VTAB VTAB_FOR_autosar_swc_aeb_CM_ObjPpty1VccTrfcSceno0 "Enumerated data type: ObjPpty1VccTrfcSceno0" TAB_VERB 2 0 "ObjPpty1VccTrfcSceno0_None" 1 "ObjPpty1VccTrfcSceno0_TurnAcrssPah" /end COMPU_VTAB
/begin COMPU_METHOD autosar_swc_aeb_CM_OnOff1 "Enumerated data type: OnOff1" TAB_VERB "%0.6" "" COMPU_TAB_REF VTAB_FOR_autosar_swc_aeb_CM_OnOff1 /end COMPU_METHOD
/begin COMPU_VTAB VTAB_FOR_autosar_swc_aeb_CM_OnOff1 "Enumerated data type: OnOff1" TAB_VERB 2 0 "OnOff1_Off" 1 "OnOff1_On" /end COMPU_VTAB
/begin COMPU_METHOD autosar_swc_aeb_CM_OnOff1Vcc "Enumerated data type: OnOff1Vcc" TAB_VERB "%0.6" "" COMPU_TAB_REF VTAB_FOR_autosar_swc_aeb_CM_OnOff1Vcc /end COMPU_METHOD
/begin COMPU_VTAB VTAB_FOR_autosar_swc_aeb_CM_OnOff1Vcc "Enumerated data type: OnOff1Vcc" TAB_VERB 2 0 "OnOff1Vcc_Off" 1 "OnOff1Vcc_On" /end COMPU_VTAB
/begin COMPU_METHOD autosar_swc_aeb_CM_PrimTarIntv1VccPrimTarInPahNow0 "Enumerated data type: PrimTarIntv1VccPrimTarInPahNow0" TAB_VERB "%0.6" "" COMPU_TAB_REF VTAB_FOR_autosar_swc_aeb_CM_PrimTarIntv1VccPrimTarInPahNow0 /end COMPU_METHOD
/begin COMPU_VTAB VTAB_FOR_autosar_swc_aeb_CM_PrimTarIntv1VccPrimTarInPahNow0 "Enumerated data type: PrimTarIntv1VccPrimTarInPahNow0" TAB_VERB 2 1 "PrimTarIntv1VccPrimTarInPahNow0_TRUE" 0 "PrimTarIntv1VccPrimTarInPahNow0_FALSE" /end COMPU_VTAB
/begin COMPU_METHOD autosar_swc_aeb_CM_PrimTarWarn1VccPrimTarInPahNow0 "Enumerated data type: PrimTarWarn1VccPrimTarInPahNow0" TAB_VERB "%0.6" "" COMPU_TAB_REF VTAB_FOR_autosar_swc_aeb_CM_PrimTarWarn1VccPrimTarInPahNow0 /end COMPU_METHOD
/begin COMPU_VTAB VTAB_FOR_autosar_swc_aeb_CM_PrimTarWarn1VccPrimTarInPahNow0 "Enumerated data type: PrimTarWarn1VccPrimTarInPahNow0" TAB_VERB 2 1 "PrimTarWarn1VccPrimTarInPahNow0_TRUE" 0 "PrimTarWarn1VccPrimTarInPahNow0_FALSE" /end COMPU_VTAB
/begin COMPU_METHOD autosar_swc_aeb_CM_Relbl1Vcc "Enumerated data type: Relbl1Vcc" TAB_VERB "%0.6" "" COMPU_TAB_REF VTAB_FOR_autosar_swc_aeb_CM_Relbl1Vcc /end COMPU_METHOD
/begin COMPU_VTAB VTAB_FOR_autosar_swc_aeb_CM_Relbl1Vcc "Enumerated data type: Relbl1Vcc" TAB_VERB 2 0 "Relbl1Vcc_NotRelbl" 1 "Relbl1Vcc_Relbl" /end COMPU_VTAB
/begin COMPU_METHOD autosar_swc_aeb_CM_Relbl3Vcc "Enumerated data type: Relbl3Vcc" TAB_VERB "%0.6" "" COMPU_TAB_REF VTAB_FOR_autosar_swc_aeb_CM_Relbl3Vcc /end COMPU_METHOD
/begin COMPU_VTAB VTAB_FOR_autosar_swc_aeb_CM_Relbl3Vcc "Enumerated data type: Relbl3Vcc" TAB_VERB 5 0 "Relbl3Vcc_NotRelbl" 1 "Relbl3Vcc_SoonNotRelbl" 2 "Relbl3Vcc_LowRelbl" 3 "Relbl3Vcc_HigherRelbl" 4 "Relbl3Vcc_HighestRelbl" /end COMPU_VTAB
/begin COMPU_METHOD autosar_swc_aeb_CM_Relbl4Vcc "Enumerated data type: Relbl4Vcc" TAB_VERB "%0.6" "" COMPU_TAB_REF VTAB_FOR_autosar_swc_aeb_CM_Relbl4Vcc /end COMPU_METHOD
/begin COMPU_VTAB VTAB_FOR_autosar_swc_aeb_CM_Relbl4Vcc "Enumerated data type: Relbl4Vcc" TAB_VERB 4 0 "Relbl4Vcc_NotRelbl" 1 "Relbl4Vcc_CoastRelbl" 2 "Relbl4Vcc_BrkSpprtRelbl" 3 "Relbl4Vcc_BrkgRelbl" /end COMPU_VTAB
/begin COMPU_METHOD autosar_swc_aeb_CM_ReqSts1Vcc "Enumerated data type: ReqSts1Vcc" TAB_VERB "%0.6" "" COMPU_TAB_REF VTAB_FOR_autosar_swc_aeb_CM_ReqSts1Vcc /end COMPU_METHOD
/begin COMPU_VTAB VTAB_FOR_autosar_swc_aeb_CM_ReqSts1Vcc "Enumerated data type: ReqSts1Vcc" TAB_VERB 4 0 "ReqSts1Vcc_Ukwn" 1 "ReqSts1Vcc_Resd1" 2 "ReqSts1Vcc_ThreatMed" 3 "ReqSts1Vcc_ThreatHi" /end COMPU_VTAB
/begin COMPU_METHOD autosar_swc_aeb_CM_Side1Vcc "Enumerated data type: Side1Vcc" TAB_VERB "%0.6" "" COMPU_TAB_REF VTAB_FOR_autosar_swc_aeb_CM_Side1Vcc /end COMPU_METHOD
/begin COMPU_VTAB VTAB_FOR_autosar_swc_aeb_CM_Side1Vcc "Enumerated data type: Side1Vcc" TAB_VERB 5 0 "Side1Vcc_Re" 1 "Side1Vcc_Frnt" 2 "Side1Vcc_RiSide" 3 "Side1Vcc_LeSide" 4 "Side1Vcc_Ukwn" /end COMPU_VTAB
/begin COMPU_METHOD autosar_swc_aeb_CM_SnsrDataSts1Vcc "Enumerated data type: SnsrDataSts1Vcc" TAB_VERB "%0.6" "" COMPU_TAB_REF VTAB_FOR_autosar_swc_aeb_CM_SnsrDataSts1Vcc /end COMPU_METHOD
/begin COMPU_VTAB VTAB_FOR_autosar_swc_aeb_CM_SnsrDataSts1Vcc "Enumerated data type: SnsrDataSts1Vcc" TAB_VERB 7 0 "SnsrDataSts1Vcc_Invld" 1 "SnsrDataSts1Vcc_Fusn" 2 "SnsrDataSts1Vcc_New" 3 "SnsrDataSts1Vcc_PredNew" 4 "SnsrDataSts1Vcc_UpdNew" 5 "SnsrDataSts1Vcc_Upd" 6 "SnsrDataSts1Vcc_Pred" /end COMPU_VTAB
/begin COMPU_METHOD autosar_swc_aeb_CM_TqAllwdPosAndNeg "Enumerated data type: TqAllwdPosAndNeg" TAB_VERB "%0.6" "" COMPU_TAB_REF VTAB_FOR_autosar_swc_aeb_CM_TqAllwdPosAndNeg /end COMPU_METHOD
/begin COMPU_VTAB VTAB_FOR_autosar_swc_aeb_CM_TqAllwdPosAndNeg "Enumerated data type: TqAllwdPosAndNeg" TAB_VERB 4 0 "TqAllwdPosAndNeg_NoTq" 1 "TqAllwdPosAndNeg_Pos" 2 "TqAllwdPosAndNeg_Neg" 3 "TqAllwdPosAndNeg_PosAndNeg" /end COMPU_VTAB
/begin COMPU_METHOD autosar_swc_aeb_CM_logical "Q = V" IDENTICAL "%1.0" "" /end COMPU_METHOD
/begin COMPU_METHOD autosar_swc_aeb_CM_single "Q = V" IDENTICAL "%8.6" "" /end COMPU_METHOD
/begin COMPU_METHOD autosar_swc_aeb_CM_uint32 "Q = V" IDENTICAL "%10.0" "" /end COMPU_METHOD
/begin COMPU_METHOD autosar_swc_aeb_CM_uint64 "Q = V" IDENTICAL "%20.0" "" /end COMPU_METHOD
/begin COMPU_METHOD autosar_swc_aeb_CM_uint8 "Q = V" IDENTICAL "%3.0" "" /end COMPU_METHOD
/begin RECORD_LAYOUT Record_UWORD FNC_VALUES 1 UWORD COLUMN_DIR DIRECT /end RECORD_LAYOUT
/begin GROUP autosar_swc_aeb_rtARID_DEF.ObjData_i[4].Offsets ""
 /begin REF_MEASUREMENT autosar_swc_aeb_rtARID_DEF.ObjData_i[4].Offsets.OffsLgtLongPred autosar_swc_aeb_rtARID_DEF.ObjData_i[4].Offsets.OffsLatLongPred autosar_swc_aeb_rtARID_DEF.ObjData_i[4].Offsets.OffsLgtShortPred autosar_swc_aeb_rtARID_DEF.ObjData_i[4].Offsets.OffsLatShortPred autosar_swc_aeb_rtARID_DEF.ObjData_i[4].Offsets.OffsLatManoeuvre autosar_swc_aeb_rtARID_DEF.ObjData_i[4].Offsets.OffsLatInPathPrimaryTarget autosar_swc_aeb_rtARID_DEF.ObjData_i[4].Offsets.OffsLatInPathCloseEdge autosar_swc_aeb_rtARID_DEF.ObjData_i[4].Offsets.OffsLatInPathFarEdge autosar_swc_aeb_rtARID_DEF.ObjData_i[4].Offsets.OffsLatIntersection autosar_swc_aeb_rtARID_DEF.ObjData_i[4].Offsets.OffsLatMplTar /end REF_MEASUREMENT
/end GROUP
/begin GROUP autosar_swc_aeb_rtARID_DEF.ObjData_i[4].ShortPredTime ""
 /begin REF_MEASUREMENT autosar_swc_aeb_rtARID_DEF.ObjData_i[4].ShortPredTime.TimeToReachLgt autosar_swc_aeb_rtARID_DEF.ObjData_i[4].ShortPredTime.TimeToMiddleLgt autosar_swc_aeb_rtARID_DEF.ObjData_i[4].ShortPredTime.TimeToPassLgt autosar_swc_aeb_rtARID_DEF.ObjData_i[4].ShortPredTime.TTMSelected autosar_swc_aeb_rtARID_DEF.ObjData_i[4].ShortPredTime.InPath autosar_swc_aeb_rtARID_DEF.ObjData_i[4].ShortPredTime.ObjOnCmngAndBrkg autosar_swc_aeb_rtARID_DEF.ObjData_i[4].ShortPredTime.ALgt autosar_swc_aeb_rtARID_DEF.ObjData_i[4].ShortPredTime.ALat autosar_swc_aeb_rtARID_DEF.ObjData_i[4].ShortPredTime.A autosar_swc_aeb_rtARID_DEF.ObjData_i[4].ShortPredTime.Crvt /end REF_MEASUREMENT
/end GROUP
/begin GROUP autosar_swc_aeb_rtARID_DEF.ObjData_i[5] ""
 /begin SUB_GROUP autosar_swc_aeb_rtARID_DEF.ObjData_i[5].MotionType autosar_swc_aeb_rtARID_DEF.ObjData_i[5].BoundingBox autosar_swc_aeb_rtARID_DEF.ObjData_i[5].Offsets autosar_swc_aeb_rtARID_DEF.ObjData_i[5].LongPredTime autosar_swc_aeb_rtARID_DEF.ObjData_i[5].ShortPredTime /end SUB_GROUP
 /begin REF_MEASUREMENT autosar_swc_aeb_rtARID_DEF.ObjData_i[5].InPathAtCurrentPosition autosar_swc_aeb_rtARID_DEF.ObjData_i[5].PredictionValid autosar_swc_aeb_rtARID_DEF.ObjData_i[5].Idn /end REF_MEASUREMENT
/end GROUP
/begin GROUP autosar_swc_aeb_rtARID_DEF.ObjData_i[5].BoundingBox ""
 /begin REF_MEASUREMENT autosar_swc_aeb_rtARID_DEF.ObjData_i[5].BoundingBox.LengthSideLat autosar_swc_aeb_rtARID_DEF.ObjData_i[5].BoundingBox.LengthSideLgt autosar_swc_aeb_rtARID_DEF.ObjData_i[5].BoundingBox.SinRotation autosar_swc_aeb_rtARID_DEF.ObjData_i[5].BoundingBox.CosRotation autosar_swc_aeb_rtARID_DEF.ObjData_i[5].BoundingBox.RotationAngle /end REF_MEASUREMENT
/end GROUP
/begin GROUP autosar_swc_aeb_rtARID_DEF.ObjData_i[5].LongPredTime ""
 /begin REF_MEASUREMENT autosar_swc_aeb_rtARID_DEF.ObjData_i[5].LongPredTime.TimeToReachLgt autosar_swc_aeb_rtARID_DEF.ObjData_i[5].LongPredTime.TimeToMiddleLgt autosar_swc_aeb_rtARID_DEF.ObjData_i[5].LongPredTime.TimeToPassLgt autosar_swc_aeb_rtARID_DEF.ObjData_i[5].LongPredTime.TTMSelected autosar_swc_aeb_rtARID_DEF.ObjData_i[5].LongPredTime.InPath autosar_swc_aeb_rtARID_DEF.ObjData_i[5].LongPredTime.ObjOnCmngAndBrkg autosar_swc_aeb_rtARID_DEF.ObjData_i[5].LongPredTime.ALgt autosar_swc_aeb_rtARID_DEF.ObjData_i[5].LongPredTime.ALat autosar_swc_aeb_rtARID_DEF.ObjData_i[5].LongPredTime.A autosar_swc_aeb_rtARID_DEF.ObjData_i[5].LongPredTime.Crvt /end REF_MEASUREMENT
/end GROUP
/begin GROUP autosar_swc_aeb_rtARID_DEF.ObjData_i[5].MotionType ""
 /begin REF_MEASUREMENT autosar_swc_aeb_rtARID_DEF.ObjData_i[5].MotionType.Stationary autosar_swc_aeb_rtARID_DEF.ObjData_i[5].MotionType.MovingOncoming autosar_swc_aeb_rtARID_DEF.ObjData_i[5].MotionType.ParallellVehicleLongPred autosar_swc_aeb_rtARID_DEF.ObjData_i[5].MotionType.ParallellVehicleShortPred autosar_swc_aeb_rtARID_DEF.ObjData_i[5].MotionType.ObjectIsVehicle autosar_swc_aeb_rtARID_DEF.ObjData_i[5].MotionType.ObjectIsMotorVehicle autosar_swc_aeb_rtARID_DEF.ObjData_i[5].MotionType.CurvedMotion autosar_swc_aeb_rtARID_DEF.ObjData_i[5].MotionType.SideIsClosest autosar_swc_aeb_rtARID_DEF.ObjData_i[5].MotionType.AbsHeading /end REF_MEASUREMENT
/end GROUP
/begin GROUP autosar_swc_aeb_rtARID_DEF.ObjData_i[5].Offsets ""
 /begin REF_MEASUREMENT autosar_swc_aeb_rtARID_DEF.ObjData_i[5].Offsets.OffsLgtLongPred autosar_swc_aeb_rtARID_DEF.ObjData_i[5].Offsets.OffsLatLongPred autosar_swc_aeb_rtARID_DEF.ObjData_i[5].Offsets.OffsLgtShortPred autosar_swc_aeb_rtARID_DEF.ObjData_i[5].Offsets.OffsLatShortPred autosar_swc_aeb_rtARID_DEF.ObjData_i[5].Offsets.OffsLatManoeuvre autosar_swc_aeb_rtARID_DEF.ObjData_i[5].Offsets.OffsLatInPathPrimaryTarget autosar_swc_aeb_rtARID_DEF.ObjData_i[5].Offsets.OffsLatInPathCloseEdge autosar_swc_aeb_rtARID_DEF.ObjData_i[5].Offsets.OffsLatInPathFarEdge autosar_swc_aeb_rtARID_DEF.ObjData_i[5].Offsets.OffsLatIntersection autosar_swc_aeb_rtARID_DEF.ObjData_i[5].Offsets.OffsLatMplTar /end REF_MEASUREMENT
/end GROUP
/begin GROUP autosar_swc_aeb_rtARID_DEF.ObjData_i[5].ShortPredTime ""
 /begin REF_MEASUREMENT autosar_swc_aeb_rtARID_DEF.ObjData_i[5].ShortPredTime.TimeToReachLgt autosar_swc_aeb_rtARID_DEF.ObjData_i[5].ShortPredTime.TimeToMiddleLgt autosar_swc_aeb_rtARID_DEF.ObjData_i[5].ShortPredTime.TimeToPassLgt autosar_swc_aeb_rtARID_DEF.ObjData_i[5].ShortPredTime.TTMSelected autosar_swc_aeb_rtARID_DEF.ObjData_i[5].ShortPredTime.InPath autosar_swc_aeb_rtARID_DEF.ObjData_i[5].ShortPredTime.ObjOnCmngAndBrkg autosar_swc_aeb_rtARID_DEF.ObjData_i[5].ShortPredTime.ALgt autosar_swc_aeb_rtARID_DEF.ObjData_i[5].ShortPredTime.ALat autosar_swc_aeb_rtARID_DEF.ObjData_i[5].ShortPredTime.A autosar_swc_aeb_rtARID_DEF.ObjData_i[5].ShortPredTime.Crvt /end REF_MEASUREMENT
/end GROUP
/begin GROUP autosar_swc_aeb_rtARID_DEF.ObjData_i[6] ""
 /begin SUB_GROUP autosar_swc_aeb_rtARID_DEF.ObjData_i[6].MotionType autosar_swc_aeb_rtARID_DEF.ObjData_i[6].BoundingBox autosar_swc_aeb_rtARID_DEF.ObjData_i[6].Offsets autosar_swc_aeb_rtARID_DEF.ObjData_i[6].LongPredTime autosar_swc_aeb_rtARID_DEF.ObjData_i[6].ShortPredTime /end SUB_GROUP
 /begin REF_MEASUREMENT autosar_swc_aeb_rtARID_DEF.ObjData_i[6].InPathAtCurrentPosition autosar_swc_aeb_rtARID_DEF.ObjData_i[6].PredictionValid autosar_swc_aeb_rtARID_DEF.ObjData_i[6].Idn /end REF_MEASUREMENT
/end GROUP
/begin GROUP autosar_swc_aeb_rtARID_DEF.ObjData_i[6].BoundingBox ""
 /begin REF_MEASUREMENT autosar_swc_aeb_rtARID_DEF.ObjData_i[6].BoundingBox.LengthSideLat autosar_swc_aeb_rtARID_DEF.ObjData_i[6].BoundingBox.LengthSideLgt autosar_swc_aeb_rtARID_DEF.ObjData_i[6].BoundingBox.SinRotation autosar_swc_aeb_rtARID_DEF.ObjData_i[6].BoundingBox.CosRotation autosar_swc_aeb_rtARID_DEF.ObjData_i[6].BoundingBox.RotationAngle /end REF_MEASUREMENT
/end GROUP
/begin GROUP autosar_swc_aeb_rtARID_DEF.ObjData_i[6].LongPredTime ""
 /begin REF_MEASUREMENT autosar_swc_aeb_rtARID_DEF.ObjData_i[6].LongPredTime.TimeToReachLgt autosar_swc_aeb_rtARID_DEF.ObjData_i[6].LongPredTime.TimeToMiddleLgt autosar_swc_aeb_rtARID_DEF.ObjData_i[6].LongPredTime.TimeToPassLgt autosar_swc_aeb_rtARID_DEF.ObjData_i[6].LongPredTime.TTMSelected autosar_swc_aeb_rtARID_DEF.ObjData_i[6].LongPredTime.InPath autosar_swc_aeb_rtARID_DEF.ObjData_i[6].LongPredTime.ObjOnCmngAndBrkg autosar_swc_aeb_rtARID_DEF.ObjData_i[6].LongPredTime.ALgt autosar_swc_aeb_rtARID_DEF.ObjData_i[6].LongPredTime.ALat autosar_swc_aeb_rtARID_DEF.ObjData_i[6].LongPredTime.A autosar_swc_aeb_rtARID_DEF.ObjData_i[6].LongPredTime.Crvt /end REF_MEASUREMENT
/end GROUP
/begin GROUP autosar_swc_aeb_rtARID_DEF.ObjData_i[6].MotionType ""
 /begin REF_MEASUREMENT autosar_swc_aeb_rtARID_DEF.ObjData_i[6].MotionType.Stationary autosar_swc_aeb_rtARID_DEF.ObjData_i[6].MotionType.MovingOncoming autosar_swc_aeb_rtARID_DEF.ObjData_i[6].MotionType.ParallellVehicleLongPred autosar_swc_aeb_rtARID_DEF.ObjData_i[6].MotionType.ParallellVehicleShortPred autosar_swc_aeb_rtARID_DEF.ObjData_i[6].MotionType.ObjectIsVehicle autosar_swc_aeb_rtARID_DEF.ObjData_i[6].MotionType.ObjectIsMotorVehicle autosar_swc_aeb_rtARID_DEF.ObjData_i[6].MotionType.CurvedMotion autosar_swc_aeb_rtARID_DEF.ObjData_i[6].MotionType.SideIsClosest autosar_swc_aeb_rtARID_DEF.ObjData_i[6].MotionType.AbsHeading /end REF_MEASUREMENT
/end GROUP
/begin GROUP autosar_swc_aeb_rtARID_DEF.ObjData_i[6].Offsets ""
 /begin REF_MEASUREMENT autosar_swc_aeb_rtARID_DEF.ObjData_i[6].Offsets.OffsLgtLongPred autosar_swc_aeb_rtARID_DEF.ObjData_i[6].Offsets.OffsLatLongPred autosar_swc_aeb_rtARID_DEF.ObjData_i[6].Offsets.OffsLgtShortPred autosar_swc_aeb_rtARID_DEF.ObjData_i[6].Offsets.OffsLatShortPred autosar_swc_aeb_rtARID_DEF.ObjData_i[6].Offsets.OffsLatManoeuvre autosar_swc_aeb_rtARID_DEF.ObjData_i[6].Offsets.OffsLatInPathPrimaryTarget autosar_swc_aeb_rtARID_DEF.ObjData_i[6].Offsets.OffsLatInPathCloseEdge autosar_swc_aeb_rtARID_DEF.ObjData_i[6].Offsets.OffsLatInPathFarEdge autosar_swc_aeb_rtARID_DEF.ObjData_i[6].Offsets.OffsLatIntersection autosar_swc_aeb_rtARID_DEF.ObjData_i[6].Offsets.OffsLatMplTar /end REF_MEASUREMENT
/end GROUP
/begin GROUP autosar_swc_aeb_rtARID_DEF.ObjData_i[6].ShortPredTime ""
 /begin REF_MEASUREMENT autosar_swc_aeb_rtARID_DEF.ObjData_i[6].ShortPredTime.TimeToReachLgt autosar_swc_aeb_rtARID_DEF.ObjData_i[6].ShortPredTime.TimeToMiddleLgt autosar_swc_aeb_rtARID_DEF.ObjData_i[6].ShortPredTime.TimeToPassLgt autosar_swc_aeb_rtARID_DEF.ObjData_i[6].ShortPredTime.TTMSelected autosar_swc_aeb_rtARID_DEF.ObjData_i[6].ShortPredTime.InPath autosar_swc_aeb_rtARID_DEF.ObjData_i[6].ShortPredTime.ObjOnCmngAndBrkg autosar_swc_aeb_rtARID_DEF.ObjData_i[6].ShortPredTime.ALgt autosar_swc_aeb_rtARID_DEF.ObjData_i[6].ShortPredTime.ALat autosar_swc_aeb_rtARID_DEF.ObjData_i[6].ShortPredTime.A autosar_swc_aeb_rtARID_DEF.ObjData_i[6].ShortPredTime.Crvt /end REF_MEASUREMENT
/end GROUP
/begin GROUP autosar_swc_aeb_rtARID_DEF.ObjData_i[7] ""
 /begin SUB_GROUP autosar_swc_aeb_rtARID_DEF.ObjData_i[7].MotionType autosar_swc_aeb_rtARID_DEF.ObjData_i[7].BoundingBox autosar_swc_aeb_rtARID_DEF.ObjData_i[7].Offsets autosar_swc_aeb_rtARID_DEF.ObjData_i[7].LongPredTime autosar_swc_aeb_rtARID_DEF.ObjData_i[7].ShortPredTime /end SUB_GROUP
 /begin REF_MEASUREMENT autosar_swc_aeb_rtARID_DEF.ObjData_i[7].InPathAtCurrentPosition autosar_swc_aeb_rtARID_DEF.ObjData_i[7].PredictionValid autosar_swc_aeb_rtARID_DEF.ObjData_i[7].Idn /end REF_MEASUREMENT
/end GROUP
/begin GROUP autosar_swc_aeb_rtARID_DEF.ObjData_i[7].BoundingBox ""
 /begin REF_MEASUREMENT autosar_swc_aeb_rtARID_DEF.ObjData_i[7].BoundingBox.LengthSideLat autosar_swc_aeb_rtARID_DEF.ObjData_i[7].BoundingBox.LengthSideLgt autosar_swc_aeb_rtARID_DEF.ObjData_i[7].BoundingBox.SinRotation autosar_swc_aeb_rtARID_DEF.ObjData_i[7].BoundingBox.CosRotation autosar_swc_aeb_rtARID_DEF.ObjData_i[7].BoundingBox.RotationAngle /end REF_MEASUREMENT
/end GROUP
/begin GROUP autosar_swc_aeb_rtARID_DEF.ObjData_i[7].LongPredTime ""
 /begin REF_MEASUREMENT autosar_swc_aeb_rtARID_DEF.ObjData_i[7].LongPredTime.TimeToReachLgt autosar_swc_aeb_rtARID_DEF.ObjData_i[7].LongPredTime.TimeToMiddleLgt autosar_swc_aeb_rtARID_DEF.ObjData_i[7].LongPredTime.TimeToPassLgt autosar_swc_aeb_rtARID_DEF.ObjData_i[7].LongPredTime.TTMSelected autosar_swc_aeb_rtARID_DEF.ObjData_i[7].LongPredTime.InPath autosar_swc_aeb_rtARID_DEF.ObjData_i[7].LongPredTime.ObjOnCmngAndBrkg autosar_swc_aeb_rtARID_DEF.ObjData_i[7].LongPredTime.ALgt autosar_swc_aeb_rtARID_DEF.ObjData_i[7].LongPredTime.ALat autosar_swc_aeb_rtARID_DEF.ObjData_i[7].LongPredTime.A autosar_swc_aeb_rtARID_DEF.ObjData_i[7].LongPredTime.Crvt /end REF_MEASUREMENT
/end GROUP
/begin GROUP autosar_swc_aeb_rtARID_DEF.ObjData_i[7].MotionType ""
 /begin REF_MEASUREMENT autosar_swc_aeb_rtARID_DEF.ObjData_i[7].MotionType.Stationary autosar_swc_aeb_rtARID_DEF.ObjData_i[7].MotionType.MovingOncoming autosar_swc_aeb_rtARID_DEF.ObjData_i[7].MotionType.ParallellVehicleLongPred autosar_swc_aeb_rtARID_DEF.ObjData_i[7].MotionType.ParallellVehicleShortPred autosar_swc_aeb_rtARID_DEF.ObjData_i[7].MotionType.ObjectIsVehicle autosar_swc_aeb_rtARID_DEF.ObjData_i[7].MotionType.ObjectIsMotorVehicle autosar_swc_aeb_rtARID_DEF.ObjData_i[7].MotionType.CurvedMotion autosar_swc_aeb_rtARID_DEF.ObjData_i[7].MotionType.SideIsClosest autosar_swc_aeb_rtARID_DEF.ObjData_i[7].MotionType.AbsHeading /end REF_MEASUREMENT
/end GROUP
/begin GROUP autosar_swc_aeb_rtARID_DEF.ObjData_i[7].Offsets ""
 /begin REF_MEASUREMENT autosar_swc_aeb_rtARID_DEF.ObjData_i[7].Offsets.OffsLgtLongPred autosar_swc_aeb_rtARID_DEF.ObjData_i[7].Offsets.OffsLatLongPred autosar_swc_aeb_rtARID_DEF.ObjData_i[7].Offsets.OffsLgtShortPred autosar_swc_aeb_rtARID_DEF.ObjData_i[7].Offsets.OffsLatShortPred autosar_swc_aeb_rtARID_DEF.ObjData_i[7].Offsets.OffsLatManoeuvre autosar_swc_aeb_rtARID_DEF.ObjData_i[7].Offsets.OffsLatInPathPrimaryTarget autosar_swc_aeb_rtARID_DEF.ObjData_i[7].Offsets.OffsLatInPathCloseEdge autosar_swc_aeb_rtARID_DEF.ObjData_i[7].Offsets.OffsLatInPathFarEdge autosar_swc_aeb_rtARID_DEF.ObjData_i[7].Offsets.OffsLatIntersection autosar_swc_aeb_rtARID_DEF.ObjData_i[7].Offsets.OffsLatMplTar /end REF_MEASUREMENT
/end GROUP
/begin GROUP autosar_swc_aeb_rtARID_DEF.ObjData_i[7].ShortPredTime ""
 /begin REF_MEASUREMENT autosar_swc_aeb_rtARID_DEF.ObjData_i[7].ShortPredTime.TimeToReachLgt autosar_swc_aeb_rtARID_DEF.ObjData_i[7].ShortPredTime.TimeToMiddleLgt autosar_swc_aeb_rtARID_DEF.ObjData_i[7].ShortPredTime.TimeToPassLgt autosar_swc_aeb_rtARID_DEF.ObjData_i[7].ShortPredTime.TTMSelected autosar_swc_aeb_rtARID_DEF.ObjData_i[7].ShortPredTime.InPath autosar_swc_aeb_rtARID_DEF.ObjData_i[7].ShortPredTime.ObjOnCmngAndBrkg autosar_swc_aeb_rtARID_DEF.ObjData_i[7].ShortPredTime.ALgt autosar_swc_aeb_rtARID_DEF.ObjData_i[7].ShortPredTime.ALat autosar_swc_aeb_rtARID_DEF.ObjData_i[7].ShortPredTime.A autosar_swc_aeb_rtARID_DEF.ObjData_i[7].ShortPredTime.Crvt /end REF_MEASUREMENT
/end GROUP
/begin GROUP autosar_swc_aeb_rtARID_DEF.ObjData_i[8] ""
 /begin SUB_GROUP autosar_swc_aeb_rtARID_DEF.ObjData_i[8].MotionType autosar_swc_aeb_rtARID_DEF.ObjData_i[8].BoundingBox autosar_swc_aeb_rtARID_DEF.ObjData_i[8].Offsets autosar_swc_aeb_rtARID_DEF.ObjData_i[8].LongPredTime autosar_swc_aeb_rtARID_DEF.ObjData_i[8].ShortPredTime /end SUB_GROUP
 /begin REF_MEASUREMENT autosar_swc_aeb_rtARID_DEF.ObjData_i[8].InPathAtCurrentPosition autosar_swc_aeb_rtARID_DEF.ObjData_i[8].PredictionValid autosar_swc_aeb_rtARID_DEF.ObjData_i[8].Idn /end REF_MEASUREMENT
/end GROUP
/begin GROUP autosar_swc_aeb_rtARID_DEF.ObjData_i[8].BoundingBox ""
 /begin REF_MEASUREMENT autosar_swc_aeb_rtARID_DEF.ObjData_i[8].BoundingBox.LengthSideLat autosar_swc_aeb_rtARID_DEF.ObjData_i[8].BoundingBox.LengthSideLgt autosar_swc_aeb_rtARID_DEF.ObjData_i[8].BoundingBox.SinRotation autosar_swc_aeb_rtARID_DEF.ObjData_i[8].BoundingBox.CosRotation autosar_swc_aeb_rtARID_DEF.ObjData_i[8].BoundingBox.RotationAngle /end REF_MEASUREMENT
/end GROUP
/begin GROUP autosar_swc_aeb_rtARID_DEF.ObjData_i[8].LongPredTime ""
 /begin REF_MEASUREMENT autosar_swc_aeb_rtARID_DEF.ObjData_i[8].LongPredTime.TimeToReachLgt autosar_swc_aeb_rtARID_DEF.ObjData_i[8].LongPredTime.TimeToMiddleLgt autosar_swc_aeb_rtARID_DEF.ObjData_i[8].LongPredTime.TimeToPassLgt autosar_swc_aeb_rtARID_DEF.ObjData_i[8].LongPredTime.TTMSelected autosar_swc_aeb_rtARID_DEF.ObjData_i[8].LongPredTime.InPath autosar_swc_aeb_rtARID_DEF.ObjData_i[8].LongPredTime.ObjOnCmngAndBrkg autosar_swc_aeb_rtARID_DEF.ObjData_i[8].LongPredTime.ALgt autosar_swc_aeb_rtARID_DEF.ObjData_i[8].LongPredTime.ALat autosar_swc_aeb_rtARID_DEF.ObjData_i[8].LongPredTime.A autosar_swc_aeb_rtARID_DEF.ObjData_i[8].LongPredTime.Crvt /end REF_MEASUREMENT
/end GROUP
/begin GROUP autosar_swc_aeb_rtARID_DEF.ObjData_i[8].MotionType ""
 /begin REF_MEASUREMENT autosar_swc_aeb_rtARID_DEF.ObjData_i[8].MotionType.Stationary autosar_swc_aeb_rtARID_DEF.ObjData_i[8].MotionType.MovingOncoming autosar_swc_aeb_rtARID_DEF.ObjData_i[8].MotionType.ParallellVehicleLongPred autosar_swc_aeb_rtARID_DEF.ObjData_i[8].MotionType.ParallellVehicleShortPred autosar_swc_aeb_rtARID_DEF.ObjData_i[8].MotionType.ObjectIsVehicle autosar_swc_aeb_rtARID_DEF.ObjData_i[8].MotionType.ObjectIsMotorVehicle autosar_swc_aeb_rtARID_DEF.ObjData_i[8].MotionType.CurvedMotion autosar_swc_aeb_rtARID_DEF.ObjData_i[8].MotionType.SideIsClosest autosar_swc_aeb_rtARID_DEF.ObjData_i[8].MotionType.AbsHeading /end REF_MEASUREMENT
/end GROUP
/begin GROUP autosar_swc_aeb_rtARID_DEF.ObjData_i[8].Offsets ""
 /begin REF_MEASUREMENT autosar_swc_aeb_rtARID_DEF.ObjData_i[8].Offsets.OffsLgtLongPred autosar_swc_aeb_rtARID_DEF.ObjData_i[8].Offsets.OffsLatLongPred autosar_swc_aeb_rtARID_DEF.ObjData_i[8].Offsets.OffsLgtShortPred autosar_swc_aeb_rtARID_DEF.ObjData_i[8].Offsets.OffsLatShortPred autosar_swc_aeb_rtARID_DEF.ObjData_i[8].Offsets.OffsLatManoeuvre autosar_swc_aeb_rtARID_DEF.ObjData_i[8].Offsets.OffsLatInPathPrimaryTarget autosar_swc_aeb_rtARID_DEF.ObjData_i[8].Offsets.OffsLatInPathCloseEdge autosar_swc_aeb_rtARID_DEF.ObjData_i[8].Offsets.OffsLatInPathFarEdge autosar_swc_aeb_rtARID_DEF.ObjData_i[8].Offsets.OffsLatIntersection autosar_swc_aeb_rtARID_DEF.ObjData_i[8].Offsets.OffsLatMplTar /end REF_MEASUREMENT
/end GROUP
/begin GROUP autosar_swc_aeb_rtARID_DEF.ObjData_i[8].ShortPredTime ""
 /begin REF_MEASUREMENT autosar_swc_aeb_rtARID_DEF.ObjData_i[8].ShortPredTime.TimeToReachLgt autosar_swc_aeb_rtARID_DEF.ObjData_i[8].ShortPredTime.TimeToMiddleLgt autosar_swc_aeb_rtARID_DEF.ObjData_i[8].ShortPredTime.TimeToPassLgt autosar_swc_aeb_rtARID_DEF.ObjData_i[8].ShortPredTime.TTMSelected autosar_swc_aeb_rtARID_DEF.ObjData_i[8].ShortPredTime.InPath autosar_swc_aeb_rtARID_DEF.ObjData_i[8].ShortPredTime.ObjOnCmngAndBrkg autosar_swc_aeb_rtARID_DEF.ObjData_i[8].ShortPredTime.ALgt autosar_swc_aeb_rtARID_DEF.ObjData_i[8].ShortPredTime.ALat autosar_swc_aeb_rtARID_DEF.ObjData_i[8].ShortPredTime.A autosar_swc_aeb_rtARID_DEF.ObjData_i[8].ShortPredTime.Crvt /end REF_MEASUREMENT
/end GROUP
/begin GROUP autosar_swc_aeb_rtARID_DEF.ObjData_i[9] ""
 /begin SUB_GROUP autosar_swc_aeb_rtARID_DEF.ObjData_i[9].MotionType autosar_swc_aeb_rtARID_DEF.ObjData_i[9].BoundingBox autosar_swc_aeb_rtARID_DEF.ObjData_i[9].Offsets autosar_swc_aeb_rtARID_DEF.ObjData_i[9].LongPredTime autosar_swc_aeb_rtARID_DEF.ObjData_i[9].ShortPredTime /end SUB_GROUP
 /begin REF_MEASUREMENT autosar_swc_aeb_rtARID_DEF.ObjData_i[9].InPathAtCurrentPosition autosar_swc_aeb_rtARID_DEF.ObjData_i[9].PredictionValid autosar_swc_aeb_rtARID_DEF.ObjData_i[9].Idn /end REF_MEASUREMENT
/end GROUP
/begin GROUP autosar_swc_aeb_rtARID_DEF.ObjData_i[9].BoundingBox ""
 /begin REF_MEASUREMENT autosar_swc_aeb_rtARID_DEF.ObjData_i[9].BoundingBox.LengthSideLat autosar_swc_aeb_rtARID_DEF.ObjData_i[9].BoundingBox.LengthSideLgt autosar_swc_aeb_rtARID_DEF.ObjData_i[9].BoundingBox.SinRotation autosar_swc_aeb_rtARID_DEF.ObjData_i[9].BoundingBox.CosRotation autosar_swc_aeb_rtARID_DEF.ObjData_i[9].BoundingBox.RotationAngle /end REF_MEASUREMENT
/end GROUP
/begin GROUP autosar_swc_aeb_rtARID_DEF.ObjData_i[9].LongPredTime ""
 /begin REF_MEASUREMENT autosar_swc_aeb_rtARID_DEF.ObjData_i[9].LongPredTime.TimeToReachLgt autosar_swc_aeb_rtARID_DEF.ObjData_i[9].LongPredTime.TimeToMiddleLgt autosar_swc_aeb_rtARID_DEF.ObjData_i[9].LongPredTime.TimeToPassLgt autosar_swc_aeb_rtARID_DEF.ObjData_i[9].LongPredTime.TTMSelected autosar_swc_aeb_rtARID_DEF.ObjData_i[9].LongPredTime.InPath autosar_swc_aeb_rtARID_DEF.ObjData_i[9].LongPredTime.ObjOnCmngAndBrkg autosar_swc_aeb_rtARID_DEF.ObjData_i[9].LongPredTime.ALgt autosar_swc_aeb_rtARID_DEF.ObjData_i[9].LongPredTime.ALat autosar_swc_aeb_rtARID_DEF.ObjData_i[9].LongPredTime.A autosar_swc_aeb_rtARID_DEF.ObjData_i[9].LongPredTime.Crvt /end REF_MEASUREMENT
/end GROUP
/begin GROUP autosar_swc_aeb_rtARID_DEF.ObjData_i[9].MotionType ""
 /begin REF_MEASUREMENT autosar_swc_aeb_rtARID_DEF.ObjData_i[9].MotionType.Stationary autosar_swc_aeb_rtARID_DEF.ObjData_i[9].MotionType.MovingOncoming autosar_swc_aeb_rtARID_DEF.ObjData_i[9].MotionType.ParallellVehicleLongPred autosar_swc_aeb_rtARID_DEF.ObjData_i[9].MotionType.ParallellVehicleShortPred autosar_swc_aeb_rtARID_DEF.ObjData_i[9].MotionType.ObjectIsVehicle autosar_swc_aeb_rtARID_DEF.ObjData_i[9].MotionType.ObjectIsMotorVehicle autosar_swc_aeb_rtARID_DEF.ObjData_i[9].MotionType.CurvedMotion autosar_swc_aeb_rtARID_DEF.ObjData_i[9].MotionType.SideIsClosest autosar_swc_aeb_rtARID_DEF.ObjData_i[9].MotionType.AbsHeading /end REF_MEASUREMENT
/end GROUP
/begin GROUP autosar_swc_aeb_rtARID_DEF.ObjData_i[9].Offsets ""
 /begin REF_MEASUREMENT autosar_swc_aeb_rtARID_DEF.ObjData_i[9].Offsets.OffsLgtLongPred autosar_swc_aeb_rtARID_DEF.ObjData_i[9].Offsets.OffsLatLongPred autosar_swc_aeb_rtARID_DEF.ObjData_i[9].Offsets.OffsLgtShortPred autosar_swc_aeb_rtARID_DEF.ObjData_i[9].Offsets.OffsLatShortPred autosar_swc_aeb_rtARID_DEF.ObjData_i[9].Offsets.OffsLatManoeuvre autosar_swc_aeb_rtARID_DEF.ObjData_i[9].Offsets.OffsLatInPathPrimaryTarget autosar_swc_aeb_rtARID_DEF.ObjData_i[9].Offsets.OffsLatInPathCloseEdge autosar_swc_aeb_rtARID_DEF.ObjData_i[9].Offsets.OffsLatInPathFarEdge autosar_swc_aeb_rtARID_DEF.ObjData_i[9].Offsets.OffsLatIntersection autosar_swc_aeb_rtARID_DEF.ObjData_i[9].Offsets.OffsLatMplTar /end REF_MEASUREMENT
/end GROUP
/begin GROUP autosar_swc_aeb_rtARID_DEF.ObjData_i[9].ShortPredTime ""
 /begin REF_MEASUREMENT autosar_swc_aeb_rtARID_DEF.ObjData_i[9].ShortPredTime.TimeToReachLgt autosar_swc_aeb_rtARID_DEF.ObjData_i[9].ShortPredTime.TimeToMiddleLgt autosar_swc_aeb_rtARID_DEF.ObjData_i[9].ShortPredTime.TimeToPassLgt autosar_swc_aeb_rtARID_DEF.ObjData_i[9].ShortPredTime.TTMSelected autosar_swc_aeb_rtARID_DEF.ObjData_i[9].ShortPredTime.InPath autosar_swc_aeb_rtARID_DEF.ObjData_i[9].ShortPredTime.ObjOnCmngAndBrkg autosar_swc_aeb_rtARID_DEF.ObjData_i[9].ShortPredTime.ALgt autosar_swc_aeb_rtARID_DEF.ObjData_i[9].ShortPredTime.ALat autosar_swc_aeb_rtARID_DEF.ObjData_i[9].ShortPredTime.A autosar_swc_aeb_rtARID_DEF.ObjData_i[9].ShortPredTime.Crvt /end REF_MEASUREMENT
/end GROUP
/begin GROUP autosar_swc_aeb_rtARID_DEF.ObjPrimaryTarget ""
 /begin SUB_GROUP autosar_swc_aeb_rtARID_DEF.ObjPrimaryTarget.Estimn autosar_swc_aeb_rtARID_DEF.ObjPrimaryTarget.Info autosar_swc_aeb_rtARID_DEF.ObjPrimaryTarget.Ppty /end SUB_GROUP
/end GROUP
/begin GROUP autosar_swc_aeb_rtARID_DEF.ObjPrimaryTarget.Estimn ""
 /begin REF_MEASUREMENT autosar_swc_aeb_rtARID_DEF.ObjPrimaryTarget.Estimn.PosnLgt autosar_swc_aeb_rtARID_DEF.ObjPrimaryTarget.Estimn.PosnLat autosar_swc_aeb_rtARID_DEF.ObjPrimaryTarget.Estimn.Spd autosar_swc_aeb_rtARID_DEF.ObjPrimaryTarget.Estimn.VLgt autosar_swc_aeb_rtARID_DEF.ObjPrimaryTarget.Estimn.VLat autosar_swc_aeb_rtARID_DEF.ObjPrimaryTarget.Estimn.A autosar_swc_aeb_rtARID_DEF.ObjPrimaryTarget.Estimn.ALgt autosar_swc_aeb_rtARID_DEF.ObjPrimaryTarget.Estimn.ALat autosar_swc_aeb_rtARID_DEF.ObjPrimaryTarget.Estimn.AgDir autosar_swc_aeb_rtARID_DEF.ObjPrimaryTarget.Estimn.Crvt /end REF_MEASUREMENT
/end GROUP
/begin GROUP autosar_swc_aeb_rtARID_DEF.ObjPrimaryTarget.Info ""
 /begin REF_MEASUREMENT autosar_swc_aeb_rtARID_DEF.ObjPrimaryTarget.Info.Typ autosar_swc_aeb_rtARID_DEF.ObjPrimaryTarget.Info.Width autosar_swc_aeb_rtARID_DEF.ObjPrimaryTarget.Info.Length autosar_swc_aeb_rtARID_DEF.ObjPrimaryTarget.Info.Hei autosar_swc_aeb_rtARID_DEF.ObjPrimaryTarget.Info.SideNear autosar_swc_aeb_rtARID_DEF.ObjPrimaryTarget.Info.IndcrTurn autosar_swc_aeb_rtARID_DEF.ObjPrimaryTarget.Info.IndcrBrkLi autosar_swc_aeb_rtARID_DEF.ObjPrimaryTarget.Info.IndcrHzrdLi autosar_swc_aeb_rtARID_DEF.ObjPrimaryTarget.Info.MtnPat autosar_swc_aeb_rtARID_DEF.ObjPrimaryTarget.Info.MtnPatHist autosar_swc_aeb_rtARID_DEF.ObjPrimaryTarget.Info.DstLatFromMidOfLaneSelf /end REF_MEASUREMENT
/end GROUP
/begin GROUP autosar_swc_aeb_rtARID_DEF.ObjPrimaryTarget.Ppty ""
 /begin REF_MEASUREMENT autosar_swc_aeb_rtARID_DEF.ObjPrimaryTarget.Ppty.Idn autosar_swc_aeb_rtARID_DEF.ObjPrimaryTarget.Ppty.VisnId autosar_swc_aeb_rtARID_DEF.ObjPrimaryTarget.Ppty.Sts autosar_swc_aeb_rtARID_DEF.ObjPrimaryTarget.Ppty.MdlOfMtn autosar_swc_aeb_rtARID_DEF.ObjPrimaryTarget.Ppty.TrfcSceno autosar_swc_aeb_rtARID_DEF.ObjPrimaryTarget.Ppty.CllsnMtgtnByBrkgPrimQly autosar_swc_aeb_rtARID_DEF.ObjPrimaryTarget.Ppty.CllsnMtgtnByBrkgSecQly autosar_swc_aeb_rtARID_DEF.ObjPrimaryTarget.Ppty.CllsnWarnFwdQly autosar_swc_aeb_rtARID_DEF.ObjPrimaryTarget.Ppty.TrfcJamAssiQly autosar_swc_aeb_rtARID_DEF.ObjPrimaryTarget.Ppty.DstLatFromMidOfLaneSelfQly autosar_swc_aeb_rtARID_DEF.ObjPrimaryTarget.Ppty.EmgyLaneKeepAidPosnQly autosar_swc_aeb_rtARID_DEF.ObjPrimaryTarget.Ppty.PosnLgtStdDe autosar_swc_aeb_rtARID_DEF.ObjPrimaryTarget.Ppty.PosnLatStdDe autosar_swc_aeb_rtARID_DEF.ObjPrimaryTarget.Ppty.AgDirStdDe autosar_swc_aeb_rtARID_DEF.ObjPrimaryTarget.Ppty.SpdStdDe autosar_swc_aeb_rtARID_DEF.ObjPrimaryTarget.Ppty.AStdDe autosar_swc_aeb_rtARID_DEF.ObjPrimaryTarget.Ppty.FusnSrc autosar_swc_aeb_rtARID_DEF.ObjPrimaryTarget.Ppty.Object_Age /end REF_MEASUREMENT
/end GROUP
/begin GROUP autosar_swc_aeb_rtARID_DEF.ObjPrimaryTarget_b ""
 /begin SUB_GROUP autosar_swc_aeb_rtARID_DEF.ObjPrimaryTarget_b.Estimn autosar_swc_aeb_rtARID_DEF.ObjPrimaryTarget_b.Info autosar_swc_aeb_rtARID_DEF.ObjPrimaryTarget_b.Ppty /end SUB_GROUP
/end GROUP
/begin GROUP autosar_swc_aeb_rtARID_DEF.ObjPrimaryTarget_b.Estimn ""
 /begin REF_MEASUREMENT autosar_swc_aeb_rtARID_DEF.ObjPrimaryTarget_b.Estimn.PosnLgt autosar_swc_aeb_rtARID_DEF.ObjPrimaryTarget_b.Estimn.PosnLat autosar_swc_aeb_rtARID_DEF.ObjPrimaryTarget_b.Estimn.Spd autosar_swc_aeb_rtARID_DEF.ObjPrimaryTarget_b.Estimn.VLgt autosar_swc_aeb_rtARID_DEF.ObjPrimaryTarget_b.Estimn.VLat autosar_swc_aeb_rtARID_DEF.ObjPrimaryTarget_b.Estimn.A autosar_swc_aeb_rtARID_DEF.ObjPrimaryTarget_b.Estimn.ALgt autosar_swc_aeb_rtARID_DEF.ObjPrimaryTarget_b.Estimn.ALat autosar_swc_aeb_rtARID_DEF.ObjPrimaryTarget_b.Estimn.AgDir autosar_swc_aeb_rtARID_DEF.ObjPrimaryTarget_b.Estimn.Crvt /end REF_MEASUREMENT
/end GROUP
/begin GROUP autosar_swc_aeb_rtARID_DEF.ObjPrimaryTarget_b.Info ""
 /begin REF_MEASUREMENT autosar_swc_aeb_rtARID_DEF.ObjPrimaryTarget_b.Info.Typ autosar_swc_aeb_rtARID_DEF.ObjPrimaryTarget_b.Info.Width autosar_swc_aeb_rtARID_DEF.ObjPrimaryTarget_b.Info.Length autosar_swc_aeb_rtARID_DEF.ObjPrimaryTarget_b.Info.Hei autosar_swc_aeb_rtARID_DEF.ObjPrimaryTarget_b.Info.SideNear autosar_swc_aeb_rtARID_DEF.ObjPrimaryTarget_b.Info.IndcrTurn autosar_swc_aeb_rtARID_DEF.ObjPrimaryTarget_b.Info.IndcrBrkLi autosar_swc_aeb_rtARID_DEF.ObjPrimaryTarget_b.Info.IndcrHzrdLi autosar_swc_aeb_rtARID_DEF.ObjPrimaryTarget_b.Info.MtnPat autosar_swc_aeb_rtARID_DEF.ObjPrimaryTarget_b.Info.MtnPatHist autosar_swc_aeb_rtARID_DEF.ObjPrimaryTarget_b.Info.DstLatFromMidOfLaneSelf /end REF_MEASUREMENT
/end GROUP
/begin GROUP autosar_swc_aeb_rtARID_DEF.ObjPrimaryTarget_b.Ppty ""
 /begin REF_MEASUREMENT autosar_swc_aeb_rtARID_DEF.ObjPrimaryTarget_b.Ppty.Idn autosar_swc_aeb_rtARID_DEF.ObjPrimaryTarget_b.Ppty.VisnId autosar_swc_aeb_rtARID_DEF.ObjPrimaryTarget_b.Ppty.Sts autosar_swc_aeb_rtARID_DEF.ObjPrimaryTarget_b.Ppty.MdlOfMtn autosar_swc_aeb_rtARID_DEF.ObjPrimaryTarget_b.Ppty.TrfcSceno autosar_swc_aeb_rtARID_DEF.ObjPrimaryTarget_b.Ppty.CllsnMtgtnByBrkgPrimQly autosar_swc_aeb_rtARID_DEF.ObjPrimaryTarget_b.Ppty.CllsnMtgtnByBrkgSecQly autosar_swc_aeb_rtARID_DEF.ObjPrimaryTarget_b.Ppty.CllsnWarnFwdQly autosar_swc_aeb_rtARID_DEF.ObjPrimaryTarget_b.Ppty.TrfcJamAssiQly autosar_swc_aeb_rtARID_DEF.ObjPrimaryTarget_b.Ppty.DstLatFromMidOfLaneSelfQly autosar_swc_aeb_rtARID_DEF.ObjPrimaryTarget_b.Ppty.EmgyLaneKeepAidPosnQly autosar_swc_aeb_rtARID_DEF.ObjPrimaryTarget_b.Ppty.PosnLgtStdDe autosar_swc_aeb_rtARID_DEF.ObjPrimaryTarget_b.Ppty.PosnLatStdDe autosar_swc_aeb_rtARID_DEF.ObjPrimaryTarget_b.Ppty.AgDirStdDe autosar_swc_aeb_rtARID_DEF.ObjPrimaryTarget_b.Ppty.SpdStdDe autosar_swc_aeb_rtARID_DEF.ObjPrimaryTarget_b.Ppty.AStdDe autosar_swc_aeb_rtARID_DEF.ObjPrimaryTarget_b.Ppty.FusnSrc autosar_swc_aeb_rtARID_DEF.ObjPrimaryTarget_b.Ppty.Object_Age /end REF_MEASUREMENT
/end GROUP
/begin GROUP autosar_swc_aeb_rtARID_DEF.PahEstimn[0] ""
 /begin REF_MEASUREMENT autosar_swc_aeb_rtARID_DEF.PahEstimn[0].CtrlAryLat autosar_swc_aeb_rtARID_DEF.PahEstimn[0].CtrlAryLgt autosar_swc_aeb_rtARID_DEF.PahEstimn[0].TiAry /end REF_MEASUREMENT
/end GROUP
/begin GROUP autosar_swc_aeb_rtARID_DEF.PahEstimn[1] ""
 /begin REF_MEASUREMENT autosar_swc_aeb_rtARID_DEF.PahEstimn[1].CtrlAryLat autosar_swc_aeb_rtARID_DEF.PahEstimn[1].CtrlAryLgt autosar_swc_aeb_rtARID_DEF.PahEstimn[1].TiAry /end REF_MEASUREMENT
/end GROUP
/begin GROUP autosar_swc_aeb_rtARID_DEF.PahEstimn[2] ""
 /begin REF_MEASUREMENT autosar_swc_aeb_rtARID_DEF.PahEstimn[2].CtrlAryLat autosar_swc_aeb_rtARID_DEF.PahEstimn[2].CtrlAryLgt autosar_swc_aeb_rtARID_DEF.PahEstimn[2].TiAry /end REF_MEASUREMENT
/end GROUP
/begin GROUP autosar_swc_aeb_rtARID_DEF.PahEstimn[3] ""
 /begin REF_MEASUREMENT autosar_swc_aeb_rtARID_DEF.PahEstimn[3].CtrlAryLat autosar_swc_aeb_rtARID_DEF.PahEstimn[3].CtrlAryLgt autosar_swc_aeb_rtARID_DEF.PahEstimn[3].TiAry /end REF_MEASUREMENT
/end GROUP
/begin GROUP autosar_swc_aeb_rtARID_DEF.PahEstimn_g[0] ""
 /begin REF_MEASUREMENT autosar_swc_aeb_rtARID_DEF.PahEstimn_g[0].CtrlAryLat autosar_swc_aeb_rtARID_DEF.PahEstimn_g[0].CtrlAryLgt autosar_swc_aeb_rtARID_DEF.PahEstimn_g[0].TiAry /end REF_MEASUREMENT
/end GROUP
/begin GROUP autosar_swc_aeb_rtARID_DEF.PahEstimn_g[1] ""
 /begin REF_MEASUREMENT autosar_swc_aeb_rtARID_DEF.PahEstimn_g[1].CtrlAryLat autosar_swc_aeb_rtARID_DEF.PahEstimn_g[1].CtrlAryLgt autosar_swc_aeb_rtARID_DEF.PahEstimn_g[1].TiAry /end REF_MEASUREMENT
/end GROUP
/begin GROUP autosar_swc_aeb_rtARID_DEF.PahEstimn_g[2] ""
 /begin REF_MEASUREMENT autosar_swc_aeb_rtARID_DEF.PahEstimn_g[2].CtrlAryLat autosar_swc_aeb_rtARID_DEF.PahEstimn_g[2].CtrlAryLgt autosar_swc_aeb_rtARID_DEF.PahEstimn_g[2].TiAry /end REF_MEASUREMENT
/end GROUP
/begin GROUP autosar_swc_aeb_rtARID_DEF.PahEstimn_g[3] ""
 /begin REF_MEASUREMENT autosar_swc_aeb_rtARID_DEF.PahEstimn_g[3].CtrlAryLat autosar_swc_aeb_rtARID_DEF.PahEstimn_g[3].CtrlAryLgt autosar_swc_aeb_rtARID_DEF.PahEstimn_g[3].TiAry /end REF_MEASUREMENT
/end GROUP
/begin GROUP autosar_swc_aeb_rtARID_DEF.UnitDelay2_DSTATE ""
 /begin REF_MEASUREMENT autosar_swc_aeb_rtARID_DEF.UnitDelay2_DSTATE.ALatAbsltCmft autosar_swc_aeb_rtARID_DEF.UnitDelay2_DSTATE.ALatAbsltMax autosar_swc_aeb_rtARID_DEF.UnitDelay2_DSTATE.ALgtNegCmft autosar_swc_aeb_rtARID_DEF.UnitDelay2_DSTATE.ALgtNegMeasd autosar_swc_aeb_rtARID_DEF.UnitDelay2_DSTATE.ALgtNegMin autosar_swc_aeb_rtARID_DEF.UnitDelay2_DSTATE.ALgtPosCmft autosar_swc_aeb_rtARID_DEF.UnitDelay2_DSTATE.ALgtPosMax autosar_swc_aeb_rtARID_DEF.UnitDelay2_DSTATE.CrvtAbsltCmft autosar_swc_aeb_rtARID_DEF.UnitDelay2_DSTATE.CrvtAbsltMax autosar_swc_aeb_rtARID_DEF.UnitDelay2_DSTATE.CrvtRateAbsltCmft autosar_swc_aeb_rtARID_DEF.UnitDelay2_DSTATE.CrvtRateAbsltMax autosar_swc_aeb_rtARID_DEF.UnitDelay2_DSTATE.JerkLatAbsltCmft autosar_swc_aeb_rtARID_DEF.UnitDelay2_DSTATE.JerkLatAbsltMax autosar_swc_aeb_rtARID_DEF.UnitDelay2_DSTATE.JerkLgtNegCmft autosar_swc_aeb_rtARID_DEF.UnitDelay2_DSTATE.JerkLgtNegMeasd autosar_swc_aeb_rtARID_DEF.UnitDelay2_DSTATE.JerkLgtNegMin autosar_swc_aeb_rtARID_DEF.UnitDelay2_DSTATE.JerkLgtPosCmft autosar_swc_aeb_rtARID_DEF.UnitDelay2_DSTATE.JerkLgtPosMax /end REF_MEASUREMENT
/end GROUP
/begin GROUP autosar_swc_aeb_rtARID_DEF.UnitDelay3_DSTATE ""
 /begin SUB_GROUP autosar_swc_aeb_rtARID_DEF.UnitDelay3_DSTATE.MtnRqrdIntv autosar_swc_aeb_rtARID_DEF.UnitDelay3_DSTATE.PrimTarIntv /end SUB_GROUP
 /begin REF_MEASUREMENT autosar_swc_aeb_rtARID_DEF.UnitDelay3_DSTATE.ANegLgtRqrdForPrimTarWarn autosar_swc_aeb_rtARID_DEF.UnitDelay3_DSTATE.ALatRqrdMplTar autosar_swc_aeb_rtARID_DEF.UnitDelay3_DSTATE.ALatRqrdMplTarQly /end REF_MEASUREMENT
/end GROUP
/begin GROUP autosar_swc_aeb_rtARID_DEF.UnitDelay3_DSTATE.MtnRqrdIntv ""
 /begin REF_MEASUREMENT autosar_swc_aeb_rtARID_DEF.UnitDelay3_DSTATE.MtnRqrdIntv.ALatRqrd autosar_swc_aeb_rtARID_DEF.UnitDelay3_DSTATE.MtnRqrdIntv.ALatRqrdQly autosar_swc_aeb_rtARID_DEF.UnitDelay3_DSTATE.MtnRqrdIntv.APosLgtRqrd autosar_swc_aeb_rtARID_DEF.UnitDelay3_DSTATE.MtnRqrdIntv.ANegLgtRqrd autosar_swc_aeb_rtARID_DEF.UnitDelay3_DSTATE.MtnRqrdIntv.JerkNegLgtRqrd autosar_swc_aeb_rtARID_DEF.UnitDelay3_DSTATE.MtnRqrdIntv.CrvtRateRqrdLe autosar_swc_aeb_rtARID_DEF.UnitDelay3_DSTATE.MtnRqrdIntv.CrvtRateRqrdRi autosar_swc_aeb_rtARID_DEF.UnitDelay3_DSTATE.MtnRqrdIntv.CrvtRqrdLe autosar_swc_aeb_rtARID_DEF.UnitDelay3_DSTATE.MtnRqrdIntv.CrvtRqrdRi /end REF_MEASUREMENT
/end GROUP
/begin GROUP autosar_swc_aeb_rtARID_DEF.UnitDelay3_DSTATE.PrimTarIntv ""
 /begin REF_MEASUREMENT autosar_swc_aeb_rtARID_DEF.UnitDelay3_DSTATE.PrimTarIntv.ALat autosar_swc_aeb_rtARID_DEF.UnitDelay3_DSTATE.PrimTarIntv.ALgt autosar_swc_aeb_rtARID_DEF.UnitDelay3_DSTATE.PrimTarIntv.Hei autosar_swc_aeb_rtARID_DEF.UnitDelay3_DSTATE.PrimTarIntv.Crvt autosar_swc_aeb_rtARID_DEF.UnitDelay3_DSTATE.PrimTarIntv.Idn autosar_swc_aeb_rtARID_DEF.UnitDelay3_DSTATE.PrimTarIntv.MtnPat autosar_swc_aeb_rtARID_DEF.UnitDelay3_DSTATE.PrimTarIntv.MtnPatHist autosar_swc_aeb_rtARID_DEF.UnitDelay3_DSTATE.PrimTarIntv.ObjTyp autosar_swc_aeb_rtARID_DEF.UnitDelay3_DSTATE.PrimTarIntv.PosnLat autosar_swc_aeb_rtARID_DEF.UnitDelay3_DSTATE.PrimTarIntv.PosnLgt autosar_swc_aeb_rtARID_DEF.UnitDelay3_DSTATE.PrimTarIntv.QlyIntv autosar_swc_aeb_rtARID_DEF.UnitDelay3_DSTATE.PrimTarIntv.TiToCllsn autosar_swc_aeb_rtARID_DEF.UnitDelay3_DSTATE.PrimTarIntv.VisnId autosar_swc_aeb_rtARID_DEF.UnitDelay3_DSTATE.PrimTarIntv.VLat autosar_swc_aeb_rtARID_DEF.UnitDelay3_DSTATE.PrimTarIntv.VLgt autosar_swc_aeb_rtARID_DEF.UnitDelay3_DSTATE.PrimTarIntv.Width autosar_swc_aeb_rtARID_DEF.UnitDelay3_DSTATE.PrimTarIntv.PrimTarInPahNow autosar_swc_aeb_rtARID_DEF.UnitDelay3_DSTATE.PrimTarIntv.InPathPredict autosar_swc_aeb_rtARID_DEF.UnitDelay3_DSTATE.PrimTarIntv.Object_Age /end REF_MEASUREMENT
/end GROUP
/begin GROUP autosar_swc_aeb_rtARID_DEF.UnitDelay4_DSTATE ""
 /begin SUB_GROUP autosar_swc_aeb_rtARID_DEF.UnitDelay4_DSTATE.MtnRqrdWarn autosar_swc_aeb_rtARID_DEF.UnitDelay4_DSTATE.PrimTarWarn /end SUB_GROUP
 /begin REF_MEASUREMENT autosar_swc_aeb_rtARID_DEF.UnitDelay4_DSTATE.ObjALrgDetd autosar_swc_aeb_rtARID_DEF.UnitDelay4_DSTATE.ObjALrgIdn /end REF_MEASUREMENT
/end GROUP
/begin GROUP autosar_swc_aeb_rtARID_DEF.UnitDelay4_DSTATE.MtnRqrdWarn ""
 /begin REF_MEASUREMENT autosar_swc_aeb_rtARID_DEF.UnitDelay4_DSTATE.MtnRqrdWarn.ALatRqrd autosar_swc_aeb_rtARID_DEF.UnitDelay4_DSTATE.MtnRqrdWarn.ALatRqrdQly autosar_swc_aeb_rtARID_DEF.UnitDelay4_DSTATE.MtnRqrdWarn.ANegLgtRqrdForWarn autosar_swc_aeb_rtARID_DEF.UnitDelay4_DSTATE.MtnRqrdWarn.ANegLgtRqrdForIntv /end REF_MEASUREMENT
/end GROUP
/begin GROUP autosar_swc_aeb_rtARID_DEF.UnitDelay4_DSTATE.PrimTarWarn ""
 /begin REF_MEASUREMENT autosar_swc_aeb_rtARID_DEF.UnitDelay4_DSTATE.PrimTarWarn.PinionSteerAgSpd autosar_swc_aeb_rtARID_DEF.UnitDelay4_DSTATE.PrimTarWarn.ALgt autosar_swc_aeb_rtARID_DEF.UnitDelay4_DSTATE.PrimTarWarn.Hei autosar_swc_aeb_rtARID_DEF.UnitDelay4_DSTATE.PrimTarWarn.Idn autosar_swc_aeb_rtARID_DEF.UnitDelay4_DSTATE.PrimTarWarn.ObjTyp autosar_swc_aeb_rtARID_DEF.UnitDelay4_DSTATE.PrimTarWarn.PosnLat autosar_swc_aeb_rtARID_DEF.UnitDelay4_DSTATE.PrimTarWarn.PosnLgt autosar_swc_aeb_rtARID_DEF.UnitDelay4_DSTATE.PrimTarWarn.QlyWarn autosar_swc_aeb_rtARID_DEF.UnitDelay4_DSTATE.PrimTarWarn.TiToCllsn autosar_swc_aeb_rtARID_DEF.UnitDelay4_DSTATE.PrimTarWarn.VisnId autosar_swc_aeb_rtARID_DEF.UnitDelay4_DSTATE.PrimTarWarn.VLgt autosar_swc_aeb_rtARID_DEF.UnitDelay4_DSTATE.PrimTarWarn.VLat autosar_swc_aeb_rtARID_DEF.UnitDelay4_DSTATE.PrimTarWarn.Width autosar_swc_aeb_rtARID_DEF.UnitDelay4_DSTATE.PrimTarWarn.PrimTarInPahNow /end REF_MEASUREMENT
/end GROUP
/begin GROUP autosar_swc_aeb_rtARID_DEF.UnitDelay5_DSTATE ""
 /begin REF_MEASUREMENT autosar_swc_aeb_rtARID_DEF.UnitDelay5_DSTATE.DecelReq autosar_swc_aeb_rtARID_DEF.UnitDelay5_DSTATE.DamprReq autosar_swc_aeb_rtARID_DEF.UnitDelay5_DSTATE.DecelEna autosar_swc_aeb_rtARID_DEF.UnitDelay5_DSTATE.SteerAsEna autosar_swc_aeb_rtARID_DEF.UnitDelay5_DSTATE.CrsCnclReq autosar_swc_aeb_rtARID_DEF.UnitDelay5_DSTATE.StandStillReq autosar_swc_aeb_rtARID_DEF.UnitDelay5_DSTATE.BltLvl autosar_swc_aeb_rtARID_DEF.UnitDelay5_DSTATE.CllsnThreat autosar_swc_aeb_rtARID_DEF.UnitDelay5_DSTATE.SteerTqSgnReq autosar_swc_aeb_rtARID_DEF.UnitDelay5_DSTATE.SteerGainEna /end REF_MEASUREMENT
/end GROUP
/begin GROUP autosar_swc_aeb_rtARID_DEF.UnitDelay6_DSTATE ""
 /begin REF_MEASUREMENT autosar_swc_aeb_rtARID_DEF.UnitDelay6_DSTATE.DecelReq autosar_swc_aeb_rtARID_DEF.UnitDelay6_DSTATE.DecelEna autosar_swc_aeb_rtARID_DEF.UnitDelay6_DSTATE.BrkGainReq autosar_swc_aeb_rtARID_DEF.UnitDelay6_DSTATE.BrkGainMaxDecel autosar_swc_aeb_rtARID_DEF.UnitDelay6_DSTATE.BrkGainEna autosar_swc_aeb_rtARID_DEF.UnitDelay6_DSTATE.CllsnThreat autosar_swc_aeb_rtARID_DEF.UnitDelay6_DSTATE.BltLvl /end REF_MEASUREMENT
/end GROUP
/begin GROUP autosar_swc_aeb_rtARID_DEF.UnitDelay_DSTATE ""
 /begin REF_MEASUREMENT autosar_swc_aeb_rtARID_DEF.UnitDelay_DSTATE.ALatAbsltCmft autosar_swc_aeb_rtARID_DEF.UnitDelay_DSTATE.ALatAbsltMax autosar_swc_aeb_rtARID_DEF.UnitDelay_DSTATE.ALgtNegCmft autosar_swc_aeb_rtARID_DEF.UnitDelay_DSTATE.ALgtNegMeasd autosar_swc_aeb_rtARID_DEF.UnitDelay_DSTATE.ALgtNegMin autosar_swc_aeb_rtARID_DEF.UnitDelay_DSTATE.ALgtPosCmft autosar_swc_aeb_rtARID_DEF.UnitDelay_DSTATE.ALgtPosMax autosar_swc_aeb_rtARID_DEF.UnitDelay_DSTATE.CrvtAbsltCmft autosar_swc_aeb_rtARID_DEF.UnitDelay_DSTATE.CrvtAbsltMax autosar_swc_aeb_rtARID_DEF.UnitDelay_DSTATE.CrvtRateAbsltCmft autosar_swc_aeb_rtARID_DEF.UnitDelay_DSTATE.CrvtRateAbsltMax autosar_swc_aeb_rtARID_DEF.UnitDelay_DSTATE.JerkLatAbsltCmft autosar_swc_aeb_rtARID_DEF.UnitDelay_DSTATE.JerkLatAbsltMax autosar_swc_aeb_rtARID_DEF.UnitDelay_DSTATE.JerkLgtNegCmft autosar_swc_aeb_rtARID_DEF.UnitDelay_DSTATE.JerkLgtNegMeasd autosar_swc_aeb_rtARID_DEF.UnitDelay_DSTATE.JerkLgtNegMin autosar_swc_aeb_rtARID_DEF.UnitDelay_DSTATE.JerkLgtPosCmft autosar_swc_aeb_rtARID_DEF.UnitDelay_DSTATE.JerkLgtPosMax /end REF_MEASUREMENT
/end GROUP
/begin GROUP rtb_BoundingBox_fd "" /begin REF_CHARACTERISTIC /end REF_CHARACTERISTIC /end GROUP
/begin GROUP rtb_CurrentObj ""
 /begin SUB_GROUP rtb_CurrentObj.Estimn rtb_CurrentObj.Info rtb_CurrentObj.Ppty /end SUB_GROUP
/end GROUP
/begin GROUP rtb_CurrentObj.Estimn "" /begin REF_CHARACTERISTIC /end REF_CHARACTERISTIC /end GROUP
/begin GROUP rtb_CurrentObj.Info "" /begin REF_CHARACTERISTIC /end REF_CHARACTERISTIC /end GROUP
/begin GROUP rtb_CurrentObj.Ppty "" /begin REF_CHARACTERISTIC /end REF_CHARACTERISTIC /end GROUP
/begin GROUP rtb_CurrentObjData.BoundingBox "" /begin REF_CHARACTERISTIC /end REF_CHARACTERISTIC /end GROUP
/begin GROUP rtb_CurrentObjData.MotionType "" /begin REF_CHARACTERISTIC /end REF_CHARACTERISTIC /end GROUP
/begin GROUP rtb_CurrentObjData.ShortPredTime "" /begin REF_CHARACTERISTIC /end REF_CHARACTERISTIC /end GROUP
/begin GROUP rtb_CurrentObj_n ""
 /begin SUB_GROUP rtb_CurrentObj_n.Estimn rtb_CurrentObj_n.Info rtb_CurrentObj_n.Ppty /end SUB_GROUP
/end GROUP
/begin GROUP rtb_CurrentObj_n.Estimn "" /begin REF_CHARACTERISTIC /end REF_CHARACTERISTIC /end GROUP
/begin GROUP rtb_CurrentObj_n.Info "" /begin REF_CHARACTERISTIC /end REF_CHARACTERISTIC /end GROUP
/begin GROUP rtb_CurrentObj_n.Ppty "" /begin REF_CHARACTERISTIC /end REF_CHARACTERISTIC /end GROUP
/begin GROUP rtb_DynCalPrm "" /begin REF_CHARACTERISTIC /end REF_CHARACTERISTIC /end GROUP
/begin GROUP rtb_LoggingBus_n "" /begin REF_CHARACTERISTIC /end REF_CHARACTERISTIC /end GROUP
/begin GROUP rtb_PahEstimn[0] "" /begin REF_CHARACTERISTIC /end REF_CHARACTERISTIC /end GROUP
/begin GROUP rtb_PahEstimn[1] "" /begin REF_CHARACTERISTIC /end REF_CHARACTERISTIC /end GROUP
/begin GROUP rtb_PahEstimn[2] "" /begin REF_CHARACTERISTIC /end REF_CHARACTERISTIC /end GROUP
/begin GROUP rtb_PahEstimn[3] "" /begin REF_CHARACTERISTIC /end REF_CHARACTERISTIC /end GROUP
/begin GROUP rtb_VehSelf "" /begin REF_CHARACTERISTIC /end REF_CHARACTERISTIC /end GROUP
/begin CHARACTERISTIC CAL_Deb_SftyFlg_BrkDrvOvrd "" VALUE 0xfe820304 /* @ECU_Address@CAL_Deb_SftyFlg_BrkDrvOvrd@ */ Record_UWORD 0 autosar_swc_fusamon_CM_uint16 0 65535 /end CHARACTERISTIC
/begin CHARACTERISTIC CAL_Deb_SftyFlg_DoorStatus "" VALUE 0xfe820306 /* @ECU_Address@CAL_Deb_SftyFlg_DoorStatus@ */ Record_UWORD 0 autosar_swc_fusamon_CM_uint16 0 65535 /end CHARACTERISTIC
/begin CHARACTERISTIC CAL_Deb_SftyFlg_HandsTqE2E "" VALUE 0xfe82030c /* @ECU_Address@CAL_Deb_SftyFlg_HandsTqE2E@ */ Record_UWORD 0 autosar_swc_fusamon_CM_uint16 0 65535 /end CHARACTERISTIC
/begin CHARACTERISTIC CAL_Deb_SftyFlg_SeatBltSts "" VALUE 0xfe820314 /* @ECU_Address@CAL_Deb_SftyFlg_SeatBltSts@ */ Record_UWORD 0 autosar_swc_fusamon_CM_uint16 0 65535 /end CHARACTERISTIC
/begin CHARACTERISTIC CAL_Deb_SftyFlg_SeatBltStsVld "" VALUE 0xfe820316 /* @ECU_Address@CAL_Deb_SftyFlg_SeatBltStsVld@ */ Record_UWORD 0 autosar_swc_fusamon_CM_uint16 0 65535 /end CHARACTERISTIC
/begin CHARACTERISTIC CAL_Deb_SftyFlg_SteerDrvOvrd "" VALUE 0xfe820318 /* @ECU_Address@CAL_Deb_SftyFlg_SteerDrvOvrd@ */ Record_UWORD 0 autosar_swc_fusamon_CM_uint16 0 65535 /end CHARACTERISTIC
/begin MEASUREMENT FUSAMON_ExecTimestamp.nanoseconds "" ULONG autosar_swc_fusamon_CM_uint32 0 0 0 4294967295 ECU_ADDRESS 0xfe4abae4 /* @ECU_Address@FUSAMON_ExecTimestamp.nanoseconds@ */ /end MEASUREMENT
/begin MEASUREMENT FUSAMON_ExecTimestamp.seconds "" A_UINT64 autosar_swc_fusamon_CM_uint64 0 0 0 18446744073709551615 ECU_ADDRESS 0xfe4abae8 /* @ECU_Address@FUSAMON_ExecTimestamp.seconds@ */ /end MEASUREMENT
/begin MEASUREMENT FUSAMON_ExecTimestamp.timeBaseStatus "" UBYTE autosar_swc_fusamon_CM_uint8 0 0 0 255 ECU_ADDRESS 0xfe4abae0 /* @ECU_Address@FUSAMON_ExecTimestamp.timeBaseStatus@ */ /end MEASUREMENT
/begin MEASUREMENT FUSAMON_Version "" ULONG autosar_swc_fusamon_CM_uint32 0 0 0 4294967295 ECU_ADDRESS 0xfe4aceb0 /* @ECU_Address@FUSAMON_Version@ */ /end MEASUREMENT
/begin MEASUREMENT SwcOut_FUSAMON_FM_SAF_OUT.SftyCmd "" ULONG autosar_swc_fusamon_CM_uint32 0 0 0 4294967295 ECU_ADDRESS 0xfe4aceb8 /* @ECU_Address@SwcOut_FUSAMON_FM_SAF_OUT.SftyCmd@ */ /end MEASUREMENT
/begin MEASUREMENT SwcOut_FUSAMON_FM_SAF_OUT.SftyErrInfo.SftyErr_0 "" ULONG autosar_swc_fusamon_CM_uint32 0 0 0 4294967295 ECU_ADDRESS 0xfe4acec8 /* @ECU_Address@SwcOut_FUSAMON_FM_SAF_OUT.SftyErrInfo.SftyErr_0@ */ /end MEASUREMENT
/begin MEASUREMENT SwcOut_FUSAMON_FM_SAF_OUT.SftyErrInfo.SftyErr_1 "" ULONG autosar_swc_fusamon_CM_uint32 0 0 0 4294967295 ECU_ADDRESS 0xfe4acecc /* @ECU_Address@SwcOut_FUSAMON_FM_SAF_OUT.SftyErrInfo.SftyErr_1@ */ /end MEASUREMENT
/begin MEASUREMENT SwcOut_FUSAMON_FM_SAF_OUT.SftyErrInfo.SftyErr_2 "" ULONG autosar_swc_fusamon_CM_uint32 0 0 0 4294967295 ECU_ADDRESS 0xfe4aced0 /* @ECU_Address@SwcOut_FUSAMON_FM_SAF_OUT.SftyErrInfo.SftyErr_2@ */ /end MEASUREMENT
/begin MEASUREMENT SwcOut_FUSAMON_FM_SAF_OUT.SftyErrInfo.SftyErr_3 "" ULONG autosar_swc_fusamon_CM_uint32 0 0 0 4294967295 ECU_ADDRESS 0xfe4aced4 /* @ECU_Address@SwcOut_FUSAMON_FM_SAF_OUT.SftyErrInfo.SftyErr_3@ */ /end MEASUREMENT
/begin MEASUREMENT SwcOut_FUSAMON_FM_SAF_OUT.SftyErrInfo.SftyErr_4 "" ULONG autosar_swc_fusamon_CM_uint32 0 0 0 4294967295 ECU_ADDRESS 0xfe4aced8 /* @ECU_Address@SwcOut_FUSAMON_FM_SAF_OUT.SftyErrInfo.SftyErr_4@ */ /end MEASUREMENT
/begin MEASUREMENT SwcOut_FUSAMON_FM_SAF_OUT.SftyErrInfo.SftyErr_5 "" ULONG autosar_swc_fusamon_CM_uint32 0 0 0 4294967295 ECU_ADDRESS 0xfe4acedc /* @ECU_Address@SwcOut_FUSAMON_FM_SAF_OUT.SftyErrInfo.SftyErr_5@ */ /end MEASUREMENT
/begin MEASUREMENT SwcOut_FUSAMON_FM_SAF_OUT.SftyErrInfo.SftyErr_6 "" ULONG autosar_swc_fusamon_CM_uint32 0 0 0 4294967295 ECU_ADDRESS 0xfe4acee0 /* @ECU_Address@SwcOut_FUSAMON_FM_SAF_OUT.SftyErrInfo.SftyErr_6@ */ /end MEASUREMENT
/begin MEASUREMENT SwcOut_FUSAMON_FM_SAF_OUT.SftyErrInfo.SftyErr_7 "" ULONG autosar_swc_fusamon_CM_uint32 0 0 0 4294967295 ECU_ADDRESS 0xfe4acee4 /* @ECU_Address@SwcOut_FUSAMON_FM_SAF_OUT.SftyErrInfo.SftyErr_7@ */ /end MEASUREMENT
/begin MEASUREMENT SwcOut_FUSAMON_FM_SAF_OUT.SftyErrInfo.SftyModeFuSa "" ULONG autosar_swc_fusamon_CM_uint32 0 0 0 4294967295 ECU_ADDRESS 0xfe4acec4 /* @ECU_Address@SwcOut_FUSAMON_FM_SAF_OUT.SftyErrInfo.SftyModeFuSa@ */ /end MEASUREMENT
/begin MEASUREMENT SwcOut_FUSAMON_FM_SAF_OUT.SftyErrInfo.SftyVehSpdChassis "" FLOAT32_IEEE autosar_swc_fusamon_CM_single 0 0 -3.4E+38 3.4E+38 ECU_ADDRESS 0xfe4acec0 /* @ECU_Address@SwcOut_FUSAMON_FM_SAF_OUT.SftyErrInfo.SftyVehSpdChassis@ */ /end MEASUREMENT
/begin MEASUREMENT SwcOut_FUSAMON_FM_SAF_OUT.SftyErrInfo.SftyVehSpdChassisVld "" UBYTE autosar_swc_fusamon_CM_boolean 0 0 0 1 ECU_ADDRESS 0xfe4acebc /* @ECU_Address@SwcOut_FUSAMON_FM_SAF_OUT.SftyErrInfo.SftyVehSpdChassisVld@ */ /end MEASUREMENT
/begin MEASUREMENT SwcOut_FUSAMON_FM_SAF_OUT.SftyErrInfoQue[0].SftyErrID "" ULONG autosar_swc_fusamon_CM_uint32 0 0 0 4294967295 ECU_ADDRESS 0xfe4acee8 /* @ECU_Address@SwcOut_FUSAMON_FM_SAF_OUT.SftyErrInfoQue[0].SftyErrID@ */ /end MEASUREMENT
/begin MEASUREMENT SwcOut_FUSAMON_FM_SAF_OUT.SftyErrInfoQue[0].TrigTimeStamp "" ULONG autosar_swc_fusamon_CM_uint32 0 0 0 4294967295 ECU_ADDRESS 0xfe4aceec /* @ECU_Address@SwcOut_FUSAMON_FM_SAF_OUT.SftyErrInfoQue[0].TrigTimeStamp@ */ /end MEASUREMENT
/begin MEASUREMENT SwcOut_FUSAMON_FM_SAF_OUT.SftyErrLvl "" UBYTE autosar_swc_fusamon_CM_uint8 0 0 0 255 ECU_ADDRESS 0xfe4aceb4 /* @ECU_Address@SwcOut_FUSAMON_FM_SAF_OUT.SftyErrLvl@ */ /end MEASUREMENT
/begin MEASUREMENT SwcOut_FUSAMON_NvM_Write_Request "" UBYTE autosar_swc_fusamon_CM_boolean 0 0 0 1 ECU_ADDRESS 0xfe4acfe8 /* @ECU_Address@SwcOut_FUSAMON_NvM_Write_Request@ */ /end MEASUREMENT
/begin MEASUREMENT autosar_swc_fusamon_rtARID_DEF.Nvm_Write_Request "" UBYTE autosar_swc_fusamon_CM_logical 0 0 0 1 ECU_ADDRESS 0xfe4acea9 /* @ECU_Address@autosar_swc_fusamon_rtARID_DEF.Nvm_Write_Request@ */ /end MEASUREMENT
/begin MEASUREMENT autosar_swc_fusamon_rtARID_DEF.UnitDelay_DSTATE_a "" UWORD autosar_swc_fusamon_CM_uint16 0 0 0 65535 ECU_ADDRESS 0xfe4ace3c /* @ECU_Address@autosar_swc_fusamon_rtARID_DEF.UnitDelay_DSTATE_a@ */ /end MEASUREMENT
/begin MEASUREMENT autosar_swc_fusamon_rtARID_DEF.UnitDelay_DSTATE_c "" UWORD autosar_swc_fusamon_CM_uint16 0 0 0 65535 ECU_ADDRESS 0xfe4ace42 /* @ECU_Address@autosar_swc_fusamon_rtARID_DEF.UnitDelay_DSTATE_c@ */ /end MEASUREMENT
/begin MEASUREMENT autosar_swc_fusamon_rtARID_DEF.UnitDelay_DSTATE_d "" UBYTE autosar_swc_fusamon_CM_uint8 0 0 0 255 ECU_ADDRESS 0xfe4ace6d /* @ECU_Address@autosar_swc_fusamon_rtARID_DEF.UnitDelay_DSTATE_d@ */ /end MEASUREMENT
/begin MEASUREMENT autosar_swc_fusamon_rtARID_DEF.UnitDelay_DSTATE_g "" UWORD autosar_swc_fusamon_CM_uint16 0 0 0 65535 ECU_ADDRESS 0xfe4ace40 /* @ECU_Address@autosar_swc_fusamon_rtARID_DEF.UnitDelay_DSTATE_g@ */ /end MEASUREMENT
/begin MEASUREMENT autosar_swc_fusamon_rtARID_DEF.UnitDelay_DSTATE_k "" UWORD autosar_swc_fusamon_CM_uint16 0 0 0 65535 ECU_ADDRESS 0xfe4ace44 /* @ECU_Address@autosar_swc_fusamon_rtARID_DEF.UnitDelay_DSTATE_k@ */ /end MEASUREMENT
/begin MEASUREMENT autosar_swc_fusamon_rtARID_DEF.UnitDelay_DSTATE_o "" UWORD autosar_swc_fusamon_CM_uint16 0 0 0 65535 ECU_ADDRESS 0xfe4ace3e /* @ECU_Address@autosar_swc_fusamon_rtARID_DEF.UnitDelay_DSTATE_o@ */ /end MEASUREMENT
/begin COMPU_METHOD autosar_swc_fusamon_CM_boolean "Q = V" IDENTICAL "%1.0" "" /end COMPU_METHOD
/begin COMPU_METHOD autosar_swc_fusamon_CM_logical "Q = V" IDENTICAL "%1.0" "" /end COMPU_METHOD
/begin COMPU_METHOD autosar_swc_fusamon_CM_single "Q = V" IDENTICAL "%8.6" "" /end COMPU_METHOD
/begin COMPU_METHOD autosar_swc_fusamon_CM_uint16 "Q = V" IDENTICAL "%5.0" "" /end COMPU_METHOD
/begin COMPU_METHOD autosar_swc_fusamon_CM_uint32 "Q = V" IDENTICAL "%10.0" "" /end COMPU_METHOD
/begin COMPU_METHOD autosar_swc_fusamon_CM_uint64 "Q = V" IDENTICAL "%20.0" "" /end COMPU_METHOD
/begin COMPU_METHOD autosar_swc_fusamon_CM_uint8 "Q = V" IDENTICAL "%3.0" "" /end COMPU_METHOD
/begin RECORD_LAYOUT Record_UWORD FNC_VALUES 1 UWORD COLUMN_DIR DIRECT /end RECORD_LAYOUT
/begin GROUP FUSAMON_ExecTimestamp ""
 /begin REF_MEASUREMENT FUSAMON_ExecTimestamp.timeBaseStatus FUSAMON_ExecTimestamp.nanoseconds FUSAMON_ExecTimestamp.seconds /end REF_MEASUREMENT
/end GROUP
/begin GROUP SwcOut_FUSAMON_FM_SAF_OUT "" /begin SUB_GROUP SwcOut_FUSAMON_FM_SAF_OUT.SftyErrInfo /end SUB_GROUP
 /begin REF_MEASUREMENT SwcOut_FUSAMON_FM_SAF_OUT.SftyErrLvl SwcOut_FUSAMON_FM_SAF_OUT.SftyCmd /end REF_MEASUREMENT
/end GROUP
/begin GROUP SwcOut_FUSAMON_FM_SAF_OUT.SftyErrInfo ""
 /begin REF_MEASUREMENT SwcOut_FUSAMON_FM_SAF_OUT.SftyErrInfo.SftyVehSpdChassisVld SwcOut_FUSAMON_FM_SAF_OUT.SftyErrInfo.SftyVehSpdChassis SwcOut_FUSAMON_FM_SAF_OUT.SftyErrInfo.SftyModeFuSa SwcOut_FUSAMON_FM_SAF_OUT.SftyErrInfo.SftyErr_0 SwcOut_FUSAMON_FM_SAF_OUT.SftyErrInfo.SftyErr_1 SwcOut_FUSAMON_FM_SAF_OUT.SftyErrInfo.SftyErr_2 SwcOut_FUSAMON_FM_SAF_OUT.SftyErrInfo.SftyErr_3 SwcOut_FUSAMON_FM_SAF_OUT.SftyErrInfo.SftyErr_4 SwcOut_FUSAMON_FM_SAF_OUT.SftyErrInfo.SftyErr_5 SwcOut_FUSAMON_FM_SAF_OUT.SftyErrInfo.SftyErr_6 SwcOut_FUSAMON_FM_SAF_OUT.SftyErrInfo.SftyErr_7 /end REF_MEASUREMENT
/end GROUP
/begin GROUP SwcOut_FUSAMON_FM_SAF_OUT.SftyErrInfoQue[0] ""
 /begin REF_MEASUREMENT SwcOut_FUSAMON_FM_SAF_OUT.SftyErrInfoQue[0].SftyErrID SwcOut_FUSAMON_FM_SAF_OUT.SftyErrInfoQue[0].TrigTimeStamp /end REF_MEASUREMENT
/end GROUP
/begin GROUP autosar_swc_fusamon "autosar_swc_fusamon" ROOT /begin SUB_GROUP autosar_swc_fusamon_Subsystem_Reference /end SUB_GROUP /end GROUP
/begin GROUP autosar_swc_fusamon_Subsystem_Reference "autosar_swc_fusamon/Subsystem Reference"
 /begin SUB_GROUP autosar_swc_fusamon_Subsystem_Reference_DrvEvInMon autosar_swc_fusamon_Subsystem_Reference_OutProcAdpt autosar_swc_fusamon_Subsystem_Reference_RelCptMon autosar_swc_fusamon_Subsystem_Reference_SysStMon /end SUB_GROUP
 /begin REF_MEASUREMENT FUSAMON_Version SwcOut_FUSAMON_NvM_Write_Request autosar_swc_fusamon_rtARID_DEF.Nvm_Write_Request /end REF_MEASUREMENT
/end GROUP
/begin GROUP autosar_swc_fusamon_Subsystem_Reference_DrvEvInMon "autosar_swc_fusamon/Subsystem Reference/DrvEvInMon"
 /begin SUB_GROUP autosar_swc_fusamon_Subsystem_Reference_DrvEvInMon_SSR_FuSaMonitor_DrvEvlnMon_0 autosar_swc_fusamon_Subsystem_Reference_DrvEvInMon_SSR_FuSaMonitor_DrvEvlnMon_1 autosar_swc_fusamon_Subsystem_Reference_DrvEvInMon_SSR_FuSaMonitor_DrvEvlnMon_2 autosar_swc_fusamon_Subsystem_Reference_DrvEvInMon_SSR_FuSaMonitor_DrvEvlnMon_3 autosar_swc_fusamon_Subsystem_Reference_DrvEvInMon_SSR_FuSaMonitor_DrvEvlnMon_4 autosar_swc_fusamon_Subsystem_Reference_DrvEvInMon_SSR_FuSaMonitor_DrvEvlnMon_5 autosar_swc_fusamon_Subsystem_Reference_DrvEvInMon_SSR_FuSaMonitor_DrvEvlnMon_6 /end SUB_GROUP
/end GROUP
/begin GROUP autosar_swc_fusamon_Subsystem_Reference_DrvEvInMon_SSR_FuSaMonitor_DrvEvlnMon_0 "autosar_swc_fusamon/Subsystem Reference/DrvEvInMon/SSR_FuSaMonitor_DrvEvlnMon_0" /begin REF_CHARACTERISTIC CAL_Deb_SftyFlg_BrkDrvOvrd /end REF_CHARACTERISTIC /begin REF_MEASUREMENT autosar_swc_fusamon_rtARID_DEF.UnitDelay_DSTATE_d /end REF_MEASUREMENT /end GROUP
/begin GROUP autosar_swc_fusamon_Subsystem_Reference_DrvEvInMon_SSR_FuSaMonitor_DrvEvlnMon_1 "autosar_swc_fusamon/Subsystem Reference/DrvEvInMon/SSR_FuSaMonitor_DrvEvlnMon_1" /begin REF_CHARACTERISTIC CAL_Deb_SftyFlg_SteerDrvOvrd /end REF_CHARACTERISTIC /begin REF_MEASUREMENT autosar_swc_fusamon_rtARID_DEF.UnitDelay_DSTATE_a /end REF_MEASUREMENT /end GROUP
/begin GROUP autosar_swc_fusamon_Subsystem_Reference_DrvEvInMon_SSR_FuSaMonitor_DrvEvlnMon_2 "autosar_swc_fusamon/Subsystem Reference/DrvEvInMon/SSR_FuSaMonitor_DrvEvlnMon_2" /begin REF_CHARACTERISTIC CAL_Deb_SftyFlg_DoorStatus /end REF_CHARACTERISTIC /begin REF_MEASUREMENT autosar_swc_fusamon_rtARID_DEF.UnitDelay_DSTATE_o /end REF_MEASUREMENT /end GROUP
/begin GROUP autosar_swc_fusamon_Subsystem_Reference_DrvEvInMon_SSR_FuSaMonitor_DrvEvlnMon_3 "autosar_swc_fusamon/Subsystem Reference/DrvEvInMon/SSR_FuSaMonitor_DrvEvlnMon_3" /begin REF_CHARACTERISTIC CAL_Deb_SftyFlg_SeatBltSts /end REF_CHARACTERISTIC /begin REF_MEASUREMENT autosar_swc_fusamon_rtARID_DEF.UnitDelay_DSTATE_g /end REF_MEASUREMENT /end GROUP
/begin GROUP autosar_swc_fusamon_Subsystem_Reference_DrvEvInMon_SSR_FuSaMonitor_DrvEvlnMon_4 "autosar_swc_fusamon/Subsystem Reference/DrvEvInMon/SSR_FuSaMonitor_DrvEvlnMon_4" /begin REF_CHARACTERISTIC CAL_Deb_SftyFlg_SeatBltStsVld /end REF_CHARACTERISTIC /begin REF_MEASUREMENT autosar_swc_fusamon_rtARID_DEF.UnitDelay_DSTATE_c /end REF_MEASUREMENT /end GROUP
/begin GROUP autosar_swc_fusamon_Subsystem_Reference_DrvEvInMon_SSR_FuSaMonitor_DrvEvlnMon_5 "autosar_swc_fusamon/Subsystem Reference/DrvEvInMon/SSR_FuSaMonitor_DrvEvlnMon_5" /begin REF_CHARACTERISTIC CAL_Deb_SftyFlg_HandsTqE2E /end REF_CHARACTERISTIC /begin REF_MEASUREMENT autosar_swc_fusamon_rtARID_DEF.UnitDelay_DSTATE_k /end REF_MEASUREMENT /end GROUP
/begin GROUP autosar_swc_fusamon_Subsystem_Reference_OutProcAdpt_FuSaStateM "autosar_swc_fusamon/Subsystem Reference/OutProcAdpt/FuSaStateM" /begin REF_MEASUREMENT autosar_swc_fusamon_rtARID_DEF.Nvm_Write_Request /end REF_MEASUREMENT /end GROUP
/begin RECORD_LAYOUT Record_UWORD FNC_VALUES 1 UWORD COLUMN_DIR DIRECT /end RECORD_LAYOUT
/begin RECORD_LAYOUT Record_UWORD FNC_VALUES 1 UWORD COLUMN_DIR DIRECT /end RECORD_LAYOUT
/begin RECORD_LAYOUT Record_UWORD FNC_VALUES 1 UWORD COLUMN_DIR DIRECT /end RECORD_LAYOUT
/begin RECORD_LAYOUT Record_UWORD FNC_VALUES 1 UWORD COLUMN_DIR DIRECT /end RECORD_LAYOUT
/begin RECORD_LAYOUT Record_UWORD FNC_VALUES 1 UWORD COLUMN_DIR DIRECT /end RECORD_LAYOUT
/begin RECORD_LAYOUT Record_UWORD FNC_VALUES 1 UWORD COLUMN_DIR DIRECT /end RECORD_LAYOUT
/begin RECORD_LAYOUT Record_UWORD FNC_VALUES 1 UWORD COLUMN_DIR DIRECT /end RECORD_LAYOUT
/begin RECORD_LAYOUT Record_UWORD FNC_VALUES 1 UWORD COLUMN_DIR DIRECT /end RECORD_LAYOUT
/end MODULE
/end PROJECT
