ASAP2_VERSION 1 71
/begin PROJECT ProjectName ""
/begin MODULE ModuleName ""
/begin MOD_COMMON "" BYTE_ORDER MSB_LAST ALIGNMENT_BYTE 1 ALIGNMENT_WORD 1 ALIGNMENT_LONG 1 ALIGNMENT_INT64 1 ALIGNMENT_FLOAT16_IEEE 1 ALIGNMENT_FLOAT32_IEEE 1 ALIGNMENT_FLOAT64_IEEE 1 /end MOD_COMMON
/begin RECORD_LAYOUT SSV__FLOAT64_IEEE_S AXIS_PTS_X 1 FLOAT64_IEEE INDEX_INCR DIRECT /end RECORD_LAYOUT
/begin RECORD_LAYOUT Record_FLOAT32_IEEE FNC_VALUES 1 FLOAT32_IEEE COLUMN_DIR DIRECT /end RECORD_LAYOUT
/begin RECORD_LAYOUT Record_UBYTE FNC_VALUES 1 UBYTE COLUMN_DIR DIRECT /end RECORD_LAYOUT
/begin RECORD_LAYOUT Record_FLOAT32_IEEE FNC_VALUES 1 FLOAT32_IEEE COLUMN_DIR DIRECT /end RECORD_LAYOUT
/begin RECORD_LAYOUT Record_UBYTE FNC_VALUES 1 UBYTE COLUMN_DIR DIRECT /end RECORD_LAYOUT
/begin RECORD_LAYOUT Record_FLOAT32_IEEE FNC_VALUES 1 FLOAT32_IEEE COLUMN_DIR DIRECT /end RECORD_LAYOUT
/begin RECORD_LAYOUT Record_UBYTE FNC_VALUES 1 UBYTE COLUMN_DIR DIRECT /end RECORD_LAYOUT
/begin RECORD_LAYOUT Record_FLOAT32_IEEE FNC_VALUES 1 FLOAT32_IEEE COLUMN_DIR DIRECT /end RECORD_LAYOUT
/begin RECORD_LAYOUT Record_UBYTE FNC_VALUES 1 UBYTE COLUMN_DIR DIRECT /end RECORD_LAYOUT
/begin RECORD_LAYOUT Record_FLOAT32_IEEE FNC_VALUES 1 FLOAT32_IEEE COLUMN_DIR DIRECT /end RECORD_LAYOUT
/begin RECORD_LAYOUT Record_UBYTE FNC_VALUES 1 UBYTE COLUMN_DIR DIRECT /end RECORD_LAYOUT
/begin CHARACTERISTIC P_ALC_RampSplYThreased "" VALUE 0xfe821d54 /* @ECU_Address@P_ALC_RampSplYThreased@ */ Record_UBYTE 0 autosar_swc_rlgs_CM_uint8 0 255 /end CHARACTERISTIC
/begin CHARACTERISTIC P_ALC_SPLXThreshold "" VALUE 0xfe821b20 /* @ECU_Address@P_ALC_SPLXThreshold@ */ Record_FLOAT32_IEEE 0 autosar_swc_rlgs_CM_single -3.4E+38 3.4E+38 /end CHARACTERISTIC
/begin CHARACTERISTIC P_TSR_XThreshold "" VALUE 0xfe821d79 /* @ECU_Address@P_TSR_XThreshold@ */ Record_UBYTE 0 autosar_swc_rlgs_CM_uint8 0 255 /end CHARACTERISTIC
/begin CHARACTERISTIC P_TSR_YThreshold "" VALUE 0xfe821d7a /* @ECU_Address@P_TSR_YThreshold@ */ Record_UBYTE 0 autosar_swc_rlgs_CM_uint8 0 255 /end CHARACTERISTIC
/begin MEASUREMENT PSM_reserve02 "" FLOAT32_IEEE autosar_swc_rlgs_CM_single 0 0 -3.4E+38 3.4E+38 MATRIX_DIM 1 1 ECU_ADDRESS 0xfe4afeb8 /* @ECU_Address@PSM_reserve02@ */ /end MEASUREMENT
/begin MEASUREMENT PSM_reserve03 "" FLOAT32_IEEE autosar_swc_rlgs_CM_single 0 0 -3.4E+38 3.4E+38 MATRIX_DIM 1 1 ECU_ADDRESS 0xfe4afebc /* @ECU_Address@PSM_reserve03@ */ /end MEASUREMENT
/begin MEASUREMENT PSM_reserve04 "" FLOAT32_IEEE autosar_swc_rlgs_CM_single 0 0 -3.4E+38 3.4E+38 MATRIX_DIM 1 1 ECU_ADDRESS 0xfe4afec0 /* @ECU_Address@PSM_reserve04@ */ /end MEASUREMENT
/begin MEASUREMENT PSM_reserve05 "" FLOAT32_IEEE autosar_swc_rlgs_CM_single 0 0 -3.4E+38 3.4E+38 MATRIX_DIM 1 1 ECU_ADDRESS 0xfe4afec4 /* @ECU_Address@PSM_reserve05@ */ /end MEASUREMENT
/begin MEASUREMENT PSM_reserve06 "" FLOAT32_IEEE autosar_swc_rlgs_CM_single 0 0 -3.4E+38 3.4E+38 MATRIX_DIM 1 1 ECU_ADDRESS 0xfe4afec8 /* @ECU_Address@PSM_reserve06@ */ /end MEASUREMENT
/begin MEASUREMENT PSM_reserve09 "" FLOAT32_IEEE autosar_swc_rlgs_CM_single 0 0 -3.4E+38 3.4E+38 MATRIX_DIM 1 1 ECU_ADDRESS 0xfe4afed4 /* @ECU_Address@PSM_reserve09@ */ /end MEASUREMENT
/begin MEASUREMENT PSM_reserve10 "" FLOAT32_IEEE autosar_swc_rlgs_CM_single 0 0 -3.4E+38 3.4E+38 MATRIX_DIM 1 1 ECU_ADDRESS 0xfe4afed8 /* @ECU_Address@PSM_reserve10@ */ /end MEASUREMENT
/begin MEASUREMENT autosar_swc_rlgs_rtARID_DEF.ALC_Path[0].arrow_dir "" UBYTE autosar_swc_rlgs_CM_uint8 0 0 0 255 ECU_ADDRESS 0xfe4af0c3 /* @ECU_Address@autosar_swc_rlgs_rtARID_DEF.ALC_Path[0].arrow_dir@ */ /end MEASUREMENT
/begin MEASUREMENT autosar_swc_rlgs_rtARID_DEF.ALC_Path[0].center_refline.calc_state "" UBYTE autosar_swc_rlgs_CM_uint8 0 0 0 255 ECU_ADDRESS 0xfe4af131 /* @ECU_Address@autosar_swc_rlgs_rtARID_DEF.ALC_Path[0].center_refline.calc_state@ */ /end MEASUREMENT
/begin MEASUREMENT autosar_swc_rlgs_rtARID_DEF.ALC_Path[0].center_refline.curve.end "" FLOAT32_IEEE autosar_swc_rlgs_CM_single 0 0 -3.4E+38 3.4E+38 ECU_ADDRESS 0xfe4af13c /* @ECU_Address@autosar_swc_rlgs_rtARID_DEF.ALC_Path[0].center_refline.curve.end@ */ /end MEASUREMENT
/begin MEASUREMENT autosar_swc_rlgs_rtARID_DEF.ALC_Path[0].center_refline.curve.poly_vec "" FLOAT32_IEEE autosar_swc_rlgs_CM_single 0 0 -3.4E+38 3.4E+38 LAYOUT COLUMN_DIR MATRIX_DIM 6 ECU_ADDRESS 0xfe4af140 /* @ECU_Address@autosar_swc_rlgs_rtARID_DEF.ALC_Path[0].center_refline.curve.poly_vec@ */ /end MEASUREMENT
/begin MEASUREMENT autosar_swc_rlgs_rtARID_DEF.ALC_Path[0].center_refline.curve.start "" FLOAT32_IEEE autosar_swc_rlgs_CM_single 0 0 -3.4E+38 3.4E+38 ECU_ADDRESS 0xfe4af138 /* @ECU_Address@autosar_swc_rlgs_rtARID_DEF.ALC_Path[0].center_refline.curve.start@ */ /end MEASUREMENT
/begin MEASUREMENT autosar_swc_rlgs_rtARID_DEF.ALC_Path[0].center_refline.id "" ULONG autosar_swc_rlgs_CM_uint32 0 0 0 4294967295 ECU_ADDRESS 0xfe4af134 /* @ECU_Address@autosar_swc_rlgs_rtARID_DEF.ALC_Path[0].center_refline.id@ */ /end MEASUREMENT
/begin MEASUREMENT autosar_swc_rlgs_rtARID_DEF.ALC_Path[0].center_refline.ref_source "" UBYTE autosar_swc_rlgs_CM_uint8 0 0 0 255 ECU_ADDRESS 0xfe4af130 /* @ECU_Address@autosar_swc_rlgs_rtARID_DEF.ALC_Path[0].center_refline.ref_source@ */ /end MEASUREMENT
/begin MEASUREMENT autosar_swc_rlgs_rtARID_DEF.ALC_Path[0].current_width "" FLOAT32_IEEE autosar_swc_rlgs_CM_single 0 0 -3.4E+38 3.4E+38 ECU_ADDRESS 0xfe4af0c4 /* @ECU_Address@autosar_swc_rlgs_rtARID_DEF.ALC_Path[0].current_width@ */ /end MEASUREMENT
/begin MEASUREMENT autosar_swc_rlgs_rtARID_DEF.ALC_Path[0].end_dist "" FLOAT32_IEEE autosar_swc_rlgs_CM_single 0 0 -3.4E+38 3.4E+38 ECU_ADDRESS 0xfe4af0c8 /* @ECU_Address@autosar_swc_rlgs_rtARID_DEF.ALC_Path[0].end_dist@ */ /end MEASUREMENT
/begin MEASUREMENT autosar_swc_rlgs_rtARID_DEF.ALC_Path[0].id "" ULONG autosar_swc_rlgs_CM_uint32 0 0 0 4294967295 ECU_ADDRESS 0xfe4af0cc /* @ECU_Address@autosar_swc_rlgs_rtARID_DEF.ALC_Path[0].id@ */ /end MEASUREMENT
/begin MEASUREMENT autosar_swc_rlgs_rtARID_DEF.ALC_Path[0].lane_extension_type "" UBYTE autosar_swc_rlgs_CM_uint8 0 0 0 255 ECU_ADDRESS 0xfe4af0c2 /* @ECU_Address@autosar_swc_rlgs_rtARID_DEF.ALC_Path[0].lane_extension_type@ */ /end MEASUREMENT
/begin MEASUREMENT autosar_swc_rlgs_rtARID_DEF.ALC_Path[0].lane_source "" UBYTE autosar_swc_rlgs_CM_uint8 0 0 0 255 ECU_ADDRESS 0xfe4af0c1 /* @ECU_Address@autosar_swc_rlgs_rtARID_DEF.ALC_Path[0].lane_source@ */ /end MEASUREMENT
/begin MEASUREMENT autosar_swc_rlgs_rtARID_DEF.ALC_Path[0].left_constraint.constraint_type "" UBYTE autosar_swc_rlgs_CM_uint8 0 0 0 255 ECU_ADDRESS 0xfe4af0d0 /* @ECU_Address@autosar_swc_rlgs_rtARID_DEF.ALC_Path[0].left_constraint.constraint_type@ */ /end MEASUREMENT
/begin MEASUREMENT autosar_swc_rlgs_rtARID_DEF.ALC_Path[0].left_constraint.constraint_type_ahead "" UBYTE autosar_swc_rlgs_CM_uint8 0 0 0 255 ECU_ADDRESS 0xfe4af0d1 /* @ECU_Address@autosar_swc_rlgs_rtARID_DEF.ALC_Path[0].left_constraint.constraint_type_ahead@ */ /end MEASUREMENT
/begin MEASUREMENT autosar_swc_rlgs_rtARID_DEF.ALC_Path[0].left_constraint.constraint_type_change_point_dx "" FLOAT32_IEEE autosar_swc_rlgs_CM_single 0 0 -3.4E+38 3.4E+38 ECU_ADDRESS 0xfe4af0d4 /* @ECU_Address@autosar_swc_rlgs_rtARID_DEF.ALC_Path[0].left_constraint.constraint_type_change_point_dx@ */ /end MEASUREMENT
/begin MEASUREMENT autosar_swc_rlgs_rtARID_DEF.ALC_Path[0].left_constraint.curve.end "" FLOAT32_IEEE autosar_swc_rlgs_CM_single 0 0 -3.4E+38 3.4E+38 ECU_ADDRESS 0xfe4af0e4 /* @ECU_Address@autosar_swc_rlgs_rtARID_DEF.ALC_Path[0].left_constraint.curve.end@ */ /end MEASUREMENT
/begin MEASUREMENT autosar_swc_rlgs_rtARID_DEF.ALC_Path[0].left_constraint.curve.poly_vec "" FLOAT32_IEEE autosar_swc_rlgs_CM_single 0 0 -3.4E+38 3.4E+38 LAYOUT COLUMN_DIR MATRIX_DIM 6 ECU_ADDRESS 0xfe4af0e8 /* @ECU_Address@autosar_swc_rlgs_rtARID_DEF.ALC_Path[0].left_constraint.curve.poly_vec@ */ /end MEASUREMENT
/begin MEASUREMENT autosar_swc_rlgs_rtARID_DEF.ALC_Path[0].left_constraint.curve.start "" FLOAT32_IEEE autosar_swc_rlgs_CM_single 0 0 -3.4E+38 3.4E+38 ECU_ADDRESS 0xfe4af0e0 /* @ECU_Address@autosar_swc_rlgs_rtARID_DEF.ALC_Path[0].left_constraint.curve.start@ */ /end MEASUREMENT
/begin MEASUREMENT autosar_swc_rlgs_rtARID_DEF.ALC_Path[0].left_constraint.id "" ULONG autosar_swc_rlgs_CM_uint32 0 0 0 4294967295 ECU_ADDRESS 0xfe4af0dc /* @ECU_Address@autosar_swc_rlgs_rtARID_DEF.ALC_Path[0].left_constraint.id@ */ /end MEASUREMENT
/begin MEASUREMENT autosar_swc_rlgs_rtARID_DEF.ALC_Path[0].left_constraint.meas_state "" UBYTE autosar_swc_rlgs_CM_uint8 0 0 0 255 ECU_ADDRESS 0xfe4af0d3 /* @ECU_Address@autosar_swc_rlgs_rtARID_DEF.ALC_Path[0].left_constraint.meas_state@ */ /end MEASUREMENT
/begin MEASUREMENT autosar_swc_rlgs_rtARID_DEF.ALC_Path[0].left_constraint.source_type "" UBYTE autosar_swc_rlgs_CM_uint8 0 0 0 255 ECU_ADDRESS 0xfe4af0d2 /* @ECU_Address@autosar_swc_rlgs_rtARID_DEF.ALC_Path[0].left_constraint.source_type@ */ /end MEASUREMENT
/begin MEASUREMENT autosar_swc_rlgs_rtARID_DEF.ALC_Path[0].left_constraint.visible_end "" FLOAT32_IEEE autosar_swc_rlgs_CM_single 0 0 -3.4E+38 3.4E+38 ECU_ADDRESS 0xfe4af0d8 /* @ECU_Address@autosar_swc_rlgs_rtARID_DEF.ALC_Path[0].left_constraint.visible_end@ */ /end MEASUREMENT
/begin MEASUREMENT autosar_swc_rlgs_rtARID_DEF.ALC_Path[0].right_constraint.constraint_type "" UBYTE autosar_swc_rlgs_CM_uint8 0 0 0 255 ECU_ADDRESS 0xfe4af100 /* @ECU_Address@autosar_swc_rlgs_rtARID_DEF.ALC_Path[0].right_constraint.constraint_type@ */ /end MEASUREMENT
/begin MEASUREMENT autosar_swc_rlgs_rtARID_DEF.ALC_Path[0].right_constraint.constraint_type_ahead "" UBYTE autosar_swc_rlgs_CM_uint8 0 0 0 255 ECU_ADDRESS 0xfe4af101 /* @ECU_Address@autosar_swc_rlgs_rtARID_DEF.ALC_Path[0].right_constraint.constraint_type_ahead@ */ /end MEASUREMENT
/begin MEASUREMENT autosar_swc_rlgs_rtARID_DEF.ALC_Path[0].right_constraint.constraint_type_change_point_dx "" FLOAT32_IEEE autosar_swc_rlgs_CM_single 0 0 -3.4E+38 3.4E+38 ECU_ADDRESS 0xfe4af104 /* @ECU_Address@autosar_swc_rlgs_rtARID_DEF.ALC_Path[0].right_constraint.constraint_type_change_point_dx@ */ /end MEASUREMENT
/begin MEASUREMENT autosar_swc_rlgs_rtARID_DEF.ALC_Path[0].right_constraint.curve.end "" FLOAT32_IEEE autosar_swc_rlgs_CM_single 0 0 -3.4E+38 3.4E+38 ECU_ADDRESS 0xfe4af114 /* @ECU_Address@autosar_swc_rlgs_rtARID_DEF.ALC_Path[0].right_constraint.curve.end@ */ /end MEASUREMENT
/begin MEASUREMENT autosar_swc_rlgs_rtARID_DEF.ALC_Path[0].right_constraint.curve.poly_vec "" FLOAT32_IEEE autosar_swc_rlgs_CM_single 0 0 -3.4E+38 3.4E+38 LAYOUT COLUMN_DIR MATRIX_DIM 6 ECU_ADDRESS 0xfe4af118 /* @ECU_Address@autosar_swc_rlgs_rtARID_DEF.ALC_Path[0].right_constraint.curve.poly_vec@ */ /end MEASUREMENT
/begin MEASUREMENT autosar_swc_rlgs_rtARID_DEF.ALC_Path[0].right_constraint.curve.start "" FLOAT32_IEEE autosar_swc_rlgs_CM_single 0 0 -3.4E+38 3.4E+38 ECU_ADDRESS 0xfe4af110 /* @ECU_Address@autosar_swc_rlgs_rtARID_DEF.ALC_Path[0].right_constraint.curve.start@ */ /end MEASUREMENT
/begin MEASUREMENT autosar_swc_rlgs_rtARID_DEF.ALC_Path[0].right_constraint.id "" ULONG autosar_swc_rlgs_CM_uint32 0 0 0 4294967295 ECU_ADDRESS 0xfe4af10c /* @ECU_Address@autosar_swc_rlgs_rtARID_DEF.ALC_Path[0].right_constraint.id@ */ /end MEASUREMENT
/begin MEASUREMENT autosar_swc_rlgs_rtARID_DEF.ALC_Path[0].right_constraint.meas_state "" UBYTE autosar_swc_rlgs_CM_uint8 0 0 0 255 ECU_ADDRESS 0xfe4af103 /* @ECU_Address@autosar_swc_rlgs_rtARID_DEF.ALC_Path[0].right_constraint.meas_state@ */ /end MEASUREMENT
/begin MEASUREMENT autosar_swc_rlgs_rtARID_DEF.ALC_Path[0].right_constraint.source_type "" UBYTE autosar_swc_rlgs_CM_uint8 0 0 0 255 ECU_ADDRESS 0xfe4af102 /* @ECU_Address@autosar_swc_rlgs_rtARID_DEF.ALC_Path[0].right_constraint.source_type@ */ /end MEASUREMENT
/begin MEASUREMENT autosar_swc_rlgs_rtARID_DEF.ALC_Path[0].right_constraint.visible_end "" FLOAT32_IEEE autosar_swc_rlgs_CM_single 0 0 -3.4E+38 3.4E+38 ECU_ADDRESS 0xfe4af108 /* @ECU_Address@autosar_swc_rlgs_rtARID_DEF.ALC_Path[0].right_constraint.visible_end@ */ /end MEASUREMENT
/begin MEASUREMENT autosar_swc_rlgs_rtARID_DEF.ALC_Path[0].type "" UBYTE autosar_swc_rlgs_CM_uint8 0 0 0 255 ECU_ADDRESS 0xfe4af0c0 /* @ECU_Address@autosar_swc_rlgs_rtARID_DEF.ALC_Path[0].type@ */ /end MEASUREMENT
/begin MEASUREMENT autosar_swc_rlgs_rtARID_DEF.ALC_Path[1].arrow_dir "" UBYTE autosar_swc_rlgs_CM_uint8 0 0 0 255 ECU_ADDRESS 0xfe4af15b /* @ECU_Address@autosar_swc_rlgs_rtARID_DEF.ALC_Path[1].arrow_dir@ */ /end MEASUREMENT
/begin MEASUREMENT autosar_swc_rlgs_rtARID_DEF.ALC_Path[1].center_refline.calc_state "" UBYTE autosar_swc_rlgs_CM_uint8 0 0 0 255 ECU_ADDRESS 0xfe4af1c9 /* @ECU_Address@autosar_swc_rlgs_rtARID_DEF.ALC_Path[1].center_refline.calc_state@ */ /end MEASUREMENT
/begin MEASUREMENT autosar_swc_rlgs_rtARID_DEF.ALC_Path[1].center_refline.curve.end "" FLOAT32_IEEE autosar_swc_rlgs_CM_single 0 0 -3.4E+38 3.4E+38 ECU_ADDRESS 0xfe4af1d4 /* @ECU_Address@autosar_swc_rlgs_rtARID_DEF.ALC_Path[1].center_refline.curve.end@ */ /end MEASUREMENT
/begin MEASUREMENT autosar_swc_rlgs_rtARID_DEF.ALC_Path[1].center_refline.curve.poly_vec "" FLOAT32_IEEE autosar_swc_rlgs_CM_single 0 0 -3.4E+38 3.4E+38 LAYOUT COLUMN_DIR MATRIX_DIM 6 ECU_ADDRESS 0xfe4af1d8 /* @ECU_Address@autosar_swc_rlgs_rtARID_DEF.ALC_Path[1].center_refline.curve.poly_vec@ */ /end MEASUREMENT
/begin MEASUREMENT autosar_swc_rlgs_rtARID_DEF.ALC_Path[1].center_refline.curve.start "" FLOAT32_IEEE autosar_swc_rlgs_CM_single 0 0 -3.4E+38 3.4E+38 ECU_ADDRESS 0xfe4af1d0 /* @ECU_Address@autosar_swc_rlgs_rtARID_DEF.ALC_Path[1].center_refline.curve.start@ */ /end MEASUREMENT
/begin MEASUREMENT autosar_swc_rlgs_rtARID_DEF.ALC_Path[1].center_refline.id "" ULONG autosar_swc_rlgs_CM_uint32 0 0 0 4294967295 ECU_ADDRESS 0xfe4af1cc /* @ECU_Address@autosar_swc_rlgs_rtARID_DEF.ALC_Path[1].center_refline.id@ */ /end MEASUREMENT
/begin MEASUREMENT autosar_swc_rlgs_rtARID_DEF.ALC_Path[1].center_refline.ref_source "" UBYTE autosar_swc_rlgs_CM_uint8 0 0 0 255 ECU_ADDRESS 0xfe4af1c8 /* @ECU_Address@autosar_swc_rlgs_rtARID_DEF.ALC_Path[1].center_refline.ref_source@ */ /end MEASUREMENT
/begin MEASUREMENT autosar_swc_rlgs_rtARID_DEF.ALC_Path[1].current_width "" FLOAT32_IEEE autosar_swc_rlgs_CM_single 0 0 -3.4E+38 3.4E+38 ECU_ADDRESS 0xfe4af15c /* @ECU_Address@autosar_swc_rlgs_rtARID_DEF.ALC_Path[1].current_width@ */ /end MEASUREMENT
/begin MEASUREMENT autosar_swc_rlgs_rtARID_DEF.ALC_Path[1].end_dist "" FLOAT32_IEEE autosar_swc_rlgs_CM_single 0 0 -3.4E+38 3.4E+38 ECU_ADDRESS 0xfe4af160 /* @ECU_Address@autosar_swc_rlgs_rtARID_DEF.ALC_Path[1].end_dist@ */ /end MEASUREMENT
/begin MEASUREMENT autosar_swc_rlgs_rtARID_DEF.ALC_Path[1].id "" ULONG autosar_swc_rlgs_CM_uint32 0 0 0 4294967295 ECU_ADDRESS 0xfe4af164 /* @ECU_Address@autosar_swc_rlgs_rtARID_DEF.ALC_Path[1].id@ */ /end MEASUREMENT
/begin MEASUREMENT autosar_swc_rlgs_rtARID_DEF.ALC_Path[1].lane_extension_type "" UBYTE autosar_swc_rlgs_CM_uint8 0 0 0 255 ECU_ADDRESS 0xfe4af15a /* @ECU_Address@autosar_swc_rlgs_rtARID_DEF.ALC_Path[1].lane_extension_type@ */ /end MEASUREMENT
/begin MEASUREMENT autosar_swc_rlgs_rtARID_DEF.ALC_Path[1].lane_source "" UBYTE autosar_swc_rlgs_CM_uint8 0 0 0 255 ECU_ADDRESS 0xfe4af159 /* @ECU_Address@autosar_swc_rlgs_rtARID_DEF.ALC_Path[1].lane_source@ */ /end MEASUREMENT
/begin MEASUREMENT autosar_swc_rlgs_rtARID_DEF.ALC_Path[1].left_constraint.constraint_type "" UBYTE autosar_swc_rlgs_CM_uint8 0 0 0 255 ECU_ADDRESS 0xfe4af168 /* @ECU_Address@autosar_swc_rlgs_rtARID_DEF.ALC_Path[1].left_constraint.constraint_type@ */ /end MEASUREMENT
/begin MEASUREMENT autosar_swc_rlgs_rtARID_DEF.ALC_Path[1].left_constraint.constraint_type_ahead "" UBYTE autosar_swc_rlgs_CM_uint8 0 0 0 255 ECU_ADDRESS 0xfe4af169 /* @ECU_Address@autosar_swc_rlgs_rtARID_DEF.ALC_Path[1].left_constraint.constraint_type_ahead@ */ /end MEASUREMENT
/begin MEASUREMENT autosar_swc_rlgs_rtARID_DEF.ALC_Path[1].left_constraint.constraint_type_change_point_dx "" FLOAT32_IEEE autosar_swc_rlgs_CM_single 0 0 -3.4E+38 3.4E+38 ECU_ADDRESS 0xfe4af16c /* @ECU_Address@autosar_swc_rlgs_rtARID_DEF.ALC_Path[1].left_constraint.constraint_type_change_point_dx@ */ /end MEASUREMENT
/begin MEASUREMENT autosar_swc_rlgs_rtARID_DEF.ALC_Path[1].left_constraint.curve.end "" FLOAT32_IEEE autosar_swc_rlgs_CM_single 0 0 -3.4E+38 3.4E+38 ECU_ADDRESS 0xfe4af17c /* @ECU_Address@autosar_swc_rlgs_rtARID_DEF.ALC_Path[1].left_constraint.curve.end@ */ /end MEASUREMENT
/begin MEASUREMENT autosar_swc_rlgs_rtARID_DEF.ALC_Path[1].left_constraint.curve.poly_vec "" FLOAT32_IEEE autosar_swc_rlgs_CM_single 0 0 -3.4E+38 3.4E+38 LAYOUT COLUMN_DIR MATRIX_DIM 6 ECU_ADDRESS 0xfe4af180 /* @ECU_Address@autosar_swc_rlgs_rtARID_DEF.ALC_Path[1].left_constraint.curve.poly_vec@ */ /end MEASUREMENT
/begin MEASUREMENT autosar_swc_rlgs_rtARID_DEF.ALC_Path[1].left_constraint.curve.start "" FLOAT32_IEEE autosar_swc_rlgs_CM_single 0 0 -3.4E+38 3.4E+38 ECU_ADDRESS 0xfe4af178 /* @ECU_Address@autosar_swc_rlgs_rtARID_DEF.ALC_Path[1].left_constraint.curve.start@ */ /end MEASUREMENT
/begin MEASUREMENT autosar_swc_rlgs_rtARID_DEF.ALC_Path[1].left_constraint.id "" ULONG autosar_swc_rlgs_CM_uint32 0 0 0 4294967295 ECU_ADDRESS 0xfe4af174 /* @ECU_Address@autosar_swc_rlgs_rtARID_DEF.ALC_Path[1].left_constraint.id@ */ /end MEASUREMENT
/begin MEASUREMENT autosar_swc_rlgs_rtARID_DEF.ALC_Path[1].left_constraint.meas_state "" UBYTE autosar_swc_rlgs_CM_uint8 0 0 0 255 ECU_ADDRESS 0xfe4af16b /* @ECU_Address@autosar_swc_rlgs_rtARID_DEF.ALC_Path[1].left_constraint.meas_state@ */ /end MEASUREMENT
/begin MEASUREMENT autosar_swc_rlgs_rtARID_DEF.ALC_Path[1].left_constraint.source_type "" UBYTE autosar_swc_rlgs_CM_uint8 0 0 0 255 ECU_ADDRESS 0xfe4af16a /* @ECU_Address@autosar_swc_rlgs_rtARID_DEF.ALC_Path[1].left_constraint.source_type@ */ /end MEASUREMENT
/begin MEASUREMENT autosar_swc_rlgs_rtARID_DEF.ALC_Path[1].left_constraint.visible_end "" FLOAT32_IEEE autosar_swc_rlgs_CM_single 0 0 -3.4E+38 3.4E+38 ECU_ADDRESS 0xfe4af170 /* @ECU_Address@autosar_swc_rlgs_rtARID_DEF.ALC_Path[1].left_constraint.visible_end@ */ /end MEASUREMENT
/begin MEASUREMENT autosar_swc_rlgs_rtARID_DEF.ALC_Path[1].right_constraint.constraint_type "" UBYTE autosar_swc_rlgs_CM_uint8 0 0 0 255 ECU_ADDRESS 0xfe4af198 /* @ECU_Address@autosar_swc_rlgs_rtARID_DEF.ALC_Path[1].right_constraint.constraint_type@ */ /end MEASUREMENT
/begin MEASUREMENT autosar_swc_rlgs_rtARID_DEF.ALC_Path[1].right_constraint.constraint_type_ahead "" UBYTE autosar_swc_rlgs_CM_uint8 0 0 0 255 ECU_ADDRESS 0xfe4af199 /* @ECU_Address@autosar_swc_rlgs_rtARID_DEF.ALC_Path[1].right_constraint.constraint_type_ahead@ */ /end MEASUREMENT
/begin MEASUREMENT autosar_swc_rlgs_rtARID_DEF.ALC_Path[1].right_constraint.constraint_type_change_point_dx "" FLOAT32_IEEE autosar_swc_rlgs_CM_single 0 0 -3.4E+38 3.4E+38 ECU_ADDRESS 0xfe4af19c /* @ECU_Address@autosar_swc_rlgs_rtARID_DEF.ALC_Path[1].right_constraint.constraint_type_change_point_dx@ */ /end MEASUREMENT
/begin MEASUREMENT autosar_swc_rlgs_rtARID_DEF.ALC_Path[1].right_constraint.curve.end "" FLOAT32_IEEE autosar_swc_rlgs_CM_single 0 0 -3.4E+38 3.4E+38 ECU_ADDRESS 0xfe4af1ac /* @ECU_Address@autosar_swc_rlgs_rtARID_DEF.ALC_Path[1].right_constraint.curve.end@ */ /end MEASUREMENT
/begin MEASUREMENT autosar_swc_rlgs_rtARID_DEF.ALC_Path[1].right_constraint.curve.poly_vec "" FLOAT32_IEEE autosar_swc_rlgs_CM_single 0 0 -3.4E+38 3.4E+38 LAYOUT COLUMN_DIR MATRIX_DIM 6 ECU_ADDRESS 0xfe4af1b0 /* @ECU_Address@autosar_swc_rlgs_rtARID_DEF.ALC_Path[1].right_constraint.curve.poly_vec@ */ /end MEASUREMENT
/begin MEASUREMENT autosar_swc_rlgs_rtARID_DEF.ALC_Path[1].right_constraint.curve.start "" FLOAT32_IEEE autosar_swc_rlgs_CM_single 0 0 -3.4E+38 3.4E+38 ECU_ADDRESS 0xfe4af1a8 /* @ECU_Address@autosar_swc_rlgs_rtARID_DEF.ALC_Path[1].right_constraint.curve.start@ */ /end MEASUREMENT
/begin MEASUREMENT autosar_swc_rlgs_rtARID_DEF.ALC_Path[1].right_constraint.id "" ULONG autosar_swc_rlgs_CM_uint32 0 0 0 4294967295 ECU_ADDRESS 0xfe4af1a4 /* @ECU_Address@autosar_swc_rlgs_rtARID_DEF.ALC_Path[1].right_constraint.id@ */ /end MEASUREMENT
/begin MEASUREMENT autosar_swc_rlgs_rtARID_DEF.ALC_Path[1].right_constraint.meas_state "" UBYTE autosar_swc_rlgs_CM_uint8 0 0 0 255 ECU_ADDRESS 0xfe4af19b /* @ECU_Address@autosar_swc_rlgs_rtARID_DEF.ALC_Path[1].right_constraint.meas_state@ */ /end MEASUREMENT
/begin MEASUREMENT autosar_swc_rlgs_rtARID_DEF.ALC_Path[1].right_constraint.source_type "" UBYTE autosar_swc_rlgs_CM_uint8 0 0 0 255 ECU_ADDRESS 0xfe4af19a /* @ECU_Address@autosar_swc_rlgs_rtARID_DEF.ALC_Path[1].right_constraint.source_type@ */ /end MEASUREMENT
/begin MEASUREMENT autosar_swc_rlgs_rtARID_DEF.ALC_Path[1].right_constraint.visible_end "" FLOAT32_IEEE autosar_swc_rlgs_CM_single 0 0 -3.4E+38 3.4E+38 ECU_ADDRESS 0xfe4af1a0 /* @ECU_Address@autosar_swc_rlgs_rtARID_DEF.ALC_Path[1].right_constraint.visible_end@ */ /end MEASUREMENT
/begin MEASUREMENT autosar_swc_rlgs_rtARID_DEF.ALC_Path[1].type "" UBYTE autosar_swc_rlgs_CM_uint8 0 0 0 255 ECU_ADDRESS 0xfe4af158 /* @ECU_Address@autosar_swc_rlgs_rtARID_DEF.ALC_Path[1].type@ */ /end MEASUREMENT
/begin MEASUREMENT autosar_swc_rlgs_rtARID_DEF.ALC_Path[2].arrow_dir "" UBYTE autosar_swc_rlgs_CM_uint8 0 0 0 255 ECU_ADDRESS 0xfe4af1f3 /* @ECU_Address@autosar_swc_rlgs_rtARID_DEF.ALC_Path[2].arrow_dir@ */ /end MEASUREMENT
/begin MEASUREMENT autosar_swc_rlgs_rtARID_DEF.ALC_Path[2].center_refline.calc_state "" UBYTE autosar_swc_rlgs_CM_uint8 0 0 0 255 ECU_ADDRESS 0xfe4af261 /* @ECU_Address@autosar_swc_rlgs_rtARID_DEF.ALC_Path[2].center_refline.calc_state@ */ /end MEASUREMENT
/begin MEASUREMENT autosar_swc_rlgs_rtARID_DEF.ALC_Path[2].center_refline.curve.end "" FLOAT32_IEEE autosar_swc_rlgs_CM_single 0 0 -3.4E+38 3.4E+38 ECU_ADDRESS 0xfe4af26c /* @ECU_Address@autosar_swc_rlgs_rtARID_DEF.ALC_Path[2].center_refline.curve.end@ */ /end MEASUREMENT
/begin MEASUREMENT autosar_swc_rlgs_rtARID_DEF.ALC_Path[2].center_refline.curve.poly_vec "" FLOAT32_IEEE autosar_swc_rlgs_CM_single 0 0 -3.4E+38 3.4E+38 LAYOUT COLUMN_DIR MATRIX_DIM 6 ECU_ADDRESS 0xfe4af270 /* @ECU_Address@autosar_swc_rlgs_rtARID_DEF.ALC_Path[2].center_refline.curve.poly_vec@ */ /end MEASUREMENT
/begin MEASUREMENT autosar_swc_rlgs_rtARID_DEF.ALC_Path[2].center_refline.curve.start "" FLOAT32_IEEE autosar_swc_rlgs_CM_single 0 0 -3.4E+38 3.4E+38 ECU_ADDRESS 0xfe4af268 /* @ECU_Address@autosar_swc_rlgs_rtARID_DEF.ALC_Path[2].center_refline.curve.start@ */ /end MEASUREMENT
/begin MEASUREMENT autosar_swc_rlgs_rtARID_DEF.ALC_Path[2].center_refline.id "" ULONG autosar_swc_rlgs_CM_uint32 0 0 0 4294967295 ECU_ADDRESS 0xfe4af264 /* @ECU_Address@autosar_swc_rlgs_rtARID_DEF.ALC_Path[2].center_refline.id@ */ /end MEASUREMENT
/begin MEASUREMENT autosar_swc_rlgs_rtARID_DEF.ALC_Path[2].center_refline.ref_source "" UBYTE autosar_swc_rlgs_CM_uint8 0 0 0 255 ECU_ADDRESS 0xfe4af260 /* @ECU_Address@autosar_swc_rlgs_rtARID_DEF.ALC_Path[2].center_refline.ref_source@ */ /end MEASUREMENT
/begin MEASUREMENT autosar_swc_rlgs_rtARID_DEF.ALC_Path[2].current_width "" FLOAT32_IEEE autosar_swc_rlgs_CM_single 0 0 -3.4E+38 3.4E+38 ECU_ADDRESS 0xfe4af1f4 /* @ECU_Address@autosar_swc_rlgs_rtARID_DEF.ALC_Path[2].current_width@ */ /end MEASUREMENT
/begin MEASUREMENT autosar_swc_rlgs_rtARID_DEF.ALC_Path[2].end_dist "" FLOAT32_IEEE autosar_swc_rlgs_CM_single 0 0 -3.4E+38 3.4E+38 ECU_ADDRESS 0xfe4af1f8 /* @ECU_Address@autosar_swc_rlgs_rtARID_DEF.ALC_Path[2].end_dist@ */ /end MEASUREMENT
/begin MEASUREMENT autosar_swc_rlgs_rtARID_DEF.ALC_Path[2].id "" ULONG autosar_swc_rlgs_CM_uint32 0 0 0 4294967295 ECU_ADDRESS 0xfe4af1fc /* @ECU_Address@autosar_swc_rlgs_rtARID_DEF.ALC_Path[2].id@ */ /end MEASUREMENT
/begin MEASUREMENT autosar_swc_rlgs_rtARID_DEF.ALC_Path[2].lane_extension_type "" UBYTE autosar_swc_rlgs_CM_uint8 0 0 0 255 ECU_ADDRESS 0xfe4af1f2 /* @ECU_Address@autosar_swc_rlgs_rtARID_DEF.ALC_Path[2].lane_extension_type@ */ /end MEASUREMENT
/begin MEASUREMENT autosar_swc_rlgs_rtARID_DEF.ALC_Path[2].lane_source "" UBYTE autosar_swc_rlgs_CM_uint8 0 0 0 255 ECU_ADDRESS 0xfe4af1f1 /* @ECU_Address@autosar_swc_rlgs_rtARID_DEF.ALC_Path[2].lane_source@ */ /end MEASUREMENT
/begin MEASUREMENT autosar_swc_rlgs_rtARID_DEF.ALC_Path[2].left_constraint.constraint_type "" UBYTE autosar_swc_rlgs_CM_uint8 0 0 0 255 ECU_ADDRESS 0xfe4af200 /* @ECU_Address@autosar_swc_rlgs_rtARID_DEF.ALC_Path[2].left_constraint.constraint_type@ */ /end MEASUREMENT
/begin MEASUREMENT autosar_swc_rlgs_rtARID_DEF.ALC_Path[2].left_constraint.constraint_type_ahead "" UBYTE autosar_swc_rlgs_CM_uint8 0 0 0 255 ECU_ADDRESS 0xfe4af201 /* @ECU_Address@autosar_swc_rlgs_rtARID_DEF.ALC_Path[2].left_constraint.constraint_type_ahead@ */ /end MEASUREMENT
/begin MEASUREMENT autosar_swc_rlgs_rtARID_DEF.ALC_Path[2].left_constraint.constraint_type_change_point_dx "" FLOAT32_IEEE autosar_swc_rlgs_CM_single 0 0 -3.4E+38 3.4E+38 ECU_ADDRESS 0xfe4af204 /* @ECU_Address@autosar_swc_rlgs_rtARID_DEF.ALC_Path[2].left_constraint.constraint_type_change_point_dx@ */ /end MEASUREMENT
/begin MEASUREMENT autosar_swc_rlgs_rtARID_DEF.ALC_Path[2].left_constraint.curve.end "" FLOAT32_IEEE autosar_swc_rlgs_CM_single 0 0 -3.4E+38 3.4E+38 ECU_ADDRESS 0xfe4af214 /* @ECU_Address@autosar_swc_rlgs_rtARID_DEF.ALC_Path[2].left_constraint.curve.end@ */ /end MEASUREMENT
/begin MEASUREMENT autosar_swc_rlgs_rtARID_DEF.ALC_Path[2].left_constraint.curve.poly_vec "" FLOAT32_IEEE autosar_swc_rlgs_CM_single 0 0 -3.4E+38 3.4E+38 LAYOUT COLUMN_DIR MATRIX_DIM 6 ECU_ADDRESS 0xfe4af218 /* @ECU_Address@autosar_swc_rlgs_rtARID_DEF.ALC_Path[2].left_constraint.curve.poly_vec@ */ /end MEASUREMENT
/begin MEASUREMENT autosar_swc_rlgs_rtARID_DEF.ALC_Path[2].left_constraint.curve.start "" FLOAT32_IEEE autosar_swc_rlgs_CM_single 0 0 -3.4E+38 3.4E+38 ECU_ADDRESS 0xfe4af210 /* @ECU_Address@autosar_swc_rlgs_rtARID_DEF.ALC_Path[2].left_constraint.curve.start@ */ /end MEASUREMENT
/begin MEASUREMENT autosar_swc_rlgs_rtARID_DEF.ALC_Path[2].left_constraint.id "" ULONG autosar_swc_rlgs_CM_uint32 0 0 0 4294967295 ECU_ADDRESS 0xfe4af20c /* @ECU_Address@autosar_swc_rlgs_rtARID_DEF.ALC_Path[2].left_constraint.id@ */ /end MEASUREMENT
/begin MEASUREMENT autosar_swc_rlgs_rtARID_DEF.ALC_Path[2].left_constraint.meas_state "" UBYTE autosar_swc_rlgs_CM_uint8 0 0 0 255 ECU_ADDRESS 0xfe4af203 /* @ECU_Address@autosar_swc_rlgs_rtARID_DEF.ALC_Path[2].left_constraint.meas_state@ */ /end MEASUREMENT
/begin MEASUREMENT autosar_swc_rlgs_rtARID_DEF.ALC_Path[2].left_constraint.source_type "" UBYTE autosar_swc_rlgs_CM_uint8 0 0 0 255 ECU_ADDRESS 0xfe4af202 /* @ECU_Address@autosar_swc_rlgs_rtARID_DEF.ALC_Path[2].left_constraint.source_type@ */ /end MEASUREMENT
/begin MEASUREMENT autosar_swc_rlgs_rtARID_DEF.ALC_Path[2].left_constraint.visible_end "" FLOAT32_IEEE autosar_swc_rlgs_CM_single 0 0 -3.4E+38 3.4E+38 ECU_ADDRESS 0xfe4af208 /* @ECU_Address@autosar_swc_rlgs_rtARID_DEF.ALC_Path[2].left_constraint.visible_end@ */ /end MEASUREMENT
/begin MEASUREMENT autosar_swc_rlgs_rtARID_DEF.ALC_Path[2].right_constraint.constraint_type "" UBYTE autosar_swc_rlgs_CM_uint8 0 0 0 255 ECU_ADDRESS 0xfe4af230 /* @ECU_Address@autosar_swc_rlgs_rtARID_DEF.ALC_Path[2].right_constraint.constraint_type@ */ /end MEASUREMENT
/begin MEASUREMENT autosar_swc_rlgs_rtARID_DEF.ALC_Path[2].right_constraint.constraint_type_ahead "" UBYTE autosar_swc_rlgs_CM_uint8 0 0 0 255 ECU_ADDRESS 0xfe4af231 /* @ECU_Address@autosar_swc_rlgs_rtARID_DEF.ALC_Path[2].right_constraint.constraint_type_ahead@ */ /end MEASUREMENT
/begin MEASUREMENT autosar_swc_rlgs_rtARID_DEF.ALC_Path[2].right_constraint.constraint_type_change_point_dx "" FLOAT32_IEEE autosar_swc_rlgs_CM_single 0 0 -3.4E+38 3.4E+38 ECU_ADDRESS 0xfe4af234 /* @ECU_Address@autosar_swc_rlgs_rtARID_DEF.ALC_Path[2].right_constraint.constraint_type_change_point_dx@ */ /end MEASUREMENT
/begin MEASUREMENT autosar_swc_rlgs_rtARID_DEF.ALC_Path[2].right_constraint.curve.end "" FLOAT32_IEEE autosar_swc_rlgs_CM_single 0 0 -3.4E+38 3.4E+38 ECU_ADDRESS 0xfe4af244 /* @ECU_Address@autosar_swc_rlgs_rtARID_DEF.ALC_Path[2].right_constraint.curve.end@ */ /end MEASUREMENT
/begin MEASUREMENT autosar_swc_rlgs_rtARID_DEF.ALC_Path[2].right_constraint.curve.poly_vec "" FLOAT32_IEEE autosar_swc_rlgs_CM_single 0 0 -3.4E+38 3.4E+38 LAYOUT COLUMN_DIR MATRIX_DIM 6 ECU_ADDRESS 0xfe4af248 /* @ECU_Address@autosar_swc_rlgs_rtARID_DEF.ALC_Path[2].right_constraint.curve.poly_vec@ */ /end MEASUREMENT
/begin MEASUREMENT autosar_swc_rlgs_rtARID_DEF.ALC_Path[2].right_constraint.curve.start "" FLOAT32_IEEE autosar_swc_rlgs_CM_single 0 0 -3.4E+38 3.4E+38 ECU_ADDRESS 0xfe4af240 /* @ECU_Address@autosar_swc_rlgs_rtARID_DEF.ALC_Path[2].right_constraint.curve.start@ */ /end MEASUREMENT
/begin MEASUREMENT autosar_swc_rlgs_rtARID_DEF.ALC_Path[2].right_constraint.id "" ULONG autosar_swc_rlgs_CM_uint32 0 0 0 4294967295 ECU_ADDRESS 0xfe4af23c /* @ECU_Address@autosar_swc_rlgs_rtARID_DEF.ALC_Path[2].right_constraint.id@ */ /end MEASUREMENT
/begin MEASUREMENT autosar_swc_rlgs_rtARID_DEF.ALC_Path[2].right_constraint.meas_state "" UBYTE autosar_swc_rlgs_CM_uint8 0 0 0 255 ECU_ADDRESS 0xfe4af233 /* @ECU_Address@autosar_swc_rlgs_rtARID_DEF.ALC_Path[2].right_constraint.meas_state@ */ /end MEASUREMENT
/begin MEASUREMENT autosar_swc_rlgs_rtARID_DEF.ALC_Path[2].right_constraint.source_type "" UBYTE autosar_swc_rlgs_CM_uint8 0 0 0 255 ECU_ADDRESS 0xfe4af232 /* @ECU_Address@autosar_swc_rlgs_rtARID_DEF.ALC_Path[2].right_constraint.source_type@ */ /end MEASUREMENT
/begin MEASUREMENT autosar_swc_rlgs_rtARID_DEF.ALC_Path[2].right_constraint.visible_end "" FLOAT32_IEEE autosar_swc_rlgs_CM_single 0 0 -3.4E+38 3.4E+38 ECU_ADDRESS 0xfe4af238 /* @ECU_Address@autosar_swc_rlgs_rtARID_DEF.ALC_Path[2].right_constraint.visible_end@ */ /end MEASUREMENT
/begin MEASUREMENT autosar_swc_rlgs_rtARID_DEF.ALC_Path[2].type "" UBYTE autosar_swc_rlgs_CM_uint8 0 0 0 255 ECU_ADDRESS 0xfe4af1f0 /* @ECU_Address@autosar_swc_rlgs_rtARID_DEF.ALC_Path[2].type@ */ /end MEASUREMENT
/begin MEASUREMENT autosar_swc_rlgs_rtARID_DEF.ALC_Path[3].arrow_dir "" UBYTE autosar_swc_rlgs_CM_uint8 0 0 0 255 ECU_ADDRESS 0xfe4af28b /* @ECU_Address@autosar_swc_rlgs_rtARID_DEF.ALC_Path[3].arrow_dir@ */ /end MEASUREMENT
/begin MEASUREMENT autosar_swc_rlgs_rtARID_DEF.ALC_Path[3].center_refline.calc_state "" UBYTE autosar_swc_rlgs_CM_uint8 0 0 0 255 ECU_ADDRESS 0xfe4af2f9 /* @ECU_Address@autosar_swc_rlgs_rtARID_DEF.ALC_Path[3].center_refline.calc_state@ */ /end MEASUREMENT
/begin MEASUREMENT autosar_swc_rlgs_rtARID_DEF.ALC_Path[3].center_refline.curve.end "" FLOAT32_IEEE autosar_swc_rlgs_CM_single 0 0 -3.4E+38 3.4E+38 ECU_ADDRESS 0xfe4af304 /* @ECU_Address@autosar_swc_rlgs_rtARID_DEF.ALC_Path[3].center_refline.curve.end@ */ /end MEASUREMENT
/begin MEASUREMENT autosar_swc_rlgs_rtARID_DEF.ALC_Path[3].center_refline.curve.poly_vec "" FLOAT32_IEEE autosar_swc_rlgs_CM_single 0 0 -3.4E+38 3.4E+38 LAYOUT COLUMN_DIR MATRIX_DIM 6 ECU_ADDRESS 0xfe4af308 /* @ECU_Address@autosar_swc_rlgs_rtARID_DEF.ALC_Path[3].center_refline.curve.poly_vec@ */ /end MEASUREMENT
/begin MEASUREMENT autosar_swc_rlgs_rtARID_DEF.ALC_Path[3].center_refline.curve.start "" FLOAT32_IEEE autosar_swc_rlgs_CM_single 0 0 -3.4E+38 3.4E+38 ECU_ADDRESS 0xfe4af300 /* @ECU_Address@autosar_swc_rlgs_rtARID_DEF.ALC_Path[3].center_refline.curve.start@ */ /end MEASUREMENT
/begin MEASUREMENT autosar_swc_rlgs_rtARID_DEF.ALC_Path[3].center_refline.id "" ULONG autosar_swc_rlgs_CM_uint32 0 0 0 4294967295 ECU_ADDRESS 0xfe4af2fc /* @ECU_Address@autosar_swc_rlgs_rtARID_DEF.ALC_Path[3].center_refline.id@ */ /end MEASUREMENT
/begin MEASUREMENT autosar_swc_rlgs_rtARID_DEF.ALC_Path[3].center_refline.ref_source "" UBYTE autosar_swc_rlgs_CM_uint8 0 0 0 255 ECU_ADDRESS 0xfe4af2f8 /* @ECU_Address@autosar_swc_rlgs_rtARID_DEF.ALC_Path[3].center_refline.ref_source@ */ /end MEASUREMENT
/begin MEASUREMENT autosar_swc_rlgs_rtARID_DEF.ALC_Path[3].current_width "" FLOAT32_IEEE autosar_swc_rlgs_CM_single 0 0 -3.4E+38 3.4E+38 ECU_ADDRESS 0xfe4af28c /* @ECU_Address@autosar_swc_rlgs_rtARID_DEF.ALC_Path[3].current_width@ */ /end MEASUREMENT
/begin MEASUREMENT autosar_swc_rlgs_rtARID_DEF.ALC_Path[3].end_dist "" FLOAT32_IEEE autosar_swc_rlgs_CM_single 0 0 -3.4E+38 3.4E+38 ECU_ADDRESS 0xfe4af290 /* @ECU_Address@autosar_swc_rlgs_rtARID_DEF.ALC_Path[3].end_dist@ */ /end MEASUREMENT
/begin MEASUREMENT autosar_swc_rlgs_rtARID_DEF.ALC_Path[3].id "" ULONG autosar_swc_rlgs_CM_uint32 0 0 0 4294967295 ECU_ADDRESS 0xfe4af294 /* @ECU_Address@autosar_swc_rlgs_rtARID_DEF.ALC_Path[3].id@ */ /end MEASUREMENT
/begin MEASUREMENT autosar_swc_rlgs_rtARID_DEF.ALC_Path[3].lane_extension_type "" UBYTE autosar_swc_rlgs_CM_uint8 0 0 0 255 ECU_ADDRESS 0xfe4af28a /* @ECU_Address@autosar_swc_rlgs_rtARID_DEF.ALC_Path[3].lane_extension_type@ */ /end MEASUREMENT
/begin MEASUREMENT autosar_swc_rlgs_rtARID_DEF.ALC_Path[3].lane_source "" UBYTE autosar_swc_rlgs_CM_uint8 0 0 0 255 ECU_ADDRESS 0xfe4af289 /* @ECU_Address@autosar_swc_rlgs_rtARID_DEF.ALC_Path[3].lane_source@ */ /end MEASUREMENT
/begin MEASUREMENT autosar_swc_rlgs_rtARID_DEF.ALC_Path[3].left_constraint.constraint_type "" UBYTE autosar_swc_rlgs_CM_uint8 0 0 0 255 ECU_ADDRESS 0xfe4af298 /* @ECU_Address@autosar_swc_rlgs_rtARID_DEF.ALC_Path[3].left_constraint.constraint_type@ */ /end MEASUREMENT
/begin MEASUREMENT autosar_swc_rlgs_rtARID_DEF.ALC_Path[3].left_constraint.constraint_type_ahead "" UBYTE autosar_swc_rlgs_CM_uint8 0 0 0 255 ECU_ADDRESS 0xfe4af299 /* @ECU_Address@autosar_swc_rlgs_rtARID_DEF.ALC_Path[3].left_constraint.constraint_type_ahead@ */ /end MEASUREMENT
/begin MEASUREMENT autosar_swc_rlgs_rtARID_DEF.ALC_Path[3].left_constraint.constraint_type_change_point_dx "" FLOAT32_IEEE autosar_swc_rlgs_CM_single 0 0 -3.4E+38 3.4E+38 ECU_ADDRESS 0xfe4af29c /* @ECU_Address@autosar_swc_rlgs_rtARID_DEF.ALC_Path[3].left_constraint.constraint_type_change_point_dx@ */ /end MEASUREMENT
/begin MEASUREMENT autosar_swc_rlgs_rtARID_DEF.ALC_Path[3].left_constraint.curve.end "" FLOAT32_IEEE autosar_swc_rlgs_CM_single 0 0 -3.4E+38 3.4E+38 ECU_ADDRESS 0xfe4af2ac /* @ECU_Address@autosar_swc_rlgs_rtARID_DEF.ALC_Path[3].left_constraint.curve.end@ */ /end MEASUREMENT
/begin MEASUREMENT autosar_swc_rlgs_rtARID_DEF.ALC_Path[3].left_constraint.curve.poly_vec "" FLOAT32_IEEE autosar_swc_rlgs_CM_single 0 0 -3.4E+38 3.4E+38 LAYOUT COLUMN_DIR MATRIX_DIM 6 ECU_ADDRESS 0xfe4af2b0 /* @ECU_Address@autosar_swc_rlgs_rtARID_DEF.ALC_Path[3].left_constraint.curve.poly_vec@ */ /end MEASUREMENT
/begin MEASUREMENT autosar_swc_rlgs_rtARID_DEF.ALC_Path[3].left_constraint.curve.start "" FLOAT32_IEEE autosar_swc_rlgs_CM_single 0 0 -3.4E+38 3.4E+38 ECU_ADDRESS 0xfe4af2a8 /* @ECU_Address@autosar_swc_rlgs_rtARID_DEF.ALC_Path[3].left_constraint.curve.start@ */ /end MEASUREMENT
/begin MEASUREMENT autosar_swc_rlgs_rtARID_DEF.ALC_Path[3].left_constraint.id "" ULONG autosar_swc_rlgs_CM_uint32 0 0 0 4294967295 ECU_ADDRESS 0xfe4af2a4 /* @ECU_Address@autosar_swc_rlgs_rtARID_DEF.ALC_Path[3].left_constraint.id@ */ /end MEASUREMENT
/begin MEASUREMENT autosar_swc_rlgs_rtARID_DEF.ALC_Path[3].left_constraint.meas_state "" UBYTE autosar_swc_rlgs_CM_uint8 0 0 0 255 ECU_ADDRESS 0xfe4af29b /* @ECU_Address@autosar_swc_rlgs_rtARID_DEF.ALC_Path[3].left_constraint.meas_state@ */ /end MEASUREMENT
/begin MEASUREMENT autosar_swc_rlgs_rtARID_DEF.ALC_Path[3].left_constraint.source_type "" UBYTE autosar_swc_rlgs_CM_uint8 0 0 0 255 ECU_ADDRESS 0xfe4af29a /* @ECU_Address@autosar_swc_rlgs_rtARID_DEF.ALC_Path[3].left_constraint.source_type@ */ /end MEASUREMENT
/begin MEASUREMENT autosar_swc_rlgs_rtARID_DEF.ALC_Path[3].left_constraint.visible_end "" FLOAT32_IEEE autosar_swc_rlgs_CM_single 0 0 -3.4E+38 3.4E+38 ECU_ADDRESS 0xfe4af2a0 /* @ECU_Address@autosar_swc_rlgs_rtARID_DEF.ALC_Path[3].left_constraint.visible_end@ */ /end MEASUREMENT
/begin MEASUREMENT autosar_swc_rlgs_rtARID_DEF.ALC_Path[3].right_constraint.constraint_type "" UBYTE autosar_swc_rlgs_CM_uint8 0 0 0 255 ECU_ADDRESS 0xfe4af2c8 /* @ECU_Address@autosar_swc_rlgs_rtARID_DEF.ALC_Path[3].right_constraint.constraint_type@ */ /end MEASUREMENT
/begin MEASUREMENT autosar_swc_rlgs_rtARID_DEF.ALC_Path[3].right_constraint.constraint_type_ahead "" UBYTE autosar_swc_rlgs_CM_uint8 0 0 0 255 ECU_ADDRESS 0xfe4af2c9 /* @ECU_Address@autosar_swc_rlgs_rtARID_DEF.ALC_Path[3].right_constraint.constraint_type_ahead@ */ /end MEASUREMENT
/begin MEASUREMENT autosar_swc_rlgs_rtARID_DEF.ALC_Path[3].right_constraint.constraint_type_change_point_dx "" FLOAT32_IEEE autosar_swc_rlgs_CM_single 0 0 -3.4E+38 3.4E+38 ECU_ADDRESS 0xfe4af2cc /* @ECU_Address@autosar_swc_rlgs_rtARID_DEF.ALC_Path[3].right_constraint.constraint_type_change_point_dx@ */ /end MEASUREMENT
/begin MEASUREMENT autosar_swc_rlgs_rtARID_DEF.ALC_Path[3].right_constraint.curve.end "" FLOAT32_IEEE autosar_swc_rlgs_CM_single 0 0 -3.4E+38 3.4E+38 ECU_ADDRESS 0xfe4af2dc /* @ECU_Address@autosar_swc_rlgs_rtARID_DEF.ALC_Path[3].right_constraint.curve.end@ */ /end MEASUREMENT
/begin MEASUREMENT autosar_swc_rlgs_rtARID_DEF.ALC_Path[3].right_constraint.curve.poly_vec "" FLOAT32_IEEE autosar_swc_rlgs_CM_single 0 0 -3.4E+38 3.4E+38 LAYOUT COLUMN_DIR MATRIX_DIM 6 ECU_ADDRESS 0xfe4af2e0 /* @ECU_Address@autosar_swc_rlgs_rtARID_DEF.ALC_Path[3].right_constraint.curve.poly_vec@ */ /end MEASUREMENT
/begin MEASUREMENT autosar_swc_rlgs_rtARID_DEF.ALC_Path[3].right_constraint.curve.start "" FLOAT32_IEEE autosar_swc_rlgs_CM_single 0 0 -3.4E+38 3.4E+38 ECU_ADDRESS 0xfe4af2d8 /* @ECU_Address@autosar_swc_rlgs_rtARID_DEF.ALC_Path[3].right_constraint.curve.start@ */ /end MEASUREMENT
/begin MEASUREMENT autosar_swc_rlgs_rtARID_DEF.ALC_Path[3].right_constraint.id "" ULONG autosar_swc_rlgs_CM_uint32 0 0 0 4294967295 ECU_ADDRESS 0xfe4af2d4 /* @ECU_Address@autosar_swc_rlgs_rtARID_DEF.ALC_Path[3].right_constraint.id@ */ /end MEASUREMENT
/begin MEASUREMENT autosar_swc_rlgs_rtARID_DEF.ALC_Path[3].right_constraint.meas_state "" UBYTE autosar_swc_rlgs_CM_uint8 0 0 0 255 ECU_ADDRESS 0xfe4af2cb /* @ECU_Address@autosar_swc_rlgs_rtARID_DEF.ALC_Path[3].right_constraint.meas_state@ */ /end MEASUREMENT
/begin MEASUREMENT autosar_swc_rlgs_rtARID_DEF.ALC_Path[3].right_constraint.source_type "" UBYTE autosar_swc_rlgs_CM_uint8 0 0 0 255 ECU_ADDRESS 0xfe4af2ca /* @ECU_Address@autosar_swc_rlgs_rtARID_DEF.ALC_Path[3].right_constraint.source_type@ */ /end MEASUREMENT
/begin MEASUREMENT autosar_swc_rlgs_rtARID_DEF.ALC_Path[3].right_constraint.visible_end "" FLOAT32_IEEE autosar_swc_rlgs_CM_single 0 0 -3.4E+38 3.4E+38 ECU_ADDRESS 0xfe4af2d0 /* @ECU_Address@autosar_swc_rlgs_rtARID_DEF.ALC_Path[3].right_constraint.visible_end@ */ /end MEASUREMENT
/begin MEASUREMENT autosar_swc_rlgs_rtARID_DEF.ALC_Path[3].type "" UBYTE autosar_swc_rlgs_CM_uint8 0 0 0 255 ECU_ADDRESS 0xfe4af288 /* @ECU_Address@autosar_swc_rlgs_rtARID_DEF.ALC_Path[3].type@ */ /end MEASUREMENT
/begin MEASUREMENT autosar_swc_rlgs_rtARID_DEF.ALC_Path[4].arrow_dir "" UBYTE autosar_swc_rlgs_CM_uint8 0 0 0 255 ECU_ADDRESS 0xfe4af323 /* @ECU_Address@autosar_swc_rlgs_rtARID_DEF.ALC_Path[4].arrow_dir@ */ /end MEASUREMENT
/begin MEASUREMENT autosar_swc_rlgs_rtARID_DEF.ALC_Path[4].center_refline.calc_state "" UBYTE autosar_swc_rlgs_CM_uint8 0 0 0 255 ECU_ADDRESS 0xfe4af391 /* @ECU_Address@autosar_swc_rlgs_rtARID_DEF.ALC_Path[4].center_refline.calc_state@ */ /end MEASUREMENT
/begin MEASUREMENT autosar_swc_rlgs_rtARID_DEF.ALC_Path[4].center_refline.curve.end "" FLOAT32_IEEE autosar_swc_rlgs_CM_single 0 0 -3.4E+38 3.4E+38 ECU_ADDRESS 0xfe4af39c /* @ECU_Address@autosar_swc_rlgs_rtARID_DEF.ALC_Path[4].center_refline.curve.end@ */ /end MEASUREMENT
/begin MEASUREMENT autosar_swc_rlgs_rtARID_DEF.ALC_Path[4].center_refline.curve.poly_vec "" FLOAT32_IEEE autosar_swc_rlgs_CM_single 0 0 -3.4E+38 3.4E+38 LAYOUT COLUMN_DIR MATRIX_DIM 6 ECU_ADDRESS 0xfe4af3a0 /* @ECU_Address@autosar_swc_rlgs_rtARID_DEF.ALC_Path[4].center_refline.curve.poly_vec@ */ /end MEASUREMENT
/begin MEASUREMENT autosar_swc_rlgs_rtARID_DEF.ALC_Path[4].center_refline.curve.start "" FLOAT32_IEEE autosar_swc_rlgs_CM_single 0 0 -3.4E+38 3.4E+38 ECU_ADDRESS 0xfe4af398 /* @ECU_Address@autosar_swc_rlgs_rtARID_DEF.ALC_Path[4].center_refline.curve.start@ */ /end MEASUREMENT
/begin MEASUREMENT autosar_swc_rlgs_rtARID_DEF.ALC_Path[4].center_refline.id "" ULONG autosar_swc_rlgs_CM_uint32 0 0 0 4294967295 ECU_ADDRESS 0xfe4af394 /* @ECU_Address@autosar_swc_rlgs_rtARID_DEF.ALC_Path[4].center_refline.id@ */ /end MEASUREMENT
/begin MEASUREMENT autosar_swc_rlgs_rtARID_DEF.ALC_Path[4].center_refline.ref_source "" UBYTE autosar_swc_rlgs_CM_uint8 0 0 0 255 ECU_ADDRESS 0xfe4af390 /* @ECU_Address@autosar_swc_rlgs_rtARID_DEF.ALC_Path[4].center_refline.ref_source@ */ /end MEASUREMENT
/begin MEASUREMENT autosar_swc_rlgs_rtARID_DEF.ALC_Path[4].current_width "" FLOAT32_IEEE autosar_swc_rlgs_CM_single 0 0 -3.4E+38 3.4E+38 ECU_ADDRESS 0xfe4af324 /* @ECU_Address@autosar_swc_rlgs_rtARID_DEF.ALC_Path[4].current_width@ */ /end MEASUREMENT
/begin MEASUREMENT autosar_swc_rlgs_rtARID_DEF.ALC_Path[4].end_dist "" FLOAT32_IEEE autosar_swc_rlgs_CM_single 0 0 -3.4E+38 3.4E+38 ECU_ADDRESS 0xfe4af328 /* @ECU_Address@autosar_swc_rlgs_rtARID_DEF.ALC_Path[4].end_dist@ */ /end MEASUREMENT
/begin MEASUREMENT autosar_swc_rlgs_rtARID_DEF.ALC_Path[4].id "" ULONG autosar_swc_rlgs_CM_uint32 0 0 0 4294967295 ECU_ADDRESS 0xfe4af32c /* @ECU_Address@autosar_swc_rlgs_rtARID_DEF.ALC_Path[4].id@ */ /end MEASUREMENT
/begin MEASUREMENT autosar_swc_rlgs_rtARID_DEF.ALC_Path[4].lane_extension_type "" UBYTE autosar_swc_rlgs_CM_uint8 0 0 0 255 ECU_ADDRESS 0xfe4af322 /* @ECU_Address@autosar_swc_rlgs_rtARID_DEF.ALC_Path[4].lane_extension_type@ */ /end MEASUREMENT
/begin MEASUREMENT autosar_swc_rlgs_rtARID_DEF.ALC_Path[4].lane_source "" UBYTE autosar_swc_rlgs_CM_uint8 0 0 0 255 ECU_ADDRESS 0xfe4af321 /* @ECU_Address@autosar_swc_rlgs_rtARID_DEF.ALC_Path[4].lane_source@ */ /end MEASUREMENT
/begin MEASUREMENT autosar_swc_rlgs_rtARID_DEF.ALC_Path[4].left_constraint.constraint_type "" UBYTE autosar_swc_rlgs_CM_uint8 0 0 0 255 ECU_ADDRESS 0xfe4af330 /* @ECU_Address@autosar_swc_rlgs_rtARID_DEF.ALC_Path[4].left_constraint.constraint_type@ */ /end MEASUREMENT
/begin MEASUREMENT autosar_swc_rlgs_rtARID_DEF.ALC_Path[4].left_constraint.constraint_type_ahead "" UBYTE autosar_swc_rlgs_CM_uint8 0 0 0 255 ECU_ADDRESS 0xfe4af331 /* @ECU_Address@autosar_swc_rlgs_rtARID_DEF.ALC_Path[4].left_constraint.constraint_type_ahead@ */ /end MEASUREMENT
/begin MEASUREMENT autosar_swc_rlgs_rtARID_DEF.ALC_Path[4].left_constraint.constraint_type_change_point_dx "" FLOAT32_IEEE autosar_swc_rlgs_CM_single 0 0 -3.4E+38 3.4E+38 ECU_ADDRESS 0xfe4af334 /* @ECU_Address@autosar_swc_rlgs_rtARID_DEF.ALC_Path[4].left_constraint.constraint_type_change_point_dx@ */ /end MEASUREMENT
/begin MEASUREMENT autosar_swc_rlgs_rtARID_DEF.ALC_Path[4].left_constraint.curve.end "" FLOAT32_IEEE autosar_swc_rlgs_CM_single 0 0 -3.4E+38 3.4E+38 ECU_ADDRESS 0xfe4af344 /* @ECU_Address@autosar_swc_rlgs_rtARID_DEF.ALC_Path[4].left_constraint.curve.end@ */ /end MEASUREMENT
/begin MEASUREMENT autosar_swc_rlgs_rtARID_DEF.ALC_Path[4].left_constraint.curve.poly_vec "" FLOAT32_IEEE autosar_swc_rlgs_CM_single 0 0 -3.4E+38 3.4E+38 LAYOUT COLUMN_DIR MATRIX_DIM 6 ECU_ADDRESS 0xfe4af348 /* @ECU_Address@autosar_swc_rlgs_rtARID_DEF.ALC_Path[4].left_constraint.curve.poly_vec@ */ /end MEASUREMENT
/begin MEASUREMENT autosar_swc_rlgs_rtARID_DEF.ALC_Path[4].left_constraint.curve.start "" FLOAT32_IEEE autosar_swc_rlgs_CM_single 0 0 -3.4E+38 3.4E+38 ECU_ADDRESS 0xfe4af340 /* @ECU_Address@autosar_swc_rlgs_rtARID_DEF.ALC_Path[4].left_constraint.curve.start@ */ /end MEASUREMENT
/begin MEASUREMENT autosar_swc_rlgs_rtARID_DEF.ALC_Path[4].left_constraint.id "" ULONG autosar_swc_rlgs_CM_uint32 0 0 0 4294967295 ECU_ADDRESS 0xfe4af33c /* @ECU_Address@autosar_swc_rlgs_rtARID_DEF.ALC_Path[4].left_constraint.id@ */ /end MEASUREMENT
/begin MEASUREMENT autosar_swc_rlgs_rtARID_DEF.ALC_Path[4].left_constraint.meas_state "" UBYTE autosar_swc_rlgs_CM_uint8 0 0 0 255 ECU_ADDRESS 0xfe4af333 /* @ECU_Address@autosar_swc_rlgs_rtARID_DEF.ALC_Path[4].left_constraint.meas_state@ */ /end MEASUREMENT
/begin MEASUREMENT autosar_swc_rlgs_rtARID_DEF.ALC_Path[4].left_constraint.source_type "" UBYTE autosar_swc_rlgs_CM_uint8 0 0 0 255 ECU_ADDRESS 0xfe4af332 /* @ECU_Address@autosar_swc_rlgs_rtARID_DEF.ALC_Path[4].left_constraint.source_type@ */ /end MEASUREMENT
/begin MEASUREMENT autosar_swc_rlgs_rtARID_DEF.ALC_Path[4].left_constraint.visible_end "" FLOAT32_IEEE autosar_swc_rlgs_CM_single 0 0 -3.4E+38 3.4E+38 ECU_ADDRESS 0xfe4af338 /* @ECU_Address@autosar_swc_rlgs_rtARID_DEF.ALC_Path[4].left_constraint.visible_end@ */ /end MEASUREMENT
/begin MEASUREMENT autosar_swc_rlgs_rtARID_DEF.ALC_Path[4].right_constraint.constraint_type "" UBYTE autosar_swc_rlgs_CM_uint8 0 0 0 255 ECU_ADDRESS 0xfe4af360 /* @ECU_Address@autosar_swc_rlgs_rtARID_DEF.ALC_Path[4].right_constraint.constraint_type@ */ /end MEASUREMENT
/begin MEASUREMENT autosar_swc_rlgs_rtARID_DEF.ALC_Path[4].right_constraint.constraint_type_ahead "" UBYTE autosar_swc_rlgs_CM_uint8 0 0 0 255 ECU_ADDRESS 0xfe4af361 /* @ECU_Address@autosar_swc_rlgs_rtARID_DEF.ALC_Path[4].right_constraint.constraint_type_ahead@ */ /end MEASUREMENT
/begin MEASUREMENT autosar_swc_rlgs_rtARID_DEF.ALC_Path[4].right_constraint.constraint_type_change_point_dx "" FLOAT32_IEEE autosar_swc_rlgs_CM_single 0 0 -3.4E+38 3.4E+38 ECU_ADDRESS 0xfe4af364 /* @ECU_Address@autosar_swc_rlgs_rtARID_DEF.ALC_Path[4].right_constraint.constraint_type_change_point_dx@ */ /end MEASUREMENT
/begin MEASUREMENT autosar_swc_rlgs_rtARID_DEF.ALC_Path[4].right_constraint.curve.end "" FLOAT32_IEEE autosar_swc_rlgs_CM_single 0 0 -3.4E+38 3.4E+38 ECU_ADDRESS 0xfe4af374 /* @ECU_Address@autosar_swc_rlgs_rtARID_DEF.ALC_Path[4].right_constraint.curve.end@ */ /end MEASUREMENT
/begin MEASUREMENT autosar_swc_rlgs_rtARID_DEF.ALC_Path[4].right_constraint.curve.poly_vec "" FLOAT32_IEEE autosar_swc_rlgs_CM_single 0 0 -3.4E+38 3.4E+38 LAYOUT COLUMN_DIR MATRIX_DIM 6 ECU_ADDRESS 0xfe4af378 /* @ECU_Address@autosar_swc_rlgs_rtARID_DEF.ALC_Path[4].right_constraint.curve.poly_vec@ */ /end MEASUREMENT
/begin MEASUREMENT autosar_swc_rlgs_rtARID_DEF.ALC_Path[4].right_constraint.curve.start "" FLOAT32_IEEE autosar_swc_rlgs_CM_single 0 0 -3.4E+38 3.4E+38 ECU_ADDRESS 0xfe4af370 /* @ECU_Address@autosar_swc_rlgs_rtARID_DEF.ALC_Path[4].right_constraint.curve.start@ */ /end MEASUREMENT
/begin MEASUREMENT autosar_swc_rlgs_rtARID_DEF.ALC_Path[4].right_constraint.id "" ULONG autosar_swc_rlgs_CM_uint32 0 0 0 4294967295 ECU_ADDRESS 0xfe4af36c /* @ECU_Address@autosar_swc_rlgs_rtARID_DEF.ALC_Path[4].right_constraint.id@ */ /end MEASUREMENT
/begin MEASUREMENT autosar_swc_rlgs_rtARID_DEF.ALC_Path[4].right_constraint.meas_state "" UBYTE autosar_swc_rlgs_CM_uint8 0 0 0 255 ECU_ADDRESS 0xfe4af363 /* @ECU_Address@autosar_swc_rlgs_rtARID_DEF.ALC_Path[4].right_constraint.meas_state@ */ /end MEASUREMENT
/begin MEASUREMENT autosar_swc_rlgs_rtARID_DEF.ALC_Path[4].right_constraint.source_type "" UBYTE autosar_swc_rlgs_CM_uint8 0 0 0 255 ECU_ADDRESS 0xfe4af362 /* @ECU_Address@autosar_swc_rlgs_rtARID_DEF.ALC_Path[4].right_constraint.source_type@ */ /end MEASUREMENT
/begin MEASUREMENT autosar_swc_rlgs_rtARID_DEF.ALC_Path[4].right_constraint.visible_end "" FLOAT32_IEEE autosar_swc_rlgs_CM_single 0 0 -3.4E+38 3.4E+38 ECU_ADDRESS 0xfe4af368 /* @ECU_Address@autosar_swc_rlgs_rtARID_DEF.ALC_Path[4].right_constraint.visible_end@ */ /end MEASUREMENT
/begin MEASUREMENT autosar_swc_rlgs_rtARID_DEF.ALC_Path[4].type "" UBYTE autosar_swc_rlgs_CM_uint8 0 0 0 255 ECU_ADDRESS 0xfe4af320 /* @ECU_Address@autosar_swc_rlgs_rtARID_DEF.ALC_Path[4].type@ */ /end MEASUREMENT
/begin MEASUREMENT autosar_swc_rlgs_rtARID_DEF.ALC_Path[5].arrow_dir "" UBYTE autosar_swc_rlgs_CM_uint8 0 0 0 255 ECU_ADDRESS 0xfe4af3bb /* @ECU_Address@autosar_swc_rlgs_rtARID_DEF.ALC_Path[5].arrow_dir@ */ /end MEASUREMENT
/begin MEASUREMENT autosar_swc_rlgs_rtARID_DEF.ALC_Path[5].center_refline.calc_state "" UBYTE autosar_swc_rlgs_CM_uint8 0 0 0 255 ECU_ADDRESS 0xfe4af429 /* @ECU_Address@autosar_swc_rlgs_rtARID_DEF.ALC_Path[5].center_refline.calc_state@ */ /end MEASUREMENT
/begin MEASUREMENT autosar_swc_rlgs_rtARID_DEF.ALC_Path[5].center_refline.curve.end "" FLOAT32_IEEE autosar_swc_rlgs_CM_single 0 0 -3.4E+38 3.4E+38 ECU_ADDRESS 0xfe4af434 /* @ECU_Address@autosar_swc_rlgs_rtARID_DEF.ALC_Path[5].center_refline.curve.end@ */ /end MEASUREMENT
/begin MEASUREMENT autosar_swc_rlgs_rtARID_DEF.ALC_Path[5].center_refline.curve.poly_vec "" FLOAT32_IEEE autosar_swc_rlgs_CM_single 0 0 -3.4E+38 3.4E+38 LAYOUT COLUMN_DIR MATRIX_DIM 6 ECU_ADDRESS 0xfe4af438 /* @ECU_Address@autosar_swc_rlgs_rtARID_DEF.ALC_Path[5].center_refline.curve.poly_vec@ */ /end MEASUREMENT
/begin MEASUREMENT autosar_swc_rlgs_rtARID_DEF.ALC_Path[5].center_refline.curve.start "" FLOAT32_IEEE autosar_swc_rlgs_CM_single 0 0 -3.4E+38 3.4E+38 ECU_ADDRESS 0xfe4af430 /* @ECU_Address@autosar_swc_rlgs_rtARID_DEF.ALC_Path[5].center_refline.curve.start@ */ /end MEASUREMENT
/begin MEASUREMENT autosar_swc_rlgs_rtARID_DEF.ALC_Path[5].center_refline.id "" ULONG autosar_swc_rlgs_CM_uint32 0 0 0 4294967295 ECU_ADDRESS 0xfe4af42c /* @ECU_Address@autosar_swc_rlgs_rtARID_DEF.ALC_Path[5].center_refline.id@ */ /end MEASUREMENT
/begin MEASUREMENT autosar_swc_rlgs_rtARID_DEF.ALC_Path[5].center_refline.ref_source "" UBYTE autosar_swc_rlgs_CM_uint8 0 0 0 255 ECU_ADDRESS 0xfe4af428 /* @ECU_Address@autosar_swc_rlgs_rtARID_DEF.ALC_Path[5].center_refline.ref_source@ */ /end MEASUREMENT
/begin MEASUREMENT autosar_swc_rlgs_rtARID_DEF.ALC_Path[5].current_width "" FLOAT32_IEEE autosar_swc_rlgs_CM_single 0 0 -3.4E+38 3.4E+38 ECU_ADDRESS 0xfe4af3bc /* @ECU_Address@autosar_swc_rlgs_rtARID_DEF.ALC_Path[5].current_width@ */ /end MEASUREMENT
/begin MEASUREMENT autosar_swc_rlgs_rtARID_DEF.ALC_Path[5].end_dist "" FLOAT32_IEEE autosar_swc_rlgs_CM_single 0 0 -3.4E+38 3.4E+38 ECU_ADDRESS 0xfe4af3c0 /* @ECU_Address@autosar_swc_rlgs_rtARID_DEF.ALC_Path[5].end_dist@ */ /end MEASUREMENT
/begin MEASUREMENT autosar_swc_rlgs_rtARID_DEF.ALC_Path[5].id "" ULONG autosar_swc_rlgs_CM_uint32 0 0 0 4294967295 ECU_ADDRESS 0xfe4af3c4 /* @ECU_Address@autosar_swc_rlgs_rtARID_DEF.ALC_Path[5].id@ */ /end MEASUREMENT
/begin MEASUREMENT autosar_swc_rlgs_rtARID_DEF.ALC_Path[5].lane_extension_type "" UBYTE autosar_swc_rlgs_CM_uint8 0 0 0 255 ECU_ADDRESS 0xfe4af3ba /* @ECU_Address@autosar_swc_rlgs_rtARID_DEF.ALC_Path[5].lane_extension_type@ */ /end MEASUREMENT
/begin MEASUREMENT autosar_swc_rlgs_rtARID_DEF.ALC_Path[5].lane_source "" UBYTE autosar_swc_rlgs_CM_uint8 0 0 0 255 ECU_ADDRESS 0xfe4af3b9 /* @ECU_Address@autosar_swc_rlgs_rtARID_DEF.ALC_Path[5].lane_source@ */ /end MEASUREMENT
/begin MEASUREMENT autosar_swc_rlgs_rtARID_DEF.ALC_Path[5].left_constraint.constraint_type "" UBYTE autosar_swc_rlgs_CM_uint8 0 0 0 255 ECU_ADDRESS 0xfe4af3c8 /* @ECU_Address@autosar_swc_rlgs_rtARID_DEF.ALC_Path[5].left_constraint.constraint_type@ */ /end MEASUREMENT
/begin MEASUREMENT autosar_swc_rlgs_rtARID_DEF.ALC_Path[5].left_constraint.constraint_type_ahead "" UBYTE autosar_swc_rlgs_CM_uint8 0 0 0 255 ECU_ADDRESS 0xfe4af3c9 /* @ECU_Address@autosar_swc_rlgs_rtARID_DEF.ALC_Path[5].left_constraint.constraint_type_ahead@ */ /end MEASUREMENT
/begin MEASUREMENT autosar_swc_rlgs_rtARID_DEF.ALC_Path[5].left_constraint.constraint_type_change_point_dx "" FLOAT32_IEEE autosar_swc_rlgs_CM_single 0 0 -3.4E+38 3.4E+38 ECU_ADDRESS 0xfe4af3cc /* @ECU_Address@autosar_swc_rlgs_rtARID_DEF.ALC_Path[5].left_constraint.constraint_type_change_point_dx@ */ /end MEASUREMENT
/begin MEASUREMENT autosar_swc_rlgs_rtARID_DEF.ALC_Path[5].left_constraint.curve.end "" FLOAT32_IEEE autosar_swc_rlgs_CM_single 0 0 -3.4E+38 3.4E+38 ECU_ADDRESS 0xfe4af3dc /* @ECU_Address@autosar_swc_rlgs_rtARID_DEF.ALC_Path[5].left_constraint.curve.end@ */ /end MEASUREMENT
/begin MEASUREMENT autosar_swc_rlgs_rtARID_DEF.ALC_Path[5].left_constraint.curve.poly_vec "" FLOAT32_IEEE autosar_swc_rlgs_CM_single 0 0 -3.4E+38 3.4E+38 LAYOUT COLUMN_DIR MATRIX_DIM 6 ECU_ADDRESS 0xfe4af3e0 /* @ECU_Address@autosar_swc_rlgs_rtARID_DEF.ALC_Path[5].left_constraint.curve.poly_vec@ */ /end MEASUREMENT
/begin MEASUREMENT autosar_swc_rlgs_rtARID_DEF.ALC_Path[5].left_constraint.curve.start "" FLOAT32_IEEE autosar_swc_rlgs_CM_single 0 0 -3.4E+38 3.4E+38 ECU_ADDRESS 0xfe4af3d8 /* @ECU_Address@autosar_swc_rlgs_rtARID_DEF.ALC_Path[5].left_constraint.curve.start@ */ /end MEASUREMENT
/begin MEASUREMENT autosar_swc_rlgs_rtARID_DEF.ALC_Path[5].left_constraint.id "" ULONG autosar_swc_rlgs_CM_uint32 0 0 0 4294967295 ECU_ADDRESS 0xfe4af3d4 /* @ECU_Address@autosar_swc_rlgs_rtARID_DEF.ALC_Path[5].left_constraint.id@ */ /end MEASUREMENT
/begin MEASUREMENT autosar_swc_rlgs_rtARID_DEF.ALC_Path[5].left_constraint.meas_state "" UBYTE autosar_swc_rlgs_CM_uint8 0 0 0 255 ECU_ADDRESS 0xfe4af3cb /* @ECU_Address@autosar_swc_rlgs_rtARID_DEF.ALC_Path[5].left_constraint.meas_state@ */ /end MEASUREMENT
/begin MEASUREMENT autosar_swc_rlgs_rtARID_DEF.ALC_Path[5].left_constraint.source_type "" UBYTE autosar_swc_rlgs_CM_uint8 0 0 0 255 ECU_ADDRESS 0xfe4af3ca /* @ECU_Address@autosar_swc_rlgs_rtARID_DEF.ALC_Path[5].left_constraint.source_type@ */ /end MEASUREMENT
/begin MEASUREMENT autosar_swc_rlgs_rtARID_DEF.ALC_Path[5].left_constraint.visible_end "" FLOAT32_IEEE autosar_swc_rlgs_CM_single 0 0 -3.4E+38 3.4E+38 ECU_ADDRESS 0xfe4af3d0 /* @ECU_Address@autosar_swc_rlgs_rtARID_DEF.ALC_Path[5].left_constraint.visible_end@ */ /end MEASUREMENT
/begin MEASUREMENT autosar_swc_rlgs_rtARID_DEF.ALC_Path[5].right_constraint.constraint_type "" UBYTE autosar_swc_rlgs_CM_uint8 0 0 0 255 ECU_ADDRESS 0xfe4af3f8 /* @ECU_Address@autosar_swc_rlgs_rtARID_DEF.ALC_Path[5].right_constraint.constraint_type@ */ /end MEASUREMENT
/begin MEASUREMENT autosar_swc_rlgs_rtARID_DEF.ALC_Path[5].right_constraint.constraint_type_ahead "" UBYTE autosar_swc_rlgs_CM_uint8 0 0 0 255 ECU_ADDRESS 0xfe4af3f9 /* @ECU_Address@autosar_swc_rlgs_rtARID_DEF.ALC_Path[5].right_constraint.constraint_type_ahead@ */ /end MEASUREMENT
/begin MEASUREMENT autosar_swc_rlgs_rtARID_DEF.ALC_Path[5].right_constraint.constraint_type_change_point_dx "" FLOAT32_IEEE autosar_swc_rlgs_CM_single 0 0 -3.4E+38 3.4E+38 ECU_ADDRESS 0xfe4af3fc /* @ECU_Address@autosar_swc_rlgs_rtARID_DEF.ALC_Path[5].right_constraint.constraint_type_change_point_dx@ */ /end MEASUREMENT
/begin MEASUREMENT autosar_swc_rlgs_rtARID_DEF.ALC_Path[5].right_constraint.curve.end "" FLOAT32_IEEE autosar_swc_rlgs_CM_single 0 0 -3.4E+38 3.4E+38 ECU_ADDRESS 0xfe4af40c /* @ECU_Address@autosar_swc_rlgs_rtARID_DEF.ALC_Path[5].right_constraint.curve.end@ */ /end MEASUREMENT
/begin MEASUREMENT autosar_swc_rlgs_rtARID_DEF.ALC_Path[5].right_constraint.curve.poly_vec "" FLOAT32_IEEE autosar_swc_rlgs_CM_single 0 0 -3.4E+38 3.4E+38 LAYOUT COLUMN_DIR MATRIX_DIM 6 ECU_ADDRESS 0xfe4af410 /* @ECU_Address@autosar_swc_rlgs_rtARID_DEF.ALC_Path[5].right_constraint.curve.poly_vec@ */ /end MEASUREMENT
/begin MEASUREMENT autosar_swc_rlgs_rtARID_DEF.ALC_Path[5].right_constraint.curve.start "" FLOAT32_IEEE autosar_swc_rlgs_CM_single 0 0 -3.4E+38 3.4E+38 ECU_ADDRESS 0xfe4af408 /* @ECU_Address@autosar_swc_rlgs_rtARID_DEF.ALC_Path[5].right_constraint.curve.start@ */ /end MEASUREMENT
/begin MEASUREMENT autosar_swc_rlgs_rtARID_DEF.ALC_Path[5].right_constraint.id "" ULONG autosar_swc_rlgs_CM_uint32 0 0 0 4294967295 ECU_ADDRESS 0xfe4af404 /* @ECU_Address@autosar_swc_rlgs_rtARID_DEF.ALC_Path[5].right_constraint.id@ */ /end MEASUREMENT
/begin MEASUREMENT autosar_swc_rlgs_rtARID_DEF.ALC_Path[5].right_constraint.meas_state "" UBYTE autosar_swc_rlgs_CM_uint8 0 0 0 255 ECU_ADDRESS 0xfe4af3fb /* @ECU_Address@autosar_swc_rlgs_rtARID_DEF.ALC_Path[5].right_constraint.meas_state@ */ /end MEASUREMENT
/begin MEASUREMENT autosar_swc_rlgs_rtARID_DEF.ALC_Path[5].right_constraint.source_type "" UBYTE autosar_swc_rlgs_CM_uint8 0 0 0 255 ECU_ADDRESS 0xfe4af3fa /* @ECU_Address@autosar_swc_rlgs_rtARID_DEF.ALC_Path[5].right_constraint.source_type@ */ /end MEASUREMENT
/begin MEASUREMENT autosar_swc_rlgs_rtARID_DEF.ALC_Path[5].right_constraint.visible_end "" FLOAT32_IEEE autosar_swc_rlgs_CM_single 0 0 -3.4E+38 3.4E+38 ECU_ADDRESS 0xfe4af400 /* @ECU_Address@autosar_swc_rlgs_rtARID_DEF.ALC_Path[5].right_constraint.visible_end@ */ /end MEASUREMENT
/begin MEASUREMENT autosar_swc_rlgs_rtARID_DEF.ALC_Path[5].type "" UBYTE autosar_swc_rlgs_CM_uint8 0 0 0 255 ECU_ADDRESS 0xfe4af3b8 /* @ECU_Address@autosar_swc_rlgs_rtARID_DEF.ALC_Path[5].type@ */ /end MEASUREMENT
/begin MEASUREMENT autosar_swc_rlgs_rtARID_DEF.Front_Valid_stub.is_on_rout "" UBYTE autosar_swc_rlgs_CM_uint8 0 0 0 255 ECU_ADDRESS 0xfe4af7ae /* @ECU_Address@autosar_swc_rlgs_rtARID_DEF.Front_Valid_stub.is_on_rout@ */ /end MEASUREMENT
/begin MEASUREMENT autosar_swc_rlgs_rtARID_DEF.Front_Valid_stub.lane_change_routing_direc "" SBYTE autosar_swc_rlgs_CM_int8 0 0 -128 127 ECU_ADDRESS 0xfe4af7ac /* @ECU_Address@autosar_swc_rlgs_rtARID_DEF.Front_Valid_stub.lane_change_routing_direc@ */ /end MEASUREMENT
/begin MEASUREMENT autosar_swc_rlgs_rtARID_DEF.Front_Valid_stub.stub_direc "" UBYTE autosar_swc_rlgs_CM_uint8 0 0 0 255 ECU_ADDRESS 0xfe4af7af /* @ECU_Address@autosar_swc_rlgs_rtARID_DEF.Front_Valid_stub.stub_direc@ */ /end MEASUREMENT
/begin MEASUREMENT autosar_swc_rlgs_rtARID_DEF.Front_Valid_stub.stub_end_dis "" SLONG autosar_swc_rlgs_CM_int32 0 0 -2147483648 2147483647 ECU_ADDRESS 0xfe4af7b8 /* @ECU_Address@autosar_swc_rlgs_rtARID_DEF.Front_Valid_stub.stub_end_dis@ */ /end MEASUREMENT
/begin MEASUREMENT autosar_swc_rlgs_rtARID_DEF.Front_Valid_stub.stub_id "" ULONG autosar_swc_rlgs_CM_uint32 0 0 0 4294967295 ECU_ADDRESS 0xfe4af7bc /* @ECU_Address@autosar_swc_rlgs_rtARID_DEF.Front_Valid_stub.stub_id@ */ /end MEASUREMENT
/begin MEASUREMENT autosar_swc_rlgs_rtARID_DEF.Front_Valid_stub.stub_linkSegment_id "" ULONG autosar_swc_rlgs_CM_uint32 0 0 0 4294967295 ECU_ADDRESS 0xfe4af7c0 /* @ECU_Address@autosar_swc_rlgs_rtARID_DEF.Front_Valid_stub.stub_linkSegment_id@ */ /end MEASUREMENT
/begin MEASUREMENT autosar_swc_rlgs_rtARID_DEF.Front_Valid_stub.stub_ramp_type "" UBYTE autosar_swc_rlgs_CM_uint8 0 0 0 255 ECU_ADDRESS 0xfe4af7b0 /* @ECU_Address@autosar_swc_rlgs_rtARID_DEF.Front_Valid_stub.stub_ramp_type@ */ /end MEASUREMENT
/begin MEASUREMENT autosar_swc_rlgs_rtARID_DEF.Front_Valid_stub.stub_start_dis "" SLONG autosar_swc_rlgs_CM_int32 0 0 -2147483648 2147483647 ECU_ADDRESS 0xfe4af7b4 /* @ECU_Address@autosar_swc_rlgs_rtARID_DEF.Front_Valid_stub.stub_start_dis@ */ /end MEASUREMENT
/begin MEASUREMENT autosar_swc_rlgs_rtARID_DEF.Front_Valid_stub.stub_type "" UBYTE autosar_swc_rlgs_CM_uint8 0 0 0 255 ECU_ADDRESS 0xfe4af7ad /* @ECU_Address@autosar_swc_rlgs_rtARID_DEF.Front_Valid_stub.stub_type@ */ /end MEASUREMENT
/begin MEASUREMENT autosar_swc_rlgs_rtARID_DEF.Index "" UBYTE autosar_swc_rlgs_CM_uint8 0 0 0 255 ECU_ADDRESS 0xfe4afd05 /* @ECU_Address@autosar_swc_rlgs_rtARID_DEF.Index@ */ /end MEASUREMENT
/begin MEASUREMENT autosar_swc_rlgs_rtARID_DEF.Switch2.Crossing "" UBYTE autosar_swc_rlgs_CM_uint8 0 0 0 255 ECU_ADDRESS 0xfe4af579 /* @ECU_Address@autosar_swc_rlgs_rtARID_DEF.Switch2.Crossing@ */ /end MEASUREMENT
/begin MEASUREMENT autosar_swc_rlgs_rtARID_DEF.Switch2.LaneExtraFarPointPosX "" FLOAT32_IEEE autosar_swc_rlgs_CM_single 0 0 -3.4E+38 3.4E+38 ECU_ADDRESS 0xfe4af584 /* @ECU_Address@autosar_swc_rlgs_rtARID_DEF.Switch2.LaneExtraFarPointPosX@ */ /end MEASUREMENT
/begin MEASUREMENT autosar_swc_rlgs_rtARID_DEF.Switch2.LaneExtraFarPointPosY "" FLOAT32_IEEE autosar_swc_rlgs_CM_single 0 0 -3.4E+38 3.4E+38 ECU_ADDRESS 0xfe4af588 /* @ECU_Address@autosar_swc_rlgs_rtARID_DEF.Switch2.LaneExtraFarPointPosY@ */ /end MEASUREMENT
/begin MEASUREMENT autosar_swc_rlgs_rtARID_DEF.Switch2.LaneExtraFarPointType "" UBYTE autosar_swc_rlgs_CM_uint8 0 0 0 255 ECU_ADDRESS 0xfe4af582 /* @ECU_Address@autosar_swc_rlgs_rtARID_DEF.Switch2.LaneExtraFarPointType@ */ /end MEASUREMENT
/begin MEASUREMENT autosar_swc_rlgs_rtARID_DEF.Switch2.LaneExtraNearPointPosX "" FLOAT32_IEEE autosar_swc_rlgs_CM_single 0 0 -3.4E+38 3.4E+38 ECU_ADDRESS 0xfe4af58c /* @ECU_Address@autosar_swc_rlgs_rtARID_DEF.Switch2.LaneExtraNearPointPosX@ */ /end MEASUREMENT
/begin MEASUREMENT autosar_swc_rlgs_rtARID_DEF.Switch2.LaneExtraNearPointPosY "" FLOAT32_IEEE autosar_swc_rlgs_CM_single 0 0 -3.4E+38 3.4E+38 ECU_ADDRESS 0xfe4af590 /* @ECU_Address@autosar_swc_rlgs_rtARID_DEF.Switch2.LaneExtraNearPointPosY@ */ /end MEASUREMENT
/begin MEASUREMENT autosar_swc_rlgs_rtARID_DEF.Switch2.LaneExtraNearPointType "" UBYTE autosar_swc_rlgs_CM_uint8 0 0 0 255 ECU_ADDRESS 0xfe4af581 /* @ECU_Address@autosar_swc_rlgs_rtARID_DEF.Switch2.LaneExtraNearPointType@ */ /end MEASUREMENT
/begin MEASUREMENT autosar_swc_rlgs_rtARID_DEF.Switch2.LaneParsingConfidence "" UBYTE autosar_swc_rlgs_CM_uint8 0 0 0 255 ECU_ADDRESS 0xfe4af594 /* @ECU_Address@autosar_swc_rlgs_rtARID_DEF.Switch2.LaneParsingConfidence@ */ /end MEASUREMENT
/begin MEASUREMENT autosar_swc_rlgs_rtARID_DEF.Switch2.ObstacleFlag "" UBYTE autosar_swc_rlgs_CM_uint8 0 0 0 255 ECU_ADDRESS 0xfe4af580 /* @ECU_Address@autosar_swc_rlgs_rtARID_DEF.Switch2.ObstacleFlag@ */ /end MEASUREMENT
/begin MEASUREMENT autosar_swc_rlgs_rtARID_DEF.Switch2.OperateState "" UBYTE autosar_swc_rlgs_CM_uint8 0 0 0 255 ECU_ADDRESS 0xfe4af554 /* @ECU_Address@autosar_swc_rlgs_rtARID_DEF.Switch2.OperateState@ */ /end MEASUREMENT
/begin MEASUREMENT autosar_swc_rlgs_rtARID_DEF.Switch2.Stopline_Relevancy "" UBYTE autosar_swc_rlgs_CM_uint8 0 0 0 255 ECU_ADDRESS 0xfe4af595 /* @ECU_Address@autosar_swc_rlgs_rtARID_DEF.Switch2.Stopline_Relevancy@ */ /end MEASUREMENT
/begin MEASUREMENT autosar_swc_rlgs_rtARID_DEF.Switch2.TrackID "" UWORD autosar_swc_rlgs_CM_uint16 0 0 0 65535 ECU_ADDRESS 0xfe4af576 /* @ECU_Address@autosar_swc_rlgs_rtARID_DEF.Switch2.TrackID@ */ /end MEASUREMENT
/begin MEASUREMENT autosar_swc_rlgs_rtARID_DEF.Switch2.bIsLineExist "" UBYTE autosar_swc_rlgs_CM_uint8 0 0 0 255 ECU_ADDRESS 0xfe4af555 /* @ECU_Address@autosar_swc_rlgs_rtARID_DEF.Switch2.bIsLineExist@ */ /end MEASUREMENT
/begin MEASUREMENT autosar_swc_rlgs_rtARID_DEF.Switch2.dC0V "" FLOAT32_IEEE autosar_swc_rlgs_CM_single 0 0 -3.4E+38 3.4E+38 ECU_ADDRESS 0xfe4af568 /* @ECU_Address@autosar_swc_rlgs_rtARID_DEF.Switch2.dC0V@ */ /end MEASUREMENT
/begin MEASUREMENT autosar_swc_rlgs_rtARID_DEF.Switch2.dC1V "" FLOAT32_IEEE autosar_swc_rlgs_CM_single 0 0 -3.4E+38 3.4E+38 ECU_ADDRESS 0xfe4af564 /* @ECU_Address@autosar_swc_rlgs_rtARID_DEF.Switch2.dC1V@ */ /end MEASUREMENT
/begin MEASUREMENT autosar_swc_rlgs_rtARID_DEF.Switch2.dC2V "" FLOAT32_IEEE autosar_swc_rlgs_CM_single 0 0 -3.4E+38 3.4E+38 ECU_ADDRESS 0xfe4af560 /* @ECU_Address@autosar_swc_rlgs_rtARID_DEF.Switch2.dC2V@ */ /end MEASUREMENT
/begin MEASUREMENT autosar_swc_rlgs_rtARID_DEF.Switch2.dC3V "" FLOAT32_IEEE autosar_swc_rlgs_CM_single 0 0 -3.4E+38 3.4E+38 ECU_ADDRESS 0xfe4af55c /* @ECU_Address@autosar_swc_rlgs_rtARID_DEF.Switch2.dC3V@ */ /end MEASUREMENT
/begin MEASUREMENT autosar_swc_rlgs_rtARID_DEF.Switch2.dDisFront "" FLOAT32_IEEE autosar_swc_rlgs_CM_single 0 0 -3.4E+38 3.4E+38 ECU_ADDRESS 0xfe4af570 /* @ECU_Address@autosar_swc_rlgs_rtARID_DEF.Switch2.dDisFront@ */ /end MEASUREMENT
/begin MEASUREMENT autosar_swc_rlgs_rtARID_DEF.Switch2.dDisStart "" FLOAT32_IEEE autosar_swc_rlgs_CM_single 0 0 -3.4E+38 3.4E+38 ECU_ADDRESS 0xfe4af56c /* @ECU_Address@autosar_swc_rlgs_rtARID_DEF.Switch2.dDisStart@ */ /end MEASUREMENT
/begin MEASUREMENT autosar_swc_rlgs_rtARID_DEF.Switch2.dLaneWidth "" FLOAT32_IEEE autosar_swc_rlgs_CM_single 0 0 -3.4E+38 3.4E+38 ECU_ADDRESS 0xfe4af57c /* @ECU_Address@autosar_swc_rlgs_rtARID_DEF.Switch2.dLaneWidth@ */ /end MEASUREMENT
/begin MEASUREMENT autosar_swc_rlgs_rtARID_DEF.Switch2.dQuality "" FLOAT32_IEEE autosar_swc_rlgs_CM_single 0 0 -3.4E+38 3.4E+38 ECU_ADDRESS 0xfe4af558 /* @ECU_Address@autosar_swc_rlgs_rtARID_DEF.Switch2.dQuality@ */ /end MEASUREMENT
/begin MEASUREMENT autosar_swc_rlgs_rtARID_DEF.Switch2.eColour "" UBYTE autosar_swc_rlgs_CM_uint8 0 0 0 255 ECU_ADDRESS 0xfe4af578 /* @ECU_Address@autosar_swc_rlgs_rtARID_DEF.Switch2.eColour@ */ /end MEASUREMENT
/begin MEASUREMENT autosar_swc_rlgs_rtARID_DEF.Switch2.eLineType "" UBYTE autosar_swc_rlgs_CM_uint8 0 0 0 255 ECU_ADDRESS 0xfe4af574 /* @ECU_Address@autosar_swc_rlgs_rtARID_DEF.Switch2.eLineType@ */ /end MEASUREMENT
/begin MEASUREMENT autosar_swc_rlgs_rtARID_DEF.TmpSignalConversionAtICAS_STATEOutport1.acc_exit_reason "" ULONG autosar_swc_rlgs_CM_uint32 0 0 0 4294967295 ECU_ADDRESS 0xfe4af664 /* @ECU_Address@autosar_swc_rlgs_rtARID_DEF.TmpSignalConversionAtICAS_STATEOutport1.acc_exit_reason@ */ /end MEASUREMENT
/begin MEASUREMENT autosar_swc_rlgs_rtARID_DEF.TmpSignalConversionAtICAS_STATEOutport1.acc_manual_act_faile_reason "" ULONG autosar_swc_rlgs_CM_uint32 0 0 0 4294967295 ECU_ADDRESS 0xfe4af660 /* @ECU_Address@autosar_swc_rlgs_rtARID_DEF.TmpSignalConversionAtICAS_STATEOutport1.acc_manual_act_faile_reason@ */ /end MEASUREMENT
/begin MEASUREMENT autosar_swc_rlgs_rtARID_DEF.TmpSignalConversionAtICAS_STATEOutport1.acc_sts "" UBYTE autosar_swc_rlgs_CM_uint8 0 0 0 255 ECU_ADDRESS 0xfe4af658 /* @ECU_Address@autosar_swc_rlgs_rtARID_DEF.TmpSignalConversionAtICAS_STATEOutport1.acc_sts@ */ /end MEASUREMENT
/begin MEASUREMENT autosar_swc_rlgs_rtARID_DEF.TmpSignalConversionAtICAS_STATEOutport1.alc_sts "" UBYTE autosar_swc_rlgs_CM_uint8 0 0 0 255 ECU_ADDRESS 0xfe4af65b /* @ECU_Address@autosar_swc_rlgs_rtARID_DEF.TmpSignalConversionAtICAS_STATEOutport1.alc_sts@ */ /end MEASUREMENT
/begin MEASUREMENT autosar_swc_rlgs_rtARID_DEF.TmpSignalConversionAtICAS_STATEOutport1.lc_req_sync_id "" UBYTE autosar_swc_rlgs_CM_uint8 0 0 0 255 ECU_ADDRESS 0xfe4af65d /* @ECU_Address@autosar_swc_rlgs_rtARID_DEF.TmpSignalConversionAtICAS_STATEOutport1.lc_req_sync_id@ */ /end MEASUREMENT
/begin MEASUREMENT autosar_swc_rlgs_rtARID_DEF.TmpSignalConversionAtICAS_STATEOutport1.lcc_auto_act_faile_reason "" ULONG autosar_swc_rlgs_CM_uint32 0 0 0 4294967295 ECU_ADDRESS 0xfe4af66c /* @ECU_Address@autosar_swc_rlgs_rtARID_DEF.TmpSignalConversionAtICAS_STATEOutport1.lcc_auto_act_faile_reason@ */ /end MEASUREMENT
/begin MEASUREMENT autosar_swc_rlgs_rtARID_DEF.TmpSignalConversionAtICAS_STATEOutport1.lcc_exit_to_idle_reason "" ULONG autosar_swc_rlgs_CM_uint32 0 0 0 4294967295 ECU_ADDRESS 0xfe4af670 /* @ECU_Address@autosar_swc_rlgs_rtARID_DEF.TmpSignalConversionAtICAS_STATEOutport1.lcc_exit_to_idle_reason@ */ /end MEASUREMENT
/begin MEASUREMENT autosar_swc_rlgs_rtARID_DEF.TmpSignalConversionAtICAS_STATEOutport1.lcc_exit_to_mrc_reason "" ULONG autosar_swc_rlgs_CM_uint32 0 0 0 4294967295 ECU_ADDRESS 0xfe4af678 /* @ECU_Address@autosar_swc_rlgs_rtARID_DEF.TmpSignalConversionAtICAS_STATEOutport1.lcc_exit_to_mrc_reason@ */ /end MEASUREMENT
/begin MEASUREMENT autosar_swc_rlgs_rtARID_DEF.TmpSignalConversionAtICAS_STATEOutport1.lcc_exit_to_wait_reason "" ULONG autosar_swc_rlgs_CM_uint32 0 0 0 4294967295 ECU_ADDRESS 0xfe4af674 /* @ECU_Address@autosar_swc_rlgs_rtARID_DEF.TmpSignalConversionAtICAS_STATEOutport1.lcc_exit_to_wait_reason@ */ /end MEASUREMENT
/begin MEASUREMENT autosar_swc_rlgs_rtARID_DEF.TmpSignalConversionAtICAS_STATEOutport1.lcc_manual_act_faile_reason "" ULONG autosar_swc_rlgs_CM_uint32 0 0 0 4294967295 ECU_ADDRESS 0xfe4af668 /* @ECU_Address@autosar_swc_rlgs_rtARID_DEF.TmpSignalConversionAtICAS_STATEOutport1.lcc_manual_act_faile_reason@ */ /end MEASUREMENT
/begin MEASUREMENT autosar_swc_rlgs_rtARID_DEF.TmpSignalConversionAtICAS_STATEOutport1.lcc_mrc_exit_reason "" ULONG autosar_swc_rlgs_CM_uint32 0 0 0 4294967295 ECU_ADDRESS 0xfe4af67c /* @ECU_Address@autosar_swc_rlgs_rtARID_DEF.TmpSignalConversionAtICAS_STATEOutport1.lcc_mrc_exit_reason@ */ /end MEASUREMENT
/begin MEASUREMENT autosar_swc_rlgs_rtARID_DEF.TmpSignalConversionAtICAS_STATEOutport1.lcc_sts "" UBYTE autosar_swc_rlgs_CM_uint8 0 0 0 255 ECU_ADDRESS 0xfe4af659 /* @ECU_Address@autosar_swc_rlgs_rtARID_DEF.TmpSignalConversionAtICAS_STATEOutport1.lcc_sts@ */ /end MEASUREMENT
/begin MEASUREMENT autosar_swc_rlgs_rtARID_DEF.TmpSignalConversionAtICAS_STATEOutport1.noa_auto_act_faile_reason "" ULONG autosar_swc_rlgs_CM_uint32 0 0 0 4294967295 ECU_ADDRESS 0xfe4af680 /* @ECU_Address@autosar_swc_rlgs_rtARID_DEF.TmpSignalConversionAtICAS_STATEOutport1.noa_auto_act_faile_reason@ */ /end MEASUREMENT
/begin MEASUREMENT autosar_swc_rlgs_rtARID_DEF.TmpSignalConversionAtICAS_STATEOutport1.noa_exit_reason "" ULONG autosar_swc_rlgs_CM_uint32 0 0 0 4294967295 ECU_ADDRESS 0xfe4af684 /* @ECU_Address@autosar_swc_rlgs_rtARID_DEF.TmpSignalConversionAtICAS_STATEOutport1.noa_exit_reason@ */ /end MEASUREMENT
/begin MEASUREMENT autosar_swc_rlgs_rtARID_DEF.TmpSignalConversionAtICAS_STATEOutport1.noa_sts "" UBYTE autosar_swc_rlgs_CM_uint8 0 0 0 255 ECU_ADDRESS 0xfe4af65c /* @ECU_Address@autosar_swc_rlgs_rtARID_DEF.TmpSignalConversionAtICAS_STATEOutport1.noa_sts@ */ /end MEASUREMENT
/begin MEASUREMENT autosar_swc_rlgs_rtARID_DEF.TmpSignalConversionAtICAS_STATEOutport1.nudge_sts "" UBYTE autosar_swc_rlgs_CM_uint8 0 0 0 255 ECU_ADDRESS 0xfe4af65a /* @ECU_Address@autosar_swc_rlgs_rtARID_DEF.TmpSignalConversionAtICAS_STATEOutport1.nudge_sts@ */ /end MEASUREMENT
/begin MEASUREMENT autosar_swc_rlgs_rtARID_DEF.TmpSignalConversionAtVAL_DRIVER_DRIVEOutport1.AccActPulse "" UBYTE autosar_swc_rlgs_CM_logical 0 0 0 1 ECU_ADDRESS 0xfe4af621 /* @ECU_Address@autosar_swc_rlgs_rtARID_DEF.TmpSignalConversionAtVAL_DRIVER_DRIVEOutport1.AccActPulse@ */ /end MEASUREMENT
/begin MEASUREMENT autosar_swc_rlgs_rtARID_DEF.TmpSignalConversionAtVAL_DRIVER_DRIVEOutport1.AccOnOffPulse "" UBYTE autosar_swc_rlgs_CM_logical 0 0 0 1 ECU_ADDRESS 0xfe4af623 /* @ECU_Address@autosar_swc_rlgs_rtARID_DEF.TmpSignalConversionAtVAL_DRIVER_DRIVEOutport1.AccOnOffPulse@ */ /end MEASUREMENT
/begin MEASUREMENT autosar_swc_rlgs_rtARID_DEF.TmpSignalConversionAtVAL_DRIVER_DRIVEOutport1.AccPedalOverride "" UBYTE autosar_swc_rlgs_CM_logical 0 0 0 1 ECU_ADDRESS 0xfe4af620 /* @ECU_Address@autosar_swc_rlgs_rtARID_DEF.TmpSignalConversionAtVAL_DRIVER_DRIVEOutport1.AccPedalOverride@ */ /end MEASUREMENT
/begin MEASUREMENT autosar_swc_rlgs_rtARID_DEF.TmpSignalConversionAtVAL_DRIVER_DRIVEOutport1.AccPedalTouchPosition "" FLOAT32_IEEE autosar_swc_rlgs_CM_single 0 0 -3.4E+38 3.4E+38 ECU_ADDRESS 0xfe4af644 /* @ECU_Address@autosar_swc_rlgs_rtARID_DEF.TmpSignalConversionAtVAL_DRIVER_DRIVEOutport1.AccPedalTouchPosition@ */ /end MEASUREMENT
/begin MEASUREMENT autosar_swc_rlgs_rtARID_DEF.TmpSignalConversionAtVAL_DRIVER_DRIVEOutport1.AutoLightSW "" UBYTE autosar_swc_rlgs_CM_uint8 0 0 0 255 ECU_ADDRESS 0xfe4af633 /* @ECU_Address@autosar_swc_rlgs_rtARID_DEF.TmpSignalConversionAtVAL_DRIVER_DRIVEOutport1.AutoLightSW@ */ /end MEASUREMENT
/begin MEASUREMENT autosar_swc_rlgs_rtARID_DEF.TmpSignalConversionAtVAL_DRIVER_DRIVEOutport1.BrkPedalStroke "" FLOAT32_IEEE autosar_swc_rlgs_CM_single 0 0 -3.4E+38 3.4E+38 ECU_ADDRESS 0xfe4af640 /* @ECU_Address@autosar_swc_rlgs_rtARID_DEF.TmpSignalConversionAtVAL_DRIVER_DRIVEOutport1.BrkPedalStroke@ */ /end MEASUREMENT
/begin MEASUREMENT autosar_swc_rlgs_rtARID_DEF.TmpSignalConversionAtVAL_DRIVER_DRIVEOutport1.CancelPulse "" UBYTE autosar_swc_rlgs_CM_logical 0 0 0 1 ECU_ADDRESS 0xfe4af626 /* @ECU_Address@autosar_swc_rlgs_rtARID_DEF.TmpSignalConversionAtVAL_DRIVER_DRIVEOutport1.CancelPulse@ */ /end MEASUREMENT
/begin MEASUREMENT autosar_swc_rlgs_rtARID_DEF.TmpSignalConversionAtVAL_DRIVER_DRIVEOutport1.DecSetSpdPulse "" UBYTE autosar_swc_rlgs_CM_logical 0 0 0 1 ECU_ADDRESS 0xfe4af628 /* @ECU_Address@autosar_swc_rlgs_rtARID_DEF.TmpSignalConversionAtVAL_DRIVER_DRIVEOutport1.DecSetSpdPulse@ */ /end MEASUREMENT
/begin MEASUREMENT autosar_swc_rlgs_rtARID_DEF.TmpSignalConversionAtVAL_DRIVER_DRIVEOutport1.DecSetSpdStep "" UBYTE autosar_swc_rlgs_CM_uint8 0 0 0 255 ECU_ADDRESS 0xfe4af635 /* @ECU_Address@autosar_swc_rlgs_rtARID_DEF.TmpSignalConversionAtVAL_DRIVER_DRIVEOutport1.DecSetSpdStep@ */ /end MEASUREMENT
/begin MEASUREMENT autosar_swc_rlgs_rtARID_DEF.TmpSignalConversionAtVAL_DRIVER_DRIVEOutport1.DecTimeGapPulse "" UBYTE autosar_swc_rlgs_CM_logical 0 0 0 1 ECU_ADDRESS 0xfe4af62a /* @ECU_Address@autosar_swc_rlgs_rtARID_DEF.TmpSignalConversionAtVAL_DRIVER_DRIVEOutport1.DecTimeGapPulse@ */ /end MEASUREMENT
/begin MEASUREMENT autosar_swc_rlgs_rtARID_DEF.TmpSignalConversionAtVAL_DRIVER_DRIVEOutport1.DrvBrakeAccel "" FLOAT32_IEEE autosar_swc_rlgs_CM_single 0 0 -3.4E+38 3.4E+38 ECU_ADDRESS 0xfe4af63c /* @ECU_Address@autosar_swc_rlgs_rtARID_DEF.TmpSignalConversionAtVAL_DRIVER_DRIVEOutport1.DrvBrakeAccel@ */ /end MEASUREMENT
/begin MEASUREMENT autosar_swc_rlgs_rtARID_DEF.TmpSignalConversionAtVAL_DRIVER_DRIVEOutport1.DrvBrakePedalSts "" UBYTE autosar_swc_rlgs_CM_uint8 0 0 0 255 ECU_ADDRESS 0xfe4af62d /* @ECU_Address@autosar_swc_rlgs_rtARID_DEF.TmpSignalConversionAtVAL_DRIVER_DRIVEOutport1.DrvBrakePedalSts@ */ /end MEASUREMENT
/begin MEASUREMENT autosar_swc_rlgs_rtARID_DEF.TmpSignalConversionAtVAL_DRIVER_DRIVEOutport1.DrvConfirmLC "" UBYTE autosar_swc_rlgs_CM_uint8 0 0 0 255 ECU_ADDRESS 0xfe4af636 /* @ECU_Address@autosar_swc_rlgs_rtARID_DEF.TmpSignalConversionAtVAL_DRIVER_DRIVEOutport1.DrvConfirmLC@ */ /end MEASUREMENT
/begin MEASUREMENT autosar_swc_rlgs_rtARID_DEF.TmpSignalConversionAtVAL_DRIVER_DRIVEOutport1.DrvSteerTrqVal "" FLOAT32_IEEE autosar_swc_rlgs_CM_single 0 0 -3.4E+38 3.4E+38 ECU_ADDRESS 0xfe4af648 /* @ECU_Address@autosar_swc_rlgs_rtARID_DEF.TmpSignalConversionAtVAL_DRIVER_DRIVEOutport1.DrvSteerTrqVal@ */ /end MEASUREMENT
/begin MEASUREMENT autosar_swc_rlgs_rtARID_DEF.TmpSignalConversionAtVAL_DRIVER_DRIVEOutport1.DrvVoiceLCReq "" UBYTE autosar_swc_rlgs_CM_uint8 0 0 0 255 ECU_ADDRESS 0xfe4af637 /* @ECU_Address@autosar_swc_rlgs_rtARID_DEF.TmpSignalConversionAtVAL_DRIVER_DRIVEOutport1.DrvVoiceLCReq@ */ /end MEASUREMENT
/begin MEASUREMENT autosar_swc_rlgs_rtARID_DEF.TmpSignalConversionAtVAL_DRIVER_DRIVEOutport1.DrvVoiceSpdAdjReq "" UBYTE autosar_swc_rlgs_CM_uint8 0 0 0 255 ECU_ADDRESS 0xfe4af63a /* @ECU_Address@autosar_swc_rlgs_rtARID_DEF.TmpSignalConversionAtVAL_DRIVER_DRIVEOutport1.DrvVoiceSpdAdjReq@ */ /end MEASUREMENT
/begin MEASUREMENT autosar_swc_rlgs_rtARID_DEF.TmpSignalConversionAtVAL_DRIVER_DRIVEOutport1.DrvVoiceSpdAdjReqValue "" UBYTE autosar_swc_rlgs_CM_uint8 0 0 0 255 ECU_ADDRESS 0xfe4af63b /* @ECU_Address@autosar_swc_rlgs_rtARID_DEF.TmpSignalConversionAtVAL_DRIVER_DRIVEOutport1.DrvVoiceSpdAdjReqValue@ */ /end MEASUREMENT
/begin MEASUREMENT autosar_swc_rlgs_rtARID_DEF.TmpSignalConversionAtVAL_DRIVER_DRIVEOutport1.DrvVoiceTimeGapAdjReq "" UBYTE autosar_swc_rlgs_CM_uint8 0 0 0 255 ECU_ADDRESS 0xfe4af638 /* @ECU_Address@autosar_swc_rlgs_rtARID_DEF.TmpSignalConversionAtVAL_DRIVER_DRIVEOutport1.DrvVoiceTimeGapAdjReq@ */ /end MEASUREMENT
/begin MEASUREMENT autosar_swc_rlgs_rtARID_DEF.TmpSignalConversionAtVAL_DRIVER_DRIVEOutport1.DrvVoiceTimeGapAdjReqValue "" UBYTE autosar_swc_rlgs_CM_uint8 0 0 0 255 ECU_ADDRESS 0xfe4af639 /* @ECU_Address@autosar_swc_rlgs_rtARID_DEF.TmpSignalConversionAtVAL_DRIVER_DRIVEOutport1.DrvVoiceTimeGapAdjReqValue@ */ /end MEASUREMENT
/begin MEASUREMENT autosar_swc_rlgs_rtARID_DEF.TmpSignalConversionAtVAL_DRIVER_DRIVEOutport1.EPBSwtSts "" UBYTE autosar_swc_rlgs_CM_uint8 0 0 0 255 ECU_ADDRESS 0xfe4af62e /* @ECU_Address@autosar_swc_rlgs_rtARID_DEF.TmpSignalConversionAtVAL_DRIVER_DRIVEOutport1.EPBSwtSts@ */ /end MEASUREMENT
/begin MEASUREMENT autosar_swc_rlgs_rtARID_DEF.TmpSignalConversionAtVAL_DRIVER_DRIVEOutport1.HazardLmpSwtSts "" UBYTE autosar_swc_rlgs_CM_logical 0 0 0 1 ECU_ADDRESS 0xfe4af62b /* @ECU_Address@autosar_swc_rlgs_rtARID_DEF.TmpSignalConversionAtVAL_DRIVER_DRIVEOutport1.HazardLmpSwtSts@ */ /end MEASUREMENT
/begin MEASUREMENT autosar_swc_rlgs_rtARID_DEF.TmpSignalConversionAtVAL_DRIVER_DRIVEOutport1.HighBeamSwtSts "" UBYTE autosar_swc_rlgs_CM_uint8 0 0 0 255 ECU_ADDRESS 0xfe4af631 /* @ECU_Address@autosar_swc_rlgs_rtARID_DEF.TmpSignalConversionAtVAL_DRIVER_DRIVEOutport1.HighBeamSwtSts@ */ /end MEASUREMENT
/begin MEASUREMENT autosar_swc_rlgs_rtARID_DEF.TmpSignalConversionAtVAL_DRIVER_DRIVEOutport1.IncSetSpdPulse "" UBYTE autosar_swc_rlgs_CM_logical 0 0 0 1 ECU_ADDRESS 0xfe4af627 /* @ECU_Address@autosar_swc_rlgs_rtARID_DEF.TmpSignalConversionAtVAL_DRIVER_DRIVEOutport1.IncSetSpdPulse@ */ /end MEASUREMENT
/begin MEASUREMENT autosar_swc_rlgs_rtARID_DEF.TmpSignalConversionAtVAL_DRIVER_DRIVEOutport1.IncSetSpdStep "" UBYTE autosar_swc_rlgs_CM_uint8 0 0 0 255 ECU_ADDRESS 0xfe4af634 /* @ECU_Address@autosar_swc_rlgs_rtARID_DEF.TmpSignalConversionAtVAL_DRIVER_DRIVEOutport1.IncSetSpdStep@ */ /end MEASUREMENT
/begin MEASUREMENT autosar_swc_rlgs_rtARID_DEF.TmpSignalConversionAtVAL_DRIVER_DRIVEOutport1.IncTimeGapPulse "" UBYTE autosar_swc_rlgs_CM_logical 0 0 0 1 ECU_ADDRESS 0xfe4af629 /* @ECU_Address@autosar_swc_rlgs_rtARID_DEF.TmpSignalConversionAtVAL_DRIVER_DRIVEOutport1.IncTimeGapPulse@ */ /end MEASUREMENT
/begin MEASUREMENT autosar_swc_rlgs_rtARID_DEF.TmpSignalConversionAtVAL_DRIVER_DRIVEOutport1.LTurnLmpSwtSts "" UBYTE autosar_swc_rlgs_CM_uint8 0 0 0 255 ECU_ADDRESS 0xfe4af62f /* @ECU_Address@autosar_swc_rlgs_rtARID_DEF.TmpSignalConversionAtVAL_DRIVER_DRIVEOutport1.LTurnLmpSwtSts@ */ /end MEASUREMENT
/begin MEASUREMENT autosar_swc_rlgs_rtARID_DEF.TmpSignalConversionAtVAL_DRIVER_DRIVEOutport1.LccActPulse "" UBYTE autosar_swc_rlgs_CM_logical 0 0 0 1 ECU_ADDRESS 0xfe4af622 /* @ECU_Address@autosar_swc_rlgs_rtARID_DEF.TmpSignalConversionAtVAL_DRIVER_DRIVEOutport1.LccActPulse@ */ /end MEASUREMENT
/begin MEASUREMENT autosar_swc_rlgs_rtARID_DEF.TmpSignalConversionAtVAL_DRIVER_DRIVEOutport1.LccOnOffPulse "" UBYTE autosar_swc_rlgs_CM_logical 0 0 0 1 ECU_ADDRESS 0xfe4af624 /* @ECU_Address@autosar_swc_rlgs_rtARID_DEF.TmpSignalConversionAtVAL_DRIVER_DRIVEOutport1.LccOnOffPulse@ */ /end MEASUREMENT
/begin MEASUREMENT autosar_swc_rlgs_rtARID_DEF.TmpSignalConversionAtVAL_DRIVER_DRIVEOutport1.OverVehBeamSwtSts "" UBYTE autosar_swc_rlgs_CM_uint8 0 0 0 255 ECU_ADDRESS 0xfe4af632 /* @ECU_Address@autosar_swc_rlgs_rtARID_DEF.TmpSignalConversionAtVAL_DRIVER_DRIVEOutport1.OverVehBeamSwtSts@ */ /end MEASUREMENT
/begin MEASUREMENT autosar_swc_rlgs_rtARID_DEF.TmpSignalConversionAtVAL_DRIVER_DRIVEOutport1.RTurnLmpSwtSts "" UBYTE autosar_swc_rlgs_CM_uint8 0 0 0 255 ECU_ADDRESS 0xfe4af630 /* @ECU_Address@autosar_swc_rlgs_rtARID_DEF.TmpSignalConversionAtVAL_DRIVER_DRIVEOutport1.RTurnLmpSwtSts@ */ /end MEASUREMENT
/begin MEASUREMENT autosar_swc_rlgs_rtARID_DEF.TmpSignalConversionAtVAL_DRIVER_DRIVEOutport1.ResumePulse "" UBYTE autosar_swc_rlgs_CM_logical 0 0 0 1 ECU_ADDRESS 0xfe4af625 /* @ECU_Address@autosar_swc_rlgs_rtARID_DEF.TmpSignalConversionAtVAL_DRIVER_DRIVEOutport1.ResumePulse@ */ /end MEASUREMENT
/begin MEASUREMENT autosar_swc_rlgs_rtARID_DEF.TmpSignalConversionAtVAL_DRIVER_DRIVEOutport1.ScfConfirm "" UBYTE autosar_swc_rlgs_CM_uint8 0 0 0 255 ECU_ADDRESS 0xfe4af62c /* @ECU_Address@autosar_swc_rlgs_rtARID_DEF.TmpSignalConversionAtVAL_DRIVER_DRIVEOutport1.ScfConfirm@ */ /end MEASUREMENT
/begin MEASUREMENT autosar_swc_rlgs_rtARID_DEF.TmpSignalConversionAtVAL_DRIVER_DRIVEOutport1.TimeStampMs "" A_UINT64 autosar_swc_rlgs_CM_uint64 0 0 0 18446744073709551615 ECU_ADDRESS 0xfe4af650 /* @ECU_Address@autosar_swc_rlgs_rtARID_DEF.TmpSignalConversionAtVAL_DRIVER_DRIVEOutport1.TimeStampMs@ */ /end MEASUREMENT
/begin MEASUREMENT autosar_swc_rlgs_rtARID_DEF.TmpSignalConversionAtVMP_STSOutport1.lat_ctrl_mod "" UBYTE autosar_swc_rlgs_CM_uint8 0 0 0 255 ECU_ADDRESS 0xfe4af775 /* @ECU_Address@autosar_swc_rlgs_rtARID_DEF.TmpSignalConversionAtVMP_STSOutport1.lat_ctrl_mod@ */ /end MEASUREMENT
/begin MEASUREMENT autosar_swc_rlgs_rtARID_DEF.TmpSignalConversionAtVMP_STSOutport1.lat_pln_sts "" UBYTE autosar_swc_rlgs_CM_uint8 0 0 0 255 ECU_ADDRESS 0xfe4af772 /* @ECU_Address@autosar_swc_rlgs_rtARID_DEF.TmpSignalConversionAtVMP_STSOutport1.lat_pln_sts@ */ /end MEASUREMENT
/begin MEASUREMENT autosar_swc_rlgs_rtARID_DEF.TmpSignalConversionAtVMP_STSOutport1.lc_exec_sts "" UBYTE autosar_swc_rlgs_CM_uint8 0 0 0 255 ECU_ADDRESS 0xfe4af774 /* @ECU_Address@autosar_swc_rlgs_rtARID_DEF.TmpSignalConversionAtVMP_STSOutport1.lc_exec_sts@ */ /end MEASUREMENT
/begin MEASUREMENT autosar_swc_rlgs_rtARID_DEF.TmpSignalConversionAtVMP_STSOutport1.lc_failed_reason "" ULONG autosar_swc_rlgs_CM_uint32 0 0 0 4294967295 ECU_ADDRESS 0xfe4af77c /* @ECU_Address@autosar_swc_rlgs_rtARID_DEF.TmpSignalConversionAtVMP_STSOutport1.lc_failed_reason@ */ /end MEASUREMENT
/begin MEASUREMENT autosar_swc_rlgs_rtARID_DEF.TmpSignalConversionAtVMP_STSOutport1.lc_feasibility_conds "" ULONG autosar_swc_rlgs_CM_uint32 0 0 0 4294967295 ECU_ADDRESS 0xfe4af780 /* @ECU_Address@autosar_swc_rlgs_rtARID_DEF.TmpSignalConversionAtVMP_STSOutport1.lc_feasibility_conds@ */ /end MEASUREMENT
/begin MEASUREMENT autosar_swc_rlgs_rtARID_DEF.TmpSignalConversionAtVMP_STSOutport1.lc_req_sync_id "" ULONG autosar_swc_rlgs_CM_uint32 0 0 0 4294967295 ECU_ADDRESS 0xfe4af778 /* @ECU_Address@autosar_swc_rlgs_rtARID_DEF.TmpSignalConversionAtVMP_STSOutport1.lc_req_sync_id@ */ /end MEASUREMENT
/begin MEASUREMENT autosar_swc_rlgs_rtARID_DEF.TmpSignalConversionAtVMP_STSOutport1.lgt_drive_sts "" UBYTE autosar_swc_rlgs_CM_uint8 0 0 0 255 ECU_ADDRESS 0xfe4af773 /* @ECU_Address@autosar_swc_rlgs_rtARID_DEF.TmpSignalConversionAtVMP_STSOutport1.lgt_drive_sts@ */ /end MEASUREMENT
/begin MEASUREMENT autosar_swc_rlgs_rtARID_DEF.TmpSignalConversionAtVMP_STSOutport1.lgt_pln_sts "" UBYTE autosar_swc_rlgs_CM_uint8 0 0 0 255 ECU_ADDRESS 0xfe4af771 /* @ECU_Address@autosar_swc_rlgs_rtARID_DEF.TmpSignalConversionAtVMP_STSOutport1.lgt_pln_sts@ */ /end MEASUREMENT
/begin MEASUREMENT autosar_swc_rlgs_rtARID_DEF.TmpSignalConversionAtVMP_STSOutport1.nudge_exec_sts "" UBYTE autosar_swc_rlgs_CM_uint8 0 0 0 255 ECU_ADDRESS 0xfe4af776 /* @ECU_Address@autosar_swc_rlgs_rtARID_DEF.TmpSignalConversionAtVMP_STSOutport1.nudge_exec_sts@ */ /end MEASUREMENT
/begin MEASUREMENT autosar_swc_rlgs_rtARID_DEF.TmpSignalConversionAtVMP_STSOutport1.pln_failed_reason "" ULONG autosar_swc_rlgs_CM_uint32 0 0 0 4294967295 ECU_ADDRESS 0xfe4af788 /* @ECU_Address@autosar_swc_rlgs_rtARID_DEF.TmpSignalConversionAtVMP_STSOutport1.pln_failed_reason@ */ /end MEASUREMENT
/begin MEASUREMENT autosar_swc_rlgs_rtARID_DEF.TmpSignalConversionAtVMP_STSOutport1.pln_inhibited_reason "" ULONG autosar_swc_rlgs_CM_uint32 0 0 0 4294967295 ECU_ADDRESS 0xfe4af784 /* @ECU_Address@autosar_swc_rlgs_rtARID_DEF.TmpSignalConversionAtVMP_STSOutport1.pln_inhibited_reason@ */ /end MEASUREMENT
/begin MEASUREMENT autosar_swc_rlgs_rtARID_DEF.TmpSignalConversionAtVMP_STSOutport1.pln_run_sts "" UBYTE autosar_swc_rlgs_CM_uint8 0 0 0 255 ECU_ADDRESS 0xfe4af770 /* @ECU_Address@autosar_swc_rlgs_rtARID_DEF.TmpSignalConversionAtVMP_STSOutport1.pln_run_sts@ */ /end MEASUREMENT
/begin MEASUREMENT autosar_swc_rlgs_rtARID_DEF.UnitDelay1_DSTATE.Crossing "" UBYTE autosar_swc_rlgs_CM_uint8 0 0 0 255 ECU_ADDRESS 0xfe4af601 /* @ECU_Address@autosar_swc_rlgs_rtARID_DEF.UnitDelay1_DSTATE.Crossing@ */ /end MEASUREMENT
/begin MEASUREMENT autosar_swc_rlgs_rtARID_DEF.UnitDelay1_DSTATE.LaneExtraFarPointPosX "" FLOAT32_IEEE autosar_swc_rlgs_CM_single 0 0 -3.4E+38 3.4E+38 ECU_ADDRESS 0xfe4af60c /* @ECU_Address@autosar_swc_rlgs_rtARID_DEF.UnitDelay1_DSTATE.LaneExtraFarPointPosX@ */ /end MEASUREMENT
/begin MEASUREMENT autosar_swc_rlgs_rtARID_DEF.UnitDelay1_DSTATE.LaneExtraFarPointPosY "" FLOAT32_IEEE autosar_swc_rlgs_CM_single 0 0 -3.4E+38 3.4E+38 ECU_ADDRESS 0xfe4af610 /* @ECU_Address@autosar_swc_rlgs_rtARID_DEF.UnitDelay1_DSTATE.LaneExtraFarPointPosY@ */ /end MEASUREMENT
/begin MEASUREMENT autosar_swc_rlgs_rtARID_DEF.UnitDelay1_DSTATE.LaneExtraFarPointType "" UBYTE autosar_swc_rlgs_CM_uint8 0 0 0 255 ECU_ADDRESS 0xfe4af60a /* @ECU_Address@autosar_swc_rlgs_rtARID_DEF.UnitDelay1_DSTATE.LaneExtraFarPointType@ */ /end MEASUREMENT
/begin MEASUREMENT autosar_swc_rlgs_rtARID_DEF.UnitDelay1_DSTATE.LaneExtraNearPointPosX "" FLOAT32_IEEE autosar_swc_rlgs_CM_single 0 0 -3.4E+38 3.4E+38 ECU_ADDRESS 0xfe4af614 /* @ECU_Address@autosar_swc_rlgs_rtARID_DEF.UnitDelay1_DSTATE.LaneExtraNearPointPosX@ */ /end MEASUREMENT
/begin MEASUREMENT autosar_swc_rlgs_rtARID_DEF.UnitDelay1_DSTATE.LaneExtraNearPointPosY "" FLOAT32_IEEE autosar_swc_rlgs_CM_single 0 0 -3.4E+38 3.4E+38 ECU_ADDRESS 0xfe4af618 /* @ECU_Address@autosar_swc_rlgs_rtARID_DEF.UnitDelay1_DSTATE.LaneExtraNearPointPosY@ */ /end MEASUREMENT
/begin MEASUREMENT autosar_swc_rlgs_rtARID_DEF.UnitDelay1_DSTATE.LaneExtraNearPointType "" UBYTE autosar_swc_rlgs_CM_uint8 0 0 0 255 ECU_ADDRESS 0xfe4af609 /* @ECU_Address@autosar_swc_rlgs_rtARID_DEF.UnitDelay1_DSTATE.LaneExtraNearPointType@ */ /end MEASUREMENT
/begin MEASUREMENT autosar_swc_rlgs_rtARID_DEF.UnitDelay1_DSTATE.LaneParsingConfidence "" UBYTE autosar_swc_rlgs_CM_uint8 0 0 0 255 ECU_ADDRESS 0xfe4af61c /* @ECU_Address@autosar_swc_rlgs_rtARID_DEF.UnitDelay1_DSTATE.LaneParsingConfidence@ */ /end MEASUREMENT
/begin MEASUREMENT autosar_swc_rlgs_rtARID_DEF.UnitDelay1_DSTATE.ObstacleFlag "" UBYTE autosar_swc_rlgs_CM_uint8 0 0 0 255 ECU_ADDRESS 0xfe4af608 /* @ECU_Address@autosar_swc_rlgs_rtARID_DEF.UnitDelay1_DSTATE.ObstacleFlag@ */ /end MEASUREMENT
/begin MEASUREMENT autosar_swc_rlgs_rtARID_DEF.UnitDelay1_DSTATE.OperateState "" UBYTE autosar_swc_rlgs_CM_uint8 0 0 0 255 ECU_ADDRESS 0xfe4af5dc /* @ECU_Address@autosar_swc_rlgs_rtARID_DEF.UnitDelay1_DSTATE.OperateState@ */ /end MEASUREMENT
/begin MEASUREMENT autosar_swc_rlgs_rtARID_DEF.UnitDelay1_DSTATE.Stopline_Relevancy "" UBYTE autosar_swc_rlgs_CM_uint8 0 0 0 255 ECU_ADDRESS 0xfe4af61d /* @ECU_Address@autosar_swc_rlgs_rtARID_DEF.UnitDelay1_DSTATE.Stopline_Relevancy@ */ /end MEASUREMENT
/begin MEASUREMENT autosar_swc_rlgs_rtARID_DEF.UnitDelay1_DSTATE.TrackID "" UWORD autosar_swc_rlgs_CM_uint16 0 0 0 65535 ECU_ADDRESS 0xfe4af5fe /* @ECU_Address@autosar_swc_rlgs_rtARID_DEF.UnitDelay1_DSTATE.TrackID@ */ /end MEASUREMENT
/begin MEASUREMENT autosar_swc_rlgs_rtARID_DEF.UnitDelay1_DSTATE.bIsLineExist "" UBYTE autosar_swc_rlgs_CM_uint8 0 0 0 255 ECU_ADDRESS 0xfe4af5dd /* @ECU_Address@autosar_swc_rlgs_rtARID_DEF.UnitDelay1_DSTATE.bIsLineExist@ */ /end MEASUREMENT
/begin MEASUREMENT autosar_swc_rlgs_rtARID_DEF.UnitDelay1_DSTATE.dC0V "" FLOAT32_IEEE autosar_swc_rlgs_CM_single 0 0 -3.4E+38 3.4E+38 ECU_ADDRESS 0xfe4af5f0 /* @ECU_Address@autosar_swc_rlgs_rtARID_DEF.UnitDelay1_DSTATE.dC0V@ */ /end MEASUREMENT
/begin MEASUREMENT autosar_swc_rlgs_rtARID_DEF.UnitDelay1_DSTATE.dC1V "" FLOAT32_IEEE autosar_swc_rlgs_CM_single 0 0 -3.4E+38 3.4E+38 ECU_ADDRESS 0xfe4af5ec /* @ECU_Address@autosar_swc_rlgs_rtARID_DEF.UnitDelay1_DSTATE.dC1V@ */ /end MEASUREMENT
/begin MEASUREMENT autosar_swc_rlgs_rtARID_DEF.UnitDelay1_DSTATE.dC2V "" FLOAT32_IEEE autosar_swc_rlgs_CM_single 0 0 -3.4E+38 3.4E+38 ECU_ADDRESS 0xfe4af5e8 /* @ECU_Address@autosar_swc_rlgs_rtARID_DEF.UnitDelay1_DSTATE.dC2V@ */ /end MEASUREMENT
/begin MEASUREMENT autosar_swc_rlgs_rtARID_DEF.UnitDelay1_DSTATE.dC3V "" FLOAT32_IEEE autosar_swc_rlgs_CM_single 0 0 -3.4E+38 3.4E+38 ECU_ADDRESS 0xfe4af5e4 /* @ECU_Address@autosar_swc_rlgs_rtARID_DEF.UnitDelay1_DSTATE.dC3V@ */ /end MEASUREMENT
/begin MEASUREMENT autosar_swc_rlgs_rtARID_DEF.UnitDelay1_DSTATE.dDisFront "" FLOAT32_IEEE autosar_swc_rlgs_CM_single 0 0 -3.4E+38 3.4E+38 ECU_ADDRESS 0xfe4af5f8 /* @ECU_Address@autosar_swc_rlgs_rtARID_DEF.UnitDelay1_DSTATE.dDisFront@ */ /end MEASUREMENT
/begin MEASUREMENT autosar_swc_rlgs_rtARID_DEF.UnitDelay1_DSTATE.dDisStart "" FLOAT32_IEEE autosar_swc_rlgs_CM_single 0 0 -3.4E+38 3.4E+38 ECU_ADDRESS 0xfe4af5f4 /* @ECU_Address@autosar_swc_rlgs_rtARID_DEF.UnitDelay1_DSTATE.dDisStart@ */ /end MEASUREMENT
/begin MEASUREMENT autosar_swc_rlgs_rtARID_DEF.UnitDelay1_DSTATE.dLaneWidth "" FLOAT32_IEEE autosar_swc_rlgs_CM_single 0 0 -3.4E+38 3.4E+38 ECU_ADDRESS 0xfe4af604 /* @ECU_Address@autosar_swc_rlgs_rtARID_DEF.UnitDelay1_DSTATE.dLaneWidth@ */ /end MEASUREMENT
/begin MEASUREMENT autosar_swc_rlgs_rtARID_DEF.UnitDelay1_DSTATE.dQuality "" FLOAT32_IEEE autosar_swc_rlgs_CM_single 0 0 -3.4E+38 3.4E+38 ECU_ADDRESS 0xfe4af5e0 /* @ECU_Address@autosar_swc_rlgs_rtARID_DEF.UnitDelay1_DSTATE.dQuality@ */ /end MEASUREMENT
/begin MEASUREMENT autosar_swc_rlgs_rtARID_DEF.UnitDelay1_DSTATE.eColour "" UBYTE autosar_swc_rlgs_CM_uint8 0 0 0 255 ECU_ADDRESS 0xfe4af600 /* @ECU_Address@autosar_swc_rlgs_rtARID_DEF.UnitDelay1_DSTATE.eColour@ */ /end MEASUREMENT
/begin MEASUREMENT autosar_swc_rlgs_rtARID_DEF.UnitDelay1_DSTATE.eLineType "" UBYTE autosar_swc_rlgs_CM_uint8 0 0 0 255 ECU_ADDRESS 0xfe4af5fc /* @ECU_Address@autosar_swc_rlgs_rtARID_DEF.UnitDelay1_DSTATE.eLineType@ */ /end MEASUREMENT
/begin MEASUREMENT autosar_swc_rlgs_rtARID_DEF.UnitDelay1_DSTATE_a.ScenarioClass "" UBYTE autosar_swc_rlgs_CM_uint8 0 0 0 255 ECU_ADDRESS 0xfe4af7f4 /* @ECU_Address@autosar_swc_rlgs_rtARID_DEF.UnitDelay1_DSTATE_a.ScenarioClass@ */ /end MEASUREMENT
/begin MEASUREMENT autosar_swc_rlgs_rtARID_DEF.UnitDelay1_DSTATE_a.ScenarioSubType "" UBYTE autosar_swc_rlgs_CM_uint8 0 0 0 255 ECU_ADDRESS 0xfe4af7f6 /* @ECU_Address@autosar_swc_rlgs_rtARID_DEF.UnitDelay1_DSTATE_a.ScenarioSubType@ */ /end MEASUREMENT
/begin MEASUREMENT autosar_swc_rlgs_rtARID_DEF.UnitDelay1_DSTATE_a.ScenarioType "" UBYTE autosar_swc_rlgs_CM_uint8 0 0 0 255 ECU_ADDRESS 0xfe4af7f5 /* @ECU_Address@autosar_swc_rlgs_rtARID_DEF.UnitDelay1_DSTATE_a.ScenarioType@ */ /end MEASUREMENT
/begin MEASUREMENT autosar_swc_rlgs_rtARID_DEF.UnitDelay1_DSTATE_a.SuggDrvDirection "" UBYTE autosar_swc_rlgs_CM_uint8 0 0 0 255 ECU_ADDRESS 0xfe4af7f7 /* @ECU_Address@autosar_swc_rlgs_rtARID_DEF.UnitDelay1_DSTATE_a.SuggDrvDirection@ */ /end MEASUREMENT
/begin MEASUREMENT autosar_swc_rlgs_rtARID_DEF.UnitDelay1_DSTATE_a.dist2GeoFence "" FLOAT32_IEEE autosar_swc_rlgs_CM_single 0 0 -3.4E+38 3.4E+38 ECU_ADDRESS 0xfe4af7fc /* @ECU_Address@autosar_swc_rlgs_rtARID_DEF.UnitDelay1_DSTATE_a.dist2GeoFence@ */ /end MEASUREMENT
/begin MEASUREMENT autosar_swc_rlgs_rtARID_DEF.UnitDelay1_DSTATE_a.splitSegmentIdx "" UBYTE autosar_swc_rlgs_CM_uint8 0 0 0 255 ECU_ADDRESS 0xfe4af7f8 /* @ECU_Address@autosar_swc_rlgs_rtARID_DEF.UnitDelay1_DSTATE_a.splitSegmentIdx@ */ /end MEASUREMENT
/begin MEASUREMENT autosar_swc_rlgs_rtARID_DEF.UnitDelay1_DSTATE_a.splitStubIdx "" UBYTE autosar_swc_rlgs_CM_uint8 0 0 0 255 ECU_ADDRESS 0xfe4af7f9 /* @ECU_Address@autosar_swc_rlgs_rtARID_DEF.UnitDelay1_DSTATE_a.splitStubIdx@ */ /end MEASUREMENT
/begin MEASUREMENT autosar_swc_rlgs_rtARID_DEF.UnitDelay1_DSTATE_h "" UBYTE autosar_swc_rlgs_CM_uint8 0 0 0 255 LAYOUT COLUMN_DIR MATRIX_DIM 8 ECU_ADDRESS 0xfe4afcbe /* @ECU_Address@autosar_swc_rlgs_rtARID_DEF.UnitDelay1_DSTATE_h@ */ /end MEASUREMENT
/begin MEASUREMENT autosar_swc_rlgs_rtARID_DEF.UnitDelay1_DSTATE_o.host_lane_idx "" UBYTE autosar_swc_rlgs_CM_uint8 0 0 0 255 ECU_ADDRESS 0xfe4af6e8 /* @ECU_Address@autosar_swc_rlgs_rtARID_DEF.UnitDelay1_DSTATE_o.host_lane_idx@ */ /end MEASUREMENT
/begin MEASUREMENT autosar_swc_rlgs_rtARID_DEF.UnitDelay1_DSTATE_o.lc_level "" UBYTE autosar_swc_rlgs_CM_uint8 0 0 0 255 ECU_ADDRESS 0xfe4af6ec /* @ECU_Address@autosar_swc_rlgs_rtARID_DEF.UnitDelay1_DSTATE_o.lc_level@ */ /end MEASUREMENT
/begin MEASUREMENT autosar_swc_rlgs_rtARID_DEF.UnitDelay1_DSTATE_o.lc_lntention_conds "" ULONG autosar_swc_rlgs_CM_uint32 0 0 0 4294967295 LAYOUT COLUMN_DIR MATRIX_DIM 10 ECU_ADDRESS 0xfe4af6f0 /* @ECU_Address@autosar_swc_rlgs_rtARID_DEF.UnitDelay1_DSTATE_o.lc_lntention_conds@ */ /end MEASUREMENT
/begin MEASUREMENT autosar_swc_rlgs_rtARID_DEF.UnitDelay1_DSTATE_o.lc_req "" UBYTE autosar_swc_rlgs_CM_uint8 0 0 0 255 ECU_ADDRESS 0xfe4af6ea /* @ECU_Address@autosar_swc_rlgs_rtARID_DEF.UnitDelay1_DSTATE_o.lc_req@ */ /end MEASUREMENT
/begin MEASUREMENT autosar_swc_rlgs_rtARID_DEF.UnitDelay1_DSTATE_o.lc_req_reason "" UBYTE autosar_swc_rlgs_CM_uint8 0 0 0 255 ECU_ADDRESS 0xfe4af6ed /* @ECU_Address@autosar_swc_rlgs_rtARID_DEF.UnitDelay1_DSTATE_o.lc_req_reason@ */ /end MEASUREMENT
/begin MEASUREMENT autosar_swc_rlgs_rtARID_DEF.UnitDelay1_DSTATE_o.lc_req_sync_id "" UBYTE autosar_swc_rlgs_CM_uint8 0 0 0 255 ECU_ADDRESS 0xfe4af6eb /* @ECU_Address@autosar_swc_rlgs_rtARID_DEF.UnitDelay1_DSTATE_o.lc_req_sync_id@ */ /end MEASUREMENT
/begin MEASUREMENT autosar_swc_rlgs_rtARID_DEF.UnitDelay1_DSTATE_o.target_lane_idx "" UBYTE autosar_swc_rlgs_CM_uint8 0 0 0 255 ECU_ADDRESS 0xfe4af6e9 /* @ECU_Address@autosar_swc_rlgs_rtARID_DEF.UnitDelay1_DSTATE_o.target_lane_idx@ */ /end MEASUREMENT
/begin MEASUREMENT autosar_swc_rlgs_rtARID_DEF.UnitDelay2_DSTATE.host_lane_idx "" UBYTE autosar_swc_rlgs_CM_uint8 0 0 0 255 ECU_ADDRESS 0xfe4af718 /* @ECU_Address@autosar_swc_rlgs_rtARID_DEF.UnitDelay2_DSTATE.host_lane_idx@ */ /end MEASUREMENT
/begin MEASUREMENT autosar_swc_rlgs_rtARID_DEF.UnitDelay2_DSTATE.lc_level "" UBYTE autosar_swc_rlgs_CM_uint8 0 0 0 255 ECU_ADDRESS 0xfe4af71c /* @ECU_Address@autosar_swc_rlgs_rtARID_DEF.UnitDelay2_DSTATE.lc_level@ */ /end MEASUREMENT
/begin MEASUREMENT autosar_swc_rlgs_rtARID_DEF.UnitDelay2_DSTATE.lc_lntention_conds "" ULONG autosar_swc_rlgs_CM_uint32 0 0 0 4294967295 LAYOUT COLUMN_DIR MATRIX_DIM 10 ECU_ADDRESS 0xfe4af720 /* @ECU_Address@autosar_swc_rlgs_rtARID_DEF.UnitDelay2_DSTATE.lc_lntention_conds@ */ /end MEASUREMENT
/begin MEASUREMENT autosar_swc_rlgs_rtARID_DEF.UnitDelay2_DSTATE.lc_req "" UBYTE autosar_swc_rlgs_CM_uint8 0 0 0 255 ECU_ADDRESS 0xfe4af71a /* @ECU_Address@autosar_swc_rlgs_rtARID_DEF.UnitDelay2_DSTATE.lc_req@ */ /end MEASUREMENT
/begin MEASUREMENT autosar_swc_rlgs_rtARID_DEF.UnitDelay2_DSTATE.lc_req_reason "" UBYTE autosar_swc_rlgs_CM_uint8 0 0 0 255 ECU_ADDRESS 0xfe4af71d /* @ECU_Address@autosar_swc_rlgs_rtARID_DEF.UnitDelay2_DSTATE.lc_req_reason@ */ /end MEASUREMENT
/begin MEASUREMENT autosar_swc_rlgs_rtARID_DEF.UnitDelay2_DSTATE.lc_req_sync_id "" UBYTE autosar_swc_rlgs_CM_uint8 0 0 0 255 ECU_ADDRESS 0xfe4af71b /* @ECU_Address@autosar_swc_rlgs_rtARID_DEF.UnitDelay2_DSTATE.lc_req_sync_id@ */ /end MEASUREMENT
/begin MEASUREMENT autosar_swc_rlgs_rtARID_DEF.UnitDelay2_DSTATE.target_lane_idx "" UBYTE autosar_swc_rlgs_CM_uint8 0 0 0 255 ECU_ADDRESS 0xfe4af719 /* @ECU_Address@autosar_swc_rlgs_rtARID_DEF.UnitDelay2_DSTATE.target_lane_idx@ */ /end MEASUREMENT
/begin MEASUREMENT autosar_swc_rlgs_rtARID_DEF.UnitDelay2_DSTATE_j.ScenarioClass "" UBYTE autosar_swc_rlgs_CM_uint8 0 0 0 255 ECU_ADDRESS 0xfe4af7e8 /* @ECU_Address@autosar_swc_rlgs_rtARID_DEF.UnitDelay2_DSTATE_j.ScenarioClass@ */ /end MEASUREMENT
/begin MEASUREMENT autosar_swc_rlgs_rtARID_DEF.UnitDelay2_DSTATE_j.ScenarioSubType "" UBYTE autosar_swc_rlgs_CM_uint8 0 0 0 255 ECU_ADDRESS 0xfe4af7ea /* @ECU_Address@autosar_swc_rlgs_rtARID_DEF.UnitDelay2_DSTATE_j.ScenarioSubType@ */ /end MEASUREMENT
/begin MEASUREMENT autosar_swc_rlgs_rtARID_DEF.UnitDelay2_DSTATE_j.ScenarioType "" UBYTE autosar_swc_rlgs_CM_uint8 0 0 0 255 ECU_ADDRESS 0xfe4af7e9 /* @ECU_Address@autosar_swc_rlgs_rtARID_DEF.UnitDelay2_DSTATE_j.ScenarioType@ */ /end MEASUREMENT
/begin MEASUREMENT autosar_swc_rlgs_rtARID_DEF.UnitDelay2_DSTATE_j.SuggDrvDirection "" UBYTE autosar_swc_rlgs_CM_uint8 0 0 0 255 ECU_ADDRESS 0xfe4af7eb /* @ECU_Address@autosar_swc_rlgs_rtARID_DEF.UnitDelay2_DSTATE_j.SuggDrvDirection@ */ /end MEASUREMENT
/begin MEASUREMENT autosar_swc_rlgs_rtARID_DEF.UnitDelay2_DSTATE_j.dist2GeoFence "" FLOAT32_IEEE autosar_swc_rlgs_CM_single 0 0 -3.4E+38 3.4E+38 ECU_ADDRESS 0xfe4af7f0 /* @ECU_Address@autosar_swc_rlgs_rtARID_DEF.UnitDelay2_DSTATE_j.dist2GeoFence@ */ /end MEASUREMENT
/begin MEASUREMENT autosar_swc_rlgs_rtARID_DEF.UnitDelay2_DSTATE_j.splitSegmentIdx "" UBYTE autosar_swc_rlgs_CM_uint8 0 0 0 255 ECU_ADDRESS 0xfe4af7ec /* @ECU_Address@autosar_swc_rlgs_rtARID_DEF.UnitDelay2_DSTATE_j.splitSegmentIdx@ */ /end MEASUREMENT
/begin MEASUREMENT autosar_swc_rlgs_rtARID_DEF.UnitDelay2_DSTATE_j.splitStubIdx "" UBYTE autosar_swc_rlgs_CM_uint8 0 0 0 255 ECU_ADDRESS 0xfe4af7ed /* @ECU_Address@autosar_swc_rlgs_rtARID_DEF.UnitDelay2_DSTATE_j.splitStubIdx@ */ /end MEASUREMENT
/begin MEASUREMENT autosar_swc_rlgs_rtARID_DEF.UnitDelay2_DSTATE_l "" UBYTE autosar_swc_rlgs_CM_uint8 0 0 0 255 LAYOUT COLUMN_DIR MATRIX_DIM 8 ECU_ADDRESS 0xfe4afcc6 /* @ECU_Address@autosar_swc_rlgs_rtARID_DEF.UnitDelay2_DSTATE_l@ */ /end MEASUREMENT
/begin MEASUREMENT autosar_swc_rlgs_rtARID_DEF.UnitDelay3_DSTATE_ef "" UBYTE autosar_swc_rlgs_CM_uint8 0 0 0 255 LAYOUT COLUMN_DIR MATRIX_DIM 8 ECU_ADDRESS 0xfe4afcce /* @ECU_Address@autosar_swc_rlgs_rtARID_DEF.UnitDelay3_DSTATE_ef@ */ /end MEASUREMENT
/begin MEASUREMENT autosar_swc_rlgs_rtARID_DEF.UnitDelay4_DSTATE.ScenarioClass "" UBYTE autosar_swc_rlgs_CM_uint8 0 0 0 255 ECU_ADDRESS 0xfe4af7dc /* @ECU_Address@autosar_swc_rlgs_rtARID_DEF.UnitDelay4_DSTATE.ScenarioClass@ */ /end MEASUREMENT
/begin MEASUREMENT autosar_swc_rlgs_rtARID_DEF.UnitDelay4_DSTATE.ScenarioSubType "" UBYTE autosar_swc_rlgs_CM_uint8 0 0 0 255 ECU_ADDRESS 0xfe4af7de /* @ECU_Address@autosar_swc_rlgs_rtARID_DEF.UnitDelay4_DSTATE.ScenarioSubType@ */ /end MEASUREMENT
/begin MEASUREMENT autosar_swc_rlgs_rtARID_DEF.UnitDelay4_DSTATE.ScenarioType "" UBYTE autosar_swc_rlgs_CM_uint8 0 0 0 255 ECU_ADDRESS 0xfe4af7dd /* @ECU_Address@autosar_swc_rlgs_rtARID_DEF.UnitDelay4_DSTATE.ScenarioType@ */ /end MEASUREMENT
/begin MEASUREMENT autosar_swc_rlgs_rtARID_DEF.UnitDelay4_DSTATE.SuggDrvDirection "" UBYTE autosar_swc_rlgs_CM_uint8 0 0 0 255 ECU_ADDRESS 0xfe4af7df /* @ECU_Address@autosar_swc_rlgs_rtARID_DEF.UnitDelay4_DSTATE.SuggDrvDirection@ */ /end MEASUREMENT
/begin MEASUREMENT autosar_swc_rlgs_rtARID_DEF.UnitDelay4_DSTATE.dist2GeoFence "" FLOAT32_IEEE autosar_swc_rlgs_CM_single 0 0 -3.4E+38 3.4E+38 ECU_ADDRESS 0xfe4af7e4 /* @ECU_Address@autosar_swc_rlgs_rtARID_DEF.UnitDelay4_DSTATE.dist2GeoFence@ */ /end MEASUREMENT
/begin MEASUREMENT autosar_swc_rlgs_rtARID_DEF.UnitDelay4_DSTATE.splitSegmentIdx "" UBYTE autosar_swc_rlgs_CM_uint8 0 0 0 255 ECU_ADDRESS 0xfe4af7e0 /* @ECU_Address@autosar_swc_rlgs_rtARID_DEF.UnitDelay4_DSTATE.splitSegmentIdx@ */ /end MEASUREMENT
/begin MEASUREMENT autosar_swc_rlgs_rtARID_DEF.UnitDelay4_DSTATE.splitStubIdx "" UBYTE autosar_swc_rlgs_CM_uint8 0 0 0 255 ECU_ADDRESS 0xfe4af7e1 /* @ECU_Address@autosar_swc_rlgs_rtARID_DEF.UnitDelay4_DSTATE.splitStubIdx@ */ /end MEASUREMENT
/begin MEASUREMENT autosar_swc_rlgs_rtARID_DEF.UnitDelay_DSTATE.Crossing "" UBYTE autosar_swc_rlgs_CM_uint8 0 0 0 255 ECU_ADDRESS 0xfe4af5bd /* @ECU_Address@autosar_swc_rlgs_rtARID_DEF.UnitDelay_DSTATE.Crossing@ */ /end MEASUREMENT
/begin MEASUREMENT autosar_swc_rlgs_rtARID_DEF.UnitDelay_DSTATE.LaneExtraFarPointPosX "" FLOAT32_IEEE autosar_swc_rlgs_CM_single 0 0 -3.4E+38 3.4E+38 ECU_ADDRESS 0xfe4af5c8 /* @ECU_Address@autosar_swc_rlgs_rtARID_DEF.UnitDelay_DSTATE.LaneExtraFarPointPosX@ */ /end MEASUREMENT
/begin MEASUREMENT autosar_swc_rlgs_rtARID_DEF.UnitDelay_DSTATE.LaneExtraFarPointPosY "" FLOAT32_IEEE autosar_swc_rlgs_CM_single 0 0 -3.4E+38 3.4E+38 ECU_ADDRESS 0xfe4af5cc /* @ECU_Address@autosar_swc_rlgs_rtARID_DEF.UnitDelay_DSTATE.LaneExtraFarPointPosY@ */ /end MEASUREMENT
/begin MEASUREMENT autosar_swc_rlgs_rtARID_DEF.UnitDelay_DSTATE.LaneExtraFarPointType "" UBYTE autosar_swc_rlgs_CM_uint8 0 0 0 255 ECU_ADDRESS 0xfe4af5c6 /* @ECU_Address@autosar_swc_rlgs_rtARID_DEF.UnitDelay_DSTATE.LaneExtraFarPointType@ */ /end MEASUREMENT
/begin MEASUREMENT autosar_swc_rlgs_rtARID_DEF.UnitDelay_DSTATE.LaneExtraNearPointPosX "" FLOAT32_IEEE autosar_swc_rlgs_CM_single 0 0 -3.4E+38 3.4E+38 ECU_ADDRESS 0xfe4af5d0 /* @ECU_Address@autosar_swc_rlgs_rtARID_DEF.UnitDelay_DSTATE.LaneExtraNearPointPosX@ */ /end MEASUREMENT
/begin MEASUREMENT autosar_swc_rlgs_rtARID_DEF.UnitDelay_DSTATE.LaneExtraNearPointPosY "" FLOAT32_IEEE autosar_swc_rlgs_CM_single 0 0 -3.4E+38 3.4E+38 ECU_ADDRESS 0xfe4af5d4 /* @ECU_Address@autosar_swc_rlgs_rtARID_DEF.UnitDelay_DSTATE.LaneExtraNearPointPosY@ */ /end MEASUREMENT
/begin MEASUREMENT autosar_swc_rlgs_rtARID_DEF.UnitDelay_DSTATE.LaneExtraNearPointType "" UBYTE autosar_swc_rlgs_CM_uint8 0 0 0 255 ECU_ADDRESS 0xfe4af5c5 /* @ECU_Address@autosar_swc_rlgs_rtARID_DEF.UnitDelay_DSTATE.LaneExtraNearPointType@ */ /end MEASUREMENT
/begin MEASUREMENT autosar_swc_rlgs_rtARID_DEF.UnitDelay_DSTATE.LaneParsingConfidence "" UBYTE autosar_swc_rlgs_CM_uint8 0 0 0 255 ECU_ADDRESS 0xfe4af5d8 /* @ECU_Address@autosar_swc_rlgs_rtARID_DEF.UnitDelay_DSTATE.LaneParsingConfidence@ */ /end MEASUREMENT
/begin MEASUREMENT autosar_swc_rlgs_rtARID_DEF.UnitDelay_DSTATE.ObstacleFlag "" UBYTE autosar_swc_rlgs_CM_uint8 0 0 0 255 ECU_ADDRESS 0xfe4af5c4 /* @ECU_Address@autosar_swc_rlgs_rtARID_DEF.UnitDelay_DSTATE.ObstacleFlag@ */ /end MEASUREMENT
/begin MEASUREMENT autosar_swc_rlgs_rtARID_DEF.UnitDelay_DSTATE.OperateState "" UBYTE autosar_swc_rlgs_CM_uint8 0 0 0 255 ECU_ADDRESS 0xfe4af598 /* @ECU_Address@autosar_swc_rlgs_rtARID_DEF.UnitDelay_DSTATE.OperateState@ */ /end MEASUREMENT
/begin MEASUREMENT autosar_swc_rlgs_rtARID_DEF.UnitDelay_DSTATE.Stopline_Relevancy "" UBYTE autosar_swc_rlgs_CM_uint8 0 0 0 255 ECU_ADDRESS 0xfe4af5d9 /* @ECU_Address@autosar_swc_rlgs_rtARID_DEF.UnitDelay_DSTATE.Stopline_Relevancy@ */ /end MEASUREMENT
/begin MEASUREMENT autosar_swc_rlgs_rtARID_DEF.UnitDelay_DSTATE.TrackID "" UWORD autosar_swc_rlgs_CM_uint16 0 0 0 65535 ECU_ADDRESS 0xfe4af5ba /* @ECU_Address@autosar_swc_rlgs_rtARID_DEF.UnitDelay_DSTATE.TrackID@ */ /end MEASUREMENT
/begin MEASUREMENT autosar_swc_rlgs_rtARID_DEF.UnitDelay_DSTATE.bIsLineExist "" UBYTE autosar_swc_rlgs_CM_uint8 0 0 0 255 ECU_ADDRESS 0xfe4af599 /* @ECU_Address@autosar_swc_rlgs_rtARID_DEF.UnitDelay_DSTATE.bIsLineExist@ */ /end MEASUREMENT
/begin MEASUREMENT autosar_swc_rlgs_rtARID_DEF.UnitDelay_DSTATE.dC0V "" FLOAT32_IEEE autosar_swc_rlgs_CM_single 0 0 -3.4E+38 3.4E+38 ECU_ADDRESS 0xfe4af5ac /* @ECU_Address@autosar_swc_rlgs_rtARID_DEF.UnitDelay_DSTATE.dC0V@ */ /end MEASUREMENT
/begin MEASUREMENT autosar_swc_rlgs_rtARID_DEF.UnitDelay_DSTATE.dC1V "" FLOAT32_IEEE autosar_swc_rlgs_CM_single 0 0 -3.4E+38 3.4E+38 ECU_ADDRESS 0xfe4af5a8 /* @ECU_Address@autosar_swc_rlgs_rtARID_DEF.UnitDelay_DSTATE.dC1V@ */ /end MEASUREMENT
/begin MEASUREMENT autosar_swc_rlgs_rtARID_DEF.UnitDelay_DSTATE.dC2V "" FLOAT32_IEEE autosar_swc_rlgs_CM_single 0 0 -3.4E+38 3.4E+38 ECU_ADDRESS 0xfe4af5a4 /* @ECU_Address@autosar_swc_rlgs_rtARID_DEF.UnitDelay_DSTATE.dC2V@ */ /end MEASUREMENT
/begin MEASUREMENT autosar_swc_rlgs_rtARID_DEF.UnitDelay_DSTATE.dC3V "" FLOAT32_IEEE autosar_swc_rlgs_CM_single 0 0 -3.4E+38 3.4E+38 ECU_ADDRESS 0xfe4af5a0 /* @ECU_Address@autosar_swc_rlgs_rtARID_DEF.UnitDelay_DSTATE.dC3V@ */ /end MEASUREMENT
/begin MEASUREMENT autosar_swc_rlgs_rtARID_DEF.UnitDelay_DSTATE.dDisFront "" FLOAT32_IEEE autosar_swc_rlgs_CM_single 0 0 -3.4E+38 3.4E+38 ECU_ADDRESS 0xfe4af5b4 /* @ECU_Address@autosar_swc_rlgs_rtARID_DEF.UnitDelay_DSTATE.dDisFront@ */ /end MEASUREMENT
/begin MEASUREMENT autosar_swc_rlgs_rtARID_DEF.UnitDelay_DSTATE.dDisStart "" FLOAT32_IEEE autosar_swc_rlgs_CM_single 0 0 -3.4E+38 3.4E+38 ECU_ADDRESS 0xfe4af5b0 /* @ECU_Address@autosar_swc_rlgs_rtARID_DEF.UnitDelay_DSTATE.dDisStart@ */ /end MEASUREMENT
/begin MEASUREMENT autosar_swc_rlgs_rtARID_DEF.UnitDelay_DSTATE.dLaneWidth "" FLOAT32_IEEE autosar_swc_rlgs_CM_single 0 0 -3.4E+38 3.4E+38 ECU_ADDRESS 0xfe4af5c0 /* @ECU_Address@autosar_swc_rlgs_rtARID_DEF.UnitDelay_DSTATE.dLaneWidth@ */ /end MEASUREMENT
/begin MEASUREMENT autosar_swc_rlgs_rtARID_DEF.UnitDelay_DSTATE.dQuality "" FLOAT32_IEEE autosar_swc_rlgs_CM_single 0 0 -3.4E+38 3.4E+38 ECU_ADDRESS 0xfe4af59c /* @ECU_Address@autosar_swc_rlgs_rtARID_DEF.UnitDelay_DSTATE.dQuality@ */ /end MEASUREMENT
/begin MEASUREMENT autosar_swc_rlgs_rtARID_DEF.UnitDelay_DSTATE.eColour "" UBYTE autosar_swc_rlgs_CM_uint8 0 0 0 255 ECU_ADDRESS 0xfe4af5bc /* @ECU_Address@autosar_swc_rlgs_rtARID_DEF.UnitDelay_DSTATE.eColour@ */ /end MEASUREMENT
/begin MEASUREMENT autosar_swc_rlgs_rtARID_DEF.UnitDelay_DSTATE.eLineType "" UBYTE autosar_swc_rlgs_CM_uint8 0 0 0 255 ECU_ADDRESS 0xfe4af5b8 /* @ECU_Address@autosar_swc_rlgs_rtARID_DEF.UnitDelay_DSTATE.eLineType@ */ /end MEASUREMENT
/begin MEASUREMENT autosar_swc_rlgs_rtARID_DEF.UnitDelay_DSTATE_ga "" UWORD autosar_swc_rlgs_CM_uint16 0 0 0 65535 ECU_ADDRESS 0xfe4afc96 /* @ECU_Address@autosar_swc_rlgs_rtARID_DEF.UnitDelay_DSTATE_ga@ */ /end MEASUREMENT
/begin MEASUREMENT autosar_swc_rlgs_rtARID_DEF.UnitDelay_DSTATE_hx "" UBYTE autosar_swc_rlgs_CM_uint8 0 0 0 255 LAYOUT COLUMN_DIR MATRIX_DIM 8 ECU_ADDRESS 0xfe4afcb6 /* @ECU_Address@autosar_swc_rlgs_rtARID_DEF.UnitDelay_DSTATE_hx@ */ /end MEASUREMENT
/begin MEASUREMENT autosar_swc_rlgs_rtARID_DEF.UnitDelay_DSTATE_ig "" UWORD autosar_swc_rlgs_CM_uint16 0 0 0 65535 ECU_ADDRESS 0xfe4afc94 /* @ECU_Address@autosar_swc_rlgs_rtARID_DEF.UnitDelay_DSTATE_ig@ */ /end MEASUREMENT
/begin MEASUREMENT autosar_swc_rlgs_rtARID_DEF.UnitDelay_DSTATE_m.is_on_rout "" UBYTE autosar_swc_rlgs_CM_uint8 0 0 0 255 ECU_ADDRESS 0xfe4af7c6 /* @ECU_Address@autosar_swc_rlgs_rtARID_DEF.UnitDelay_DSTATE_m.is_on_rout@ */ /end MEASUREMENT
/begin MEASUREMENT autosar_swc_rlgs_rtARID_DEF.UnitDelay_DSTATE_m.lane_change_routing_direc "" SBYTE autosar_swc_rlgs_CM_int8 0 0 -128 127 ECU_ADDRESS 0xfe4af7c4 /* @ECU_Address@autosar_swc_rlgs_rtARID_DEF.UnitDelay_DSTATE_m.lane_change_routing_direc@ */ /end MEASUREMENT
/begin MEASUREMENT autosar_swc_rlgs_rtARID_DEF.UnitDelay_DSTATE_m.stub_direc "" UBYTE autosar_swc_rlgs_CM_uint8 0 0 0 255 ECU_ADDRESS 0xfe4af7c7 /* @ECU_Address@autosar_swc_rlgs_rtARID_DEF.UnitDelay_DSTATE_m.stub_direc@ */ /end MEASUREMENT
/begin MEASUREMENT autosar_swc_rlgs_rtARID_DEF.UnitDelay_DSTATE_m.stub_end_dis "" SLONG autosar_swc_rlgs_CM_int32 0 0 -2147483648 2147483647 ECU_ADDRESS 0xfe4af7d0 /* @ECU_Address@autosar_swc_rlgs_rtARID_DEF.UnitDelay_DSTATE_m.stub_end_dis@ */ /end MEASUREMENT
/begin MEASUREMENT autosar_swc_rlgs_rtARID_DEF.UnitDelay_DSTATE_m.stub_id "" ULONG autosar_swc_rlgs_CM_uint32 0 0 0 4294967295 ECU_ADDRESS 0xfe4af7d4 /* @ECU_Address@autosar_swc_rlgs_rtARID_DEF.UnitDelay_DSTATE_m.stub_id@ */ /end MEASUREMENT
/begin MEASUREMENT autosar_swc_rlgs_rtARID_DEF.UnitDelay_DSTATE_m.stub_linkSegment_id "" ULONG autosar_swc_rlgs_CM_uint32 0 0 0 4294967295 ECU_ADDRESS 0xfe4af7d8 /* @ECU_Address@autosar_swc_rlgs_rtARID_DEF.UnitDelay_DSTATE_m.stub_linkSegment_id@ */ /end MEASUREMENT
/begin MEASUREMENT autosar_swc_rlgs_rtARID_DEF.UnitDelay_DSTATE_m.stub_ramp_type "" UBYTE autosar_swc_rlgs_CM_uint8 0 0 0 255 ECU_ADDRESS 0xfe4af7c8 /* @ECU_Address@autosar_swc_rlgs_rtARID_DEF.UnitDelay_DSTATE_m.stub_ramp_type@ */ /end MEASUREMENT
/begin MEASUREMENT autosar_swc_rlgs_rtARID_DEF.UnitDelay_DSTATE_m.stub_start_dis "" SLONG autosar_swc_rlgs_CM_int32 0 0 -2147483648 2147483647 ECU_ADDRESS 0xfe4af7cc /* @ECU_Address@autosar_swc_rlgs_rtARID_DEF.UnitDelay_DSTATE_m.stub_start_dis@ */ /end MEASUREMENT
/begin MEASUREMENT autosar_swc_rlgs_rtARID_DEF.UnitDelay_DSTATE_m.stub_type "" UBYTE autosar_swc_rlgs_CM_uint8 0 0 0 255 ECU_ADDRESS 0xfe4af7c5 /* @ECU_Address@autosar_swc_rlgs_rtARID_DEF.UnitDelay_DSTATE_m.stub_type@ */ /end MEASUREMENT
/begin MEASUREMENT autosar_swc_rlgs_rtARID_DEF.UnitDelay_DSTATE_n.host_lane_idx "" UBYTE autosar_swc_rlgs_CM_uint8 0 0 0 255 ECU_ADDRESS 0xfe4af6b8 /* @ECU_Address@autosar_swc_rlgs_rtARID_DEF.UnitDelay_DSTATE_n.host_lane_idx@ */ /end MEASUREMENT
/begin MEASUREMENT autosar_swc_rlgs_rtARID_DEF.UnitDelay_DSTATE_n.lc_level "" UBYTE autosar_swc_rlgs_CM_uint8 0 0 0 255 ECU_ADDRESS 0xfe4af6bc /* @ECU_Address@autosar_swc_rlgs_rtARID_DEF.UnitDelay_DSTATE_n.lc_level@ */ /end MEASUREMENT
/begin MEASUREMENT autosar_swc_rlgs_rtARID_DEF.UnitDelay_DSTATE_n.lc_lntention_conds "" ULONG autosar_swc_rlgs_CM_uint32 0 0 0 4294967295 LAYOUT COLUMN_DIR MATRIX_DIM 10 ECU_ADDRESS 0xfe4af6c0 /* @ECU_Address@autosar_swc_rlgs_rtARID_DEF.UnitDelay_DSTATE_n.lc_lntention_conds@ */ /end MEASUREMENT
/begin MEASUREMENT autosar_swc_rlgs_rtARID_DEF.UnitDelay_DSTATE_n.lc_req "" UBYTE autosar_swc_rlgs_CM_uint8 0 0 0 255 ECU_ADDRESS 0xfe4af6ba /* @ECU_Address@autosar_swc_rlgs_rtARID_DEF.UnitDelay_DSTATE_n.lc_req@ */ /end MEASUREMENT
/begin MEASUREMENT autosar_swc_rlgs_rtARID_DEF.UnitDelay_DSTATE_n.lc_req_reason "" UBYTE autosar_swc_rlgs_CM_uint8 0 0 0 255 ECU_ADDRESS 0xfe4af6bd /* @ECU_Address@autosar_swc_rlgs_rtARID_DEF.UnitDelay_DSTATE_n.lc_req_reason@ */ /end MEASUREMENT
/begin MEASUREMENT autosar_swc_rlgs_rtARID_DEF.UnitDelay_DSTATE_n.lc_req_sync_id "" UBYTE autosar_swc_rlgs_CM_uint8 0 0 0 255 ECU_ADDRESS 0xfe4af6bb /* @ECU_Address@autosar_swc_rlgs_rtARID_DEF.UnitDelay_DSTATE_n.lc_req_sync_id@ */ /end MEASUREMENT
/begin MEASUREMENT autosar_swc_rlgs_rtARID_DEF.UnitDelay_DSTATE_n.target_lane_idx "" UBYTE autosar_swc_rlgs_CM_uint8 0 0 0 255 ECU_ADDRESS 0xfe4af6b9 /* @ECU_Address@autosar_swc_rlgs_rtARID_DEF.UnitDelay_DSTATE_n.target_lane_idx@ */ /end MEASUREMENT
/begin MEASUREMENT autosar_swc_rlgs_rtARID_DEF.is_active_c1387_autosar_swc_rlgs "" UBYTE autosar_swc_rlgs_CM_uint8 0 0 0 255 ECU_ADDRESS 0xfe4afd0a /* @ECU_Address@autosar_swc_rlgs_rtARID_DEF.is_active_c1387_autosar_swc_rlgs@ */ /end MEASUREMENT
/begin MEASUREMENT autosar_swc_rlgs_rtARID_DEF.is_c1387_autosar_swc_rlgs "" UBYTE autosar_swc_rlgs_CM_uint8 0 0 0 255 ECU_ADDRESS 0xfe4afd0b /* @ECU_Address@autosar_swc_rlgs_rtARID_DEF.is_c1387_autosar_swc_rlgs@ */ /end MEASUREMENT
/begin MEASUREMENT autosar_swc_rlgs_rtARID_DEF.tempo "" UBYTE autosar_swc_rlgs_CM_uint8 0 0 0 255 ECU_ADDRESS 0xfe4afd02 /* @ECU_Address@autosar_swc_rlgs_rtARID_DEF.tempo@ */ /end MEASUREMENT
/begin MEASUREMENT autosar_swc_rlgs_rtARID_DEF.tempo_g "" UBYTE autosar_swc_rlgs_CM_uint8 0 0 0 255 ECU_ADDRESS 0xfe4afd04 /* @ECU_Address@autosar_swc_rlgs_rtARID_DEF.tempo_g@ */ /end MEASUREMENT
/begin MEASUREMENT autosar_swc_rlgs_rtARID_DEF.tempo_j "" UBYTE autosar_swc_rlgs_CM_uint8 0 0 0 255 ECU_ADDRESS 0xfe4afd07 /* @ECU_Address@autosar_swc_rlgs_rtARID_DEF.tempo_j@ */ /end MEASUREMENT
/begin MEASUREMENT autosar_swc_rlgs_rtARID_DEF.tempo_ja "" UBYTE autosar_swc_rlgs_CM_uint8 0 0 0 255 ECU_ADDRESS 0xfe4afd09 /* @ECU_Address@autosar_swc_rlgs_rtARID_DEF.tempo_ja@ */ /end MEASUREMENT
/begin MEASUREMENT autosar_swc_rlgs_rtARID_DEF.timer "" UBYTE autosar_swc_rlgs_CM_uint8 0 0 0 255 ECU_ADDRESS 0xfe4afd01 /* @ECU_Address@autosar_swc_rlgs_rtARID_DEF.timer@ */ /end MEASUREMENT
/begin MEASUREMENT autosar_swc_rlgs_rtARID_DEF.timer_e "" UBYTE autosar_swc_rlgs_CM_uint8 0 0 0 255 ECU_ADDRESS 0xfe4afd06 /* @ECU_Address@autosar_swc_rlgs_rtARID_DEF.timer_e@ */ /end MEASUREMENT
/begin MEASUREMENT autosar_swc_rlgs_rtARID_DEF.timer_j "" UBYTE autosar_swc_rlgs_CM_uint8 0 0 0 255 ECU_ADDRESS 0xfe4afd03 /* @ECU_Address@autosar_swc_rlgs_rtARID_DEF.timer_j@ */ /end MEASUREMENT
/begin MEASUREMENT autosar_swc_rlgs_rtARID_DEF.timer_jg "" UBYTE autosar_swc_rlgs_CM_uint8 0 0 0 255 ECU_ADDRESS 0xfe4afd08 /* @ECU_Address@autosar_swc_rlgs_rtARID_DEF.timer_jg@ */ /end MEASUREMENT
/begin COMPU_METHOD autosar_swc_rlgs_CM_int32 "Q = V" IDENTICAL "%10.0" "" /end COMPU_METHOD
/begin COMPU_METHOD autosar_swc_rlgs_CM_int8 "Q = V" IDENTICAL "%3.0" "" /end COMPU_METHOD
/begin COMPU_METHOD autosar_swc_rlgs_CM_logical "Q = V" IDENTICAL "%1.0" "" /end COMPU_METHOD
/begin COMPU_METHOD autosar_swc_rlgs_CM_single "Q = V" IDENTICAL "%8.6" "" /end COMPU_METHOD
/begin COMPU_METHOD autosar_swc_rlgs_CM_uint16 "Q = V" IDENTICAL "%5.0" "" /end COMPU_METHOD
/begin COMPU_METHOD autosar_swc_rlgs_CM_uint32 "Q = V" IDENTICAL "%10.0" "" /end COMPU_METHOD
/begin COMPU_METHOD autosar_swc_rlgs_CM_uint64 "Q = V" IDENTICAL "%20.0" "" /end COMPU_METHOD
/begin COMPU_METHOD autosar_swc_rlgs_CM_uint8 "Q = V" IDENTICAL "%3.0" "" /end COMPU_METHOD
/begin RECORD_LAYOUT Record_FLOAT32_IEEE FNC_VALUES 1 FLOAT32_IEEE COLUMN_DIR DIRECT /end RECORD_LAYOUT
/begin RECORD_LAYOUT Record_UBYTE FNC_VALUES 1 UBYTE COLUMN_DIR DIRECT /end RECORD_LAYOUT
/begin GROUP autosar_swc_rlgs_autosar_swc_rlgs_Step_sys_rlgs1_alc1_alc_unpack "autosar_swc_rlgs/autosar_swc_rlgs_Step_sys/rlgs1/alc1/alc_unpack"
 /begin SUB_GROUP autosar_swc_rlgs_autosar_swc_rlgs_Step_sys_rlgs1_alc1_alc_unpack_alc_rainModeState /end SUB_GROUP
 /begin REF_MEASUREMENT PSM_reserve02 PSM_reserve03 PSM_reserve04 PSM_reserve05 PSM_reserve06 /end REF_MEASUREMENT
/end GROUP
/begin GROUP autosar_swc_rlgs_autosar_swc_rlgs_Step_sys_rlgs1_alc1_alc_unpack_alc_rainModeState "autosar_swc_rlgs/autosar_swc_rlgs_Step_sys/rlgs1/alc1/alc_unpack/alc_rainModeState"
 /begin SUB_GROUP autosar_swc_rlgs_autosar_swc_rlgs_Step_sys_rlgs1_alc1_alc_unpack_alc_rainModeState_Counter1 autosar_swc_rlgs_autosar_swc_rlgs_Step_sys_rlgs1_alc1_alc_unpack_alc_rainModeState_Counter3 /end SUB_GROUP
 /begin REF_MEASUREMENT autosar_swc_rlgs_rtARID_DEF.is_active_c1387_autosar_swc_rlgs autosar_swc_rlgs_rtARID_DEF.is_c1387_autosar_swc_rlgs /end REF_MEASUREMENT
/end GROUP
/begin GROUP autosar_swc_rlgs_autosar_swc_rlgs_Step_sys_rlgs1_alc1_alc_unpack_alc_rainModeState_Counter1 "autosar_swc_rlgs/autosar_swc_rlgs_Step_sys/rlgs1/alc1/alc_unpack/alc_rainModeState/Counter1" /begin REF_MEASUREMENT autosar_swc_rlgs_rtARID_DEF.UnitDelay_DSTATE_ga /end REF_MEASUREMENT /end GROUP
/begin GROUP autosar_swc_rlgs_autosar_swc_rlgs_Step_sys_rlgs1_alc1_alc_unpack_alc_rainModeState_Counter3 "autosar_swc_rlgs/autosar_swc_rlgs_Step_sys/rlgs1/alc1/alc_unpack/alc_rainModeState/Counter3" /begin REF_MEASUREMENT autosar_swc_rlgs_rtARID_DEF.UnitDelay_DSTATE_ig /end REF_MEASUREMENT /end GROUP
/begin GROUP autosar_swc_rlgs_autosar_swc_rlgs_Step_sys_rlgs1_alc1_tsr "autosar_swc_rlgs/autosar_swc_rlgs_Step_sys/rlgs1/alc1/tsr"
 /begin SUB_GROUP autosar_swc_rlgs_autosar_swc_rlgs_Step_sys_rlgs1_alc1_tsr_J3TSRAnalysis autosar_swc_rlgs_autosar_swc_rlgs_Step_sys_rlgs1_alc1_tsr_SpeedLimitFusion /end SUB_GROUP
 /begin REF_MEASUREMENT PSM_reserve09 PSM_reserve10 /end REF_MEASUREMENT
/end GROUP
/begin GROUP autosar_swc_rlgs_autosar_swc_rlgs_Step_sys_rlgs1_alc1_tsr_J3TSRAnalysis "autosar_swc_rlgs/autosar_swc_rlgs_Step_sys/rlgs1/alc1/tsr/J3TSRAnalysis"
 /begin SUB_GROUP autosar_swc_rlgs_autosar_swc_rlgs_Step_sys_rlgs1_alc1_tsr_J3TSRAnalysis_For_Each_Subsystem2 /end SUB_GROUP
 /begin REF_MEASUREMENT autosar_swc_rlgs_rtARID_DEF.Index autosar_swc_rlgs_rtARID_DEF.UnitDelay1_DSTATE_h autosar_swc_rlgs_rtARID_DEF.UnitDelay2_DSTATE_l autosar_swc_rlgs_rtARID_DEF.UnitDelay3_DSTATE_ef autosar_swc_rlgs_rtARID_DEF.UnitDelay_DSTATE_hx autosar_swc_rlgs_rtARID_DEF.tempo autosar_swc_rlgs_rtARID_DEF.tempo_g autosar_swc_rlgs_rtARID_DEF.tempo_j autosar_swc_rlgs_rtARID_DEF.tempo_ja autosar_swc_rlgs_rtARID_DEF.timer autosar_swc_rlgs_rtARID_DEF.timer_e autosar_swc_rlgs_rtARID_DEF.timer_j autosar_swc_rlgs_rtARID_DEF.timer_jg /end REF_MEASUREMENT
/end GROUP
/begin GROUP autosar_swc_rlgs_autosar_swc_rlgs_Step_sys_rlgs1_alc1_tsr_J3TSRAnalysis_For_Each_Subsystem2 "autosar_swc_rlgs/autosar_swc_rlgs_Step_sys/rlgs1/alc1/tsr/J3TSRAnalysis/For Each\nSubsystem2" /begin REF_CHARACTERISTIC P_TSR_XThreshold P_TSR_YThreshold /end REF_CHARACTERISTIC /end GROUP
/begin GROUP autosar_swc_rlgs_autosar_swc_rlgs_Step_sys_rlgs1_alc1_tsr_SpeedLimitFusion "autosar_swc_rlgs/autosar_swc_rlgs_Step_sys/rlgs1/alc1/tsr/SpeedLimitFusion"
 /begin SUB_GROUP autosar_swc_rlgs_autosar_swc_rlgs_Step_sys_rlgs1_alc1_tsr_SpeedLimitFusion_Compare_To_Constant autosar_swc_rlgs_autosar_swc_rlgs_Step_sys_rlgs1_alc1_tsr_SpeedLimitFusion_Compare_To_Constant6 /end SUB_GROUP
/end GROUP
/begin GROUP autosar_swc_rlgs_autosar_swc_rlgs_Step_sys_rlgs1_alc1_tsr_SpeedLimitFusion_Compare_To_Constant "autosar_swc_rlgs/autosar_swc_rlgs_Step_sys/rlgs1/alc1/tsr/SpeedLimitFusion/Compare\nTo Constant" /begin REF_CHARACTERISTIC P_ALC_SPLXThreshold /end REF_CHARACTERISTIC /end GROUP
/begin GROUP autosar_swc_rlgs_autosar_swc_rlgs_Step_sys_rlgs1_alc1_tsr_SpeedLimitFusion_Compare_To_Constant6 "autosar_swc_rlgs/autosar_swc_rlgs_Step_sys/rlgs1/alc1/tsr/SpeedLimitFusion/Compare\nTo Constant6" /begin REF_CHARACTERISTIC P_ALC_RampSplYThreased /end REF_CHARACTERISTIC /end GROUP
/begin GROUP autosar_swc_rlgs_rtARID_DEF.ALC_Path[0] ""
 /begin SUB_GROUP autosar_swc_rlgs_rtARID_DEF.ALC_Path[0].left_constraint autosar_swc_rlgs_rtARID_DEF.ALC_Path[0].right_constraint autosar_swc_rlgs_rtARID_DEF.ALC_Path[0].center_refline /end SUB_GROUP
 /begin REF_MEASUREMENT autosar_swc_rlgs_rtARID_DEF.ALC_Path[0].type autosar_swc_rlgs_rtARID_DEF.ALC_Path[0].lane_source autosar_swc_rlgs_rtARID_DEF.ALC_Path[0].lane_extension_type autosar_swc_rlgs_rtARID_DEF.ALC_Path[0].arrow_dir autosar_swc_rlgs_rtARID_DEF.ALC_Path[0].current_width autosar_swc_rlgs_rtARID_DEF.ALC_Path[0].end_dist autosar_swc_rlgs_rtARID_DEF.ALC_Path[0].id /end REF_MEASUREMENT
/end GROUP
/begin GROUP autosar_swc_rlgs_rtARID_DEF.ALC_Path[0].center_refline ""
 /begin SUB_GROUP autosar_swc_rlgs_rtARID_DEF.ALC_Path[0].center_refline.curve /end SUB_GROUP
 /begin REF_MEASUREMENT autosar_swc_rlgs_rtARID_DEF.ALC_Path[0].center_refline.ref_source autosar_swc_rlgs_rtARID_DEF.ALC_Path[0].center_refline.calc_state autosar_swc_rlgs_rtARID_DEF.ALC_Path[0].center_refline.id /end REF_MEASUREMENT
/end GROUP
/begin GROUP autosar_swc_rlgs_rtARID_DEF.ALC_Path[0].center_refline.curve ""
 /begin REF_MEASUREMENT autosar_swc_rlgs_rtARID_DEF.ALC_Path[0].center_refline.curve.start autosar_swc_rlgs_rtARID_DEF.ALC_Path[0].center_refline.curve.end autosar_swc_rlgs_rtARID_DEF.ALC_Path[0].center_refline.curve.poly_vec /end REF_MEASUREMENT
/end GROUP
/begin GROUP autosar_swc_rlgs_rtARID_DEF.ALC_Path[0].left_constraint ""
 /begin SUB_GROUP autosar_swc_rlgs_rtARID_DEF.ALC_Path[0].left_constraint.curve /end SUB_GROUP
 /begin REF_MEASUREMENT autosar_swc_rlgs_rtARID_DEF.ALC_Path[0].left_constraint.constraint_type autosar_swc_rlgs_rtARID_DEF.ALC_Path[0].left_constraint.constraint_type_ahead autosar_swc_rlgs_rtARID_DEF.ALC_Path[0].left_constraint.source_type autosar_swc_rlgs_rtARID_DEF.ALC_Path[0].left_constraint.meas_state autosar_swc_rlgs_rtARID_DEF.ALC_Path[0].left_constraint.constraint_type_change_point_dx autosar_swc_rlgs_rtARID_DEF.ALC_Path[0].left_constraint.visible_end autosar_swc_rlgs_rtARID_DEF.ALC_Path[0].left_constraint.id /end REF_MEASUREMENT
/end GROUP
/begin GROUP autosar_swc_rlgs_rtARID_DEF.ALC_Path[0].left_constraint.curve ""
 /begin REF_MEASUREMENT autosar_swc_rlgs_rtARID_DEF.ALC_Path[0].left_constraint.curve.start autosar_swc_rlgs_rtARID_DEF.ALC_Path[0].left_constraint.curve.end autosar_swc_rlgs_rtARID_DEF.ALC_Path[0].left_constraint.curve.poly_vec /end REF_MEASUREMENT
/end GROUP
/begin GROUP autosar_swc_rlgs_rtARID_DEF.ALC_Path[0].right_constraint ""
 /begin SUB_GROUP autosar_swc_rlgs_rtARID_DEF.ALC_Path[0].right_constraint.curve /end SUB_GROUP
 /begin REF_MEASUREMENT autosar_swc_rlgs_rtARID_DEF.ALC_Path[0].right_constraint.constraint_type autosar_swc_rlgs_rtARID_DEF.ALC_Path[0].right_constraint.constraint_type_ahead autosar_swc_rlgs_rtARID_DEF.ALC_Path[0].right_constraint.source_type autosar_swc_rlgs_rtARID_DEF.ALC_Path[0].right_constraint.meas_state autosar_swc_rlgs_rtARID_DEF.ALC_Path[0].right_constraint.constraint_type_change_point_dx autosar_swc_rlgs_rtARID_DEF.ALC_Path[0].right_constraint.visible_end autosar_swc_rlgs_rtARID_DEF.ALC_Path[0].right_constraint.id /end REF_MEASUREMENT
/end GROUP
/begin GROUP autosar_swc_rlgs_rtARID_DEF.ALC_Path[0].right_constraint.curve ""
 /begin REF_MEASUREMENT autosar_swc_rlgs_rtARID_DEF.ALC_Path[0].right_constraint.curve.start autosar_swc_rlgs_rtARID_DEF.ALC_Path[0].right_constraint.curve.end autosar_swc_rlgs_rtARID_DEF.ALC_Path[0].right_constraint.curve.poly_vec /end REF_MEASUREMENT
/end GROUP
/begin GROUP autosar_swc_rlgs_rtARID_DEF.ALC_Path[1] ""
 /begin SUB_GROUP autosar_swc_rlgs_rtARID_DEF.ALC_Path[1].left_constraint autosar_swc_rlgs_rtARID_DEF.ALC_Path[1].right_constraint autosar_swc_rlgs_rtARID_DEF.ALC_Path[1].center_refline /end SUB_GROUP
 /begin REF_MEASUREMENT autosar_swc_rlgs_rtARID_DEF.ALC_Path[1].type autosar_swc_rlgs_rtARID_DEF.ALC_Path[1].lane_source autosar_swc_rlgs_rtARID_DEF.ALC_Path[1].lane_extension_type autosar_swc_rlgs_rtARID_DEF.ALC_Path[1].arrow_dir autosar_swc_rlgs_rtARID_DEF.ALC_Path[1].current_width autosar_swc_rlgs_rtARID_DEF.ALC_Path[1].end_dist autosar_swc_rlgs_rtARID_DEF.ALC_Path[1].id /end REF_MEASUREMENT
/end GROUP
/begin GROUP autosar_swc_rlgs_rtARID_DEF.ALC_Path[1].center_refline ""
 /begin SUB_GROUP autosar_swc_rlgs_rtARID_DEF.ALC_Path[1].center_refline.curve /end SUB_GROUP
 /begin REF_MEASUREMENT autosar_swc_rlgs_rtARID_DEF.ALC_Path[1].center_refline.ref_source autosar_swc_rlgs_rtARID_DEF.ALC_Path[1].center_refline.calc_state autosar_swc_rlgs_rtARID_DEF.ALC_Path[1].center_refline.id /end REF_MEASUREMENT
/end GROUP
/begin GROUP autosar_swc_rlgs_rtARID_DEF.ALC_Path[1].center_refline.curve ""
 /begin REF_MEASUREMENT autosar_swc_rlgs_rtARID_DEF.ALC_Path[1].center_refline.curve.start autosar_swc_rlgs_rtARID_DEF.ALC_Path[1].center_refline.curve.end autosar_swc_rlgs_rtARID_DEF.ALC_Path[1].center_refline.curve.poly_vec /end REF_MEASUREMENT
/end GROUP
/begin GROUP autosar_swc_rlgs_rtARID_DEF.ALC_Path[1].left_constraint ""
 /begin SUB_GROUP autosar_swc_rlgs_rtARID_DEF.ALC_Path[1].left_constraint.curve /end SUB_GROUP
 /begin REF_MEASUREMENT autosar_swc_rlgs_rtARID_DEF.ALC_Path[1].left_constraint.constraint_type autosar_swc_rlgs_rtARID_DEF.ALC_Path[1].left_constraint.constraint_type_ahead autosar_swc_rlgs_rtARID_DEF.ALC_Path[1].left_constraint.source_type autosar_swc_rlgs_rtARID_DEF.ALC_Path[1].left_constraint.meas_state autosar_swc_rlgs_rtARID_DEF.ALC_Path[1].left_constraint.constraint_type_change_point_dx autosar_swc_rlgs_rtARID_DEF.ALC_Path[1].left_constraint.visible_end autosar_swc_rlgs_rtARID_DEF.ALC_Path[1].left_constraint.id /end REF_MEASUREMENT
/end GROUP
/begin GROUP autosar_swc_rlgs_rtARID_DEF.ALC_Path[1].left_constraint.curve ""
 /begin REF_MEASUREMENT autosar_swc_rlgs_rtARID_DEF.ALC_Path[1].left_constraint.curve.start autosar_swc_rlgs_rtARID_DEF.ALC_Path[1].left_constraint.curve.end autosar_swc_rlgs_rtARID_DEF.ALC_Path[1].left_constraint.curve.poly_vec /end REF_MEASUREMENT
/end GROUP
/begin GROUP autosar_swc_rlgs_rtARID_DEF.ALC_Path[1].right_constraint ""
 /begin SUB_GROUP autosar_swc_rlgs_rtARID_DEF.ALC_Path[1].right_constraint.curve /end SUB_GROUP
 /begin REF_MEASUREMENT autosar_swc_rlgs_rtARID_DEF.ALC_Path[1].right_constraint.constraint_type autosar_swc_rlgs_rtARID_DEF.ALC_Path[1].right_constraint.constraint_type_ahead autosar_swc_rlgs_rtARID_DEF.ALC_Path[1].right_constraint.source_type autosar_swc_rlgs_rtARID_DEF.ALC_Path[1].right_constraint.meas_state autosar_swc_rlgs_rtARID_DEF.ALC_Path[1].right_constraint.constraint_type_change_point_dx autosar_swc_rlgs_rtARID_DEF.ALC_Path[1].right_constraint.visible_end autosar_swc_rlgs_rtARID_DEF.ALC_Path[1].right_constraint.id /end REF_MEASUREMENT
/end GROUP
/begin GROUP autosar_swc_rlgs_rtARID_DEF.ALC_Path[1].right_constraint.curve ""
 /begin REF_MEASUREMENT autosar_swc_rlgs_rtARID_DEF.ALC_Path[1].right_constraint.curve.start autosar_swc_rlgs_rtARID_DEF.ALC_Path[1].right_constraint.curve.end autosar_swc_rlgs_rtARID_DEF.ALC_Path[1].right_constraint.curve.poly_vec /end REF_MEASUREMENT
/end GROUP
/begin GROUP autosar_swc_rlgs_rtARID_DEF.ALC_Path[2] ""
 /begin SUB_GROUP autosar_swc_rlgs_rtARID_DEF.ALC_Path[2].left_constraint autosar_swc_rlgs_rtARID_DEF.ALC_Path[2].right_constraint autosar_swc_rlgs_rtARID_DEF.ALC_Path[2].center_refline /end SUB_GROUP
 /begin REF_MEASUREMENT autosar_swc_rlgs_rtARID_DEF.ALC_Path[2].type autosar_swc_rlgs_rtARID_DEF.ALC_Path[2].lane_source autosar_swc_rlgs_rtARID_DEF.ALC_Path[2].lane_extension_type autosar_swc_rlgs_rtARID_DEF.ALC_Path[2].arrow_dir autosar_swc_rlgs_rtARID_DEF.ALC_Path[2].current_width autosar_swc_rlgs_rtARID_DEF.ALC_Path[2].end_dist autosar_swc_rlgs_rtARID_DEF.ALC_Path[2].id /end REF_MEASUREMENT
/end GROUP
/begin GROUP autosar_swc_rlgs_rtARID_DEF.ALC_Path[2].center_refline ""
 /begin SUB_GROUP autosar_swc_rlgs_rtARID_DEF.ALC_Path[2].center_refline.curve /end SUB_GROUP
 /begin REF_MEASUREMENT autosar_swc_rlgs_rtARID_DEF.ALC_Path[2].center_refline.ref_source autosar_swc_rlgs_rtARID_DEF.ALC_Path[2].center_refline.calc_state autosar_swc_rlgs_rtARID_DEF.ALC_Path[2].center_refline.id /end REF_MEASUREMENT
/end GROUP
/begin GROUP autosar_swc_rlgs_rtARID_DEF.ALC_Path[2].center_refline.curve ""
 /begin REF_MEASUREMENT autosar_swc_rlgs_rtARID_DEF.ALC_Path[2].center_refline.curve.start autosar_swc_rlgs_rtARID_DEF.ALC_Path[2].center_refline.curve.end autosar_swc_rlgs_rtARID_DEF.ALC_Path[2].center_refline.curve.poly_vec /end REF_MEASUREMENT
/end GROUP
/begin GROUP autosar_swc_rlgs_rtARID_DEF.ALC_Path[2].left_constraint ""
 /begin SUB_GROUP autosar_swc_rlgs_rtARID_DEF.ALC_Path[2].left_constraint.curve /end SUB_GROUP
 /begin REF_MEASUREMENT autosar_swc_rlgs_rtARID_DEF.ALC_Path[2].left_constraint.constraint_type autosar_swc_rlgs_rtARID_DEF.ALC_Path[2].left_constraint.constraint_type_ahead autosar_swc_rlgs_rtARID_DEF.ALC_Path[2].left_constraint.source_type autosar_swc_rlgs_rtARID_DEF.ALC_Path[2].left_constraint.meas_state autosar_swc_rlgs_rtARID_DEF.ALC_Path[2].left_constraint.constraint_type_change_point_dx autosar_swc_rlgs_rtARID_DEF.ALC_Path[2].left_constraint.visible_end autosar_swc_rlgs_rtARID_DEF.ALC_Path[2].left_constraint.id /end REF_MEASUREMENT
/end GROUP
/begin GROUP autosar_swc_rlgs_rtARID_DEF.ALC_Path[2].left_constraint.curve ""
 /begin REF_MEASUREMENT autosar_swc_rlgs_rtARID_DEF.ALC_Path[2].left_constraint.curve.start autosar_swc_rlgs_rtARID_DEF.ALC_Path[2].left_constraint.curve.end autosar_swc_rlgs_rtARID_DEF.ALC_Path[2].left_constraint.curve.poly_vec /end REF_MEASUREMENT
/end GROUP
/begin GROUP autosar_swc_rlgs_rtARID_DEF.ALC_Path[2].right_constraint ""
 /begin SUB_GROUP autosar_swc_rlgs_rtARID_DEF.ALC_Path[2].right_constraint.curve /end SUB_GROUP
 /begin REF_MEASUREMENT autosar_swc_rlgs_rtARID_DEF.ALC_Path[2].right_constraint.constraint_type autosar_swc_rlgs_rtARID_DEF.ALC_Path[2].right_constraint.constraint_type_ahead autosar_swc_rlgs_rtARID_DEF.ALC_Path[2].right_constraint.source_type autosar_swc_rlgs_rtARID_DEF.ALC_Path[2].right_constraint.meas_state autosar_swc_rlgs_rtARID_DEF.ALC_Path[2].right_constraint.constraint_type_change_point_dx autosar_swc_rlgs_rtARID_DEF.ALC_Path[2].right_constraint.visible_end autosar_swc_rlgs_rtARID_DEF.ALC_Path[2].right_constraint.id /end REF_MEASUREMENT
/end GROUP
/begin GROUP autosar_swc_rlgs_rtARID_DEF.ALC_Path[2].right_constraint.curve ""
 /begin REF_MEASUREMENT autosar_swc_rlgs_rtARID_DEF.ALC_Path[2].right_constraint.curve.start autosar_swc_rlgs_rtARID_DEF.ALC_Path[2].right_constraint.curve.end autosar_swc_rlgs_rtARID_DEF.ALC_Path[2].right_constraint.curve.poly_vec /end REF_MEASUREMENT
/end GROUP
/begin GROUP autosar_swc_rlgs_rtARID_DEF.ALC_Path[3] ""
 /begin SUB_GROUP autosar_swc_rlgs_rtARID_DEF.ALC_Path[3].left_constraint autosar_swc_rlgs_rtARID_DEF.ALC_Path[3].right_constraint autosar_swc_rlgs_rtARID_DEF.ALC_Path[3].center_refline /end SUB_GROUP
 /begin REF_MEASUREMENT autosar_swc_rlgs_rtARID_DEF.ALC_Path[3].type autosar_swc_rlgs_rtARID_DEF.ALC_Path[3].lane_source autosar_swc_rlgs_rtARID_DEF.ALC_Path[3].lane_extension_type autosar_swc_rlgs_rtARID_DEF.ALC_Path[3].arrow_dir autosar_swc_rlgs_rtARID_DEF.ALC_Path[3].current_width autosar_swc_rlgs_rtARID_DEF.ALC_Path[3].end_dist autosar_swc_rlgs_rtARID_DEF.ALC_Path[3].id /end REF_MEASUREMENT
/end GROUP
/begin GROUP autosar_swc_rlgs_rtARID_DEF.ALC_Path[3].center_refline ""
 /begin SUB_GROUP autosar_swc_rlgs_rtARID_DEF.ALC_Path[3].center_refline.curve /end SUB_GROUP
 /begin REF_MEASUREMENT autosar_swc_rlgs_rtARID_DEF.ALC_Path[3].center_refline.ref_source autosar_swc_rlgs_rtARID_DEF.ALC_Path[3].center_refline.calc_state autosar_swc_rlgs_rtARID_DEF.ALC_Path[3].center_refline.id /end REF_MEASUREMENT
/end GROUP
/begin GROUP autosar_swc_rlgs_rtARID_DEF.ALC_Path[3].center_refline.curve ""
 /begin REF_MEASUREMENT autosar_swc_rlgs_rtARID_DEF.ALC_Path[3].center_refline.curve.start autosar_swc_rlgs_rtARID_DEF.ALC_Path[3].center_refline.curve.end autosar_swc_rlgs_rtARID_DEF.ALC_Path[3].center_refline.curve.poly_vec /end REF_MEASUREMENT
/end GROUP
/begin GROUP autosar_swc_rlgs_rtARID_DEF.ALC_Path[3].left_constraint ""
 /begin SUB_GROUP autosar_swc_rlgs_rtARID_DEF.ALC_Path[3].left_constraint.curve /end SUB_GROUP
 /begin REF_MEASUREMENT autosar_swc_rlgs_rtARID_DEF.ALC_Path[3].left_constraint.constraint_type autosar_swc_rlgs_rtARID_DEF.ALC_Path[3].left_constraint.constraint_type_ahead autosar_swc_rlgs_rtARID_DEF.ALC_Path[3].left_constraint.source_type autosar_swc_rlgs_rtARID_DEF.ALC_Path[3].left_constraint.meas_state autosar_swc_rlgs_rtARID_DEF.ALC_Path[3].left_constraint.constraint_type_change_point_dx autosar_swc_rlgs_rtARID_DEF.ALC_Path[3].left_constraint.visible_end autosar_swc_rlgs_rtARID_DEF.ALC_Path[3].left_constraint.id /end REF_MEASUREMENT
/end GROUP
/begin GROUP autosar_swc_rlgs_rtARID_DEF.ALC_Path[3].left_constraint.curve ""
 /begin REF_MEASUREMENT autosar_swc_rlgs_rtARID_DEF.ALC_Path[3].left_constraint.curve.start autosar_swc_rlgs_rtARID_DEF.ALC_Path[3].left_constraint.curve.end autosar_swc_rlgs_rtARID_DEF.ALC_Path[3].left_constraint.curve.poly_vec /end REF_MEASUREMENT
/end GROUP
/begin GROUP autosar_swc_rlgs_rtARID_DEF.ALC_Path[3].right_constraint ""
 /begin SUB_GROUP autosar_swc_rlgs_rtARID_DEF.ALC_Path[3].right_constraint.curve /end SUB_GROUP
 /begin REF_MEASUREMENT autosar_swc_rlgs_rtARID_DEF.ALC_Path[3].right_constraint.constraint_type autosar_swc_rlgs_rtARID_DEF.ALC_Path[3].right_constraint.constraint_type_ahead autosar_swc_rlgs_rtARID_DEF.ALC_Path[3].right_constraint.source_type autosar_swc_rlgs_rtARID_DEF.ALC_Path[3].right_constraint.meas_state autosar_swc_rlgs_rtARID_DEF.ALC_Path[3].right_constraint.constraint_type_change_point_dx autosar_swc_rlgs_rtARID_DEF.ALC_Path[3].right_constraint.visible_end autosar_swc_rlgs_rtARID_DEF.ALC_Path[3].right_constraint.id /end REF_MEASUREMENT
/end GROUP
/begin GROUP autosar_swc_rlgs_rtARID_DEF.ALC_Path[3].right_constraint.curve ""
 /begin REF_MEASUREMENT autosar_swc_rlgs_rtARID_DEF.ALC_Path[3].right_constraint.curve.start autosar_swc_rlgs_rtARID_DEF.ALC_Path[3].right_constraint.curve.end autosar_swc_rlgs_rtARID_DEF.ALC_Path[3].right_constraint.curve.poly_vec /end REF_MEASUREMENT
/end GROUP
/begin GROUP autosar_swc_rlgs_rtARID_DEF.ALC_Path[4] ""
 /begin SUB_GROUP autosar_swc_rlgs_rtARID_DEF.ALC_Path[4].left_constraint autosar_swc_rlgs_rtARID_DEF.ALC_Path[4].right_constraint autosar_swc_rlgs_rtARID_DEF.ALC_Path[4].center_refline /end SUB_GROUP
 /begin REF_MEASUREMENT autosar_swc_rlgs_rtARID_DEF.ALC_Path[4].type autosar_swc_rlgs_rtARID_DEF.ALC_Path[4].lane_source autosar_swc_rlgs_rtARID_DEF.ALC_Path[4].lane_extension_type autosar_swc_rlgs_rtARID_DEF.ALC_Path[4].arrow_dir autosar_swc_rlgs_rtARID_DEF.ALC_Path[4].current_width autosar_swc_rlgs_rtARID_DEF.ALC_Path[4].end_dist autosar_swc_rlgs_rtARID_DEF.ALC_Path[4].id /end REF_MEASUREMENT
/end GROUP
/begin GROUP autosar_swc_rlgs_rtARID_DEF.ALC_Path[4].center_refline ""
 /begin SUB_GROUP autosar_swc_rlgs_rtARID_DEF.ALC_Path[4].center_refline.curve /end SUB_GROUP
 /begin REF_MEASUREMENT autosar_swc_rlgs_rtARID_DEF.ALC_Path[4].center_refline.ref_source autosar_swc_rlgs_rtARID_DEF.ALC_Path[4].center_refline.calc_state autosar_swc_rlgs_rtARID_DEF.ALC_Path[4].center_refline.id /end REF_MEASUREMENT
/end GROUP
/begin GROUP autosar_swc_rlgs_rtARID_DEF.ALC_Path[4].center_refline.curve ""
 /begin REF_MEASUREMENT autosar_swc_rlgs_rtARID_DEF.ALC_Path[4].center_refline.curve.start autosar_swc_rlgs_rtARID_DEF.ALC_Path[4].center_refline.curve.end autosar_swc_rlgs_rtARID_DEF.ALC_Path[4].center_refline.curve.poly_vec /end REF_MEASUREMENT
/end GROUP
/begin GROUP autosar_swc_rlgs_rtARID_DEF.ALC_Path[4].left_constraint ""
 /begin SUB_GROUP autosar_swc_rlgs_rtARID_DEF.ALC_Path[4].left_constraint.curve /end SUB_GROUP
 /begin REF_MEASUREMENT autosar_swc_rlgs_rtARID_DEF.ALC_Path[4].left_constraint.constraint_type autosar_swc_rlgs_rtARID_DEF.ALC_Path[4].left_constraint.constraint_type_ahead autosar_swc_rlgs_rtARID_DEF.ALC_Path[4].left_constraint.source_type autosar_swc_rlgs_rtARID_DEF.ALC_Path[4].left_constraint.meas_state autosar_swc_rlgs_rtARID_DEF.ALC_Path[4].left_constraint.constraint_type_change_point_dx autosar_swc_rlgs_rtARID_DEF.ALC_Path[4].left_constraint.visible_end autosar_swc_rlgs_rtARID_DEF.ALC_Path[4].left_constraint.id /end REF_MEASUREMENT
/end GROUP
/begin GROUP autosar_swc_rlgs_rtARID_DEF.ALC_Path[4].left_constraint.curve ""
 /begin REF_MEASUREMENT autosar_swc_rlgs_rtARID_DEF.ALC_Path[4].left_constraint.curve.start autosar_swc_rlgs_rtARID_DEF.ALC_Path[4].left_constraint.curve.end autosar_swc_rlgs_rtARID_DEF.ALC_Path[4].left_constraint.curve.poly_vec /end REF_MEASUREMENT
/end GROUP
/begin GROUP autosar_swc_rlgs_rtARID_DEF.ALC_Path[4].right_constraint ""
 /begin SUB_GROUP autosar_swc_rlgs_rtARID_DEF.ALC_Path[4].right_constraint.curve /end SUB_GROUP
 /begin REF_MEASUREMENT autosar_swc_rlgs_rtARID_DEF.ALC_Path[4].right_constraint.constraint_type autosar_swc_rlgs_rtARID_DEF.ALC_Path[4].right_constraint.constraint_type_ahead autosar_swc_rlgs_rtARID_DEF.ALC_Path[4].right_constraint.source_type autosar_swc_rlgs_rtARID_DEF.ALC_Path[4].right_constraint.meas_state autosar_swc_rlgs_rtARID_DEF.ALC_Path[4].right_constraint.constraint_type_change_point_dx autosar_swc_rlgs_rtARID_DEF.ALC_Path[4].right_constraint.visible_end autosar_swc_rlgs_rtARID_DEF.ALC_Path[4].right_constraint.id /end REF_MEASUREMENT
/end GROUP
/begin GROUP autosar_swc_rlgs_rtARID_DEF.ALC_Path[4].right_constraint.curve ""
 /begin REF_MEASUREMENT autosar_swc_rlgs_rtARID_DEF.ALC_Path[4].right_constraint.curve.start autosar_swc_rlgs_rtARID_DEF.ALC_Path[4].right_constraint.curve.end autosar_swc_rlgs_rtARID_DEF.ALC_Path[4].right_constraint.curve.poly_vec /end REF_MEASUREMENT
/end GROUP
/begin GROUP autosar_swc_rlgs_rtARID_DEF.ALC_Path[5] ""
 /begin SUB_GROUP autosar_swc_rlgs_rtARID_DEF.ALC_Path[5].left_constraint autosar_swc_rlgs_rtARID_DEF.ALC_Path[5].right_constraint autosar_swc_rlgs_rtARID_DEF.ALC_Path[5].center_refline /end SUB_GROUP
 /begin REF_MEASUREMENT autosar_swc_rlgs_rtARID_DEF.ALC_Path[5].type autosar_swc_rlgs_rtARID_DEF.ALC_Path[5].lane_source autosar_swc_rlgs_rtARID_DEF.ALC_Path[5].lane_extension_type autosar_swc_rlgs_rtARID_DEF.ALC_Path[5].arrow_dir autosar_swc_rlgs_rtARID_DEF.ALC_Path[5].current_width autosar_swc_rlgs_rtARID_DEF.ALC_Path[5].end_dist autosar_swc_rlgs_rtARID_DEF.ALC_Path[5].id /end REF_MEASUREMENT
/end GROUP
/begin GROUP autosar_swc_rlgs_rtARID_DEF.ALC_Path[5].center_refline ""
 /begin SUB_GROUP autosar_swc_rlgs_rtARID_DEF.ALC_Path[5].center_refline.curve /end SUB_GROUP
 /begin REF_MEASUREMENT autosar_swc_rlgs_rtARID_DEF.ALC_Path[5].center_refline.ref_source autosar_swc_rlgs_rtARID_DEF.ALC_Path[5].center_refline.calc_state autosar_swc_rlgs_rtARID_DEF.ALC_Path[5].center_refline.id /end REF_MEASUREMENT
/end GROUP
/begin GROUP autosar_swc_rlgs_rtARID_DEF.ALC_Path[5].center_refline.curve ""
 /begin REF_MEASUREMENT autosar_swc_rlgs_rtARID_DEF.ALC_Path[5].center_refline.curve.start autosar_swc_rlgs_rtARID_DEF.ALC_Path[5].center_refline.curve.end autosar_swc_rlgs_rtARID_DEF.ALC_Path[5].center_refline.curve.poly_vec /end REF_MEASUREMENT
/end GROUP
/begin GROUP autosar_swc_rlgs_rtARID_DEF.ALC_Path[5].left_constraint ""
 /begin SUB_GROUP autosar_swc_rlgs_rtARID_DEF.ALC_Path[5].left_constraint.curve /end SUB_GROUP
 /begin REF_MEASUREMENT autosar_swc_rlgs_rtARID_DEF.ALC_Path[5].left_constraint.constraint_type autosar_swc_rlgs_rtARID_DEF.ALC_Path[5].left_constraint.constraint_type_ahead autosar_swc_rlgs_rtARID_DEF.ALC_Path[5].left_constraint.source_type autosar_swc_rlgs_rtARID_DEF.ALC_Path[5].left_constraint.meas_state autosar_swc_rlgs_rtARID_DEF.ALC_Path[5].left_constraint.constraint_type_change_point_dx autosar_swc_rlgs_rtARID_DEF.ALC_Path[5].left_constraint.visible_end autosar_swc_rlgs_rtARID_DEF.ALC_Path[5].left_constraint.id /end REF_MEASUREMENT
/end GROUP
/begin GROUP autosar_swc_rlgs_rtARID_DEF.ALC_Path[5].left_constraint.curve ""
 /begin REF_MEASUREMENT autosar_swc_rlgs_rtARID_DEF.ALC_Path[5].left_constraint.curve.start autosar_swc_rlgs_rtARID_DEF.ALC_Path[5].left_constraint.curve.end autosar_swc_rlgs_rtARID_DEF.ALC_Path[5].left_constraint.curve.poly_vec /end REF_MEASUREMENT
/end GROUP
/begin GROUP autosar_swc_rlgs_rtARID_DEF.ALC_Path[5].right_constraint ""
 /begin SUB_GROUP autosar_swc_rlgs_rtARID_DEF.ALC_Path[5].right_constraint.curve /end SUB_GROUP
 /begin REF_MEASUREMENT autosar_swc_rlgs_rtARID_DEF.ALC_Path[5].right_constraint.constraint_type autosar_swc_rlgs_rtARID_DEF.ALC_Path[5].right_constraint.constraint_type_ahead autosar_swc_rlgs_rtARID_DEF.ALC_Path[5].right_constraint.source_type autosar_swc_rlgs_rtARID_DEF.ALC_Path[5].right_constraint.meas_state autosar_swc_rlgs_rtARID_DEF.ALC_Path[5].right_constraint.constraint_type_change_point_dx autosar_swc_rlgs_rtARID_DEF.ALC_Path[5].right_constraint.visible_end autosar_swc_rlgs_rtARID_DEF.ALC_Path[5].right_constraint.id /end REF_MEASUREMENT
/end GROUP
/begin GROUP autosar_swc_rlgs_rtARID_DEF.ALC_Path[5].right_constraint.curve ""
 /begin REF_MEASUREMENT autosar_swc_rlgs_rtARID_DEF.ALC_Path[5].right_constraint.curve.start autosar_swc_rlgs_rtARID_DEF.ALC_Path[5].right_constraint.curve.end autosar_swc_rlgs_rtARID_DEF.ALC_Path[5].right_constraint.curve.poly_vec /end REF_MEASUREMENT
/end GROUP
/begin GROUP autosar_swc_rlgs_rtARID_DEF.Front_Valid_stub ""
 /begin REF_MEASUREMENT autosar_swc_rlgs_rtARID_DEF.Front_Valid_stub.lane_change_routing_direc autosar_swc_rlgs_rtARID_DEF.Front_Valid_stub.stub_type autosar_swc_rlgs_rtARID_DEF.Front_Valid_stub.is_on_rout autosar_swc_rlgs_rtARID_DEF.Front_Valid_stub.stub_direc autosar_swc_rlgs_rtARID_DEF.Front_Valid_stub.stub_ramp_type autosar_swc_rlgs_rtARID_DEF.Front_Valid_stub.stub_start_dis autosar_swc_rlgs_rtARID_DEF.Front_Valid_stub.stub_end_dis autosar_swc_rlgs_rtARID_DEF.Front_Valid_stub.stub_id autosar_swc_rlgs_rtARID_DEF.Front_Valid_stub.stub_linkSegment_id /end REF_MEASUREMENT
/end GROUP
/begin GROUP autosar_swc_rlgs_rtARID_DEF.Switch2 ""
 /begin REF_MEASUREMENT autosar_swc_rlgs_rtARID_DEF.Switch2.OperateState autosar_swc_rlgs_rtARID_DEF.Switch2.bIsLineExist autosar_swc_rlgs_rtARID_DEF.Switch2.dQuality autosar_swc_rlgs_rtARID_DEF.Switch2.dC3V autosar_swc_rlgs_rtARID_DEF.Switch2.dC2V autosar_swc_rlgs_rtARID_DEF.Switch2.dC1V autosar_swc_rlgs_rtARID_DEF.Switch2.dC0V autosar_swc_rlgs_rtARID_DEF.Switch2.dDisStart autosar_swc_rlgs_rtARID_DEF.Switch2.dDisFront autosar_swc_rlgs_rtARID_DEF.Switch2.eLineType autosar_swc_rlgs_rtARID_DEF.Switch2.TrackID autosar_swc_rlgs_rtARID_DEF.Switch2.eColour autosar_swc_rlgs_rtARID_DEF.Switch2.Crossing autosar_swc_rlgs_rtARID_DEF.Switch2.dLaneWidth autosar_swc_rlgs_rtARID_DEF.Switch2.ObstacleFlag autosar_swc_rlgs_rtARID_DEF.Switch2.LaneExtraNearPointType autosar_swc_rlgs_rtARID_DEF.Switch2.LaneExtraFarPointType autosar_swc_rlgs_rtARID_DEF.Switch2.LaneExtraFarPointPosX autosar_swc_rlgs_rtARID_DEF.Switch2.LaneExtraFarPointPosY autosar_swc_rlgs_rtARID_DEF.Switch2.LaneExtraNearPointPosX autosar_swc_rlgs_rtARID_DEF.Switch2.LaneExtraNearPointPosY autosar_swc_rlgs_rtARID_DEF.Switch2.LaneParsingConfidence autosar_swc_rlgs_rtARID_DEF.Switch2.Stopline_Relevancy /end REF_MEASUREMENT
/end GROUP
/begin GROUP autosar_swc_rlgs_rtARID_DEF.TmpSignalConversionAtICAS_STATEOutport1 ""
 /begin REF_MEASUREMENT autosar_swc_rlgs_rtARID_DEF.TmpSignalConversionAtICAS_STATEOutport1.acc_sts autosar_swc_rlgs_rtARID_DEF.TmpSignalConversionAtICAS_STATEOutport1.lcc_sts autosar_swc_rlgs_rtARID_DEF.TmpSignalConversionAtICAS_STATEOutport1.nudge_sts autosar_swc_rlgs_rtARID_DEF.TmpSignalConversionAtICAS_STATEOutport1.alc_sts autosar_swc_rlgs_rtARID_DEF.TmpSignalConversionAtICAS_STATEOutport1.noa_sts autosar_swc_rlgs_rtARID_DEF.TmpSignalConversionAtICAS_STATEOutport1.lc_req_sync_id autosar_swc_rlgs_rtARID_DEF.TmpSignalConversionAtICAS_STATEOutport1.acc_manual_act_faile_reason autosar_swc_rlgs_rtARID_DEF.TmpSignalConversionAtICAS_STATEOutport1.acc_exit_reason autosar_swc_rlgs_rtARID_DEF.TmpSignalConversionAtICAS_STATEOutport1.lcc_manual_act_faile_reason autosar_swc_rlgs_rtARID_DEF.TmpSignalConversionAtICAS_STATEOutport1.lcc_auto_act_faile_reason autosar_swc_rlgs_rtARID_DEF.TmpSignalConversionAtICAS_STATEOutport1.lcc_exit_to_idle_reason autosar_swc_rlgs_rtARID_DEF.TmpSignalConversionAtICAS_STATEOutport1.lcc_exit_to_wait_reason autosar_swc_rlgs_rtARID_DEF.TmpSignalConversionAtICAS_STATEOutport1.lcc_exit_to_mrc_reason autosar_swc_rlgs_rtARID_DEF.TmpSignalConversionAtICAS_STATEOutport1.lcc_mrc_exit_reason autosar_swc_rlgs_rtARID_DEF.TmpSignalConversionAtICAS_STATEOutport1.noa_auto_act_faile_reason autosar_swc_rlgs_rtARID_DEF.TmpSignalConversionAtICAS_STATEOutport1.noa_exit_reason /end REF_MEASUREMENT
/end GROUP
/begin GROUP autosar_swc_rlgs_rtARID_DEF.TmpSignalConversionAtVAL_DRIVER_DRIVEOutport1 ""
 /begin REF_MEASUREMENT autosar_swc_rlgs_rtARID_DEF.TmpSignalConversionAtVAL_DRIVER_DRIVEOutport1.AccPedalOverride autosar_swc_rlgs_rtARID_DEF.TmpSignalConversionAtVAL_DRIVER_DRIVEOutport1.AccActPulse autosar_swc_rlgs_rtARID_DEF.TmpSignalConversionAtVAL_DRIVER_DRIVEOutport1.LccActPulse autosar_swc_rlgs_rtARID_DEF.TmpSignalConversionAtVAL_DRIVER_DRIVEOutport1.AccOnOffPulse autosar_swc_rlgs_rtARID_DEF.TmpSignalConversionAtVAL_DRIVER_DRIVEOutport1.LccOnOffPulse autosar_swc_rlgs_rtARID_DEF.TmpSignalConversionAtVAL_DRIVER_DRIVEOutport1.ResumePulse autosar_swc_rlgs_rtARID_DEF.TmpSignalConversionAtVAL_DRIVER_DRIVEOutport1.CancelPulse autosar_swc_rlgs_rtARID_DEF.TmpSignalConversionAtVAL_DRIVER_DRIVEOutport1.IncSetSpdPulse autosar_swc_rlgs_rtARID_DEF.TmpSignalConversionAtVAL_DRIVER_DRIVEOutport1.DecSetSpdPulse autosar_swc_rlgs_rtARID_DEF.TmpSignalConversionAtVAL_DRIVER_DRIVEOutport1.IncTimeGapPulse autosar_swc_rlgs_rtARID_DEF.TmpSignalConversionAtVAL_DRIVER_DRIVEOutport1.DecTimeGapPulse autosar_swc_rlgs_rtARID_DEF.TmpSignalConversionAtVAL_DRIVER_DRIVEOutport1.HazardLmpSwtSts autosar_swc_rlgs_rtARID_DEF.TmpSignalConversionAtVAL_DRIVER_DRIVEOutport1.ScfConfirm autosar_swc_rlgs_rtARID_DEF.TmpSignalConversionAtVAL_DRIVER_DRIVEOutport1.DrvBrakePedalSts autosar_swc_rlgs_rtARID_DEF.TmpSignalConversionAtVAL_DRIVER_DRIVEOutport1.EPBSwtSts autosar_swc_rlgs_rtARID_DEF.TmpSignalConversionAtVAL_DRIVER_DRIVEOutport1.LTurnLmpSwtSts autosar_swc_rlgs_rtARID_DEF.TmpSignalConversionAtVAL_DRIVER_DRIVEOutport1.RTurnLmpSwtSts autosar_swc_rlgs_rtARID_DEF.TmpSignalConversionAtVAL_DRIVER_DRIVEOutport1.HighBeamSwtSts autosar_swc_rlgs_rtARID_DEF.TmpSignalConversionAtVAL_DRIVER_DRIVEOutport1.OverVehBeamSwtSts autosar_swc_rlgs_rtARID_DEF.TmpSignalConversionAtVAL_DRIVER_DRIVEOutport1.AutoLightSW autosar_swc_rlgs_rtARID_DEF.TmpSignalConversionAtVAL_DRIVER_DRIVEOutport1.IncSetSpdStep autosar_swc_rlgs_rtARID_DEF.TmpSignalConversionAtVAL_DRIVER_DRIVEOutport1.DecSetSpdStep autosar_swc_rlgs_rtARID_DEF.TmpSignalConversionAtVAL_DRIVER_DRIVEOutport1.DrvConfirmLC autosar_swc_rlgs_rtARID_DEF.TmpSignalConversionAtVAL_DRIVER_DRIVEOutport1.DrvVoiceLCReq autosar_swc_rlgs_rtARID_DEF.TmpSignalConversionAtVAL_DRIVER_DRIVEOutport1.DrvVoiceTimeGapAdjReq autosar_swc_rlgs_rtARID_DEF.TmpSignalConversionAtVAL_DRIVER_DRIVEOutport1.DrvVoiceTimeGapAdjReqValue autosar_swc_rlgs_rtARID_DEF.TmpSignalConversionAtVAL_DRIVER_DRIVEOutport1.DrvVoiceSpdAdjReq autosar_swc_rlgs_rtARID_DEF.TmpSignalConversionAtVAL_DRIVER_DRIVEOutport1.DrvVoiceSpdAdjReqValue autosar_swc_rlgs_rtARID_DEF.TmpSignalConversionAtVAL_DRIVER_DRIVEOutport1.DrvBrakeAccel autosar_swc_rlgs_rtARID_DEF.TmpSignalConversionAtVAL_DRIVER_DRIVEOutport1.BrkPedalStroke autosar_swc_rlgs_rtARID_DEF.TmpSignalConversionAtVAL_DRIVER_DRIVEOutport1.AccPedalTouchPosition autosar_swc_rlgs_rtARID_DEF.TmpSignalConversionAtVAL_DRIVER_DRIVEOutport1.DrvSteerTrqVal autosar_swc_rlgs_rtARID_DEF.TmpSignalConversionAtVAL_DRIVER_DRIVEOutport1.TimeStampMs /end REF_MEASUREMENT
/end GROUP
/begin GROUP autosar_swc_rlgs_rtARID_DEF.TmpSignalConversionAtVMP_STSOutport1 ""
 /begin REF_MEASUREMENT autosar_swc_rlgs_rtARID_DEF.TmpSignalConversionAtVMP_STSOutport1.pln_run_sts autosar_swc_rlgs_rtARID_DEF.TmpSignalConversionAtVMP_STSOutport1.lgt_pln_sts autosar_swc_rlgs_rtARID_DEF.TmpSignalConversionAtVMP_STSOutport1.lat_pln_sts autosar_swc_rlgs_rtARID_DEF.TmpSignalConversionAtVMP_STSOutport1.lgt_drive_sts autosar_swc_rlgs_rtARID_DEF.TmpSignalConversionAtVMP_STSOutport1.lc_exec_sts autosar_swc_rlgs_rtARID_DEF.TmpSignalConversionAtVMP_STSOutport1.lat_ctrl_mod autosar_swc_rlgs_rtARID_DEF.TmpSignalConversionAtVMP_STSOutport1.nudge_exec_sts autosar_swc_rlgs_rtARID_DEF.TmpSignalConversionAtVMP_STSOutport1.lc_req_sync_id autosar_swc_rlgs_rtARID_DEF.TmpSignalConversionAtVMP_STSOutport1.lc_failed_reason autosar_swc_rlgs_rtARID_DEF.TmpSignalConversionAtVMP_STSOutport1.lc_feasibility_conds autosar_swc_rlgs_rtARID_DEF.TmpSignalConversionAtVMP_STSOutport1.pln_inhibited_reason autosar_swc_rlgs_rtARID_DEF.TmpSignalConversionAtVMP_STSOutport1.pln_failed_reason /end REF_MEASUREMENT
/end GROUP
/begin GROUP autosar_swc_rlgs_rtARID_DEF.UnitDelay1_DSTATE ""
 /begin REF_MEASUREMENT autosar_swc_rlgs_rtARID_DEF.UnitDelay1_DSTATE.OperateState autosar_swc_rlgs_rtARID_DEF.UnitDelay1_DSTATE.bIsLineExist autosar_swc_rlgs_rtARID_DEF.UnitDelay1_DSTATE.dQuality autosar_swc_rlgs_rtARID_DEF.UnitDelay1_DSTATE.dC3V autosar_swc_rlgs_rtARID_DEF.UnitDelay1_DSTATE.dC2V autosar_swc_rlgs_rtARID_DEF.UnitDelay1_DSTATE.dC1V autosar_swc_rlgs_rtARID_DEF.UnitDelay1_DSTATE.dC0V autosar_swc_rlgs_rtARID_DEF.UnitDelay1_DSTATE.dDisStart autosar_swc_rlgs_rtARID_DEF.UnitDelay1_DSTATE.dDisFront autosar_swc_rlgs_rtARID_DEF.UnitDelay1_DSTATE.eLineType autosar_swc_rlgs_rtARID_DEF.UnitDelay1_DSTATE.TrackID autosar_swc_rlgs_rtARID_DEF.UnitDelay1_DSTATE.eColour autosar_swc_rlgs_rtARID_DEF.UnitDelay1_DSTATE.Crossing autosar_swc_rlgs_rtARID_DEF.UnitDelay1_DSTATE.dLaneWidth autosar_swc_rlgs_rtARID_DEF.UnitDelay1_DSTATE.ObstacleFlag autosar_swc_rlgs_rtARID_DEF.UnitDelay1_DSTATE.LaneExtraNearPointType autosar_swc_rlgs_rtARID_DEF.UnitDelay1_DSTATE.LaneExtraFarPointType autosar_swc_rlgs_rtARID_DEF.UnitDelay1_DSTATE.LaneExtraFarPointPosX autosar_swc_rlgs_rtARID_DEF.UnitDelay1_DSTATE.LaneExtraFarPointPosY autosar_swc_rlgs_rtARID_DEF.UnitDelay1_DSTATE.LaneExtraNearPointPosX autosar_swc_rlgs_rtARID_DEF.UnitDelay1_DSTATE.LaneExtraNearPointPosY autosar_swc_rlgs_rtARID_DEF.UnitDelay1_DSTATE.LaneParsingConfidence autosar_swc_rlgs_rtARID_DEF.UnitDelay1_DSTATE.Stopline_Relevancy /end REF_MEASUREMENT
/end GROUP
/begin GROUP autosar_swc_rlgs_rtARID_DEF.UnitDelay1_DSTATE_a ""
 /begin REF_MEASUREMENT autosar_swc_rlgs_rtARID_DEF.UnitDelay1_DSTATE_a.ScenarioClass autosar_swc_rlgs_rtARID_DEF.UnitDelay1_DSTATE_a.ScenarioType autosar_swc_rlgs_rtARID_DEF.UnitDelay1_DSTATE_a.ScenarioSubType autosar_swc_rlgs_rtARID_DEF.UnitDelay1_DSTATE_a.SuggDrvDirection autosar_swc_rlgs_rtARID_DEF.UnitDelay1_DSTATE_a.splitSegmentIdx autosar_swc_rlgs_rtARID_DEF.UnitDelay1_DSTATE_a.splitStubIdx autosar_swc_rlgs_rtARID_DEF.UnitDelay1_DSTATE_a.dist2GeoFence /end REF_MEASUREMENT
/end GROUP
/begin GROUP autosar_swc_rlgs_rtARID_DEF.UnitDelay1_DSTATE_o ""
 /begin REF_MEASUREMENT autosar_swc_rlgs_rtARID_DEF.UnitDelay1_DSTATE_o.host_lane_idx autosar_swc_rlgs_rtARID_DEF.UnitDelay1_DSTATE_o.target_lane_idx autosar_swc_rlgs_rtARID_DEF.UnitDelay1_DSTATE_o.lc_req autosar_swc_rlgs_rtARID_DEF.UnitDelay1_DSTATE_o.lc_req_sync_id autosar_swc_rlgs_rtARID_DEF.UnitDelay1_DSTATE_o.lc_level autosar_swc_rlgs_rtARID_DEF.UnitDelay1_DSTATE_o.lc_req_reason autosar_swc_rlgs_rtARID_DEF.UnitDelay1_DSTATE_o.lc_lntention_conds /end REF_MEASUREMENT
/end GROUP
/begin GROUP autosar_swc_rlgs_rtARID_DEF.UnitDelay2_DSTATE ""
 /begin REF_MEASUREMENT autosar_swc_rlgs_rtARID_DEF.UnitDelay2_DSTATE.host_lane_idx autosar_swc_rlgs_rtARID_DEF.UnitDelay2_DSTATE.target_lane_idx autosar_swc_rlgs_rtARID_DEF.UnitDelay2_DSTATE.lc_req autosar_swc_rlgs_rtARID_DEF.UnitDelay2_DSTATE.lc_req_sync_id autosar_swc_rlgs_rtARID_DEF.UnitDelay2_DSTATE.lc_level autosar_swc_rlgs_rtARID_DEF.UnitDelay2_DSTATE.lc_req_reason autosar_swc_rlgs_rtARID_DEF.UnitDelay2_DSTATE.lc_lntention_conds /end REF_MEASUREMENT
/end GROUP
/begin GROUP autosar_swc_rlgs_rtARID_DEF.UnitDelay2_DSTATE_j ""
 /begin REF_MEASUREMENT autosar_swc_rlgs_rtARID_DEF.UnitDelay2_DSTATE_j.ScenarioClass autosar_swc_rlgs_rtARID_DEF.UnitDelay2_DSTATE_j.ScenarioType autosar_swc_rlgs_rtARID_DEF.UnitDelay2_DSTATE_j.ScenarioSubType autosar_swc_rlgs_rtARID_DEF.UnitDelay2_DSTATE_j.SuggDrvDirection autosar_swc_rlgs_rtARID_DEF.UnitDelay2_DSTATE_j.splitSegmentIdx autosar_swc_rlgs_rtARID_DEF.UnitDelay2_DSTATE_j.splitStubIdx autosar_swc_rlgs_rtARID_DEF.UnitDelay2_DSTATE_j.dist2GeoFence /end REF_MEASUREMENT
/end GROUP
/begin GROUP autosar_swc_rlgs_rtARID_DEF.UnitDelay4_DSTATE ""
 /begin REF_MEASUREMENT autosar_swc_rlgs_rtARID_DEF.UnitDelay4_DSTATE.ScenarioClass autosar_swc_rlgs_rtARID_DEF.UnitDelay4_DSTATE.ScenarioType autosar_swc_rlgs_rtARID_DEF.UnitDelay4_DSTATE.ScenarioSubType autosar_swc_rlgs_rtARID_DEF.UnitDelay4_DSTATE.SuggDrvDirection autosar_swc_rlgs_rtARID_DEF.UnitDelay4_DSTATE.splitSegmentIdx autosar_swc_rlgs_rtARID_DEF.UnitDelay4_DSTATE.splitStubIdx autosar_swc_rlgs_rtARID_DEF.UnitDelay4_DSTATE.dist2GeoFence /end REF_MEASUREMENT
/end GROUP
/begin GROUP autosar_swc_rlgs_rtARID_DEF.UnitDelay_DSTATE ""
 /begin REF_MEASUREMENT autosar_swc_rlgs_rtARID_DEF.UnitDelay_DSTATE.OperateState autosar_swc_rlgs_rtARID_DEF.UnitDelay_DSTATE.bIsLineExist autosar_swc_rlgs_rtARID_DEF.UnitDelay_DSTATE.dQuality autosar_swc_rlgs_rtARID_DEF.UnitDelay_DSTATE.dC3V autosar_swc_rlgs_rtARID_DEF.UnitDelay_DSTATE.dC2V autosar_swc_rlgs_rtARID_DEF.UnitDelay_DSTATE.dC1V autosar_swc_rlgs_rtARID_DEF.UnitDelay_DSTATE.dC0V autosar_swc_rlgs_rtARID_DEF.UnitDelay_DSTATE.dDisStart autosar_swc_rlgs_rtARID_DEF.UnitDelay_DSTATE.dDisFront autosar_swc_rlgs_rtARID_DEF.UnitDelay_DSTATE.eLineType autosar_swc_rlgs_rtARID_DEF.UnitDelay_DSTATE.TrackID autosar_swc_rlgs_rtARID_DEF.UnitDelay_DSTATE.eColour autosar_swc_rlgs_rtARID_DEF.UnitDelay_DSTATE.Crossing autosar_swc_rlgs_rtARID_DEF.UnitDelay_DSTATE.dLaneWidth autosar_swc_rlgs_rtARID_DEF.UnitDelay_DSTATE.ObstacleFlag autosar_swc_rlgs_rtARID_DEF.UnitDelay_DSTATE.LaneExtraNearPointType autosar_swc_rlgs_rtARID_DEF.UnitDelay_DSTATE.LaneExtraFarPointType autosar_swc_rlgs_rtARID_DEF.UnitDelay_DSTATE.LaneExtraFarPointPosX autosar_swc_rlgs_rtARID_DEF.UnitDelay_DSTATE.LaneExtraFarPointPosY autosar_swc_rlgs_rtARID_DEF.UnitDelay_DSTATE.LaneExtraNearPointPosX autosar_swc_rlgs_rtARID_DEF.UnitDelay_DSTATE.LaneExtraNearPointPosY autosar_swc_rlgs_rtARID_DEF.UnitDelay_DSTATE.LaneParsingConfidence autosar_swc_rlgs_rtARID_DEF.UnitDelay_DSTATE.Stopline_Relevancy /end REF_MEASUREMENT
/end GROUP
/begin GROUP autosar_swc_rlgs_rtARID_DEF.UnitDelay_DSTATE_m ""
 /begin REF_MEASUREMENT autosar_swc_rlgs_rtARID_DEF.UnitDelay_DSTATE_m.lane_change_routing_direc autosar_swc_rlgs_rtARID_DEF.UnitDelay_DSTATE_m.stub_type autosar_swc_rlgs_rtARID_DEF.UnitDelay_DSTATE_m.is_on_rout autosar_swc_rlgs_rtARID_DEF.UnitDelay_DSTATE_m.stub_direc autosar_swc_rlgs_rtARID_DEF.UnitDelay_DSTATE_m.stub_ramp_type autosar_swc_rlgs_rtARID_DEF.UnitDelay_DSTATE_m.stub_start_dis autosar_swc_rlgs_rtARID_DEF.UnitDelay_DSTATE_m.stub_end_dis autosar_swc_rlgs_rtARID_DEF.UnitDelay_DSTATE_m.stub_id autosar_swc_rlgs_rtARID_DEF.UnitDelay_DSTATE_m.stub_linkSegment_id /end REF_MEASUREMENT
/end GROUP
/begin GROUP autosar_swc_rlgs_rtARID_DEF.UnitDelay_DSTATE_n ""
 /begin REF_MEASUREMENT autosar_swc_rlgs_rtARID_DEF.UnitDelay_DSTATE_n.host_lane_idx autosar_swc_rlgs_rtARID_DEF.UnitDelay_DSTATE_n.target_lane_idx autosar_swc_rlgs_rtARID_DEF.UnitDelay_DSTATE_n.lc_req autosar_swc_rlgs_rtARID_DEF.UnitDelay_DSTATE_n.lc_req_sync_id autosar_swc_rlgs_rtARID_DEF.UnitDelay_DSTATE_n.lc_level autosar_swc_rlgs_rtARID_DEF.UnitDelay_DSTATE_n.lc_req_reason autosar_swc_rlgs_rtARID_DEF.UnitDelay_DSTATE_n.lc_lntention_conds /end REF_MEASUREMENT
/end GROUP
/begin MEASUREMENT SwcOut_EVM_CIPV[0].accel_gnd.mod "" FLOAT32_IEEE autosar_swc_tos_CM_single 0 0 -3.4E+38 3.4E+38 ECU_ADDRESS 0xfe4b02fc /* @ECU_Address@SwcOut_EVM_CIPV[0].accel_gnd.mod@ */ /end MEASUREMENT
/begin MEASUREMENT SwcOut_EVM_CIPV[0].accel_gnd.x "" FLOAT32_IEEE autosar_swc_tos_CM_single 0 0 -3.4E+38 3.4E+38 ECU_ADDRESS 0xfe4b02f4 /* @ECU_Address@SwcOut_EVM_CIPV[0].accel_gnd.x@ */ /end MEASUREMENT
/begin MEASUREMENT SwcOut_EVM_CIPV[0].accel_gnd.y "" FLOAT32_IEEE autosar_swc_tos_CM_single 0 0 -3.4E+38 3.4E+38 ECU_ADDRESS 0xfe4b02f8 /* @ECU_Address@SwcOut_EVM_CIPV[0].accel_gnd.y@ */ /end MEASUREMENT
/begin MEASUREMENT SwcOut_EVM_CIPV[0].accel_gnd_sl.mod "" FLOAT32_IEEE autosar_swc_tos_CM_single 0 0 -3.4E+38 3.4E+38 ECU_ADDRESS 0xfe4b0314 /* @ECU_Address@SwcOut_EVM_CIPV[0].accel_gnd_sl.mod@ */ /end MEASUREMENT
/begin MEASUREMENT SwcOut_EVM_CIPV[0].accel_gnd_sl.x "" FLOAT32_IEEE autosar_swc_tos_CM_single 0 0 -3.4E+38 3.4E+38 ECU_ADDRESS 0xfe4b030c /* @ECU_Address@SwcOut_EVM_CIPV[0].accel_gnd_sl.x@ */ /end MEASUREMENT
/begin MEASUREMENT SwcOut_EVM_CIPV[0].accel_gnd_sl.y "" FLOAT32_IEEE autosar_swc_tos_CM_single 0 0 -3.4E+38 3.4E+38 ECU_ADDRESS 0xfe4b0310 /* @ECU_Address@SwcOut_EVM_CIPV[0].accel_gnd_sl.y@ */ /end MEASUREMENT
/begin MEASUREMENT SwcOut_EVM_CIPV[0].box.corner_x_vec "" FLOAT32_IEEE autosar_swc_tos_CM_single 0 0 -3.4E+38 3.4E+38 LAYOUT COLUMN_DIR MATRIX_DIM 4 ECU_ADDRESS 0xfe4b02a4 /* @ECU_Address@SwcOut_EVM_CIPV[0].box.corner_x_vec@ */ /end MEASUREMENT
/begin MEASUREMENT SwcOut_EVM_CIPV[0].box.corner_y_vec "" FLOAT32_IEEE autosar_swc_tos_CM_single 0 0 -3.4E+38 3.4E+38 LAYOUT COLUMN_DIR MATRIX_DIM 4 ECU_ADDRESS 0xfe4b02b4 /* @ECU_Address@SwcOut_EVM_CIPV[0].box.corner_y_vec@ */ /end MEASUREMENT
/begin MEASUREMENT SwcOut_EVM_CIPV[0].class_type "" UBYTE autosar_swc_tos_CM_uint8 0 0 0 255 ECU_ADDRESS 0xfe4b029a /* @ECU_Address@SwcOut_EVM_CIPV[0].class_type@ */ /end MEASUREMENT
/begin MEASUREMENT SwcOut_EVM_CIPV[0].cut_type "" UBYTE autosar_swc_tos_CM_uint8 0 0 0 255 ECU_ADDRESS 0xfe4b029b /* @ECU_Address@SwcOut_EVM_CIPV[0].cut_type@ */ /end MEASUREMENT
/begin MEASUREMENT SwcOut_EVM_CIPV[0].fus_type "" UBYTE autosar_swc_tos_CM_uint8 0 0 0 255 ECU_ADDRESS 0xfe4b0299 /* @ECU_Address@SwcOut_EVM_CIPV[0].fus_type@ */ /end MEASUREMENT
/begin MEASUREMENT SwcOut_EVM_CIPV[0].id "" ULONG autosar_swc_tos_CM_uint32 0 0 0 4294967295 ECU_ADDRESS 0xfe4b02a0 /* @ECU_Address@SwcOut_EVM_CIPV[0].id@ */ /end MEASUREMENT
/begin MEASUREMENT SwcOut_EVM_CIPV[0].meas_state "" UBYTE autosar_swc_tos_CM_uint8 0 0 0 255 ECU_ADDRESS 0xfe4b0298 /* @ECU_Address@SwcOut_EVM_CIPV[0].meas_state@ */ /end MEASUREMENT
/begin MEASUREMENT SwcOut_EVM_CIPV[0].position.heading_angle "" FLOAT32_IEEE autosar_swc_tos_CM_single 0 0 -3.4E+38 3.4E+38 ECU_ADDRESS 0xfe4b02cc /* @ECU_Address@SwcOut_EVM_CIPV[0].position.heading_angle@ */ /end MEASUREMENT
/begin MEASUREMENT SwcOut_EVM_CIPV[0].position.x "" FLOAT32_IEEE autosar_swc_tos_CM_single 0 0 -3.4E+38 3.4E+38 ECU_ADDRESS 0xfe4b02c4 /* @ECU_Address@SwcOut_EVM_CIPV[0].position.x@ */ /end MEASUREMENT
/begin MEASUREMENT SwcOut_EVM_CIPV[0].position.y "" FLOAT32_IEEE autosar_swc_tos_CM_single 0 0 -3.4E+38 3.4E+38 ECU_ADDRESS 0xfe4b02c8 /* @ECU_Address@SwcOut_EVM_CIPV[0].position.y@ */ /end MEASUREMENT
/begin MEASUREMENT SwcOut_EVM_CIPV[0].position_sl.heading_angle "" FLOAT32_IEEE autosar_swc_tos_CM_single 0 0 -3.4E+38 3.4E+38 ECU_ADDRESS 0xfe4b02d8 /* @ECU_Address@SwcOut_EVM_CIPV[0].position_sl.heading_angle@ */ /end MEASUREMENT
/begin MEASUREMENT SwcOut_EVM_CIPV[0].position_sl.x "" FLOAT32_IEEE autosar_swc_tos_CM_single 0 0 -3.4E+38 3.4E+38 ECU_ADDRESS 0xfe4b02d0 /* @ECU_Address@SwcOut_EVM_CIPV[0].position_sl.x@ */ /end MEASUREMENT
/begin MEASUREMENT SwcOut_EVM_CIPV[0].position_sl.y "" FLOAT32_IEEE autosar_swc_tos_CM_single 0 0 -3.4E+38 3.4E+38 ECU_ADDRESS 0xfe4b02d4 /* @ECU_Address@SwcOut_EVM_CIPV[0].position_sl.y@ */ /end MEASUREMENT
/begin MEASUREMENT SwcOut_EVM_CIPV[0].ref_lane_id "" UBYTE autosar_swc_tos_CM_uint8 0 0 0 255 ECU_ADDRESS 0xfe4b029c /* @ECU_Address@SwcOut_EVM_CIPV[0].ref_lane_id@ */ /end MEASUREMENT
/begin MEASUREMENT SwcOut_EVM_CIPV[0].size.higth "" FLOAT32_IEEE autosar_swc_tos_CM_single 0 0 -3.4E+38 3.4E+38 ECU_ADDRESS 0xfe4b02e4 /* @ECU_Address@SwcOut_EVM_CIPV[0].size.higth@ */ /end MEASUREMENT
/begin MEASUREMENT SwcOut_EVM_CIPV[0].size.length "" FLOAT32_IEEE autosar_swc_tos_CM_single 0 0 -3.4E+38 3.4E+38 ECU_ADDRESS 0xfe4b02dc /* @ECU_Address@SwcOut_EVM_CIPV[0].size.length@ */ /end MEASUREMENT
/begin MEASUREMENT SwcOut_EVM_CIPV[0].size.width "" FLOAT32_IEEE autosar_swc_tos_CM_single 0 0 -3.4E+38 3.4E+38 ECU_ADDRESS 0xfe4b02e0 /* @ECU_Address@SwcOut_EVM_CIPV[0].size.width@ */ /end MEASUREMENT
/begin MEASUREMENT SwcOut_EVM_CIPV[0].velocity_gnd.mod "" FLOAT32_IEEE autosar_swc_tos_CM_single 0 0 -3.4E+38 3.4E+38 ECU_ADDRESS 0xfe4b02f0 /* @ECU_Address@SwcOut_EVM_CIPV[0].velocity_gnd.mod@ */ /end MEASUREMENT
/begin MEASUREMENT SwcOut_EVM_CIPV[0].velocity_gnd.x "" FLOAT32_IEEE autosar_swc_tos_CM_single 0 0 -3.4E+38 3.4E+38 ECU_ADDRESS 0xfe4b02e8 /* @ECU_Address@SwcOut_EVM_CIPV[0].velocity_gnd.x@ */ /end MEASUREMENT
/begin MEASUREMENT SwcOut_EVM_CIPV[0].velocity_gnd.y "" FLOAT32_IEEE autosar_swc_tos_CM_single 0 0 -3.4E+38 3.4E+38 ECU_ADDRESS 0xfe4b02ec /* @ECU_Address@SwcOut_EVM_CIPV[0].velocity_gnd.y@ */ /end MEASUREMENT
/begin MEASUREMENT SwcOut_EVM_CIPV[0].velocity_gnd_sl.mod "" FLOAT32_IEEE autosar_swc_tos_CM_single 0 0 -3.4E+38 3.4E+38 ECU_ADDRESS 0xfe4b0308 /* @ECU_Address@SwcOut_EVM_CIPV[0].velocity_gnd_sl.mod@ */ /end MEASUREMENT
/begin MEASUREMENT SwcOut_EVM_CIPV[0].velocity_gnd_sl.x "" FLOAT32_IEEE autosar_swc_tos_CM_single 0 0 -3.4E+38 3.4E+38 ECU_ADDRESS 0xfe4b0300 /* @ECU_Address@SwcOut_EVM_CIPV[0].velocity_gnd_sl.x@ */ /end MEASUREMENT
/begin MEASUREMENT SwcOut_EVM_CIPV[0].velocity_gnd_sl.y "" FLOAT32_IEEE autosar_swc_tos_CM_single 0 0 -3.4E+38 3.4E+38 ECU_ADDRESS 0xfe4b0304 /* @ECU_Address@SwcOut_EVM_CIPV[0].velocity_gnd_sl.y@ */ /end MEASUREMENT
/begin MEASUREMENT SwcOut_EVM_CIPV[1].accel_gnd.mod "" FLOAT32_IEEE autosar_swc_tos_CM_single 0 0 -3.4E+38 3.4E+38 ECU_ADDRESS 0xfe4b037c /* @ECU_Address@SwcOut_EVM_CIPV[1].accel_gnd.mod@ */ /end MEASUREMENT
/begin MEASUREMENT SwcOut_EVM_CIPV[1].accel_gnd.x "" FLOAT32_IEEE autosar_swc_tos_CM_single 0 0 -3.4E+38 3.4E+38 ECU_ADDRESS 0xfe4b0374 /* @ECU_Address@SwcOut_EVM_CIPV[1].accel_gnd.x@ */ /end MEASUREMENT
/begin MEASUREMENT SwcOut_EVM_CIPV[1].accel_gnd.y "" FLOAT32_IEEE autosar_swc_tos_CM_single 0 0 -3.4E+38 3.4E+38 ECU_ADDRESS 0xfe4b0378 /* @ECU_Address@SwcOut_EVM_CIPV[1].accel_gnd.y@ */ /end MEASUREMENT
/begin MEASUREMENT SwcOut_EVM_CIPV[1].accel_gnd_sl.mod "" FLOAT32_IEEE autosar_swc_tos_CM_single 0 0 -3.4E+38 3.4E+38 ECU_ADDRESS 0xfe4b0394 /* @ECU_Address@SwcOut_EVM_CIPV[1].accel_gnd_sl.mod@ */ /end MEASUREMENT
/begin MEASUREMENT SwcOut_EVM_CIPV[1].accel_gnd_sl.x "" FLOAT32_IEEE autosar_swc_tos_CM_single 0 0 -3.4E+38 3.4E+38 ECU_ADDRESS 0xfe4b038c /* @ECU_Address@SwcOut_EVM_CIPV[1].accel_gnd_sl.x@ */ /end MEASUREMENT
/begin MEASUREMENT SwcOut_EVM_CIPV[1].accel_gnd_sl.y "" FLOAT32_IEEE autosar_swc_tos_CM_single 0 0 -3.4E+38 3.4E+38 ECU_ADDRESS 0xfe4b0390 /* @ECU_Address@SwcOut_EVM_CIPV[1].accel_gnd_sl.y@ */ /end MEASUREMENT
/begin MEASUREMENT SwcOut_EVM_CIPV[1].box.corner_x_vec "" FLOAT32_IEEE autosar_swc_tos_CM_single 0 0 -3.4E+38 3.4E+38 LAYOUT COLUMN_DIR MATRIX_DIM 4 ECU_ADDRESS 0xfe4b0324 /* @ECU_Address@SwcOut_EVM_CIPV[1].box.corner_x_vec@ */ /end MEASUREMENT
/begin MEASUREMENT SwcOut_EVM_CIPV[1].box.corner_y_vec "" FLOAT32_IEEE autosar_swc_tos_CM_single 0 0 -3.4E+38 3.4E+38 LAYOUT COLUMN_DIR MATRIX_DIM 4 ECU_ADDRESS 0xfe4b0334 /* @ECU_Address@SwcOut_EVM_CIPV[1].box.corner_y_vec@ */ /end MEASUREMENT
/begin MEASUREMENT SwcOut_EVM_CIPV[1].class_type "" UBYTE autosar_swc_tos_CM_uint8 0 0 0 255 ECU_ADDRESS 0xfe4b031a /* @ECU_Address@SwcOut_EVM_CIPV[1].class_type@ */ /end MEASUREMENT
/begin MEASUREMENT SwcOut_EVM_CIPV[1].cut_type "" UBYTE autosar_swc_tos_CM_uint8 0 0 0 255 ECU_ADDRESS 0xfe4b031b /* @ECU_Address@SwcOut_EVM_CIPV[1].cut_type@ */ /end MEASUREMENT
/begin MEASUREMENT SwcOut_EVM_CIPV[1].fus_type "" UBYTE autosar_swc_tos_CM_uint8 0 0 0 255 ECU_ADDRESS 0xfe4b0319 /* @ECU_Address@SwcOut_EVM_CIPV[1].fus_type@ */ /end MEASUREMENT
/begin MEASUREMENT SwcOut_EVM_CIPV[1].id "" ULONG autosar_swc_tos_CM_uint32 0 0 0 4294967295 ECU_ADDRESS 0xfe4b0320 /* @ECU_Address@SwcOut_EVM_CIPV[1].id@ */ /end MEASUREMENT
/begin MEASUREMENT SwcOut_EVM_CIPV[1].meas_state "" UBYTE autosar_swc_tos_CM_uint8 0 0 0 255 ECU_ADDRESS 0xfe4b0318 /* @ECU_Address@SwcOut_EVM_CIPV[1].meas_state@ */ /end MEASUREMENT
/begin MEASUREMENT SwcOut_EVM_CIPV[1].position.heading_angle "" FLOAT32_IEEE autosar_swc_tos_CM_single 0 0 -3.4E+38 3.4E+38 ECU_ADDRESS 0xfe4b034c /* @ECU_Address@SwcOut_EVM_CIPV[1].position.heading_angle@ */ /end MEASUREMENT
/begin MEASUREMENT SwcOut_EVM_CIPV[1].position.x "" FLOAT32_IEEE autosar_swc_tos_CM_single 0 0 -3.4E+38 3.4E+38 ECU_ADDRESS 0xfe4b0344 /* @ECU_Address@SwcOut_EVM_CIPV[1].position.x@ */ /end MEASUREMENT
/begin MEASUREMENT SwcOut_EVM_CIPV[1].position.y "" FLOAT32_IEEE autosar_swc_tos_CM_single 0 0 -3.4E+38 3.4E+38 ECU_ADDRESS 0xfe4b0348 /* @ECU_Address@SwcOut_EVM_CIPV[1].position.y@ */ /end MEASUREMENT
/begin MEASUREMENT SwcOut_EVM_CIPV[1].position_sl.heading_angle "" FLOAT32_IEEE autosar_swc_tos_CM_single 0 0 -3.4E+38 3.4E+38 ECU_ADDRESS 0xfe4b0358 /* @ECU_Address@SwcOut_EVM_CIPV[1].position_sl.heading_angle@ */ /end MEASUREMENT
/begin MEASUREMENT SwcOut_EVM_CIPV[1].position_sl.x "" FLOAT32_IEEE autosar_swc_tos_CM_single 0 0 -3.4E+38 3.4E+38 ECU_ADDRESS 0xfe4b0350 /* @ECU_Address@SwcOut_EVM_CIPV[1].position_sl.x@ */ /end MEASUREMENT
/begin MEASUREMENT SwcOut_EVM_CIPV[1].position_sl.y "" FLOAT32_IEEE autosar_swc_tos_CM_single 0 0 -3.4E+38 3.4E+38 ECU_ADDRESS 0xfe4b0354 /* @ECU_Address@SwcOut_EVM_CIPV[1].position_sl.y@ */ /end MEASUREMENT
/begin MEASUREMENT SwcOut_EVM_CIPV[1].ref_lane_id "" UBYTE autosar_swc_tos_CM_uint8 0 0 0 255 ECU_ADDRESS 0xfe4b031c /* @ECU_Address@SwcOut_EVM_CIPV[1].ref_lane_id@ */ /end MEASUREMENT
/begin MEASUREMENT SwcOut_EVM_CIPV[1].size.higth "" FLOAT32_IEEE autosar_swc_tos_CM_single 0 0 -3.4E+38 3.4E+38 ECU_ADDRESS 0xfe4b0364 /* @ECU_Address@SwcOut_EVM_CIPV[1].size.higth@ */ /end MEASUREMENT
/begin MEASUREMENT SwcOut_EVM_CIPV[1].size.length "" FLOAT32_IEEE autosar_swc_tos_CM_single 0 0 -3.4E+38 3.4E+38 ECU_ADDRESS 0xfe4b035c /* @ECU_Address@SwcOut_EVM_CIPV[1].size.length@ */ /end MEASUREMENT
/begin MEASUREMENT SwcOut_EVM_CIPV[1].size.width "" FLOAT32_IEEE autosar_swc_tos_CM_single 0 0 -3.4E+38 3.4E+38 ECU_ADDRESS 0xfe4b0360 /* @ECU_Address@SwcOut_EVM_CIPV[1].size.width@ */ /end MEASUREMENT
/begin MEASUREMENT SwcOut_EVM_CIPV[1].velocity_gnd.mod "" FLOAT32_IEEE autosar_swc_tos_CM_single 0 0 -3.4E+38 3.4E+38 ECU_ADDRESS 0xfe4b0370 /* @ECU_Address@SwcOut_EVM_CIPV[1].velocity_gnd.mod@ */ /end MEASUREMENT
/begin MEASUREMENT SwcOut_EVM_CIPV[1].velocity_gnd.x "" FLOAT32_IEEE autosar_swc_tos_CM_single 0 0 -3.4E+38 3.4E+38 ECU_ADDRESS 0xfe4b0368 /* @ECU_Address@SwcOut_EVM_CIPV[1].velocity_gnd.x@ */ /end MEASUREMENT
/begin MEASUREMENT SwcOut_EVM_CIPV[1].velocity_gnd.y "" FLOAT32_IEEE autosar_swc_tos_CM_single 0 0 -3.4E+38 3.4E+38 ECU_ADDRESS 0xfe4b036c /* @ECU_Address@SwcOut_EVM_CIPV[1].velocity_gnd.y@ */ /end MEASUREMENT
/begin MEASUREMENT SwcOut_EVM_CIPV[1].velocity_gnd_sl.mod "" FLOAT32_IEEE autosar_swc_tos_CM_single 0 0 -3.4E+38 3.4E+38 ECU_ADDRESS 0xfe4b0388 /* @ECU_Address@SwcOut_EVM_CIPV[1].velocity_gnd_sl.mod@ */ /end MEASUREMENT
/begin MEASUREMENT SwcOut_EVM_CIPV[1].velocity_gnd_sl.x "" FLOAT32_IEEE autosar_swc_tos_CM_single 0 0 -3.4E+38 3.4E+38 ECU_ADDRESS 0xfe4b0380 /* @ECU_Address@SwcOut_EVM_CIPV[1].velocity_gnd_sl.x@ */ /end MEASUREMENT
/begin MEASUREMENT SwcOut_EVM_CIPV[1].velocity_gnd_sl.y "" FLOAT32_IEEE autosar_swc_tos_CM_single 0 0 -3.4E+38 3.4E+38 ECU_ADDRESS 0xfe4b0384 /* @ECU_Address@SwcOut_EVM_CIPV[1].velocity_gnd_sl.y@ */ /end MEASUREMENT
/begin MEASUREMENT SwcOut_EVM_CIPV[2].accel_gnd.mod "" FLOAT32_IEEE autosar_swc_tos_CM_single 0 0 -3.4E+38 3.4E+38 ECU_ADDRESS 0xfe4b03fc /* @ECU_Address@SwcOut_EVM_CIPV[2].accel_gnd.mod@ */ /end MEASUREMENT
/begin MEASUREMENT SwcOut_EVM_CIPV[2].accel_gnd.x "" FLOAT32_IEEE autosar_swc_tos_CM_single 0 0 -3.4E+38 3.4E+38 ECU_ADDRESS 0xfe4b03f4 /* @ECU_Address@SwcOut_EVM_CIPV[2].accel_gnd.x@ */ /end MEASUREMENT
/begin MEASUREMENT SwcOut_EVM_CIPV[2].accel_gnd.y "" FLOAT32_IEEE autosar_swc_tos_CM_single 0 0 -3.4E+38 3.4E+38 ECU_ADDRESS 0xfe4b03f8 /* @ECU_Address@SwcOut_EVM_CIPV[2].accel_gnd.y@ */ /end MEASUREMENT
/begin MEASUREMENT SwcOut_EVM_CIPV[2].accel_gnd_sl.mod "" FLOAT32_IEEE autosar_swc_tos_CM_single 0 0 -3.4E+38 3.4E+38 ECU_ADDRESS 0xfe4b0414 /* @ECU_Address@SwcOut_EVM_CIPV[2].accel_gnd_sl.mod@ */ /end MEASUREMENT
/begin MEASUREMENT SwcOut_EVM_CIPV[2].accel_gnd_sl.x "" FLOAT32_IEEE autosar_swc_tos_CM_single 0 0 -3.4E+38 3.4E+38 ECU_ADDRESS 0xfe4b040c /* @ECU_Address@SwcOut_EVM_CIPV[2].accel_gnd_sl.x@ */ /end MEASUREMENT
/begin MEASUREMENT SwcOut_EVM_CIPV[2].accel_gnd_sl.y "" FLOAT32_IEEE autosar_swc_tos_CM_single 0 0 -3.4E+38 3.4E+38 ECU_ADDRESS 0xfe4b0410 /* @ECU_Address@SwcOut_EVM_CIPV[2].accel_gnd_sl.y@ */ /end MEASUREMENT
/begin MEASUREMENT SwcOut_EVM_CIPV[2].box.corner_x_vec "" FLOAT32_IEEE autosar_swc_tos_CM_single 0 0 -3.4E+38 3.4E+38 LAYOUT COLUMN_DIR MATRIX_DIM 4 ECU_ADDRESS 0xfe4b03a4 /* @ECU_Address@SwcOut_EVM_CIPV[2].box.corner_x_vec@ */ /end MEASUREMENT
/begin MEASUREMENT SwcOut_EVM_CIPV[2].box.corner_y_vec "" FLOAT32_IEEE autosar_swc_tos_CM_single 0 0 -3.4E+38 3.4E+38 LAYOUT COLUMN_DIR MATRIX_DIM 4 ECU_ADDRESS 0xfe4b03b4 /* @ECU_Address@SwcOut_EVM_CIPV[2].box.corner_y_vec@ */ /end MEASUREMENT
/begin MEASUREMENT SwcOut_EVM_CIPV[2].class_type "" UBYTE autosar_swc_tos_CM_uint8 0 0 0 255 ECU_ADDRESS 0xfe4b039a /* @ECU_Address@SwcOut_EVM_CIPV[2].class_type@ */ /end MEASUREMENT
/begin MEASUREMENT SwcOut_EVM_CIPV[2].cut_type "" UBYTE autosar_swc_tos_CM_uint8 0 0 0 255 ECU_ADDRESS 0xfe4b039b /* @ECU_Address@SwcOut_EVM_CIPV[2].cut_type@ */ /end MEASUREMENT
/begin MEASUREMENT SwcOut_EVM_CIPV[2].fus_type "" UBYTE autosar_swc_tos_CM_uint8 0 0 0 255 ECU_ADDRESS 0xfe4b0399 /* @ECU_Address@SwcOut_EVM_CIPV[2].fus_type@ */ /end MEASUREMENT
/begin MEASUREMENT SwcOut_EVM_CIPV[2].id "" ULONG autosar_swc_tos_CM_uint32 0 0 0 4294967295 ECU_ADDRESS 0xfe4b03a0 /* @ECU_Address@SwcOut_EVM_CIPV[2].id@ */ /end MEASUREMENT
/begin MEASUREMENT SwcOut_EVM_CIPV[2].meas_state "" UBYTE autosar_swc_tos_CM_uint8 0 0 0 255 ECU_ADDRESS 0xfe4b0398 /* @ECU_Address@SwcOut_EVM_CIPV[2].meas_state@ */ /end MEASUREMENT
/begin MEASUREMENT SwcOut_EVM_CIPV[2].position.heading_angle "" FLOAT32_IEEE autosar_swc_tos_CM_single 0 0 -3.4E+38 3.4E+38 ECU_ADDRESS 0xfe4b03cc /* @ECU_Address@SwcOut_EVM_CIPV[2].position.heading_angle@ */ /end MEASUREMENT
/begin MEASUREMENT SwcOut_EVM_CIPV[2].position.x "" FLOAT32_IEEE autosar_swc_tos_CM_single 0 0 -3.4E+38 3.4E+38 ECU_ADDRESS 0xfe4b03c4 /* @ECU_Address@SwcOut_EVM_CIPV[2].position.x@ */ /end MEASUREMENT
/begin MEASUREMENT SwcOut_EVM_CIPV[2].position.y "" FLOAT32_IEEE autosar_swc_tos_CM_single 0 0 -3.4E+38 3.4E+38 ECU_ADDRESS 0xfe4b03c8 /* @ECU_Address@SwcOut_EVM_CIPV[2].position.y@ */ /end MEASUREMENT
/begin MEASUREMENT SwcOut_EVM_CIPV[2].position_sl.heading_angle "" FLOAT32_IEEE autosar_swc_tos_CM_single 0 0 -3.4E+38 3.4E+38 ECU_ADDRESS 0xfe4b03d8 /* @ECU_Address@SwcOut_EVM_CIPV[2].position_sl.heading_angle@ */ /end MEASUREMENT
/begin MEASUREMENT SwcOut_EVM_CIPV[2].position_sl.x "" FLOAT32_IEEE autosar_swc_tos_CM_single 0 0 -3.4E+38 3.4E+38 ECU_ADDRESS 0xfe4b03d0 /* @ECU_Address@SwcOut_EVM_CIPV[2].position_sl.x@ */ /end MEASUREMENT
/begin MEASUREMENT SwcOut_EVM_CIPV[2].position_sl.y "" FLOAT32_IEEE autosar_swc_tos_CM_single 0 0 -3.4E+38 3.4E+38 ECU_ADDRESS 0xfe4b03d4 /* @ECU_Address@SwcOut_EVM_CIPV[2].position_sl.y@ */ /end MEASUREMENT
/begin MEASUREMENT SwcOut_EVM_CIPV[2].ref_lane_id "" UBYTE autosar_swc_tos_CM_uint8 0 0 0 255 ECU_ADDRESS 0xfe4b039c /* @ECU_Address@SwcOut_EVM_CIPV[2].ref_lane_id@ */ /end MEASUREMENT
/begin MEASUREMENT SwcOut_EVM_CIPV[2].size.higth "" FLOAT32_IEEE autosar_swc_tos_CM_single 0 0 -3.4E+38 3.4E+38 ECU_ADDRESS 0xfe4b03e4 /* @ECU_Address@SwcOut_EVM_CIPV[2].size.higth@ */ /end MEASUREMENT
/begin MEASUREMENT SwcOut_EVM_CIPV[2].size.length "" FLOAT32_IEEE autosar_swc_tos_CM_single 0 0 -3.4E+38 3.4E+38 ECU_ADDRESS 0xfe4b03dc /* @ECU_Address@SwcOut_EVM_CIPV[2].size.length@ */ /end MEASUREMENT
/begin MEASUREMENT SwcOut_EVM_CIPV[2].size.width "" FLOAT32_IEEE autosar_swc_tos_CM_single 0 0 -3.4E+38 3.4E+38 ECU_ADDRESS 0xfe4b03e0 /* @ECU_Address@SwcOut_EVM_CIPV[2].size.width@ */ /end MEASUREMENT
/begin MEASUREMENT SwcOut_EVM_CIPV[2].velocity_gnd.mod "" FLOAT32_IEEE autosar_swc_tos_CM_single 0 0 -3.4E+38 3.4E+38 ECU_ADDRESS 0xfe4b03f0 /* @ECU_Address@SwcOut_EVM_CIPV[2].velocity_gnd.mod@ */ /end MEASUREMENT
/begin MEASUREMENT SwcOut_EVM_CIPV[2].velocity_gnd.x "" FLOAT32_IEEE autosar_swc_tos_CM_single 0 0 -3.4E+38 3.4E+38 ECU_ADDRESS 0xfe4b03e8 /* @ECU_Address@SwcOut_EVM_CIPV[2].velocity_gnd.x@ */ /end MEASUREMENT
/begin MEASUREMENT SwcOut_EVM_CIPV[2].velocity_gnd.y "" FLOAT32_IEEE autosar_swc_tos_CM_single 0 0 -3.4E+38 3.4E+38 ECU_ADDRESS 0xfe4b03ec /* @ECU_Address@SwcOut_EVM_CIPV[2].velocity_gnd.y@ */ /end MEASUREMENT
/begin MEASUREMENT SwcOut_EVM_CIPV[2].velocity_gnd_sl.mod "" FLOAT32_IEEE autosar_swc_tos_CM_single 0 0 -3.4E+38 3.4E+38 ECU_ADDRESS 0xfe4b0408 /* @ECU_Address@SwcOut_EVM_CIPV[2].velocity_gnd_sl.mod@ */ /end MEASUREMENT
/begin MEASUREMENT SwcOut_EVM_CIPV[2].velocity_gnd_sl.x "" FLOAT32_IEEE autosar_swc_tos_CM_single 0 0 -3.4E+38 3.4E+38 ECU_ADDRESS 0xfe4b0400 /* @ECU_Address@SwcOut_EVM_CIPV[2].velocity_gnd_sl.x@ */ /end MEASUREMENT
/begin MEASUREMENT SwcOut_EVM_CIPV[2].velocity_gnd_sl.y "" FLOAT32_IEEE autosar_swc_tos_CM_single 0 0 -3.4E+38 3.4E+38 ECU_ADDRESS 0xfe4b0404 /* @ECU_Address@SwcOut_EVM_CIPV[2].velocity_gnd_sl.y@ */ /end MEASUREMENT
/begin MEASUREMENT SwcOut_EVM_CIPV[3].accel_gnd.mod "" FLOAT32_IEEE autosar_swc_tos_CM_single 0 0 -3.4E+38 3.4E+38 ECU_ADDRESS 0xfe4b047c /* @ECU_Address@SwcOut_EVM_CIPV[3].accel_gnd.mod@ */ /end MEASUREMENT
/begin MEASUREMENT SwcOut_EVM_CIPV[3].accel_gnd.x "" FLOAT32_IEEE autosar_swc_tos_CM_single 0 0 -3.4E+38 3.4E+38 ECU_ADDRESS 0xfe4b0474 /* @ECU_Address@SwcOut_EVM_CIPV[3].accel_gnd.x@ */ /end MEASUREMENT
/begin MEASUREMENT SwcOut_EVM_CIPV[3].accel_gnd.y "" FLOAT32_IEEE autosar_swc_tos_CM_single 0 0 -3.4E+38 3.4E+38 ECU_ADDRESS 0xfe4b0478 /* @ECU_Address@SwcOut_EVM_CIPV[3].accel_gnd.y@ */ /end MEASUREMENT
/begin MEASUREMENT SwcOut_EVM_CIPV[3].accel_gnd_sl.mod "" FLOAT32_IEEE autosar_swc_tos_CM_single 0 0 -3.4E+38 3.4E+38 ECU_ADDRESS 0xfe4b0494 /* @ECU_Address@SwcOut_EVM_CIPV[3].accel_gnd_sl.mod@ */ /end MEASUREMENT
/begin MEASUREMENT SwcOut_EVM_CIPV[3].accel_gnd_sl.x "" FLOAT32_IEEE autosar_swc_tos_CM_single 0 0 -3.4E+38 3.4E+38 ECU_ADDRESS 0xfe4b048c /* @ECU_Address@SwcOut_EVM_CIPV[3].accel_gnd_sl.x@ */ /end MEASUREMENT
/begin MEASUREMENT SwcOut_EVM_CIPV[3].accel_gnd_sl.y "" FLOAT32_IEEE autosar_swc_tos_CM_single 0 0 -3.4E+38 3.4E+38 ECU_ADDRESS 0xfe4b0490 /* @ECU_Address@SwcOut_EVM_CIPV[3].accel_gnd_sl.y@ */ /end MEASUREMENT
/begin MEASUREMENT SwcOut_EVM_CIPV[3].box.corner_x_vec "" FLOAT32_IEEE autosar_swc_tos_CM_single 0 0 -3.4E+38 3.4E+38 LAYOUT COLUMN_DIR MATRIX_DIM 4 ECU_ADDRESS 0xfe4b0424 /* @ECU_Address@SwcOut_EVM_CIPV[3].box.corner_x_vec@ */ /end MEASUREMENT
/begin MEASUREMENT SwcOut_EVM_CIPV[3].box.corner_y_vec "" FLOAT32_IEEE autosar_swc_tos_CM_single 0 0 -3.4E+38 3.4E+38 LAYOUT COLUMN_DIR MATRIX_DIM 4 ECU_ADDRESS 0xfe4b0434 /* @ECU_Address@SwcOut_EVM_CIPV[3].box.corner_y_vec@ */ /end MEASUREMENT
/begin MEASUREMENT SwcOut_EVM_CIPV[3].class_type "" UBYTE autosar_swc_tos_CM_uint8 0 0 0 255 ECU_ADDRESS 0xfe4b041a /* @ECU_Address@SwcOut_EVM_CIPV[3].class_type@ */ /end MEASUREMENT
/begin MEASUREMENT SwcOut_EVM_CIPV[3].cut_type "" UBYTE autosar_swc_tos_CM_uint8 0 0 0 255 ECU_ADDRESS 0xfe4b041b /* @ECU_Address@SwcOut_EVM_CIPV[3].cut_type@ */ /end MEASUREMENT
/begin MEASUREMENT SwcOut_EVM_CIPV[3].fus_type "" UBYTE autosar_swc_tos_CM_uint8 0 0 0 255 ECU_ADDRESS 0xfe4b0419 /* @ECU_Address@SwcOut_EVM_CIPV[3].fus_type@ */ /end MEASUREMENT
/begin MEASUREMENT SwcOut_EVM_CIPV[3].id "" ULONG autosar_swc_tos_CM_uint32 0 0 0 4294967295 ECU_ADDRESS 0xfe4b0420 /* @ECU_Address@SwcOut_EVM_CIPV[3].id@ */ /end MEASUREMENT
/begin MEASUREMENT SwcOut_EVM_CIPV[3].meas_state "" UBYTE autosar_swc_tos_CM_uint8 0 0 0 255 ECU_ADDRESS 0xfe4b0418 /* @ECU_Address@SwcOut_EVM_CIPV[3].meas_state@ */ /end MEASUREMENT
/begin MEASUREMENT SwcOut_EVM_CIPV[3].position.heading_angle "" FLOAT32_IEEE autosar_swc_tos_CM_single 0 0 -3.4E+38 3.4E+38 ECU_ADDRESS 0xfe4b044c /* @ECU_Address@SwcOut_EVM_CIPV[3].position.heading_angle@ */ /end MEASUREMENT
/begin MEASUREMENT SwcOut_EVM_CIPV[3].position.x "" FLOAT32_IEEE autosar_swc_tos_CM_single 0 0 -3.4E+38 3.4E+38 ECU_ADDRESS 0xfe4b0444 /* @ECU_Address@SwcOut_EVM_CIPV[3].position.x@ */ /end MEASUREMENT
/begin MEASUREMENT SwcOut_EVM_CIPV[3].position.y "" FLOAT32_IEEE autosar_swc_tos_CM_single 0 0 -3.4E+38 3.4E+38 ECU_ADDRESS 0xfe4b0448 /* @ECU_Address@SwcOut_EVM_CIPV[3].position.y@ */ /end MEASUREMENT
/begin MEASUREMENT SwcOut_EVM_CIPV[3].position_sl.heading_angle "" FLOAT32_IEEE autosar_swc_tos_CM_single 0 0 -3.4E+38 3.4E+38 ECU_ADDRESS 0xfe4b0458 /* @ECU_Address@SwcOut_EVM_CIPV[3].position_sl.heading_angle@ */ /end MEASUREMENT
/begin MEASUREMENT SwcOut_EVM_CIPV[3].position_sl.x "" FLOAT32_IEEE autosar_swc_tos_CM_single 0 0 -3.4E+38 3.4E+38 ECU_ADDRESS 0xfe4b0450 /* @ECU_Address@SwcOut_EVM_CIPV[3].position_sl.x@ */ /end MEASUREMENT
/begin MEASUREMENT SwcOut_EVM_CIPV[3].position_sl.y "" FLOAT32_IEEE autosar_swc_tos_CM_single 0 0 -3.4E+38 3.4E+38 ECU_ADDRESS 0xfe4b0454 /* @ECU_Address@SwcOut_EVM_CIPV[3].position_sl.y@ */ /end MEASUREMENT
/begin MEASUREMENT SwcOut_EVM_CIPV[3].ref_lane_id "" UBYTE autosar_swc_tos_CM_uint8 0 0 0 255 ECU_ADDRESS 0xfe4b041c /* @ECU_Address@SwcOut_EVM_CIPV[3].ref_lane_id@ */ /end MEASUREMENT
/begin MEASUREMENT SwcOut_EVM_CIPV[3].size.higth "" FLOAT32_IEEE autosar_swc_tos_CM_single 0 0 -3.4E+38 3.4E+38 ECU_ADDRESS 0xfe4b0464 /* @ECU_Address@SwcOut_EVM_CIPV[3].size.higth@ */ /end MEASUREMENT
/begin MEASUREMENT SwcOut_EVM_CIPV[3].size.length "" FLOAT32_IEEE autosar_swc_tos_CM_single 0 0 -3.4E+38 3.4E+38 ECU_ADDRESS 0xfe4b045c /* @ECU_Address@SwcOut_EVM_CIPV[3].size.length@ */ /end MEASUREMENT
/begin MEASUREMENT SwcOut_EVM_CIPV[3].size.width "" FLOAT32_IEEE autosar_swc_tos_CM_single 0 0 -3.4E+38 3.4E+38 ECU_ADDRESS 0xfe4b0460 /* @ECU_Address@SwcOut_EVM_CIPV[3].size.width@ */ /end MEASUREMENT
/begin MEASUREMENT SwcOut_EVM_CIPV[3].velocity_gnd.mod "" FLOAT32_IEEE autosar_swc_tos_CM_single 0 0 -3.4E+38 3.4E+38 ECU_ADDRESS 0xfe4b0470 /* @ECU_Address@SwcOut_EVM_CIPV[3].velocity_gnd.mod@ */ /end MEASUREMENT
/begin MEASUREMENT SwcOut_EVM_CIPV[3].velocity_gnd.x "" FLOAT32_IEEE autosar_swc_tos_CM_single 0 0 -3.4E+38 3.4E+38 ECU_ADDRESS 0xfe4b0468 /* @ECU_Address@SwcOut_EVM_CIPV[3].velocity_gnd.x@ */ /end MEASUREMENT
/begin MEASUREMENT SwcOut_EVM_CIPV[3].velocity_gnd.y "" FLOAT32_IEEE autosar_swc_tos_CM_single 0 0 -3.4E+38 3.4E+38 ECU_ADDRESS 0xfe4b046c /* @ECU_Address@SwcOut_EVM_CIPV[3].velocity_gnd.y@ */ /end MEASUREMENT
/begin MEASUREMENT SwcOut_EVM_CIPV[3].velocity_gnd_sl.mod "" FLOAT32_IEEE autosar_swc_tos_CM_single 0 0 -3.4E+38 3.4E+38 ECU_ADDRESS 0xfe4b0488 /* @ECU_Address@SwcOut_EVM_CIPV[3].velocity_gnd_sl.mod@ */ /end MEASUREMENT
/begin MEASUREMENT SwcOut_EVM_CIPV[3].velocity_gnd_sl.x "" FLOAT32_IEEE autosar_swc_tos_CM_single 0 0 -3.4E+38 3.4E+38 ECU_ADDRESS 0xfe4b0480 /* @ECU_Address@SwcOut_EVM_CIPV[3].velocity_gnd_sl.x@ */ /end MEASUREMENT
/begin MEASUREMENT SwcOut_EVM_CIPV[3].velocity_gnd_sl.y "" FLOAT32_IEEE autosar_swc_tos_CM_single 0 0 -3.4E+38 3.4E+38 ECU_ADDRESS 0xfe4b0484 /* @ECU_Address@SwcOut_EVM_CIPV[3].velocity_gnd_sl.y@ */ /end MEASUREMENT
/begin MEASUREMENT SwcOut_EVM_CIPV[4].accel_gnd.mod "" FLOAT32_IEEE autosar_swc_tos_CM_single 0 0 -3.4E+38 3.4E+38 ECU_ADDRESS 0xfe4b04fc /* @ECU_Address@SwcOut_EVM_CIPV[4].accel_gnd.mod@ */ /end MEASUREMENT
/begin MEASUREMENT SwcOut_EVM_CIPV[4].accel_gnd.x "" FLOAT32_IEEE autosar_swc_tos_CM_single 0 0 -3.4E+38 3.4E+38 ECU_ADDRESS 0xfe4b04f4 /* @ECU_Address@SwcOut_EVM_CIPV[4].accel_gnd.x@ */ /end MEASUREMENT
/begin MEASUREMENT SwcOut_EVM_CIPV[4].accel_gnd.y "" FLOAT32_IEEE autosar_swc_tos_CM_single 0 0 -3.4E+38 3.4E+38 ECU_ADDRESS 0xfe4b04f8 /* @ECU_Address@SwcOut_EVM_CIPV[4].accel_gnd.y@ */ /end MEASUREMENT
/begin MEASUREMENT SwcOut_EVM_CIPV[4].accel_gnd_sl.mod "" FLOAT32_IEEE autosar_swc_tos_CM_single 0 0 -3.4E+38 3.4E+38 ECU_ADDRESS 0xfe4b0514 /* @ECU_Address@SwcOut_EVM_CIPV[4].accel_gnd_sl.mod@ */ /end MEASUREMENT
/begin MEASUREMENT SwcOut_EVM_CIPV[4].accel_gnd_sl.x "" FLOAT32_IEEE autosar_swc_tos_CM_single 0 0 -3.4E+38 3.4E+38 ECU_ADDRESS 0xfe4b050c /* @ECU_Address@SwcOut_EVM_CIPV[4].accel_gnd_sl.x@ */ /end MEASUREMENT
/begin MEASUREMENT SwcOut_EVM_CIPV[4].accel_gnd_sl.y "" FLOAT32_IEEE autosar_swc_tos_CM_single 0 0 -3.4E+38 3.4E+38 ECU_ADDRESS 0xfe4b0510 /* @ECU_Address@SwcOut_EVM_CIPV[4].accel_gnd_sl.y@ */ /end MEASUREMENT
/begin MEASUREMENT SwcOut_EVM_CIPV[4].box.corner_x_vec "" FLOAT32_IEEE autosar_swc_tos_CM_single 0 0 -3.4E+38 3.4E+38 LAYOUT COLUMN_DIR MATRIX_DIM 4 ECU_ADDRESS 0xfe4b04a4 /* @ECU_Address@SwcOut_EVM_CIPV[4].box.corner_x_vec@ */ /end MEASUREMENT
/begin MEASUREMENT SwcOut_EVM_CIPV[4].box.corner_y_vec "" FLOAT32_IEEE autosar_swc_tos_CM_single 0 0 -3.4E+38 3.4E+38 LAYOUT COLUMN_DIR MATRIX_DIM 4 ECU_ADDRESS 0xfe4b04b4 /* @ECU_Address@SwcOut_EVM_CIPV[4].box.corner_y_vec@ */ /end MEASUREMENT
/begin MEASUREMENT SwcOut_EVM_CIPV[4].class_type "" UBYTE autosar_swc_tos_CM_uint8 0 0 0 255 ECU_ADDRESS 0xfe4b049a /* @ECU_Address@SwcOut_EVM_CIPV[4].class_type@ */ /end MEASUREMENT
/begin MEASUREMENT SwcOut_EVM_CIPV[4].cut_type "" UBYTE autosar_swc_tos_CM_uint8 0 0 0 255 ECU_ADDRESS 0xfe4b049b /* @ECU_Address@SwcOut_EVM_CIPV[4].cut_type@ */ /end MEASUREMENT
/begin MEASUREMENT SwcOut_EVM_CIPV[4].fus_type "" UBYTE autosar_swc_tos_CM_uint8 0 0 0 255 ECU_ADDRESS 0xfe4b0499 /* @ECU_Address@SwcOut_EVM_CIPV[4].fus_type@ */ /end MEASUREMENT
/begin MEASUREMENT SwcOut_EVM_CIPV[4].id "" ULONG autosar_swc_tos_CM_uint32 0 0 0 4294967295 ECU_ADDRESS 0xfe4b04a0 /* @ECU_Address@SwcOut_EVM_CIPV[4].id@ */ /end MEASUREMENT
/begin MEASUREMENT SwcOut_EVM_CIPV[4].meas_state "" UBYTE autosar_swc_tos_CM_uint8 0 0 0 255 ECU_ADDRESS 0xfe4b0498 /* @ECU_Address@SwcOut_EVM_CIPV[4].meas_state@ */ /end MEASUREMENT
/begin MEASUREMENT SwcOut_EVM_CIPV[4].position.heading_angle "" FLOAT32_IEEE autosar_swc_tos_CM_single 0 0 -3.4E+38 3.4E+38 ECU_ADDRESS 0xfe4b04cc /* @ECU_Address@SwcOut_EVM_CIPV[4].position.heading_angle@ */ /end MEASUREMENT
/begin MEASUREMENT SwcOut_EVM_CIPV[4].position.x "" FLOAT32_IEEE autosar_swc_tos_CM_single 0 0 -3.4E+38 3.4E+38 ECU_ADDRESS 0xfe4b04c4 /* @ECU_Address@SwcOut_EVM_CIPV[4].position.x@ */ /end MEASUREMENT
/begin MEASUREMENT SwcOut_EVM_CIPV[4].position.y "" FLOAT32_IEEE autosar_swc_tos_CM_single 0 0 -3.4E+38 3.4E+38 ECU_ADDRESS 0xfe4b04c8 /* @ECU_Address@SwcOut_EVM_CIPV[4].position.y@ */ /end MEASUREMENT
/begin MEASUREMENT SwcOut_EVM_CIPV[4].position_sl.heading_angle "" FLOAT32_IEEE autosar_swc_tos_CM_single 0 0 -3.4E+38 3.4E+38 ECU_ADDRESS 0xfe4b04d8 /* @ECU_Address@SwcOut_EVM_CIPV[4].position_sl.heading_angle@ */ /end MEASUREMENT
/begin MEASUREMENT SwcOut_EVM_CIPV[4].position_sl.x "" FLOAT32_IEEE autosar_swc_tos_CM_single 0 0 -3.4E+38 3.4E+38 ECU_ADDRESS 0xfe4b04d0 /* @ECU_Address@SwcOut_EVM_CIPV[4].position_sl.x@ */ /end MEASUREMENT
/begin MEASUREMENT SwcOut_EVM_CIPV[4].position_sl.y "" FLOAT32_IEEE autosar_swc_tos_CM_single 0 0 -3.4E+38 3.4E+38 ECU_ADDRESS 0xfe4b04d4 /* @ECU_Address@SwcOut_EVM_CIPV[4].position_sl.y@ */ /end MEASUREMENT
/begin MEASUREMENT SwcOut_EVM_CIPV[4].ref_lane_id "" UBYTE autosar_swc_tos_CM_uint8 0 0 0 255 ECU_ADDRESS 0xfe4b049c /* @ECU_Address@SwcOut_EVM_CIPV[4].ref_lane_id@ */ /end MEASUREMENT
/begin COMPU_METHOD autosar_swc_tos_CM_single "Q = V" IDENTICAL "%8.6" "" /end COMPU_METHOD
/begin COMPU_METHOD autosar_swc_tos_CM_uint32 "Q = V" IDENTICAL "%10.0" "" /end COMPU_METHOD
/begin COMPU_METHOD autosar_swc_tos_CM_uint8 "Q = V" IDENTICAL "%3.0" "" /end COMPU_METHOD
/begin RECORD_LAYOUT Record_FLOAT32_IEEE FNC_VALUES 1 FLOAT32_IEEE COLUMN_DIR DIRECT /end RECORD_LAYOUT
/begin RECORD_LAYOUT Record_UBYTE FNC_VALUES 1 UBYTE COLUMN_DIR DIRECT /end RECORD_LAYOUT
/begin GROUP SwcOut_EVM_CIPV[0] ""
 /begin SUB_GROUP SwcOut_EVM_CIPV[0].box SwcOut_EVM_CIPV[0].position SwcOut_EVM_CIPV[0].position_sl SwcOut_EVM_CIPV[0].size SwcOut_EVM_CIPV[0].velocity_gnd SwcOut_EVM_CIPV[0].accel_gnd SwcOut_EVM_CIPV[0].velocity_gnd_sl SwcOut_EVM_CIPV[0].accel_gnd_sl /end SUB_GROUP
 /begin REF_MEASUREMENT SwcOut_EVM_CIPV[0].meas_state SwcOut_EVM_CIPV[0].fus_type SwcOut_EVM_CIPV[0].class_type SwcOut_EVM_CIPV[0].cut_type SwcOut_EVM_CIPV[0].ref_lane_id SwcOut_EVM_CIPV[0].id /end REF_MEASUREMENT
/end GROUP
/begin GROUP SwcOut_EVM_CIPV[0].accel_gnd ""
 /begin REF_MEASUREMENT SwcOut_EVM_CIPV[0].accel_gnd.x SwcOut_EVM_CIPV[0].accel_gnd.y SwcOut_EVM_CIPV[0].accel_gnd.mod /end REF_MEASUREMENT
/end GROUP
/begin GROUP SwcOut_EVM_CIPV[0].accel_gnd_sl ""
 /begin REF_MEASUREMENT SwcOut_EVM_CIPV[0].accel_gnd_sl.x SwcOut_EVM_CIPV[0].accel_gnd_sl.y SwcOut_EVM_CIPV[0].accel_gnd_sl.mod /end REF_MEASUREMENT
/end GROUP
/begin GROUP SwcOut_EVM_CIPV[0].box ""
 /begin REF_MEASUREMENT SwcOut_EVM_CIPV[0].box.corner_x_vec SwcOut_EVM_CIPV[0].box.corner_y_vec /end REF_MEASUREMENT
/end GROUP
/begin GROUP SwcOut_EVM_CIPV[0].position ""
 /begin REF_MEASUREMENT SwcOut_EVM_CIPV[0].position.x SwcOut_EVM_CIPV[0].position.y SwcOut_EVM_CIPV[0].position.heading_angle /end REF_MEASUREMENT
/end GROUP
/begin GROUP SwcOut_EVM_CIPV[0].position_sl ""
 /begin REF_MEASUREMENT SwcOut_EVM_CIPV[0].position_sl.x SwcOut_EVM_CIPV[0].position_sl.y SwcOut_EVM_CIPV[0].position_sl.heading_angle /end REF_MEASUREMENT
/end GROUP
/begin GROUP SwcOut_EVM_CIPV[0].size ""
 /begin REF_MEASUREMENT SwcOut_EVM_CIPV[0].size.length SwcOut_EVM_CIPV[0].size.width SwcOut_EVM_CIPV[0].size.higth /end REF_MEASUREMENT
/end GROUP
/begin GROUP SwcOut_EVM_CIPV[0].velocity_gnd ""
 /begin REF_MEASUREMENT SwcOut_EVM_CIPV[0].velocity_gnd.x SwcOut_EVM_CIPV[0].velocity_gnd.y SwcOut_EVM_CIPV[0].velocity_gnd.mod /end REF_MEASUREMENT
/end GROUP
/begin GROUP SwcOut_EVM_CIPV[0].velocity_gnd_sl ""
 /begin REF_MEASUREMENT SwcOut_EVM_CIPV[0].velocity_gnd_sl.x SwcOut_EVM_CIPV[0].velocity_gnd_sl.y SwcOut_EVM_CIPV[0].velocity_gnd_sl.mod /end REF_MEASUREMENT
/end GROUP
/begin GROUP SwcOut_EVM_CIPV[1] ""
 /begin SUB_GROUP SwcOut_EVM_CIPV[1].box SwcOut_EVM_CIPV[1].position SwcOut_EVM_CIPV[1].position_sl SwcOut_EVM_CIPV[1].size SwcOut_EVM_CIPV[1].velocity_gnd SwcOut_EVM_CIPV[1].accel_gnd SwcOut_EVM_CIPV[1].velocity_gnd_sl SwcOut_EVM_CIPV[1].accel_gnd_sl /end SUB_GROUP
 /begin REF_MEASUREMENT SwcOut_EVM_CIPV[1].meas_state SwcOut_EVM_CIPV[1].fus_type SwcOut_EVM_CIPV[1].class_type SwcOut_EVM_CIPV[1].cut_type SwcOut_EVM_CIPV[1].ref_lane_id SwcOut_EVM_CIPV[1].id /end REF_MEASUREMENT
/end GROUP
/begin GROUP SwcOut_EVM_CIPV[1].accel_gnd ""
 /begin REF_MEASUREMENT SwcOut_EVM_CIPV[1].accel_gnd.x SwcOut_EVM_CIPV[1].accel_gnd.y SwcOut_EVM_CIPV[1].accel_gnd.mod /end REF_MEASUREMENT
/end GROUP
/begin GROUP SwcOut_EVM_CIPV[1].accel_gnd_sl ""
 /begin REF_MEASUREMENT SwcOut_EVM_CIPV[1].accel_gnd_sl.x SwcOut_EVM_CIPV[1].accel_gnd_sl.y SwcOut_EVM_CIPV[1].accel_gnd_sl.mod /end REF_MEASUREMENT
/end GROUP
/begin GROUP SwcOut_EVM_CIPV[1].box ""
 /begin REF_MEASUREMENT SwcOut_EVM_CIPV[1].box.corner_x_vec SwcOut_EVM_CIPV[1].box.corner_y_vec /end REF_MEASUREMENT
/end GROUP
/begin GROUP SwcOut_EVM_CIPV[1].position ""
 /begin REF_MEASUREMENT SwcOut_EVM_CIPV[1].position.x SwcOut_EVM_CIPV[1].position.y SwcOut_EVM_CIPV[1].position.heading_angle /end REF_MEASUREMENT
/end GROUP
/begin GROUP SwcOut_EVM_CIPV[1].position_sl ""
 /begin REF_MEASUREMENT SwcOut_EVM_CIPV[1].position_sl.x SwcOut_EVM_CIPV[1].position_sl.y SwcOut_EVM_CIPV[1].position_sl.heading_angle /end REF_MEASUREMENT
/end GROUP
/begin GROUP SwcOut_EVM_CIPV[1].size ""
 /begin REF_MEASUREMENT SwcOut_EVM_CIPV[1].size.length SwcOut_EVM_CIPV[1].size.width SwcOut_EVM_CIPV[1].size.higth /end REF_MEASUREMENT
/end GROUP
/begin GROUP SwcOut_EVM_CIPV[1].velocity_gnd ""
 /begin REF_MEASUREMENT SwcOut_EVM_CIPV[1].velocity_gnd.x SwcOut_EVM_CIPV[1].velocity_gnd.y SwcOut_EVM_CIPV[1].velocity_gnd.mod /end REF_MEASUREMENT
/end GROUP
/begin GROUP SwcOut_EVM_CIPV[1].velocity_gnd_sl ""
 /begin REF_MEASUREMENT SwcOut_EVM_CIPV[1].velocity_gnd_sl.x SwcOut_EVM_CIPV[1].velocity_gnd_sl.y SwcOut_EVM_CIPV[1].velocity_gnd_sl.mod /end REF_MEASUREMENT
/end GROUP
/begin GROUP SwcOut_EVM_CIPV[2] ""
 /begin SUB_GROUP SwcOut_EVM_CIPV[2].box SwcOut_EVM_CIPV[2].position SwcOut_EVM_CIPV[2].position_sl SwcOut_EVM_CIPV[2].size SwcOut_EVM_CIPV[2].velocity_gnd SwcOut_EVM_CIPV[2].accel_gnd SwcOut_EVM_CIPV[2].velocity_gnd_sl SwcOut_EVM_CIPV[2].accel_gnd_sl /end SUB_GROUP
 /begin REF_MEASUREMENT SwcOut_EVM_CIPV[2].meas_state SwcOut_EVM_CIPV[2].fus_type SwcOut_EVM_CIPV[2].class_type SwcOut_EVM_CIPV[2].cut_type SwcOut_EVM_CIPV[2].ref_lane_id SwcOut_EVM_CIPV[2].id /end REF_MEASUREMENT
/end GROUP
/begin GROUP SwcOut_EVM_CIPV[2].accel_gnd ""
 /begin REF_MEASUREMENT SwcOut_EVM_CIPV[2].accel_gnd.x SwcOut_EVM_CIPV[2].accel_gnd.y SwcOut_EVM_CIPV[2].accel_gnd.mod /end REF_MEASUREMENT
/end GROUP
/begin GROUP SwcOut_EVM_CIPV[2].accel_gnd_sl ""
 /begin REF_MEASUREMENT SwcOut_EVM_CIPV[2].accel_gnd_sl.x SwcOut_EVM_CIPV[2].accel_gnd_sl.y SwcOut_EVM_CIPV[2].accel_gnd_sl.mod /end REF_MEASUREMENT
/end GROUP
/begin GROUP SwcOut_EVM_CIPV[2].box ""
 /begin REF_MEASUREMENT SwcOut_EVM_CIPV[2].box.corner_x_vec SwcOut_EVM_CIPV[2].box.corner_y_vec /end REF_MEASUREMENT
/end GROUP
/begin GROUP SwcOut_EVM_CIPV[2].position ""
 /begin REF_MEASUREMENT SwcOut_EVM_CIPV[2].position.x SwcOut_EVM_CIPV[2].position.y SwcOut_EVM_CIPV[2].position.heading_angle /end REF_MEASUREMENT
/end GROUP
/begin GROUP SwcOut_EVM_CIPV[2].position_sl ""
 /begin REF_MEASUREMENT SwcOut_EVM_CIPV[2].position_sl.x SwcOut_EVM_CIPV[2].position_sl.y SwcOut_EVM_CIPV[2].position_sl.heading_angle /end REF_MEASUREMENT
/end GROUP
/begin GROUP SwcOut_EVM_CIPV[2].size ""
 /begin REF_MEASUREMENT SwcOut_EVM_CIPV[2].size.length SwcOut_EVM_CIPV[2].size.width SwcOut_EVM_CIPV[2].size.higth /end REF_MEASUREMENT
/end GROUP
/begin GROUP SwcOut_EVM_CIPV[2].velocity_gnd ""
 /begin REF_MEASUREMENT SwcOut_EVM_CIPV[2].velocity_gnd.x SwcOut_EVM_CIPV[2].velocity_gnd.y SwcOut_EVM_CIPV[2].velocity_gnd.mod /end REF_MEASUREMENT
/end GROUP
/begin GROUP SwcOut_EVM_CIPV[2].velocity_gnd_sl ""
 /begin REF_MEASUREMENT SwcOut_EVM_CIPV[2].velocity_gnd_sl.x SwcOut_EVM_CIPV[2].velocity_gnd_sl.y SwcOut_EVM_CIPV[2].velocity_gnd_sl.mod /end REF_MEASUREMENT
/end GROUP
/begin GROUP SwcOut_EVM_CIPV[3] ""
 /begin SUB_GROUP SwcOut_EVM_CIPV[3].box SwcOut_EVM_CIPV[3].position SwcOut_EVM_CIPV[3].position_sl SwcOut_EVM_CIPV[3].size SwcOut_EVM_CIPV[3].velocity_gnd SwcOut_EVM_CIPV[3].accel_gnd SwcOut_EVM_CIPV[3].velocity_gnd_sl SwcOut_EVM_CIPV[3].accel_gnd_sl /end SUB_GROUP
 /begin REF_MEASUREMENT SwcOut_EVM_CIPV[3].meas_state SwcOut_EVM_CIPV[3].fus_type SwcOut_EVM_CIPV[3].class_type SwcOut_EVM_CIPV[3].cut_type SwcOut_EVM_CIPV[3].ref_lane_id SwcOut_EVM_CIPV[3].id /end REF_MEASUREMENT
/end GROUP
/begin GROUP SwcOut_EVM_CIPV[3].accel_gnd ""
 /begin REF_MEASUREMENT SwcOut_EVM_CIPV[3].accel_gnd.x SwcOut_EVM_CIPV[3].accel_gnd.y SwcOut_EVM_CIPV[3].accel_gnd.mod /end REF_MEASUREMENT
/end GROUP
/begin GROUP SwcOut_EVM_CIPV[3].accel_gnd_sl ""
 /begin REF_MEASUREMENT SwcOut_EVM_CIPV[3].accel_gnd_sl.x SwcOut_EVM_CIPV[3].accel_gnd_sl.y SwcOut_EVM_CIPV[3].accel_gnd_sl.mod /end REF_MEASUREMENT
/end GROUP
/begin GROUP SwcOut_EVM_CIPV[3].box ""
 /begin REF_MEASUREMENT SwcOut_EVM_CIPV[3].box.corner_x_vec SwcOut_EVM_CIPV[3].box.corner_y_vec /end REF_MEASUREMENT
/end GROUP
/begin GROUP SwcOut_EVM_CIPV[3].position ""
 /begin REF_MEASUREMENT SwcOut_EVM_CIPV[3].position.x SwcOut_EVM_CIPV[3].position.y SwcOut_EVM_CIPV[3].position.heading_angle /end REF_MEASUREMENT
/end GROUP
/begin GROUP SwcOut_EVM_CIPV[3].position_sl ""
 /begin REF_MEASUREMENT SwcOut_EVM_CIPV[3].position_sl.x SwcOut_EVM_CIPV[3].position_sl.y SwcOut_EVM_CIPV[3].position_sl.heading_angle /end REF_MEASUREMENT
/end GROUP
/begin GROUP SwcOut_EVM_CIPV[3].size ""
 /begin REF_MEASUREMENT SwcOut_EVM_CIPV[3].size.length SwcOut_EVM_CIPV[3].size.width SwcOut_EVM_CIPV[3].size.higth /end REF_MEASUREMENT
/end GROUP
/begin GROUP SwcOut_EVM_CIPV[3].velocity_gnd ""
 /begin REF_MEASUREMENT SwcOut_EVM_CIPV[3].velocity_gnd.x SwcOut_EVM_CIPV[3].velocity_gnd.y SwcOut_EVM_CIPV[3].velocity_gnd.mod /end REF_MEASUREMENT
/end GROUP
/begin GROUP SwcOut_EVM_CIPV[3].velocity_gnd_sl ""
 /begin REF_MEASUREMENT SwcOut_EVM_CIPV[3].velocity_gnd_sl.x SwcOut_EVM_CIPV[3].velocity_gnd_sl.y SwcOut_EVM_CIPV[3].velocity_gnd_sl.mod /end REF_MEASUREMENT
/end GROUP
/begin GROUP SwcOut_EVM_CIPV[4] ""
 /begin SUB_GROUP SwcOut_EVM_CIPV[4].box SwcOut_EVM_CIPV[4].position SwcOut_EVM_CIPV[4].position_sl SwcOut_EVM_CIPV[4].size SwcOut_EVM_CIPV[4].velocity_gnd SwcOut_EVM_CIPV[4].accel_gnd SwcOut_EVM_CIPV[4].velocity_gnd_sl SwcOut_EVM_CIPV[4].accel_gnd_sl /end SUB_GROUP
 /begin REF_MEASUREMENT SwcOut_EVM_CIPV[4].meas_state SwcOut_EVM_CIPV[4].fus_type SwcOut_EVM_CIPV[4].class_type SwcOut_EVM_CIPV[4].cut_type SwcOut_EVM_CIPV[4].ref_lane_id SwcOut_EVM_CIPV[4].id /end REF_MEASUREMENT
/end GROUP
/begin GROUP SwcOut_EVM_CIPV[4].accel_gnd ""
 /begin REF_MEASUREMENT SwcOut_EVM_CIPV[4].accel_gnd.x SwcOut_EVM_CIPV[4].accel_gnd.y SwcOut_EVM_CIPV[4].accel_gnd.mod /end REF_MEASUREMENT
/end GROUP
/begin GROUP SwcOut_EVM_CIPV[4].accel_gnd_sl ""
 /begin REF_MEASUREMENT SwcOut_EVM_CIPV[4].accel_gnd_sl.x SwcOut_EVM_CIPV[4].accel_gnd_sl.y SwcOut_EVM_CIPV[4].accel_gnd_sl.mod /end REF_MEASUREMENT
/end GROUP
/begin GROUP SwcOut_EVM_CIPV[4].box ""
 /begin REF_MEASUREMENT SwcOut_EVM_CIPV[4].box.corner_x_vec SwcOut_EVM_CIPV[4].box.corner_y_vec /end REF_MEASUREMENT
/end GROUP
/begin GROUP SwcOut_EVM_CIPV[4].position ""
 /begin REF_MEASUREMENT SwcOut_EVM_CIPV[4].position.x SwcOut_EVM_CIPV[4].position.y SwcOut_EVM_CIPV[4].position.heading_angle /end REF_MEASUREMENT
/end GROUP
/begin GROUP SwcOut_EVM_CIPV[4].position_sl ""
 /begin REF_MEASUREMENT SwcOut_EVM_CIPV[4].position_sl.x SwcOut_EVM_CIPV[4].position_sl.y SwcOut_EVM_CIPV[4].position_sl.heading_angle /end REF_MEASUREMENT
/end GROUP
/begin RECORD_LAYOUT Record_FLOAT32_IEEE FNC_VALUES 1 FLOAT32_IEEE COLUMN_DIR DIRECT /end RECORD_LAYOUT
/begin RECORD_LAYOUT Record_UBYTE FNC_VALUES 1 UBYTE COLUMN_DIR DIRECT /end RECORD_LAYOUT
/begin RECORD_LAYOUT Record_FLOAT32_IEEE FNC_VALUES 1 FLOAT32_IEEE COLUMN_DIR DIRECT /end RECORD_LAYOUT
/begin RECORD_LAYOUT Record_UBYTE FNC_VALUES 1 UBYTE COLUMN_DIR DIRECT /end RECORD_LAYOUT
/begin RECORD_LAYOUT Record_FLOAT32_IEEE FNC_VALUES 1 FLOAT32_IEEE COLUMN_DIR DIRECT /end RECORD_LAYOUT
/begin RECORD_LAYOUT Record_UBYTE FNC_VALUES 1 UBYTE COLUMN_DIR DIRECT /end RECORD_LAYOUT
/begin RECORD_LAYOUT Record_FLOAT32_IEEE FNC_VALUES 1 FLOAT32_IEEE COLUMN_DIR DIRECT /end RECORD_LAYOUT
/begin RECORD_LAYOUT Record_UBYTE FNC_VALUES 1 UBYTE COLUMN_DIR DIRECT /end RECORD_LAYOUT
/end MODULE
/end PROJECT
