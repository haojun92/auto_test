ASAP2_VERSION 1 71
/begin PROJECT ProjectName ""
/begin MODULE ModuleName ""
/begin MOD_COMMON "" BYTE_ORDER MSB_LAST ALIGNMENT_BYTE 1 ALIGNMENT_WORD 1 ALIGNMENT_LONG 1 ALIGNMENT_INT64 1 ALIGNMENT_FLOAT16_IEEE 1 ALIGNMENT_FLOAT32_IEEE 1 ALIGNMENT_FLOAT64_IEEE 1 /end MOD_COMMON
/begin RECORD_LAYOUT Scalar_LONG FNC_VALUES 1 SLONG COLUMN_DIR DIRECT /end RECORD_LAYOUT
/begin RECORD_LAYOUT Record_BOOLEAN FNC_VALUES 1 UBYTE COLUMN_DIR DIRECT /end RECORD_LAYOUT
/begin RECORD_LAYOUT Record_FLOAT32_IEEE FNC_VALUES 1 FLOAT32_IEEE COLUMN_DIR DIRECT /end RECORD_LAYOUT
/begin RECORD_LAYOUT Record_SBYTE FNC_VALUES 1 SBYTE COLUMN_DIR DIRECT /end RECORD_LAYOUT
/begin RECORD_LAYOUT Record_UBYTE FNC_VALUES 1 UBYTE COLUMN_DIR DIRECT /end RECORD_LAYOUT
/begin RECORD_LAYOUT Record_ULONG FNC_VALUES 1 ULONG COLUMN_DIR DIRECT /end RECORD_LAYOUT
/begin RECORD_LAYOUT Record_UWORD FNC_VALUES 1 UWORD COLUMN_DIR DIRECT /end RECORD_LAYOUT
/begin RECORD_LAYOUT Axis_FLOAT32_IEEE AXIS_PTS_X 1 FLOAT32_IEEE INDEX_INCR DIRECT /end RECORD_LAYOUT
/begin RECORD_LAYOUT Record_BOOLEAN FNC_VALUES 1 UBYTE COLUMN_DIR DIRECT /end RECORD_LAYOUT
/begin RECORD_LAYOUT Record_FLOAT32_IEEE FNC_VALUES 1 FLOAT32_IEEE COLUMN_DIR DIRECT /end RECORD_LAYOUT
/begin RECORD_LAYOUT Record_UBYTE FNC_VALUES 1 UBYTE COLUMN_DIR DIRECT /end RECORD_LAYOUT
/begin RECORD_LAYOUT Record_ULONG FNC_VALUES 1 ULONG COLUMN_DIR DIRECT /end RECORD_LAYOUT
/begin RECORD_LAYOUT Record_UWORD FNC_VALUES 1 UWORD COLUMN_DIR DIRECT /end RECORD_LAYOUT
/begin RECORD_LAYOUT Axis_FLOAT32_IEEE AXIS_PTS_X 1 FLOAT32_IEEE INDEX_INCR DIRECT /end RECORD_LAYOUT
/begin RECORD_LAYOUT Record_BOOLEAN FNC_VALUES 1 UBYTE COLUMN_DIR DIRECT /end RECORD_LAYOUT
/begin RECORD_LAYOUT Record_FLOAT32_IEEE FNC_VALUES 1 FLOAT32_IEEE COLUMN_DIR DIRECT /end RECORD_LAYOUT
/begin RECORD_LAYOUT Record_UBYTE FNC_VALUES 1 UBYTE COLUMN_DIR DIRECT /end RECORD_LAYOUT
/begin RECORD_LAYOUT Record_ULONG FNC_VALUES 1 ULONG COLUMN_DIR DIRECT /end RECORD_LAYOUT
/begin RECORD_LAYOUT Record_BOOLEAN FNC_VALUES 1 UBYTE COLUMN_DIR DIRECT /end RECORD_LAYOUT
/begin RECORD_LAYOUT Record_FLOAT32_IEEE FNC_VALUES 1 FLOAT32_IEEE COLUMN_DIR DIRECT /end RECORD_LAYOUT
/begin RECORD_LAYOUT Record_SBYTE FNC_VALUES 1 SBYTE COLUMN_DIR DIRECT /end RECORD_LAYOUT
/begin RECORD_LAYOUT Record_UBYTE FNC_VALUES 1 UBYTE COLUMN_DIR DIRECT /end RECORD_LAYOUT
/begin RECORD_LAYOUT Record_ULONG FNC_VALUES 1 ULONG COLUMN_DIR DIRECT /end RECORD_LAYOUT
/begin RECORD_LAYOUT Record_UWORD FNC_VALUES 1 UWORD COLUMN_DIR DIRECT /end RECORD_LAYOUT
/begin RECORD_LAYOUT Axis_FLOAT32_IEEE AXIS_PTS_X 1 FLOAT32_IEEE INDEX_INCR DIRECT /end RECORD_LAYOUT
/begin RECORD_LAYOUT Record_BOOLEAN FNC_VALUES 1 UBYTE COLUMN_DIR DIRECT /end RECORD_LAYOUT
/begin RECORD_LAYOUT Record_FLOAT32_IEEE FNC_VALUES 1 FLOAT32_IEEE COLUMN_DIR DIRECT /end RECORD_LAYOUT
/begin RECORD_LAYOUT Record_SBYTE FNC_VALUES 1 SBYTE COLUMN_DIR DIRECT /end RECORD_LAYOUT
/begin RECORD_LAYOUT Record_UBYTE FNC_VALUES 1 UBYTE COLUMN_DIR DIRECT /end RECORD_LAYOUT
/begin RECORD_LAYOUT Record_ULONG FNC_VALUES 1 ULONG COLUMN_DIR DIRECT /end RECORD_LAYOUT
/begin RECORD_LAYOUT Record_UWORD FNC_VALUES 1 UWORD COLUMN_DIR DIRECT /end RECORD_LAYOUT
/begin RECORD_LAYOUT Axis_FLOAT32_IEEE AXIS_PTS_X 1 FLOAT32_IEEE INDEX_INCR DIRECT /end RECORD_LAYOUT
/begin RECORD_LAYOUT Record_BOOLEAN FNC_VALUES 1 UBYTE COLUMN_DIR DIRECT /end RECORD_LAYOUT
/begin RECORD_LAYOUT Record_FLOAT32_IEEE FNC_VALUES 1 FLOAT32_IEEE COLUMN_DIR DIRECT /end RECORD_LAYOUT
/begin RECORD_LAYOUT Record_SBYTE FNC_VALUES 1 SBYTE COLUMN_DIR DIRECT /end RECORD_LAYOUT
/begin RECORD_LAYOUT Record_UBYTE FNC_VALUES 1 UBYTE COLUMN_DIR DIRECT /end RECORD_LAYOUT
/begin RECORD_LAYOUT Record_ULONG FNC_VALUES 1 ULONG COLUMN_DIR DIRECT /end RECORD_LAYOUT
/begin RECORD_LAYOUT Record_UWORD FNC_VALUES 1 UWORD COLUMN_DIR DIRECT /end RECORD_LAYOUT
/begin RECORD_LAYOUT Axis_FLOAT32_IEEE AXIS_PTS_X 1 FLOAT32_IEEE INDEX_INCR DIRECT /end RECORD_LAYOUT
/begin RECORD_LAYOUT Record_BOOLEAN FNC_VALUES 1 UBYTE COLUMN_DIR DIRECT /end RECORD_LAYOUT
/begin RECORD_LAYOUT Record_FLOAT32_IEEE FNC_VALUES 1 FLOAT32_IEEE COLUMN_DIR DIRECT /end RECORD_LAYOUT
/begin RECORD_LAYOUT Record_SBYTE FNC_VALUES 1 SBYTE COLUMN_DIR DIRECT /end RECORD_LAYOUT
/begin RECORD_LAYOUT Record_UBYTE FNC_VALUES 1 UBYTE COLUMN_DIR DIRECT /end RECORD_LAYOUT
/begin RECORD_LAYOUT Record_ULONG FNC_VALUES 1 ULONG COLUMN_DIR DIRECT /end RECORD_LAYOUT
/begin RECORD_LAYOUT Record_UWORD FNC_VALUES 1 UWORD COLUMN_DIR DIRECT /end RECORD_LAYOUT
/begin RECORD_LAYOUT Record_BOOLEAN FNC_VALUES 1 UBYTE COLUMN_DIR DIRECT /end RECORD_LAYOUT
/begin RECORD_LAYOUT Record_FLOAT32_IEEE FNC_VALUES 1 FLOAT32_IEEE COLUMN_DIR DIRECT /end RECORD_LAYOUT
/begin RECORD_LAYOUT Record_SBYTE FNC_VALUES 1 SBYTE COLUMN_DIR DIRECT /end RECORD_LAYOUT
/begin RECORD_LAYOUT Record_UBYTE FNC_VALUES 1 UBYTE COLUMN_DIR DIRECT /end RECORD_LAYOUT
/begin RECORD_LAYOUT Record_ULONG FNC_VALUES 1 ULONG COLUMN_DIR DIRECT /end RECORD_LAYOUT
/begin RECORD_LAYOUT Record_UWORD FNC_VALUES 1 UWORD COLUMN_DIR DIRECT /end RECORD_LAYOUT
/begin RECORD_LAYOUT Axis_FLOAT32_IEEE AXIS_PTS_X 1 FLOAT32_IEEE INDEX_INCR DIRECT /end RECORD_LAYOUT
/begin RECORD_LAYOUT Record_BOOLEAN FNC_VALUES 1 UBYTE COLUMN_DIR DIRECT /end RECORD_LAYOUT
/begin RECORD_LAYOUT Record_FLOAT32_IEEE FNC_VALUES 1 FLOAT32_IEEE COLUMN_DIR DIRECT /end RECORD_LAYOUT
/begin RECORD_LAYOUT Record_SBYTE FNC_VALUES 1 SBYTE COLUMN_DIR DIRECT /end RECORD_LAYOUT
/begin RECORD_LAYOUT Record_UBYTE FNC_VALUES 1 UBYTE COLUMN_DIR DIRECT /end RECORD_LAYOUT
/begin RECORD_LAYOUT Record_ULONG FNC_VALUES 1 ULONG COLUMN_DIR DIRECT /end RECORD_LAYOUT
/begin RECORD_LAYOUT Record_UWORD FNC_VALUES 1 UWORD COLUMN_DIR DIRECT /end RECORD_LAYOUT
/begin RECORD_LAYOUT Axis_FLOAT32_IEEE AXIS_PTS_X 1 FLOAT32_IEEE INDEX_INCR DIRECT /end RECORD_LAYOUT
/begin RECORD_LAYOUT Record_BOOLEAN FNC_VALUES 1 UBYTE COLUMN_DIR DIRECT /end RECORD_LAYOUT
/begin RECORD_LAYOUT Record_FLOAT32_IEEE FNC_VALUES 1 FLOAT32_IEEE COLUMN_DIR DIRECT /end RECORD_LAYOUT
/begin RECORD_LAYOUT Record_SBYTE FNC_VALUES 1 SBYTE COLUMN_DIR DIRECT /end RECORD_LAYOUT
/begin RECORD_LAYOUT Record_UBYTE FNC_VALUES 1 UBYTE COLUMN_DIR DIRECT /end RECORD_LAYOUT
/begin RECORD_LAYOUT Record_ULONG FNC_VALUES 1 ULONG COLUMN_DIR DIRECT /end RECORD_LAYOUT
/begin RECORD_LAYOUT Record_UWORD FNC_VALUES 1 UWORD COLUMN_DIR DIRECT /end RECORD_LAYOUT
/begin RECORD_LAYOUT Axis_FLOAT32_IEEE AXIS_PTS_X 1 FLOAT32_IEEE INDEX_INCR DIRECT /end RECORD_LAYOUT
/begin CHARACTERISTIC P_VAL_AEB2CAN_OnOff "" VALUE 0xfe821f50 /* @ECU_Address@P_VAL_AEB2CAN_OnOff@ */ Record_UBYTE 0 autosar_swc_val_CM_uint8 0 255 /end CHARACTERISTIC
/begin CHARACTERISTIC P_VAL_AEBDeceLimSpd1 "" VALUE 0xfe821ee4 /* @ECU_Address@P_VAL_AEBDeceLimSpd1@ */ Record_FLOAT32_IEEE 0 autosar_swc_val_CM_single -3.4E+38 3.4E+38 /end CHARACTERISTIC
/begin CHARACTERISTIC P_VAL_AEBDeceLimSpd1Val "" VALUE 0xfe821ee8 /* @ECU_Address@P_VAL_AEBDeceLimSpd1Val@ */ Record_FLOAT32_IEEE 0 autosar_swc_val_CM_single -3.4E+38 3.4E+38 /end CHARACTERISTIC
/begin CHARACTERISTIC P_VAL_AEBDeceLimSpd2 "" VALUE 0xfe821eec /* @ECU_Address@P_VAL_AEBDeceLimSpd2@ */ Record_FLOAT32_IEEE 0 autosar_swc_val_CM_single -3.4E+38 3.4E+38 /end CHARACTERISTIC
/begin CHARACTERISTIC P_VAL_AEBDeceLimSpd2Val "" VALUE 0xfe821ef0 /* @ECU_Address@P_VAL_AEBDeceLimSpd2Val@ */ Record_FLOAT32_IEEE 0 autosar_swc_val_CM_single -3.4E+38 3.4E+38 /end CHARACTERISTIC
/begin CHARACTERISTIC P_VAL_AEBDeceLimSpd3 "" VALUE 0xfe821ef4 /* @ECU_Address@P_VAL_AEBDeceLimSpd3@ */ Record_FLOAT32_IEEE 0 autosar_swc_val_CM_single -3.4E+38 3.4E+38 /end CHARACTERISTIC
/begin CHARACTERISTIC P_VAL_AEBDeceLimSpd3Val "" VALUE 0xfe821ef8 /* @ECU_Address@P_VAL_AEBDeceLimSpd3Val@ */ Record_FLOAT32_IEEE 0 autosar_swc_val_CM_single -3.4E+38 3.4E+38 /end CHARACTERISTIC
/begin CHARACTERISTIC P_VAL_AEBLimitOnOff "" VALUE 0xfe821f51 /* @ECU_Address@P_VAL_AEBLimitOnOff@ */ Record_UBYTE 0 autosar_swc_val_CM_uint8 0 255 /end CHARACTERISTIC
/begin CHARACTERISTIC P_VAL_AEBTarDec "" VALUE 0xfe821efc /* @ECU_Address@P_VAL_AEBTarDec@ */ Record_FLOAT32_IEEE 0 autosar_swc_val_CM_single -3.4E+38 3.4E+38 /end CHARACTERISTIC
/begin CHARACTERISTIC P_VAL_AEBTarDecLowerLimt "" VALUE 0xfe821f00 /* @ECU_Address@P_VAL_AEBTarDecLowerLimt@ */ Record_FLOAT32_IEEE 0 autosar_swc_val_CM_single -3.4E+38 3.4E+38 /end CHARACTERISTIC
/begin CHARACTERISTIC P_VAL_AWB2CAN_OnOff "" VALUE 0xfe821f52 /* @ECU_Address@P_VAL_AWB2CAN_OnOff@ */ Record_UBYTE 0 autosar_swc_val_CM_uint8 0 255 /end CHARACTERISTIC
/begin CHARACTERISTIC P_VAL_AWBLevel "" VALUE 0xfe821f53 /* @ECU_Address@P_VAL_AWBLevel@ */ Record_UBYTE 0 autosar_swc_val_CM_uint8 0 255 /end CHARACTERISTIC
/begin CHARACTERISTIC P_VAL_AWBRequest "" VALUE 0xfe821f54 /* @ECU_Address@P_VAL_AWBRequest@ */ Record_UBYTE 0 autosar_swc_val_CM_uint8 0 255 /end CHARACTERISTIC
/begin CHARACTERISTIC P_VAL_BrakePedalStrokeLower "" VALUE 0xfe821f04 /* @ECU_Address@P_VAL_BrakePedalStrokeLower@ */ Record_FLOAT32_IEEE 0 autosar_swc_val_CM_single -3.4E+38 3.4E+38 /end CHARACTERISTIC
/begin CHARACTERISTIC P_VAL_BrakePedalStrokeLower_AEB "" VALUE 0xfe821f08 /* @ECU_Address@P_VAL_BrakePedalStrokeLower_AEB@ */ Record_FLOAT32_IEEE 0 autosar_swc_val_CM_single -3.4E+38 3.4E+38 /end CHARACTERISTIC
/begin CHARACTERISTIC P_VAL_BrakePedalStrokeUpper "" VALUE 0xfe821f0c /* @ECU_Address@P_VAL_BrakePedalStrokeUpper@ */ Record_FLOAT32_IEEE 0 autosar_swc_val_CM_single -3.4E+38 3.4E+38 /end CHARACTERISTIC
/begin CHARACTERISTIC P_VAL_BrakePedalStrokeUpper_AEB "" VALUE 0xfe821f10 /* @ECU_Address@P_VAL_BrakePedalStrokeUpper_AEB@ */ Record_FLOAT32_IEEE 0 autosar_swc_val_CM_single -3.4E+38 3.4E+38 /end CHARACTERISTIC
/begin CHARACTERISTIC P_VAL_CriusePushTime "" VALUE 0xfe821f55 /* @ECU_Address@P_VAL_CriusePushTime@ */ Record_UBYTE 0 autosar_swc_val_CM_uint8 0 255 /end CHARACTERISTIC
/begin CHARACTERISTIC P_VAL_DecelReqTable_ms2 "" CURVE 0xfe821f8c /* @ECU_Address@P_VAL_DecelReqTable_ms2@ */ Record_FLOAT32_IEEE 0 autosar_swc_val_CM_single -3.4E+38 3.4E+38
 /begin AXIS_DESCR COM_AXIS NO_INPUT_QUANTITY autosar_swc_val_CM_single 6 -3.4E+38 3.4E+38 AXIS_PTS_REF P_VAL_MCPressureTable_bar /end AXIS_DESCR
/end CHARACTERISTIC
/begin CHARACTERISTIC P_VAL_DecelRespValue_ms2 "" VALUE 0xfe821f14 /* @ECU_Address@P_VAL_DecelRespValue_ms2@ */ Record_FLOAT32_IEEE 0 autosar_swc_val_CM_single -3.4E+38 3.4E+38 /end CHARACTERISTIC
/begin CHARACTERISTIC P_VAL_DisableTirePressure "" VALUE 0xfe821f56 /* @ECU_Address@P_VAL_DisableTirePressure@ */ Record_UBYTE 0 autosar_swc_val_CM_uint8 0 255 /end CHARACTERISTIC
/begin CHARACTERISTIC P_VAL_DrvTorsionBarTqThd "" VALUE 0xfe821f18 /* @ECU_Address@P_VAL_DrvTorsionBarTqThd@ */ Record_FLOAT32_IEEE 0 autosar_swc_val_CM_single -3.4E+38 3.4E+38 /end CHARACTERISTIC
/begin CHARACTERISTIC P_VAL_EnableConfig "" VALUE 0xfe821f57 /* @ECU_Address@P_VAL_EnableConfig@ */ Record_UBYTE 0 autosar_swc_val_CM_uint8 0 255 /end CHARACTERISTIC
/begin CHARACTERISTIC P_VAL_EnableCruiseMiddleKey "" VALUE 0xfe821f58 /* @ECU_Address@P_VAL_EnableCruiseMiddleKey@ */ Record_UBYTE 0 autosar_swc_val_CM_uint8 0 255 /end CHARACTERISTIC
/begin CHARACTERISTIC P_VAL_EnableFusaErrID "" VALUE 0xfe821f59 /* @ECU_Address@P_VAL_EnableFusaErrID@ */ Record_BOOLEAN 0 autosar_swc_val_CM_boolean 0 1 /end CHARACTERISTIC
/begin CHARACTERISTIC P_VAL_EnableRainWiper "" VALUE 0xfe821f5a /* @ECU_Address@P_VAL_EnableRainWiper@ */ Record_UBYTE 0 autosar_swc_val_CM_uint8 0 255 /end CHARACTERISTIC
/begin CHARACTERISTIC P_VAL_Enable_SafSignal "" VALUE 0xfe821f5b /* @ECU_Address@P_VAL_Enable_SafSignal@ */ Record_UBYTE 0 autosar_swc_val_CM_uint8 0 255 /end CHARACTERISTIC
/begin CHARACTERISTIC P_VAL_Fusa_EPB_R_1_CRC2_Error "" VALUE 0xfe821f5c /* @ECU_Address@P_VAL_Fusa_EPB_R_1_CRC2_Error@ */ Record_BOOLEAN 0 autosar_swc_val_CM_boolean 0 1 /end CHARACTERISTIC
/begin CHARACTERISTIC P_VAL_Fusa_EPB_R_1_RollgCntr2_Error "" VALUE 0xfe821f5d /* @ECU_Address@P_VAL_Fusa_EPB_R_1_RollgCntr2_Error@ */ Record_BOOLEAN 0 autosar_swc_val_CM_boolean 0 1 /end CHARACTERISTIC
/begin CHARACTERISTIC P_VAL_HandsoffDet_Trq "" VALUE 0xfe821f1c /* @ECU_Address@P_VAL_HandsoffDet_Trq@ */ Record_FLOAT32_IEEE 0 autosar_swc_val_CM_single -3.4E+38 3.4E+38 /end CHARACTERISTIC
/begin CHARACTERISTIC P_VAL_HandsoffDet_Trq_Saf "" VALUE 0xfe821f20 /* @ECU_Address@P_VAL_HandsoffDet_Trq_Saf@ */ Record_FLOAT32_IEEE 0 autosar_swc_val_CM_single -3.4E+38 3.4E+38 /end CHARACTERISTIC
/begin CHARACTERISTIC P_VAL_HandsonDet_Trq "" VALUE 0xfe821f24 /* @ECU_Address@P_VAL_HandsonDet_Trq@ */ Record_FLOAT32_IEEE 0 autosar_swc_val_CM_single -3.4E+38 3.4E+38 /end CHARACTERISTIC
/begin CHARACTERISTIC P_VAL_HandsonDet_Trq_Saf "" VALUE 0xfe821f28 /* @ECU_Address@P_VAL_HandsonDet_Trq_Saf@ */ Record_FLOAT32_IEEE 0 autosar_swc_val_CM_single -3.4E+38 3.4E+38 /end CHARACTERISTIC
/begin CHARACTERISTIC P_VAL_IsSftyEna "" VALUE 0xfe821f5e /* @ECU_Address@P_VAL_IsSftyEna@ */ Record_BOOLEAN 0 autosar_swc_val_CM_boolean 0 1 /end CHARACTERISTIC
/begin CHARACTERISTIC P_VAL_LDWSHOCK_TIME "" VALUE 0xfe821f48 /* @ECU_Address@P_VAL_LDWSHOCK_TIME@ */ Record_UWORD 0 autosar_swc_val_CM_uint16 0 65535 /end CHARACTERISTIC
/begin CHARACTERISTIC P_VAL_LDWUNSHOCK_TIME "" VALUE 0xfe821f4a /* @ECU_Address@P_VAL_LDWUNSHOCK_TIME@ */ Record_UWORD 0 autosar_swc_val_CM_uint16 0 65535 /end CHARACTERISTIC
/begin CHARACTERISTIC P_VAL_LdpUnSuppressShock "" VALUE 0xfe821f5f /* @ECU_Address@P_VAL_LdpUnSuppressShock@ */ Record_UBYTE 0 autosar_swc_val_CM_uint8 0 255 /end CHARACTERISTIC
/begin CHARACTERISTIC P_VAL_LeRollrUpDwnAdjSteps "" VALUE 0xfe821f60 /* @ECU_Address@P_VAL_LeRollrUpDwnAdjSteps@ */ Record_UBYTE 0 autosar_swc_val_CM_uint8 0 255 /end CHARACTERISTIC
/begin CHARACTERISTIC P_VAL_ManDrv_SW "" VALUE 0xfe821f61 /* @ECU_Address@P_VAL_ManDrv_SW@ */ Record_UBYTE 0 autosar_swc_val_CM_uint8 0 255 /end CHARACTERISTIC
/begin CHARACTERISTIC P_VAL_PilotDeceLim "" VALUE 0xfe821f2c /* @ECU_Address@P_VAL_PilotDeceLim@ */ Record_FLOAT32_IEEE 0 autosar_swc_val_CM_single -3.4E+38 3.4E+38 /end CHARACTERISTIC
/begin CHARACTERISTIC P_VAL_SftyChkTmr "" VALUE 0xfe821f62 /* @ECU_Address@P_VAL_SftyChkTmr@ */ Record_UBYTE 0 autosar_swc_val_CM_uint8 0 255 /end CHARACTERISTIC
/begin CHARACTERISTIC P_VAL_SftyJerkLimDece "" VALUE 0xfe821f30 /* @ECU_Address@P_VAL_SftyJerkLimDece@ */ Record_FLOAT32_IEEE 0 autosar_swc_val_CM_single -3.4E+38 3.4E+38 /end CHARACTERISTIC
/begin CHARACTERISTIC P_VAL_SftyOvrdKeptTi "" VALUE 0xfe821f63 /* @ECU_Address@P_VAL_SftyOvrdKeptTi@ */ Record_UBYTE 0 autosar_swc_val_CM_uint8 0 255 /end CHARACTERISTIC
/begin CHARACTERISTIC P_VAL_SwitchELKOn "" VALUE 0xfe821f64 /* @ECU_Address@P_VAL_SwitchELKOn@ */ Record_UBYTE 0 autosar_swc_val_CM_uint8 0 255 /end CHARACTERISTIC
/begin CHARACTERISTIC P_VAL_TEMP_FusaEnable "" VALUE 0xfe821f65 /* @ECU_Address@P_VAL_TEMP_FusaEnable@ */ Record_BOOLEAN 0 autosar_swc_val_CM_boolean 0 1 /end CHARACTERISTIC
/begin CHARACTERISTIC P_VAL_Virtual_AEBONOFFSts "" VALUE 0xfe821f66 /* @ECU_Address@P_VAL_Virtual_AEBONOFFSts@ */ Record_BOOLEAN 0 autosar_swc_val_CM_boolean 0 1 /end CHARACTERISTIC
/begin CHARACTERISTIC P_VAL_Virtual_AESONOFFSts "" VALUE 0xfe821f67 /* @ECU_Address@P_VAL_Virtual_AESONOFFSts@ */ Record_BOOLEAN 0 autosar_swc_val_CM_boolean 0 1 /end CHARACTERISTIC
/begin CHARACTERISTIC P_VAL_Virtual_ALCONOFFSts "" VALUE 0xfe821f68 /* @ECU_Address@P_VAL_Virtual_ALCONOFFSts@ */ Record_UBYTE 0 autosar_swc_val_CM_uint8 0 255 /end CHARACTERISTIC
/begin CHARACTERISTIC P_VAL_Virtual_ALCSnvtySet "" VALUE 0xfe821f69 /* @ECU_Address@P_VAL_Virtual_ALCSnvtySet@ */ Record_UBYTE 0 autosar_swc_val_CM_uint8 0 255 /end CHARACTERISTIC
/begin CHARACTERISTIC P_VAL_Virtual_Cam_1_Module "" VALUE 0xfe821f34 /* @ECU_Address@P_VAL_Virtual_Cam_1_Module@ */ Record_ULONG 0 autosar_swc_val_CM_uint32 0 4294967295 /end CHARACTERISTIC
/begin CHARACTERISTIC P_VAL_Virtual_Cam_1_Ser "" VALUE 0xfe821f38 /* @ECU_Address@P_VAL_Virtual_Cam_1_Ser@ */ Record_ULONG 0 autosar_swc_val_CM_uint32 0 4294967295 /end CHARACTERISTIC
/begin CHARACTERISTIC P_VAL_Virtual_DAIONOFFSts "" VALUE 0xfe821f6a /* @ECU_Address@P_VAL_Virtual_DAIONOFFSts@ */ Record_BOOLEAN 0 autosar_swc_val_CM_boolean 0 1 /end CHARACTERISTIC
/begin CHARACTERISTIC P_VAL_Virtual_DCLCSetSTS "" VALUE 0xfe821f6b /* @ECU_Address@P_VAL_Virtual_DCLCSetSTS@ */ Record_UBYTE 0 autosar_swc_val_CM_uint8 0 255 /end CHARACTERISTIC
/begin CHARACTERISTIC P_VAL_Virtual_ELKONOFFSts "ELKonof" VALUE 0xfe821f6c /* @ECU_Address@P_VAL_Virtual_ELKONOFFSts@ */ Record_BOOLEAN 0 autosar_swc_val_CM_boolean 0 1 /end CHARACTERISTIC
/begin CHARACTERISTIC P_VAL_Virtual_ESSONOFFSts "" VALUE 0xfe821f6d /* @ECU_Address@P_VAL_Virtual_ESSONOFFSts@ */ Record_BOOLEAN 0 autosar_swc_val_CM_boolean 0 1 /end CHARACTERISTIC
/begin CHARACTERISTIC P_VAL_Virtual_FCWONOFFSts "" VALUE 0xfe821f6e /* @ECU_Address@P_VAL_Virtual_FCWONOFFSts@ */ Record_BOOLEAN 0 autosar_swc_val_CM_boolean 0 1 /end CHARACTERISTIC
/begin CHARACTERISTIC P_VAL_Virtual_FCWSnvty "" VALUE 0xfe821f6f /* @ECU_Address@P_VAL_Virtual_FCWSnvty@ */ Record_UBYTE 0 autosar_swc_val_CM_uint8 0 255 /end CHARACTERISTIC
/begin CHARACTERISTIC P_VAL_Virtual_ICAONOFFSts "" VALUE 0xfe821f70 /* @ECU_Address@P_VAL_Virtual_ICAONOFFSts@ */ Record_UBYTE 0 autosar_swc_val_CM_uint8 0 255 /end CHARACTERISTIC
/begin CHARACTERISTIC P_VAL_Virtual_IESONOFFSts "" VALUE 0xfe821f71 /* @ECU_Address@P_VAL_Virtual_IESONOFFSts@ */ Record_BOOLEAN 0 autosar_swc_val_CM_boolean 0 1 /end CHARACTERISTIC
/begin CHARACTERISTIC P_VAL_Virtual_IHCONOFFSts "" VALUE 0xfe821f72 /* @ECU_Address@P_VAL_Virtual_IHCONOFFSts@ */ Record_UBYTE 0 autosar_swc_val_CM_uint8 0 255 /end CHARACTERISTIC
/begin CHARACTERISTIC P_VAL_Virtual_ISLONOFFSts "" VALUE 0xfe821f73 /* @ECU_Address@P_VAL_Virtual_ISLONOFFSts@ */ Record_BOOLEAN 0 autosar_swc_val_CM_boolean 0 1 /end CHARACTERISTIC
/begin CHARACTERISTIC P_VAL_Virtual_IntellgntCurveOnOff "" VALUE 0xfe821f74 /* @ECU_Address@P_VAL_Virtual_IntellgntCurveOnOff@ */ Record_BOOLEAN 0 autosar_swc_val_CM_boolean 0 1 /end CHARACTERISTIC
/begin CHARACTERISTIC P_VAL_Virtual_J3_Err1 "" VALUE 0xfe821f3c /* @ECU_Address@P_VAL_Virtual_J3_Err1@ */ Record_ULONG 0 autosar_swc_val_CM_uint32 0 4294967295 /end CHARACTERISTIC
/begin CHARACTERISTIC P_VAL_Virtual_J3_Err2 "" VALUE 0xfe821f40 /* @ECU_Address@P_VAL_Virtual_J3_Err2@ */ Record_ULONG 0 autosar_swc_val_CM_uint32 0 4294967295 /end CHARACTERISTIC
/begin CHARACTERISTIC P_VAL_Virtual_J3_Err3 "" VALUE 0xfe821f44 /* @ECU_Address@P_VAL_Virtual_J3_Err3@ */ Record_ULONG 0 autosar_swc_val_CM_uint32 0 4294967295 /end CHARACTERISTIC
/begin CHARACTERISTIC P_VAL_Virtual_LASSnvtySet "" VALUE 0xfe821f75 /* @ECU_Address@P_VAL_Virtual_LASSnvtySet@ */ Record_UBYTE 0 autosar_swc_val_CM_uint8 0 255 /end CHARACTERISTIC
/begin CHARACTERISTIC P_VAL_Virtual_LASWarnFormSwtReq "" VALUE 0xfe821f76 /* @ECU_Address@P_VAL_Virtual_LASWarnFormSwtReq@ */ Record_UBYTE 0 autosar_swc_val_CM_uint8 0 255 /end CHARACTERISTIC
/begin CHARACTERISTIC P_VAL_Virtual_LDPONOFFSts "" VALUE 0xfe821f77 /* @ECU_Address@P_VAL_Virtual_LDPONOFFSts@ */ Record_BOOLEAN 0 autosar_swc_val_CM_boolean 0 1 /end CHARACTERISTIC
/begin CHARACTERISTIC P_VAL_Virtual_LDWONOFFSts "" VALUE 0xfe821f78 /* @ECU_Address@P_VAL_Virtual_LDWONOFFSts@ */ Record_BOOLEAN 0 autosar_swc_val_CM_boolean 0 1 /end CHARACTERISTIC
/begin CHARACTERISTIC P_VAL_Virtual_Mcu_U2A16 "" VALUE 0xfe821f79 /* @ECU_Address@P_VAL_Virtual_Mcu_U2A16@ */ Record_UBYTE 0 autosar_swc_val_CM_uint8 0 255 /end CHARACTERISTIC
/begin CHARACTERISTIC P_VAL_Virtual_NOHActReq "" VALUE 0xfe821f7a /* @ECU_Address@P_VAL_Virtual_NOHActReq@ */ Record_BOOLEAN 0 autosar_swc_val_CM_boolean 0 1 /end CHARACTERISTIC
/begin CHARACTERISTIC P_VAL_Virtual_NOHONOFFsts "" VALUE 0xfe821f7b /* @ECU_Address@P_VAL_Virtual_NOHONOFFsts@ */ Record_BOOLEAN 0 autosar_swc_val_CM_boolean 0 1 /end CHARACTERISTIC
/begin CHARACTERISTIC P_VAL_Virtual_SLAONOFFSts "" VALUE 0xfe821f7c /* @ECU_Address@P_VAL_Virtual_SLAONOFFSts@ */ Record_UBYTE 0 autosar_swc_val_CM_uint8 0 255 /end CHARACTERISTIC
/begin CHARACTERISTIC P_VAL_Virtual_SLAWarnMod "" VALUE 0xfe821f7d /* @ECU_Address@P_VAL_Virtual_SLAWarnMod@ */ Record_UBYTE 0 autosar_swc_val_CM_uint8 0 255 /end CHARACTERISTIC
/begin CHARACTERISTIC P_VAL_Virtual_SW "" VALUE 0xfe821f7e /* @ECU_Address@P_VAL_Virtual_SW@ */ Record_UBYTE 0 autosar_swc_val_CM_uint8 0 255 /end CHARACTERISTIC
/begin CHARACTERISTIC P_VAL_Virtual_Sbc_TLF35584 "" VALUE 0xfe821f7f /* @ECU_Address@P_VAL_Virtual_Sbc_TLF35584@ */ Record_UBYTE 0 autosar_swc_val_CM_uint8 0 255 /end CHARACTERISTIC
/begin CHARACTERISTIC P_VAL_Virtual_SerDes_MAX96716 "" VALUE 0xfe821f4c /* @ECU_Address@P_VAL_Virtual_SerDes_MAX96716@ */ Record_UWORD 0 autosar_swc_val_CM_uint16 0 65535 /end CHARACTERISTIC
/begin CHARACTERISTIC P_VAL_Virtual_SerDes_MAX96717_1 "" VALUE 0xfe821f80 /* @ECU_Address@P_VAL_Virtual_SerDes_MAX96717_1@ */ Record_UBYTE 0 autosar_swc_val_CM_uint8 0 255 /end CHARACTERISTIC
/begin CHARACTERISTIC P_VAL_Virtual_SerDes_MAX96717_2 "" VALUE 0xfe821f81 /* @ECU_Address@P_VAL_Virtual_SerDes_MAX96717_2@ */ Record_UBYTE 0 autosar_swc_val_CM_uint8 0 255 /end CHARACTERISTIC
/begin CHARACTERISTIC P_VAL_Virtual_SerDes_MAX96722 "" VALUE 0xfe821f4e /* @ECU_Address@P_VAL_Virtual_SerDes_MAX96722@ */ Record_UWORD 0 autosar_swc_val_CM_uint16 0 65535 /end CHARACTERISTIC
/begin CHARACTERISTIC P_VAL_Virtual_SpeedLimitOnOff "" VALUE 0xfe821f82 /* @ECU_Address@P_VAL_Virtual_SpeedLimitOnOff@ */ Record_UBYTE 0 autosar_swc_val_CM_uint8 0 255 /end CHARACTERISTIC
/begin CHARACTERISTIC P_VAL_Virtual_SpeedLmtNmverAbs "" VALUE 0xfe821f83 /* @ECU_Address@P_VAL_Virtual_SpeedLmtNmverAbs@ */ Record_SBYTE 0 autosar_swc_val_CM_int8 -128 127 /end CHARACTERISTIC
/begin CHARACTERISTIC P_VAL_Virtual_SpeedLmtNmverPerct "" VALUE 0xfe821f84 /* @ECU_Address@P_VAL_Virtual_SpeedLmtNmverPerct@ */ Record_SBYTE 0 autosar_swc_val_CM_int8 -128 127 /end CHARACTERISTIC
/begin CHARACTERISTIC P_VAL_Virtual_SpeedLmtSnvtyModSts "" VALUE 0xfe821f85 /* @ECU_Address@P_VAL_Virtual_SpeedLmtSnvtyModSts@ */ Record_UBYTE 0 autosar_swc_val_CM_uint8 0 255 /end CHARACTERISTIC
/begin CHARACTERISTIC P_VAL_Virtual_TJAICAExitTextInfoONOFF "" VALUE 0xfe821f86 /* @ECU_Address@P_VAL_Virtual_TJAICAExitTextInfoONOFF@ */ Record_UBYTE 0 autosar_swc_val_CM_uint8 0 255 /end CHARACTERISTIC
/begin CHARACTERISTIC P_VAL_Virtual_TLIOnOffSts "" VALUE 0xfe821f87 /* @ECU_Address@P_VAL_Virtual_TLIOnOffSts@ */ Record_UBYTE 0 autosar_swc_val_CM_uint8 0 255 /end CHARACTERISTIC
/begin CHARACTERISTIC P_VAL_Virtual_TSRONOFFSts "" VALUE 0xfe821f88 /* @ECU_Address@P_VAL_Virtual_TSRONOFFSts@ */ Record_UBYTE 0 autosar_swc_val_CM_uint8 0 255 /end CHARACTERISTIC
/begin CHARACTERISTIC P_VAL_Virtual_VoiceRemindType "" VALUE 0xfe821f89 /* @ECU_Address@P_VAL_Virtual_VoiceRemindType@ */ Record_UBYTE 0 autosar_swc_val_CM_uint8 0 255 /end CHARACTERISTIC
/begin CHARACTERISTIC ZDrive_BSW_Cal_Cal.ZDrive_BSW_Cal_PlatformParameterTable.ADAS_Def_Byte0 "" VALUE 0x3d8040 /* @ECU_Address@ZDrive_BSW_Cal_Cal.ZDrive_BSW_Cal_PlatformParameterTable.ADAS_Def_Byte0@ */ Record_UBYTE 0 autosar_swc_val_CM_uint8 0 255 /end CHARACTERISTIC
/begin CHARACTERISTIC ZDrive_BSW_Cal_Cal.ZDrive_BSW_Cal_PlatformParameterTable.ADAS_Def_Byte1 "" VALUE 0x3d8041 /* @ECU_Address@ZDrive_BSW_Cal_Cal.ZDrive_BSW_Cal_PlatformParameterTable.ADAS_Def_Byte1@ */ Record_UBYTE 0 autosar_swc_val_CM_uint8 0 255 /end CHARACTERISTIC
/begin CHARACTERISTIC ZDrive_BSW_Cal_Cal.ZDrive_BSW_Cal_PlatformParameterTable.Feature_Cfg_Byte0 "" VALUE 0x3d8047 /* @ECU_Address@ZDrive_BSW_Cal_Cal.ZDrive_BSW_Cal_PlatformParameterTable.Feature_Cfg_Byte0@ */ Record_UBYTE 0 autosar_swc_val_CM_uint8 0 255 /end CHARACTERISTIC
/begin CHARACTERISTIC ZDrive_BSW_Cal_Cal.ZDrive_BSW_Cal_PlatformParameterTable.Feature_Cfg_Byte1 "" VALUE 0x3d8048 /* @ECU_Address@ZDrive_BSW_Cal_Cal.ZDrive_BSW_Cal_PlatformParameterTable.Feature_Cfg_Byte1@ */ Record_UBYTE 0 autosar_swc_val_CM_uint8 0 255 /end CHARACTERISTIC
/begin CHARACTERISTIC ZDrive_BSW_Cal_Cal.ZDrive_BSW_Cal_PlatformParameterTable.Feature_Cfg_Byte2 "" VALUE 0x3d8049 /* @ECU_Address@ZDrive_BSW_Cal_Cal.ZDrive_BSW_Cal_PlatformParameterTable.Feature_Cfg_Byte2@ */ Record_UBYTE 0 autosar_swc_val_CM_uint8 0 255 /end CHARACTERISTIC
/begin CHARACTERISTIC ZDrive_BSW_Cal_Cal.ZDrive_BSW_Cal_PlatformParameterTable.Feature_Cfg_Byte3 "" VALUE 0x3d804a /* @ECU_Address@ZDrive_BSW_Cal_Cal.ZDrive_BSW_Cal_PlatformParameterTable.Feature_Cfg_Byte3@ */ Record_UBYTE 0 autosar_swc_val_CM_uint8 0 255 /end CHARACTERISTIC
/begin CHARACTERISTIC ZDrive_BSW_Cal_Cal.ZDrive_BSW_Cal_PlatformParameterTable.Feature_Cfg_Byte4 "" VALUE 0x3d804b /* @ECU_Address@ZDrive_BSW_Cal_Cal.ZDrive_BSW_Cal_PlatformParameterTable.Feature_Cfg_Byte4@ */ Record_UBYTE 0 autosar_swc_val_CM_uint8 0 255 /end CHARACTERISTIC
/begin CHARACTERISTIC ZDrive_BSW_Cal_Cal.ZDrive_BSW_Cal_PlatformParameterTable.Feature_Enable_Byte0 "" VALUE 0x3d8042 /* @ECU_Address@ZDrive_BSW_Cal_Cal.ZDrive_BSW_Cal_PlatformParameterTable.Feature_Enable_Byte0@ */ Record_UBYTE 0 autosar_swc_val_CM_uint8 0 255 /end CHARACTERISTIC
/begin CHARACTERISTIC ZDrive_BSW_Cal_Cal.ZDrive_BSW_Cal_PlatformParameterTable.Feature_Enable_Byte1 "" VALUE 0x3d8043 /* @ECU_Address@ZDrive_BSW_Cal_Cal.ZDrive_BSW_Cal_PlatformParameterTable.Feature_Enable_Byte1@ */ Record_UBYTE 0 autosar_swc_val_CM_uint8 0 255 /end CHARACTERISTIC
/begin CHARACTERISTIC ZDrive_BSW_Cal_Cal.ZDrive_BSW_Cal_PlatformParameterTable.Feature_Enable_Byte2 "" VALUE 0x3d8044 /* @ECU_Address@ZDrive_BSW_Cal_Cal.ZDrive_BSW_Cal_PlatformParameterTable.Feature_Enable_Byte2@ */ Record_UBYTE 0 autosar_swc_val_CM_uint8 0 255 /end CHARACTERISTIC
/begin CHARACTERISTIC ZDrive_BSW_Cal_Cal.ZDrive_BSW_Cal_PlatformParameterTable.Feature_Enable_Byte3 "" VALUE 0x3d8045 /* @ECU_Address@ZDrive_BSW_Cal_Cal.ZDrive_BSW_Cal_PlatformParameterTable.Feature_Enable_Byte3@ */ Record_UBYTE 0 autosar_swc_val_CM_uint8 0 255 /end CHARACTERISTIC
/begin CHARACTERISTIC ZDrive_BSW_Cal_Cal.ZDrive_BSW_Cal_PlatformParameterTable.Feature_Enable_Byte4 "" VALUE 0x3d8046 /* @ECU_Address@ZDrive_BSW_Cal_Cal.ZDrive_BSW_Cal_PlatformParameterTable.Feature_Enable_Byte4@ */ Record_UBYTE 0 autosar_swc_val_CM_uint8 0 255 /end CHARACTERISTIC
/begin CHARACTERISTIC ZDrive_BSW_Cal_Cal.ZDrive_BSW_Cal_PlatformParameterTable.Feature_Switch_Cfg_Byte0 "" VALUE 0x3d804c /* @ECU_Address@ZDrive_BSW_Cal_Cal.ZDrive_BSW_Cal_PlatformParameterTable.Feature_Switch_Cfg_Byte0@ */ Record_UBYTE 0 autosar_swc_val_CM_uint8 0 255 /end CHARACTERISTIC
/begin CHARACTERISTIC ZDrive_BSW_Cal_Cal.ZDrive_BSW_Cal_PlatformParameterTable.Feature_Switch_Cfg_Byte1 "" VALUE 0x3d804d /* @ECU_Address@ZDrive_BSW_Cal_Cal.ZDrive_BSW_Cal_PlatformParameterTable.Feature_Switch_Cfg_Byte1@ */ Record_UBYTE 0 autosar_swc_val_CM_uint8 0 255 /end CHARACTERISTIC
/begin CHARACTERISTIC ZDrive_BSW_Cal_Cal.ZDrive_BSW_Cal_PlatformParameterTable.Feature_Switch_Cfg_Byte10 "" VALUE 0x3d8056 /* @ECU_Address@ZDrive_BSW_Cal_Cal.ZDrive_BSW_Cal_PlatformParameterTable.Feature_Switch_Cfg_Byte10@ */ Record_UBYTE 0 autosar_swc_val_CM_uint8 0 255 /end CHARACTERISTIC
/begin CHARACTERISTIC ZDrive_BSW_Cal_Cal.ZDrive_BSW_Cal_PlatformParameterTable.Feature_Switch_Cfg_Byte2 "" VALUE 0x3d804e /* @ECU_Address@ZDrive_BSW_Cal_Cal.ZDrive_BSW_Cal_PlatformParameterTable.Feature_Switch_Cfg_Byte2@ */ Record_UBYTE 0 autosar_swc_val_CM_uint8 0 255 /end CHARACTERISTIC
/begin CHARACTERISTIC ZDrive_BSW_Cal_Cal.ZDrive_BSW_Cal_PlatformParameterTable.Feature_Switch_Cfg_Byte3 "" VALUE 0x3d804f /* @ECU_Address@ZDrive_BSW_Cal_Cal.ZDrive_BSW_Cal_PlatformParameterTable.Feature_Switch_Cfg_Byte3@ */ Record_UBYTE 0 autosar_swc_val_CM_uint8 0 255 /end CHARACTERISTIC
/begin CHARACTERISTIC ZDrive_BSW_Cal_Cal.ZDrive_BSW_Cal_PlatformParameterTable.Feature_Switch_Cfg_Byte4 "" VALUE 0x3d8050 /* @ECU_Address@ZDrive_BSW_Cal_Cal.ZDrive_BSW_Cal_PlatformParameterTable.Feature_Switch_Cfg_Byte4@ */ Record_UBYTE 0 autosar_swc_val_CM_uint8 0 255 /end CHARACTERISTIC
/begin CHARACTERISTIC ZDrive_BSW_Cal_Cal.ZDrive_BSW_Cal_PlatformParameterTable.Feature_Switch_Cfg_Byte5 "" VALUE 0x3d8051 /* @ECU_Address@ZDrive_BSW_Cal_Cal.ZDrive_BSW_Cal_PlatformParameterTable.Feature_Switch_Cfg_Byte5@ */ Record_UBYTE 0 autosar_swc_val_CM_uint8 0 255 /end CHARACTERISTIC
/begin CHARACTERISTIC ZDrive_BSW_Cal_Cal.ZDrive_BSW_Cal_PlatformParameterTable.Feature_Switch_Cfg_Byte6 "" VALUE 0x3d8052 /* @ECU_Address@ZDrive_BSW_Cal_Cal.ZDrive_BSW_Cal_PlatformParameterTable.Feature_Switch_Cfg_Byte6@ */ Record_UBYTE 0 autosar_swc_val_CM_uint8 0 255 /end CHARACTERISTIC
/begin CHARACTERISTIC ZDrive_BSW_Cal_Cal.ZDrive_BSW_Cal_PlatformParameterTable.Feature_Switch_Cfg_Byte7 "" VALUE 0x3d8053 /* @ECU_Address@ZDrive_BSW_Cal_Cal.ZDrive_BSW_Cal_PlatformParameterTable.Feature_Switch_Cfg_Byte7@ */ Record_UBYTE 0 autosar_swc_val_CM_uint8 0 255 /end CHARACTERISTIC
/begin CHARACTERISTIC ZDrive_BSW_Cal_Cal.ZDrive_BSW_Cal_PlatformParameterTable.Feature_Switch_Cfg_Byte8 "" VALUE 0x3d8054 /* @ECU_Address@ZDrive_BSW_Cal_Cal.ZDrive_BSW_Cal_PlatformParameterTable.Feature_Switch_Cfg_Byte8@ */ Record_UBYTE 0 autosar_swc_val_CM_uint8 0 255 /end CHARACTERISTIC
/begin CHARACTERISTIC ZDrive_BSW_Cal_Cal.ZDrive_BSW_Cal_PlatformParameterTable.Feature_Switch_Cfg_Byte9 "" VALUE 0x3d8055 /* @ECU_Address@ZDrive_BSW_Cal_Cal.ZDrive_BSW_Cal_PlatformParameterTable.Feature_Switch_Cfg_Byte9@ */ Record_UBYTE 0 autosar_swc_val_CM_uint8 0 255 /end CHARACTERISTIC
/begin CHARACTERISTIC ZDrive_BSW_Cal_Cal.ZDrive_BSW_Cal_PlatformParameterTable.Feature_Switch_Init_Cfg_Byte0 "" VALUE 0x3d8057 /* @ECU_Address@ZDrive_BSW_Cal_Cal.ZDrive_BSW_Cal_PlatformParameterTable.Feature_Switch_Init_Cfg_Byte0@ */ Record_UBYTE 0 autosar_swc_val_CM_uint8 0 255 /end CHARACTERISTIC
/begin CHARACTERISTIC ZDrive_BSW_Cal_Cal.ZDrive_BSW_Cal_PlatformParameterTable.Feature_Switch_Init_Cfg_Byte1 "" VALUE 0x3d8058 /* @ECU_Address@ZDrive_BSW_Cal_Cal.ZDrive_BSW_Cal_PlatformParameterTable.Feature_Switch_Init_Cfg_Byte1@ */ Record_UBYTE 0 autosar_swc_val_CM_uint8 0 255 /end CHARACTERISTIC
/begin CHARACTERISTIC ZDrive_BSW_Cal_Cal.ZDrive_BSW_Cal_PlatformParameterTable.Feature_Switch_Init_Cfg_Byte2 "" VALUE 0x3d8059 /* @ECU_Address@ZDrive_BSW_Cal_Cal.ZDrive_BSW_Cal_PlatformParameterTable.Feature_Switch_Init_Cfg_Byte2@ */ Record_UBYTE 0 autosar_swc_val_CM_uint8 0 255 /end CHARACTERISTIC
/begin CHARACTERISTIC ZDrive_BSW_Cal_Cal.ZDrive_BSW_Cal_PlatformParameterTable.Feature_Switch_Init_Cfg_Byte3 "" VALUE 0x3d805a /* @ECU_Address@ZDrive_BSW_Cal_Cal.ZDrive_BSW_Cal_PlatformParameterTable.Feature_Switch_Init_Cfg_Byte3@ */ Record_UBYTE 0 autosar_swc_val_CM_uint8 0 255 /end CHARACTERISTIC
/begin CHARACTERISTIC ZDrive_BSW_Cal_Cal.ZDrive_BSW_Cal_PlatformParameterTable.Feature_Switch_Init_Cfg_Byte4 "" VALUE 0x3d805b /* @ECU_Address@ZDrive_BSW_Cal_Cal.ZDrive_BSW_Cal_PlatformParameterTable.Feature_Switch_Init_Cfg_Byte4@ */ Record_UBYTE 0 autosar_swc_val_CM_uint8 0 255 /end CHARACTERISTIC
/begin CHARACTERISTIC ZDrive_BSW_Cal_Cal.ZDrive_BSW_Cal_PlatformParameterTable.PlatformParameter_CRC_Byte_0 "" VALUE 0x3d805c /* @ECU_Address@ZDrive_BSW_Cal_Cal.ZDrive_BSW_Cal_PlatformParameterTable.PlatformParameter_CRC_Byte_0@ */ Record_UBYTE 0 autosar_swc_val_CM_uint8 0 255 /end CHARACTERISTIC
/begin CHARACTERISTIC ZDrive_BSW_Cal_Cal.ZDrive_BSW_Cal_PlatformParameterTable.PlatformParameter_CRC_Byte_1 "" VALUE 0x3d805d /* @ECU_Address@ZDrive_BSW_Cal_Cal.ZDrive_BSW_Cal_PlatformParameterTable.PlatformParameter_CRC_Byte_1@ */ Record_UBYTE 0 autosar_swc_val_CM_uint8 0 255 /end CHARACTERISTIC
/begin CHARACTERISTIC ZDrive_BSW_Cal_Cal.ZDrive_BSW_Cal_PlatformParameterTable.PlatformParameter_CRC_Byte_2 "" VALUE 0x3d805e /* @ECU_Address@ZDrive_BSW_Cal_Cal.ZDrive_BSW_Cal_PlatformParameterTable.PlatformParameter_CRC_Byte_2@ */ Record_UBYTE 0 autosar_swc_val_CM_uint8 0 255 /end CHARACTERISTIC
/begin CHARACTERISTIC ZDrive_BSW_Cal_Cal.ZDrive_BSW_Cal_PlatformParameterTable.PlatformParameter_CRC_Byte_3 "" VALUE 0x3d805f /* @ECU_Address@ZDrive_BSW_Cal_Cal.ZDrive_BSW_Cal_PlatformParameterTable.PlatformParameter_CRC_Byte_3@ */ Record_UBYTE 0 autosar_swc_val_CM_uint8 0 255 /end CHARACTERISTIC
/begin CHARACTERISTIC ZDrive_BSW_Cal_Cal.ZDrive_BSW_Cal_VehicleInfomationTable.ADAS_DVR_Type "" VALUE 0x3d807d /* @ECU_Address@ZDrive_BSW_Cal_Cal.ZDrive_BSW_Cal_VehicleInfomationTable.ADAS_DVR_Type@ */ Record_UBYTE 0 autosar_swc_val_CM_uint8 0 255 /end CHARACTERISTIC
/begin CHARACTERISTIC ZDrive_BSW_Cal_Cal.ZDrive_BSW_Cal_VehicleInfomationTable.ADSA_APA_Switch_Source "" VALUE 0x3d807c /* @ECU_Address@ZDrive_BSW_Cal_Cal.ZDrive_BSW_Cal_VehicleInfomationTable.ADSA_APA_Switch_Source@ */ Record_UBYTE 0 autosar_swc_val_CM_uint8 0 255 /end CHARACTERISTIC
/begin MEASUREMENT SwcIn_TOP_FuncStatus "" UBYTE autosar_swc_val_CM_uint8 0 0 0 255 ECU_ADDRESS 0xfe4cbc72 /* @ECU_Address@SwcIn_TOP_FuncStatus@ */ /end MEASUREMENT
/begin MEASUREMENT SwcIn_VAL_MemSet_ACCStsInit "" UBYTE autosar_swc_val_CM_uint8 0 0 0 255 ECU_ADDRESS 0xfe4cbc73 /* @ECU_Address@SwcIn_VAL_MemSet_ACCStsInit@ */ /end MEASUREMENT
/begin MEASUREMENT SwcIn_VAL_MemSet_ICASStsInit "" UBYTE autosar_swc_val_CM_uint8 0 0 0 255 ECU_ADDRESS 0xfe4cbc74 /* @ECU_Address@SwcIn_VAL_MemSet_ICASStsInit@ */ /end MEASUREMENT
/begin MEASUREMENT SwcIn_VAL_MemSet_SteerAngOffsetInit "" FLOAT32_IEEE autosar_swc_val_CM_single 0 0 -3.4E+38 3.4E+38 ECU_ADDRESS 0xfe4cb948 /* @ECU_Address@SwcIn_VAL_MemSet_SteerAngOffsetInit@ */ /end MEASUREMENT
/begin MEASUREMENT SwcIn_VAL_MemSet_TimeGapInit "" UBYTE autosar_swc_val_CM_uint8 0 0 0 255 ECU_ADDRESS 0xfe4cbc75 /* @ECU_Address@SwcIn_VAL_MemSet_TimeGapInit@ */ /end MEASUREMENT
/begin MEASUREMENT SwcOut_Enable_SafSignal "" UBYTE autosar_swc_val_CM_uint8 0 0 0 255 ECU_ADDRESS 0xfe4cbc9a /* @ECU_Address@SwcOut_Enable_SafSignal@ */ /end MEASUREMENT
/begin MEASUREMENT SwcOut_Fusa_EPB_R_1_CRC2_Error "" UBYTE autosar_swc_val_CM_boolean 0 0 0 1 ECU_ADDRESS 0xfe4cbcb8 /* @ECU_Address@SwcOut_Fusa_EPB_R_1_CRC2_Error@ */ /end MEASUREMENT
/begin MEASUREMENT SwcOut_Fusa_EPB_R_1_RollgCntr2_Error "" UBYTE autosar_swc_val_CM_boolean 0 0 0 1 ECU_ADDRESS 0xfe4cbcb9 /* @ECU_Address@SwcOut_Fusa_EPB_R_1_RollgCntr2_Error@ */ /end MEASUREMENT
/begin MEASUREMENT SwcOut_TEMP_FusaEnable "" UBYTE autosar_swc_val_CM_boolean 0 0 0 1 ECU_ADDRESS 0xfe4cbcba /* @ECU_Address@SwcOut_TEMP_FusaEnable@ */ /end MEASUREMENT
/begin MEASUREMENT SwcOut_VAL_DRIVER_SWITCH.AEBOnOff "" UBYTE autosar_swc_val_CM_boolean 0 0 0 1 ECU_ADDRESS 0xfe4ca72b /* @ECU_Address@SwcOut_VAL_DRIVER_SWITCH.AEBOnOff@ */ /end MEASUREMENT
/begin MEASUREMENT SwcOut_VAL_DRIVER_SWITCH.AESOnOff "" UBYTE autosar_swc_val_CM_boolean 0 0 0 1 ECU_ADDRESS 0xfe4ca726 /* @ECU_Address@SwcOut_VAL_DRIVER_SWITCH.AESOnOff@ */ /end MEASUREMENT
/begin MEASUREMENT SwcOut_VAL_DRIVER_SWITCH.ALCSet "" UBYTE autosar_swc_val_CM_uint8 0 0 0 255 ECU_ADDRESS 0xfe4ca738 /* @ECU_Address@SwcOut_VAL_DRIVER_SWITCH.ALCSet@ */ /end MEASUREMENT
/begin MEASUREMENT SwcOut_VAL_DRIVER_SWITCH.ALCSnvtySet "" UBYTE autosar_swc_val_CM_uint8 0 0 0 255 ECU_ADDRESS 0xfe4ca73a /* @ECU_Address@SwcOut_VAL_DRIVER_SWITCH.ALCSnvtySet@ */ /end MEASUREMENT
/begin MEASUREMENT SwcOut_VAL_DRIVER_SWITCH.DAIOnOff "" UBYTE autosar_swc_val_CM_boolean 0 0 0 1 ECU_ADDRESS 0xfe4ca72c /* @ECU_Address@SwcOut_VAL_DRIVER_SWITCH.DAIOnOff@ */ /end MEASUREMENT
/begin MEASUREMENT SwcOut_VAL_DRIVER_SWITCH.DCLCSet "" UBYTE autosar_swc_val_CM_uint8 0 0 0 255 ECU_ADDRESS 0xfe4ca739 /* @ECU_Address@SwcOut_VAL_DRIVER_SWITCH.DCLCSet@ */ /end MEASUREMENT
/begin MEASUREMENT SwcOut_VAL_DRIVER_SWITCH.ELKOnOff "" UBYTE autosar_swc_val_CM_boolean 0 0 0 1 ECU_ADDRESS 0xfe4ca724 /* @ECU_Address@SwcOut_VAL_DRIVER_SWITCH.ELKOnOff@ */ /end MEASUREMENT
/begin MEASUREMENT SwcOut_VAL_DRIVER_SWITCH.ESSOnOff "" UBYTE autosar_swc_val_CM_boolean 0 0 0 1 ECU_ADDRESS 0xfe4ca725 /* @ECU_Address@SwcOut_VAL_DRIVER_SWITCH.ESSOnOff@ */ /end MEASUREMENT
/begin MEASUREMENT SwcOut_VAL_DRIVER_SWITCH.FCWOnOff "" UBYTE autosar_swc_val_CM_boolean 0 0 0 1 ECU_ADDRESS 0xfe4ca72a /* @ECU_Address@SwcOut_VAL_DRIVER_SWITCH.FCWOnOff@ */ /end MEASUREMENT
/begin MEASUREMENT SwcOut_VAL_DRIVER_SWITCH.FCWSnvty "" UBYTE autosar_swc_val_CM_uint8 0 0 0 255 ECU_ADDRESS 0xfe4ca73b /* @ECU_Address@SwcOut_VAL_DRIVER_SWITCH.FCWSnvty@ */ /end MEASUREMENT
/begin MEASUREMENT SwcOut_VAL_DRIVER_SWITCH.ICAOnOff "" UBYTE autosar_swc_val_CM_uint8 0 0 0 255 ECU_ADDRESS 0xfe4ca731 /* @ECU_Address@SwcOut_VAL_DRIVER_SWITCH.ICAOnOff@ */ /end MEASUREMENT
/begin MEASUREMENT SwcOut_VAL_DRIVER_SWITCH.IHCOnOff "" UBYTE autosar_swc_val_CM_uint8 0 0 0 255 ECU_ADDRESS 0xfe4ca730 /* @ECU_Address@SwcOut_VAL_DRIVER_SWITCH.IHCOnOff@ */ /end MEASUREMENT
/begin MEASUREMENT SwcOut_VAL_DRIVER_SWITCH.ISLOnOff "" UBYTE autosar_swc_val_CM_boolean 0 0 0 1 ECU_ADDRESS 0xfe4ca728 /* @ECU_Address@SwcOut_VAL_DRIVER_SWITCH.ISLOnOff@ */ /end MEASUREMENT
/begin MEASUREMENT SwcOut_VAL_DRIVER_SWITCH.IntellgntCurveOnOff "" UBYTE autosar_swc_val_CM_boolean 0 0 0 1 ECU_ADDRESS 0xfe4ca729 /* @ECU_Address@SwcOut_VAL_DRIVER_SWITCH.IntellgntCurveOnOff@ */ /end MEASUREMENT
/begin MEASUREMENT SwcOut_VAL_DRIVER_SWITCH.LASSnvtySet "" UBYTE autosar_swc_val_CM_uint8 0 0 0 255 ECU_ADDRESS 0xfe4ca734 /* @ECU_Address@SwcOut_VAL_DRIVER_SWITCH.LASSnvtySet@ */ /end MEASUREMENT
/begin MEASUREMENT SwcOut_VAL_DRIVER_SWITCH.LASWarnFormSwtReq "" UBYTE autosar_swc_val_CM_uint8 0 0 0 255 ECU_ADDRESS 0xfe4ca735 /* @ECU_Address@SwcOut_VAL_DRIVER_SWITCH.LASWarnFormSwtReq@ */ /end MEASUREMENT
/begin MEASUREMENT SwcOut_VAL_DRIVER_SWITCH.LCKIEOnOff "" UBYTE autosar_swc_val_CM_boolean 0 0 0 1 ECU_ADDRESS 0xfe4ca727 /* @ECU_Address@SwcOut_VAL_DRIVER_SWITCH.LCKIEOnOff@ */ /end MEASUREMENT
/begin MEASUREMENT SwcOut_VAL_DRIVER_SWITCH.LDWOnOff "" UBYTE autosar_swc_val_CM_boolean 0 0 0 1 ECU_ADDRESS 0xfe4ca722 /* @ECU_Address@SwcOut_VAL_DRIVER_SWITCH.LDWOnOff@ */ /end MEASUREMENT
/begin MEASUREMENT SwcOut_VAL_DRIVER_SWITCH.LKAOnOff "" UBYTE autosar_swc_val_CM_boolean 0 0 0 1 ECU_ADDRESS 0xfe4ca723 /* @ECU_Address@SwcOut_VAL_DRIVER_SWITCH.LKAOnOff@ */ /end MEASUREMENT
/begin MEASUREMENT SwcOut_VAL_DRIVER_SWITCH.NOHActReq "" UBYTE autosar_swc_val_CM_boolean 0 0 0 1 ECU_ADDRESS 0xfe4ca721 /* @ECU_Address@SwcOut_VAL_DRIVER_SWITCH.NOHActReq@ */ /end MEASUREMENT
/begin MEASUREMENT SwcOut_VAL_DRIVER_SWITCH.NOHOnOff "" UBYTE autosar_swc_val_CM_boolean 0 0 0 1 ECU_ADDRESS 0xfe4ca720 /* @ECU_Address@SwcOut_VAL_DRIVER_SWITCH.NOHOnOff@ */ /end MEASUREMENT
/begin MEASUREMENT SwcOut_VAL_DRIVER_SWITCH.SLAOnOff "" UBYTE autosar_swc_val_CM_uint8 0 0 0 255 ECU_ADDRESS 0xfe4ca732 /* @ECU_Address@SwcOut_VAL_DRIVER_SWITCH.SLAOnOff@ */ /end MEASUREMENT
/begin MEASUREMENT SwcOut_VAL_DRIVER_SWITCH.SLAWarnMod "" UBYTE autosar_swc_val_CM_uint8 0 0 0 255 ECU_ADDRESS 0xfe4ca733 /* @ECU_Address@SwcOut_VAL_DRIVER_SWITCH.SLAWarnMod@ */ /end MEASUREMENT
/begin MEASUREMENT SwcOut_VAL_DRIVER_SWITCH.SpeedLimitOnOff "" UBYTE autosar_swc_val_CM_uint8 0 0 0 255 ECU_ADDRESS 0xfe4ca73e /* @ECU_Address@SwcOut_VAL_DRIVER_SWITCH.SpeedLimitOnOff@ */ /end MEASUREMENT
/begin MEASUREMENT SwcOut_VAL_DRIVER_SWITCH.SpeedLmtNumberAbs "" SBYTE autosar_swc_val_CM_int8 0 0 -128 127 ECU_ADDRESS 0xfe4ca72d /* @ECU_Address@SwcOut_VAL_DRIVER_SWITCH.SpeedLmtNumberAbs@ */ /end MEASUREMENT
/begin MEASUREMENT SwcOut_VAL_DRIVER_SWITCH.SpeedLmtNumberPerct "" SBYTE autosar_swc_val_CM_int8 0 0 -128 127 ECU_ADDRESS 0xfe4ca72e /* @ECU_Address@SwcOut_VAL_DRIVER_SWITCH.SpeedLmtNumberPerct@ */ /end MEASUREMENT
/begin MEASUREMENT SwcOut_VAL_DRIVER_SWITCH.SpeedLmtSnvtyMod "" UBYTE autosar_swc_val_CM_uint8 0 0 0 255 ECU_ADDRESS 0xfe4ca72f /* @ECU_Address@SwcOut_VAL_DRIVER_SWITCH.SpeedLmtSnvtyMod@ */ /end MEASUREMENT
/begin MEASUREMENT SwcOut_VAL_DRIVER_SWITCH.TJAICAExitTextInfoONOFF "" UBYTE autosar_swc_val_CM_uint8 0 0 0 255 ECU_ADDRESS 0xfe4ca73d /* @ECU_Address@SwcOut_VAL_DRIVER_SWITCH.TJAICAExitTextInfoONOFF@ */ /end MEASUREMENT
/begin MEASUREMENT SwcOut_VAL_DRIVER_SWITCH.TLIOnOff "" UBYTE autosar_swc_val_CM_uint8 0 0 0 255 ECU_ADDRESS 0xfe4ca737 /* @ECU_Address@SwcOut_VAL_DRIVER_SWITCH.TLIOnOff@ */ /end MEASUREMENT
/begin MEASUREMENT SwcOut_VAL_DRIVER_SWITCH.TSROnOff "" UBYTE autosar_swc_val_CM_uint8 0 0 0 255 ECU_ADDRESS 0xfe4ca736 /* @ECU_Address@SwcOut_VAL_DRIVER_SWITCH.TSROnOff@ */ /end MEASUREMENT
/begin MEASUREMENT SwcOut_VAL_DRIVER_SWITCH.TimeStampMs "" A_UINT64 autosar_swc_val_CM_uint64 0 0 0.0 1.844674407370955e+19 ECU_ADDRESS 0xfe4ca740 /* @ECU_Address@SwcOut_VAL_DRIVER_SWITCH.TimeStampMs@ */ /end MEASUREMENT
/begin MEASUREMENT SwcOut_VAL_DRIVER_SWITCH.VoiceRemindType "" UBYTE autosar_swc_val_CM_uint8 0 0 0 255 ECU_ADDRESS 0xfe4ca73c /* @ECU_Address@SwcOut_VAL_DRIVER_SWITCH.VoiceRemindType@ */ /end MEASUREMENT
/begin MEASUREMENT SwcOut_VAL_ENV.DayTime "" UBYTE autosar_swc_val_CM_uint8 0 0 0 255 ECU_ADDRESS 0xfe4ca748 /* @ECU_Address@SwcOut_VAL_ENV.DayTime@ */ /end MEASUREMENT
/begin MEASUREMENT SwcOut_VAL_ENV.TimeStampMs "" A_UINT64 autosar_swc_val_CM_uint64 0 0 0.0 1.844674407370955e+19 ECU_ADDRESS 0xfe4ca750 /* @ECU_Address@SwcOut_VAL_ENV.TimeStampMs@ */ /end MEASUREMENT
/begin MEASUREMENT SwcOut_VAL_ENV.Weather "" UBYTE autosar_swc_val_CM_uint8 0 0 0 255 ECU_ADDRESS 0xfe4ca749 /* @ECU_Address@SwcOut_VAL_ENV.Weather@ */ /end MEASUREMENT
/begin MEASUREMENT SwcOut_VAL_Herbeat_Info.inner_error "" ULONG autosar_swc_val_CM_uint32 0 0 0 4294967295 ECU_ADDRESS 0xfe4cba44 /* @ECU_Address@SwcOut_VAL_Herbeat_Info.inner_error@ */ /end MEASUREMENT
/begin MEASUREMENT SwcOut_VAL_Herbeat_Info.module_status "" UBYTE autosar_swc_val_CM_SM_MODULE_STATUS 0 0 0 3 ECU_ADDRESS 0xfe4cba48 /* @ECU_Address@SwcOut_VAL_Herbeat_Info.module_status@ */ /end MEASUREMENT
/begin MEASUREMENT SwcOut_VAL_Herbeat_Info.sequence_num "" UBYTE autosar_swc_val_CM_uint8 0 0 0 255 ECU_ADDRESS 0xfe4cba41 /* @ECU_Address@SwcOut_VAL_Herbeat_Info.sequence_num@ */ /end MEASUREMENT
/begin MEASUREMENT SwcOut_VAL_Herbeat_Info.swc_id "" UBYTE autosar_swc_val_CM_uint8 0 0 0 255 ECU_ADDRESS 0xfe4cba40 /* @ECU_Address@SwcOut_VAL_Herbeat_Info.swc_id@ */ /end MEASUREMENT
/begin MEASUREMENT SwcOut_VAL_ICC_NAV.country_region_code "" UWORD autosar_swc_val_CM_uint16 0 0 0 65535 ECU_ADDRESS 0xfe4cba56 /* @ECU_Address@SwcOut_VAL_ICC_NAV.country_region_code@ */ /end MEASUREMENT
/begin MEASUREMENT SwcOut_VAL_ICC_NAV.curr_road_type "" UBYTE autosar_swc_val_CM_uint8 0 0 0 255 ECU_ADDRESS 0xfe4cba4d /* @ECU_Address@SwcOut_VAL_ICC_NAV.curr_road_type@ */ /end MEASUREMENT
/begin MEASUREMENT SwcOut_VAL_ICC_NAV.elec_eye_dist "" UWORD autosar_swc_val_CM_uint16 0 0 0 65535 ECU_ADDRESS 0xfe4cba54 /* @ECU_Address@SwcOut_VAL_ICC_NAV.elec_eye_dist@ */ /end MEASUREMENT
/begin MEASUREMENT SwcOut_VAL_ICC_NAV.elec_eye_spl_value "" UBYTE autosar_swc_val_CM_uint8 0 0 0 255 ECU_ADDRESS 0xfe4cba4f /* @ECU_Address@SwcOut_VAL_ICC_NAV.elec_eye_spl_value@ */ /end MEASUREMENT
/begin MEASUREMENT SwcOut_VAL_ICC_NAV.nav_status "" UBYTE autosar_swc_val_CM_uint8 0 0 0 255 ECU_ADDRESS 0xfe4cba4c /* @ECU_Address@SwcOut_VAL_ICC_NAV.nav_status@ */ /end MEASUREMENT
/begin MEASUREMENT SwcOut_VAL_ICC_NAV.road_spl_dist "" UWORD autosar_swc_val_CM_uint16 0 0 0 65535 ECU_ADDRESS 0xfe4cba52 /* @ECU_Address@SwcOut_VAL_ICC_NAV.road_spl_dist@ */ /end MEASUREMENT
/begin MEASUREMENT SwcOut_VAL_ICC_NAV.road_spl_value "" UBYTE autosar_swc_val_CM_uint8 0 0 0 255 ECU_ADDRESS 0xfe4cba4e /* @ECU_Address@SwcOut_VAL_ICC_NAV.road_spl_value@ */ /end MEASUREMENT
/begin MEASUREMENT SwcOut_VAL_ICC_NAV.spl_unit "" UBYTE autosar_swc_val_CM_uint8 0 0 0 255 ECU_ADDRESS 0xfe4cba50 /* @ECU_Address@SwcOut_VAL_ICC_NAV.spl_unit@ */ /end MEASUREMENT
/begin MEASUREMENT SwcOut_VAL_SAF_FUSAIN.DrvEvlnMonIf.BrkDrvOvrd "" UBYTE autosar_swc_val_CM_boolean 0 0 0 1 ECU_ADDRESS 0xfe4ca758 /* @ECU_Address@SwcOut_VAL_SAF_FUSAIN.DrvEvlnMonIf.BrkDrvOvrd@ */ /end MEASUREMENT
/begin MEASUREMENT SwcOut_VAL_SAF_FUSAIN.DrvEvlnMonIf.DoorStatus "" UBYTE autosar_swc_val_CM_boolean 0 0 0 1 ECU_ADDRESS 0xfe4ca759 /* @ECU_Address@SwcOut_VAL_SAF_FUSAIN.DrvEvlnMonIf.DoorStatus@ */ /end MEASUREMENT
/begin MEASUREMENT SwcOut_VAL_SAF_FUSAIN.DrvEvlnMonIf.HandsOff "" UBYTE autosar_swc_val_CM_boolean 0 0 0 1 ECU_ADDRESS 0xfe4ca75a /* @ECU_Address@SwcOut_VAL_SAF_FUSAIN.DrvEvlnMonIf.HandsOff@ */ /end MEASUREMENT
/begin MEASUREMENT SwcOut_VAL_SAF_FUSAIN.DrvEvlnMonIf.HandsTqE2E "" UBYTE autosar_swc_val_CM_boolean 0 0 0 1 ECU_ADDRESS 0xfe4ca75b /* @ECU_Address@SwcOut_VAL_SAF_FUSAIN.DrvEvlnMonIf.HandsTqE2E@ */ /end MEASUREMENT
/begin MEASUREMENT SwcOut_VAL_SAF_FUSAIN.DrvEvlnMonIf.LCCSts "" UBYTE autosar_swc_val_CM_uint8 0 0 0 255 ECU_ADDRESS 0xfe4ca761 /* @ECU_Address@SwcOut_VAL_SAF_FUSAIN.DrvEvlnMonIf.LCCSts@ */ /end MEASUREMENT
/begin MEASUREMENT SwcOut_VAL_SAF_FUSAIN.DrvEvlnMonIf.SeatBltSts "" UBYTE autosar_swc_val_CM_boolean 0 0 0 1 ECU_ADDRESS 0xfe4ca75c /* @ECU_Address@SwcOut_VAL_SAF_FUSAIN.DrvEvlnMonIf.SeatBltSts@ */ /end MEASUREMENT
/begin MEASUREMENT SwcOut_VAL_SAF_FUSAIN.DrvEvlnMonIf.SeatBltStsVld "" UBYTE autosar_swc_val_CM_boolean 0 0 0 1 ECU_ADDRESS 0xfe4ca75d /* @ECU_Address@SwcOut_VAL_SAF_FUSAIN.DrvEvlnMonIf.SeatBltStsVld@ */ /end MEASUREMENT
/begin MEASUREMENT SwcOut_VAL_SAF_FUSAIN.DrvEvlnMonIf.SteerDrvOvrd "" UBYTE autosar_swc_val_CM_boolean 0 0 0 1 ECU_ADDRESS 0xfe4ca75e /* @ECU_Address@SwcOut_VAL_SAF_FUSAIN.DrvEvlnMonIf.SteerDrvOvrd@ */ /end MEASUREMENT
/begin MEASUREMENT SwcOut_VAL_SAF_FUSAIN.DrvEvlnMonIf.SteerDrvOvrdE2E "" UBYTE autosar_swc_val_CM_boolean 0 0 0 1 ECU_ADDRESS 0xfe4ca75f /* @ECU_Address@SwcOut_VAL_SAF_FUSAIN.DrvEvlnMonIf.SteerDrvOvrdE2E@ */ /end MEASUREMENT
/begin MEASUREMENT SwcOut_VAL_SAF_FUSAIN.DrvEvlnMonIf.SteerDrvOvrdVld "" UBYTE autosar_swc_val_CM_boolean 0 0 0 1 ECU_ADDRESS 0xfe4ca760 /* @ECU_Address@SwcOut_VAL_SAF_FUSAIN.DrvEvlnMonIf.SteerDrvOvrdVld@ */ /end MEASUREMENT
/begin MEASUREMENT SwcOut_VAL_SAF_FUSAIN.OutProcAdprIf.PowerMode "" UBYTE autosar_swc_val_CM_uint8 0 0 0 255 ECU_ADDRESS 0xfe4ca762 /* @ECU_Address@SwcOut_VAL_SAF_FUSAIN.OutProcAdprIf.PowerMode@ */ /end MEASUREMENT
/begin MEASUREMENT SwcOut_VAL_SAF_FUSAIN.RelCptMonIf.AccSwtStsE2E "" UBYTE autosar_swc_val_CM_boolean 0 0 0 1 ECU_ADDRESS 0xfe4ca763 /* @ECU_Address@SwcOut_VAL_SAF_FUSAIN.RelCptMonIf.AccSwtStsE2E@ */ /end MEASUREMENT
/begin MEASUREMENT SwcOut_VAL_SAF_FUSAIN.RelCptMonIf.AccSwtStsVld "" UBYTE autosar_swc_val_CM_boolean 0 0 0 1 ECU_ADDRESS 0xfe4ca764 /* @ECU_Address@SwcOut_VAL_SAF_FUSAIN.RelCptMonIf.AccSwtStsVld@ */ /end MEASUREMENT
/begin MEASUREMENT SwcOut_VAL_SAF_FUSAIN.RelCptMonIf.ActGearE2E "" UBYTE autosar_swc_val_CM_boolean 0 0 0 1 ECU_ADDRESS 0xfe4ca765 /* @ECU_Address@SwcOut_VAL_SAF_FUSAIN.RelCptMonIf.ActGearE2E@ */ /end MEASUREMENT
/begin MEASUREMENT SwcOut_VAL_SAF_FUSAIN.RelCptMonIf.ActGearVld "" UBYTE autosar_swc_val_CM_boolean 0 0 0 1 ECU_ADDRESS 0xfe4ca766 /* @ECU_Address@SwcOut_VAL_SAF_FUSAIN.RelCptMonIf.ActGearVld@ */ /end MEASUREMENT
/begin MEASUREMENT SwcOut_VAL_SAF_FUSAIN.RelCptMonIf.AxE2E "" UBYTE autosar_swc_val_CM_boolean 0 0 0 1 ECU_ADDRESS 0xfe4ca767 /* @ECU_Address@SwcOut_VAL_SAF_FUSAIN.RelCptMonIf.AxE2E@ */ /end MEASUREMENT
/begin MEASUREMENT SwcOut_VAL_SAF_FUSAIN.RelCptMonIf.AxVld "" UBYTE autosar_swc_val_CM_boolean 0 0 0 1 ECU_ADDRESS 0xfe4ca768 /* @ECU_Address@SwcOut_VAL_SAF_FUSAIN.RelCptMonIf.AxVld@ */ /end MEASUREMENT
/begin MEASUREMENT SwcOut_VAL_SAF_FUSAIN.RelCptMonIf.AyE2E "" UBYTE autosar_swc_val_CM_boolean 0 0 0 1 ECU_ADDRESS 0xfe4ca769 /* @ECU_Address@SwcOut_VAL_SAF_FUSAIN.RelCptMonIf.AyE2E@ */ /end MEASUREMENT
/begin MEASUREMENT SwcOut_VAL_SAF_FUSAIN.RelCptMonIf.AyVld "" UBYTE autosar_swc_val_CM_boolean 0 0 0 1 ECU_ADDRESS 0xfe4ca76a /* @ECU_Address@SwcOut_VAL_SAF_FUSAIN.RelCptMonIf.AyVld@ */ /end MEASUREMENT
/begin MEASUREMENT SwcOut_VAL_SAF_FUSAIN.RelCptMonIf.BodyAvlE2E "" UBYTE autosar_swc_val_CM_boolean 0 0 0 1 ECU_ADDRESS 0xfe4ca76b /* @ECU_Address@SwcOut_VAL_SAF_FUSAIN.RelCptMonIf.BodyAvlE2E@ */ /end MEASUREMENT
/begin MEASUREMENT SwcOut_VAL_SAF_FUSAIN.RelCptMonIf.BrkAvl "" UBYTE autosar_swc_val_CM_boolean 0 0 0 1 ECU_ADDRESS 0xfe4ca76c /* @ECU_Address@SwcOut_VAL_SAF_FUSAIN.RelCptMonIf.BrkAvl@ */ /end MEASUREMENT
/begin MEASUREMENT SwcOut_VAL_SAF_FUSAIN.RelCptMonIf.BrkAvlE2E "" UBYTE autosar_swc_val_CM_boolean 0 0 0 1 ECU_ADDRESS 0xfe4ca76d /* @ECU_Address@SwcOut_VAL_SAF_FUSAIN.RelCptMonIf.BrkAvlE2E@ */ /end MEASUREMENT
/begin MEASUREMENT SwcOut_VAL_SAF_FUSAIN.RelCptMonIf.BrkMstCylPrsE2E "" UBYTE autosar_swc_val_CM_boolean 0 0 0 1 ECU_ADDRESS 0xfe4ca76e /* @ECU_Address@SwcOut_VAL_SAF_FUSAIN.RelCptMonIf.BrkMstCylPrsE2E@ */ /end MEASUREMENT
/begin MEASUREMENT SwcOut_VAL_SAF_FUSAIN.RelCptMonIf.BrkMstCylPrsVld "" UBYTE autosar_swc_val_CM_boolean 0 0 0 1 ECU_ADDRESS 0xfe4ca76f /* @ECU_Address@SwcOut_VAL_SAF_FUSAIN.RelCptMonIf.BrkMstCylPrsVld@ */ /end MEASUREMENT
/begin MEASUREMENT SwcOut_VAL_SAF_FUSAIN.RelCptMonIf.Chassis_ABSFailSts "" UBYTE autosar_swc_val_CM_boolean 0 0 0 1 ECU_ADDRESS 0xfe4ca770 /* @ECU_Address@SwcOut_VAL_SAF_FUSAIN.RelCptMonIf.Chassis_ABSFailSts@ */ /end MEASUREMENT
/begin MEASUREMENT SwcOut_VAL_SAF_FUSAIN.RelCptMonIf.Chassis_EBDFailSts "" UBYTE autosar_swc_val_CM_boolean 0 0 0 1 ECU_ADDRESS 0xfe4ca771 /* @ECU_Address@SwcOut_VAL_SAF_FUSAIN.RelCptMonIf.Chassis_EBDFailSts@ */ /end MEASUREMENT
/begin MEASUREMENT SwcOut_VAL_SAF_FUSAIN.RelCptMonIf.Chassis_HDCFailSts "" UBYTE autosar_swc_val_CM_boolean 0 0 0 1 ECU_ADDRESS 0xfe4ca772 /* @ECU_Address@SwcOut_VAL_SAF_FUSAIN.RelCptMonIf.Chassis_HDCFailSts@ */ /end MEASUREMENT
/begin MEASUREMENT SwcOut_VAL_SAF_FUSAIN.RelCptMonIf.Chassis_TCSFailSts "" UBYTE autosar_swc_val_CM_boolean 0 0 0 1 ECU_ADDRESS 0xfe4ca773 /* @ECU_Address@SwcOut_VAL_SAF_FUSAIN.RelCptMonIf.Chassis_TCSFailSts@ */ /end MEASUREMENT
/begin MEASUREMENT SwcOut_VAL_SAF_FUSAIN.RelCptMonIf.Chassis_VDCFailSts "" UBYTE autosar_swc_val_CM_boolean 0 0 0 1 ECU_ADDRESS 0xfe4ca774 /* @ECU_Address@SwcOut_VAL_SAF_FUSAIN.RelCptMonIf.Chassis_VDCFailSts@ */ /end MEASUREMENT
/begin MEASUREMENT SwcOut_VAL_SAF_FUSAIN.RelCptMonIf.DrvAccePedlPosnE2E "" UBYTE autosar_swc_val_CM_boolean 0 0 0 1 ECU_ADDRESS 0xfe4ca775 /* @ECU_Address@SwcOut_VAL_SAF_FUSAIN.RelCptMonIf.DrvAccePedlPosnE2E@ */ /end MEASUREMENT
/begin MEASUREMENT SwcOut_VAL_SAF_FUSAIN.RelCptMonIf.DrvAccePedlPosnVld "" UBYTE autosar_swc_val_CM_boolean 0 0 0 1 ECU_ADDRESS 0xfe4ca776 /* @ECU_Address@SwcOut_VAL_SAF_FUSAIN.RelCptMonIf.DrvAccePedlPosnVld@ */ /end MEASUREMENT
/begin MEASUREMENT SwcOut_VAL_SAF_FUSAIN.RelCptMonIf.EpbAvl "" UBYTE autosar_swc_val_CM_boolean 0 0 0 1 ECU_ADDRESS 0xfe4ca777 /* @ECU_Address@SwcOut_VAL_SAF_FUSAIN.RelCptMonIf.EpbAvl@ */ /end MEASUREMENT
/begin MEASUREMENT SwcOut_VAL_SAF_FUSAIN.RelCptMonIf.EpbAvlE2E "" UBYTE autosar_swc_val_CM_boolean 0 0 0 1 ECU_ADDRESS 0xfe4ca778 /* @ECU_Address@SwcOut_VAL_SAF_FUSAIN.RelCptMonIf.EpbAvlE2E@ */ /end MEASUREMENT
/begin MEASUREMENT SwcOut_VAL_SAF_FUSAIN.RelCptMonIf.Fusa_Cam_1_Module_Res.Fusa_Cam_BLC_checker "" UBYTE autosar_swc_val_CM_boolean 0 0 0 1 ECU_ADDRESS 0xfe4ca793 /* @ECU_Address@SwcOut_VAL_SAF_FUSAIN.RelCptMonIf.Fusa_Cam_1_Module_Res.Fusa_Cam_BLC_checker@ */ /end MEASUREMENT
/begin MEASUREMENT SwcOut_VAL_SAF_FUSAIN.RelCptMonIf.Fusa_Cam_1_Module_Res.Fusa_Cam_Frame_counter "" UBYTE autosar_swc_val_CM_boolean 0 0 0 1 ECU_ADDRESS 0xfe4ca791 /* @ECU_Address@SwcOut_VAL_SAF_FUSAIN.RelCptMonIf.Fusa_Cam_1_Module_Res.Fusa_Cam_Frame_counter@ */ /end MEASUREMENT
/begin MEASUREMENT SwcOut_VAL_SAF_FUSAIN.RelCptMonIf.Fusa_Cam_1_Module_Res.Fusa_Cam_ID_checker_col "" UBYTE autosar_swc_val_CM_boolean 0 0 0 1 ECU_ADDRESS 0xfe4ca78e /* @ECU_Address@SwcOut_VAL_SAF_FUSAIN.RelCptMonIf.Fusa_Cam_1_Module_Res.Fusa_Cam_ID_checker_col@ */ /end MEASUREMENT
/begin MEASUREMENT SwcOut_VAL_SAF_FUSAIN.RelCptMonIf.Fusa_Cam_1_Module_Res.Fusa_Cam_ID_checker_row "" UBYTE autosar_swc_val_CM_boolean 0 0 0 1 ECU_ADDRESS 0xfe4ca78f /* @ECU_Address@SwcOut_VAL_SAF_FUSAIN.RelCptMonIf.Fusa_Cam_1_Module_Res.Fusa_Cam_ID_checker_row@ */ /end MEASUREMENT
/begin MEASUREMENT SwcOut_VAL_SAF_FUSAIN.RelCptMonIf.Fusa_Cam_1_Module_Res.Fusa_Cam_PEC "" UBYTE autosar_swc_val_CM_boolean 0 0 0 1 ECU_ADDRESS 0xfe4ca796 /* @ECU_Address@SwcOut_VAL_SAF_FUSAIN.RelCptMonIf.Fusa_Cam_1_Module_Res.Fusa_Cam_PEC@ */ /end MEASUREMENT
/begin MEASUREMENT SwcOut_VAL_SAF_FUSAIN.RelCptMonIf.Fusa_Cam_1_Module_Res.Fusa_Cam_PLL_CLK "" UBYTE autosar_swc_val_CM_boolean 0 0 0 1 ECU_ADDRESS 0xfe4ca795 /* @ECU_Address@SwcOut_VAL_SAF_FUSAIN.RelCptMonIf.Fusa_Cam_1_Module_Res.Fusa_Cam_PLL_CLK@ */ /end MEASUREMENT
/begin MEASUREMENT SwcOut_VAL_SAF_FUSAIN.RelCptMonIf.Fusa_Cam_1_Module_Res.Fusa_Cam_PLL_CLK_mon "" UBYTE autosar_swc_val_CM_boolean 0 0 0 1 ECU_ADDRESS 0xfe4ca794 /* @ECU_Address@SwcOut_VAL_SAF_FUSAIN.RelCptMonIf.Fusa_Cam_1_Module_Res.Fusa_Cam_PLL_CLK_mon@ */ /end MEASUREMENT
/begin MEASUREMENT SwcOut_VAL_SAF_FUSAIN.RelCptMonIf.Fusa_Cam_1_Module_Res.Fusa_Cam_ROMCRC "" UBYTE autosar_swc_val_CM_boolean 0 0 0 1 ECU_ADDRESS 0xfe4ca79c /* @ECU_Address@SwcOut_VAL_SAF_FUSAIN.RelCptMonIf.Fusa_Cam_1_Module_Res.Fusa_Cam_ROMCRC@ */ /end MEASUREMENT
/begin MEASUREMENT SwcOut_VAL_SAF_FUSAIN.RelCptMonIf.Fusa_Cam_1_Module_Res.Fusa_Cam_SCCB_CRC "" UBYTE autosar_swc_val_CM_boolean 0 0 0 1 ECU_ADDRESS 0xfe4ca790 /* @ECU_Address@SwcOut_VAL_SAF_FUSAIN.RelCptMonIf.Fusa_Cam_1_Module_Res.Fusa_Cam_SCCB_CRC@ */ /end MEASUREMENT
/begin MEASUREMENT SwcOut_VAL_SAF_FUSAIN.RelCptMonIf.Fusa_Cam_1_Module_Res.Fusa_Cam_SI_default_register_check "" UBYTE autosar_swc_val_CM_boolean 0 0 0 1 ECU_ADDRESS 0xfe4ca79b /* @ECU_Address@SwcOut_VAL_SAF_FUSAIN.RelCptMonIf.Fusa_Cam_1_Module_Res.Fusa_Cam_SI_default_register_check@ */ /end MEASUREMENT
/begin MEASUREMENT SwcOut_VAL_SAF_FUSAIN.RelCptMonIf.Fusa_Cam_1_Module_Res.Fusa_Cam_SM_test "" UBYTE autosar_swc_val_CM_boolean 0 0 0 1 ECU_ADDRESS 0xfe4ca79e /* @ECU_Address@SwcOut_VAL_SAF_FUSAIN.RelCptMonIf.Fusa_Cam_1_Module_Res.Fusa_Cam_SM_test@ */ /end MEASUREMENT
/begin MEASUREMENT SwcOut_VAL_SAF_FUSAIN.RelCptMonIf.Fusa_Cam_1_Module_Res.Fusa_Cam_SRAM_BIST "" UBYTE autosar_swc_val_CM_boolean 0 0 0 1 ECU_ADDRESS 0xfe4ca79d /* @ECU_Address@SwcOut_VAL_SAF_FUSAIN.RelCptMonIf.Fusa_Cam_1_Module_Res.Fusa_Cam_SRAM_BIST@ */ /end MEASUREMENT
/begin MEASUREMENT SwcOut_VAL_SAF_FUSAIN.RelCptMonIf.Fusa_Cam_1_Module_Res.Fusa_Cam_SRAM_CRC "" UBYTE autosar_swc_val_CM_boolean 0 0 0 1 ECU_ADDRESS 0xfe4ca798 /* @ECU_Address@SwcOut_VAL_SAF_FUSAIN.RelCptMonIf.Fusa_Cam_1_Module_Res.Fusa_Cam_SRAM_CRC@ */ /end MEASUREMENT
/begin MEASUREMENT SwcOut_VAL_SAF_FUSAIN.RelCptMonIf.Fusa_Cam_1_Module_Res.Fusa_Cam_Sensor_voltage "" UBYTE autosar_swc_val_CM_boolean 0 0 0 1 ECU_ADDRESS 0xfe4ca799 /* @ECU_Address@SwcOut_VAL_SAF_FUSAIN.RelCptMonIf.Fusa_Cam_1_Module_Res.Fusa_Cam_Sensor_voltage@ */ /end MEASUREMENT
/begin MEASUREMENT SwcOut_VAL_SAF_FUSAIN.RelCptMonIf.Fusa_Cam_1_Module_Res.Fusa_Cam_internal_register_readback "" UBYTE autosar_swc_val_CM_boolean 0 0 0 1 ECU_ADDRESS 0xfe4ca79a /* @ECU_Address@SwcOut_VAL_SAF_FUSAIN.RelCptMonIf.Fusa_Cam_1_Module_Res.Fusa_Cam_internal_register_readback@ */ /end MEASUREMENT
/begin MEASUREMENT SwcOut_VAL_SAF_FUSAIN.RelCptMonIf.Fusa_Cam_1_Module_Res.Fusa_Cam_online_pixel "" UBYTE autosar_swc_val_CM_boolean 0 0 0 1 ECU_ADDRESS 0xfe4ca78c /* @ECU_Address@SwcOut_VAL_SAF_FUSAIN.RelCptMonIf.Fusa_Cam_1_Module_Res.Fusa_Cam_online_pixel@ */ /end MEASUREMENT
/begin MEASUREMENT SwcOut_VAL_SAF_FUSAIN.RelCptMonIf.Fusa_Cam_1_Module_Res.Fusa_Cam_output_FIFO_CRC "" UBYTE autosar_swc_val_CM_boolean 0 0 0 1 ECU_ADDRESS 0xfe4ca797 /* @ECU_Address@SwcOut_VAL_SAF_FUSAIN.RelCptMonIf.Fusa_Cam_1_Module_Res.Fusa_Cam_output_FIFO_CRC@ */ /end MEASUREMENT
/begin MEASUREMENT SwcOut_VAL_SAF_FUSAIN.RelCptMonIf.Fusa_Cam_1_Module_Res.Fusa_Cam_row_checker_analog "" UBYTE autosar_swc_val_CM_boolean 0 0 0 1 ECU_ADDRESS 0xfe4ca78d /* @ECU_Address@SwcOut_VAL_SAF_FUSAIN.RelCptMonIf.Fusa_Cam_1_Module_Res.Fusa_Cam_row_checker_analog@ */ /end MEASUREMENT
/begin MEASUREMENT SwcOut_VAL_SAF_FUSAIN.RelCptMonIf.Fusa_Cam_1_Module_Res.Fusa_Cam_row_checker_digital "" UBYTE autosar_swc_val_CM_boolean 0 0 0 1 ECU_ADDRESS 0xfe4ca792 /* @ECU_Address@SwcOut_VAL_SAF_FUSAIN.RelCptMonIf.Fusa_Cam_1_Module_Res.Fusa_Cam_row_checker_digital@ */ /end MEASUREMENT
/begin MEASUREMENT SwcOut_VAL_SAF_FUSAIN.RelCptMonIf.Fusa_Cam_1_Module_Res.Fusa_Cam_temperature "" UBYTE autosar_swc_val_CM_boolean 0 0 0 1 ECU_ADDRESS 0xfe4ca79f /* @ECU_Address@SwcOut_VAL_SAF_FUSAIN.RelCptMonIf.Fusa_Cam_1_Module_Res.Fusa_Cam_temperature@ */ /end MEASUREMENT
/begin MEASUREMENT SwcOut_VAL_SAF_FUSAIN.RelCptMonIf.Fusa_Cam_1_Ser_Res.Fusa_Cam_PMIC "" UBYTE autosar_swc_val_CM_boolean 0 0 0 1 ECU_ADDRESS 0xfe4ca7a7 /* @ECU_Address@SwcOut_VAL_SAF_FUSAIN.RelCptMonIf.Fusa_Cam_1_Ser_Res.Fusa_Cam_PMIC@ */ /end MEASUREMENT
/begin MEASUREMENT SwcOut_VAL_SAF_FUSAIN.RelCptMonIf.Fusa_Cam_1_Ser_Res.Fusa_Cam_Ser_ADC_BIST "" UBYTE autosar_swc_val_CM_boolean 0 0 0 1 ECU_ADDRESS 0xfe4ca7a5 /* @ECU_Address@SwcOut_VAL_SAF_FUSAIN.RelCptMonIf.Fusa_Cam_1_Ser_Res.Fusa_Cam_Ser_ADC_BIST@ */ /end MEASUREMENT
/begin MEASUREMENT SwcOut_VAL_SAF_FUSAIN.RelCptMonIf.Fusa_Cam_1_Ser_Res.Fusa_Cam_Ser_CFG_CRC "" UBYTE autosar_swc_val_CM_boolean 0 0 0 1 ECU_ADDRESS 0xfe4ca7a6 /* @ECU_Address@SwcOut_VAL_SAF_FUSAIN.RelCptMonIf.Fusa_Cam_1_Ser_Res.Fusa_Cam_Ser_CFG_CRC@ */ /end MEASUREMENT
/begin MEASUREMENT SwcOut_VAL_SAF_FUSAIN.RelCptMonIf.Fusa_Cam_1_Ser_Res.Fusa_Cam_Ser_FIFO_Overflow "" UBYTE autosar_swc_val_CM_boolean 0 0 0 1 ECU_ADDRESS 0xfe4ca7a2 /* @ECU_Address@SwcOut_VAL_SAF_FUSAIN.RelCptMonIf.Fusa_Cam_1_Ser_Res.Fusa_Cam_Ser_FIFO_Overflow@ */ /end MEASUREMENT
/begin MEASUREMENT SwcOut_VAL_SAF_FUSAIN.RelCptMonIf.Fusa_Cam_1_Ser_Res.Fusa_Cam_Ser_I2C "" UBYTE autosar_swc_val_CM_boolean 0 0 0 1 ECU_ADDRESS 0xfe4ca7a1 /* @ECU_Address@SwcOut_VAL_SAF_FUSAIN.RelCptMonIf.Fusa_Cam_1_Ser_Res.Fusa_Cam_Ser_I2C@ */ /end MEASUREMENT
/begin MEASUREMENT SwcOut_VAL_SAF_FUSAIN.RelCptMonIf.Fusa_Cam_1_Ser_Res.Fusa_Cam_Ser_LBIST "" UBYTE autosar_swc_val_CM_boolean 0 0 0 1 ECU_ADDRESS 0xfe4ca7a3 /* @ECU_Address@SwcOut_VAL_SAF_FUSAIN.RelCptMonIf.Fusa_Cam_1_Ser_Res.Fusa_Cam_Ser_LBIST@ */ /end MEASUREMENT
/begin MEASUREMENT SwcOut_VAL_SAF_FUSAIN.RelCptMonIf.Fusa_Cam_1_Ser_Res.Fusa_Cam_Ser_MBIST "" UBYTE autosar_swc_val_CM_boolean 0 0 0 1 ECU_ADDRESS 0xfe4ca7a4 /* @ECU_Address@SwcOut_VAL_SAF_FUSAIN.RelCptMonIf.Fusa_Cam_1_Ser_Res.Fusa_Cam_Ser_MBIST@ */ /end MEASUREMENT
/begin MEASUREMENT SwcOut_VAL_SAF_FUSAIN.RelCptMonIf.Fusa_Cam_1_Ser_Res.Fusa_Cam_Ser_OV_UV "" UBYTE autosar_swc_val_CM_boolean 0 0 0 1 ECU_ADDRESS 0xfe4ca7a0 /* @ECU_Address@SwcOut_VAL_SAF_FUSAIN.RelCptMonIf.Fusa_Cam_1_Ser_Res.Fusa_Cam_Ser_OV_UV@ */ /end MEASUREMENT
/begin MEASUREMENT SwcOut_VAL_SAF_FUSAIN.RelCptMonIf.ImuNotCal "" UBYTE autosar_swc_val_CM_boolean 0 0 0 1 ECU_ADDRESS 0xfe4ca779 /* @ECU_Address@SwcOut_VAL_SAF_FUSAIN.RelCptMonIf.ImuNotCal@ */ /end MEASUREMENT
/begin MEASUREMENT SwcOut_VAL_SAF_FUSAIN.RelCptMonIf.PTAvl "" UBYTE autosar_swc_val_CM_boolean 0 0 0 1 ECU_ADDRESS 0xfe4ca77a /* @ECU_Address@SwcOut_VAL_SAF_FUSAIN.RelCptMonIf.PTAvl@ */ /end MEASUREMENT
/begin MEASUREMENT SwcOut_VAL_SAF_FUSAIN.RelCptMonIf.PTAvlE2E "" UBYTE autosar_swc_val_CM_boolean 0 0 0 1 ECU_ADDRESS 0xfe4ca77b /* @ECU_Address@SwcOut_VAL_SAF_FUSAIN.RelCptMonIf.PTAvlE2E@ */ /end MEASUREMENT
/begin MEASUREMENT SwcOut_VAL_SAF_FUSAIN.RelCptMonIf.PTHvAvl "" UBYTE autosar_swc_val_CM_boolean 0 0 0 1 ECU_ADDRESS 0xfe4ca77c /* @ECU_Address@SwcOut_VAL_SAF_FUSAIN.RelCptMonIf.PTHvAvl@ */ /end MEASUREMENT
/begin MEASUREMENT SwcOut_VAL_SAF_FUSAIN.RelCptMonIf.PTHvAvlE2E "" UBYTE autosar_swc_val_CM_boolean 0 0 0 1 ECU_ADDRESS 0xfe4ca77d /* @ECU_Address@SwcOut_VAL_SAF_FUSAIN.RelCptMonIf.PTHvAvlE2E@ */ /end MEASUREMENT
/begin MEASUREMENT SwcOut_VAL_SAF_FUSAIN.RelCptMonIf.RL_Radar_Err "" UBYTE autosar_swc_val_CM_boolean 0 0 0 1 ECU_ADDRESS 0xfe4ca77e /* @ECU_Address@SwcOut_VAL_SAF_FUSAIN.RelCptMonIf.RL_Radar_Err@ */ /end MEASUREMENT
/begin MEASUREMENT SwcOut_VAL_SAF_FUSAIN.RelCptMonIf.RR_Radar_Err "" UBYTE autosar_swc_val_CM_boolean 0 0 0 1 ECU_ADDRESS 0xfe4ca77f /* @ECU_Address@SwcOut_VAL_SAF_FUSAIN.RelCptMonIf.RR_Radar_Err@ */ /end MEASUREMENT
/begin MEASUREMENT SwcOut_VAL_SAF_FUSAIN.RelCptMonIf.SerDes_MAX96716_Res.Fusa_96716_MEM_ECC_ERR1 "" UBYTE autosar_swc_val_CM_boolean 0 0 0 1 ECU_ADDRESS 0xfe4ca7b2 /* @ECU_Address@SwcOut_VAL_SAF_FUSAIN.RelCptMonIf.SerDes_MAX96716_Res.Fusa_96716_MEM_ECC_ERR1@ */ /end MEASUREMENT
/begin MEASUREMENT SwcOut_VAL_SAF_FUSAIN.RelCptMonIf.SerDes_MAX96716_Res.Fusa_96716_MEM_ECC_ERR2 "" UBYTE autosar_swc_val_CM_boolean 0 0 0 1 ECU_ADDRESS 0xfe4ca7b1 /* @ECU_Address@SwcOut_VAL_SAF_FUSAIN.RelCptMonIf.SerDes_MAX96716_Res.Fusa_96716_MEM_ECC_ERR2@ */ /end MEASUREMENT
/begin MEASUREMENT SwcOut_VAL_SAF_FUSAIN.RelCptMonIf.SerDes_MAX96716_Res.Fusa_FSYNC_ERR "" UBYTE autosar_swc_val_CM_boolean 0 0 0 1 ECU_ADDRESS 0xfe4ca7ac /* @ECU_Address@SwcOut_VAL_SAF_FUSAIN.RelCptMonIf.SerDes_MAX96716_Res.Fusa_FSYNC_ERR@ */ /end MEASUREMENT
/begin MEASUREMENT SwcOut_VAL_SAF_FUSAIN.RelCptMonIf.SerDes_MAX96716_Res.Fusa_I2C_UART_CRC_ERR "" UBYTE autosar_swc_val_CM_boolean 0 0 0 1 ECU_ADDRESS 0xfe4ca7b0 /* @ECU_Address@SwcOut_VAL_SAF_FUSAIN.RelCptMonIf.SerDes_MAX96716_Res.Fusa_I2C_UART_CRC_ERR@ */ /end MEASUREMENT
/begin MEASUREMENT SwcOut_VAL_SAF_FUSAIN.RelCptMonIf.SerDes_MAX96716_Res.Fusa_I2C_UART_MSGCNTR_ERR "" UBYTE autosar_swc_val_CM_boolean 0 0 0 1 ECU_ADDRESS 0xfe4ca7af /* @ECU_Address@SwcOut_VAL_SAF_FUSAIN.RelCptMonIf.SerDes_MAX96716_Res.Fusa_I2C_UART_MSGCNTR_ERR@ */ /end MEASUREMENT
/begin MEASUREMENT SwcOut_VAL_SAF_FUSAIN.RelCptMonIf.SerDes_MAX96716_Res.Fusa_LCRC_ERR "" UBYTE autosar_swc_val_CM_boolean 0 0 0 1 ECU_ADDRESS 0xfe4ca7ad /* @ECU_Address@SwcOut_VAL_SAF_FUSAIN.RelCptMonIf.SerDes_MAX96716_Res.Fusa_LCRC_ERR@ */ /end MEASUREMENT
/begin MEASUREMENT SwcOut_VAL_SAF_FUSAIN.RelCptMonIf.SerDes_MAX96716_Res.Fusa_POST_LBIST_ERR "" UBYTE autosar_swc_val_CM_boolean 0 0 0 1 ECU_ADDRESS 0xfe4ca7b5 /* @ECU_Address@SwcOut_VAL_SAF_FUSAIN.RelCptMonIf.SerDes_MAX96716_Res.Fusa_POST_LBIST_ERR@ */ /end MEASUREMENT
/begin MEASUREMENT SwcOut_VAL_SAF_FUSAIN.RelCptMonIf.SerDes_MAX96716_Res.Fusa_POST_MBIST_ERR "" UBYTE autosar_swc_val_CM_boolean 0 0 0 1 ECU_ADDRESS 0xfe4ca7b4 /* @ECU_Address@SwcOut_VAL_SAF_FUSAIN.RelCptMonIf.SerDes_MAX96716_Res.Fusa_POST_MBIST_ERR@ */ /end MEASUREMENT
/begin MEASUREMENT SwcOut_VAL_SAF_FUSAIN.RelCptMonIf.SerDes_MAX96716_Res.Fusa_REG_CRC_ERR "" UBYTE autosar_swc_val_CM_boolean 0 0 0 1 ECU_ADDRESS 0xfe4ca7b3 /* @ECU_Address@SwcOut_VAL_SAF_FUSAIN.RelCptMonIf.SerDes_MAX96716_Res.Fusa_REG_CRC_ERR@ */ /end MEASUREMENT
/begin MEASUREMENT SwcOut_VAL_SAF_FUSAIN.RelCptMonIf.SerDes_MAX96716_Res.Fusa_TUN_DATA_CRC_ERR "" UBYTE autosar_swc_val_CM_boolean 0 0 0 1 ECU_ADDRESS 0xfe4ca7a8 /* @ECU_Address@SwcOut_VAL_SAF_FUSAIN.RelCptMonIf.SerDes_MAX96716_Res.Fusa_TUN_DATA_CRC_ERR@ */ /end MEASUREMENT
/begin MEASUREMENT SwcOut_VAL_SAF_FUSAIN.RelCptMonIf.SerDes_MAX96716_Res.Fusa_TUN_ECC_CORR_ERR "" UBYTE autosar_swc_val_CM_boolean 0 0 0 1 ECU_ADDRESS 0xfe4ca7aa /* @ECU_Address@SwcOut_VAL_SAF_FUSAIN.RelCptMonIf.SerDes_MAX96716_Res.Fusa_TUN_ECC_CORR_ERR@ */ /end MEASUREMENT
/begin MEASUREMENT SwcOut_VAL_SAF_FUSAIN.RelCptMonIf.SerDes_MAX96716_Res.Fusa_TUN_ECC_UNCORR_ERR "" UBYTE autosar_swc_val_CM_boolean 0 0 0 1 ECU_ADDRESS 0xfe4ca7a9 /* @ECU_Address@SwcOut_VAL_SAF_FUSAIN.RelCptMonIf.SerDes_MAX96716_Res.Fusa_TUN_ECC_UNCORR_ERR@ */ /end MEASUREMENT
/begin MEASUREMENT SwcOut_VAL_SAF_FUSAIN.RelCptMonIf.SerDes_MAX96716_Res.Fusa_VID_OVERFLOW_ERR "" UBYTE autosar_swc_val_CM_boolean 0 0 0 1 ECU_ADDRESS 0xfe4ca7ab /* @ECU_Address@SwcOut_VAL_SAF_FUSAIN.RelCptMonIf.SerDes_MAX96716_Res.Fusa_VID_OVERFLOW_ERR@ */ /end MEASUREMENT
/begin MEASUREMENT SwcOut_VAL_SAF_FUSAIN.RelCptMonIf.SerDes_MAX96716_Res.Fusa_VPRBS_ERR "" UBYTE autosar_swc_val_CM_boolean 0 0 0 1 ECU_ADDRESS 0xfe4ca7ae /* @ECU_Address@SwcOut_VAL_SAF_FUSAIN.RelCptMonIf.SerDes_MAX96716_Res.Fusa_VPRBS_ERR@ */ /end MEASUREMENT
/begin MEASUREMENT SwcOut_VAL_SAF_FUSAIN.RelCptMonIf.SerDes_MAX96716_Res.Fusa_WM_ERR "" UBYTE autosar_swc_val_CM_boolean 0 0 0 1 ECU_ADDRESS 0xfe4ca7b6 /* @ECU_Address@SwcOut_VAL_SAF_FUSAIN.RelCptMonIf.SerDes_MAX96716_Res.Fusa_WM_ERR@ */ /end MEASUREMENT
/begin MEASUREMENT SwcOut_VAL_SAF_FUSAIN.RelCptMonIf.SteerAvl "" UBYTE autosar_swc_val_CM_boolean 0 0 0 1 ECU_ADDRESS 0xfe4ca780 /* @ECU_Address@SwcOut_VAL_SAF_FUSAIN.RelCptMonIf.SteerAvl@ */ /end MEASUREMENT
/begin MEASUREMENT SwcOut_VAL_SAF_FUSAIN.RelCptMonIf.SteerAvlE2E "" UBYTE autosar_swc_val_CM_boolean 0 0 0 1 ECU_ADDRESS 0xfe4ca781 /* @ECU_Address@SwcOut_VAL_SAF_FUSAIN.RelCptMonIf.SteerAvlE2E@ */ /end MEASUREMENT
/begin MEASUREMENT SwcOut_VAL_SAF_FUSAIN.RelCptMonIf.SteerWhlAngE2E "" UBYTE autosar_swc_val_CM_boolean 0 0 0 1 ECU_ADDRESS 0xfe4ca782 /* @ECU_Address@SwcOut_VAL_SAF_FUSAIN.RelCptMonIf.SteerWhlAngE2E@ */ /end MEASUREMENT
/begin MEASUREMENT SwcOut_VAL_SAF_FUSAIN.RelCptMonIf.SteerWhlAngSpdE2E "" UBYTE autosar_swc_val_CM_boolean 0 0 0 1 ECU_ADDRESS 0xfe4ca783 /* @ECU_Address@SwcOut_VAL_SAF_FUSAIN.RelCptMonIf.SteerWhlAngSpdE2E@ */ /end MEASUREMENT
/begin MEASUREMENT SwcOut_VAL_SAF_FUSAIN.RelCptMonIf.SteerWhlAngSpdVld "" UBYTE autosar_swc_val_CM_boolean 0 0 0 1 ECU_ADDRESS 0xfe4ca784 /* @ECU_Address@SwcOut_VAL_SAF_FUSAIN.RelCptMonIf.SteerWhlAngSpdVld@ */ /end MEASUREMENT
/begin MEASUREMENT SwcOut_VAL_SAF_FUSAIN.RelCptMonIf.SteerWhlAngVld "" UBYTE autosar_swc_val_CM_boolean 0 0 0 1 ECU_ADDRESS 0xfe4ca785 /* @ECU_Address@SwcOut_VAL_SAF_FUSAIN.RelCptMonIf.SteerWhlAngVld@ */ /end MEASUREMENT
/begin MEASUREMENT SwcOut_VAL_SAF_FUSAIN.RelCptMonIf.VehSpdChassisE2E "" UBYTE autosar_swc_val_CM_boolean 0 0 0 1 ECU_ADDRESS 0xfe4ca786 /* @ECU_Address@SwcOut_VAL_SAF_FUSAIN.RelCptMonIf.VehSpdChassisE2E@ */ /end MEASUREMENT
/begin MEASUREMENT SwcOut_VAL_SAF_FUSAIN.RelCptMonIf.VehSpdChassisVld "" UBYTE autosar_swc_val_CM_boolean 0 0 0 1 ECU_ADDRESS 0xfe4ca787 /* @ECU_Address@SwcOut_VAL_SAF_FUSAIN.RelCptMonIf.VehSpdChassisVld@ */ /end MEASUREMENT
/begin MEASUREMENT SwcOut_VAL_SAF_FUSAIN.RelCptMonIf.WhlSpdAvl "" UBYTE autosar_swc_val_CM_boolean 0 0 0 1 ECU_ADDRESS 0xfe4ca788 /* @ECU_Address@SwcOut_VAL_SAF_FUSAIN.RelCptMonIf.WhlSpdAvl@ */ /end MEASUREMENT
/begin MEASUREMENT SwcOut_VAL_SAF_FUSAIN.RelCptMonIf.WhlSpdE2E "" UBYTE autosar_swc_val_CM_boolean 0 0 0 1 ECU_ADDRESS 0xfe4ca789 /* @ECU_Address@SwcOut_VAL_SAF_FUSAIN.RelCptMonIf.WhlSpdE2E@ */ /end MEASUREMENT
/begin MEASUREMENT SwcOut_VAL_SAF_FUSAIN.RelCptMonIf.YawRateE2E "" UBYTE autosar_swc_val_CM_boolean 0 0 0 1 ECU_ADDRESS 0xfe4ca78a /* @ECU_Address@SwcOut_VAL_SAF_FUSAIN.RelCptMonIf.YawRateE2E@ */ /end MEASUREMENT
/begin MEASUREMENT SwcOut_VAL_SAF_FUSAIN.RelCptMonIf.YawRateVld "" UBYTE autosar_swc_val_CM_boolean 0 0 0 1 ECU_ADDRESS 0xfe4ca78b /* @ECU_Address@SwcOut_VAL_SAF_FUSAIN.RelCptMonIf.YawRateVld@ */ /end MEASUREMENT
/begin MEASUREMENT SwcOut_VAL_SAF_FUSAIN.SysStMonIf.ACCSts "" UBYTE autosar_swc_val_CM_uint8 0 0 0 255 ECU_ADDRESS 0xfe4ca7bb /* @ECU_Address@SwcOut_VAL_SAF_FUSAIN.SysStMonIf.ACCSts@ */ /end MEASUREMENT
/begin MEASUREMENT SwcOut_VAL_SAF_FUSAIN.SysStMonIf.Ax "" FLOAT32_IEEE autosar_swc_val_CM_single 0 0 -3.4E+38 3.4E+38 ECU_ADDRESS 0xfe4ca7d0 /* @ECU_Address@SwcOut_VAL_SAF_FUSAIN.SysStMonIf.Ax@ */ /end MEASUREMENT
/begin MEASUREMENT SwcOut_VAL_SAF_FUSAIN.SysStMonIf.Ay "" FLOAT32_IEEE autosar_swc_val_CM_single 0 0 -3.4E+38 3.4E+38 ECU_ADDRESS 0xfe4ca7cc /* @ECU_Address@SwcOut_VAL_SAF_FUSAIN.SysStMonIf.Ay@ */ /end MEASUREMENT
/begin MEASUREMENT SwcOut_VAL_SAF_FUSAIN.SysStMonIf.DriveOff "" UBYTE autosar_swc_val_CM_boolean 0 0 0 1 ECU_ADDRESS 0xfe4ca7b8 /* @ECU_Address@SwcOut_VAL_SAF_FUSAIN.SysStMonIf.DriveOff@ */ /end MEASUREMENT
/begin MEASUREMENT SwcOut_VAL_SAF_FUSAIN.SysStMonIf.DrvOffBtnCfm "" UBYTE autosar_swc_val_CM_boolean 0 0 0 1 ECU_ADDRESS 0xfe4ca7b9 /* @ECU_Address@SwcOut_VAL_SAF_FUSAIN.SysStMonIf.DrvOffBtnCfm@ */ /end MEASUREMENT
/begin MEASUREMENT SwcOut_VAL_SAF_FUSAIN.SysStMonIf.Mcu_U2A16_Res.Fusa_J3_SPI_CRC_ERR "" UBYTE autosar_swc_val_CM_boolean 0 0 0 1 ECU_ADDRESS 0xfe4ca7dd /* @ECU_Address@SwcOut_VAL_SAF_FUSAIN.SysStMonIf.Mcu_U2A16_Res.Fusa_J3_SPI_CRC_ERR@ */ /end MEASUREMENT
/begin MEASUREMENT SwcOut_VAL_SAF_FUSAIN.SysStMonIf.Mcu_U2A16_Res.Fusa_J3_SPI_RC_ERR "" UBYTE autosar_swc_val_CM_boolean 0 0 0 1 ECU_ADDRESS 0xfe4ca7de /* @ECU_Address@SwcOut_VAL_SAF_FUSAIN.SysStMonIf.Mcu_U2A16_Res.Fusa_J3_SPI_RC_ERR@ */ /end MEASUREMENT
/begin MEASUREMENT SwcOut_VAL_SAF_FUSAIN.SysStMonIf.Mcu_U2A16_Res.Fusa_U2A16_BIST_ERR "" UBYTE autosar_swc_val_CM_boolean 0 0 0 1 ECU_ADDRESS 0xfe4ca7dc /* @ECU_Address@SwcOut_VAL_SAF_FUSAIN.SysStMonIf.Mcu_U2A16_Res.Fusa_U2A16_BIST_ERR@ */ /end MEASUREMENT
/begin MEASUREMENT SwcOut_VAL_SAF_FUSAIN.SysStMonIf.Pilot_Accel "" FLOAT32_IEEE autosar_swc_val_CM_single 0 0 -3.4E+38 3.4E+38 ECU_ADDRESS 0xfe4ca7bc /* @ECU_Address@SwcOut_VAL_SAF_FUSAIN.SysStMonIf.Pilot_Accel@ */ /end MEASUREMENT
/begin MEASUREMENT SwcOut_VAL_SAF_FUSAIN.SysStMonIf.PtDrvAccePedlPosn "" FLOAT32_IEEE autosar_swc_val_CM_single 0 0 -3.4E+38 3.4E+38 ECU_ADDRESS 0xfe4ca7c0 /* @ECU_Address@SwcOut_VAL_SAF_FUSAIN.SysStMonIf.PtDrvAccePedlPosn@ */ /end MEASUREMENT
/begin MEASUREMENT SwcOut_VAL_SAF_FUSAIN.SysStMonIf.Sbc_TLF35584_Res.FuSa_TLF35584_BIST_ERR "" UBYTE autosar_swc_val_CM_boolean 0 0 0 1 ECU_ADDRESS 0xfe4ca7df /* @ECU_Address@SwcOut_VAL_SAF_FUSAIN.SysStMonIf.Sbc_TLF35584_Res.FuSa_TLF35584_BIST_ERR@ */ /end MEASUREMENT
/begin MEASUREMENT SwcOut_VAL_SAF_FUSAIN.SysStMonIf.SteerWhlAng "" FLOAT32_IEEE autosar_swc_val_CM_single 0 0 -3.4E+38 3.4E+38 ECU_ADDRESS 0xfe4ca7d4 /* @ECU_Address@SwcOut_VAL_SAF_FUSAIN.SysStMonIf.SteerWhlAng@ */ /end MEASUREMENT
/begin MEASUREMENT SwcOut_VAL_SAF_FUSAIN.SysStMonIf.SteerWhlAngSpd "" FLOAT32_IEEE autosar_swc_val_CM_single 0 0 -3.4E+38 3.4E+38 ECU_ADDRESS 0xfe4ca7c4 /* @ECU_Address@SwcOut_VAL_SAF_FUSAIN.SysStMonIf.SteerWhlAngSpd@ */ /end MEASUREMENT
/begin MEASUREMENT SwcOut_VAL_SAF_FUSAIN.SysStMonIf.VehSpdChassis "" FLOAT32_IEEE autosar_swc_val_CM_single 0 0 -3.4E+38 3.4E+38 ECU_ADDRESS 0xfe4ca7c8 /* @ECU_Address@SwcOut_VAL_SAF_FUSAIN.SysStMonIf.VehSpdChassis@ */ /end MEASUREMENT
/begin MEASUREMENT SwcOut_VAL_SAF_FUSAIN.SysStMonIf.YawRate "" FLOAT32_IEEE autosar_swc_val_CM_single 0 0 -3.4E+38 3.4E+38 ECU_ADDRESS 0xfe4ca7d8 /* @ECU_Address@SwcOut_VAL_SAF_FUSAIN.SysStMonIf.YawRate@ */ /end MEASUREMENT
/begin MEASUREMENT SwcOut_VAL_SAF_FUSAIN.SysStMonIf.isActGearR "" UBYTE autosar_swc_val_CM_boolean 0 0 0 1 ECU_ADDRESS 0xfe4ca7ba /* @ECU_Address@SwcOut_VAL_SAF_FUSAIN.SysStMonIf.isActGearR@ */ /end MEASUREMENT
/begin MEASUREMENT SwcOut_VAL_SAF_TrigSftyAct.isAEBFrbdnAct "" UBYTE autosar_swc_val_CM_boolean 0 0 0 1 ECU_ADDRESS 0xfe4cba5b /* @ECU_Address@SwcOut_VAL_SAF_TrigSftyAct.isAEBFrbdnAct@ */ /end MEASUREMENT
/begin MEASUREMENT SwcOut_VAL_SAF_TrigSftyAct.isLatFrbdnAct "" UBYTE autosar_swc_val_CM_boolean 0 0 0 1 ECU_ADDRESS 0xfe4cba58 /* @ECU_Address@SwcOut_VAL_SAF_TrigSftyAct.isLatFrbdnAct@ */ /end MEASUREMENT
/begin MEASUREMENT SwcOut_VAL_SAF_TrigSftyAct.isLgtNegFrbdnAct "" UBYTE autosar_swc_val_CM_boolean 0 0 0 1 ECU_ADDRESS 0xfe4cba5a /* @ECU_Address@SwcOut_VAL_SAF_TrigSftyAct.isLgtNegFrbdnAct@ */ /end MEASUREMENT
/begin MEASUREMENT SwcOut_VAL_SAF_TrigSftyAct.isLgtPosFrbdnAct "" UBYTE autosar_swc_val_CM_boolean 0 0 0 1 ECU_ADDRESS 0xfe4cba59 /* @ECU_Address@SwcOut_VAL_SAF_TrigSftyAct.isLgtPosFrbdnAct@ */ /end MEASUREMENT
/begin MEASUREMENT SwcOut_VAL_SysOut_NvM_Write.AEBOnOff "" UBYTE autosar_swc_val_CM_boolean 0 0 0 1 ECU_ADDRESS 0xfe4ca7eb /* @ECU_Address@SwcOut_VAL_SysOut_NvM_Write.AEBOnOff@ */ /end MEASUREMENT
/begin MEASUREMENT SwcOut_VAL_SysOut_NvM_Write.AESOnOff "" UBYTE autosar_swc_val_CM_boolean 0 0 0 1 ECU_ADDRESS 0xfe4ca7e6 /* @ECU_Address@SwcOut_VAL_SysOut_NvM_Write.AESOnOff@ */ /end MEASUREMENT
/begin MEASUREMENT SwcOut_VAL_SysOut_NvM_Write.ALCSet "" UBYTE autosar_swc_val_CM_uint8 0 0 0 255 ECU_ADDRESS 0xfe4ca7f8 /* @ECU_Address@SwcOut_VAL_SysOut_NvM_Write.ALCSet@ */ /end MEASUREMENT
/begin MEASUREMENT SwcOut_VAL_SysOut_NvM_Write.ALCSnvtySet "" UBYTE autosar_swc_val_CM_uint8 0 0 0 255 ECU_ADDRESS 0xfe4ca7fa /* @ECU_Address@SwcOut_VAL_SysOut_NvM_Write.ALCSnvtySet@ */ /end MEASUREMENT
/begin MEASUREMENT SwcOut_VAL_SysOut_NvM_Write.DAIOnOff "" UBYTE autosar_swc_val_CM_boolean 0 0 0 1 ECU_ADDRESS 0xfe4ca7ec /* @ECU_Address@SwcOut_VAL_SysOut_NvM_Write.DAIOnOff@ */ /end MEASUREMENT
/begin MEASUREMENT SwcOut_VAL_SysOut_NvM_Write.DCLCSet "" UBYTE autosar_swc_val_CM_uint8 0 0 0 255 ECU_ADDRESS 0xfe4ca7f9 /* @ECU_Address@SwcOut_VAL_SysOut_NvM_Write.DCLCSet@ */ /end MEASUREMENT
/begin MEASUREMENT SwcOut_VAL_SysOut_NvM_Write.ELKOnOff "" UBYTE autosar_swc_val_CM_boolean 0 0 0 1 ECU_ADDRESS 0xfe4ca7e4 /* @ECU_Address@SwcOut_VAL_SysOut_NvM_Write.ELKOnOff@ */ /end MEASUREMENT
/begin MEASUREMENT SwcOut_VAL_SysOut_NvM_Write.ESSOnOff "" UBYTE autosar_swc_val_CM_boolean 0 0 0 1 ECU_ADDRESS 0xfe4ca7e5 /* @ECU_Address@SwcOut_VAL_SysOut_NvM_Write.ESSOnOff@ */ /end MEASUREMENT
/begin MEASUREMENT SwcOut_VAL_SysOut_NvM_Write.FCWOnOff "" UBYTE autosar_swc_val_CM_boolean 0 0 0 1 ECU_ADDRESS 0xfe4ca7ea /* @ECU_Address@SwcOut_VAL_SysOut_NvM_Write.FCWOnOff@ */ /end MEASUREMENT
/begin MEASUREMENT SwcOut_VAL_SysOut_NvM_Write.FCWSnvty "" UBYTE autosar_swc_val_CM_uint8 0 0 0 255 ECU_ADDRESS 0xfe4ca7fb /* @ECU_Address@SwcOut_VAL_SysOut_NvM_Write.FCWSnvty@ */ /end MEASUREMENT
/begin MEASUREMENT SwcOut_VAL_SysOut_NvM_Write.ICAOnOff "" UBYTE autosar_swc_val_CM_uint8 0 0 0 255 ECU_ADDRESS 0xfe4ca7f1 /* @ECU_Address@SwcOut_VAL_SysOut_NvM_Write.ICAOnOff@ */ /end MEASUREMENT
/begin MEASUREMENT SwcOut_VAL_SysOut_NvM_Write.IHCOnOff "" UBYTE autosar_swc_val_CM_uint8 0 0 0 255 ECU_ADDRESS 0xfe4ca7f0 /* @ECU_Address@SwcOut_VAL_SysOut_NvM_Write.IHCOnOff@ */ /end MEASUREMENT
/begin MEASUREMENT SwcOut_VAL_SysOut_NvM_Write.ISLOnOff "" UBYTE autosar_swc_val_CM_boolean 0 0 0 1 ECU_ADDRESS 0xfe4ca7e8 /* @ECU_Address@SwcOut_VAL_SysOut_NvM_Write.ISLOnOff@ */ /end MEASUREMENT
/begin MEASUREMENT SwcOut_VAL_SysOut_NvM_Write.IntellgntCurveOnOff "" UBYTE autosar_swc_val_CM_boolean 0 0 0 1 ECU_ADDRESS 0xfe4ca7e9 /* @ECU_Address@SwcOut_VAL_SysOut_NvM_Write.IntellgntCurveOnOff@ */ /end MEASUREMENT
/begin MEASUREMENT SwcOut_VAL_SysOut_NvM_Write.LASSnvtySet "" UBYTE autosar_swc_val_CM_uint8 0 0 0 255 ECU_ADDRESS 0xfe4ca7f4 /* @ECU_Address@SwcOut_VAL_SysOut_NvM_Write.LASSnvtySet@ */ /end MEASUREMENT
/begin MEASUREMENT SwcOut_VAL_SysOut_NvM_Write.LASWarnFormSwtReq "" UBYTE autosar_swc_val_CM_uint8 0 0 0 255 ECU_ADDRESS 0xfe4ca7f5 /* @ECU_Address@SwcOut_VAL_SysOut_NvM_Write.LASWarnFormSwtReq@ */ /end MEASUREMENT
/begin MEASUREMENT SwcOut_VAL_SysOut_NvM_Write.LCKIEOnOff "" UBYTE autosar_swc_val_CM_boolean 0 0 0 1 ECU_ADDRESS 0xfe4ca7e7 /* @ECU_Address@SwcOut_VAL_SysOut_NvM_Write.LCKIEOnOff@ */ /end MEASUREMENT
/begin MEASUREMENT SwcOut_VAL_SysOut_NvM_Write.LDWOnOff "" UBYTE autosar_swc_val_CM_boolean 0 0 0 1 ECU_ADDRESS 0xfe4ca7e2 /* @ECU_Address@SwcOut_VAL_SysOut_NvM_Write.LDWOnOff@ */ /end MEASUREMENT
/begin MEASUREMENT SwcOut_VAL_SysOut_NvM_Write.LKAOnOff "" UBYTE autosar_swc_val_CM_boolean 0 0 0 1 ECU_ADDRESS 0xfe4ca7e3 /* @ECU_Address@SwcOut_VAL_SysOut_NvM_Write.LKAOnOff@ */ /end MEASUREMENT
/begin MEASUREMENT SwcOut_VAL_SysOut_NvM_Write.NOHActReq "" UBYTE autosar_swc_val_CM_boolean 0 0 0 1 ECU_ADDRESS 0xfe4ca7e1 /* @ECU_Address@SwcOut_VAL_SysOut_NvM_Write.NOHActReq@ */ /end MEASUREMENT
/begin MEASUREMENT SwcOut_VAL_SysOut_NvM_Write.NOHOnOff "" UBYTE autosar_swc_val_CM_boolean 0 0 0 1 ECU_ADDRESS 0xfe4ca7e0 /* @ECU_Address@SwcOut_VAL_SysOut_NvM_Write.NOHOnOff@ */ /end MEASUREMENT
/begin MEASUREMENT SwcOut_VAL_SysOut_NvM_Write.Reserve "" UBYTE autosar_swc_val_CM_uint8 0 0 0 255 LAYOUT COLUMN_DIR MATRIX_DIM 72 ECU_ADDRESS 0xfe4ca818 /* @ECU_Address@SwcOut_VAL_SysOut_NvM_Write.Reserve@ */ /end MEASUREMENT
/begin MEASUREMENT SwcOut_VAL_SysOut_NvM_Write.SLAOnOff "" UBYTE autosar_swc_val_CM_uint8 0 0 0 255 ECU_ADDRESS 0xfe4ca7f2 /* @ECU_Address@SwcOut_VAL_SysOut_NvM_Write.SLAOnOff@ */ /end MEASUREMENT
/begin MEASUREMENT SwcOut_VAL_SysOut_NvM_Write.SLAWarnMod "" UBYTE autosar_swc_val_CM_uint8 0 0 0 255 ECU_ADDRESS 0xfe4ca7f3 /* @ECU_Address@SwcOut_VAL_SysOut_NvM_Write.SLAWarnMod@ */ /end MEASUREMENT
/begin MEASUREMENT SwcOut_VAL_SysOut_NvM_Write.SPL_SuppName_Value_Init "" UBYTE autosar_swc_val_CM_uint8 0 0 0 255 ECU_ADDRESS 0xfe4ca802 /* @ECU_Address@SwcOut_VAL_SysOut_NvM_Write.SPL_SuppName_Value_Init@ */ /end MEASUREMENT
/begin MEASUREMENT SwcOut_VAL_SysOut_NvM_Write.SPL_noSupp_Dist_Init "" FLOAT32_IEEE autosar_swc_val_CM_single 0 0 -3.4E+38 3.4E+38 ECU_ADDRESS 0xfe4ca80c /* @ECU_Address@SwcOut_VAL_SysOut_NvM_Write.SPL_noSupp_Dist_Init@ */ /end MEASUREMENT
/begin MEASUREMENT SwcOut_VAL_SysOut_NvM_Write.SPL_noSupp_Value_Init "" UBYTE autosar_swc_val_CM_uint8 0 0 0 255 ECU_ADDRESS 0xfe4ca7ff /* @ECU_Address@SwcOut_VAL_SysOut_NvM_Write.SPL_noSupp_Value_Init@ */ /end MEASUREMENT
/begin MEASUREMENT SwcOut_VAL_SysOut_NvM_Write.SPL_whSupp_Dist_Init "" FLOAT32_IEEE autosar_swc_val_CM_single 0 0 -3.4E+38 3.4E+38 ECU_ADDRESS 0xfe4ca810 /* @ECU_Address@SwcOut_VAL_SysOut_NvM_Write.SPL_whSupp_Dist_Init@ */ /end MEASUREMENT
/begin MEASUREMENT SwcOut_VAL_SysOut_NvM_Write.SPL_whSupp_Value_Init "" UBYTE autosar_swc_val_CM_uint8 0 0 0 255 ECU_ADDRESS 0xfe4ca800 /* @ECU_Address@SwcOut_VAL_SysOut_NvM_Write.SPL_whSupp_Value_Init@ */ /end MEASUREMENT
/begin MEASUREMENT SwcOut_VAL_SysOut_NvM_Write.SpeedLimitOnOff "" UBYTE autosar_swc_val_CM_uint8 0 0 0 255 ECU_ADDRESS 0xfe4ca7fe /* @ECU_Address@SwcOut_VAL_SysOut_NvM_Write.SpeedLimitOnOff@ */ /end MEASUREMENT
/begin MEASUREMENT SwcOut_VAL_SysOut_NvM_Write.SpeedLmtNumberAbs "" SBYTE autosar_swc_val_CM_int8 0 0 -128 127 ECU_ADDRESS 0xfe4ca7ed /* @ECU_Address@SwcOut_VAL_SysOut_NvM_Write.SpeedLmtNumberAbs@ */ /end MEASUREMENT
/begin MEASUREMENT SwcOut_VAL_SysOut_NvM_Write.SpeedLmtNumberPerct "" SBYTE autosar_swc_val_CM_int8 0 0 -128 127 ECU_ADDRESS 0xfe4ca7ee /* @ECU_Address@SwcOut_VAL_SysOut_NvM_Write.SpeedLmtNumberPerct@ */ /end MEASUREMENT
/begin MEASUREMENT SwcOut_VAL_SysOut_NvM_Write.SpeedLmtSnvtyMod "" UBYTE autosar_swc_val_CM_uint8 0 0 0 255 ECU_ADDRESS 0xfe4ca7ef /* @ECU_Address@SwcOut_VAL_SysOut_NvM_Write.SpeedLmtSnvtyMod@ */ /end MEASUREMENT
/begin MEASUREMENT SwcOut_VAL_SysOut_NvM_Write.SysOut_ACCStsInit "" UBYTE autosar_swc_val_CM_uint8 0 0 0 255 ECU_ADDRESS 0xfe4ca804 /* @ECU_Address@SwcOut_VAL_SysOut_NvM_Write.SysOut_ACCStsInit@ */ /end MEASUREMENT
/begin MEASUREMENT SwcOut_VAL_SysOut_NvM_Write.SysOut_ICASStsInit "" UBYTE autosar_swc_val_CM_uint8 0 0 0 255 ECU_ADDRESS 0xfe4ca805 /* @ECU_Address@SwcOut_VAL_SysOut_NvM_Write.SysOut_ICASStsInit@ */ /end MEASUREMENT
/begin MEASUREMENT SwcOut_VAL_SysOut_NvM_Write.SysOut_SteerAngOffsetInit "" FLOAT32_IEEE autosar_swc_val_CM_single 0 0 -3.4E+38 3.4E+38 ECU_ADDRESS 0xfe4ca808 /* @ECU_Address@SwcOut_VAL_SysOut_NvM_Write.SysOut_SteerAngOffsetInit@ */ /end MEASUREMENT
/begin MEASUREMENT SwcOut_VAL_SysOut_NvM_Write.SysOut_TimeGapInit "" UBYTE autosar_swc_val_CM_uint8 0 0 0 255 ECU_ADDRESS 0xfe4ca803 /* @ECU_Address@SwcOut_VAL_SysOut_NvM_Write.SysOut_TimeGapInit@ */ /end MEASUREMENT
/begin MEASUREMENT SwcOut_VAL_SysOut_NvM_Write.TJAICAExitTextInfoONOFF "" UBYTE autosar_swc_val_CM_uint8 0 0 0 255 ECU_ADDRESS 0xfe4ca7fd /* @ECU_Address@SwcOut_VAL_SysOut_NvM_Write.TJAICAExitTextInfoONOFF@ */ /end MEASUREMENT
/begin MEASUREMENT SwcOut_VAL_SysOut_NvM_Write.TLIOnOff "" UBYTE autosar_swc_val_CM_uint8 0 0 0 255 ECU_ADDRESS 0xfe4ca7f7 /* @ECU_Address@SwcOut_VAL_SysOut_NvM_Write.TLIOnOff@ */ /end MEASUREMENT
/begin MEASUREMENT SwcOut_VAL_SysOut_NvM_Write.TSROnOff "" UBYTE autosar_swc_val_CM_uint8 0 0 0 255 ECU_ADDRESS 0xfe4ca7f6 /* @ECU_Address@SwcOut_VAL_SysOut_NvM_Write.TSROnOff@ */ /end MEASUREMENT
/begin MEASUREMENT SwcOut_VAL_SysOut_NvM_Write.TS_SignName_Dist_Init "" FLOAT32_IEEE autosar_swc_val_CM_single 0 0 -3.4E+38 3.4E+38 ECU_ADDRESS 0xfe4ca814 /* @ECU_Address@SwcOut_VAL_SysOut_NvM_Write.TS_SignName_Dist_Init@ */ /end MEASUREMENT
/begin MEASUREMENT SwcOut_VAL_SysOut_NvM_Write.TS_SignName_Value_Init "" UBYTE autosar_swc_val_CM_uint8 0 0 0 255 ECU_ADDRESS 0xfe4ca801 /* @ECU_Address@SwcOut_VAL_SysOut_NvM_Write.TS_SignName_Value_Init@ */ /end MEASUREMENT
/begin MEASUREMENT SwcOut_VAL_SysOut_NvM_Write.Uint8_Reserve "" UBYTE autosar_swc_val_CM_uint8 0 0 0 255 LAYOUT COLUMN_DIR MATRIX_DIM 2 ECU_ADDRESS 0xfe4ca806 /* @ECU_Address@SwcOut_VAL_SysOut_NvM_Write.Uint8_Reserve@ */ /end MEASUREMENT
/begin MEASUREMENT SwcOut_VAL_SysOut_NvM_Write.VoiceRemindType "" UBYTE autosar_swc_val_CM_uint8 0 0 0 255 ECU_ADDRESS 0xfe4ca7fc /* @ECU_Address@SwcOut_VAL_SysOut_NvM_Write.VoiceRemindType@ */ /end MEASUREMENT
/begin MEASUREMENT SwcOut_VAL_VEHICLE_FUNC.ABPAvl "" UBYTE autosar_swc_val_CM_uint8 0 0 0 255 ECU_ADDRESS 0xfe4ca872 /* @ECU_Address@SwcOut_VAL_VEHICLE_FUNC.ABPAvl@ */ /end MEASUREMENT
/begin MEASUREMENT SwcOut_VAL_VEHICLE_FUNC.AVHSts "" UBYTE autosar_swc_val_CM_uint8 0 0 0 255 ECU_ADDRESS 0xfe4ca868 /* @ECU_Address@SwcOut_VAL_VEHICLE_FUNC.AVHSts@ */ /end MEASUREMENT
/begin MEASUREMENT SwcOut_VAL_VEHICLE_FUNC.AWBAvl "" UBYTE autosar_swc_val_CM_uint8 0 0 0 255 ECU_ADDRESS 0xfe4ca870 /* @ECU_Address@SwcOut_VAL_VEHICLE_FUNC.AWBAvl@ */ /end MEASUREMENT
/begin MEASUREMENT SwcOut_VAL_VEHICLE_FUNC.CDDActv "" UBYTE autosar_swc_val_CM_boolean 0 0 0 1 ECU_ADDRESS 0xfe4ca860 /* @ECU_Address@SwcOut_VAL_VEHICLE_FUNC.CDDActv@ */ /end MEASUREMENT
/begin MEASUREMENT SwcOut_VAL_VEHICLE_FUNC.DrvingMod "" UBYTE autosar_swc_val_CM_uint8 0 0 0 255 ECU_ADDRESS 0xfe4ca86c /* @ECU_Address@SwcOut_VAL_VEHICLE_FUNC.DrvingMod@ */ /end MEASUREMENT
/begin MEASUREMENT SwcOut_VAL_VEHICLE_FUNC.EPBSts "" UBYTE autosar_swc_val_CM_uint8 0 0 0 255 ECU_ADDRESS 0xfe4ca869 /* @ECU_Address@SwcOut_VAL_VEHICLE_FUNC.EPBSts@ */ /end MEASUREMENT
/begin MEASUREMENT SwcOut_VAL_VEHICLE_FUNC.ESPFuncActive "" UBYTE autosar_swc_val_CM_uint8 0 0 0 255 ECU_ADDRESS 0xfe4ca866 /* @ECU_Address@SwcOut_VAL_VEHICLE_FUNC.ESPFuncActive@ */ /end MEASUREMENT
/begin MEASUREMENT SwcOut_VAL_VEHICLE_FUNC.ESPFuncOffSts "" UBYTE autosar_swc_val_CM_uint8 0 0 0 255 ECU_ADDRESS 0xfe4ca865 /* @ECU_Address@SwcOut_VAL_VEHICLE_FUNC.ESPFuncOffSts@ */ /end MEASUREMENT
/begin MEASUREMENT SwcOut_VAL_VEHICLE_FUNC.FCTAAct "" UBYTE autosar_swc_val_CM_boolean 0 0 0 1 ECU_ADDRESS 0xfe4ca862 /* @ECU_Address@SwcOut_VAL_VEHICLE_FUNC.FCTAAct@ */ /end MEASUREMENT
/begin MEASUREMENT SwcOut_VAL_VEHICLE_FUNC.FCTBAct "" UBYTE autosar_swc_val_CM_boolean 0 0 0 1 ECU_ADDRESS 0xfe4ca861 /* @ECU_Address@SwcOut_VAL_VEHICLE_FUNC.FCTBAct@ */ /end MEASUREMENT
/begin MEASUREMENT SwcOut_VAL_VEHICLE_FUNC.HBAAvl "" UBYTE autosar_swc_val_CM_uint8 0 0 0 255 ECU_ADDRESS 0xfe4ca871 /* @ECU_Address@SwcOut_VAL_VEHICLE_FUNC.HBAAvl@ */ /end MEASUREMENT
/begin MEASUREMENT SwcOut_VAL_VEHICLE_FUNC.HDCCtrl "" UBYTE autosar_swc_val_CM_uint8 0 0 0 255 ECU_ADDRESS 0xfe4ca867 /* @ECU_Address@SwcOut_VAL_VEHICLE_FUNC.HDCCtrl@ */ /end MEASUREMENT
/begin MEASUREMENT SwcOut_VAL_VEHICLE_FUNC.HMASW "" UBYTE autosar_swc_val_CM_uint8 0 0 0 255 ECU_ADDRESS 0xfe4ca873 /* @ECU_Address@SwcOut_VAL_VEHICLE_FUNC.HMASW@ */ /end MEASUREMENT
/begin MEASUREMENT SwcOut_VAL_VEHICLE_FUNC.LIMITAct "" UBYTE autosar_swc_val_CM_boolean 0 0 0 1 ECU_ADDRESS 0xfe4ca864 /* @ECU_Address@SwcOut_VAL_VEHICLE_FUNC.LIMITAct@ */ /end MEASUREMENT
/begin MEASUREMENT SwcOut_VAL_VEHICLE_FUNC.ParkAct "" UBYTE autosar_swc_val_CM_boolean 0 0 0 1 ECU_ADDRESS 0xfe4ca863 /* @ECU_Address@SwcOut_VAL_VEHICLE_FUNC.ParkAct@ */ /end MEASUREMENT
/begin MEASUREMENT SwcOut_VAL_VEHICLE_FUNC.RadarBSDsts "" UBYTE autosar_swc_val_CM_uint8 0 0 0 255 ECU_ADDRESS 0xfe4ca86b /* @ECU_Address@SwcOut_VAL_VEHICLE_FUNC.RadarBSDsts@ */ /end MEASUREMENT
/begin MEASUREMENT SwcOut_VAL_VEHICLE_FUNC.RadarELKsts "" UBYTE autosar_swc_val_CM_uint8 0 0 0 255 ECU_ADDRESS 0xfe4ca86a /* @ECU_Address@SwcOut_VAL_VEHICLE_FUNC.RadarELKsts@ */ /end MEASUREMENT
/begin MEASUREMENT SwcOut_VAL_VEHICLE_FUNC.TimeStampMs "" A_UINT64 autosar_swc_val_CM_uint64 0 0 0.0 1.844674407370955e+19 ECU_ADDRESS 0xfe4ca878 /* @ECU_Address@SwcOut_VAL_VEHICLE_FUNC.TimeStampMs@ */ /end MEASUREMENT
/begin MEASUREMENT SwcOut_VAL_VEHICLE_FUNC.VehBrakeSysCtrlerResp "" UBYTE autosar_swc_val_CM_uint8 0 0 0 255 ECU_ADDRESS 0xfe4ca86e /* @ECU_Address@SwcOut_VAL_VEHICLE_FUNC.VehBrakeSysCtrlerResp@ */ /end MEASUREMENT
/begin MEASUREMENT SwcOut_VAL_VEHICLE_FUNC.VehPowerSysCtrlerResp "" UBYTE autosar_swc_val_CM_uint8 0 0 0 255 ECU_ADDRESS 0xfe4ca86d /* @ECU_Address@SwcOut_VAL_VEHICLE_FUNC.VehPowerSysCtrlerResp@ */ /end MEASUREMENT
/begin MEASUREMENT SwcOut_VAL_VEHICLE_FUNC.VehSteerSysCtrlerResp "" UBYTE autosar_swc_val_CM_uint8 0 0 0 255 ECU_ADDRESS 0xfe4ca86f /* @ECU_Address@SwcOut_VAL_VEHICLE_FUNC.VehSteerSysCtrlerResp@ */ /end MEASUREMENT
/begin MEASUREMENT SwcOut_VAL_VEHICLE_PARTS.AirBagSts "" UBYTE autosar_swc_val_CM_uint8 0 0 0 255 ECU_ADDRESS 0xfe4ca88c /* @ECU_Address@SwcOut_VAL_VEHICLE_PARTS.AirBagSts@ */ /end MEASUREMENT
/begin MEASUREMENT SwcOut_VAL_VEHICLE_PARTS.BrkDskOvrheatd "" UBYTE autosar_swc_val_CM_boolean 0 0 0 1 ECU_ADDRESS 0xfe4ca882 /* @ECU_Address@SwcOut_VAL_VEHICLE_PARTS.BrkDskOvrheatd@ */ /end MEASUREMENT
/begin MEASUREMENT SwcOut_VAL_VEHICLE_PARTS.CrashSts "" UBYTE autosar_swc_val_CM_uint8 0 0 0 255 ECU_ADDRESS 0xfe4ca88d /* @ECU_Address@SwcOut_VAL_VEHICLE_PARTS.CrashSts@ */ /end MEASUREMENT
/begin MEASUREMENT SwcOut_VAL_VEHICLE_PARTS.DrvDoorSts "" UBYTE autosar_swc_val_CM_uint8 0 0 0 255 ECU_ADDRESS 0xfe4ca883 /* @ECU_Address@SwcOut_VAL_VEHICLE_PARTS.DrvDoorSts@ */ /end MEASUREMENT
/begin MEASUREMENT SwcOut_VAL_VEHICLE_PARTS.DrvSBR "" UBYTE autosar_swc_val_CM_boolean 0 0 0 1 ECU_ADDRESS 0xfe4ca880 /* @ECU_Address@SwcOut_VAL_VEHICLE_PARTS.DrvSBR@ */ /end MEASUREMENT
/begin MEASUREMENT SwcOut_VAL_VEHICLE_PARTS.FFogLmpSts "" UBYTE autosar_swc_val_CM_uint8 0 0 0 255 ECU_ADDRESS 0xfe4ca885 /* @ECU_Address@SwcOut_VAL_VEHICLE_PARTS.FFogLmpSts@ */ /end MEASUREMENT
/begin MEASUREMENT SwcOut_VAL_VEHICLE_PARTS.FLTirePressureSts "" UBYTE autosar_swc_val_CM_uint8 0 0 0 255 ECU_ADDRESS 0xfe4ca893 /* @ECU_Address@SwcOut_VAL_VEHICLE_PARTS.FLTirePressureSts@ */ /end MEASUREMENT
/begin MEASUREMENT SwcOut_VAL_VEHICLE_PARTS.FRTirePressureSts "" UBYTE autosar_swc_val_CM_uint8 0 0 0 255 ECU_ADDRESS 0xfe4ca894 /* @ECU_Address@SwcOut_VAL_VEHICLE_PARTS.FRTirePressureSts@ */ /end MEASUREMENT
/begin MEASUREMENT SwcOut_VAL_VEHICLE_PARTS.FWiperSts "" UBYTE autosar_swc_val_CM_uint8 0 0 0 255 ECU_ADDRESS 0xfe4ca897 /* @ECU_Address@SwcOut_VAL_VEHICLE_PARTS.FWiperSts@ */ /end MEASUREMENT
/begin MEASUREMENT SwcOut_VAL_VEHICLE_PARTS.HazardLmpSts "" UBYTE autosar_swc_val_CM_uint8 0 0 0 255 ECU_ADDRESS 0xfe4ca892 /* @ECU_Address@SwcOut_VAL_VEHICLE_PARTS.HazardLmpSts@ */ /end MEASUREMENT
/begin MEASUREMENT SwcOut_VAL_VEHICLE_PARTS.HighBeamSts "" UBYTE autosar_swc_val_CM_uint8 0 0 0 255 ECU_ADDRESS 0xfe4ca890 /* @ECU_Address@SwcOut_VAL_VEHICLE_PARTS.HighBeamSts@ */ /end MEASUREMENT
/begin MEASUREMENT SwcOut_VAL_VEHICLE_PARTS.HoodSts "" UBYTE autosar_swc_val_CM_uint8 0 0 0 255 ECU_ADDRESS 0xfe4ca88a /* @ECU_Address@SwcOut_VAL_VEHICLE_PARTS.HoodSts@ */ /end MEASUREMENT
/begin MEASUREMENT SwcOut_VAL_VEHICLE_PARTS.LRDoorSts "" UBYTE autosar_swc_val_CM_uint8 0 0 0 255 ECU_ADDRESS 0xfe4ca889 /* @ECU_Address@SwcOut_VAL_VEHICLE_PARTS.LRDoorSts@ */ /end MEASUREMENT
/begin MEASUREMENT SwcOut_VAL_VEHICLE_PARTS.LTurnLmpSts "" UBYTE autosar_swc_val_CM_uint8 0 0 0 255 ECU_ADDRESS 0xfe4ca88e /* @ECU_Address@SwcOut_VAL_VEHICLE_PARTS.LTurnLmpSts@ */ /end MEASUREMENT
/begin MEASUREMENT SwcOut_VAL_VEHICLE_PARTS.LowBeamSts "" UBYTE autosar_swc_val_CM_uint8 0 0 0 255 ECU_ADDRESS 0xfe4ca891 /* @ECU_Address@SwcOut_VAL_VEHICLE_PARTS.LowBeamSts@ */ /end MEASUREMENT
/begin MEASUREMENT SwcOut_VAL_VEHICLE_PARTS.PassSBR "" UBYTE autosar_swc_val_CM_boolean 0 0 0 1 ECU_ADDRESS 0xfe4ca881 /* @ECU_Address@SwcOut_VAL_VEHICLE_PARTS.PassSBR@ */ /end MEASUREMENT
/begin MEASUREMENT SwcOut_VAL_VEHICLE_PARTS.PassengerDoorSts "" UBYTE autosar_swc_val_CM_uint8 0 0 0 255 ECU_ADDRESS 0xfe4ca884 /* @ECU_Address@SwcOut_VAL_VEHICLE_PARTS.PassengerDoorSts@ */ /end MEASUREMENT
/begin MEASUREMENT SwcOut_VAL_VEHICLE_PARTS.RFogLmpSts "" UBYTE autosar_swc_val_CM_uint8 0 0 0 255 ECU_ADDRESS 0xfe4ca886 /* @ECU_Address@SwcOut_VAL_VEHICLE_PARTS.RFogLmpSts@ */ /end MEASUREMENT
/begin MEASUREMENT SwcOut_VAL_VEHICLE_PARTS.RLTirePressureSts "" UBYTE autosar_swc_val_CM_uint8 0 0 0 255 ECU_ADDRESS 0xfe4ca895 /* @ECU_Address@SwcOut_VAL_VEHICLE_PARTS.RLTirePressureSts@ */ /end MEASUREMENT
/begin MEASUREMENT SwcOut_VAL_VEHICLE_PARTS.RRDoorSts "" UBYTE autosar_swc_val_CM_uint8 0 0 0 255 ECU_ADDRESS 0xfe4ca888 /* @ECU_Address@SwcOut_VAL_VEHICLE_PARTS.RRDoorSts@ */ /end MEASUREMENT
/begin MEASUREMENT SwcOut_VAL_VEHICLE_PARTS.RRTirePressureSts "" UBYTE autosar_swc_val_CM_uint8 0 0 0 255 ECU_ADDRESS 0xfe4ca896 /* @ECU_Address@SwcOut_VAL_VEHICLE_PARTS.RRTirePressureSts@ */ /end MEASUREMENT
/begin MEASUREMENT SwcOut_VAL_VEHICLE_PARTS.RTurnLmpSts "" UBYTE autosar_swc_val_CM_uint8 0 0 0 255 ECU_ADDRESS 0xfe4ca88f /* @ECU_Address@SwcOut_VAL_VEHICLE_PARTS.RTurnLmpSts@ */ /end MEASUREMENT
/begin MEASUREMENT SwcOut_VAL_VEHICLE_PARTS.TimeStampMs "" A_UINT64 autosar_swc_val_CM_uint64 0 0 0.0 1.844674407370955e+19 ECU_ADDRESS 0xfe4ca898 /* @ECU_Address@SwcOut_VAL_VEHICLE_PARTS.TimeStampMs@ */ /end MEASUREMENT
/begin MEASUREMENT SwcOut_VAL_VEHICLE_PARTS.TrailerSts "" UBYTE autosar_swc_val_CM_uint8 0 0 0 255 ECU_ADDRESS 0xfe4ca887 /* @ECU_Address@SwcOut_VAL_VEHICLE_PARTS.TrailerSts@ */ /end MEASUREMENT
/begin MEASUREMENT SwcOut_VAL_VEHICLE_PARTS.TrunkSts "" UBYTE autosar_swc_val_CM_uint8 0 0 0 255 ECU_ADDRESS 0xfe4ca88b /* @ECU_Address@SwcOut_VAL_VEHICLE_PARTS.TrunkSts@ */ /end MEASUREMENT
/begin MEASUREMENT SwcOut_VAL_VEHICLE_STATE.BlindTemp "" UBYTE autosar_swc_val_CM_boolean 0 0 0 1 ECU_ADDRESS 0xfe4ca8a6 /* @ECU_Address@SwcOut_VAL_VEHICLE_STATE.BlindTemp@ */ /end MEASUREMENT
/begin MEASUREMENT SwcOut_VAL_VEHICLE_STATE.CurrentGear "" UBYTE autosar_swc_val_CM_uint8 0 0 0 255 ECU_ADDRESS 0xfe4ca8a8 /* @ECU_Address@SwcOut_VAL_VEHICLE_STATE.CurrentGear@ */ /end MEASUREMENT
/begin MEASUREMENT SwcOut_VAL_VEHICLE_STATE.EngSpd "" FLOAT32_IEEE autosar_swc_val_CM_single 0 0 -3.4E+38 3.4E+38 ECU_ADDRESS 0xfe4ca8f0 /* @ECU_Address@SwcOut_VAL_VEHICLE_STATE.EngSpd@ */ /end MEASUREMENT
/begin MEASUREMENT SwcOut_VAL_VEHICLE_STATE.EngTrqMinAct "" FLOAT32_IEEE autosar_swc_val_CM_single 0 0 -3.4E+38 3.4E+38 ECU_ADDRESS 0xfe4ca8ec /* @ECU_Address@SwcOut_VAL_VEHICLE_STATE.EngTrqMinAct@ */ /end MEASUREMENT
/begin MEASUREMENT SwcOut_VAL_VEHICLE_STATE.EngTrqMinNm "" FLOAT32_IEEE autosar_swc_val_CM_single 0 0 -3.4E+38 3.4E+38 ECU_ADDRESS 0xfe4ca8e0 /* @ECU_Address@SwcOut_VAL_VEHICLE_STATE.EngTrqMinNm@ */ /end MEASUREMENT
/begin MEASUREMENT SwcOut_VAL_VEHICLE_STATE.EngTrqNm "" FLOAT32_IEEE autosar_swc_val_CM_single 0 0 -3.4E+38 3.4E+38 ECU_ADDRESS 0xfe4ca8dc /* @ECU_Address@SwcOut_VAL_VEHICLE_STATE.EngTrqNm@ */ /end MEASUREMENT
/begin MEASUREMENT SwcOut_VAL_VEHICLE_STATE.EngineOn "" UBYTE autosar_swc_val_CM_boolean 0 0 0 1 ECU_ADDRESS 0xfe4ca8a1 /* @ECU_Address@SwcOut_VAL_VEHICLE_STATE.EngineOn@ */ /end MEASUREMENT
/begin MEASUREMENT SwcOut_VAL_VEHICLE_STATE.FAShiftInProgress "" UBYTE autosar_swc_val_CM_boolean 0 0 0 1 ECU_ADDRESS 0xfe4ca8a2 /* @ECU_Address@SwcOut_VAL_VEHICLE_STATE.FAShiftInProgress@ */ /end MEASUREMENT
/begin MEASUREMENT SwcOut_VAL_VEHICLE_STATE.FLWheelPulseCounter "" ULONG autosar_swc_val_CM_uint32 0 0 0 4294967295 ECU_ADDRESS 0xfe4ca918 /* @ECU_Address@SwcOut_VAL_VEHICLE_STATE.FLWheelPulseCounter@ */ /end MEASUREMENT
/begin MEASUREMENT SwcOut_VAL_VEHICLE_STATE.FLWheelSpdMps "" FLOAT32_IEEE autosar_swc_val_CM_single 0 0 -3.4E+38 3.4E+38 ECU_ADDRESS 0xfe4ca8f4 /* @ECU_Address@SwcOut_VAL_VEHICLE_STATE.FLWheelSpdMps@ */ /end MEASUREMENT
/begin MEASUREMENT SwcOut_VAL_VEHICLE_STATE.FRWheelPulseCounter "" ULONG autosar_swc_val_CM_uint32 0 0 0 4294967295 ECU_ADDRESS 0xfe4ca91c /* @ECU_Address@SwcOut_VAL_VEHICLE_STATE.FRWheelPulseCounter@ */ /end MEASUREMENT
/begin MEASUREMENT SwcOut_VAL_VEHICLE_STATE.FRWheelSpdMps "" FLOAT32_IEEE autosar_swc_val_CM_single 0 0 -3.4E+38 3.4E+38 ECU_ADDRESS 0xfe4ca8f8 /* @ECU_Address@SwcOut_VAL_VEHICLE_STATE.FRWheelSpdMps@ */ /end MEASUREMENT
/begin MEASUREMENT SwcOut_VAL_VEHICLE_STATE.FourWhlsBrkTrq "" UWORD autosar_swc_val_CM_uint16 0 0 0 65535 ECU_ADDRESS 0xfe4ca8b2 /* @ECU_Address@SwcOut_VAL_VEHICLE_STATE.FourWhlsBrkTrq@ */ /end MEASUREMENT
/begin MEASUREMENT SwcOut_VAL_VEHICLE_STATE.GearSts "" UBYTE autosar_swc_val_CM_uint8 0 0 0 255 ECU_ADDRESS 0xfe4ca8aa /* @ECU_Address@SwcOut_VAL_VEHICLE_STATE.GearSts@ */ /end MEASUREMENT
/begin MEASUREMENT SwcOut_VAL_VEHICLE_STATE.IPVehSpdDispKph "" UWORD autosar_swc_val_CM_uint16 0 0 0 65535 ECU_ADDRESS 0xfe4ca8ae /* @ECU_Address@SwcOut_VAL_VEHICLE_STATE.IPVehSpdDispKph@ */ /end MEASUREMENT
/begin MEASUREMENT SwcOut_VAL_VEHICLE_STATE.IPVehSpdDispKphFloat "" FLOAT32_IEEE autosar_swc_val_CM_single 0 0 -3.4E+38 3.4E+38 ECU_ADDRESS 0xfe4ca8bc /* @ECU_Address@SwcOut_VAL_VEHICLE_STATE.IPVehSpdDispKphFloat@ */ /end MEASUREMENT
/begin MEASUREMENT SwcOut_VAL_VEHICLE_STATE.IPVehSpdDispMph "" UWORD autosar_swc_val_CM_uint16 0 0 0 65535 ECU_ADDRESS 0xfe4ca8b0 /* @ECU_Address@SwcOut_VAL_VEHICLE_STATE.IPVehSpdDispMph@ */ /end MEASUREMENT
/begin MEASUREMENT SwcOut_VAL_VEHICLE_STATE.IPVehSpdUnit "" UBYTE autosar_swc_val_CM_uint8 0 0 0 255 ECU_ADDRESS 0xfe4ca8ac /* @ECU_Address@SwcOut_VAL_VEHICLE_STATE.IPVehSpdUnit@ */ /end MEASUREMENT
/begin MEASUREMENT SwcOut_VAL_VEHICLE_STATE.LKACtrDlvdValue "" FLOAT32_IEEE autosar_swc_val_CM_single 0 0 -3.4E+38 3.4E+38 ECU_ADDRESS 0xfe4ca8e4 /* @ECU_Address@SwcOut_VAL_VEHICLE_STATE.LKACtrDlvdValue@ */ /end MEASUREMENT
/begin MEASUREMENT SwcOut_VAL_VEHICLE_STATE.MasterCylBrkPress "" FLOAT32_IEEE autosar_swc_val_CM_single 0 0 -3.4E+38 3.4E+38 ECU_ADDRESS 0xfe4ca8cc /* @ECU_Address@SwcOut_VAL_VEHICLE_STATE.MasterCylBrkPress@ */ /end MEASUREMENT
/begin MEASUREMENT SwcOut_VAL_VEHICLE_STATE.MaxEngTrqNorm "" UWORD autosar_swc_val_CM_uint16 0 0 0 65535 ECU_ADDRESS 0xfe4ca8b4 /* @ECU_Address@SwcOut_VAL_VEHICLE_STATE.MaxEngTrqNorm@ */ /end MEASUREMENT
/begin MEASUREMENT SwcOut_VAL_VEHICLE_STATE.NetEngTrq "" FLOAT32_IEEE autosar_swc_val_CM_single 0 0 -3.4E+38 3.4E+38 ECU_ADDRESS 0xfe4ca8e8 /* @ECU_Address@SwcOut_VAL_VEHICLE_STATE.NetEngTrq@ */ /end MEASUREMENT
/begin MEASUREMENT SwcOut_VAL_VEHICLE_STATE.NoBrakeForce "" UBYTE autosar_swc_val_CM_boolean 0 0 0 1 ECU_ADDRESS 0xfe4ca8a4 /* @ECU_Address@SwcOut_VAL_VEHICLE_STATE.NoBrakeForce@ */ /end MEASUREMENT
/begin MEASUREMENT SwcOut_VAL_VEHICLE_STATE.RAShiftInProgress "" UBYTE autosar_swc_val_CM_boolean 0 0 0 1 ECU_ADDRESS 0xfe4ca8a3 /* @ECU_Address@SwcOut_VAL_VEHICLE_STATE.RAShiftInProgress@ */ /end MEASUREMENT
/begin MEASUREMENT SwcOut_VAL_VEHICLE_STATE.RLWheelPulseCounter "" ULONG autosar_swc_val_CM_uint32 0 0 0 4294967295 ECU_ADDRESS 0xfe4ca920 /* @ECU_Address@SwcOut_VAL_VEHICLE_STATE.RLWheelPulseCounter@ */ /end MEASUREMENT
/begin MEASUREMENT SwcOut_VAL_VEHICLE_STATE.RLWheelSpdMps "" FLOAT32_IEEE autosar_swc_val_CM_single 0 0 -3.4E+38 3.4E+38 ECU_ADDRESS 0xfe4ca8fc /* @ECU_Address@SwcOut_VAL_VEHICLE_STATE.RLWheelSpdMps@ */ /end MEASUREMENT
/begin MEASUREMENT SwcOut_VAL_VEHICLE_STATE.RRWheelPulseCounter "" ULONG autosar_swc_val_CM_uint32 0 0 0 4294967295 ECU_ADDRESS 0xfe4ca924 /* @ECU_Address@SwcOut_VAL_VEHICLE_STATE.RRWheelPulseCounter@ */ /end MEASUREMENT
/begin MEASUREMENT SwcOut_VAL_VEHICLE_STATE.RRWheelSpdMps "" FLOAT32_IEEE autosar_swc_val_CM_single 0 0 -3.4E+38 3.4E+38 ECU_ADDRESS 0xfe4ca900 /* @ECU_Address@SwcOut_VAL_VEHICLE_STATE.RRWheelSpdMps@ */ /end MEASUREMENT
/begin MEASUREMENT SwcOut_VAL_VEHICLE_STATE.SensorVehLatAccelMps2 "" FLOAT32_IEEE autosar_swc_val_CM_single 0 0 -3.4E+38 3.4E+38 ECU_ADDRESS 0xfe4ca90c /* @ECU_Address@SwcOut_VAL_VEHICLE_STATE.SensorVehLatAccelMps2@ */ /end MEASUREMENT
/begin MEASUREMENT SwcOut_VAL_VEHICLE_STATE.SensorVehLonAccelMps2 "" FLOAT32_IEEE autosar_swc_val_CM_single 0 0 -3.4E+38 3.4E+38 ECU_ADDRESS 0xfe4ca908 /* @ECU_Address@SwcOut_VAL_VEHICLE_STATE.SensorVehLonAccelMps2@ */ /end MEASUREMENT
/begin MEASUREMENT SwcOut_VAL_VEHICLE_STATE.SensorVehYawRateRadps "" FLOAT32_IEEE autosar_swc_val_CM_single 0 0 -3.4E+38 3.4E+38 ECU_ADDRESS 0xfe4ca904 /* @ECU_Address@SwcOut_VAL_VEHICLE_STATE.SensorVehYawRateRadps@ */ /end MEASUREMENT
/begin MEASUREMENT SwcOut_VAL_VEHICLE_STATE.SteerWheelAngle "" FLOAT32_IEEE autosar_swc_val_CM_single 0 0 -3.4E+38 3.4E+38 ECU_ADDRESS 0xfe4ca8c0 /* @ECU_Address@SwcOut_VAL_VEHICLE_STATE.SteerWheelAngle@ */ /end MEASUREMENT
/begin MEASUREMENT SwcOut_VAL_VEHICLE_STATE.SteerWheelSpd "" FLOAT32_IEEE autosar_swc_val_CM_single 0 0 -3.4E+38 3.4E+38 ECU_ADDRESS 0xfe4ca8c4 /* @ECU_Address@SwcOut_VAL_VEHICLE_STATE.SteerWheelSpd@ */ /end MEASUREMENT
/begin MEASUREMENT SwcOut_VAL_VEHICLE_STATE.SteerWheelTor "" FLOAT32_IEEE autosar_swc_val_CM_single 0 0 -3.4E+38 3.4E+38 ECU_ADDRESS 0xfe4ca8c8 /* @ECU_Address@SwcOut_VAL_VEHICLE_STATE.SteerWheelTor@ */ /end MEASUREMENT
/begin MEASUREMENT SwcOut_VAL_VEHICLE_STATE.SysPowerMod "" UBYTE autosar_swc_val_CM_uint8 0 0 0 255 ECU_ADDRESS 0xfe4ca8ab /* @ECU_Address@SwcOut_VAL_VEHICLE_STATE.SysPowerMod@ */ /end MEASUREMENT
/begin MEASUREMENT SwcOut_VAL_VEHICLE_STATE.TargetGear "" UBYTE autosar_swc_val_CM_uint8 0 0 0 255 ECU_ADDRESS 0xfe4ca8a9 /* @ECU_Address@SwcOut_VAL_VEHICLE_STATE.TargetGear@ */ /end MEASUREMENT
/begin MEASUREMENT SwcOut_VAL_VEHICLE_STATE.TimeStampMs "" A_UINT64 autosar_swc_val_CM_uint64 0 0 0.0 1.844674407370955e+19 ECU_ADDRESS 0xfe4ca928 /* @ECU_Address@SwcOut_VAL_VEHICLE_STATE.TimeStampMs@ */ /end MEASUREMENT
/begin MEASUREMENT SwcOut_VAL_VEHICLE_STATE.TotalOdometer_km "" ULONG autosar_swc_val_CM_uint32 0 0 0 4294967295 ECU_ADDRESS 0xfe4ca914 /* @ECU_Address@SwcOut_VAL_VEHICLE_STATE.TotalOdometer_km@ */ /end MEASUREMENT
/begin MEASUREMENT SwcOut_VAL_VEHICLE_STATE.VCUTrqNm "" FLOAT32_IEEE autosar_swc_val_CM_single 0 0 -3.4E+38 3.4E+38 ECU_ADDRESS 0xfe4ca8d8 /* @ECU_Address@SwcOut_VAL_VEHICLE_STATE.VCUTrqNm@ */ /end MEASUREMENT
/begin MEASUREMENT SwcOut_VAL_VEHICLE_STATE.VLC_InternalTargetAcceleration "" FLOAT32_IEEE autosar_swc_val_CM_single 0 0 -3.4E+38 3.4E+38 ECU_ADDRESS 0xfe4ca910 /* @ECU_Address@SwcOut_VAL_VEHICLE_STATE.VLC_InternalTargetAcceleration@ */ /end MEASUREMENT
/begin MEASUREMENT SwcOut_VAL_VEHICLE_STATE.VLC_InternalTargetAccelerationValid "" UBYTE autosar_swc_val_CM_boolean 0 0 0 1 ECU_ADDRESS 0xfe4ca8a5 /* @ECU_Address@SwcOut_VAL_VEHICLE_STATE.VLC_InternalTargetAccelerationValid@ */ /end MEASUREMENT
/begin MEASUREMENT SwcOut_VAL_VEHICLE_STATE.VehSpdKph "" FLOAT32_IEEE autosar_swc_val_CM_single 0 0 -3.4E+38 3.4E+38 ECU_ADDRESS 0xfe4ca8b8 /* @ECU_Address@SwcOut_VAL_VEHICLE_STATE.VehSpdKph@ */ /end MEASUREMENT
/begin MEASUREMENT SwcOut_VAL_VEHICLE_STATE.VehStandstill "" UBYTE autosar_swc_val_CM_boolean 0 0 0 1 ECU_ADDRESS 0xfe4ca8a0 /* @ECU_Address@SwcOut_VAL_VEHICLE_STATE.VehStandstill@ */ /end MEASUREMENT
/begin MEASUREMENT SwcOut_VAL_VEHICLE_STATE.WheelPulseCounterValid "" UBYTE autosar_swc_val_CM_boolean 0 0 0 1 ECU_ADDRESS 0xfe4ca8a7 /* @ECU_Address@SwcOut_VAL_VEHICLE_STATE.WheelPulseCounterValid@ */ /end MEASUREMENT
/begin MEASUREMENT SwcOut_VAL_VEHICLE_STATE.WheelTrqMinNm "" FLOAT32_IEEE autosar_swc_val_CM_single 0 0 -3.4E+38 3.4E+38 ECU_ADDRESS 0xfe4ca8d4 /* @ECU_Address@SwcOut_VAL_VEHICLE_STATE.WheelTrqMinNm@ */ /end MEASUREMENT
/begin MEASUREMENT SwcOut_VAL_VEHICLE_STATE.WheelTrqNm "" FLOAT32_IEEE autosar_swc_val_CM_single 0 0 -3.4E+38 3.4E+38 ECU_ADDRESS 0xfe4ca8d0 /* @ECU_Address@SwcOut_VAL_VEHICLE_STATE.WheelTrqNm@ */ /end MEASUREMENT
/begin MEASUREMENT SwcOut_Virtual_ELKONOFFSts "" UBYTE autosar_swc_val_CM_boolean 0 0 0 1 ECU_ADDRESS 0xfe4cbcbb /* @ECU_Address@SwcOut_Virtual_ELKONOFFSts@ */ /end MEASUREMENT
/begin MEASUREMENT SwcOut_Virtual_LDPONOFFSts "" UBYTE autosar_swc_val_CM_boolean 0 0 0 1 ECU_ADDRESS 0xfe4cbcbc /* @ECU_Address@SwcOut_Virtual_LDPONOFFSts@ */ /end MEASUREMENT
/begin MEASUREMENT SwcOut_Virtual_LDWONOFFSts "" UBYTE autosar_swc_val_CM_boolean 0 0 0 1 ECU_ADDRESS 0xfe4cbcbd /* @ECU_Address@SwcOut_Virtual_LDWONOFFSts@ */ /end MEASUREMENT
/begin MEASUREMENT SwcOut_Virtual_SW "" UBYTE autosar_swc_val_CM_uint8 0 0 0 255 ECU_ADDRESS 0xfe4cbcbe /* @ECU_Address@SwcOut_Virtual_SW@ */ /end MEASUREMENT
/begin MEASUREMENT VAL_ExecTimestamp.nanoseconds "" ULONG autosar_swc_val_CM_uint32 0 0 0 4294967295 ECU_ADDRESS 0xfe4ca934 /* @ECU_Address@VAL_ExecTimestamp.nanoseconds@ */ /end MEASUREMENT
/begin MEASUREMENT VAL_ExecTimestamp.seconds "" A_UINT64 autosar_swc_val_CM_uint64 0 0 0.0 1.844674407370955e+19 ECU_ADDRESS 0xfe4ca938 /* @ECU_Address@VAL_ExecTimestamp.seconds@ */ /end MEASUREMENT
/begin MEASUREMENT VAL_ExecTimestamp.timeBaseStatus "" UBYTE autosar_swc_val_CM_uint8 0 0 0 255 ECU_ADDRESS 0xfe4ca930 /* @ECU_Address@VAL_ExecTimestamp.timeBaseStatus@ */ /end MEASUREMENT
/begin MEASUREMENT VAL_UpdateCnt "" UBYTE autosar_swc_val_CM_uint8 0 0 0 255 ECU_ADDRESS 0xfe4cbcbf /* @ECU_Address@VAL_UpdateCnt@ */ /end MEASUREMENT
/begin MEASUREMENT VAL_Version "" ULONG autosar_swc_val_CM_uint32 0 0 0 4294967295 ECU_ADDRESS 0xfe4cba5c /* @ECU_Address@VAL_Version@ */ /end MEASUREMENT
/begin MEASUREMENT VehConfig_Code1 "" ULONG autosar_swc_val_CM_uint32 0 0 0 4294967295 ECU_ADDRESS 0xfe4cba60 /* @ECU_Address@VehConfig_Code1@ */ /end MEASUREMENT
/begin MEASUREMENT VehConfig_Code2 "" ULONG autosar_swc_val_CM_uint32 0 0 0 4294967295 ECU_ADDRESS 0xfe4cba64 /* @ECU_Address@VehConfig_Code2@ */ /end MEASUREMENT
/begin MEASUREMENT autosar_swc_val_rtARID_DEF.ADS_1_DrvTarTqVld "" UBYTE autosar_swc_val_CM_ADS_1_DrvTarTqVld_359_dt 0 0 0 255 ECU_ADDRESS 0xfe4cb60f /* @ECU_Address@autosar_swc_val_rtARID_DEF.ADS_1_DrvTarTqVld@ */ /end MEASUREMENT
/begin MEASUREMENT autosar_swc_val_rtARID_DEF.ADS_1_SteerAgVld "" UBYTE autosar_swc_val_CM_uint8 0 0 0 255 ECU_ADDRESS 0xfe4cb60d /* @ECU_Address@autosar_swc_val_rtARID_DEF.ADS_1_SteerAgVld@ */ /end MEASUREMENT
/begin MEASUREMENT autosar_swc_val_rtARID_DEF.BusAssignment.ADS_1_ADSHealthSts "" UBYTE autosar_swc_val_CM_ADS_1_ADSHealthSts_405_dt 0 0 0 255 ECU_ADDRESS 0xfe4cb338 /* @ECU_Address@autosar_swc_val_rtARID_DEF.BusAssignment.ADS_1_ADSHealthSts@ */ /end MEASUREMENT
/begin MEASUREMENT autosar_swc_val_rtARID_DEF.BusAssignment.ADS_1_CRC1 "" UBYTE autosar_swc_val_CM_ADS_1_CRC1_405_dt 0 0 0 255 ECU_ADDRESS 0xfe4cb320 /* @ECU_Address@autosar_swc_val_rtARID_DEF.BusAssignment.ADS_1_CRC1@ */ /end MEASUREMENT
/begin MEASUREMENT autosar_swc_val_rtARID_DEF.BusAssignment.ADS_1_CRC2 "" UBYTE autosar_swc_val_CM_ADS_1_CRC2_405_dt 0 0 0 255 ECU_ADDRESS 0xfe4cb32a /* @ECU_Address@autosar_swc_val_rtARID_DEF.BusAssignment.ADS_1_CRC2@ */ /end MEASUREMENT
/begin MEASUREMENT autosar_swc_val_rtARID_DEF.BusAssignment.ADS_1_LdwWarningCmd "" UBYTE autosar_swc_val_CM_ADS_1_LdwWarningCmd_405_dt 0 0 0 255 ECU_ADDRESS 0xfe4cb32e /* @ECU_Address@autosar_swc_val_rtARID_DEF.BusAssignment.ADS_1_LdwWarningCmd@ */ /end MEASUREMENT
/begin MEASUREMENT autosar_swc_val_rtARID_DEF.BusAssignment.ADS_1_LdwWarningCmdVld "" UBYTE autosar_swc_val_CM_ADS_1_LdwWarningCmdVld_405_dt 0 0 0 255 ECU_ADDRESS 0xfe4cb32f /* @ECU_Address@autosar_swc_val_rtARID_DEF.BusAssignment.ADS_1_LdwWarningCmdVld@ */ /end MEASUREMENT
/begin MEASUREMENT autosar_swc_val_rtARID_DEF.BusAssignment.ADS_1_Resd1 "" UBYTE autosar_swc_val_CM_ADS_1_Resd1_405_dt 0 0 0 255 ECU_ADDRESS 0xfe4cb322 /* @ECU_Address@autosar_swc_val_rtARID_DEF.BusAssignment.ADS_1_Resd1@ */ /end MEASUREMENT
/begin MEASUREMENT autosar_swc_val_rtARID_DEF.BusAssignment.ADS_1_Resd2 "" UBYTE autosar_swc_val_CM_ADS_1_Resd2_405_dt 0 0 0 255 ECU_ADDRESS 0xfe4cb32c /* @ECU_Address@autosar_swc_val_rtARID_DEF.BusAssignment.ADS_1_Resd2@ */ /end MEASUREMENT
/begin MEASUREMENT autosar_swc_val_rtARID_DEF.BusAssignment.ADS_1_RollgCntr1 "" UBYTE autosar_swc_val_CM_ADS_1_RollgCntr1_405_dt 0 0 0 255 ECU_ADDRESS 0xfe4cb321 /* @ECU_Address@autosar_swc_val_rtARID_DEF.BusAssignment.ADS_1_RollgCntr1@ */ /end MEASUREMENT
/begin MEASUREMENT autosar_swc_val_rtARID_DEF.BusAssignment.ADS_1_RollgCntr2 "" UBYTE autosar_swc_val_CM_ADS_1_RollgCntr2_405_dt 0 0 0 255 ECU_ADDRESS 0xfe4cb32b /* @ECU_Address@autosar_swc_val_rtARID_DEF.BusAssignment.ADS_1_RollgCntr2@ */ /end MEASUREMENT
/begin MEASUREMENT autosar_swc_val_rtARID_DEF.BusAssignment.ADS_1_SteerAgReq "" FLOAT32_IEEE autosar_swc_val_CM_ADS_1_SteerAgReq_405_dt 0 0 -3.4E+38 3.4E+38 ECU_ADDRESS 0xfe4cb324 /* @ECU_Address@autosar_swc_val_rtARID_DEF.BusAssignment.ADS_1_SteerAgReq@ */ /end MEASUREMENT
/begin MEASUREMENT autosar_swc_val_rtARID_DEF.BusAssignment.ADS_1_SteerAgVld "" UBYTE autosar_swc_val_CM_ADS_1_SteerAgVld_405_dt 0 0 0 255 ECU_ADDRESS 0xfe4cb328 /* @ECU_Address@autosar_swc_val_rtARID_DEF.BusAssignment.ADS_1_SteerAgVld@ */ /end MEASUREMENT
/begin MEASUREMENT autosar_swc_val_rtARID_DEF.BusAssignment.ADS_1_SteerMaxTqReq "" FLOAT32_IEEE autosar_swc_val_CM_ADS_1_SteerMaxTqReq_405_dt 0 0 -3.4E+38 3.4E+38 ECU_ADDRESS 0xfe4cb330 /* @ECU_Address@autosar_swc_val_rtARID_DEF.BusAssignment.ADS_1_SteerMaxTqReq@ */ /end MEASUREMENT
/begin MEASUREMENT autosar_swc_val_rtARID_DEF.BusAssignment.ADS_1_SteerMinTqReq "" FLOAT32_IEEE autosar_swc_val_CM_ADS_1_SteerMinTqReq_405_dt 0 0 -3.4E+38 3.4E+38 ECU_ADDRESS 0xfe4cb334 /* @ECU_Address@autosar_swc_val_rtARID_DEF.BusAssignment.ADS_1_SteerMinTqReq@ */ /end MEASUREMENT
/begin MEASUREMENT autosar_swc_val_rtARID_DEF.BusAssignment.ADS_1_SteerPilotAgEna "" UBYTE autosar_swc_val_CM_ADS_1_SteerPilotAgEna_405_dt 0 0 0 255 ECU_ADDRESS 0xfe4cb329 /* @ECU_Address@autosar_swc_val_rtARID_DEF.BusAssignment.ADS_1_SteerPilotAgEna@ */ /end MEASUREMENT
/begin MEASUREMENT autosar_swc_val_rtARID_DEF.BusAssignment.ADS_1_SteerTqEna "" UBYTE autosar_swc_val_CM_ADS_1_SteerTqEna_405_dt 0 0 0 255 ECU_ADDRESS 0xfe4cb32d /* @ECU_Address@autosar_swc_val_rtARID_DEF.BusAssignment.ADS_1_SteerTqEna@ */ /end MEASUREMENT
/begin MEASUREMENT autosar_swc_val_rtARID_DEF.BusAssignment.CutOutFreshvalues_2CB_S "" UWORD autosar_swc_val_CM_CutOutFreshvalues_2CB_S_405_dt 0 0 0 65535 ECU_ADDRESS 0xfe4cb33a /* @ECU_Address@autosar_swc_val_rtARID_DEF.BusAssignment.CutOutFreshvalues_2CB_S@ */ /end MEASUREMENT
/begin MEASUREMENT autosar_swc_val_rtARID_DEF.BusAssignment.CutOutMAC_2CB_S "" A_UINT64 autosar_swc_val_CM_CutOutMAC_2CB_S_405_dt 0 0 0.0 1.844674407370955e+19 ECU_ADDRESS 0xfe4cb340 /* @ECU_Address@autosar_swc_val_rtARID_DEF.BusAssignment.CutOutMAC_2CB_S@ */ /end MEASUREMENT
/begin MEASUREMENT autosar_swc_val_rtARID_DEF.Cnt "" UBYTE autosar_swc_val_CM_uint8 0 0 0 255 ECU_ADDRESS 0xfe4cb614 /* @ECU_Address@autosar_swc_val_rtARID_DEF.Cnt@ */ /end MEASUREMENT
/begin MEASUREMENT autosar_swc_val_rtARID_DEF.Cnt_a "" UBYTE autosar_swc_val_CM_uint8 0 0 0 255 ECU_ADDRESS 0xfe4cb650 /* @ECU_Address@autosar_swc_val_rtARID_DEF.Cnt_a@ */ /end MEASUREMENT
/begin MEASUREMENT autosar_swc_val_rtARID_DEF.Cnt_b "" UBYTE autosar_swc_val_CM_uint8 0 0 0 255 ECU_ADDRESS 0xfe4cb648 /* @ECU_Address@autosar_swc_val_rtARID_DEF.Cnt_b@ */ /end MEASUREMENT
/begin MEASUREMENT autosar_swc_val_rtARID_DEF.Cnt_h "" UBYTE autosar_swc_val_CM_uint8 0 0 0 255 ECU_ADDRESS 0xfe4cb644 /* @ECU_Address@autosar_swc_val_rtARID_DEF.Cnt_h@ */ /end MEASUREMENT
/begin MEASUREMENT autosar_swc_val_rtARID_DEF.Cnt_l "" UBYTE autosar_swc_val_CM_uint8 0 0 0 255 ECU_ADDRESS 0xfe4cb64c /* @ECU_Address@autosar_swc_val_rtARID_DEF.Cnt_l@ */ /end MEASUREMENT
/begin MEASUREMENT autosar_swc_val_rtARID_DEF.Cruise_LongPush "" UBYTE autosar_swc_val_CM_uint8 0 0 0 255 ECU_ADDRESS 0xfe4cb5fa /* @ECU_Address@autosar_swc_val_rtARID_DEF.Cruise_LongPush@ */ /end MEASUREMENT
/begin MEASUREMENT autosar_swc_val_rtARID_DEF.DelayInput1_DSTATE "" SBYTE autosar_swc_val_CM_int8 0 0 -128 127 ECU_ADDRESS 0xfe4cb5f2 /* @ECU_Address@autosar_swc_val_rtARID_DEF.DelayInput1_DSTATE@ */ /end MEASUREMENT
/begin MEASUREMENT autosar_swc_val_rtARID_DEF.DelayInput1_DSTATE_a "" UBYTE autosar_swc_val_CM_logical 0 0 0 1 ECU_ADDRESS 0xfe4cb660 /* @ECU_Address@autosar_swc_val_rtARID_DEF.DelayInput1_DSTATE_a@ */ /end MEASUREMENT
/begin MEASUREMENT autosar_swc_val_rtARID_DEF.DelayInput1_DSTATE_c "" UBYTE autosar_swc_val_CM_logical 0 0 0 1 ECU_ADDRESS 0xfe4cb65f /* @ECU_Address@autosar_swc_val_rtARID_DEF.DelayInput1_DSTATE_c@ */ /end MEASUREMENT
/begin MEASUREMENT autosar_swc_val_rtARID_DEF.DelayInput1_DSTATE_d "" UBYTE autosar_swc_val_CM_logical 0 0 0 1 ECU_ADDRESS 0xfe4cb667 /* @ECU_Address@autosar_swc_val_rtARID_DEF.DelayInput1_DSTATE_d@ */ /end MEASUREMENT
/begin MEASUREMENT autosar_swc_val_rtARID_DEF.DelayInput1_DSTATE_dx "" UBYTE autosar_swc_val_CM_logical 0 0 0 1 ECU_ADDRESS 0xfe4cb668 /* @ECU_Address@autosar_swc_val_rtARID_DEF.DelayInput1_DSTATE_dx@ */ /end MEASUREMENT
/begin MEASUREMENT autosar_swc_val_rtARID_DEF.DelayInput1_DSTATE_f "" UBYTE autosar_swc_val_CM_logical 0 0 0 1 ECU_ADDRESS 0xfe4cb666 /* @ECU_Address@autosar_swc_val_rtARID_DEF.DelayInput1_DSTATE_f@ */ /end MEASUREMENT
/begin MEASUREMENT autosar_swc_val_rtARID_DEF.DelayInput1_DSTATE_h "" UBYTE autosar_swc_val_CM_logical 0 0 0 1 ECU_ADDRESS 0xfe4cb662 /* @ECU_Address@autosar_swc_val_rtARID_DEF.DelayInput1_DSTATE_h@ */ /end MEASUREMENT
/begin MEASUREMENT autosar_swc_val_rtARID_DEF.DelayInput1_DSTATE_i "" UBYTE autosar_swc_val_CM_logical 0 0 0 1 ECU_ADDRESS 0xfe4cb665 /* @ECU_Address@autosar_swc_val_rtARID_DEF.DelayInput1_DSTATE_i@ */ /end MEASUREMENT
/begin MEASUREMENT autosar_swc_val_rtARID_DEF.DelayInput1_DSTATE_j "" SBYTE autosar_swc_val_CM_int8 0 0 -128 127 ECU_ADDRESS 0xfe4cb5f4 /* @ECU_Address@autosar_swc_val_rtARID_DEF.DelayInput1_DSTATE_j@ */ /end MEASUREMENT
/begin MEASUREMENT autosar_swc_val_rtARID_DEF.DelayInput1_DSTATE_k "" UBYTE autosar_swc_val_CM_logical 0 0 0 1 ECU_ADDRESS 0xfe4cb661 /* @ECU_Address@autosar_swc_val_rtARID_DEF.DelayInput1_DSTATE_k@ */ /end MEASUREMENT
/begin MEASUREMENT autosar_swc_val_rtARID_DEF.DelayInput1_DSTATE_l "" UBYTE autosar_swc_val_CM_logical 0 0 0 1 ECU_ADDRESS 0xfe4cb663 /* @ECU_Address@autosar_swc_val_rtARID_DEF.DelayInput1_DSTATE_l@ */ /end MEASUREMENT
/begin MEASUREMENT autosar_swc_val_rtARID_DEF.Delay_DSTATE "" FLOAT32_IEEE autosar_swc_val_CM_single 0 0 -3.4E+38 3.4E+38 LAYOUT COLUMN_DIR MATRIX_DIM 2 ECU_ADDRESS 0xfe4cb5e0 /* @ECU_Address@autosar_swc_val_rtARID_DEF.Delay_DSTATE@ */ /end MEASUREMENT
/begin MEASUREMENT autosar_swc_val_rtARID_DEF.Delay_DSTATE_m "" FLOAT32_IEEE autosar_swc_val_CM_FCM_3_PilotkBrkDecTar_330_dt 0 0 -3.4E+38 3.4E+38 ECU_ADDRESS 0xfe4cb5ec /* @ECU_Address@autosar_swc_val_rtARID_DEF.Delay_DSTATE_m@ */ /end MEASUREMENT
/begin MEASUREMENT autosar_swc_val_rtARID_DEF.FCM_3_PilotBrkDecTarVld "" UBYTE autosar_swc_val_CM_FCM_3_PilotBrkDecTarVld_330_dt 0 0 0 255 ECU_ADDRESS 0xfe4cb60e /* @ECU_Address@autosar_swc_val_rtARID_DEF.FCM_3_PilotBrkDecTarVld@ */ /end MEASUREMENT
/begin MEASUREMENT autosar_swc_val_rtARID_DEF.FunSts "" UBYTE autosar_swc_val_CM_uint8 0 0 0 255 ECU_ADDRESS 0xfe4cb600 /* @ECU_Address@autosar_swc_val_rtARID_DEF.FunSts@ */ /end MEASUREMENT
/begin MEASUREMENT autosar_swc_val_rtARID_DEF.FunSts_b "" UBYTE autosar_swc_val_CM_uint8 0 0 0 255 ECU_ADDRESS 0xfe4cb60b /* @ECU_Address@autosar_swc_val_rtARID_DEF.FunSts_b@ */ /end MEASUREMENT
/begin MEASUREMENT autosar_swc_val_rtARID_DEF.FunSts_c "" UBYTE autosar_swc_val_CM_uint8 0 0 0 255 ECU_ADDRESS 0xfe4cb604 /* @ECU_Address@autosar_swc_val_rtARID_DEF.FunSts_c@ */ /end MEASUREMENT
/begin MEASUREMENT autosar_swc_val_rtARID_DEF.FunSts_c4 "" UBYTE autosar_swc_val_CM_uint8 0 0 0 255 ECU_ADDRESS 0xfe4cb60c /* @ECU_Address@autosar_swc_val_rtARID_DEF.FunSts_c4@ */ /end MEASUREMENT
/begin MEASUREMENT autosar_swc_val_rtARID_DEF.FunSts_d "" UBYTE autosar_swc_val_CM_uint8 0 0 0 255 ECU_ADDRESS 0xfe4cb607 /* @ECU_Address@autosar_swc_val_rtARID_DEF.FunSts_d@ */ /end MEASUREMENT
/begin MEASUREMENT autosar_swc_val_rtARID_DEF.FunSts_ei "" UBYTE autosar_swc_val_CM_uint8 0 0 0 255 ECU_ADDRESS 0xfe4cb608 /* @ECU_Address@autosar_swc_val_rtARID_DEF.FunSts_ei@ */ /end MEASUREMENT
/begin MEASUREMENT autosar_swc_val_rtARID_DEF.FunSts_f "" UBYTE autosar_swc_val_CM_uint8 0 0 0 255 ECU_ADDRESS 0xfe4cb60a /* @ECU_Address@autosar_swc_val_rtARID_DEF.FunSts_f@ */ /end MEASUREMENT
/begin MEASUREMENT autosar_swc_val_rtARID_DEF.FunSts_g "" UBYTE autosar_swc_val_CM_uint8 0 0 0 255 ECU_ADDRESS 0xfe4cb602 /* @ECU_Address@autosar_swc_val_rtARID_DEF.FunSts_g@ */ /end MEASUREMENT
/begin MEASUREMENT autosar_swc_val_rtARID_DEF.FunSts_gr "" UBYTE autosar_swc_val_CM_uint8 0 0 0 255 ECU_ADDRESS 0xfe4cb606 /* @ECU_Address@autosar_swc_val_rtARID_DEF.FunSts_gr@ */ /end MEASUREMENT
/begin MEASUREMENT autosar_swc_val_rtARID_DEF.FunSts_h "" UBYTE autosar_swc_val_CM_uint8 0 0 0 255 ECU_ADDRESS 0xfe4cb605 /* @ECU_Address@autosar_swc_val_rtARID_DEF.FunSts_h@ */ /end MEASUREMENT
/begin MEASUREMENT autosar_swc_val_rtARID_DEF.FunSts_k "" UBYTE autosar_swc_val_CM_uint8 0 0 0 255 ECU_ADDRESS 0xfe4cb601 /* @ECU_Address@autosar_swc_val_rtARID_DEF.FunSts_k@ */ /end MEASUREMENT
/begin MEASUREMENT autosar_swc_val_rtARID_DEF.FunSts_l "" UBYTE autosar_swc_val_CM_uint8 0 0 0 255 ECU_ADDRESS 0xfe4cb609 /* @ECU_Address@autosar_swc_val_rtARID_DEF.FunSts_l@ */ /end MEASUREMENT
/begin MEASUREMENT autosar_swc_val_rtARID_DEF.FunSts_n "" UBYTE autosar_swc_val_CM_uint8 0 0 0 255 ECU_ADDRESS 0xfe4cb603 /* @ECU_Address@autosar_swc_val_rtARID_DEF.FunSts_n@ */ /end MEASUREMENT
/begin MEASUREMENT autosar_swc_val_rtARID_DEF.HandsOff "" UBYTE autosar_swc_val_CM_uint8 0 0 0 255 ECU_ADDRESS 0xfe4cb5f8 /* @ECU_Address@autosar_swc_val_rtARID_DEF.HandsOff@ */ /end MEASUREMENT
/begin MEASUREMENT autosar_swc_val_rtARID_DEF.HandsOff_l "" UBYTE autosar_swc_val_CM_uint8 0 0 0 255 ECU_ADDRESS 0xfe4cb5f9 /* @ECU_Address@autosar_swc_val_rtARID_DEF.HandsOff_l@ */ /end MEASUREMENT
/begin MEASUREMENT autosar_swc_val_rtARID_DEF.HazardLightReq "" UBYTE autosar_swc_val_CM_uint8 0 0 0 255 ECU_ADDRESS 0xfe4cb611 /* @ECU_Address@autosar_swc_val_rtARID_DEF.HazardLightReq@ */ /end MEASUREMENT
/begin MEASUREMENT autosar_swc_val_rtARID_DEF.Lsts "" UBYTE autosar_swc_val_CM_uint8 0 0 0 255 ECU_ADDRESS 0xfe4cb5f6 /* @ECU_Address@autosar_swc_val_rtARID_DEF.Lsts@ */ /end MEASUREMENT
/begin MEASUREMENT autosar_swc_val_rtARID_DEF.Lsts_c "" UBYTE autosar_swc_val_CM_uint8 0 0 0 255 ECU_ADDRESS 0xfe4cb5f7 /* @ECU_Address@autosar_swc_val_rtARID_DEF.Lsts_c@ */ /end MEASUREMENT
/begin MEASUREMENT autosar_swc_val_rtARID_DEF.Output_DSTATE "" UBYTE autosar_swc_val_CM_uint8 0 0 0 255 ECU_ADDRESS 0xfe4cb612 /* @ECU_Address@autosar_swc_val_rtARID_DEF.Output_DSTATE@ */ /end MEASUREMENT
/begin MEASUREMENT autosar_swc_val_rtARID_DEF.Output_DSTATE_d "" UBYTE autosar_swc_val_CM_uint8 0 0 0 255 ECU_ADDRESS 0xfe4cb613 /* @ECU_Address@autosar_swc_val_rtARID_DEF.Output_DSTATE_d@ */ /end MEASUREMENT
/begin MEASUREMENT autosar_swc_val_rtARID_DEF.ResumePulse "" UBYTE autosar_swc_val_CM_logical 0 0 0 1 ECU_ADDRESS 0xfe4cb65b /* @ECU_Address@autosar_swc_val_rtARID_DEF.ResumePulse@ */ /end MEASUREMENT
/begin MEASUREMENT autosar_swc_val_rtARID_DEF.SftyOvrdKeptTi "" UBYTE autosar_swc_val_CM_uint8 0 0 0 255 ECU_ADDRESS 0xfe4cb645 /* @ECU_Address@autosar_swc_val_rtARID_DEF.SftyOvrdKeptTi@ */ /end MEASUREMENT
/begin MEASUREMENT autosar_swc_val_rtARID_DEF.SftyOvrdKeptTi_b "" UBYTE autosar_swc_val_CM_uint8 0 0 0 255 ECU_ADDRESS 0xfe4cb64d /* @ECU_Address@autosar_swc_val_rtARID_DEF.SftyOvrdKeptTi_b@ */ /end MEASUREMENT
/begin MEASUREMENT autosar_swc_val_rtARID_DEF.SftyOvrdKeptTi_k "" UBYTE autosar_swc_val_CM_uint8 0 0 0 255 ECU_ADDRESS 0xfe4cb649 /* @ECU_Address@autosar_swc_val_rtARID_DEF.SftyOvrdKeptTi_k@ */ /end MEASUREMENT
/begin MEASUREMENT autosar_swc_val_rtARID_DEF.Time "" UBYTE autosar_swc_val_CM_uint8 0 0 0 255 ECU_ADDRESS 0xfe4cb621 /* @ECU_Address@autosar_swc_val_rtARID_DEF.Time@ */ /end MEASUREMENT
/begin MEASUREMENT autosar_swc_val_rtARID_DEF.TimeCnt "" UBYTE autosar_swc_val_CM_uint8 0 0 0 255 ECU_ADDRESS 0xfe4cb617 /* @ECU_Address@autosar_swc_val_rtARID_DEF.TimeCnt@ */ /end MEASUREMENT
/begin MEASUREMENT autosar_swc_val_rtARID_DEF.TimeCnt_n "" UBYTE autosar_swc_val_CM_uint8 0 0 0 255 ECU_ADDRESS 0xfe4cb61a /* @ECU_Address@autosar_swc_val_rtARID_DEF.TimeCnt_n@ */ /end MEASUREMENT
/begin MEASUREMENT autosar_swc_val_rtARID_DEF.TimeGap "" UBYTE autosar_swc_val_CM_uint8 0 0 0 255 ECU_ADDRESS 0xfe4cb610 /* @ECU_Address@autosar_swc_val_rtARID_DEF.TimeGap@ */ /end MEASUREMENT
/begin MEASUREMENT autosar_swc_val_rtARID_DEF.UnitDelay1_DSTATE "" SBYTE autosar_swc_val_CM_int8 0 0 -128 127 ECU_ADDRESS 0xfe4cb5f3 /* @ECU_Address@autosar_swc_val_rtARID_DEF.UnitDelay1_DSTATE@ */ /end MEASUREMENT
/begin MEASUREMENT autosar_swc_val_rtARID_DEF.UnitDelay1_DSTATE_c "" UBYTE autosar_swc_val_CM_logical 0 0 0 1 ECU_ADDRESS 0xfe4cb664 /* @ECU_Address@autosar_swc_val_rtARID_DEF.UnitDelay1_DSTATE_c@ */ /end MEASUREMENT
/begin MEASUREMENT autosar_swc_val_rtARID_DEF.UnitDelay_DSTATE "" FLOAT32_IEEE autosar_swc_val_CM_single 0 0 -3.4E+38 3.4E+38 ECU_ADDRESS 0xfe4cb5e8 /* @ECU_Address@autosar_swc_val_rtARID_DEF.UnitDelay_DSTATE@ */ /end MEASUREMENT
/begin MEASUREMENT autosar_swc_val_rtARID_DEF.UnitDelay_DSTATE_n "" SBYTE autosar_swc_val_CM_int8 0 0 -128 127 ECU_ADDRESS 0xfe4cb5f5 /* @ECU_Address@autosar_swc_val_rtARID_DEF.UnitDelay_DSTATE_n@ */ /end MEASUREMENT
/begin MEASUREMENT autosar_swc_val_rtARID_DEF.cnt "" UWORD autosar_swc_val_CM_uint16 0 0 0 65535 ECU_ADDRESS 0xfe4cb5f0 /* @ECU_Address@autosar_swc_val_rtARID_DEF.cnt@ */ /end MEASUREMENT
/begin MEASUREMENT autosar_swc_val_rtARID_DEF.cnt_b "" UBYTE autosar_swc_val_CM_uint8 0 0 0 255 ECU_ADDRESS 0xfe4cb62a /* @ECU_Address@autosar_swc_val_rtARID_DEF.cnt_b@ */ /end MEASUREMENT
/begin MEASUREMENT autosar_swc_val_rtARID_DEF.cnt_d "" UBYTE autosar_swc_val_CM_uint8 0 0 0 255 ECU_ADDRESS 0xfe4cb62e /* @ECU_Address@autosar_swc_val_rtARID_DEF.cnt_d@ */ /end MEASUREMENT
/begin MEASUREMENT autosar_swc_val_rtARID_DEF.cnt_h "" UBYTE autosar_swc_val_CM_uint8 0 0 0 255 ECU_ADDRESS 0xfe4cb627 /* @ECU_Address@autosar_swc_val_rtARID_DEF.cnt_h@ */ /end MEASUREMENT
/begin MEASUREMENT autosar_swc_val_rtARID_DEF.cnt_m "" UBYTE autosar_swc_val_CM_uint8 0 0 0 255 ECU_ADDRESS 0xfe4cb655 /* @ECU_Address@autosar_swc_val_rtARID_DEF.cnt_m@ */ /end MEASUREMENT
/begin MEASUREMENT autosar_swc_val_rtARID_DEF.icLoad "" UBYTE autosar_swc_val_CM_logical 0 0 0 1 ECU_ADDRESS 0xfe4cb669 /* @ECU_Address@autosar_swc_val_rtARID_DEF.icLoad@ */ /end MEASUREMENT
/begin MEASUREMENT autosar_swc_val_rtARID_DEF.isLatFrbdnAct "" UBYTE autosar_swc_val_CM_logical 0 0 0 1 ECU_ADDRESS 0xfe4cb65c /* @ECU_Address@autosar_swc_val_rtARID_DEF.isLatFrbdnAct@ */ /end MEASUREMENT
/begin MEASUREMENT autosar_swc_val_rtARID_DEF.isLgtNegFrbdnAct "" UBYTE autosar_swc_val_CM_logical 0 0 0 1 ECU_ADDRESS 0xfe4cb65d /* @ECU_Address@autosar_swc_val_rtARID_DEF.isLgtNegFrbdnAct@ */ /end MEASUREMENT
/begin MEASUREMENT autosar_swc_val_rtARID_DEF.isLgtPosFrbdnAct "" UBYTE autosar_swc_val_CM_logical 0 0 0 1 ECU_ADDRESS 0xfe4cb65e /* @ECU_Address@autosar_swc_val_rtARID_DEF.isLgtPosFrbdnAct@ */ /end MEASUREMENT
/begin MEASUREMENT autosar_swc_val_rtARID_DEF.is_Clock_On "" UBYTE autosar_swc_val_CM_uint8 0 0 0 255 ECU_ADDRESS 0xfe4cb653 /* @ECU_Address@autosar_swc_val_rtARID_DEF.is_Clock_On@ */ /end MEASUREMENT
/begin MEASUREMENT autosar_swc_val_rtARID_DEF.is_WARN "" UBYTE autosar_swc_val_CM_uint8 0 0 0 255 ECU_ADDRESS 0xfe4cb65a /* @ECU_Address@autosar_swc_val_rtARID_DEF.is_WARN@ */ /end MEASUREMENT
/begin MEASUREMENT autosar_swc_val_rtARID_DEF.is_active_c113_autosar_swc_val "" UBYTE autosar_swc_val_CM_uint8 0 0 0 255 ECU_ADDRESS 0xfe4cb651 /* @ECU_Address@autosar_swc_val_rtARID_DEF.is_active_c113_autosar_swc_val@ */ /end MEASUREMENT
/begin MEASUREMENT autosar_swc_val_rtARID_DEF.is_active_c125_autosar_swc_val "" UBYTE autosar_swc_val_CM_uint8 0 0 0 255 ECU_ADDRESS 0xfe4cb615 /* @ECU_Address@autosar_swc_val_rtARID_DEF.is_active_c125_autosar_swc_val@ */ /end MEASUREMENT
/begin MEASUREMENT autosar_swc_val_rtARID_DEF.is_active_c127_autosar_swc_val "" UBYTE autosar_swc_val_CM_uint8 0 0 0 255 ECU_ADDRESS 0xfe4cb640 /* @ECU_Address@autosar_swc_val_rtARID_DEF.is_active_c127_autosar_swc_val@ */ /end MEASUREMENT
/begin MEASUREMENT autosar_swc_val_rtARID_DEF.is_active_c12_autosar_swc_val "" UBYTE autosar_swc_val_CM_uint8 0 0 0 255 ECU_ADDRESS 0xfe4cb642 /* @ECU_Address@autosar_swc_val_rtARID_DEF.is_active_c12_autosar_swc_val@ */ /end MEASUREMENT
/begin MEASUREMENT autosar_swc_val_rtARID_DEF.is_active_c144_autosar_swc_val "" UBYTE autosar_swc_val_CM_uint8 0 0 0 255 ECU_ADDRESS 0xfe4cb63e /* @ECU_Address@autosar_swc_val_rtARID_DEF.is_active_c144_autosar_swc_val@ */ /end MEASUREMENT
/begin MEASUREMENT autosar_swc_val_rtARID_DEF.is_active_c14_autosar_swc_val "" UBYTE autosar_swc_val_CM_uint8 0 0 0 255 ECU_ADDRESS 0xfe4cb658 /* @ECU_Address@autosar_swc_val_rtARID_DEF.is_active_c14_autosar_swc_val@ */ /end MEASUREMENT
/begin MEASUREMENT autosar_swc_val_rtARID_DEF.is_active_c155_autosar_swc_val "" UBYTE autosar_swc_val_CM_uint8 0 0 0 255 ECU_ADDRESS 0xfe4cb63c /* @ECU_Address@autosar_swc_val_rtARID_DEF.is_active_c155_autosar_swc_val@ */ /end MEASUREMENT
/begin MEASUREMENT autosar_swc_val_rtARID_DEF.is_active_c158_autosar_swc_val "" UBYTE autosar_swc_val_CM_uint8 0 0 0 255 ECU_ADDRESS 0xfe4cb63a /* @ECU_Address@autosar_swc_val_rtARID_DEF.is_active_c158_autosar_swc_val@ */ /end MEASUREMENT
/begin MEASUREMENT autosar_swc_val_rtARID_DEF.is_active_c159_autosar_swc_val "" UBYTE autosar_swc_val_CM_uint8 0 0 0 255 ECU_ADDRESS 0xfe4cb638 /* @ECU_Address@autosar_swc_val_rtARID_DEF.is_active_c159_autosar_swc_val@ */ /end MEASUREMENT
/begin MEASUREMENT autosar_swc_val_rtARID_DEF.is_active_c160_autosar_swc_val "" UBYTE autosar_swc_val_CM_uint8 0 0 0 255 ECU_ADDRESS 0xfe4cb636 /* @ECU_Address@autosar_swc_val_rtARID_DEF.is_active_c160_autosar_swc_val@ */ /end MEASUREMENT
/begin MEASUREMENT autosar_swc_val_rtARID_DEF.is_active_c162_autosar_swc_val "" UBYTE autosar_swc_val_CM_uint8 0 0 0 255 ECU_ADDRESS 0xfe4cb634 /* @ECU_Address@autosar_swc_val_rtARID_DEF.is_active_c162_autosar_swc_val@ */ /end MEASUREMENT
/begin MEASUREMENT autosar_swc_val_rtARID_DEF.is_active_c168_autosar_swc_val "" UBYTE autosar_swc_val_CM_uint8 0 0 0 255 ECU_ADDRESS 0xfe4cb632 /* @ECU_Address@autosar_swc_val_rtARID_DEF.is_active_c168_autosar_swc_val@ */ /end MEASUREMENT
/begin MEASUREMENT autosar_swc_val_rtARID_DEF.is_active_c24_autosar_swc_val "" UBYTE autosar_swc_val_CM_uint8 0 0 0 255 ECU_ADDRESS 0xfe4cb61b /* @ECU_Address@autosar_swc_val_rtARID_DEF.is_active_c24_autosar_swc_val@ */ /end MEASUREMENT
/begin MEASUREMENT autosar_swc_val_rtARID_DEF.is_active_c27_autosar_swc_val "" UBYTE autosar_swc_val_CM_uint8 0 0 0 255 ECU_ADDRESS 0xfe4cb654 /* @ECU_Address@autosar_swc_val_rtARID_DEF.is_active_c27_autosar_swc_val@ */ /end MEASUREMENT
/begin MEASUREMENT autosar_swc_val_rtARID_DEF.is_active_c31_autosar_swc_val "" UBYTE autosar_swc_val_CM_uint8 0 0 0 255 ECU_ADDRESS 0xfe4cb618 /* @ECU_Address@autosar_swc_val_rtARID_DEF.is_active_c31_autosar_swc_val@ */ /end MEASUREMENT
/begin MEASUREMENT autosar_swc_val_rtARID_DEF.is_active_c44_autosar_swc_val "" UBYTE autosar_swc_val_CM_uint8 0 0 0 255 ECU_ADDRESS 0xfe4cb625 /* @ECU_Address@autosar_swc_val_rtARID_DEF.is_active_c44_autosar_swc_val@ */ /end MEASUREMENT
/begin MEASUREMENT autosar_swc_val_rtARID_DEF.is_active_c46_autosar_swc_val "" UBYTE autosar_swc_val_CM_uint8 0 0 0 255 ECU_ADDRESS 0xfe4cb622 /* @ECU_Address@autosar_swc_val_rtARID_DEF.is_active_c46_autosar_swc_val@ */ /end MEASUREMENT
/begin MEASUREMENT autosar_swc_val_rtARID_DEF.is_active_c54_autosar_swc_val "" UBYTE autosar_swc_val_CM_uint8 0 0 0 255 ECU_ADDRESS 0xfe4cb61f /* @ECU_Address@autosar_swc_val_rtARID_DEF.is_active_c54_autosar_swc_val@ */ /end MEASUREMENT
/begin MEASUREMENT autosar_swc_val_rtARID_DEF.is_active_c55_autosar_swc_val "" UBYTE autosar_swc_val_CM_uint8 0 0 0 255 ECU_ADDRESS 0xfe4cb61d /* @ECU_Address@autosar_swc_val_rtARID_DEF.is_active_c55_autosar_swc_val@ */ /end MEASUREMENT
/begin MEASUREMENT autosar_swc_val_rtARID_DEF.is_active_c58_autosar_swc_val "" UBYTE autosar_swc_val_CM_uint8 0 0 0 255 ECU_ADDRESS 0xfe4cb64a /* @ECU_Address@autosar_swc_val_rtARID_DEF.is_active_c58_autosar_swc_val@ */ /end MEASUREMENT
/begin MEASUREMENT autosar_swc_val_rtARID_DEF.is_active_c59_autosar_swc_val "" UBYTE autosar_swc_val_CM_uint8 0 0 0 255 ECU_ADDRESS 0xfe4cb64e /* @ECU_Address@autosar_swc_val_rtARID_DEF.is_active_c59_autosar_swc_val@ */ /end MEASUREMENT
/begin MEASUREMENT autosar_swc_val_rtARID_DEF.is_active_c5_autosar_swc_val "" UBYTE autosar_swc_val_CM_uint8 0 0 0 255 ECU_ADDRESS 0xfe4cb656 /* @ECU_Address@autosar_swc_val_rtARID_DEF.is_active_c5_autosar_swc_val@ */ /end MEASUREMENT
/begin MEASUREMENT autosar_swc_val_rtARID_DEF.is_active_c60_autosar_swc_val "" UBYTE autosar_swc_val_CM_uint8 0 0 0 255 ECU_ADDRESS 0xfe4cb630 /* @ECU_Address@autosar_swc_val_rtARID_DEF.is_active_c60_autosar_swc_val@ */ /end MEASUREMENT
/begin MEASUREMENT autosar_swc_val_rtARID_DEF.is_active_c66_autosar_swc_val "" UBYTE autosar_swc_val_CM_uint8 0 0 0 255 ECU_ADDRESS 0xfe4cb646 /* @ECU_Address@autosar_swc_val_rtARID_DEF.is_active_c66_autosar_swc_val@ */ /end MEASUREMENT
/begin MEASUREMENT autosar_swc_val_rtARID_DEF.is_active_c76_autosar_swc_val "" UBYTE autosar_swc_val_CM_uint8 0 0 0 255 ECU_ADDRESS 0xfe4cb62c /* @ECU_Address@autosar_swc_val_rtARID_DEF.is_active_c76_autosar_swc_val@ */ /end MEASUREMENT
/begin MEASUREMENT autosar_swc_val_rtARID_DEF.is_active_c78_autosar_swc_val "" UBYTE autosar_swc_val_CM_uint8 0 0 0 255 ECU_ADDRESS 0xfe4cb628 /* @ECU_Address@autosar_swc_val_rtARID_DEF.is_active_c78_autosar_swc_val@ */ /end MEASUREMENT
/begin MEASUREMENT autosar_swc_val_rtARID_DEF.is_c113_autosar_swc_val "" UBYTE autosar_swc_val_CM_uint8 0 0 0 255 ECU_ADDRESS 0xfe4cb652 /* @ECU_Address@autosar_swc_val_rtARID_DEF.is_c113_autosar_swc_val@ */ /end MEASUREMENT
/begin MEASUREMENT autosar_swc_val_rtARID_DEF.is_c125_autosar_swc_val "" UBYTE autosar_swc_val_CM_uint8 0 0 0 255 ECU_ADDRESS 0xfe4cb616 /* @ECU_Address@autosar_swc_val_rtARID_DEF.is_c125_autosar_swc_val@ */ /end MEASUREMENT
/begin MEASUREMENT autosar_swc_val_rtARID_DEF.is_c127_autosar_swc_val "" UBYTE autosar_swc_val_CM_uint8 0 0 0 255 ECU_ADDRESS 0xfe4cb641 /* @ECU_Address@autosar_swc_val_rtARID_DEF.is_c127_autosar_swc_val@ */ /end MEASUREMENT
/begin MEASUREMENT autosar_swc_val_rtARID_DEF.is_c12_autosar_swc_val "" UBYTE autosar_swc_val_CM_uint8 0 0 0 255 ECU_ADDRESS 0xfe4cb643 /* @ECU_Address@autosar_swc_val_rtARID_DEF.is_c12_autosar_swc_val@ */ /end MEASUREMENT
/begin MEASUREMENT autosar_swc_val_rtARID_DEF.is_c144_autosar_swc_val "" UBYTE autosar_swc_val_CM_uint8 0 0 0 255 ECU_ADDRESS 0xfe4cb63f /* @ECU_Address@autosar_swc_val_rtARID_DEF.is_c144_autosar_swc_val@ */ /end MEASUREMENT
/begin MEASUREMENT autosar_swc_val_rtARID_DEF.is_c14_autosar_swc_val "" UBYTE autosar_swc_val_CM_uint8 0 0 0 255 ECU_ADDRESS 0xfe4cb659 /* @ECU_Address@autosar_swc_val_rtARID_DEF.is_c14_autosar_swc_val@ */ /end MEASUREMENT
/begin MEASUREMENT autosar_swc_val_rtARID_DEF.is_c155_autosar_swc_val "" UBYTE autosar_swc_val_CM_uint8 0 0 0 255 ECU_ADDRESS 0xfe4cb63d /* @ECU_Address@autosar_swc_val_rtARID_DEF.is_c155_autosar_swc_val@ */ /end MEASUREMENT
/begin MEASUREMENT autosar_swc_val_rtARID_DEF.is_c158_autosar_swc_val "" UBYTE autosar_swc_val_CM_uint8 0 0 0 255 ECU_ADDRESS 0xfe4cb63b /* @ECU_Address@autosar_swc_val_rtARID_DEF.is_c158_autosar_swc_val@ */ /end MEASUREMENT
/begin MEASUREMENT autosar_swc_val_rtARID_DEF.is_c159_autosar_swc_val "" UBYTE autosar_swc_val_CM_uint8 0 0 0 255 ECU_ADDRESS 0xfe4cb639 /* @ECU_Address@autosar_swc_val_rtARID_DEF.is_c159_autosar_swc_val@ */ /end MEASUREMENT
/begin MEASUREMENT autosar_swc_val_rtARID_DEF.is_c160_autosar_swc_val "" UBYTE autosar_swc_val_CM_uint8 0 0 0 255 ECU_ADDRESS 0xfe4cb637 /* @ECU_Address@autosar_swc_val_rtARID_DEF.is_c160_autosar_swc_val@ */ /end MEASUREMENT
/begin MEASUREMENT autosar_swc_val_rtARID_DEF.is_c162_autosar_swc_val "" UBYTE autosar_swc_val_CM_uint8 0 0 0 255 ECU_ADDRESS 0xfe4cb635 /* @ECU_Address@autosar_swc_val_rtARID_DEF.is_c162_autosar_swc_val@ */ /end MEASUREMENT
/begin MEASUREMENT autosar_swc_val_rtARID_DEF.is_c168_autosar_swc_val "" UBYTE autosar_swc_val_CM_uint8 0 0 0 255 ECU_ADDRESS 0xfe4cb633 /* @ECU_Address@autosar_swc_val_rtARID_DEF.is_c168_autosar_swc_val@ */ /end MEASUREMENT
/begin MEASUREMENT autosar_swc_val_rtARID_DEF.is_c24_autosar_swc_val "" UBYTE autosar_swc_val_CM_uint8 0 0 0 255 ECU_ADDRESS 0xfe4cb61c /* @ECU_Address@autosar_swc_val_rtARID_DEF.is_c24_autosar_swc_val@ */ /end MEASUREMENT
/begin MEASUREMENT autosar_swc_val_rtARID_DEF.is_c31_autosar_swc_val "" UBYTE autosar_swc_val_CM_uint8 0 0 0 255 ECU_ADDRESS 0xfe4cb619 /* @ECU_Address@autosar_swc_val_rtARID_DEF.is_c31_autosar_swc_val@ */ /end MEASUREMENT
/begin MEASUREMENT autosar_swc_val_rtARID_DEF.is_c44_autosar_swc_val "" UBYTE autosar_swc_val_CM_uint8 0 0 0 255 ECU_ADDRESS 0xfe4cb626 /* @ECU_Address@autosar_swc_val_rtARID_DEF.is_c44_autosar_swc_val@ */ /end MEASUREMENT
/begin MEASUREMENT autosar_swc_val_rtARID_DEF.is_c46_autosar_swc_val "" UBYTE autosar_swc_val_CM_uint8 0 0 0 255 ECU_ADDRESS 0xfe4cb623 /* @ECU_Address@autosar_swc_val_rtARID_DEF.is_c46_autosar_swc_val@ */ /end MEASUREMENT
/begin MEASUREMENT autosar_swc_val_rtARID_DEF.is_c54_autosar_swc_val "" UBYTE autosar_swc_val_CM_uint8 0 0 0 255 ECU_ADDRESS 0xfe4cb620 /* @ECU_Address@autosar_swc_val_rtARID_DEF.is_c54_autosar_swc_val@ */ /end MEASUREMENT
/begin MEASUREMENT autosar_swc_val_rtARID_DEF.is_c55_autosar_swc_val "" UBYTE autosar_swc_val_CM_uint8 0 0 0 255 ECU_ADDRESS 0xfe4cb61e /* @ECU_Address@autosar_swc_val_rtARID_DEF.is_c55_autosar_swc_val@ */ /end MEASUREMENT
/begin MEASUREMENT autosar_swc_val_rtARID_DEF.is_c58_autosar_swc_val "" UBYTE autosar_swc_val_CM_uint8 0 0 0 255 ECU_ADDRESS 0xfe4cb64b /* @ECU_Address@autosar_swc_val_rtARID_DEF.is_c58_autosar_swc_val@ */ /end MEASUREMENT
/begin MEASUREMENT autosar_swc_val_rtARID_DEF.is_c59_autosar_swc_val "" UBYTE autosar_swc_val_CM_uint8 0 0 0 255 ECU_ADDRESS 0xfe4cb64f /* @ECU_Address@autosar_swc_val_rtARID_DEF.is_c59_autosar_swc_val@ */ /end MEASUREMENT
/begin MEASUREMENT autosar_swc_val_rtARID_DEF.is_c5_autosar_swc_val "" UBYTE autosar_swc_val_CM_uint8 0 0 0 255 ECU_ADDRESS 0xfe4cb657 /* @ECU_Address@autosar_swc_val_rtARID_DEF.is_c5_autosar_swc_val@ */ /end MEASUREMENT
/begin MEASUREMENT autosar_swc_val_rtARID_DEF.is_c60_autosar_swc_val "" UBYTE autosar_swc_val_CM_uint8 0 0 0 255 ECU_ADDRESS 0xfe4cb631 /* @ECU_Address@autosar_swc_val_rtARID_DEF.is_c60_autosar_swc_val@ */ /end MEASUREMENT
/begin MEASUREMENT autosar_swc_val_rtARID_DEF.is_c66_autosar_swc_val "" UBYTE autosar_swc_val_CM_uint8 0 0 0 255 ECU_ADDRESS 0xfe4cb647 /* @ECU_Address@autosar_swc_val_rtARID_DEF.is_c66_autosar_swc_val@ */ /end MEASUREMENT
/begin MEASUREMENT autosar_swc_val_rtARID_DEF.is_c76_autosar_swc_val "" UBYTE autosar_swc_val_CM_uint8 0 0 0 255 ECU_ADDRESS 0xfe4cb62d /* @ECU_Address@autosar_swc_val_rtARID_DEF.is_c76_autosar_swc_val@ */ /end MEASUREMENT
/begin MEASUREMENT autosar_swc_val_rtARID_DEF.is_c78_autosar_swc_val "" UBYTE autosar_swc_val_CM_uint8 0 0 0 255 ECU_ADDRESS 0xfe4cb629 /* @ECU_Address@autosar_swc_val_rtARID_DEF.is_c78_autosar_swc_val@ */ /end MEASUREMENT
/begin MEASUREMENT autosar_swc_val_rtARID_DEF.is_state "" UBYTE autosar_swc_val_CM_uint8 0 0 0 255 ECU_ADDRESS 0xfe4cb624 /* @ECU_Address@autosar_swc_val_rtARID_DEF.is_state@ */ /end MEASUREMENT
/begin MEASUREMENT autosar_swc_val_rtARID_DEF.out_step "" UBYTE autosar_swc_val_CM_uint8 0 0 0 255 ECU_ADDRESS 0xfe4cb5fc /* @ECU_Address@autosar_swc_val_rtARID_DEF.out_step@ */ /end MEASUREMENT
/begin MEASUREMENT autosar_swc_val_rtARID_DEF.out_step_a "" UBYTE autosar_swc_val_CM_uint8 0 0 0 255 ECU_ADDRESS 0xfe4cb5fd /* @ECU_Address@autosar_swc_val_rtARID_DEF.out_step_a@ */ /end MEASUREMENT
/begin MEASUREMENT autosar_swc_val_rtARID_DEF.out_step_c "" UBYTE autosar_swc_val_CM_uint8 0 0 0 255 ECU_ADDRESS 0xfe4cb5ff /* @ECU_Address@autosar_swc_val_rtARID_DEF.out_step_c@ */ /end MEASUREMENT
/begin MEASUREMENT autosar_swc_val_rtARID_DEF.out_step_j "" UBYTE autosar_swc_val_CM_uint8 0 0 0 255 ECU_ADDRESS 0xfe4cb5fe /* @ECU_Address@autosar_swc_val_rtARID_DEF.out_step_j@ */ /end MEASUREMENT
/begin MEASUREMENT autosar_swc_val_rtARID_DEF.state "" UBYTE autosar_swc_val_CM_uint8 0 0 0 255 ECU_ADDRESS 0xfe4cb5fb /* @ECU_Address@autosar_swc_val_rtARID_DEF.state@ */ /end MEASUREMENT
/begin MEASUREMENT autosar_swc_val_rtARID_DEF.step "" UBYTE autosar_swc_val_CM_uint8 0 0 0 255 ECU_ADDRESS 0xfe4cb62b /* @ECU_Address@autosar_swc_val_rtARID_DEF.step@ */ /end MEASUREMENT
/begin MEASUREMENT autosar_swc_val_rtARID_DEF.step_l "" UBYTE autosar_swc_val_CM_uint8 0 0 0 255 ECU_ADDRESS 0xfe4cb62f /* @ECU_Address@autosar_swc_val_rtARID_DEF.step_l@ */ /end MEASUREMENT
/begin MEASUREMENT autosar_swc_val_rtARID_DEF.time "" FLOAT64_IEEE autosar_swc_val_CM_double 0 0 -1.7E+308 1.7E+308 ECU_ADDRESS 0xfe4cb5d0 /* @ECU_Address@autosar_swc_val_rtARID_DEF.time@ */ /end MEASUREMENT
/begin MEASUREMENT autosar_swc_val_rtARID_DEF.time_g "" FLOAT64_IEEE autosar_swc_val_CM_double 0 0 -1.7E+308 1.7E+308 ECU_ADDRESS 0xfe4cb5d8 /* @ECU_Address@autosar_swc_val_rtARID_DEF.time_g@ */ /end MEASUREMENT
/begin AXIS_PTS P_VAL_MCPressureTable_bar "" 0xfe821fa4 /* @ECU_Address@P_VAL_MCPressureTable_bar@ */ NO_INPUT_QUANTITY Axis_FLOAT32_IEEE 0 autosar_swc_val_CM_single 6 -3.4E+38 3.4E+38 /end AXIS_PTS
/begin COMPU_METHOD autosar_swc_val_CM_ADS_1_ADSHealthSts_405_dt "Q = V" IDENTICAL "%0.6" "" /end COMPU_METHOD
/begin COMPU_METHOD autosar_swc_val_CM_ADS_1_CRC1_405_dt "Q = V" IDENTICAL "%0.6" "" /end COMPU_METHOD
/begin COMPU_METHOD autosar_swc_val_CM_ADS_1_CRC2_405_dt "Q = V" IDENTICAL "%0.6" "" /end COMPU_METHOD
/begin COMPU_METHOD autosar_swc_val_CM_ADS_1_DrvTarTqVld_359_dt "Q = V" IDENTICAL "%0.6" "" /end COMPU_METHOD
/begin COMPU_METHOD autosar_swc_val_CM_ADS_1_LdwWarningCmdVld_405_dt "Q = V" IDENTICAL "%0.6" "" /end COMPU_METHOD
/begin COMPU_METHOD autosar_swc_val_CM_ADS_1_LdwWarningCmd_405_dt "Q = V" IDENTICAL "%0.6" "" /end COMPU_METHOD
/begin COMPU_METHOD autosar_swc_val_CM_ADS_1_Resd1_405_dt "Q = V" IDENTICAL "%0.6" "" /end COMPU_METHOD
/begin COMPU_METHOD autosar_swc_val_CM_ADS_1_Resd2_405_dt "Q = V" IDENTICAL "%0.6" "" /end COMPU_METHOD
/begin COMPU_METHOD autosar_swc_val_CM_ADS_1_RollgCntr1_405_dt "Q = V" IDENTICAL "%0.6" "" /end COMPU_METHOD
/begin COMPU_METHOD autosar_swc_val_CM_ADS_1_RollgCntr2_405_dt "Q = V" IDENTICAL "%0.6" "" /end COMPU_METHOD
/begin COMPU_METHOD autosar_swc_val_CM_ADS_1_SteerAgReq_405_dt "Q = V" IDENTICAL "%8.6" "" /end COMPU_METHOD
/begin COMPU_METHOD autosar_swc_val_CM_ADS_1_SteerAgVld_405_dt "Q = V" IDENTICAL "%0.6" "" /end COMPU_METHOD
/begin COMPU_METHOD autosar_swc_val_CM_ADS_1_SteerMaxTqReq_405_dt "Q = V" IDENTICAL "%8.6" "" /end COMPU_METHOD
/begin COMPU_METHOD autosar_swc_val_CM_ADS_1_SteerMinTqReq_405_dt "Q = V" IDENTICAL "%8.6" "" /end COMPU_METHOD
/begin COMPU_METHOD autosar_swc_val_CM_ADS_1_SteerPilotAgEna_405_dt "Q = V" IDENTICAL "%0.6" "" /end COMPU_METHOD
/begin COMPU_METHOD autosar_swc_val_CM_ADS_1_SteerTqEna_405_dt "Q = V" IDENTICAL "%0.6" "" /end COMPU_METHOD
/begin COMPU_METHOD autosar_swc_val_CM_CutOutFreshvalues_2CB_S_405_dt "Q = V" IDENTICAL "%0.6" "" /end COMPU_METHOD
/begin COMPU_METHOD autosar_swc_val_CM_CutOutMAC_2CB_S_405_dt "Q = V" IDENTICAL "%0.6" "" /end COMPU_METHOD
/begin COMPU_METHOD autosar_swc_val_CM_FCM_3_PilotBrkDecTarVld_330_dt "Q = V" IDENTICAL "%0.6" "" /end COMPU_METHOD
/begin COMPU_METHOD autosar_swc_val_CM_FCM_3_PilotkBrkDecTar_330_dt "Q = V" IDENTICAL "%8.6" "" /end COMPU_METHOD
/begin COMPU_METHOD autosar_swc_val_CM_SM_MODULE_STATUS "Enumerated data type: SM_MODULE_STATUS" TAB_VERB "%0.6" "" COMPU_TAB_REF VTAB_FOR_autosar_swc_val_CM_SM_MODULE_STATUS /end COMPU_METHOD
/begin COMPU_VTAB VTAB_FOR_autosar_swc_val_CM_SM_MODULE_STATUS "Enumerated data type: SM_MODULE_STATUS" TAB_VERB 4 0 "STATUS_NORMAL" 1 "STATUS_NOT_CONNECTED" 2 "STATUS_HEARTBEAT_MISSED" 3 "STATUS_ABNORMAL" /end COMPU_VTAB
/begin COMPU_METHOD autosar_swc_val_CM_boolean "Q = V" IDENTICAL "%1.0" "" /end COMPU_METHOD
/begin COMPU_METHOD autosar_swc_val_CM_double "Q = V" IDENTICAL "%15.10" "" /end COMPU_METHOD
/begin COMPU_METHOD autosar_swc_val_CM_int8 "Q = V" IDENTICAL "%3.0" "" /end COMPU_METHOD
/begin COMPU_METHOD autosar_swc_val_CM_logical "Q = V" IDENTICAL "%1.0" "" /end COMPU_METHOD
/begin COMPU_METHOD autosar_swc_val_CM_single "Q = V" IDENTICAL "%8.6" "" /end COMPU_METHOD
/begin COMPU_METHOD autosar_swc_val_CM_uint16 "Q = V" IDENTICAL "%5.0" "" /end COMPU_METHOD
/begin COMPU_METHOD autosar_swc_val_CM_uint32 "Q = V" IDENTICAL "%10.0" "" /end COMPU_METHOD
/begin COMPU_METHOD autosar_swc_val_CM_uint64 "Q = V" IDENTICAL "%20.0" "" /end COMPU_METHOD
/begin COMPU_METHOD autosar_swc_val_CM_uint8 "Q = V" IDENTICAL "%3.0" "" /end COMPU_METHOD
/begin RECORD_LAYOUT Record_BOOLEAN FNC_VALUES 1 UBYTE COLUMN_DIR DIRECT /end RECORD_LAYOUT
/begin RECORD_LAYOUT Record_FLOAT32_IEEE FNC_VALUES 1 FLOAT32_IEEE COLUMN_DIR DIRECT /end RECORD_LAYOUT
/begin RECORD_LAYOUT Record_SBYTE FNC_VALUES 1 SBYTE COLUMN_DIR DIRECT /end RECORD_LAYOUT
/begin RECORD_LAYOUT Record_UBYTE FNC_VALUES 1 UBYTE COLUMN_DIR DIRECT /end RECORD_LAYOUT
/begin RECORD_LAYOUT Record_ULONG FNC_VALUES 1 ULONG COLUMN_DIR DIRECT /end RECORD_LAYOUT
/begin RECORD_LAYOUT Record_UWORD FNC_VALUES 1 UWORD COLUMN_DIR DIRECT /end RECORD_LAYOUT
/begin RECORD_LAYOUT Axis_FLOAT32_IEEE AXIS_PTS_X 1 FLOAT32_IEEE INDEX_INCR DIRECT /end RECORD_LAYOUT
/begin GROUP SwcOut_VAL_DRIVER_SWITCH ""
 /begin REF_MEASUREMENT SwcOut_VAL_DRIVER_SWITCH.NOHOnOff SwcOut_VAL_DRIVER_SWITCH.NOHActReq SwcOut_VAL_DRIVER_SWITCH.LDWOnOff SwcOut_VAL_DRIVER_SWITCH.LKAOnOff SwcOut_VAL_DRIVER_SWITCH.ELKOnOff SwcOut_VAL_DRIVER_SWITCH.ESSOnOff SwcOut_VAL_DRIVER_SWITCH.AESOnOff SwcOut_VAL_DRIVER_SWITCH.LCKIEOnOff SwcOut_VAL_DRIVER_SWITCH.ISLOnOff SwcOut_VAL_DRIVER_SWITCH.IntellgntCurveOnOff SwcOut_VAL_DRIVER_SWITCH.FCWOnOff SwcOut_VAL_DRIVER_SWITCH.AEBOnOff SwcOut_VAL_DRIVER_SWITCH.DAIOnOff SwcOut_VAL_DRIVER_SWITCH.SpeedLmtNumberAbs SwcOut_VAL_DRIVER_SWITCH.SpeedLmtNumberPerct SwcOut_VAL_DRIVER_SWITCH.SpeedLmtSnvtyMod SwcOut_VAL_DRIVER_SWITCH.IHCOnOff SwcOut_VAL_DRIVER_SWITCH.ICAOnOff SwcOut_VAL_DRIVER_SWITCH.SLAOnOff SwcOut_VAL_DRIVER_SWITCH.SLAWarnMod SwcOut_VAL_DRIVER_SWITCH.LASSnvtySet SwcOut_VAL_DRIVER_SWITCH.LASWarnFormSwtReq SwcOut_VAL_DRIVER_SWITCH.TSROnOff SwcOut_VAL_DRIVER_SWITCH.TLIOnOff SwcOut_VAL_DRIVER_SWITCH.ALCSet SwcOut_VAL_DRIVER_SWITCH.DCLCSet SwcOut_VAL_DRIVER_SWITCH.ALCSnvtySet SwcOut_VAL_DRIVER_SWITCH.FCWSnvty SwcOut_VAL_DRIVER_SWITCH.VoiceRemindType SwcOut_VAL_DRIVER_SWITCH.TJAICAExitTextInfoONOFF SwcOut_VAL_DRIVER_SWITCH.SpeedLimitOnOff SwcOut_VAL_DRIVER_SWITCH.TimeStampMs /end REF_MEASUREMENT
/end GROUP
/begin GROUP SwcOut_VAL_ENV ""
 /begin REF_MEASUREMENT SwcOut_VAL_ENV.DayTime SwcOut_VAL_ENV.Weather SwcOut_VAL_ENV.TimeStampMs /end REF_MEASUREMENT
/end GROUP
/begin GROUP SwcOut_VAL_Herbeat_Info ""
 /begin REF_MEASUREMENT SwcOut_VAL_Herbeat_Info.swc_id SwcOut_VAL_Herbeat_Info.sequence_num SwcOut_VAL_Herbeat_Info.inner_error SwcOut_VAL_Herbeat_Info.module_status /end REF_MEASUREMENT
/end GROUP
/begin GROUP SwcOut_VAL_ICC_NAV ""
 /begin REF_MEASUREMENT SwcOut_VAL_ICC_NAV.nav_status SwcOut_VAL_ICC_NAV.curr_road_type SwcOut_VAL_ICC_NAV.road_spl_value SwcOut_VAL_ICC_NAV.elec_eye_spl_value SwcOut_VAL_ICC_NAV.spl_unit SwcOut_VAL_ICC_NAV.road_spl_dist SwcOut_VAL_ICC_NAV.elec_eye_dist SwcOut_VAL_ICC_NAV.country_region_code /end REF_MEASUREMENT
/end GROUP
/begin GROUP SwcOut_VAL_SAF_FUSAIN ""
 /begin SUB_GROUP SwcOut_VAL_SAF_FUSAIN.DrvEvlnMonIf SwcOut_VAL_SAF_FUSAIN.OutProcAdprIf SwcOut_VAL_SAF_FUSAIN.RelCptMonIf SwcOut_VAL_SAF_FUSAIN.SysStMonIf /end SUB_GROUP
/end GROUP
/begin GROUP SwcOut_VAL_SAF_FUSAIN.DrvEvlnMonIf ""
 /begin REF_MEASUREMENT SwcOut_VAL_SAF_FUSAIN.DrvEvlnMonIf.BrkDrvOvrd SwcOut_VAL_SAF_FUSAIN.DrvEvlnMonIf.DoorStatus SwcOut_VAL_SAF_FUSAIN.DrvEvlnMonIf.HandsOff SwcOut_VAL_SAF_FUSAIN.DrvEvlnMonIf.HandsTqE2E SwcOut_VAL_SAF_FUSAIN.DrvEvlnMonIf.SeatBltSts SwcOut_VAL_SAF_FUSAIN.DrvEvlnMonIf.SeatBltStsVld SwcOut_VAL_SAF_FUSAIN.DrvEvlnMonIf.SteerDrvOvrd SwcOut_VAL_SAF_FUSAIN.DrvEvlnMonIf.SteerDrvOvrdE2E SwcOut_VAL_SAF_FUSAIN.DrvEvlnMonIf.SteerDrvOvrdVld SwcOut_VAL_SAF_FUSAIN.DrvEvlnMonIf.LCCSts /end REF_MEASUREMENT
/end GROUP
/begin GROUP SwcOut_VAL_SAF_FUSAIN.OutProcAdprIf "" /begin REF_MEASUREMENT SwcOut_VAL_SAF_FUSAIN.OutProcAdprIf.PowerMode /end REF_MEASUREMENT /end GROUP
/begin GROUP SwcOut_VAL_SAF_FUSAIN.RelCptMonIf ""
 /begin SUB_GROUP SwcOut_VAL_SAF_FUSAIN.RelCptMonIf.Fusa_Cam_1_Module_Res SwcOut_VAL_SAF_FUSAIN.RelCptMonIf.Fusa_Cam_1_Ser_Res SwcOut_VAL_SAF_FUSAIN.RelCptMonIf.SerDes_MAX96716_Res /end SUB_GROUP
 /begin REF_MEASUREMENT SwcOut_VAL_SAF_FUSAIN.RelCptMonIf.AccSwtStsE2E SwcOut_VAL_SAF_FUSAIN.RelCptMonIf.AccSwtStsVld SwcOut_VAL_SAF_FUSAIN.RelCptMonIf.ActGearE2E SwcOut_VAL_SAF_FUSAIN.RelCptMonIf.ActGearVld SwcOut_VAL_SAF_FUSAIN.RelCptMonIf.AxE2E SwcOut_VAL_SAF_FUSAIN.RelCptMonIf.AxVld SwcOut_VAL_SAF_FUSAIN.RelCptMonIf.AyE2E SwcOut_VAL_SAF_FUSAIN.RelCptMonIf.AyVld SwcOut_VAL_SAF_FUSAIN.RelCptMonIf.BodyAvlE2E SwcOut_VAL_SAF_FUSAIN.RelCptMonIf.BrkAvl SwcOut_VAL_SAF_FUSAIN.RelCptMonIf.BrkAvlE2E SwcOut_VAL_SAF_FUSAIN.RelCptMonIf.BrkMstCylPrsE2E SwcOut_VAL_SAF_FUSAIN.RelCptMonIf.BrkMstCylPrsVld SwcOut_VAL_SAF_FUSAIN.RelCptMonIf.Chassis_ABSFailSts SwcOut_VAL_SAF_FUSAIN.RelCptMonIf.Chassis_EBDFailSts SwcOut_VAL_SAF_FUSAIN.RelCptMonIf.Chassis_HDCFailSts SwcOut_VAL_SAF_FUSAIN.RelCptMonIf.Chassis_TCSFailSts SwcOut_VAL_SAF_FUSAIN.RelCptMonIf.Chassis_VDCFailSts SwcOut_VAL_SAF_FUSAIN.RelCptMonIf.DrvAccePedlPosnE2E SwcOut_VAL_SAF_FUSAIN.RelCptMonIf.DrvAccePedlPosnVld SwcOut_VAL_SAF_FUSAIN.RelCptMonIf.EpbAvl SwcOut_VAL_SAF_FUSAIN.RelCptMonIf.EpbAvlE2E SwcOut_VAL_SAF_FUSAIN.RelCptMonIf.ImuNotCal SwcOut_VAL_SAF_FUSAIN.RelCptMonIf.PTAvl SwcOut_VAL_SAF_FUSAIN.RelCptMonIf.PTAvlE2E SwcOut_VAL_SAF_FUSAIN.RelCptMonIf.PTHvAvl SwcOut_VAL_SAF_FUSAIN.RelCptMonIf.PTHvAvlE2E SwcOut_VAL_SAF_FUSAIN.RelCptMonIf.RL_Radar_Err SwcOut_VAL_SAF_FUSAIN.RelCptMonIf.RR_Radar_Err SwcOut_VAL_SAF_FUSAIN.RelCptMonIf.SteerAvl SwcOut_VAL_SAF_FUSAIN.RelCptMonIf.SteerAvlE2E SwcOut_VAL_SAF_FUSAIN.RelCptMonIf.SteerWhlAngE2E SwcOut_VAL_SAF_FUSAIN.RelCptMonIf.SteerWhlAngSpdE2E SwcOut_VAL_SAF_FUSAIN.RelCptMonIf.SteerWhlAngSpdVld SwcOut_VAL_SAF_FUSAIN.RelCptMonIf.SteerWhlAngVld SwcOut_VAL_SAF_FUSAIN.RelCptMonIf.VehSpdChassisE2E SwcOut_VAL_SAF_FUSAIN.RelCptMonIf.VehSpdChassisVld SwcOut_VAL_SAF_FUSAIN.RelCptMonIf.WhlSpdAvl SwcOut_VAL_SAF_FUSAIN.RelCptMonIf.WhlSpdE2E SwcOut_VAL_SAF_FUSAIN.RelCptMonIf.YawRateE2E SwcOut_VAL_SAF_FUSAIN.RelCptMonIf.YawRateVld /end REF_MEASUREMENT
/end GROUP
/begin GROUP SwcOut_VAL_SAF_FUSAIN.RelCptMonIf.Fusa_Cam_1_Module_Res ""
 /begin REF_MEASUREMENT SwcOut_VAL_SAF_FUSAIN.RelCptMonIf.Fusa_Cam_1_Module_Res.Fusa_Cam_online_pixel SwcOut_VAL_SAF_FUSAIN.RelCptMonIf.Fusa_Cam_1_Module_Res.Fusa_Cam_row_checker_analog SwcOut_VAL_SAF_FUSAIN.RelCptMonIf.Fusa_Cam_1_Module_Res.Fusa_Cam_ID_checker_col SwcOut_VAL_SAF_FUSAIN.RelCptMonIf.Fusa_Cam_1_Module_Res.Fusa_Cam_ID_checker_row SwcOut_VAL_SAF_FUSAIN.RelCptMonIf.Fusa_Cam_1_Module_Res.Fusa_Cam_SCCB_CRC SwcOut_VAL_SAF_FUSAIN.RelCptMonIf.Fusa_Cam_1_Module_Res.Fusa_Cam_Frame_counter SwcOut_VAL_SAF_FUSAIN.RelCptMonIf.Fusa_Cam_1_Module_Res.Fusa_Cam_row_checker_digital SwcOut_VAL_SAF_FUSAIN.RelCptMonIf.Fusa_Cam_1_Module_Res.Fusa_Cam_BLC_checker SwcOut_VAL_SAF_FUSAIN.RelCptMonIf.Fusa_Cam_1_Module_Res.Fusa_Cam_PLL_CLK_mon SwcOut_VAL_SAF_FUSAIN.RelCptMonIf.Fusa_Cam_1_Module_Res.Fusa_Cam_PLL_CLK SwcOut_VAL_SAF_FUSAIN.RelCptMonIf.Fusa_Cam_1_Module_Res.Fusa_Cam_PEC SwcOut_VAL_SAF_FUSAIN.RelCptMonIf.Fusa_Cam_1_Module_Res.Fusa_Cam_output_FIFO_CRC SwcOut_VAL_SAF_FUSAIN.RelCptMonIf.Fusa_Cam_1_Module_Res.Fusa_Cam_SRAM_CRC SwcOut_VAL_SAF_FUSAIN.RelCptMonIf.Fusa_Cam_1_Module_Res.Fusa_Cam_Sensor_voltage SwcOut_VAL_SAF_FUSAIN.RelCptMonIf.Fusa_Cam_1_Module_Res.Fusa_Cam_internal_register_readback SwcOut_VAL_SAF_FUSAIN.RelCptMonIf.Fusa_Cam_1_Module_Res.Fusa_Cam_SI_default_register_check SwcOut_VAL_SAF_FUSAIN.RelCptMonIf.Fusa_Cam_1_Module_Res.Fusa_Cam_ROMCRC SwcOut_VAL_SAF_FUSAIN.RelCptMonIf.Fusa_Cam_1_Module_Res.Fusa_Cam_SRAM_BIST SwcOut_VAL_SAF_FUSAIN.RelCptMonIf.Fusa_Cam_1_Module_Res.Fusa_Cam_SM_test SwcOut_VAL_SAF_FUSAIN.RelCptMonIf.Fusa_Cam_1_Module_Res.Fusa_Cam_temperature /end REF_MEASUREMENT
/end GROUP
/begin GROUP SwcOut_VAL_SAF_FUSAIN.RelCptMonIf.Fusa_Cam_1_Ser_Res ""
 /begin REF_MEASUREMENT SwcOut_VAL_SAF_FUSAIN.RelCptMonIf.Fusa_Cam_1_Ser_Res.Fusa_Cam_Ser_OV_UV SwcOut_VAL_SAF_FUSAIN.RelCptMonIf.Fusa_Cam_1_Ser_Res.Fusa_Cam_Ser_I2C SwcOut_VAL_SAF_FUSAIN.RelCptMonIf.Fusa_Cam_1_Ser_Res.Fusa_Cam_Ser_FIFO_Overflow SwcOut_VAL_SAF_FUSAIN.RelCptMonIf.Fusa_Cam_1_Ser_Res.Fusa_Cam_Ser_LBIST SwcOut_VAL_SAF_FUSAIN.RelCptMonIf.Fusa_Cam_1_Ser_Res.Fusa_Cam_Ser_MBIST SwcOut_VAL_SAF_FUSAIN.RelCptMonIf.Fusa_Cam_1_Ser_Res.Fusa_Cam_Ser_ADC_BIST SwcOut_VAL_SAF_FUSAIN.RelCptMonIf.Fusa_Cam_1_Ser_Res.Fusa_Cam_Ser_CFG_CRC SwcOut_VAL_SAF_FUSAIN.RelCptMonIf.Fusa_Cam_1_Ser_Res.Fusa_Cam_PMIC /end REF_MEASUREMENT
/end GROUP
/begin GROUP SwcOut_VAL_SAF_FUSAIN.RelCptMonIf.SerDes_MAX96716_Res ""
 /begin REF_MEASUREMENT SwcOut_VAL_SAF_FUSAIN.RelCptMonIf.SerDes_MAX96716_Res.Fusa_TUN_DATA_CRC_ERR SwcOut_VAL_SAF_FUSAIN.RelCptMonIf.SerDes_MAX96716_Res.Fusa_TUN_ECC_UNCORR_ERR SwcOut_VAL_SAF_FUSAIN.RelCptMonIf.SerDes_MAX96716_Res.Fusa_TUN_ECC_CORR_ERR SwcOut_VAL_SAF_FUSAIN.RelCptMonIf.SerDes_MAX96716_Res.Fusa_VID_OVERFLOW_ERR SwcOut_VAL_SAF_FUSAIN.RelCptMonIf.SerDes_MAX96716_Res.Fusa_FSYNC_ERR SwcOut_VAL_SAF_FUSAIN.RelCptMonIf.SerDes_MAX96716_Res.Fusa_LCRC_ERR SwcOut_VAL_SAF_FUSAIN.RelCptMonIf.SerDes_MAX96716_Res.Fusa_VPRBS_ERR SwcOut_VAL_SAF_FUSAIN.RelCptMonIf.SerDes_MAX96716_Res.Fusa_I2C_UART_MSGCNTR_ERR SwcOut_VAL_SAF_FUSAIN.RelCptMonIf.SerDes_MAX96716_Res.Fusa_I2C_UART_CRC_ERR SwcOut_VAL_SAF_FUSAIN.RelCptMonIf.SerDes_MAX96716_Res.Fusa_96716_MEM_ECC_ERR2 SwcOut_VAL_SAF_FUSAIN.RelCptMonIf.SerDes_MAX96716_Res.Fusa_96716_MEM_ECC_ERR1 SwcOut_VAL_SAF_FUSAIN.RelCptMonIf.SerDes_MAX96716_Res.Fusa_REG_CRC_ERR SwcOut_VAL_SAF_FUSAIN.RelCptMonIf.SerDes_MAX96716_Res.Fusa_POST_MBIST_ERR SwcOut_VAL_SAF_FUSAIN.RelCptMonIf.SerDes_MAX96716_Res.Fusa_POST_LBIST_ERR SwcOut_VAL_SAF_FUSAIN.RelCptMonIf.SerDes_MAX96716_Res.Fusa_WM_ERR /end REF_MEASUREMENT
/end GROUP
/begin GROUP SwcOut_VAL_SAF_FUSAIN.SysStMonIf ""
 /begin SUB_GROUP SwcOut_VAL_SAF_FUSAIN.SysStMonIf.Mcu_U2A16_Res SwcOut_VAL_SAF_FUSAIN.SysStMonIf.Sbc_TLF35584_Res /end SUB_GROUP
 /begin REF_MEASUREMENT SwcOut_VAL_SAF_FUSAIN.SysStMonIf.DriveOff SwcOut_VAL_SAF_FUSAIN.SysStMonIf.DrvOffBtnCfm SwcOut_VAL_SAF_FUSAIN.SysStMonIf.isActGearR SwcOut_VAL_SAF_FUSAIN.SysStMonIf.ACCSts SwcOut_VAL_SAF_FUSAIN.SysStMonIf.Pilot_Accel SwcOut_VAL_SAF_FUSAIN.SysStMonIf.PtDrvAccePedlPosn SwcOut_VAL_SAF_FUSAIN.SysStMonIf.SteerWhlAngSpd SwcOut_VAL_SAF_FUSAIN.SysStMonIf.VehSpdChassis SwcOut_VAL_SAF_FUSAIN.SysStMonIf.Ay SwcOut_VAL_SAF_FUSAIN.SysStMonIf.Ax SwcOut_VAL_SAF_FUSAIN.SysStMonIf.SteerWhlAng SwcOut_VAL_SAF_FUSAIN.SysStMonIf.YawRate /end REF_MEASUREMENT
/end GROUP
/begin GROUP SwcOut_VAL_SAF_FUSAIN.SysStMonIf.Mcu_U2A16_Res ""
 /begin REF_MEASUREMENT SwcOut_VAL_SAF_FUSAIN.SysStMonIf.Mcu_U2A16_Res.Fusa_U2A16_BIST_ERR SwcOut_VAL_SAF_FUSAIN.SysStMonIf.Mcu_U2A16_Res.Fusa_J3_SPI_CRC_ERR SwcOut_VAL_SAF_FUSAIN.SysStMonIf.Mcu_U2A16_Res.Fusa_J3_SPI_RC_ERR /end REF_MEASUREMENT
/end GROUP
/begin GROUP SwcOut_VAL_SAF_FUSAIN.SysStMonIf.Sbc_TLF35584_Res ""
 /begin REF_MEASUREMENT SwcOut_VAL_SAF_FUSAIN.SysStMonIf.Sbc_TLF35584_Res.FuSa_TLF35584_BIST_ERR /end REF_MEASUREMENT
/end GROUP
/begin GROUP SwcOut_VAL_SAF_TrigSftyAct ""
 /begin REF_MEASUREMENT SwcOut_VAL_SAF_TrigSftyAct.isLatFrbdnAct SwcOut_VAL_SAF_TrigSftyAct.isLgtPosFrbdnAct SwcOut_VAL_SAF_TrigSftyAct.isLgtNegFrbdnAct SwcOut_VAL_SAF_TrigSftyAct.isAEBFrbdnAct /end REF_MEASUREMENT
/end GROUP
/begin GROUP SwcOut_VAL_SysOut_NvM_Write ""
 /begin REF_MEASUREMENT SwcOut_VAL_SysOut_NvM_Write.NOHOnOff SwcOut_VAL_SysOut_NvM_Write.NOHActReq SwcOut_VAL_SysOut_NvM_Write.LDWOnOff SwcOut_VAL_SysOut_NvM_Write.LKAOnOff SwcOut_VAL_SysOut_NvM_Write.ELKOnOff SwcOut_VAL_SysOut_NvM_Write.ESSOnOff SwcOut_VAL_SysOut_NvM_Write.AESOnOff SwcOut_VAL_SysOut_NvM_Write.LCKIEOnOff SwcOut_VAL_SysOut_NvM_Write.ISLOnOff SwcOut_VAL_SysOut_NvM_Write.IntellgntCurveOnOff SwcOut_VAL_SysOut_NvM_Write.FCWOnOff SwcOut_VAL_SysOut_NvM_Write.AEBOnOff SwcOut_VAL_SysOut_NvM_Write.DAIOnOff SwcOut_VAL_SysOut_NvM_Write.SpeedLmtNumberAbs SwcOut_VAL_SysOut_NvM_Write.SpeedLmtNumberPerct SwcOut_VAL_SysOut_NvM_Write.SpeedLmtSnvtyMod SwcOut_VAL_SysOut_NvM_Write.IHCOnOff SwcOut_VAL_SysOut_NvM_Write.ICAOnOff SwcOut_VAL_SysOut_NvM_Write.SLAOnOff SwcOut_VAL_SysOut_NvM_Write.SLAWarnMod SwcOut_VAL_SysOut_NvM_Write.LASSnvtySet SwcOut_VAL_SysOut_NvM_Write.LASWarnFormSwtReq SwcOut_VAL_SysOut_NvM_Write.TSROnOff SwcOut_VAL_SysOut_NvM_Write.TLIOnOff SwcOut_VAL_SysOut_NvM_Write.ALCSet SwcOut_VAL_SysOut_NvM_Write.DCLCSet SwcOut_VAL_SysOut_NvM_Write.ALCSnvtySet SwcOut_VAL_SysOut_NvM_Write.FCWSnvty SwcOut_VAL_SysOut_NvM_Write.VoiceRemindType SwcOut_VAL_SysOut_NvM_Write.TJAICAExitTextInfoONOFF SwcOut_VAL_SysOut_NvM_Write.SpeedLimitOnOff SwcOut_VAL_SysOut_NvM_Write.SPL_noSupp_Value_Init SwcOut_VAL_SysOut_NvM_Write.SPL_whSupp_Value_Init SwcOut_VAL_SysOut_NvM_Write.TS_SignName_Value_Init SwcOut_VAL_SysOut_NvM_Write.SPL_SuppName_Value_Init SwcOut_VAL_SysOut_NvM_Write.SysOut_TimeGapInit SwcOut_VAL_SysOut_NvM_Write.SysOut_ACCStsInit SwcOut_VAL_SysOut_NvM_Write.SysOut_ICASStsInit SwcOut_VAL_SysOut_NvM_Write.Uint8_Reserve SwcOut_VAL_SysOut_NvM_Write.SysOut_SteerAngOffsetInit SwcOut_VAL_SysOut_NvM_Write.SPL_noSupp_Dist_Init SwcOut_VAL_SysOut_NvM_Write.SPL_whSupp_Dist_Init SwcOut_VAL_SysOut_NvM_Write.TS_SignName_Dist_Init SwcOut_VAL_SysOut_NvM_Write.Reserve /end REF_MEASUREMENT
/end GROUP
/begin GROUP SwcOut_VAL_VEHICLE_FUNC ""
 /begin REF_MEASUREMENT SwcOut_VAL_VEHICLE_FUNC.CDDActv SwcOut_VAL_VEHICLE_FUNC.FCTBAct SwcOut_VAL_VEHICLE_FUNC.FCTAAct SwcOut_VAL_VEHICLE_FUNC.ParkAct SwcOut_VAL_VEHICLE_FUNC.LIMITAct SwcOut_VAL_VEHICLE_FUNC.ESPFuncOffSts SwcOut_VAL_VEHICLE_FUNC.ESPFuncActive SwcOut_VAL_VEHICLE_FUNC.HDCCtrl SwcOut_VAL_VEHICLE_FUNC.AVHSts SwcOut_VAL_VEHICLE_FUNC.EPBSts SwcOut_VAL_VEHICLE_FUNC.RadarELKsts SwcOut_VAL_VEHICLE_FUNC.RadarBSDsts SwcOut_VAL_VEHICLE_FUNC.DrvingMod SwcOut_VAL_VEHICLE_FUNC.VehPowerSysCtrlerResp SwcOut_VAL_VEHICLE_FUNC.VehBrakeSysCtrlerResp SwcOut_VAL_VEHICLE_FUNC.VehSteerSysCtrlerResp SwcOut_VAL_VEHICLE_FUNC.AWBAvl SwcOut_VAL_VEHICLE_FUNC.HBAAvl SwcOut_VAL_VEHICLE_FUNC.ABPAvl SwcOut_VAL_VEHICLE_FUNC.HMASW SwcOut_VAL_VEHICLE_FUNC.TimeStampMs /end REF_MEASUREMENT
/end GROUP
/begin GROUP SwcOut_VAL_VEHICLE_PARTS ""
 /begin REF_MEASUREMENT SwcOut_VAL_VEHICLE_PARTS.DrvSBR SwcOut_VAL_VEHICLE_PARTS.PassSBR SwcOut_VAL_VEHICLE_PARTS.BrkDskOvrheatd SwcOut_VAL_VEHICLE_PARTS.DrvDoorSts SwcOut_VAL_VEHICLE_PARTS.PassengerDoorSts SwcOut_VAL_VEHICLE_PARTS.FFogLmpSts SwcOut_VAL_VEHICLE_PARTS.RFogLmpSts SwcOut_VAL_VEHICLE_PARTS.TrailerSts SwcOut_VAL_VEHICLE_PARTS.RRDoorSts SwcOut_VAL_VEHICLE_PARTS.LRDoorSts SwcOut_VAL_VEHICLE_PARTS.HoodSts SwcOut_VAL_VEHICLE_PARTS.TrunkSts SwcOut_VAL_VEHICLE_PARTS.AirBagSts SwcOut_VAL_VEHICLE_PARTS.CrashSts SwcOut_VAL_VEHICLE_PARTS.LTurnLmpSts SwcOut_VAL_VEHICLE_PARTS.RTurnLmpSts SwcOut_VAL_VEHICLE_PARTS.HighBeamSts SwcOut_VAL_VEHICLE_PARTS.LowBeamSts SwcOut_VAL_VEHICLE_PARTS.HazardLmpSts SwcOut_VAL_VEHICLE_PARTS.FLTirePressureSts SwcOut_VAL_VEHICLE_PARTS.FRTirePressureSts SwcOut_VAL_VEHICLE_PARTS.RLTirePressureSts SwcOut_VAL_VEHICLE_PARTS.RRTirePressureSts SwcOut_VAL_VEHICLE_PARTS.FWiperSts SwcOut_VAL_VEHICLE_PARTS.TimeStampMs /end REF_MEASUREMENT
/end GROUP
/begin GROUP SwcOut_VAL_VEHICLE_STATE ""
 /begin REF_MEASUREMENT SwcOut_VAL_VEHICLE_STATE.VehStandstill SwcOut_VAL_VEHICLE_STATE.EngineOn SwcOut_VAL_VEHICLE_STATE.FAShiftInProgress SwcOut_VAL_VEHICLE_STATE.RAShiftInProgress SwcOut_VAL_VEHICLE_STATE.NoBrakeForce SwcOut_VAL_VEHICLE_STATE.VLC_InternalTargetAccelerationValid SwcOut_VAL_VEHICLE_STATE.BlindTemp SwcOut_VAL_VEHICLE_STATE.WheelPulseCounterValid SwcOut_VAL_VEHICLE_STATE.CurrentGear SwcOut_VAL_VEHICLE_STATE.TargetGear SwcOut_VAL_VEHICLE_STATE.GearSts SwcOut_VAL_VEHICLE_STATE.SysPowerMod SwcOut_VAL_VEHICLE_STATE.IPVehSpdUnit SwcOut_VAL_VEHICLE_STATE.IPVehSpdDispKph SwcOut_VAL_VEHICLE_STATE.IPVehSpdDispMph SwcOut_VAL_VEHICLE_STATE.FourWhlsBrkTrq SwcOut_VAL_VEHICLE_STATE.MaxEngTrqNorm SwcOut_VAL_VEHICLE_STATE.VehSpdKph SwcOut_VAL_VEHICLE_STATE.IPVehSpdDispKphFloat SwcOut_VAL_VEHICLE_STATE.SteerWheelAngle SwcOut_VAL_VEHICLE_STATE.SteerWheelSpd SwcOut_VAL_VEHICLE_STATE.SteerWheelTor SwcOut_VAL_VEHICLE_STATE.MasterCylBrkPress SwcOut_VAL_VEHICLE_STATE.WheelTrqNm SwcOut_VAL_VEHICLE_STATE.WheelTrqMinNm SwcOut_VAL_VEHICLE_STATE.VCUTrqNm SwcOut_VAL_VEHICLE_STATE.EngTrqNm SwcOut_VAL_VEHICLE_STATE.EngTrqMinNm SwcOut_VAL_VEHICLE_STATE.LKACtrDlvdValue SwcOut_VAL_VEHICLE_STATE.NetEngTrq SwcOut_VAL_VEHICLE_STATE.EngTrqMinAct SwcOut_VAL_VEHICLE_STATE.EngSpd SwcOut_VAL_VEHICLE_STATE.FLWheelSpdMps SwcOut_VAL_VEHICLE_STATE.FRWheelSpdMps SwcOut_VAL_VEHICLE_STATE.RLWheelSpdMps SwcOut_VAL_VEHICLE_STATE.RRWheelSpdMps SwcOut_VAL_VEHICLE_STATE.SensorVehYawRateRadps SwcOut_VAL_VEHICLE_STATE.SensorVehLonAccelMps2 SwcOut_VAL_VEHICLE_STATE.SensorVehLatAccelMps2 SwcOut_VAL_VEHICLE_STATE.VLC_InternalTargetAcceleration SwcOut_VAL_VEHICLE_STATE.TotalOdometer_km SwcOut_VAL_VEHICLE_STATE.FLWheelPulseCounter SwcOut_VAL_VEHICLE_STATE.FRWheelPulseCounter SwcOut_VAL_VEHICLE_STATE.RLWheelPulseCounter SwcOut_VAL_VEHICLE_STATE.RRWheelPulseCounter SwcOut_VAL_VEHICLE_STATE.TimeStampMs /end REF_MEASUREMENT
/end GROUP
/begin GROUP VAL_ExecTimestamp ""
 /begin REF_MEASUREMENT VAL_ExecTimestamp.timeBaseStatus VAL_ExecTimestamp.nanoseconds VAL_ExecTimestamp.seconds /end REF_MEASUREMENT
/end GROUP
/begin GROUP ZDrive_BSW_Cal_Cal ""
 /begin SUB_GROUP ZDrive_BSW_Cal_Cal.ZDrive_BSW_Cal_PlatformParameterTable ZDrive_BSW_Cal_Cal.ZDrive_BSW_Cal_VehicleInfomationTable /end SUB_GROUP
/end GROUP
/begin GROUP ZDrive_BSW_Cal_Cal.ZDrive_BSW_Cal_PlatformParameterTable ""
 /begin REF_CHARACTERISTIC ZDrive_BSW_Cal_Cal.ZDrive_BSW_Cal_PlatformParameterTable.ADAS_Def_Byte0 ZDrive_BSW_Cal_Cal.ZDrive_BSW_Cal_PlatformParameterTable.ADAS_Def_Byte1 ZDrive_BSW_Cal_Cal.ZDrive_BSW_Cal_PlatformParameterTable.Feature_Enable_Byte0 ZDrive_BSW_Cal_Cal.ZDrive_BSW_Cal_PlatformParameterTable.Feature_Enable_Byte1 ZDrive_BSW_Cal_Cal.ZDrive_BSW_Cal_PlatformParameterTable.Feature_Enable_Byte2 ZDrive_BSW_Cal_Cal.ZDrive_BSW_Cal_PlatformParameterTable.Feature_Enable_Byte3 ZDrive_BSW_Cal_Cal.ZDrive_BSW_Cal_PlatformParameterTable.Feature_Enable_Byte4 ZDrive_BSW_Cal_Cal.ZDrive_BSW_Cal_PlatformParameterTable.Feature_Cfg_Byte0 ZDrive_BSW_Cal_Cal.ZDrive_BSW_Cal_PlatformParameterTable.Feature_Cfg_Byte1 ZDrive_BSW_Cal_Cal.ZDrive_BSW_Cal_PlatformParameterTable.Feature_Cfg_Byte2 ZDrive_BSW_Cal_Cal.ZDrive_BSW_Cal_PlatformParameterTable.Feature_Cfg_Byte3 ZDrive_BSW_Cal_Cal.ZDrive_BSW_Cal_PlatformParameterTable.Feature_Cfg_Byte4 ZDrive_BSW_Cal_Cal.ZDrive_BSW_Cal_PlatformParameterTable.Feature_Switch_Cfg_Byte0 ZDrive_BSW_Cal_Cal.ZDrive_BSW_Cal_PlatformParameterTable.Feature_Switch_Cfg_Byte1 ZDrive_BSW_Cal_Cal.ZDrive_BSW_Cal_PlatformParameterTable.Feature_Switch_Cfg_Byte2 ZDrive_BSW_Cal_Cal.ZDrive_BSW_Cal_PlatformParameterTable.Feature_Switch_Cfg_Byte3 ZDrive_BSW_Cal_Cal.ZDrive_BSW_Cal_PlatformParameterTable.Feature_Switch_Cfg_Byte4 ZDrive_BSW_Cal_Cal.ZDrive_BSW_Cal_PlatformParameterTable.Feature_Switch_Cfg_Byte5 ZDrive_BSW_Cal_Cal.ZDrive_BSW_Cal_PlatformParameterTable.Feature_Switch_Cfg_Byte6 ZDrive_BSW_Cal_Cal.ZDrive_BSW_Cal_PlatformParameterTable.Feature_Switch_Cfg_Byte7 ZDrive_BSW_Cal_Cal.ZDrive_BSW_Cal_PlatformParameterTable.Feature_Switch_Cfg_Byte8 ZDrive_BSW_Cal_Cal.ZDrive_BSW_Cal_PlatformParameterTable.Feature_Switch_Cfg_Byte9 ZDrive_BSW_Cal_Cal.ZDrive_BSW_Cal_PlatformParameterTable.Feature_Switch_Cfg_Byte10 ZDrive_BSW_Cal_Cal.ZDrive_BSW_Cal_PlatformParameterTable.Feature_Switch_Init_Cfg_Byte0 ZDrive_BSW_Cal_Cal.ZDrive_BSW_Cal_PlatformParameterTable.Feature_Switch_Init_Cfg_Byte1 ZDrive_BSW_Cal_Cal.ZDrive_BSW_Cal_PlatformParameterTable.Feature_Switch_Init_Cfg_Byte2 ZDrive_BSW_Cal_Cal.ZDrive_BSW_Cal_PlatformParameterTable.Feature_Switch_Init_Cfg_Byte3 ZDrive_BSW_Cal_Cal.ZDrive_BSW_Cal_PlatformParameterTable.Feature_Switch_Init_Cfg_Byte4 ZDrive_BSW_Cal_Cal.ZDrive_BSW_Cal_PlatformParameterTable.PlatformParameter_CRC_Byte_0 ZDrive_BSW_Cal_Cal.ZDrive_BSW_Cal_PlatformParameterTable.PlatformParameter_CRC_Byte_1 ZDrive_BSW_Cal_Cal.ZDrive_BSW_Cal_PlatformParameterTable.PlatformParameter_CRC_Byte_2 ZDrive_BSW_Cal_Cal.ZDrive_BSW_Cal_PlatformParameterTable.PlatformParameter_CRC_Byte_3 /end REF_CHARACTERISTIC
/end GROUP
/begin GROUP ZDrive_BSW_Cal_Cal.ZDrive_BSW_Cal_VehicleInfomationTable ""
 /begin REF_CHARACTERISTIC ZDrive_BSW_Cal_Cal.ZDrive_BSW_Cal_VehicleInfomationTable.ADSA_APA_Switch_Source ZDrive_BSW_Cal_Cal.ZDrive_BSW_Cal_VehicleInfomationTable.ADAS_DVR_Type /end REF_CHARACTERISTIC
/end GROUP
/begin GROUP autosar_swc_val "autosar_swc_val" ROOT
 /begin SUB_GROUP SwcIn_ACU_2 SwcIn_ACU_3 SwcIn_CSA_1 SwcIn_CSA_2 SwcIn_EPB_R_1 SwcIn_EPS_1 SwcIn_EPS_3 SwcIn_EPS_4 SwcIn_FLZCU_1 SwcIn_FLZCU_12 SwcIn_FLZCU_15 SwcIn_FLZCU_3 SwcIn_FRZCU_1 SwcIn_ICC_COM_1 SwcIn_MFS_2 SwcIn_ONEBOX_1 SwcIn_ONEBOX_3 SwcIn_ONEBOX_4 SwcIn_ONEBOX_5 SwcIn_RZCU_2 SwcIn_SAS_1 SwcIn_TCM_1 SwcIn_VCU_1_G SwcIn_VCU_2_G SwcIn_VCU_3_G SwcIn_VCU_ADCC_12 SwcIn_VCU_COM_10 SwcOut_VAL_SysOut_NvM_Write autosar_swc_val_rtARID_DEF.BusAssignment autosar_swc_val_rtARID_DEF.BusAssignment1 autosar_swc_val_rtARID_DEF.BusAssignment2 autosar_swc_val_rtARID_DEF.BusAssignment3 autosar_swc_val_rtARID_DEF.BusAssignment4 autosar_swc_val_rtARID_DEF.SignalCopy4 autosar_swc_val_rtARID_DEF.TmpSignalConversionAtIF_sysEPS_4_sysEPS_4Outport1 autosar_swc_val_rtARID_DEF.TmpSignalConversionAtIF_sysONEBOX_5_sysONEBOX_5Outport1 autosar_swc_val_rtARID_DEF.TmpSignalConversionAtIF_sysVCU_ADCC_12_sysVCU_ADCC_12Outport1 autosar_swc_val_autosar_swc_val_Step_sys /end SUB_GROUP
/end GROUP
/begin GROUP autosar_swc_val_autosar_swc_val_Step_sys "autosar_swc_val/autosar_swc_val_Step_sys"
 /begin SUB_GROUP autosar_swc_val_autosar_swc_val_Step_sys_Subsystem_Reference /end SUB_GROUP
/end GROUP
/begin GROUP autosar_swc_val_autosar_swc_val_Step_sys_Subsystem_Reference "autosar_swc_val/autosar_swc_val_Step_sys/Subsystem Reference"
 /begin SUB_GROUP autosar_swc_val_autosar_swc_val_Step_sys_Subsystem_Reference_ADS_EPS_1_SubSyS1 autosar_swc_val_autosar_swc_val_Step_sys_Subsystem_Reference_ADS_VCU_1_SubSyS1 autosar_swc_val_autosar_swc_val_Step_sys_Subsystem_Reference_ADS_VCU_1_SubSyS2 autosar_swc_val_autosar_swc_val_Step_sys_Subsystem_Reference_AEB_SubSys autosar_swc_val_autosar_swc_val_Step_sys_Subsystem_Reference_Counter_Limited autosar_swc_val_autosar_swc_val_Step_sys_Subsystem_Reference_Counter_Limited1 autosar_swc_val_autosar_swc_val_Step_sys_Subsystem_Reference_HMI_ADS_COM3 autosar_swc_val_autosar_swc_val_Step_sys_Subsystem_Reference_SubFusa3_0 autosar_swc_val_autosar_swc_val_Step_sys_Subsystem_Reference_SubSys_DRIVER_SWITCH autosar_swc_val_autosar_swc_val_Step_sys_Subsystem_Reference_VAL_DRIVER_DRIVE_SubSys2 autosar_swc_val_autosar_swc_val_Step_sys_Subsystem_Reference_VAL_DRIVER_STATE_SubSys1 autosar_swc_val_autosar_swc_val_Step_sys_Subsystem_Reference_VAL_FuSaInput_SubSys autosar_swc_val_autosar_swc_val_Step_sys_Subsystem_Reference_VAL_VEHICLE_FUNC_SubSys1 autosar_swc_val_autosar_swc_val_Step_sys_Subsystem_Reference_VAL_VEHICLE_PARTS_SubSys2 autosar_swc_val_autosar_swc_val_Step_sys_Subsystem_Reference_VAL_VEHICLE_STATE_SubSys autosar_swc_val_autosar_swc_val_Step_sys_Subsystem_Reference_calibration autosar_swc_val_autosar_swc_val_Step_sys_Subsystem_Reference_inputinit autosar_swc_val_autosar_swc_val_Step_sys_Subsystem_Reference_inputinit3 /end SUB_GROUP
 /begin REF_CHARACTERISTIC P_VAL_EnableConfig P_VAL_Enable_SafSignal P_VAL_Fusa_EPB_R_1_CRC2_Error P_VAL_Fusa_EPB_R_1_RollgCntr2_Error P_VAL_IsSftyEna P_VAL_TEMP_FusaEnable P_VAL_Virtual_ELKONOFFSts P_VAL_Virtual_LDPONOFFSts P_VAL_Virtual_LDWONOFFSts P_VAL_Virtual_SW /end REF_CHARACTERISTIC
 /begin REF_MEASUREMENT SwcOut_Virtual_ELKONOFFSts SwcOut_Virtual_LDPONOFFSts SwcOut_Virtual_LDWONOFFSts VAL_Version VehConfig_Code1 VehConfig_Code2 autosar_swc_val_rtARID_DEF.is_active_c27_autosar_swc_val /end REF_MEASUREMENT
/end GROUP
/begin GROUP autosar_swc_val_autosar_swc_val_Step_sys_Subsystem_Reference_ADS_EPS_1_SubSyS1 "autosar_swc_val/autosar_swc_val_Step_sys/Subsystem Reference/ADS_EPS_1_SubSyS1"
 /begin REF_CHARACTERISTIC P_VAL_LDWSHOCK_TIME P_VAL_LDWUNSHOCK_TIME P_VAL_LdpUnSuppressShock /end REF_CHARACTERISTIC
 /begin REF_MEASUREMENT autosar_swc_val_rtARID_DEF.cnt autosar_swc_val_rtARID_DEF.is_WARN autosar_swc_val_rtARID_DEF.is_active_c14_autosar_swc_val autosar_swc_val_rtARID_DEF.is_c14_autosar_swc_val /end REF_MEASUREMENT
/end GROUP
/begin GROUP autosar_swc_val_autosar_swc_val_Step_sys_Subsystem_Reference_ADS_VCU_1_SubSyS1 "autosar_swc_val/autosar_swc_val_Step_sys/Subsystem Reference/ADS_VCU_1_SubSyS1" /begin REF_CHARACTERISTIC P_VAL_AWB2CAN_OnOff P_VAL_AWBLevel P_VAL_AWBRequest /end REF_CHARACTERISTIC /end GROUP
/begin GROUP autosar_swc_val_autosar_swc_val_Step_sys_Subsystem_Reference_ADS_VCU_1_SubSyS2 "autosar_swc_val/autosar_swc_val_Step_sys/Subsystem Reference/ADS_VCU_1_SubSyS2"
 /begin REF_CHARACTERISTIC P_VAL_AEB2CAN_OnOff P_VAL_AEBLimitOnOff P_VAL_AEBTarDec P_VAL_AEBTarDecLowerLimt /end REF_CHARACTERISTIC
/end GROUP
/begin GROUP autosar_swc_val_autosar_swc_val_Step_sys_Subsystem_Reference_AEB_SubSys "autosar_swc_val/autosar_swc_val_Step_sys/Subsystem Reference/AEB_SubSys"
 /begin SUB_GROUP autosar_swc_val_autosar_swc_val_Step_sys_Subsystem_Reference_AEB_SubSys_Detect_Decrease /end SUB_GROUP
 /begin REF_MEASUREMENT autosar_swc_val_rtARID_DEF.HazardLightReq autosar_swc_val_rtARID_DEF.cnt_m autosar_swc_val_rtARID_DEF.is_active_c5_autosar_swc_val autosar_swc_val_rtARID_DEF.is_c5_autosar_swc_val /end REF_MEASUREMENT
/end GROUP
/begin GROUP autosar_swc_val_autosar_swc_val_Step_sys_Subsystem_Reference_AEB_SubSys_Detect_Decrease "autosar_swc_val/autosar_swc_val_Step_sys/Subsystem Reference/AEB_SubSys/Detect\nDecrease" /begin REF_MEASUREMENT autosar_swc_val_rtARID_DEF.DelayInput1_DSTATE_i /end REF_MEASUREMENT /end GROUP
/begin GROUP autosar_swc_val_autosar_swc_val_Step_sys_Subsystem_Reference_Counter_Limited "autosar_swc_val/autosar_swc_val_Step_sys/Subsystem Reference/Counter\nLimited"
 /begin SUB_GROUP autosar_swc_val_autosar_swc_val_Step_sys_Subsystem_Reference_Counter_Limited_Increment_Real_World /end SUB_GROUP
 /begin REF_MEASUREMENT VAL_UpdateCnt autosar_swc_val_rtARID_DEF.Output_DSTATE_d /end REF_MEASUREMENT
/end GROUP
/begin GROUP autosar_swc_val_autosar_swc_val_Step_sys_Subsystem_Reference_Counter_Limited1 "autosar_swc_val/autosar_swc_val_Step_sys/Subsystem Reference/Counter\nLimited1" /begin REF_MEASUREMENT autosar_swc_val_rtARID_DEF.Output_DSTATE /end REF_MEASUREMENT /end GROUP
/begin GROUP autosar_swc_val_autosar_swc_val_Step_sys_Subsystem_Reference_Counter_Limited_Increment_Real_World "autosar_swc_val/autosar_swc_val_Step_sys/Subsystem Reference/Counter\nLimited/Increment\nReal World" /begin REF_MEASUREMENT VAL_UpdateCnt /end REF_MEASUREMENT /end GROUP
/begin GROUP autosar_swc_val_autosar_swc_val_Step_sys_Subsystem_Reference_HMI_ADS_COM3 "autosar_swc_val/autosar_swc_val_Step_sys/Subsystem Reference/HMI_ADS_COM3"
 /begin SUB_GROUP autosar_swc_val_autosar_swc_val_Step_sys_Subsystem_Reference_HMI_ADS_COM3_Compare_To_Constant178 /end SUB_GROUP
 /begin REF_MEASUREMENT autosar_swc_val_rtARID_DEF.Cnt_a autosar_swc_val_rtARID_DEF.TimeGap autosar_swc_val_rtARID_DEF.is_Clock_On autosar_swc_val_rtARID_DEF.is_active_c113_autosar_swc_val autosar_swc_val_rtARID_DEF.is_c113_autosar_swc_val /end REF_MEASUREMENT
/end GROUP
/begin GROUP autosar_swc_val_autosar_swc_val_Step_sys_Subsystem_Reference_HMI_ADS_COM3_Compare_To_Constant178 "autosar_swc_val/autosar_swc_val_Step_sys/Subsystem Reference/HMI_ADS_COM3/Compare\nTo Constant178" /begin REF_CHARACTERISTIC P_VAL_DecelRespValue_ms2 /end REF_CHARACTERISTIC /end GROUP
/begin GROUP autosar_swc_val_autosar_swc_val_Step_sys_Subsystem_Reference_SubFusa3_0 "autosar_swc_val/autosar_swc_val_Step_sys/Subsystem Reference/SubFusa3_0"
 /begin SUB_GROUP autosar_swc_val_autosar_swc_val_Step_sys_Subsystem_Reference_SubFusa3_0_Detect_Increase autosar_swc_val_autosar_swc_val_Step_sys_Subsystem_Reference_SubFusa3_0_Detect_Increase1 autosar_swc_val_autosar_swc_val_Step_sys_Subsystem_Reference_SubFusa3_0_Detect_Increase2 autosar_swc_val_autosar_swc_val_Step_sys_Subsystem_Reference_SubFusa3_0_Subsystem3 autosar_swc_val_autosar_swc_val_Step_sys_Subsystem_Reference_SubFusa3_0_Subsystem4 /end SUB_GROUP
 /begin REF_CHARACTERISTIC P_VAL_SftyChkTmr P_VAL_SftyOvrdKeptTi /end REF_CHARACTERISTIC
 /begin REF_MEASUREMENT autosar_swc_val_rtARID_DEF.ADS_1_DrvTarTqVld autosar_swc_val_rtARID_DEF.ADS_1_SteerAgVld autosar_swc_val_rtARID_DEF.Cnt_b autosar_swc_val_rtARID_DEF.Cnt_h autosar_swc_val_rtARID_DEF.Cnt_l autosar_swc_val_rtARID_DEF.FCM_3_PilotBrkDecTarVld autosar_swc_val_rtARID_DEF.SftyOvrdKeptTi autosar_swc_val_rtARID_DEF.SftyOvrdKeptTi_b autosar_swc_val_rtARID_DEF.SftyOvrdKeptTi_k autosar_swc_val_rtARID_DEF.isLatFrbdnAct autosar_swc_val_rtARID_DEF.isLgtNegFrbdnAct autosar_swc_val_rtARID_DEF.isLgtPosFrbdnAct autosar_swc_val_rtARID_DEF.is_active_c12_autosar_swc_val autosar_swc_val_rtARID_DEF.is_active_c58_autosar_swc_val autosar_swc_val_rtARID_DEF.is_active_c59_autosar_swc_val autosar_swc_val_rtARID_DEF.is_active_c66_autosar_swc_val autosar_swc_val_rtARID_DEF.is_c12_autosar_swc_val autosar_swc_val_rtARID_DEF.is_c58_autosar_swc_val autosar_swc_val_rtARID_DEF.is_c59_autosar_swc_val autosar_swc_val_rtARID_DEF.is_c66_autosar_swc_val /end REF_MEASUREMENT
/end GROUP
/begin GROUP autosar_swc_val_autosar_swc_val_Step_sys_Subsystem_Reference_SubFusa3_0_Detect_Increase "autosar_swc_val/autosar_swc_val_Step_sys/Subsystem Reference/SubFusa3_0/Detect\nIncrease" /begin REF_MEASUREMENT autosar_swc_val_rtARID_DEF.DelayInput1_DSTATE_f /end REF_MEASUREMENT /end GROUP
/begin GROUP autosar_swc_val_autosar_swc_val_Step_sys_Subsystem_Reference_SubFusa3_0_Detect_Increase1 "autosar_swc_val/autosar_swc_val_Step_sys/Subsystem Reference/SubFusa3_0/Detect\nIncrease1" /begin REF_MEASUREMENT autosar_swc_val_rtARID_DEF.DelayInput1_DSTATE_d /end REF_MEASUREMENT /end GROUP
/begin GROUP autosar_swc_val_autosar_swc_val_Step_sys_Subsystem_Reference_SubFusa3_0_Detect_Increase2 "autosar_swc_val/autosar_swc_val_Step_sys/Subsystem Reference/SubFusa3_0/Detect\nIncrease2" /begin REF_MEASUREMENT autosar_swc_val_rtARID_DEF.DelayInput1_DSTATE_dx /end REF_MEASUREMENT /end GROUP
/begin GROUP autosar_swc_val_autosar_swc_val_Step_sys_Subsystem_Reference_SubFusa3_0_Subsystem3 "autosar_swc_val/autosar_swc_val_Step_sys/Subsystem Reference/SubFusa3_0/Subsystem3"
 /begin SUB_GROUP autosar_swc_val_autosar_swc_val_Step_sys_Subsystem_Reference_SubFusa3_0_Subsystem3_Compare_To_Constant11 autosar_swc_val_autosar_swc_val_Step_sys_Subsystem_Reference_SubFusa3_0_Subsystem3_Compare_To_Constant12 autosar_swc_val_autosar_swc_val_Step_sys_Subsystem_Reference_SubFusa3_0_Subsystem3_Compare_To_Constant13 /end SUB_GROUP
 /begin REF_CHARACTERISTIC P_VAL_AEBDeceLimSpd1Val P_VAL_AEBDeceLimSpd2Val P_VAL_AEBDeceLimSpd3Val /end REF_CHARACTERISTIC
/end GROUP
/begin GROUP autosar_swc_val_autosar_swc_val_Step_sys_Subsystem_Reference_SubFusa3_0_Subsystem3_Compare_To_Constant11 "autosar_swc_val/autosar_swc_val_Step_sys/Subsystem Reference/SubFusa3_0/Subsystem3/Compare\nTo Constant11" /begin REF_CHARACTERISTIC P_VAL_AEBDeceLimSpd3 /end REF_CHARACTERISTIC /end GROUP
/begin GROUP autosar_swc_val_autosar_swc_val_Step_sys_Subsystem_Reference_SubFusa3_0_Subsystem3_Compare_To_Constant12 "autosar_swc_val/autosar_swc_val_Step_sys/Subsystem Reference/SubFusa3_0/Subsystem3/Compare\nTo Constant12" /begin REF_CHARACTERISTIC P_VAL_AEBDeceLimSpd2 /end REF_CHARACTERISTIC /end GROUP
/begin GROUP autosar_swc_val_autosar_swc_val_Step_sys_Subsystem_Reference_SubFusa3_0_Subsystem3_Compare_To_Constant13 "autosar_swc_val/autosar_swc_val_Step_sys/Subsystem Reference/SubFusa3_0/Subsystem3/Compare\nTo Constant13" /begin REF_CHARACTERISTIC P_VAL_AEBDeceLimSpd1 /end REF_CHARACTERISTIC /end GROUP
/begin GROUP autosar_swc_val_autosar_swc_val_Step_sys_Subsystem_Reference_SubFusa3_0_Subsystem4 "autosar_swc_val/autosar_swc_val_Step_sys/Subsystem Reference/SubFusa3_0/Subsystem4" /begin REF_CHARACTERISTIC P_VAL_PilotDeceLim P_VAL_SftyJerkLimDece /end REF_CHARACTERISTIC /begin REF_MEASUREMENT autosar_swc_val_rtARID_DEF.Delay_DSTATE_m /end REF_MEASUREMENT /end GROUP
/begin GROUP autosar_swc_val_autosar_swc_val_Step_sys_Subsystem_Reference_SubSys_DRIVER_SWITCH "autosar_swc_val/autosar_swc_val_Step_sys/Subsystem Reference/SubSys_DRIVER_SWITCH"
 /begin SUB_GROUP autosar_swc_val_autosar_swc_val_Step_sys_Subsystem_Reference_SubSys_DRIVER_SWITCH_Compare_To_Constant4 autosar_swc_val_autosar_swc_val_Step_sys_Subsystem_Reference_SubSys_DRIVER_SWITCH_Detect_Change autosar_swc_val_autosar_swc_val_Step_sys_Subsystem_Reference_SubSys_DRIVER_SWITCH_Detect_Change1 autosar_swc_val_autosar_swc_val_Step_sys_Subsystem_Reference_SubSys_DRIVER_SWITCH_Detect_Decrease autosar_swc_val_autosar_swc_val_Step_sys_Subsystem_Reference_SubSys_DRIVER_SWITCH_Subsystem autosar_swc_val_autosar_swc_val_Step_sys_Subsystem_Reference_SubSys_DRIVER_SWITCH_Virtual_SW /end SUB_GROUP
 /begin REF_CHARACTERISTIC P_VAL_EnableConfig P_VAL_SwitchELKOn P_VAL_Virtual_SW /end REF_CHARACTERISTIC
 /begin REF_MEASUREMENT autosar_swc_val_rtARID_DEF.FunSts autosar_swc_val_rtARID_DEF.FunSts_b autosar_swc_val_rtARID_DEF.FunSts_c autosar_swc_val_rtARID_DEF.FunSts_c4 autosar_swc_val_rtARID_DEF.FunSts_d autosar_swc_val_rtARID_DEF.FunSts_ei autosar_swc_val_rtARID_DEF.FunSts_f autosar_swc_val_rtARID_DEF.FunSts_g autosar_swc_val_rtARID_DEF.FunSts_gr autosar_swc_val_rtARID_DEF.FunSts_h autosar_swc_val_rtARID_DEF.FunSts_k autosar_swc_val_rtARID_DEF.FunSts_l autosar_swc_val_rtARID_DEF.FunSts_n autosar_swc_val_rtARID_DEF.UnitDelay1_DSTATE autosar_swc_val_rtARID_DEF.UnitDelay_DSTATE_n autosar_swc_val_rtARID_DEF.is_active_c127_autosar_swc_val autosar_swc_val_rtARID_DEF.is_active_c144_autosar_swc_val autosar_swc_val_rtARID_DEF.is_active_c155_autosar_swc_val autosar_swc_val_rtARID_DEF.is_active_c158_autosar_swc_val autosar_swc_val_rtARID_DEF.is_active_c159_autosar_swc_val autosar_swc_val_rtARID_DEF.is_active_c160_autosar_swc_val autosar_swc_val_rtARID_DEF.is_active_c162_autosar_swc_val autosar_swc_val_rtARID_DEF.is_active_c168_autosar_swc_val autosar_swc_val_rtARID_DEF.is_c127_autosar_swc_val autosar_swc_val_rtARID_DEF.is_c144_autosar_swc_val autosar_swc_val_rtARID_DEF.is_c155_autosar_swc_val autosar_swc_val_rtARID_DEF.is_c158_autosar_swc_val autosar_swc_val_rtARID_DEF.is_c159_autosar_swc_val autosar_swc_val_rtARID_DEF.is_c160_autosar_swc_val autosar_swc_val_rtARID_DEF.is_c162_autosar_swc_val autosar_swc_val_rtARID_DEF.is_c168_autosar_swc_val /end REF_MEASUREMENT
/end GROUP
/begin GROUP autosar_swc_val_autosar_swc_val_Step_sys_Subsystem_Reference_SubSys_DRIVER_SWITCH_Compare_To_Constant4 "autosar_swc_val/autosar_swc_val_Step_sys/Subsystem Reference/SubSys_DRIVER_SWITCH/Compare\nTo Constant4" /begin REF_MEASUREMENT autosar_swc_val_rtARID_DEF.FunSts_c /end REF_MEASUREMENT /end GROUP
/begin GROUP autosar_swc_val_autosar_swc_val_Step_sys_Subsystem_Reference_SubSys_DRIVER_SWITCH_Detect_Change "autosar_swc_val/autosar_swc_val_Step_sys/Subsystem Reference/SubSys_DRIVER_SWITCH/Detect\nChange" /begin REF_MEASUREMENT autosar_swc_val_rtARID_DEF.DelayInput1_DSTATE_j /end REF_MEASUREMENT /end GROUP
/begin GROUP autosar_swc_val_autosar_swc_val_Step_sys_Subsystem_Reference_SubSys_DRIVER_SWITCH_Detect_Change1 "autosar_swc_val/autosar_swc_val_Step_sys/Subsystem Reference/SubSys_DRIVER_SWITCH/Detect\nChange1" /begin REF_MEASUREMENT autosar_swc_val_rtARID_DEF.DelayInput1_DSTATE /end REF_MEASUREMENT /end GROUP
/begin GROUP autosar_swc_val_autosar_swc_val_Step_sys_Subsystem_Reference_SubSys_DRIVER_SWITCH_Detect_Decrease "autosar_swc_val/autosar_swc_val_Step_sys/Subsystem Reference/SubSys_DRIVER_SWITCH/Detect\nDecrease" /begin REF_MEASUREMENT autosar_swc_val_rtARID_DEF.DelayInput1_DSTATE_c /end REF_MEASUREMENT /end GROUP
/begin GROUP autosar_swc_val_autosar_swc_val_Step_sys_Subsystem_Reference_SubSys_DRIVER_SWITCH_Subsystem "autosar_swc_val/autosar_swc_val_Step_sys/Subsystem Reference/SubSys_DRIVER_SWITCH/Subsystem" /begin REF_MEASUREMENT autosar_swc_val_rtARID_DEF.FunSts_c4 /end REF_MEASUREMENT /end GROUP
/begin GROUP autosar_swc_val_autosar_swc_val_Step_sys_Subsystem_Reference_SubSys_DRIVER_SWITCH_Virtual_SW "autosar_swc_val/autosar_swc_val_Step_sys/Subsystem Reference/SubSys_DRIVER_SWITCH/Virtual_SW"
 /begin REF_CHARACTERISTIC P_VAL_Virtual_AEBONOFFSts P_VAL_Virtual_AESONOFFSts P_VAL_Virtual_ALCONOFFSts P_VAL_Virtual_ALCSnvtySet P_VAL_Virtual_DAIONOFFSts P_VAL_Virtual_DCLCSetSTS P_VAL_Virtual_ELKONOFFSts P_VAL_Virtual_ESSONOFFSts P_VAL_Virtual_FCWONOFFSts P_VAL_Virtual_FCWSnvty P_VAL_Virtual_ICAONOFFSts P_VAL_Virtual_IESONOFFSts P_VAL_Virtual_IHCONOFFSts P_VAL_Virtual_ISLONOFFSts P_VAL_Virtual_IntellgntCurveOnOff P_VAL_Virtual_LASSnvtySet P_VAL_Virtual_LASWarnFormSwtReq P_VAL_Virtual_LDPONOFFSts P_VAL_Virtual_LDWONOFFSts P_VAL_Virtual_NOHActReq P_VAL_Virtual_NOHONOFFsts P_VAL_Virtual_SLAONOFFSts P_VAL_Virtual_SLAWarnMod P_VAL_Virtual_SpeedLimitOnOff P_VAL_Virtual_SpeedLmtNmverAbs P_VAL_Virtual_SpeedLmtNmverPerct P_VAL_Virtual_SpeedLmtSnvtyModSts P_VAL_Virtual_TJAICAExitTextInfoONOFF P_VAL_Virtual_TLIOnOffSts P_VAL_Virtual_TSRONOFFSts P_VAL_Virtual_VoiceRemindType /end REF_CHARACTERISTIC
/end GROUP
/begin GROUP autosar_swc_val_autosar_swc_val_Step_sys_Subsystem_Reference_VAL_DRIVER_DRIVE_SubSys2 "autosar_swc_val/autosar_swc_val_Step_sys/Subsystem Reference/VAL_DRIVER_DRIVE_SubSys2"
 /begin SUB_GROUP autosar_swc_val_autosar_swc_val_Step_sys_Subsystem_Reference_VAL_DRIVER_DRIVE_SubSys2_AdjustSpeed autosar_swc_val_autosar_swc_val_Step_sys_Subsystem_Reference_VAL_DRIVER_DRIVE_SubSys2_Subsystem1 /end SUB_GROUP
 /begin REF_CHARACTERISTIC P_VAL_BrakePedalStrokeLower P_VAL_BrakePedalStrokeLower_AEB P_VAL_BrakePedalStrokeUpper P_VAL_BrakePedalStrokeUpper_AEB P_VAL_CriusePushTime P_VAL_DecelReqTable_ms2 P_VAL_EnableCruiseMiddleKey P_VAL_MCPressureTable_bar /end REF_CHARACTERISTIC
 /begin REF_MEASUREMENT autosar_swc_val_rtARID_DEF.ResumePulse autosar_swc_val_rtARID_DEF.out_step autosar_swc_val_rtARID_DEF.out_step_c autosar_swc_val_rtARID_DEF.state /end REF_MEASUREMENT
/end GROUP
/begin GROUP autosar_swc_val_autosar_swc_val_Step_sys_Subsystem_Reference_VAL_DRIVER_DRIVE_SubSys2_AdjustSpeed "autosar_swc_val/autosar_swc_val_Step_sys/Subsystem Reference/VAL_DRIVER_DRIVE_SubSys2/AdjustSpeed"
 /begin SUB_GROUP autosar_swc_val_autosar_swc_val_Step_sys_Subsystem_Reference_VAL_DRIVER_DRIVE_SubSys2_AdjustSpeed_Compare_To_Constant1 autosar_swc_val_autosar_swc_val_Step_sys_Subsystem_Reference_VAL_DRIVER_DRIVE_SubSys2_AdjustSpeed_Compare_To_Constant2 autosar_swc_val_autosar_swc_val_Step_sys_Subsystem_Reference_VAL_DRIVER_DRIVE_SubSys2_AdjustSpeed_Compare_To_Constant3 autosar_swc_val_autosar_swc_val_Step_sys_Subsystem_Reference_VAL_DRIVER_DRIVE_SubSys2_AdjustSpeed_Compare_To_Zero autosar_swc_val_autosar_swc_val_Step_sys_Subsystem_Reference_VAL_DRIVER_DRIVE_SubSys2_AdjustSpeed_Detect_Decrease autosar_swc_val_autosar_swc_val_Step_sys_Subsystem_Reference_VAL_DRIVER_DRIVE_SubSys2_AdjustSpeed_Detect_Decrease1 autosar_swc_val_autosar_swc_val_Step_sys_Subsystem_Reference_VAL_DRIVER_DRIVE_SubSys2_AdjustSpeed_Detect_Increase autosar_swc_val_autosar_swc_val_Step_sys_Subsystem_Reference_VAL_DRIVER_DRIVE_SubSys2_AdjustSpeed_Detect_Increase1 /end SUB_GROUP
 /begin REF_MEASUREMENT autosar_swc_val_rtARID_DEF.cnt_b autosar_swc_val_rtARID_DEF.cnt_d autosar_swc_val_rtARID_DEF.cnt_h autosar_swc_val_rtARID_DEF.is_active_c60_autosar_swc_val autosar_swc_val_rtARID_DEF.is_active_c76_autosar_swc_val autosar_swc_val_rtARID_DEF.is_active_c78_autosar_swc_val autosar_swc_val_rtARID_DEF.is_c60_autosar_swc_val autosar_swc_val_rtARID_DEF.is_c76_autosar_swc_val autosar_swc_val_rtARID_DEF.is_c78_autosar_swc_val autosar_swc_val_rtARID_DEF.out_step autosar_swc_val_rtARID_DEF.out_step_a autosar_swc_val_rtARID_DEF.out_step_c autosar_swc_val_rtARID_DEF.out_step_j autosar_swc_val_rtARID_DEF.state autosar_swc_val_rtARID_DEF.step autosar_swc_val_rtARID_DEF.step_l /end REF_MEASUREMENT
/end GROUP
/begin GROUP autosar_swc_val_autosar_swc_val_Step_sys_Subsystem_Reference_VAL_DRIVER_DRIVE_SubSys2_AdjustSpeed_Compare_To_Constant1 "autosar_swc_val/autosar_swc_val_Step_sys/Subsystem Reference/VAL_DRIVER_DRIVE_SubSys2/AdjustSpeed/Compare\nTo Constant1" /begin REF_CHARACTERISTIC P_VAL_LeRollrUpDwnAdjSteps /end REF_CHARACTERISTIC /begin REF_MEASUREMENT autosar_swc_val_rtARID_DEF.out_step_a /end REF_MEASUREMENT /end GROUP
/begin GROUP autosar_swc_val_autosar_swc_val_Step_sys_Subsystem_Reference_VAL_DRIVER_DRIVE_SubSys2_AdjustSpeed_Compare_To_Constant2 "autosar_swc_val/autosar_swc_val_Step_sys/Subsystem Reference/VAL_DRIVER_DRIVE_SubSys2/AdjustSpeed/Compare\nTo Constant2" /begin REF_CHARACTERISTIC P_VAL_LeRollrUpDwnAdjSteps /end REF_CHARACTERISTIC /begin REF_MEASUREMENT autosar_swc_val_rtARID_DEF.out_step_j /end REF_MEASUREMENT /end GROUP
/begin GROUP autosar_swc_val_autosar_swc_val_Step_sys_Subsystem_Reference_VAL_DRIVER_DRIVE_SubSys2_AdjustSpeed_Compare_To_Constant3 "autosar_swc_val/autosar_swc_val_Step_sys/Subsystem Reference/VAL_DRIVER_DRIVE_SubSys2/AdjustSpeed/Compare\nTo Constant3" /begin REF_CHARACTERISTIC P_VAL_LeRollrUpDwnAdjSteps /end REF_CHARACTERISTIC /begin REF_MEASUREMENT autosar_swc_val_rtARID_DEF.out_step_a /end REF_MEASUREMENT /end GROUP
/begin GROUP autosar_swc_val_autosar_swc_val_Step_sys_Subsystem_Reference_VAL_DRIVER_DRIVE_SubSys2_AdjustSpeed_Compare_To_Zero "autosar_swc_val/autosar_swc_val_Step_sys/Subsystem Reference/VAL_DRIVER_DRIVE_SubSys2/AdjustSpeed/Compare\nTo Zero" /begin REF_MEASUREMENT autosar_swc_val_rtARID_DEF.out_step_j /end REF_MEASUREMENT /end GROUP
/begin GROUP autosar_swc_val_autosar_swc_val_Step_sys_Subsystem_Reference_VAL_DRIVER_DRIVE_SubSys2_AdjustSpeed_Detect_Decrease "autosar_swc_val/autosar_swc_val_Step_sys/Subsystem Reference/VAL_DRIVER_DRIVE_SubSys2/AdjustSpeed/Detect\nDecrease" /begin REF_MEASUREMENT autosar_swc_val_rtARID_DEF.DelayInput1_DSTATE_l /end REF_MEASUREMENT /end GROUP
/begin GROUP autosar_swc_val_autosar_swc_val_Step_sys_Subsystem_Reference_VAL_DRIVER_DRIVE_SubSys2_AdjustSpeed_Detect_Decrease1 "autosar_swc_val/autosar_swc_val_Step_sys/Subsystem Reference/VAL_DRIVER_DRIVE_SubSys2/AdjustSpeed/Detect\nDecrease1" /begin REF_MEASUREMENT autosar_swc_val_rtARID_DEF.DelayInput1_DSTATE_k /end REF_MEASUREMENT /end GROUP
/begin GROUP autosar_swc_val_autosar_swc_val_Step_sys_Subsystem_Reference_VAL_DRIVER_DRIVE_SubSys2_AdjustSpeed_Detect_Increase "autosar_swc_val/autosar_swc_val_Step_sys/Subsystem Reference/VAL_DRIVER_DRIVE_SubSys2/AdjustSpeed/Detect\nIncrease" /begin REF_MEASUREMENT autosar_swc_val_rtARID_DEF.DelayInput1_DSTATE_h /end REF_MEASUREMENT /end GROUP
/begin GROUP autosar_swc_val_autosar_swc_val_Step_sys_Subsystem_Reference_VAL_DRIVER_DRIVE_SubSys2_AdjustSpeed_Detect_Increase1 "autosar_swc_val/autosar_swc_val_Step_sys/Subsystem Reference/VAL_DRIVER_DRIVE_SubSys2/AdjustSpeed/Detect\nIncrease1" /begin REF_MEASUREMENT autosar_swc_val_rtARID_DEF.DelayInput1_DSTATE_a /end REF_MEASUREMENT /end GROUP
/begin GROUP autosar_swc_val_autosar_swc_val_Step_sys_Subsystem_Reference_VAL_DRIVER_DRIVE_SubSys2_Subsystem1 "autosar_swc_val/autosar_swc_val_Step_sys/Subsystem Reference/VAL_DRIVER_DRIVE_SubSys2/Subsystem1"
 /begin REF_MEASUREMENT autosar_swc_val_rtARID_DEF.Cruise_LongPush autosar_swc_val_rtARID_DEF.ResumePulse autosar_swc_val_rtARID_DEF.Time autosar_swc_val_rtARID_DEF.is_active_c44_autosar_swc_val autosar_swc_val_rtARID_DEF.is_active_c46_autosar_swc_val autosar_swc_val_rtARID_DEF.is_active_c54_autosar_swc_val autosar_swc_val_rtARID_DEF.is_active_c55_autosar_swc_val autosar_swc_val_rtARID_DEF.is_c44_autosar_swc_val autosar_swc_val_rtARID_DEF.is_c46_autosar_swc_val autosar_swc_val_rtARID_DEF.is_c54_autosar_swc_val autosar_swc_val_rtARID_DEF.is_c55_autosar_swc_val autosar_swc_val_rtARID_DEF.is_state autosar_swc_val_rtARID_DEF.time autosar_swc_val_rtARID_DEF.time_g /end REF_MEASUREMENT
/end GROUP
/begin GROUP autosar_swc_val_autosar_swc_val_Step_sys_Subsystem_Reference_VAL_DRIVER_STATE_SubSys1 "autosar_swc_val/autosar_swc_val_Step_sys/Subsystem Reference/VAL_DRIVER_STATE_SubSys1"
 /begin SUB_GROUP autosar_swc_val_autosar_swc_val_Step_sys_Subsystem_Reference_VAL_DRIVER_STATE_SubSys1_Compare_To_Constant178 autosar_swc_val_autosar_swc_val_Step_sys_Subsystem_Reference_VAL_DRIVER_STATE_SubSys1_Compare_To_Constant179 /end SUB_GROUP
 /begin REF_MEASUREMENT autosar_swc_val_rtARID_DEF.HandsOff_l autosar_swc_val_rtARID_DEF.TimeCnt_n autosar_swc_val_rtARID_DEF.is_active_c24_autosar_swc_val autosar_swc_val_rtARID_DEF.is_c24_autosar_swc_val /end REF_MEASUREMENT
/end GROUP
/begin GROUP autosar_swc_val_autosar_swc_val_Step_sys_Subsystem_Reference_VAL_DRIVER_STATE_SubSys1_Compare_To_Constant178 "autosar_swc_val/autosar_swc_val_Step_sys/Subsystem Reference/VAL_DRIVER_STATE_SubSys1/Compare\nTo Constant178" /begin REF_CHARACTERISTIC P_VAL_HandsoffDet_Trq /end REF_CHARACTERISTIC /end GROUP
/begin GROUP autosar_swc_val_autosar_swc_val_Step_sys_Subsystem_Reference_VAL_DRIVER_STATE_SubSys1_Compare_To_Constant179 "autosar_swc_val/autosar_swc_val_Step_sys/Subsystem Reference/VAL_DRIVER_STATE_SubSys1/Compare\nTo Constant179" /begin REF_CHARACTERISTIC P_VAL_HandsonDet_Trq /end REF_CHARACTERISTIC /end GROUP
/begin GROUP autosar_swc_val_autosar_swc_val_Step_sys_Subsystem_Reference_VAL_FuSaInput_SubSys "autosar_swc_val/autosar_swc_val_Step_sys/Subsystem Reference/VAL_FuSaInput_SubSys"
 /begin SUB_GROUP autosar_swc_val_autosar_swc_val_Step_sys_Subsystem_Reference_VAL_FuSaInput_SubSys_Subsystem10 autosar_swc_val_autosar_swc_val_Step_sys_Subsystem_Reference_VAL_FuSaInput_SubSys_Subsystem12 /end SUB_GROUP
 /begin REF_CHARACTERISTIC P_VAL_EnableFusaErrID P_VAL_Enable_SafSignal P_VAL_Fusa_EPB_R_1_CRC2_Error P_VAL_Fusa_EPB_R_1_RollgCntr2_Error P_VAL_Virtual_Cam_1_Module P_VAL_Virtual_Cam_1_Ser P_VAL_Virtual_J3_Err1 P_VAL_Virtual_J3_Err2 P_VAL_Virtual_J3_Err3 P_VAL_Virtual_Mcu_U2A16 P_VAL_Virtual_Sbc_TLF35584 P_VAL_Virtual_SerDes_MAX96716 P_VAL_Virtual_SerDes_MAX96717_1 P_VAL_Virtual_SerDes_MAX96717_2 P_VAL_Virtual_SerDes_MAX96722 /end REF_CHARACTERISTIC
/end GROUP
/begin GROUP autosar_swc_val_autosar_swc_val_Step_sys_Subsystem_Reference_VAL_FuSaInput_SubSys_Subsystem10 "autosar_swc_val/autosar_swc_val_Step_sys/Subsystem Reference/VAL_FuSaInput_SubSys/Subsystem10"
 /begin SUB_GROUP autosar_swc_val_autosar_swc_val_Step_sys_Subsystem_Reference_VAL_FuSaInput_SubSys_Subsystem10_Compare_To_Constant2 autosar_swc_val_autosar_swc_val_Step_sys_Subsystem_Reference_VAL_FuSaInput_SubSys_Subsystem10_Compare_To_Constant3 /end SUB_GROUP
/end GROUP
/begin GROUP autosar_swc_val_autosar_swc_val_Step_sys_Subsystem_Reference_VAL_FuSaInput_SubSys_Subsystem10_Compare_To_Constant2 "autosar_swc_val/autosar_swc_val_Step_sys/Subsystem Reference/VAL_FuSaInput_SubSys/Subsystem10/Compare\nTo Constant2" /begin REF_CHARACTERISTIC P_VAL_DrvTorsionBarTqThd /end REF_CHARACTERISTIC /end GROUP
/begin GROUP autosar_swc_val_autosar_swc_val_Step_sys_Subsystem_Reference_VAL_FuSaInput_SubSys_Subsystem10_Compare_To_Constant3 "autosar_swc_val/autosar_swc_val_Step_sys/Subsystem Reference/VAL_FuSaInput_SubSys/Subsystem10/Compare\nTo Constant3" /begin REF_CHARACTERISTIC P_VAL_BrakePedalStrokeUpper /end REF_CHARACTERISTIC /end GROUP
/begin GROUP autosar_swc_val_autosar_swc_val_Step_sys_Subsystem_Reference_VAL_FuSaInput_SubSys_Subsystem12 "autosar_swc_val/autosar_swc_val_Step_sys/Subsystem Reference/VAL_FuSaInput_SubSys/Subsystem12"
 /begin SUB_GROUP autosar_swc_val_autosar_swc_val_Step_sys_Subsystem_Reference_VAL_FuSaInput_SubSys_Subsystem12_Compare_To_Constant178 autosar_swc_val_autosar_swc_val_Step_sys_Subsystem_Reference_VAL_FuSaInput_SubSys_Subsystem12_Compare_To_Constant179 /end SUB_GROUP
 /begin REF_MEASUREMENT autosar_swc_val_rtARID_DEF.HandsOff autosar_swc_val_rtARID_DEF.TimeCnt autosar_swc_val_rtARID_DEF.is_active_c31_autosar_swc_val autosar_swc_val_rtARID_DEF.is_c31_autosar_swc_val /end REF_MEASUREMENT
/end GROUP
/begin GROUP autosar_swc_val_autosar_swc_val_Step_sys_Subsystem_Reference_VAL_FuSaInput_SubSys_Subsystem12_Compare_To_Constant178 "autosar_swc_val/autosar_swc_val_Step_sys/Subsystem Reference/VAL_FuSaInput_SubSys/Subsystem12/Compare\nTo Constant178" /begin REF_CHARACTERISTIC P_VAL_HandsoffDet_Trq_Saf /end REF_CHARACTERISTIC /end GROUP
/begin GROUP autosar_swc_val_autosar_swc_val_Step_sys_Subsystem_Reference_VAL_FuSaInput_SubSys_Subsystem12_Compare_To_Constant179 "autosar_swc_val/autosar_swc_val_Step_sys/Subsystem Reference/VAL_FuSaInput_SubSys/Subsystem12/Compare\nTo Constant179" /begin REF_CHARACTERISTIC P_VAL_HandsonDet_Trq_Saf /end REF_CHARACTERISTIC /end GROUP
/begin GROUP autosar_swc_val_autosar_swc_val_Step_sys_Subsystem_Reference_VAL_VEHICLE_FUNC_SubSys1 "autosar_swc_val/autosar_swc_val_Step_sys/Subsystem Reference/VAL_VEHICLE_FUNC_SubSys1" /begin REF_CHARACTERISTIC P_VAL_ManDrv_SW /end REF_CHARACTERISTIC
 /begin REF_MEASUREMENT autosar_swc_val_rtARID_DEF.Cnt autosar_swc_val_rtARID_DEF.is_active_c125_autosar_swc_val autosar_swc_val_rtARID_DEF.is_c125_autosar_swc_val /end REF_MEASUREMENT
/end GROUP
/begin GROUP autosar_swc_val_autosar_swc_val_Step_sys_Subsystem_Reference_VAL_VEHICLE_PARTS_SubSys2 "autosar_swc_val/autosar_swc_val_Step_sys/Subsystem Reference/VAL_VEHICLE_PARTS_SubSys2"
 /begin SUB_GROUP autosar_swc_val_autosar_swc_val_Step_sys_Subsystem_Reference_VAL_VEHICLE_PARTS_SubSys2_Compare_To_Constant8 autosar_swc_val_autosar_swc_val_Step_sys_Subsystem_Reference_VAL_VEHICLE_PARTS_SubSys2_Compare_To_Constant9 /end SUB_GROUP
 /begin REF_CHARACTERISTIC P_VAL_DisableTirePressure P_VAL_EnableRainWiper /end REF_CHARACTERISTIC
 /begin REF_MEASUREMENT autosar_swc_val_rtARID_DEF.Lsts autosar_swc_val_rtARID_DEF.Lsts_c /end REF_MEASUREMENT
/end GROUP
/begin GROUP autosar_swc_val_autosar_swc_val_Step_sys_Subsystem_Reference_VAL_VEHICLE_PARTS_SubSys2_Compare_To_Constant8 "autosar_swc_val/autosar_swc_val_Step_sys/Subsystem Reference/VAL_VEHICLE_PARTS_SubSys2/Compare\nTo Constant8" /begin REF_MEASUREMENT autosar_swc_val_rtARID_DEF.Lsts /end REF_MEASUREMENT /end GROUP
/begin GROUP autosar_swc_val_autosar_swc_val_Step_sys_Subsystem_Reference_VAL_VEHICLE_PARTS_SubSys2_Compare_To_Constant9 "autosar_swc_val/autosar_swc_val_Step_sys/Subsystem Reference/VAL_VEHICLE_PARTS_SubSys2/Compare\nTo Constant9" /begin REF_MEASUREMENT autosar_swc_val_rtARID_DEF.Lsts_c /end REF_MEASUREMENT /end GROUP
/begin GROUP autosar_swc_val_autosar_swc_val_Step_sys_Subsystem_Reference_VAL_VEHICLE_STATE_SubSys "autosar_swc_val/autosar_swc_val_Step_sys/Subsystem Reference/VAL_VEHICLE_STATE_SubSys"
 /begin SUB_GROUP autosar_swc_val_autosar_swc_val_Step_sys_Subsystem_Reference_VAL_VEHICLE_STATE_SubSys_DiscreteLowPassFilter /end SUB_GROUP
 /begin REF_MEASUREMENT autosar_swc_val_rtARID_DEF.Delay_DSTATE autosar_swc_val_rtARID_DEF.icLoad /end REF_MEASUREMENT
/end GROUP
/begin GROUP autosar_swc_val_autosar_swc_val_Step_sys_Subsystem_Reference_VAL_VEHICLE_STATE_SubSys_DiscreteLowPassFilter "autosar_swc_val/autosar_swc_val_Step_sys/Subsystem Reference/VAL_VEHICLE_STATE_SubSys/DiscreteLowPassFilter"
 /begin REF_MEASUREMENT autosar_swc_val_rtARID_DEF.UnitDelay1_DSTATE_c autosar_swc_val_rtARID_DEF.UnitDelay_DSTATE /end REF_MEASUREMENT
/end GROUP
/begin GROUP autosar_swc_val_autosar_swc_val_Step_sys_Subsystem_Reference_calibration "autosar_swc_val/autosar_swc_val_Step_sys/Subsystem Reference/calibration"
 /begin REF_MEASUREMENT SwcOut_Enable_SafSignal SwcOut_Fusa_EPB_R_1_CRC2_Error SwcOut_Fusa_EPB_R_1_RollgCntr2_Error SwcOut_TEMP_FusaEnable SwcOut_Virtual_SW /end REF_MEASUREMENT
/end GROUP
/begin GROUP autosar_swc_val_autosar_swc_val_Step_sys_Subsystem_Reference_inputinit "autosar_swc_val/autosar_swc_val_Step_sys/Subsystem Reference/inputinit"
 /begin REF_MEASUREMENT SwcIn_VAL_MemSet_ACCStsInit SwcIn_VAL_MemSet_ICASStsInit SwcIn_VAL_MemSet_SteerAngOffsetInit SwcIn_VAL_MemSet_TimeGapInit /end REF_MEASUREMENT
/end GROUP
/begin GROUP autosar_swc_val_autosar_swc_val_Step_sys_Subsystem_Reference_inputinit3 "autosar_swc_val/autosar_swc_val_Step_sys/Subsystem Reference/inputinit3" /begin REF_MEASUREMENT SwcIn_TOP_FuncStatus /end REF_MEASUREMENT /end GROUP
/begin GROUP autosar_swc_val_rtARID_DEF.BusAssignment ""
 /begin REF_MEASUREMENT autosar_swc_val_rtARID_DEF.BusAssignment.ADS_1_CRC1 autosar_swc_val_rtARID_DEF.BusAssignment.ADS_1_RollgCntr1 autosar_swc_val_rtARID_DEF.BusAssignment.ADS_1_Resd1 autosar_swc_val_rtARID_DEF.BusAssignment.ADS_1_SteerAgReq autosar_swc_val_rtARID_DEF.BusAssignment.ADS_1_SteerAgVld autosar_swc_val_rtARID_DEF.BusAssignment.ADS_1_SteerPilotAgEna autosar_swc_val_rtARID_DEF.BusAssignment.ADS_1_CRC2 autosar_swc_val_rtARID_DEF.BusAssignment.ADS_1_RollgCntr2 autosar_swc_val_rtARID_DEF.BusAssignment.ADS_1_Resd2 autosar_swc_val_rtARID_DEF.BusAssignment.ADS_1_SteerTqEna autosar_swc_val_rtARID_DEF.BusAssignment.ADS_1_LdwWarningCmd autosar_swc_val_rtARID_DEF.BusAssignment.ADS_1_LdwWarningCmdVld autosar_swc_val_rtARID_DEF.BusAssignment.ADS_1_SteerMaxTqReq autosar_swc_val_rtARID_DEF.BusAssignment.ADS_1_SteerMinTqReq autosar_swc_val_rtARID_DEF.BusAssignment.ADS_1_ADSHealthSts autosar_swc_val_rtARID_DEF.BusAssignment.CutOutFreshvalues_2CB_S autosar_swc_val_rtARID_DEF.BusAssignment.CutOutMAC_2CB_S /end REF_MEASUREMENT
/end GROUP
/end MODULE
/end PROJECT
