ASAP2_VERSION 1 71
/begin PROJECT ProjectName ""
/begin MODULE ModuleName ""
/begin MOD_COMMON "" BYTE_ORDER MSB_LAST ALIGNMENT_BYTE 1 ALIGNMENT_WORD 1 ALIGNMENT_LONG 1 ALIGNMENT_INT64 1 ALIGNMENT_FLOAT16_IEEE 1 ALIGNMENT_FLOAT32_IEEE 1 ALIGNMENT_FLOAT64_IEEE 1 /end MOD_COMMON
/begin RECORD_LAYOUT __SBYTE_Z FNC_VALUES 1 SBYTE ROW_DIR DIRECT /end RECORD_LAYOUT
/begin CHARACTERISTIC CLTS_ObjSpdMovgToSelfMaxForBrkgInAsyEvlrCritEve_Ca "Maximum speed for an oncoming vehicle that is assumed to brake." VALUE 0xfe50732c /* @ECU_Address@CLTS_ObjSpdMovgToSelfMaxForBrkgInAsyEvlrCritEve_Ca@ */ Record_FLOAT32_IEEE 0 autosar_swc_aeb_CM_single_m_per_s 0.000000 50.000000 /end CHARACTERISTIC
/begin MEASUREMENT autosar_swc_aeb_rtARID_DEF.CrvtObj_l "" FLOAT32_IEEE autosar_swc_aeb_CM_single 0 0 -3.4E+38 3.4E+38 ECU_ADDRESS 0xfe4ab6ec /* @ECU_Address@autosar_swc_aeb_rtARID_DEF.CrvtObj_l@ */ /end MEASUREMENT
/begin MEASUREMENT autosar_swc_aeb_rtARID_DEF.HeadingObj_m "" FLOAT32_IEEE autosar_swc_aeb_CM_single 0 0 -3.4E+38 3.4E+38 ECU_ADDRESS 0xfe4ab6a8 /* @ECU_Address@autosar_swc_aeb_rtARID_DEF.HeadingObj_m@ */ /end MEASUREMENT
/begin MEASUREMENT autosar_swc_aeb_rtARID_DEF.LastSegment_h "" UBYTE autosar_swc_aeb_CM_uint8 0 0 0 255 ECU_ADDRESS 0xfe4aba4b /* @ECU_Address@autosar_swc_aeb_rtARID_DEF.LastSegment_h@ */ /end MEASUREMENT
/begin MEASUREMENT autosar_swc_aeb_rtARID_DEF.PosnLatObj_p "" FLOAT32_IEEE autosar_swc_aeb_CM_single 0 0 -3.4E+38 3.4E+38 ECU_ADDRESS 0xfe4ab6a4 /* @ECU_Address@autosar_swc_aeb_rtARID_DEF.PosnLatObj_p@ */ /end MEASUREMENT
/begin MEASUREMENT autosar_swc_aeb_rtARID_DEF.PosnLatObj_p3h "" FLOAT32_IEEE autosar_swc_aeb_CM_single 0 0 -3.4E+38 3.4E+38 ECU_ADDRESS 0xfe4ab6c4 /* @ECU_Address@autosar_swc_aeb_rtARID_DEF.PosnLatObj_p3h@ */ /end MEASUREMENT
/begin MEASUREMENT autosar_swc_aeb_rtARID_DEF.PosnLgtObj_o "" FLOAT32_IEEE autosar_swc_aeb_CM_single 0 0 -3.4E+38 3.4E+38 ECU_ADDRESS 0xfe4ab6a0 /* @ECU_Address@autosar_swc_aeb_rtARID_DEF.PosnLgtObj_o@ */ /end MEASUREMENT
/begin MEASUREMENT autosar_swc_aeb_rtARID_DEF.PosnLgtObj_o0e "" FLOAT32_IEEE autosar_swc_aeb_CM_single 0 0 -3.4E+38 3.4E+38 ECU_ADDRESS 0xfe4ab6c0 /* @ECU_Address@autosar_swc_aeb_rtARID_DEF.PosnLgtObj_o0e@ */ /end MEASUREMENT
/begin MEASUREMENT autosar_swc_aeb_rtARID_DEF.VLatObj_j "" FLOAT32_IEEE autosar_swc_aeb_CM_single 0 0 -3.4E+38 3.4E+38 ECU_ADDRESS 0xfe4ab6b0 /* @ECU_Address@autosar_swc_aeb_rtARID_DEF.VLatObj_j@ */ /end MEASUREMENT
/begin MEASUREMENT autosar_swc_aeb_rtARID_DEF.VLgtObj_f "" FLOAT32_IEEE autosar_swc_aeb_CM_single 0 0 -3.4E+38 3.4E+38 ECU_ADDRESS 0xfe4ab6ac /* @ECU_Address@autosar_swc_aeb_rtARID_DEF.VLgtObj_f@ */ /end MEASUREMENT
/begin COMPU_METHOD autosar_swc_aeb_CM_single "Q = V" IDENTICAL "%8.6" "" /end COMPU_METHOD
/begin COMPU_METHOD autosar_swc_aeb_CM_single_m_per_s "Q = V" IDENTICAL "%8.6" "m/s" /end COMPU_METHOD
/begin COMPU_METHOD autosar_swc_aeb_CM_uint8 "Q = V" IDENTICAL "%3.0" "" /end COMPU_METHOD
/begin RECORD_LAYOUT Record_FLOAT32_IEEE FNC_VALUES 1 FLOAT32_IEEE COLUMN_DIR DIRECT /end RECORD_LAYOUT
/begin GROUP autosar_swc_aeb_autosar_swc_aeb_Step_sys_Subsystem_Reference_AEB_Function_Run_AsyEvlrCritEve_Step_Func_Run_AsyEvlrCritEve_Step_Func_TAWrapper_PreProcessor_ObjectPreProcessor_ObjectPreProcessorLoop_ValidObject_SafetyMarginFrontObjects_InPathCalculationWithPredictedObjPositions_CreateInPathDataTTM_CalculateAccelerationAndPredictPosition_CircularPrediction_AccelerationCalculationAndCircularPredictionOfTurningObjAtTTR_NoOperation1 "autosar_swc_aeb/autosar_swc_aeb_Step_sys/Subsystem Reference/AEB Function/Run_AsyEvlrCritEve_Step_Func/Run_AsyEvlrCritEve_Step_Func/TAWrapper/PreProcessor/ObjectPreProcessor/ObjectPreProcessorLoop/ValidObject/SafetyMarginFrontObjects/InPathCalculationWithPredictedObjPositions/CreateInPathDataTTM/CalculateAccelerationAndPredictPosition/CircularPrediction/AccelerationCalculationAndCircularPredictionOfTurningObjAtTTR/NoOperation1" /begin REF_MEASUREMENT autosar_swc_aeb_rtARID_DEF.CrvtObj_l /end REF_MEASUREMENT /end GROUP
/begin GROUP autosar_swc_aeb_autosar_swc_aeb_Step_sys_Subsystem_Reference_AEB_Function_Run_AsyEvlrCritEve_Step_Func_Run_AsyEvlrCritEve_Step_Func_TAWrapper_PreProcessor_ObjectPreProcessor_ObjectPreProcessorLoop_ValidObject_SafetyMarginFrontObjects_InPathCalculationWithPredictedObjPositions_CreateInPathDataTTM_CalculateAccelerationAndPredictPosition_CircularPrediction_AccelerationCalculationAndCircularPredictionOfTurningObjAtTTR_PredictedPositionAtTimeHeadingAngleAndCurvatureBased "autosar_swc_aeb/autosar_swc_aeb_Step_sys/Subsystem Reference/AEB Function/Run_AsyEvlrCritEve_Step_Func/Run_AsyEvlrCritEve_Step_Func/TAWrapper/PreProcessor/ObjectPreProcessor/ObjectPreProcessorLoop/ValidObject/SafetyMarginFrontObjects/InPathCalculationWithPredictedObjPositions/CreateInPathDataTTM/CalculateAccelerationAndPredictPosition/CircularPrediction/AccelerationCalculationAndCircularPredictionOfTurningObjAtTTR/PredictedPositionAtTimeHeadingAngleAndCurvatureBased"
 /begin REF_MEASUREMENT autosar_swc_aeb_rtARID_DEF.PosnLatObj_p3h autosar_swc_aeb_rtARID_DEF.PosnLgtObj_o0e /end REF_MEASUREMENT
/end GROUP
/begin GROUP autosar_swc_aeb_autosar_swc_aeb_Step_sys_Subsystem_Reference_AEB_Function_Run_AsyEvlrCritEve_Step_Func_Run_AsyEvlrCritEve_Step_Func_TAWrapper_PreProcessor_ObjectPreProcessor_ObjectPreProcessorLoop_ValidObject_SafetyMarginFrontObjects_InPathCalculationWithPredictedObjPositions_CreateInPathDataTTM_CalculateAccelerationAndPredictPosition_CircularPrediction_CircularPredictionOfObjAtTTR "autosar_swc_aeb/autosar_swc_aeb_Step_sys/Subsystem Reference/AEB Function/Run_AsyEvlrCritEve_Step_Func/Run_AsyEvlrCritEve_Step_Func/TAWrapper/PreProcessor/ObjectPreProcessor/ObjectPreProcessorLoop/ValidObject/SafetyMarginFrontObjects/InPathCalculationWithPredictedObjPositions/CreateInPathDataTTM/CalculateAccelerationAndPredictPosition/CircularPrediction/CircularPredictionOfObjAtTTR"
 /begin SUB_GROUP autosar_swc_aeb_autosar_swc_aeb_Step_sys_Subsystem_Reference_AEB_Function_Run_AsyEvlrCritEve_Step_Func_Run_AsyEvlrCritEve_Step_Func_TAWrapper_PreProcessor_ObjectPreProcessor_ObjectPreProcessorLoop_ValidObject_SafetyMarginFrontObjects_InPathCalculationWithPredictedObjPositions_CreateInPathDataTTM_CalculateAccelerationAndPredictPosition_CircularPrediction_CircularPredictionOfObjAtTTR_NoOperation autosar_swc_aeb_autosar_swc_aeb_Step_sys_Subsystem_Reference_AEB_Function_Run_AsyEvlrCritEve_Step_Func_Run_AsyEvlrCritEve_Step_Func_TAWrapper_PreProcessor_ObjectPreProcessor_ObjectPreProcessorLoop_ValidObject_SafetyMarginFrontObjects_InPathCalculationWithPredictedObjPositions_CreateInPathDataTTM_CalculateAccelerationAndPredictPosition_CircularPrediction_CircularPredictionOfObjAtTTR_PredictedPositionAtTimeHeadingAngleAndCurvatureBased /end SUB_GROUP
 /begin REF_MEASUREMENT autosar_swc_aeb_rtARID_DEF.VLatObj_j autosar_swc_aeb_rtARID_DEF.VLgtObj_f /end REF_MEASUREMENT
/end GROUP
/begin GROUP autosar_swc_aeb_autosar_swc_aeb_Step_sys_Subsystem_Reference_AEB_Function_Run_AsyEvlrCritEve_Step_Func_Run_AsyEvlrCritEve_Step_Func_TAWrapper_PreProcessor_ObjectPreProcessor_ObjectPreProcessorLoop_ValidObject_SafetyMarginFrontObjects_InPathCalculationWithPredictedObjPositions_CreateInPathDataTTM_CalculateAccelerationAndPredictPosition_CircularPrediction_CircularPredictionOfObjAtTTR_NoOperation "autosar_swc_aeb/autosar_swc_aeb_Step_sys/Subsystem Reference/AEB Function/Run_AsyEvlrCritEve_Step_Func/Run_AsyEvlrCritEve_Step_Func/TAWrapper/PreProcessor/ObjectPreProcessor/ObjectPreProcessorLoop/ValidObject/SafetyMarginFrontObjects/InPathCalculationWithPredictedObjPositions/CreateInPathDataTTM/CalculateAccelerationAndPredictPosition/CircularPrediction/CircularPredictionOfObjAtTTR/NoOperation" /begin REF_MEASUREMENT autosar_swc_aeb_rtARID_DEF.HeadingObj_m /end REF_MEASUREMENT /end GROUP
/begin GROUP autosar_swc_aeb_autosar_swc_aeb_Step_sys_Subsystem_Reference_AEB_Function_Run_AsyEvlrCritEve_Step_Func_Run_AsyEvlrCritEve_Step_Func_TAWrapper_PreProcessor_ObjectPreProcessor_ObjectPreProcessorLoop_ValidObject_SafetyMarginFrontObjects_InPathCalculationWithPredictedObjPositions_CreateInPathDataTTM_CalculateAccelerationAndPredictPosition_CircularPrediction_CircularPredictionOfObjAtTTR_PredictedPositionAtTimeHeadingAngleAndCurvatureBased "autosar_swc_aeb/autosar_swc_aeb_Step_sys/Subsystem Reference/AEB Function/Run_AsyEvlrCritEve_Step_Func/Run_AsyEvlrCritEve_Step_Func/TAWrapper/PreProcessor/ObjectPreProcessor/ObjectPreProcessorLoop/ValidObject/SafetyMarginFrontObjects/InPathCalculationWithPredictedObjPositions/CreateInPathDataTTM/CalculateAccelerationAndPredictPosition/CircularPrediction/CircularPredictionOfObjAtTTR/PredictedPositionAtTimeHeadingAngleAndCurvatureBased"
 /begin REF_MEASUREMENT autosar_swc_aeb_rtARID_DEF.PosnLatObj_p autosar_swc_aeb_rtARID_DEF.PosnLgtObj_o /end REF_MEASUREMENT
/end GROUP
/begin GROUP autosar_swc_aeb_autosar_swc_aeb_Step_sys_Subsystem_Reference_AEB_Function_Run_AsyEvlrCritEve_Step_Func_Run_AsyEvlrCritEve_Step_Func_TAWrapper_PreProcessor_ObjectPreProcessor_ObjectPreProcessorLoop_ValidObject_SafetyMarginFrontObjects_InPathCalculationWithPredictedObjPositions_CreateInPathDataTTM_CalculateAccelerationAndPredictPosition_LinearPrediction "autosar_swc_aeb/autosar_swc_aeb_Step_sys/Subsystem Reference/AEB Function/Run_AsyEvlrCritEve_Step_Func/Run_AsyEvlrCritEve_Step_Func/TAWrapper/PreProcessor/ObjectPreProcessor/ObjectPreProcessorLoop/ValidObject/SafetyMarginFrontObjects/InPathCalculationWithPredictedObjPositions/CreateInPathDataTTM/CalculateAccelerationAndPredictPosition/LinearPrediction"
 /begin SUB_GROUP autosar_swc_aeb_autosar_swc_aeb_Step_sys_Subsystem_Reference_AEB_Function_Run_AsyEvlrCritEve_Step_Func_Run_AsyEvlrCritEve_Step_Func_TAWrapper_PreProcessor_ObjectPreProcessor_ObjectPreProcessorLoop_ValidObject_SafetyMarginFrontObjects_InPathCalculationWithPredictedObjPositions_CreateInPathDataTTM_CalculateAccelerationAndPredictPosition_LinearPrediction_AccelerationCalculationAndLinearPredictionOfBrakingObjAtTTR autosar_swc_aeb_autosar_swc_aeb_Step_sys_Subsystem_Reference_AEB_Function_Run_AsyEvlrCritEve_Step_Func_Run_AsyEvlrCritEve_Step_Func_TAWrapper_PreProcessor_ObjectPreProcessor_ObjectPreProcessorLoop_ValidObject_SafetyMarginFrontObjects_InPathCalculationWithPredictedObjPositions_CreateInPathDataTTM_CalculateAccelerationAndPredictPosition_LinearPrediction_AccelerationCalculationAndLinearPredictionOfBrakingObjAtTTR1 autosar_swc_aeb_autosar_swc_aeb_Step_sys_Subsystem_Reference_AEB_Function_Run_AsyEvlrCritEve_Step_Func_Run_AsyEvlrCritEve_Step_Func_TAWrapper_PreProcessor_ObjectPreProcessor_ObjectPreProcessorLoop_ValidObject_SafetyMarginFrontObjects_InPathCalculationWithPredictedObjPositions_CreateInPathDataTTM_CalculateAccelerationAndPredictPosition_LinearPrediction_AccelerationCalculationAndLinearPredictionOfTurningObjAtTTR autosar_swc_aeb_autosar_swc_aeb_Step_sys_Subsystem_Reference_AEB_Function_Run_AsyEvlrCritEve_Step_Func_Run_AsyEvlrCritEve_Step_Func_TAWrapper_PreProcessor_ObjectPreProcessor_ObjectPreProcessorLoop_ValidObject_SafetyMarginFrontObjects_InPathCalculationWithPredictedObjPositions_CreateInPathDataTTM_CalculateAccelerationAndPredictPosition_LinearPrediction_AccelerationCalculationAndLinearPredictionOfTurningObjAtTTR1 autosar_swc_aeb_autosar_swc_aeb_Step_sys_Subsystem_Reference_AEB_Function_Run_AsyEvlrCritEve_Step_Func_Run_AsyEvlrCritEve_Step_Func_TAWrapper_PreProcessor_ObjectPreProcessor_ObjectPreProcessorLoop_ValidObject_SafetyMarginFrontObjects_InPathCalculationWithPredictedObjPositions_CreateInPathDataTTM_CalculateAccelerationAndPredictPosition_LinearPrediction_LinearPredictionOfObjAtTTR /end SUB_GROUP
/end GROUP
/begin GROUP autosar_swc_aeb_autosar_swc_aeb_Step_sys_Subsystem_Reference_AEB_Function_Run_AsyEvlrCritEve_Step_Func_Run_AsyEvlrCritEve_Step_Func_TAWrapper_PreProcessor_ObjectPreProcessor_ObjectPreProcessorLoop_ValidObject_SafetyMarginFrontObjects_InPathCalculationWithPredictedObjPositions_CreateInPathDataTTM_CalculateAccelerationAndPredictPosition_LinearPrediction_AccelerationCalculationAndLinearPredictionOfBrakingObjAtTTR "autosar_swc_aeb/autosar_swc_aeb_Step_sys/Subsystem Reference/AEB Function/Run_AsyEvlrCritEve_Step_Func/Run_AsyEvlrCritEve_Step_Func/TAWrapper/PreProcessor/ObjectPreProcessor/ObjectPreProcessorLoop/ValidObject/SafetyMarginFrontObjects/InPathCalculationWithPredictedObjPositions/CreateInPathDataTTM/CalculateAccelerationAndPredictPosition/LinearPrediction/AccelerationCalculationAndLinearPredictionOfBrakingObjAtTTR"
 /begin SUB_GROUP autosar_swc_aeb_autosar_swc_aeb_Step_sys_Subsystem_Reference_AEB_Function_Run_AsyEvlrCritEve_Step_Func_Run_AsyEvlrCritEve_Step_Func_TAWrapper_PreProcessor_ObjectPreProcessor_ObjectPreProcessorLoop_ValidObject_SafetyMarginFrontObjects_InPathCalculationWithPredictedObjPositions_CreateInPathDataTTM_CalculateAccelerationAndPredictPosition_LinearPrediction_AccelerationCalculationAndLinearPredictionOfBrakingObjAtTTR_LinearMovementPredictorWithStopDetection autosar_swc_aeb_autosar_swc_aeb_Step_sys_Subsystem_Reference_AEB_Function_Run_AsyEvlrCritEve_Step_Func_Run_AsyEvlrCritEve_Step_Func_TAWrapper_PreProcessor_ObjectPreProcessor_ObjectPreProcessorLoop_ValidObject_SafetyMarginFrontObjects_InPathCalculationWithPredictedObjPositions_CreateInPathDataTTM_CalculateAccelerationAndPredictPosition_LinearPrediction_AccelerationCalculationAndLinearPredictionOfBrakingObjAtTTR_LinearMovementPredictorWithStopDetection1 autosar_swc_aeb_autosar_swc_aeb_Step_sys_Subsystem_Reference_AEB_Function_Run_AsyEvlrCritEve_Step_Func_Run_AsyEvlrCritEve_Step_Func_TAWrapper_PreProcessor_ObjectPreProcessor_ObjectPreProcessorLoop_ValidObject_SafetyMarginFrontObjects_InPathCalculationWithPredictedObjPositions_CreateInPathDataTTM_CalculateAccelerationAndPredictPosition_LinearPrediction_AccelerationCalculationAndLinearPredictionOfBrakingObjAtTTR_NoOperation1 autosar_swc_aeb_autosar_swc_aeb_Step_sys_Subsystem_Reference_AEB_Function_Run_AsyEvlrCritEve_Step_Func_Run_AsyEvlrCritEve_Step_Func_TAWrapper_PreProcessor_ObjectPreProcessor_ObjectPreProcessorLoop_ValidObject_SafetyMarginFrontObjects_InPathCalculationWithPredictedObjPositions_CreateInPathDataTTM_CalculateAccelerationAndPredictPosition_LinearPrediction_AccelerationCalculationAndLinearPredictionOfBrakingObjAtTTR_NoOperation2 autosar_swc_aeb_autosar_swc_aeb_Step_sys_Subsystem_Reference_AEB_Function_Run_AsyEvlrCritEve_Step_Func_Run_AsyEvlrCritEve_Step_Func_TAWrapper_PreProcessor_ObjectPreProcessor_ObjectPreProcessorLoop_ValidObject_SafetyMarginFrontObjects_InPathCalculationWithPredictedObjPositions_CreateInPathDataTTM_CalculateAccelerationAndPredictPosition_LinearPrediction_AccelerationCalculationAndLinearPredictionOfBrakingObjAtTTR_NoOperation3 autosar_swc_aeb_autosar_swc_aeb_Step_sys_Subsystem_Reference_AEB_Function_Run_AsyEvlrCritEve_Step_Func_Run_AsyEvlrCritEve_Step_Func_TAWrapper_PreProcessor_ObjectPreProcessor_ObjectPreProcessorLoop_ValidObject_SafetyMarginFrontObjects_InPathCalculationWithPredictedObjPositions_CreateInPathDataTTM_CalculateAccelerationAndPredictPosition_LinearPrediction_AccelerationCalculationAndLinearPredictionOfBrakingObjAtTTR_NoOperation4 autosar_swc_aeb_autosar_swc_aeb_Step_sys_Subsystem_Reference_AEB_Function_Run_AsyEvlrCritEve_Step_Func_Run_AsyEvlrCritEve_Step_Func_TAWrapper_PreProcessor_ObjectPreProcessor_ObjectPreProcessorLoop_ValidObject_SafetyMarginFrontObjects_InPathCalculationWithPredictedObjPositions_CreateInPathDataTTM_CalculateAccelerationAndPredictPosition_LinearPrediction_AccelerationCalculationAndLinearPredictionOfBrakingObjAtTTR_NoOperation5 /end SUB_GROUP
/end GROUP
/begin GROUP autosar_swc_aeb_autosar_swc_aeb_Step_sys_Subsystem_Reference_AEB_Function_Run_AsyEvlrCritEve_Step_Func_Run_AsyEvlrCritEve_Step_Func_TAWrapper_PreProcessor_ObjectPreProcessor_ObjectPreProcessorLoop_ValidObject_SafetyMarginFrontObjects_InPathCalculationWithPredictedObjPositions_CreateInPathDataTTM_CalculateAccelerationAndPredictPosition_LinearPrediction_AccelerationCalculationAndLinearPredictionOfBrakingObjAtTTR1 "autosar_swc_aeb/autosar_swc_aeb_Step_sys/Subsystem Reference/AEB Function/Run_AsyEvlrCritEve_Step_Func/Run_AsyEvlrCritEve_Step_Func/TAWrapper/PreProcessor/ObjectPreProcessor/ObjectPreProcessorLoop/ValidObject/SafetyMarginFrontObjects/InPathCalculationWithPredictedObjPositions/CreateInPathDataTTM/CalculateAccelerationAndPredictPosition/LinearPrediction/AccelerationCalculationAndLinearPredictionOfBrakingObjAtTTR1"
 /begin SUB_GROUP autosar_swc_aeb_autosar_swc_aeb_Step_sys_Subsystem_Reference_AEB_Function_Run_AsyEvlrCritEve_Step_Func_Run_AsyEvlrCritEve_Step_Func_TAWrapper_PreProcessor_ObjectPreProcessor_ObjectPreProcessorLoop_ValidObject_SafetyMarginFrontObjects_InPathCalculationWithPredictedObjPositions_CreateInPathDataTTM_CalculateAccelerationAndPredictPosition_LinearPrediction_AccelerationCalculationAndLinearPredictionOfBrakingObjAtTTR1_LinearMovementPredictorWithStopDetection autosar_swc_aeb_autosar_swc_aeb_Step_sys_Subsystem_Reference_AEB_Function_Run_AsyEvlrCritEve_Step_Func_Run_AsyEvlrCritEve_Step_Func_TAWrapper_PreProcessor_ObjectPreProcessor_ObjectPreProcessorLoop_ValidObject_SafetyMarginFrontObjects_InPathCalculationWithPredictedObjPositions_CreateInPathDataTTM_CalculateAccelerationAndPredictPosition_LinearPrediction_AccelerationCalculationAndLinearPredictionOfBrakingObjAtTTR1_LinearMovementPredictorWithStopDetection1 autosar_swc_aeb_autosar_swc_aeb_Step_sys_Subsystem_Reference_AEB_Function_Run_AsyEvlrCritEve_Step_Func_Run_AsyEvlrCritEve_Step_Func_TAWrapper_PreProcessor_ObjectPreProcessor_ObjectPreProcessorLoop_ValidObject_SafetyMarginFrontObjects_InPathCalculationWithPredictedObjPositions_CreateInPathDataTTM_CalculateAccelerationAndPredictPosition_LinearPrediction_AccelerationCalculationAndLinearPredictionOfBrakingObjAtTTR1_NoOperation1 autosar_swc_aeb_autosar_swc_aeb_Step_sys_Subsystem_Reference_AEB_Function_Run_AsyEvlrCritEve_Step_Func_Run_AsyEvlrCritEve_Step_Func_TAWrapper_PreProcessor_ObjectPreProcessor_ObjectPreProcessorLoop_ValidObject_SafetyMarginFrontObjects_InPathCalculationWithPredictedObjPositions_CreateInPathDataTTM_CalculateAccelerationAndPredictPosition_LinearPrediction_AccelerationCalculationAndLinearPredictionOfBrakingObjAtTTR1_NoOperation2 autosar_swc_aeb_autosar_swc_aeb_Step_sys_Subsystem_Reference_AEB_Function_Run_AsyEvlrCritEve_Step_Func_Run_AsyEvlrCritEve_Step_Func_TAWrapper_PreProcessor_ObjectPreProcessor_ObjectPreProcessorLoop_ValidObject_SafetyMarginFrontObjects_InPathCalculationWithPredictedObjPositions_CreateInPathDataTTM_CalculateAccelerationAndPredictPosition_LinearPrediction_AccelerationCalculationAndLinearPredictionOfBrakingObjAtTTR1_NoOperation3 autosar_swc_aeb_autosar_swc_aeb_Step_sys_Subsystem_Reference_AEB_Function_Run_AsyEvlrCritEve_Step_Func_Run_AsyEvlrCritEve_Step_Func_TAWrapper_PreProcessor_ObjectPreProcessor_ObjectPreProcessorLoop_ValidObject_SafetyMarginFrontObjects_InPathCalculationWithPredictedObjPositions_CreateInPathDataTTM_CalculateAccelerationAndPredictPosition_LinearPrediction_AccelerationCalculationAndLinearPredictionOfBrakingObjAtTTR1_NoOperation4 autosar_swc_aeb_autosar_swc_aeb_Step_sys_Subsystem_Reference_AEB_Function_Run_AsyEvlrCritEve_Step_Func_Run_AsyEvlrCritEve_Step_Func_TAWrapper_PreProcessor_ObjectPreProcessor_ObjectPreProcessorLoop_ValidObject_SafetyMarginFrontObjects_InPathCalculationWithPredictedObjPositions_CreateInPathDataTTM_CalculateAccelerationAndPredictPosition_LinearPrediction_AccelerationCalculationAndLinearPredictionOfBrakingObjAtTTR1_NoOperation5 /end SUB_GROUP
/end GROUP
/begin GROUP autosar_swc_aeb_autosar_swc_aeb_Step_sys_Subsystem_Reference_AEB_Function_Run_AsyEvlrCritEve_Step_Func_Run_AsyEvlrCritEve_Step_Func_TAWrapper_PreProcessor_ObjectPreProcessor_ObjectPreProcessorLoop_ValidObject_SafetyMarginFrontObjects_InPathCalculationWithPredictedObjPositions_CreateInPathDataTTM_CalculateAccelerationAndPredictPosition_LinearPrediction_AccelerationCalculationAndLinearPredictionOfBrakingObjAtTTR1_LinearMovementPredictorWithStopDetection "autosar_swc_aeb/autosar_swc_aeb_Step_sys/Subsystem Reference/AEB Function/Run_AsyEvlrCritEve_Step_Func/Run_AsyEvlrCritEve_Step_Func/TAWrapper/PreProcessor/ObjectPreProcessor/ObjectPreProcessorLoop/ValidObject/SafetyMarginFrontObjects/InPathCalculationWithPredictedObjPositions/CreateInPathDataTTM/CalculateAccelerationAndPredictPosition/LinearPrediction/AccelerationCalculationAndLinearPredictionOfBrakingObjAtTTR1/LinearMovementPredictorWithStopDetection"
 /begin SUB_GROUP autosar_swc_aeb_autosar_swc_aeb_Step_sys_Subsystem_Reference_AEB_Function_Run_AsyEvlrCritEve_Step_Func_Run_AsyEvlrCritEve_Step_Func_TAWrapper_PreProcessor_ObjectPreProcessor_ObjectPreProcessorLoop_ValidObject_SafetyMarginFrontObjects_InPathCalculationWithPredictedObjPositions_CreateInPathDataTTM_CalculateAccelerationAndPredictPosition_LinearPrediction_AccelerationCalculationAndLinearPredictionOfBrakingObjAtTTR1_LinearMovementPredictorWithStopDetection_LinearMovementPredictor /end SUB_GROUP
/end GROUP
/begin GROUP autosar_swc_aeb_autosar_swc_aeb_Step_sys_Subsystem_Reference_AEB_Function_Run_AsyEvlrCritEve_Step_Func_Run_AsyEvlrCritEve_Step_Func_TAWrapper_PreProcessor_ObjectPreProcessor_ObjectPreProcessorLoop_ValidObject_SafetyMarginFrontObjects_InPathCalculationWithPredictedObjPositions_CreateInPathDataTTM_CalculateAccelerationAndPredictPosition_LinearPrediction_AccelerationCalculationAndLinearPredictionOfBrakingObjAtTTR1_LinearMovementPredictorWithStopDetection1 "autosar_swc_aeb/autosar_swc_aeb_Step_sys/Subsystem Reference/AEB Function/Run_AsyEvlrCritEve_Step_Func/Run_AsyEvlrCritEve_Step_Func/TAWrapper/PreProcessor/ObjectPreProcessor/ObjectPreProcessorLoop/ValidObject/SafetyMarginFrontObjects/InPathCalculationWithPredictedObjPositions/CreateInPathDataTTM/CalculateAccelerationAndPredictPosition/LinearPrediction/AccelerationCalculationAndLinearPredictionOfBrakingObjAtTTR1/LinearMovementPredictorWithStopDetection1"
 /begin SUB_GROUP autosar_swc_aeb_autosar_swc_aeb_Step_sys_Subsystem_Reference_AEB_Function_Run_AsyEvlrCritEve_Step_Func_Run_AsyEvlrCritEve_Step_Func_TAWrapper_PreProcessor_ObjectPreProcessor_ObjectPreProcessorLoop_ValidObject_SafetyMarginFrontObjects_InPathCalculationWithPredictedObjPositions_CreateInPathDataTTM_CalculateAccelerationAndPredictPosition_LinearPrediction_AccelerationCalculationAndLinearPredictionOfBrakingObjAtTTR1_LinearMovementPredictorWithStopDetection1_LinearMovementPredictor /end SUB_GROUP
/end GROUP
/begin GROUP autosar_swc_aeb_autosar_swc_aeb_Step_sys_Subsystem_Reference_AEB_Function_Run_AsyEvlrCritEve_Step_Func_Run_AsyEvlrCritEve_Step_Func_TAWrapper_PreProcessor_ObjectPreProcessor_ObjectPreProcessorLoop_ValidObject_SafetyMarginFrontObjects_InPathCalculationWithPredictedObjPositions_CreateInPathDataTTM_CalculateAccelerationAndPredictPosition_LinearPrediction_AccelerationCalculationAndLinearPredictionOfBrakingObjAtTTR_LinearMovementPredictorWithStopDetection "autosar_swc_aeb/autosar_swc_aeb_Step_sys/Subsystem Reference/AEB Function/Run_AsyEvlrCritEve_Step_Func/Run_AsyEvlrCritEve_Step_Func/TAWrapper/PreProcessor/ObjectPreProcessor/ObjectPreProcessorLoop/ValidObject/SafetyMarginFrontObjects/InPathCalculationWithPredictedObjPositions/CreateInPathDataTTM/CalculateAccelerationAndPredictPosition/LinearPrediction/AccelerationCalculationAndLinearPredictionOfBrakingObjAtTTR/LinearMovementPredictorWithStopDetection"
 /begin SUB_GROUP autosar_swc_aeb_autosar_swc_aeb_Step_sys_Subsystem_Reference_AEB_Function_Run_AsyEvlrCritEve_Step_Func_Run_AsyEvlrCritEve_Step_Func_TAWrapper_PreProcessor_ObjectPreProcessor_ObjectPreProcessorLoop_ValidObject_SafetyMarginFrontObjects_InPathCalculationWithPredictedObjPositions_CreateInPathDataTTM_CalculateAccelerationAndPredictPosition_LinearPrediction_AccelerationCalculationAndLinearPredictionOfBrakingObjAtTTR_LinearMovementPredictorWithStopDetection_LinearMovementPredictor /end SUB_GROUP
/end GROUP
/begin GROUP autosar_swc_aeb_autosar_swc_aeb_Step_sys_Subsystem_Reference_AEB_Function_Run_AsyEvlrCritEve_Step_Func_Run_AsyEvlrCritEve_Step_Func_TAWrapper_PreProcessor_ObjectPreProcessor_ObjectPreProcessorLoop_ValidObject_SafetyMarginFrontObjects_InPathCalculationWithPredictedObjPositions_CreateInPathDataTTM_CalculateAccelerationAndPredictPosition_LinearPrediction_AccelerationCalculationAndLinearPredictionOfBrakingObjAtTTR_LinearMovementPredictorWithStopDetection1 "autosar_swc_aeb/autosar_swc_aeb_Step_sys/Subsystem Reference/AEB Function/Run_AsyEvlrCritEve_Step_Func/Run_AsyEvlrCritEve_Step_Func/TAWrapper/PreProcessor/ObjectPreProcessor/ObjectPreProcessorLoop/ValidObject/SafetyMarginFrontObjects/InPathCalculationWithPredictedObjPositions/CreateInPathDataTTM/CalculateAccelerationAndPredictPosition/LinearPrediction/AccelerationCalculationAndLinearPredictionOfBrakingObjAtTTR/LinearMovementPredictorWithStopDetection1"
 /begin SUB_GROUP autosar_swc_aeb_autosar_swc_aeb_Step_sys_Subsystem_Reference_AEB_Function_Run_AsyEvlrCritEve_Step_Func_Run_AsyEvlrCritEve_Step_Func_TAWrapper_PreProcessor_ObjectPreProcessor_ObjectPreProcessorLoop_ValidObject_SafetyMarginFrontObjects_InPathCalculationWithPredictedObjPositions_CreateInPathDataTTM_CalculateAccelerationAndPredictPosition_LinearPrediction_AccelerationCalculationAndLinearPredictionOfBrakingObjAtTTR_LinearMovementPredictorWithStopDetection1_LinearMovementPredictor /end SUB_GROUP
/end GROUP
/begin GROUP autosar_swc_aeb_autosar_swc_aeb_Step_sys_Subsystem_Reference_AEB_Function_Run_AsyEvlrCritEve_Step_Func_Run_AsyEvlrCritEve_Step_Func_TAWrapper_PreProcessor_ObjectPreProcessor_ObjectPreProcessorLoop_ValidObject_SafetyMarginFrontObjects_InPathCalculationWithPredictedObjPositions_CreateInPathDataTTM_CalculateAccelerationAndPredictPosition_LinearPrediction_AccelerationCalculationAndLinearPredictionOfTurningObjAtTTR "autosar_swc_aeb/autosar_swc_aeb_Step_sys/Subsystem Reference/AEB Function/Run_AsyEvlrCritEve_Step_Func/Run_AsyEvlrCritEve_Step_Func/TAWrapper/PreProcessor/ObjectPreProcessor/ObjectPreProcessorLoop/ValidObject/SafetyMarginFrontObjects/InPathCalculationWithPredictedObjPositions/CreateInPathDataTTM/CalculateAccelerationAndPredictPosition/LinearPrediction/AccelerationCalculationAndLinearPredictionOfTurningObjAtTTR"
 /begin SUB_GROUP autosar_swc_aeb_autosar_swc_aeb_Step_sys_Subsystem_Reference_AEB_Function_Run_AsyEvlrCritEve_Step_Func_Run_AsyEvlrCritEve_Step_Func_TAWrapper_PreProcessor_ObjectPreProcessor_ObjectPreProcessorLoop_ValidObject_SafetyMarginFrontObjects_InPathCalculationWithPredictedObjPositions_CreateInPathDataTTM_CalculateAccelerationAndPredictPosition_LinearPrediction_AccelerationCalculationAndLinearPredictionOfTurningObjAtTTR_NoOperation autosar_swc_aeb_autosar_swc_aeb_Step_sys_Subsystem_Reference_AEB_Function_Run_AsyEvlrCritEve_Step_Func_Run_AsyEvlrCritEve_Step_Func_TAWrapper_PreProcessor_ObjectPreProcessor_ObjectPreProcessorLoop_ValidObject_SafetyMarginFrontObjects_InPathCalculationWithPredictedObjPositions_CreateInPathDataTTM_CalculateAccelerationAndPredictPosition_LinearPrediction_AccelerationCalculationAndLinearPredictionOfTurningObjAtTTR_NoOperation1 autosar_swc_aeb_autosar_swc_aeb_Step_sys_Subsystem_Reference_AEB_Function_Run_AsyEvlrCritEve_Step_Func_Run_AsyEvlrCritEve_Step_Func_TAWrapper_PreProcessor_ObjectPreProcessor_ObjectPreProcessorLoop_ValidObject_SafetyMarginFrontObjects_InPathCalculationWithPredictedObjPositions_CreateInPathDataTTM_CalculateAccelerationAndPredictPosition_LinearPrediction_AccelerationCalculationAndLinearPredictionOfTurningObjAtTTR_NoOperation2 autosar_swc_aeb_autosar_swc_aeb_Step_sys_Subsystem_Reference_AEB_Function_Run_AsyEvlrCritEve_Step_Func_Run_AsyEvlrCritEve_Step_Func_TAWrapper_PreProcessor_ObjectPreProcessor_ObjectPreProcessorLoop_ValidObject_SafetyMarginFrontObjects_InPathCalculationWithPredictedObjPositions_CreateInPathDataTTM_CalculateAccelerationAndPredictPosition_LinearPrediction_AccelerationCalculationAndLinearPredictionOfTurningObjAtTTR_NoOperation3 autosar_swc_aeb_autosar_swc_aeb_Step_sys_Subsystem_Reference_AEB_Function_Run_AsyEvlrCritEve_Step_Func_Run_AsyEvlrCritEve_Step_Func_TAWrapper_PreProcessor_ObjectPreProcessor_ObjectPreProcessorLoop_ValidObject_SafetyMarginFrontObjects_InPathCalculationWithPredictedObjPositions_CreateInPathDataTTM_CalculateAccelerationAndPredictPosition_LinearPrediction_AccelerationCalculationAndLinearPredictionOfTurningObjAtTTR_NoOperation4 autosar_swc_aeb_autosar_swc_aeb_Step_sys_Subsystem_Reference_AEB_Function_Run_AsyEvlrCritEve_Step_Func_Run_AsyEvlrCritEve_Step_Func_TAWrapper_PreProcessor_ObjectPreProcessor_ObjectPreProcessorLoop_ValidObject_SafetyMarginFrontObjects_InPathCalculationWithPredictedObjPositions_CreateInPathDataTTM_CalculateAccelerationAndPredictPosition_LinearPrediction_AccelerationCalculationAndLinearPredictionOfTurningObjAtTTR_NoOperation5 /end SUB_GROUP
 /begin REF_MEASUREMENT autosar_swc_aeb_rtARID_DEF.PosnLatObj_p3h autosar_swc_aeb_rtARID_DEF.PosnLgtObj_o0e /end REF_MEASUREMENT
/end GROUP
/begin GROUP autosar_swc_aeb_autosar_swc_aeb_Step_sys_Subsystem_Reference_AEB_Function_Run_AsyEvlrCritEve_Step_Func_Run_AsyEvlrCritEve_Step_Func_TAWrapper_PreProcessor_ObjectPreProcessor_ObjectPreProcessorLoop_ValidObject_SafetyMarginFrontObjects_InPathCalculationWithPredictedObjPositions_CreateInPathDataTTM_CalculateAccelerationAndPredictPosition_LinearPrediction_AccelerationCalculationAndLinearPredictionOfTurningObjAtTTR1 "autosar_swc_aeb/autosar_swc_aeb_Step_sys/Subsystem Reference/AEB Function/Run_AsyEvlrCritEve_Step_Func/Run_AsyEvlrCritEve_Step_Func/TAWrapper/PreProcessor/ObjectPreProcessor/ObjectPreProcessorLoop/ValidObject/SafetyMarginFrontObjects/InPathCalculationWithPredictedObjPositions/CreateInPathDataTTM/CalculateAccelerationAndPredictPosition/LinearPrediction/AccelerationCalculationAndLinearPredictionOfTurningObjAtTTR1"
 /begin SUB_GROUP autosar_swc_aeb_autosar_swc_aeb_Step_sys_Subsystem_Reference_AEB_Function_Run_AsyEvlrCritEve_Step_Func_Run_AsyEvlrCritEve_Step_Func_TAWrapper_PreProcessor_ObjectPreProcessor_ObjectPreProcessorLoop_ValidObject_SafetyMarginFrontObjects_InPathCalculationWithPredictedObjPositions_CreateInPathDataTTM_CalculateAccelerationAndPredictPosition_LinearPrediction_AccelerationCalculationAndLinearPredictionOfTurningObjAtTTR1_NoOperation autosar_swc_aeb_autosar_swc_aeb_Step_sys_Subsystem_Reference_AEB_Function_Run_AsyEvlrCritEve_Step_Func_Run_AsyEvlrCritEve_Step_Func_TAWrapper_PreProcessor_ObjectPreProcessor_ObjectPreProcessorLoop_ValidObject_SafetyMarginFrontObjects_InPathCalculationWithPredictedObjPositions_CreateInPathDataTTM_CalculateAccelerationAndPredictPosition_LinearPrediction_AccelerationCalculationAndLinearPredictionOfTurningObjAtTTR1_NoOperation1 autosar_swc_aeb_autosar_swc_aeb_Step_sys_Subsystem_Reference_AEB_Function_Run_AsyEvlrCritEve_Step_Func_Run_AsyEvlrCritEve_Step_Func_TAWrapper_PreProcessor_ObjectPreProcessor_ObjectPreProcessorLoop_ValidObject_SafetyMarginFrontObjects_InPathCalculationWithPredictedObjPositions_CreateInPathDataTTM_CalculateAccelerationAndPredictPosition_LinearPrediction_AccelerationCalculationAndLinearPredictionOfTurningObjAtTTR1_NoOperation2 autosar_swc_aeb_autosar_swc_aeb_Step_sys_Subsystem_Reference_AEB_Function_Run_AsyEvlrCritEve_Step_Func_Run_AsyEvlrCritEve_Step_Func_TAWrapper_PreProcessor_ObjectPreProcessor_ObjectPreProcessorLoop_ValidObject_SafetyMarginFrontObjects_InPathCalculationWithPredictedObjPositions_CreateInPathDataTTM_CalculateAccelerationAndPredictPosition_LinearPrediction_AccelerationCalculationAndLinearPredictionOfTurningObjAtTTR1_NoOperation3 autosar_swc_aeb_autosar_swc_aeb_Step_sys_Subsystem_Reference_AEB_Function_Run_AsyEvlrCritEve_Step_Func_Run_AsyEvlrCritEve_Step_Func_TAWrapper_PreProcessor_ObjectPreProcessor_ObjectPreProcessorLoop_ValidObject_SafetyMarginFrontObjects_InPathCalculationWithPredictedObjPositions_CreateInPathDataTTM_CalculateAccelerationAndPredictPosition_LinearPrediction_AccelerationCalculationAndLinearPredictionOfTurningObjAtTTR1_NoOperation4 autosar_swc_aeb_autosar_swc_aeb_Step_sys_Subsystem_Reference_AEB_Function_Run_AsyEvlrCritEve_Step_Func_Run_AsyEvlrCritEve_Step_Func_TAWrapper_PreProcessor_ObjectPreProcessor_ObjectPreProcessorLoop_ValidObject_SafetyMarginFrontObjects_InPathCalculationWithPredictedObjPositions_CreateInPathDataTTM_CalculateAccelerationAndPredictPosition_LinearPrediction_AccelerationCalculationAndLinearPredictionOfTurningObjAtTTR1_NoOperation5 /end SUB_GROUP
/end GROUP
/begin GROUP autosar_swc_aeb_autosar_swc_aeb_Step_sys_Subsystem_Reference_AEB_Function_Run_AsyEvlrCritEve_Step_Func_Run_AsyEvlrCritEve_Step_Func_TAWrapper_PreProcessor_ObjectPreProcessor_ObjectPreProcessorLoop_ValidObject_SafetyMarginFrontObjects_InPathCalculationWithPredictedObjPositions_CreateInPathDataTTM_CalculateAccelerationAndPredictPosition_LinearPrediction_AccelerationCalculationAndLinearPredictionOfTurningObjAtTTR_NoOperation2 "autosar_swc_aeb/autosar_swc_aeb_Step_sys/Subsystem Reference/AEB Function/Run_AsyEvlrCritEve_Step_Func/Run_AsyEvlrCritEve_Step_Func/TAWrapper/PreProcessor/ObjectPreProcessor/ObjectPreProcessorLoop/ValidObject/SafetyMarginFrontObjects/InPathCalculationWithPredictedObjPositions/CreateInPathDataTTM/CalculateAccelerationAndPredictPosition/LinearPrediction/AccelerationCalculationAndLinearPredictionOfTurningObjAtTTR/NoOperation2" /begin REF_MEASUREMENT autosar_swc_aeb_rtARID_DEF.CrvtObj_l /end REF_MEASUREMENT /end GROUP
/begin GROUP autosar_swc_aeb_autosar_swc_aeb_Step_sys_Subsystem_Reference_AEB_Function_Run_AsyEvlrCritEve_Step_Func_Run_AsyEvlrCritEve_Step_Func_TAWrapper_PreProcessor_ObjectPreProcessor_ObjectPreProcessorLoop_ValidObject_SafetyMarginFrontObjects_InPathCalculationWithPredictedObjPositions_CreateInPathDataTTM_CalculateAccelerationAndPredictPosition_LinearPrediction_LinearPredictionOfObjAtTTR "autosar_swc_aeb/autosar_swc_aeb_Step_sys/Subsystem Reference/AEB Function/Run_AsyEvlrCritEve_Step_Func/Run_AsyEvlrCritEve_Step_Func/TAWrapper/PreProcessor/ObjectPreProcessor/ObjectPreProcessorLoop/ValidObject/SafetyMarginFrontObjects/InPathCalculationWithPredictedObjPositions/CreateInPathDataTTM/CalculateAccelerationAndPredictPosition/LinearPrediction/LinearPredictionOfObjAtTTR"
 /begin SUB_GROUP autosar_swc_aeb_autosar_swc_aeb_Step_sys_Subsystem_Reference_AEB_Function_Run_AsyEvlrCritEve_Step_Func_Run_AsyEvlrCritEve_Step_Func_TAWrapper_PreProcessor_ObjectPreProcessor_ObjectPreProcessorLoop_ValidObject_SafetyMarginFrontObjects_InPathCalculationWithPredictedObjPositions_CreateInPathDataTTM_CalculateAccelerationAndPredictPosition_LinearPrediction_LinearPredictionOfObjAtTTR_LinearMovementPredictorWithStopDetection autosar_swc_aeb_autosar_swc_aeb_Step_sys_Subsystem_Reference_AEB_Function_Run_AsyEvlrCritEve_Step_Func_Run_AsyEvlrCritEve_Step_Func_TAWrapper_PreProcessor_ObjectPreProcessor_ObjectPreProcessorLoop_ValidObject_SafetyMarginFrontObjects_InPathCalculationWithPredictedObjPositions_CreateInPathDataTTM_CalculateAccelerationAndPredictPosition_LinearPrediction_LinearPredictionOfObjAtTTR_LinearMovementPredictorWithStopDetection1 autosar_swc_aeb_autosar_swc_aeb_Step_sys_Subsystem_Reference_AEB_Function_Run_AsyEvlrCritEve_Step_Func_Run_AsyEvlrCritEve_Step_Func_TAWrapper_PreProcessor_ObjectPreProcessor_ObjectPreProcessorLoop_ValidObject_SafetyMarginFrontObjects_InPathCalculationWithPredictedObjPositions_CreateInPathDataTTM_CalculateAccelerationAndPredictPosition_LinearPrediction_LinearPredictionOfObjAtTTR_NoOperation autosar_swc_aeb_autosar_swc_aeb_Step_sys_Subsystem_Reference_AEB_Function_Run_AsyEvlrCritEve_Step_Func_Run_AsyEvlrCritEve_Step_Func_TAWrapper_PreProcessor_ObjectPreProcessor_ObjectPreProcessorLoop_ValidObject_SafetyMarginFrontObjects_InPathCalculationWithPredictedObjPositions_CreateInPathDataTTM_CalculateAccelerationAndPredictPosition_LinearPrediction_LinearPredictionOfObjAtTTR_NoOperation1 /end SUB_GROUP
 /begin REF_MEASUREMENT autosar_swc_aeb_rtARID_DEF.HeadingObj_m /end REF_MEASUREMENT
/end GROUP
/begin GROUP autosar_swc_aeb_autosar_swc_aeb_Step_sys_Subsystem_Reference_AEB_Function_Run_AsyEvlrCritEve_Step_Func_Run_AsyEvlrCritEve_Step_Func_TAWrapper_PreProcessor_ObjectPreProcessor_ObjectPreProcessorLoop_ValidObject_SafetyMarginFrontObjects_InPathCalculationWithPredictedObjPositions_CreateInPathDataTTM_CalculateAccelerationAndPredictPosition_LinearPrediction_LinearPredictionOfObjAtTTR_LinearMovementPredictorWithStopDetection "autosar_swc_aeb/autosar_swc_aeb_Step_sys/Subsystem Reference/AEB Function/Run_AsyEvlrCritEve_Step_Func/Run_AsyEvlrCritEve_Step_Func/TAWrapper/PreProcessor/ObjectPreProcessor/ObjectPreProcessorLoop/ValidObject/SafetyMarginFrontObjects/InPathCalculationWithPredictedObjPositions/CreateInPathDataTTM/CalculateAccelerationAndPredictPosition/LinearPrediction/LinearPredictionOfObjAtTTR/LinearMovementPredictorWithStopDetection"
 /begin SUB_GROUP autosar_swc_aeb_autosar_swc_aeb_Step_sys_Subsystem_Reference_AEB_Function_Run_AsyEvlrCritEve_Step_Func_Run_AsyEvlrCritEve_Step_Func_TAWrapper_PreProcessor_ObjectPreProcessor_ObjectPreProcessorLoop_ValidObject_SafetyMarginFrontObjects_InPathCalculationWithPredictedObjPositions_CreateInPathDataTTM_CalculateAccelerationAndPredictPosition_LinearPrediction_LinearPredictionOfObjAtTTR_LinearMovementPredictorWithStopDetection_LinearMovementPredictor /end SUB_GROUP
/end GROUP
/begin GROUP autosar_swc_aeb_autosar_swc_aeb_Step_sys_Subsystem_Reference_AEB_Function_Run_AsyEvlrCritEve_Step_Func_Run_AsyEvlrCritEve_Step_Func_TAWrapper_PreProcessor_ObjectPreProcessor_ObjectPreProcessorLoop_ValidObject_SafetyMarginFrontObjects_InPathCalculationWithPredictedObjPositions_CreateInPathDataTTM_CalculateAccelerationAndPredictPosition_LinearPrediction_LinearPredictionOfObjAtTTR_LinearMovementPredictorWithStopDetection1 "autosar_swc_aeb/autosar_swc_aeb_Step_sys/Subsystem Reference/AEB Function/Run_AsyEvlrCritEve_Step_Func/Run_AsyEvlrCritEve_Step_Func/TAWrapper/PreProcessor/ObjectPreProcessor/ObjectPreProcessorLoop/ValidObject/SafetyMarginFrontObjects/InPathCalculationWithPredictedObjPositions/CreateInPathDataTTM/CalculateAccelerationAndPredictPosition/LinearPrediction/LinearPredictionOfObjAtTTR/LinearMovementPredictorWithStopDetection1"
 /begin SUB_GROUP autosar_swc_aeb_autosar_swc_aeb_Step_sys_Subsystem_Reference_AEB_Function_Run_AsyEvlrCritEve_Step_Func_Run_AsyEvlrCritEve_Step_Func_TAWrapper_PreProcessor_ObjectPreProcessor_ObjectPreProcessorLoop_ValidObject_SafetyMarginFrontObjects_InPathCalculationWithPredictedObjPositions_CreateInPathDataTTM_CalculateAccelerationAndPredictPosition_LinearPrediction_LinearPredictionOfObjAtTTR_LinearMovementPredictorWithStopDetection1_LinearMovementPredictor /end SUB_GROUP
/end GROUP
/begin GROUP autosar_swc_aeb_autosar_swc_aeb_Step_sys_Subsystem_Reference_AEB_Function_Run_AsyEvlrCritEve_Step_Func_Run_AsyEvlrCritEve_Step_Func_TAWrapper_PreProcessor_ObjectPreProcessor_ObjectPreProcessorLoop_ValidObject_SafetyMarginFrontObjects_InPathCalculationWithPredictedObjPositions_CreateInPathDataTTM_CalculateAccelerationAndPredictPosition_LinearPrediction_LinearPredictionOfObjAtTTR_LinearMovementPredictorWithStopDetection1_LinearMovementPredictor "autosar_swc_aeb/autosar_swc_aeb_Step_sys/Subsystem Reference/AEB Function/Run_AsyEvlrCritEve_Step_Func/Run_AsyEvlrCritEve_Step_Func/TAWrapper/PreProcessor/ObjectPreProcessor/ObjectPreProcessorLoop/ValidObject/SafetyMarginFrontObjects/InPathCalculationWithPredictedObjPositions/CreateInPathDataTTM/CalculateAccelerationAndPredictPosition/LinearPrediction/LinearPredictionOfObjAtTTR/LinearMovementPredictorWithStopDetection1/LinearMovementPredictor" /begin REF_MEASUREMENT autosar_swc_aeb_rtARID_DEF.PosnLatObj_p /end REF_MEASUREMENT /end GROUP
/begin GROUP autosar_swc_aeb_autosar_swc_aeb_Step_sys_Subsystem_Reference_AEB_Function_Run_AsyEvlrCritEve_Step_Func_Run_AsyEvlrCritEve_Step_Func_TAWrapper_PreProcessor_ObjectPreProcessor_ObjectPreProcessorLoop_ValidObject_SafetyMarginFrontObjects_InPathCalculationWithPredictedObjPositions_CreateInPathDataTTM_CalculateAccelerationAndPredictPosition_LinearPrediction_LinearPredictionOfObjAtTTR_LinearMovementPredictorWithStopDetection_LinearMovementPredictor "autosar_swc_aeb/autosar_swc_aeb_Step_sys/Subsystem Reference/AEB Function/Run_AsyEvlrCritEve_Step_Func/Run_AsyEvlrCritEve_Step_Func/TAWrapper/PreProcessor/ObjectPreProcessor/ObjectPreProcessorLoop/ValidObject/SafetyMarginFrontObjects/InPathCalculationWithPredictedObjPositions/CreateInPathDataTTM/CalculateAccelerationAndPredictPosition/LinearPrediction/LinearPredictionOfObjAtTTR/LinearMovementPredictorWithStopDetection/LinearMovementPredictor" /begin REF_MEASUREMENT autosar_swc_aeb_rtARID_DEF.PosnLgtObj_o /end REF_MEASUREMENT /end GROUP
/begin GROUP autosar_swc_aeb_autosar_swc_aeb_Step_sys_Subsystem_Reference_AEB_Function_Run_AsyEvlrCritEve_Step_Func_Run_AsyEvlrCritEve_Step_Func_TAWrapper_PreProcessor_ObjectPreProcessor_ObjectPreProcessorLoop_ValidObject_SafetyMarginFrontObjects_InPathCalculationWithPredictedObjPositions_CreateInPathDataTTM_CalculateAccelerationAndPredictPosition_LinearPrediction_LinearPredictionOfObjAtTTR_NoOperation "autosar_swc_aeb/autosar_swc_aeb_Step_sys/Subsystem Reference/AEB Function/Run_AsyEvlrCritEve_Step_Func/Run_AsyEvlrCritEve_Step_Func/TAWrapper/PreProcessor/ObjectPreProcessor/ObjectPreProcessorLoop/ValidObject/SafetyMarginFrontObjects/InPathCalculationWithPredictedObjPositions/CreateInPathDataTTM/CalculateAccelerationAndPredictPosition/LinearPrediction/LinearPredictionOfObjAtTTR/NoOperation" /begin REF_MEASUREMENT autosar_swc_aeb_rtARID_DEF.VLatObj_j /end REF_MEASUREMENT /end GROUP
/begin GROUP autosar_swc_aeb_autosar_swc_aeb_Step_sys_Subsystem_Reference_AEB_Function_Run_AsyEvlrCritEve_Step_Func_Run_AsyEvlrCritEve_Step_Func_TAWrapper_PreProcessor_ObjectPreProcessor_ObjectPreProcessorLoop_ValidObject_SafetyMarginFrontObjects_InPathCalculationWithPredictedObjPositions_CreateInPathDataTTM_CalculateAccelerationAndPredictPosition_LinearPrediction_LinearPredictionOfObjAtTTR_NoOperation1 "autosar_swc_aeb/autosar_swc_aeb_Step_sys/Subsystem Reference/AEB Function/Run_AsyEvlrCritEve_Step_Func/Run_AsyEvlrCritEve_Step_Func/TAWrapper/PreProcessor/ObjectPreProcessor/ObjectPreProcessorLoop/ValidObject/SafetyMarginFrontObjects/InPathCalculationWithPredictedObjPositions/CreateInPathDataTTM/CalculateAccelerationAndPredictPosition/LinearPrediction/LinearPredictionOfObjAtTTR/NoOperation1" /begin REF_MEASUREMENT autosar_swc_aeb_rtARID_DEF.VLgtObj_f /end REF_MEASUREMENT /end GROUP
/begin GROUP autosar_swc_aeb_autosar_swc_aeb_Step_sys_Subsystem_Reference_AEB_Function_Run_AsyEvlrCritEve_Step_Func_Run_AsyEvlrCritEve_Step_Func_TAWrapper_PreProcessor_ObjectPreProcessor_ObjectPreProcessorLoop_ValidObject_SafetyMarginFrontObjects_InPathCalculationWithPredictedObjPositions_CreateInPathDataTTM_CalculateAccelerationAndPredictPosition_NoPrediction "autosar_swc_aeb/autosar_swc_aeb_Step_sys/Subsystem Reference/AEB Function/Run_AsyEvlrCritEve_Step_Func/Run_AsyEvlrCritEve_Step_Func/TAWrapper/PreProcessor/ObjectPreProcessor/ObjectPreProcessorLoop/ValidObject/SafetyMarginFrontObjects/InPathCalculationWithPredictedObjPositions/CreateInPathDataTTM/CalculateAccelerationAndPredictPosition/NoPrediction"
 /begin SUB_GROUP autosar_swc_aeb_autosar_swc_aeb_Step_sys_Subsystem_Reference_AEB_Function_Run_AsyEvlrCritEve_Step_Func_Run_AsyEvlrCritEve_Step_Func_TAWrapper_PreProcessor_ObjectPreProcessor_ObjectPreProcessorLoop_ValidObject_SafetyMarginFrontObjects_InPathCalculationWithPredictedObjPositions_CreateInPathDataTTM_CalculateAccelerationAndPredictPosition_NoPrediction_NoOperation autosar_swc_aeb_autosar_swc_aeb_Step_sys_Subsystem_Reference_AEB_Function_Run_AsyEvlrCritEve_Step_Func_Run_AsyEvlrCritEve_Step_Func_TAWrapper_PreProcessor_ObjectPreProcessor_ObjectPreProcessorLoop_ValidObject_SafetyMarginFrontObjects_InPathCalculationWithPredictedObjPositions_CreateInPathDataTTM_CalculateAccelerationAndPredictPosition_NoPrediction_NoOperation1 autosar_swc_aeb_autosar_swc_aeb_Step_sys_Subsystem_Reference_AEB_Function_Run_AsyEvlrCritEve_Step_Func_Run_AsyEvlrCritEve_Step_Func_TAWrapper_PreProcessor_ObjectPreProcessor_ObjectPreProcessorLoop_ValidObject_SafetyMarginFrontObjects_InPathCalculationWithPredictedObjPositions_CreateInPathDataTTM_CalculateAccelerationAndPredictPosition_NoPrediction_NoOperation10 autosar_swc_aeb_autosar_swc_aeb_Step_sys_Subsystem_Reference_AEB_Function_Run_AsyEvlrCritEve_Step_Func_Run_AsyEvlrCritEve_Step_Func_TAWrapper_PreProcessor_ObjectPreProcessor_ObjectPreProcessorLoop_ValidObject_SafetyMarginFrontObjects_InPathCalculationWithPredictedObjPositions_CreateInPathDataTTM_CalculateAccelerationAndPredictPosition_NoPrediction_NoOperation11 autosar_swc_aeb_autosar_swc_aeb_Step_sys_Subsystem_Reference_AEB_Function_Run_AsyEvlrCritEve_Step_Func_Run_AsyEvlrCritEve_Step_Func_TAWrapper_PreProcessor_ObjectPreProcessor_ObjectPreProcessorLoop_ValidObject_SafetyMarginFrontObjects_InPathCalculationWithPredictedObjPositions_CreateInPathDataTTM_CalculateAccelerationAndPredictPosition_NoPrediction_NoOperation12 autosar_swc_aeb_autosar_swc_aeb_Step_sys_Subsystem_Reference_AEB_Function_Run_AsyEvlrCritEve_Step_Func_Run_AsyEvlrCritEve_Step_Func_TAWrapper_PreProcessor_ObjectPreProcessor_ObjectPreProcessorLoop_ValidObject_SafetyMarginFrontObjects_InPathCalculationWithPredictedObjPositions_CreateInPathDataTTM_CalculateAccelerationAndPredictPosition_NoPrediction_NoOperation13 autosar_swc_aeb_autosar_swc_aeb_Step_sys_Subsystem_Reference_AEB_Function_Run_AsyEvlrCritEve_Step_Func_Run_AsyEvlrCritEve_Step_Func_TAWrapper_PreProcessor_ObjectPreProcessor_ObjectPreProcessorLoop_ValidObject_SafetyMarginFrontObjects_InPathCalculationWithPredictedObjPositions_CreateInPathDataTTM_CalculateAccelerationAndPredictPosition_NoPrediction_NoOperation14 autosar_swc_aeb_autosar_swc_aeb_Step_sys_Subsystem_Reference_AEB_Function_Run_AsyEvlrCritEve_Step_Func_Run_AsyEvlrCritEve_Step_Func_TAWrapper_PreProcessor_ObjectPreProcessor_ObjectPreProcessorLoop_ValidObject_SafetyMarginFrontObjects_InPathCalculationWithPredictedObjPositions_CreateInPathDataTTM_CalculateAccelerationAndPredictPosition_NoPrediction_NoOperation15 autosar_swc_aeb_autosar_swc_aeb_Step_sys_Subsystem_Reference_AEB_Function_Run_AsyEvlrCritEve_Step_Func_Run_AsyEvlrCritEve_Step_Func_TAWrapper_PreProcessor_ObjectPreProcessor_ObjectPreProcessorLoop_ValidObject_SafetyMarginFrontObjects_InPathCalculationWithPredictedObjPositions_CreateInPathDataTTM_CalculateAccelerationAndPredictPosition_NoPrediction_NoOperation16 autosar_swc_aeb_autosar_swc_aeb_Step_sys_Subsystem_Reference_AEB_Function_Run_AsyEvlrCritEve_Step_Func_Run_AsyEvlrCritEve_Step_Func_TAWrapper_PreProcessor_ObjectPreProcessor_ObjectPreProcessorLoop_ValidObject_SafetyMarginFrontObjects_InPathCalculationWithPredictedObjPositions_CreateInPathDataTTM_CalculateAccelerationAndPredictPosition_NoPrediction_NoOperation17 autosar_swc_aeb_autosar_swc_aeb_Step_sys_Subsystem_Reference_AEB_Function_Run_AsyEvlrCritEve_Step_Func_Run_AsyEvlrCritEve_Step_Func_TAWrapper_PreProcessor_ObjectPreProcessor_ObjectPreProcessorLoop_ValidObject_SafetyMarginFrontObjects_InPathCalculationWithPredictedObjPositions_CreateInPathDataTTM_CalculateAccelerationAndPredictPosition_NoPrediction_NoOperation18 autosar_swc_aeb_autosar_swc_aeb_Step_sys_Subsystem_Reference_AEB_Function_Run_AsyEvlrCritEve_Step_Func_Run_AsyEvlrCritEve_Step_Func_TAWrapper_PreProcessor_ObjectPreProcessor_ObjectPreProcessorLoop_ValidObject_SafetyMarginFrontObjects_InPathCalculationWithPredictedObjPositions_CreateInPathDataTTM_CalculateAccelerationAndPredictPosition_NoPrediction_NoOperation19 autosar_swc_aeb_autosar_swc_aeb_Step_sys_Subsystem_Reference_AEB_Function_Run_AsyEvlrCritEve_Step_Func_Run_AsyEvlrCritEve_Step_Func_TAWrapper_PreProcessor_ObjectPreProcessor_ObjectPreProcessorLoop_ValidObject_SafetyMarginFrontObjects_InPathCalculationWithPredictedObjPositions_CreateInPathDataTTM_CalculateAccelerationAndPredictPosition_NoPrediction_NoOperation2 autosar_swc_aeb_autosar_swc_aeb_Step_sys_Subsystem_Reference_AEB_Function_Run_AsyEvlrCritEve_Step_Func_Run_AsyEvlrCritEve_Step_Func_TAWrapper_PreProcessor_ObjectPreProcessor_ObjectPreProcessorLoop_ValidObject_SafetyMarginFrontObjects_InPathCalculationWithPredictedObjPositions_CreateInPathDataTTM_CalculateAccelerationAndPredictPosition_NoPrediction_NoOperation20 autosar_swc_aeb_autosar_swc_aeb_Step_sys_Subsystem_Reference_AEB_Function_Run_AsyEvlrCritEve_Step_Func_Run_AsyEvlrCritEve_Step_Func_TAWrapper_PreProcessor_ObjectPreProcessor_ObjectPreProcessorLoop_ValidObject_SafetyMarginFrontObjects_InPathCalculationWithPredictedObjPositions_CreateInPathDataTTM_CalculateAccelerationAndPredictPosition_NoPrediction_NoOperation21 autosar_swc_aeb_autosar_swc_aeb_Step_sys_Subsystem_Reference_AEB_Function_Run_AsyEvlrCritEve_Step_Func_Run_AsyEvlrCritEve_Step_Func_TAWrapper_PreProcessor_ObjectPreProcessor_ObjectPreProcessorLoop_ValidObject_SafetyMarginFrontObjects_InPathCalculationWithPredictedObjPositions_CreateInPathDataTTM_CalculateAccelerationAndPredictPosition_NoPrediction_NoOperation22 autosar_swc_aeb_autosar_swc_aeb_Step_sys_Subsystem_Reference_AEB_Function_Run_AsyEvlrCritEve_Step_Func_Run_AsyEvlrCritEve_Step_Func_TAWrapper_PreProcessor_ObjectPreProcessor_ObjectPreProcessorLoop_ValidObject_SafetyMarginFrontObjects_InPathCalculationWithPredictedObjPositions_CreateInPathDataTTM_CalculateAccelerationAndPredictPosition_NoPrediction_NoOperation23 autosar_swc_aeb_autosar_swc_aeb_Step_sys_Subsystem_Reference_AEB_Function_Run_AsyEvlrCritEve_Step_Func_Run_AsyEvlrCritEve_Step_Func_TAWrapper_PreProcessor_ObjectPreProcessor_ObjectPreProcessorLoop_ValidObject_SafetyMarginFrontObjects_InPathCalculationWithPredictedObjPositions_CreateInPathDataTTM_CalculateAccelerationAndPredictPosition_NoPrediction_NoOperation24 autosar_swc_aeb_autosar_swc_aeb_Step_sys_Subsystem_Reference_AEB_Function_Run_AsyEvlrCritEve_Step_Func_Run_AsyEvlrCritEve_Step_Func_TAWrapper_PreProcessor_ObjectPreProcessor_ObjectPreProcessorLoop_ValidObject_SafetyMarginFrontObjects_InPathCalculationWithPredictedObjPositions_CreateInPathDataTTM_CalculateAccelerationAndPredictPosition_NoPrediction_NoOperation25 autosar_swc_aeb_autosar_swc_aeb_Step_sys_Subsystem_Reference_AEB_Function_Run_AsyEvlrCritEve_Step_Func_Run_AsyEvlrCritEve_Step_Func_TAWrapper_PreProcessor_ObjectPreProcessor_ObjectPreProcessorLoop_ValidObject_SafetyMarginFrontObjects_InPathCalculationWithPredictedObjPositions_CreateInPathDataTTM_CalculateAccelerationAndPredictPosition_NoPrediction_NoOperation26 autosar_swc_aeb_autosar_swc_aeb_Step_sys_Subsystem_Reference_AEB_Function_Run_AsyEvlrCritEve_Step_Func_Run_AsyEvlrCritEve_Step_Func_TAWrapper_PreProcessor_ObjectPreProcessor_ObjectPreProcessorLoop_ValidObject_SafetyMarginFrontObjects_InPathCalculationWithPredictedObjPositions_CreateInPathDataTTM_CalculateAccelerationAndPredictPosition_NoPrediction_NoOperation27 autosar_swc_aeb_autosar_swc_aeb_Step_sys_Subsystem_Reference_AEB_Function_Run_AsyEvlrCritEve_Step_Func_Run_AsyEvlrCritEve_Step_Func_TAWrapper_PreProcessor_ObjectPreProcessor_ObjectPreProcessorLoop_ValidObject_SafetyMarginFrontObjects_InPathCalculationWithPredictedObjPositions_CreateInPathDataTTM_CalculateAccelerationAndPredictPosition_NoPrediction_NoOperation28 autosar_swc_aeb_autosar_swc_aeb_Step_sys_Subsystem_Reference_AEB_Function_Run_AsyEvlrCritEve_Step_Func_Run_AsyEvlrCritEve_Step_Func_TAWrapper_PreProcessor_ObjectPreProcessor_ObjectPreProcessorLoop_ValidObject_SafetyMarginFrontObjects_InPathCalculationWithPredictedObjPositions_CreateInPathDataTTM_CalculateAccelerationAndPredictPosition_NoPrediction_NoOperation29 autosar_swc_aeb_autosar_swc_aeb_Step_sys_Subsystem_Reference_AEB_Function_Run_AsyEvlrCritEve_Step_Func_Run_AsyEvlrCritEve_Step_Func_TAWrapper_PreProcessor_ObjectPreProcessor_ObjectPreProcessorLoop_ValidObject_SafetyMarginFrontObjects_InPathCalculationWithPredictedObjPositions_CreateInPathDataTTM_CalculateAccelerationAndPredictPosition_NoPrediction_NoOperation3 autosar_swc_aeb_autosar_swc_aeb_Step_sys_Subsystem_Reference_AEB_Function_Run_AsyEvlrCritEve_Step_Func_Run_AsyEvlrCritEve_Step_Func_TAWrapper_PreProcessor_ObjectPreProcessor_ObjectPreProcessorLoop_ValidObject_SafetyMarginFrontObjects_InPathCalculationWithPredictedObjPositions_CreateInPathDataTTM_CalculateAccelerationAndPredictPosition_NoPrediction_NoOperation30 autosar_swc_aeb_autosar_swc_aeb_Step_sys_Subsystem_Reference_AEB_Function_Run_AsyEvlrCritEve_Step_Func_Run_AsyEvlrCritEve_Step_Func_TAWrapper_PreProcessor_ObjectPreProcessor_ObjectPreProcessorLoop_ValidObject_SafetyMarginFrontObjects_InPathCalculationWithPredictedObjPositions_CreateInPathDataTTM_CalculateAccelerationAndPredictPosition_NoPrediction_NoOperation31 autosar_swc_aeb_autosar_swc_aeb_Step_sys_Subsystem_Reference_AEB_Function_Run_AsyEvlrCritEve_Step_Func_Run_AsyEvlrCritEve_Step_Func_TAWrapper_PreProcessor_ObjectPreProcessor_ObjectPreProcessorLoop_ValidObject_SafetyMarginFrontObjects_InPathCalculationWithPredictedObjPositions_CreateInPathDataTTM_CalculateAccelerationAndPredictPosition_NoPrediction_NoOperation32 autosar_swc_aeb_autosar_swc_aeb_Step_sys_Subsystem_Reference_AEB_Function_Run_AsyEvlrCritEve_Step_Func_Run_AsyEvlrCritEve_Step_Func_TAWrapper_PreProcessor_ObjectPreProcessor_ObjectPreProcessorLoop_ValidObject_SafetyMarginFrontObjects_InPathCalculationWithPredictedObjPositions_CreateInPathDataTTM_CalculateAccelerationAndPredictPosition_NoPrediction_NoOperation33 autosar_swc_aeb_autosar_swc_aeb_Step_sys_Subsystem_Reference_AEB_Function_Run_AsyEvlrCritEve_Step_Func_Run_AsyEvlrCritEve_Step_Func_TAWrapper_PreProcessor_ObjectPreProcessor_ObjectPreProcessorLoop_ValidObject_SafetyMarginFrontObjects_InPathCalculationWithPredictedObjPositions_CreateInPathDataTTM_CalculateAccelerationAndPredictPosition_NoPrediction_NoOperation34 autosar_swc_aeb_autosar_swc_aeb_Step_sys_Subsystem_Reference_AEB_Function_Run_AsyEvlrCritEve_Step_Func_Run_AsyEvlrCritEve_Step_Func_TAWrapper_PreProcessor_ObjectPreProcessor_ObjectPreProcessorLoop_ValidObject_SafetyMarginFrontObjects_InPathCalculationWithPredictedObjPositions_CreateInPathDataTTM_CalculateAccelerationAndPredictPosition_NoPrediction_NoOperation4 autosar_swc_aeb_autosar_swc_aeb_Step_sys_Subsystem_Reference_AEB_Function_Run_AsyEvlrCritEve_Step_Func_Run_AsyEvlrCritEve_Step_Func_TAWrapper_PreProcessor_ObjectPreProcessor_ObjectPreProcessorLoop_ValidObject_SafetyMarginFrontObjects_InPathCalculationWithPredictedObjPositions_CreateInPathDataTTM_CalculateAccelerationAndPredictPosition_NoPrediction_NoOperation5 autosar_swc_aeb_autosar_swc_aeb_Step_sys_Subsystem_Reference_AEB_Function_Run_AsyEvlrCritEve_Step_Func_Run_AsyEvlrCritEve_Step_Func_TAWrapper_PreProcessor_ObjectPreProcessor_ObjectPreProcessorLoop_ValidObject_SafetyMarginFrontObjects_InPathCalculationWithPredictedObjPositions_CreateInPathDataTTM_CalculateAccelerationAndPredictPosition_NoPrediction_NoOperation6 autosar_swc_aeb_autosar_swc_aeb_Step_sys_Subsystem_Reference_AEB_Function_Run_AsyEvlrCritEve_Step_Func_Run_AsyEvlrCritEve_Step_Func_TAWrapper_PreProcessor_ObjectPreProcessor_ObjectPreProcessorLoop_ValidObject_SafetyMarginFrontObjects_InPathCalculationWithPredictedObjPositions_CreateInPathDataTTM_CalculateAccelerationAndPredictPosition_NoPrediction_NoOperation7 autosar_swc_aeb_autosar_swc_aeb_Step_sys_Subsystem_Reference_AEB_Function_Run_AsyEvlrCritEve_Step_Func_Run_AsyEvlrCritEve_Step_Func_TAWrapper_PreProcessor_ObjectPreProcessor_ObjectPreProcessorLoop_ValidObject_SafetyMarginFrontObjects_InPathCalculationWithPredictedObjPositions_CreateInPathDataTTM_CalculateAccelerationAndPredictPosition_NoPrediction_NoOperation8 autosar_swc_aeb_autosar_swc_aeb_Step_sys_Subsystem_Reference_AEB_Function_Run_AsyEvlrCritEve_Step_Func_Run_AsyEvlrCritEve_Step_Func_TAWrapper_PreProcessor_ObjectPreProcessor_ObjectPreProcessorLoop_ValidObject_SafetyMarginFrontObjects_InPathCalculationWithPredictedObjPositions_CreateInPathDataTTM_CalculateAccelerationAndPredictPosition_NoPrediction_NoOperation9 /end SUB_GROUP
/end GROUP
/begin GROUP autosar_swc_aeb_autosar_swc_aeb_Step_sys_Subsystem_Reference_AEB_Function_Run_AsyEvlrCritEve_Step_Func_Run_AsyEvlrCritEve_Step_Func_TAWrapper_PreProcessor_ObjectPreProcessor_ObjectPreProcessorLoop_ValidObject_SafetyMarginFrontObjects_InPathCalculationWithPredictedObjPositions_CreateInPathDataTTM_CalculateAccelerationAndPredictPosition_NoPrediction_NoOperation "autosar_swc_aeb/autosar_swc_aeb_Step_sys/Subsystem Reference/AEB Function/Run_AsyEvlrCritEve_Step_Func/Run_AsyEvlrCritEve_Step_Func/TAWrapper/PreProcessor/ObjectPreProcessor/ObjectPreProcessorLoop/ValidObject/SafetyMarginFrontObjects/InPathCalculationWithPredictedObjPositions/CreateInPathDataTTM/CalculateAccelerationAndPredictPosition/NoPrediction/NoOperation" /begin REF_MEASUREMENT autosar_swc_aeb_rtARID_DEF.PosnLgtObj_o /end REF_MEASUREMENT /end GROUP
/begin GROUP autosar_swc_aeb_autosar_swc_aeb_Step_sys_Subsystem_Reference_AEB_Function_Run_AsyEvlrCritEve_Step_Func_Run_AsyEvlrCritEve_Step_Func_TAWrapper_PreProcessor_ObjectPreProcessor_ObjectPreProcessorLoop_ValidObject_SafetyMarginFrontObjects_InPathCalculationWithPredictedObjPositions_CreateInPathDataTTM_CalculateAccelerationAndPredictPosition_NoPrediction_NoOperation1 "autosar_swc_aeb/autosar_swc_aeb_Step_sys/Subsystem Reference/AEB Function/Run_AsyEvlrCritEve_Step_Func/Run_AsyEvlrCritEve_Step_Func/TAWrapper/PreProcessor/ObjectPreProcessor/ObjectPreProcessorLoop/ValidObject/SafetyMarginFrontObjects/InPathCalculationWithPredictedObjPositions/CreateInPathDataTTM/CalculateAccelerationAndPredictPosition/NoPrediction/NoOperation1" /begin REF_MEASUREMENT autosar_swc_aeb_rtARID_DEF.PosnLatObj_p /end REF_MEASUREMENT /end GROUP
/begin GROUP autosar_swc_aeb_autosar_swc_aeb_Step_sys_Subsystem_Reference_AEB_Function_Run_AsyEvlrCritEve_Step_Func_Run_AsyEvlrCritEve_Step_Func_TAWrapper_PreProcessor_ObjectPreProcessor_ObjectPreProcessorLoop_ValidObject_SafetyMarginFrontObjects_InPathCalculationWithPredictedObjPositions_CreateInPathDataTTM_CalculateAccelerationAndPredictPosition_NoPrediction_NoOperation11 "autosar_swc_aeb/autosar_swc_aeb_Step_sys/Subsystem Reference/AEB Function/Run_AsyEvlrCritEve_Step_Func/Run_AsyEvlrCritEve_Step_Func/TAWrapper/PreProcessor/ObjectPreProcessor/ObjectPreProcessorLoop/ValidObject/SafetyMarginFrontObjects/InPathCalculationWithPredictedObjPositions/CreateInPathDataTTM/CalculateAccelerationAndPredictPosition/NoPrediction/NoOperation11" /begin REF_MEASUREMENT autosar_swc_aeb_rtARID_DEF.PosnLgtObj_o0e /end REF_MEASUREMENT /end GROUP
/begin GROUP autosar_swc_aeb_autosar_swc_aeb_Step_sys_Subsystem_Reference_AEB_Function_Run_AsyEvlrCritEve_Step_Func_Run_AsyEvlrCritEve_Step_Func_TAWrapper_PreProcessor_ObjectPreProcessor_ObjectPreProcessorLoop_ValidObject_SafetyMarginFrontObjects_InPathCalculationWithPredictedObjPositions_CreateInPathDataTTM_CalculateAccelerationAndPredictPosition_NoPrediction_NoOperation12 "autosar_swc_aeb/autosar_swc_aeb_Step_sys/Subsystem Reference/AEB Function/Run_AsyEvlrCritEve_Step_Func/Run_AsyEvlrCritEve_Step_Func/TAWrapper/PreProcessor/ObjectPreProcessor/ObjectPreProcessorLoop/ValidObject/SafetyMarginFrontObjects/InPathCalculationWithPredictedObjPositions/CreateInPathDataTTM/CalculateAccelerationAndPredictPosition/NoPrediction/NoOperation12" /begin REF_MEASUREMENT autosar_swc_aeb_rtARID_DEF.PosnLatObj_p3h /end REF_MEASUREMENT /end GROUP
/begin GROUP autosar_swc_aeb_autosar_swc_aeb_Step_sys_Subsystem_Reference_AEB_Function_Run_AsyEvlrCritEve_Step_Func_Run_AsyEvlrCritEve_Step_Func_TAWrapper_PreProcessor_ObjectPreProcessor_ObjectPreProcessorLoop_ValidObject_SafetyMarginFrontObjects_InPathCalculationWithPredictedObjPositions_CreateInPathDataTTM_CalculateAccelerationAndPredictPosition_NoPrediction_NoOperation2 "autosar_swc_aeb/autosar_swc_aeb_Step_sys/Subsystem Reference/AEB Function/Run_AsyEvlrCritEve_Step_Func/Run_AsyEvlrCritEve_Step_Func/TAWrapper/PreProcessor/ObjectPreProcessor/ObjectPreProcessorLoop/ValidObject/SafetyMarginFrontObjects/InPathCalculationWithPredictedObjPositions/CreateInPathDataTTM/CalculateAccelerationAndPredictPosition/NoPrediction/NoOperation2" /begin REF_MEASUREMENT autosar_swc_aeb_rtARID_DEF.VLgtObj_f /end REF_MEASUREMENT /end GROUP
/begin GROUP autosar_swc_aeb_autosar_swc_aeb_Step_sys_Subsystem_Reference_AEB_Function_Run_AsyEvlrCritEve_Step_Func_Run_AsyEvlrCritEve_Step_Func_TAWrapper_PreProcessor_ObjectPreProcessor_ObjectPreProcessorLoop_ValidObject_SafetyMarginFrontObjects_InPathCalculationWithPredictedObjPositions_CreateInPathDataTTM_CalculateAccelerationAndPredictPosition_NoPrediction_NoOperation20 "autosar_swc_aeb/autosar_swc_aeb_Step_sys/Subsystem Reference/AEB Function/Run_AsyEvlrCritEve_Step_Func/Run_AsyEvlrCritEve_Step_Func/TAWrapper/PreProcessor/ObjectPreProcessor/ObjectPreProcessorLoop/ValidObject/SafetyMarginFrontObjects/InPathCalculationWithPredictedObjPositions/CreateInPathDataTTM/CalculateAccelerationAndPredictPosition/NoPrediction/NoOperation20" /begin REF_MEASUREMENT autosar_swc_aeb_rtARID_DEF.CrvtObj_l /end REF_MEASUREMENT /end GROUP
/begin GROUP autosar_swc_aeb_autosar_swc_aeb_Step_sys_Subsystem_Reference_AEB_Function_Run_AsyEvlrCritEve_Step_Func_Run_AsyEvlrCritEve_Step_Func_TAWrapper_PreProcessor_ObjectPreProcessor_ObjectPreProcessorLoop_ValidObject_SafetyMarginFrontObjects_InPathCalculationWithPredictedObjPositions_CreateInPathDataTTM_CalculateAccelerationAndPredictPosition_NoPrediction_NoOperation3 "autosar_swc_aeb/autosar_swc_aeb_Step_sys/Subsystem Reference/AEB Function/Run_AsyEvlrCritEve_Step_Func/Run_AsyEvlrCritEve_Step_Func/TAWrapper/PreProcessor/ObjectPreProcessor/ObjectPreProcessorLoop/ValidObject/SafetyMarginFrontObjects/InPathCalculationWithPredictedObjPositions/CreateInPathDataTTM/CalculateAccelerationAndPredictPosition/NoPrediction/NoOperation3" /begin REF_MEASUREMENT autosar_swc_aeb_rtARID_DEF.VLatObj_j /end REF_MEASUREMENT /end GROUP
/begin GROUP autosar_swc_aeb_autosar_swc_aeb_Step_sys_Subsystem_Reference_AEB_Function_Run_AsyEvlrCritEve_Step_Func_Run_AsyEvlrCritEve_Step_Func_TAWrapper_PreProcessor_ObjectPreProcessor_ObjectPreProcessorLoop_ValidObject_SafetyMarginFrontObjects_InPathCalculationWithPredictedObjPositions_CreateInPathDataTTM_CalculateAccelerationAndPredictPosition_NoPrediction_NoOperation9 "autosar_swc_aeb/autosar_swc_aeb_Step_sys/Subsystem Reference/AEB Function/Run_AsyEvlrCritEve_Step_Func/Run_AsyEvlrCritEve_Step_Func/TAWrapper/PreProcessor/ObjectPreProcessor/ObjectPreProcessorLoop/ValidObject/SafetyMarginFrontObjects/InPathCalculationWithPredictedObjPositions/CreateInPathDataTTM/CalculateAccelerationAndPredictPosition/NoPrediction/NoOperation9" /begin REF_MEASUREMENT autosar_swc_aeb_rtARID_DEF.HeadingObj_m /end REF_MEASUREMENT /end GROUP
/begin GROUP autosar_swc_aeb_autosar_swc_aeb_Step_sys_Subsystem_Reference_AEB_Function_Run_AsyEvlrCritEve_Step_Func_Run_AsyEvlrCritEve_Step_Func_TAWrapper_PreProcessor_ObjectPreProcessor_ObjectPreProcessorLoop_ValidObject_SafetyMarginFrontObjects_InPathCalculationWithPredictedObjPositions_CreateInPathDataTTM_CalculateAccelerationAndPredictPosition_PredictHostLateralPositionAtTTR "autosar_swc_aeb/autosar_swc_aeb_Step_sys/Subsystem Reference/AEB Function/Run_AsyEvlrCritEve_Step_Func/Run_AsyEvlrCritEve_Step_Func/TAWrapper/PreProcessor/ObjectPreProcessor/ObjectPreProcessorLoop/ValidObject/SafetyMarginFrontObjects/InPathCalculationWithPredictedObjPositions/CreateInPathDataTTM/CalculateAccelerationAndPredictPosition/PredictHostLateralPositionAtTTR"
 /begin SUB_GROUP autosar_swc_aeb_autosar_swc_aeb_Step_sys_Subsystem_Reference_AEB_Function_Run_AsyEvlrCritEve_Step_Func_Run_AsyEvlrCritEve_Step_Func_TAWrapper_PreProcessor_ObjectPreProcessor_ObjectPreProcessorLoop_ValidObject_SafetyMarginFrontObjects_InPathCalculationWithPredictedObjPositions_CreateInPathDataTTM_CalculateAccelerationAndPredictPosition_PredictHostLateralPositionAtTTR_CalculateHeading autosar_swc_aeb_autosar_swc_aeb_Step_sys_Subsystem_Reference_AEB_Function_Run_AsyEvlrCritEve_Step_Func_Run_AsyEvlrCritEve_Step_Func_TAWrapper_PreProcessor_ObjectPreProcessor_ObjectPreProcessorLoop_ValidObject_SafetyMarginFrontObjects_InPathCalculationWithPredictedObjPositions_CreateInPathDataTTM_CalculateAccelerationAndPredictPosition_PredictHostLateralPositionAtTTR_SelectSegment /end SUB_GROUP
/end GROUP
/begin GROUP autosar_swc_aeb_autosar_swc_aeb_Step_sys_Subsystem_Reference_AEB_Function_Run_AsyEvlrCritEve_Step_Func_Run_AsyEvlrCritEve_Step_Func_TAWrapper_PreProcessor_ObjectPreProcessor_ObjectPreProcessorLoop_ValidObject_SafetyMarginFrontObjects_InPathCalculationWithPredictedObjPositions_CreateInPathDataTTM_CalculateAccelerationAndPredictPosition_PredictHostLateralPositionAtTTR_CalculateHeading "autosar_swc_aeb/autosar_swc_aeb_Step_sys/Subsystem Reference/AEB Function/Run_AsyEvlrCritEve_Step_Func/Run_AsyEvlrCritEve_Step_Func/TAWrapper/PreProcessor/ObjectPreProcessor/ObjectPreProcessorLoop/ValidObject/SafetyMarginFrontObjects/InPathCalculationWithPredictedObjPositions/CreateInPathDataTTM/CalculateAccelerationAndPredictPosition/PredictHostLateralPositionAtTTR/CalculateHeading"
 /begin SUB_GROUP autosar_swc_aeb_autosar_swc_aeb_Step_sys_Subsystem_Reference_AEB_Function_Run_AsyEvlrCritEve_Step_Func_Run_AsyEvlrCritEve_Step_Func_TAWrapper_PreProcessor_ObjectPreProcessor_ObjectPreProcessorLoop_ValidObject_SafetyMarginFrontObjects_InPathCalculationWithPredictedObjPositions_CreateInPathDataTTM_CalculateAccelerationAndPredictPosition_PredictHostLateralPositionAtTTR_CalculateHeading_CheckSpeed autosar_swc_aeb_autosar_swc_aeb_Step_sys_Subsystem_Reference_AEB_Function_Run_AsyEvlrCritEve_Step_Func_Run_AsyEvlrCritEve_Step_Func_TAWrapper_PreProcessor_ObjectPreProcessor_ObjectPreProcessorLoop_ValidObject_SafetyMarginFrontObjects_InPathCalculationWithPredictedObjPositions_CreateInPathDataTTM_CalculateAccelerationAndPredictPosition_PredictHostLateralPositionAtTTR_CalculateHeading_ExtractVelocitiesAtStartOfSegments /end SUB_GROUP
/end GROUP
/begin GROUP autosar_swc_aeb_autosar_swc_aeb_Step_sys_Subsystem_Reference_AEB_Function_Run_AsyEvlrCritEve_Step_Func_Run_AsyEvlrCritEve_Step_Func_TAWrapper_PreProcessor_ObjectPreProcessor_ObjectPreProcessorLoop_ValidObject_SafetyMarginFrontObjects_InPathCalculationWithPredictedObjPositions_CreateInPathDataTTM_CalculateAccelerationAndPredictPosition_PredictHostLateralPositionAtTTR_CalculateHeading_ExtractVelocitiesAtStartOfSegments "autosar_swc_aeb/autosar_swc_aeb_Step_sys/Subsystem Reference/AEB Function/Run_AsyEvlrCritEve_Step_Func/Run_AsyEvlrCritEve_Step_Func/TAWrapper/PreProcessor/ObjectPreProcessor/ObjectPreProcessorLoop/ValidObject/SafetyMarginFrontObjects/InPathCalculationWithPredictedObjPositions/CreateInPathDataTTM/CalculateAccelerationAndPredictPosition/PredictHostLateralPositionAtTTR/CalculateHeading/ExtractVelocitiesAtStartOfSegments"
 /begin SUB_GROUP autosar_swc_aeb_autosar_swc_aeb_Step_sys_Subsystem_Reference_AEB_Function_Run_AsyEvlrCritEve_Step_Func_Run_AsyEvlrCritEve_Step_Func_TAWrapper_PreProcessor_ObjectPreProcessor_ObjectPreProcessorLoop_ValidObject_SafetyMarginFrontObjects_InPathCalculationWithPredictedObjPositions_CreateInPathDataTTM_CalculateAccelerationAndPredictPosition_PredictHostLateralPositionAtTTR_CalculateHeading_ExtractVelocitiesAtStartOfSegments_CheckSpeed /end SUB_GROUP
/end GROUP
/begin GROUP autosar_swc_aeb_autosar_swc_aeb_Step_sys_Subsystem_Reference_AEB_Function_Run_AsyEvlrCritEve_Step_Func_Run_AsyEvlrCritEve_Step_Func_TAWrapper_PreProcessor_ObjectPreProcessor_ObjectPreProcessorLoop_ValidObject_SafetyMarginFrontObjects_InPathCalculationWithPredictedObjPositions_CreateInPathDataTTM_CalculateAccelerationAndPredictPosition_PredictHostLateralPositionAtTTR_SelectSegment "autosar_swc_aeb/autosar_swc_aeb_Step_sys/Subsystem Reference/AEB Function/Run_AsyEvlrCritEve_Step_Func/Run_AsyEvlrCritEve_Step_Func/TAWrapper/PreProcessor/ObjectPreProcessor/ObjectPreProcessorLoop/ValidObject/SafetyMarginFrontObjects/InPathCalculationWithPredictedObjPositions/CreateInPathDataTTM/CalculateAccelerationAndPredictPosition/PredictHostLateralPositionAtTTR/SelectSegment" /begin REF_MEASUREMENT autosar_swc_aeb_rtARID_DEF.LastSegment_h /end REF_MEASUREMENT /end GROUP
/begin GROUP autosar_swc_aeb_autosar_swc_aeb_Step_sys_Subsystem_Reference_AEB_Function_Run_AsyEvlrCritEve_Step_Func_Run_AsyEvlrCritEve_Step_Func_TAWrapper_PreProcessor_ObjectPreProcessor_ObjectPreProcessorLoop_ValidObject_SafetyMarginFrontObjects_InPathCalculationWithPredictedObjPositions_CreateInPathDataTTM_CheckBrakingAndSteering "autosar_swc_aeb/autosar_swc_aeb_Step_sys/Subsystem Reference/AEB Function/Run_AsyEvlrCritEve_Step_Func/Run_AsyEvlrCritEve_Step_Func/TAWrapper/PreProcessor/ObjectPreProcessor/ObjectPreProcessorLoop/ValidObject/SafetyMarginFrontObjects/InPathCalculationWithPredictedObjPositions/CreateInPathDataTTM/CheckBrakingAndSteering"
 /begin SUB_GROUP autosar_swc_aeb_autosar_swc_aeb_Step_sys_Subsystem_Reference_AEB_Function_Run_AsyEvlrCritEve_Step_Func_Run_AsyEvlrCritEve_Step_Func_TAWrapper_PreProcessor_ObjectPreProcessor_ObjectPreProcessorLoop_ValidObject_SafetyMarginFrontObjects_InPathCalculationWithPredictedObjPositions_CreateInPathDataTTM_CheckBrakingAndSteering_CheckIfObjectTriesToManoeuver /end SUB_GROUP
/end GROUP
/begin GROUP autosar_swc_aeb_autosar_swc_aeb_Step_sys_Subsystem_Reference_AEB_Function_Run_AsyEvlrCritEve_Step_Func_Run_AsyEvlrCritEve_Step_Func_TAWrapper_PreProcessor_ObjectPreProcessor_ObjectPreProcessorLoop_ValidObject_SafetyMarginFrontObjects_InPathCalculationWithPredictedObjPositions_CreateInPathDataTTM_CreateInPathData "autosar_swc_aeb/autosar_swc_aeb_Step_sys/Subsystem Reference/AEB Function/Run_AsyEvlrCritEve_Step_Func/Run_AsyEvlrCritEve_Step_Func/TAWrapper/PreProcessor/ObjectPreProcessor/ObjectPreProcessorLoop/ValidObject/SafetyMarginFrontObjects/InPathCalculationWithPredictedObjPositions/CreateInPathDataTTM/CreateInPathData"
 /begin SUB_GROUP autosar_swc_aeb_autosar_swc_aeb_Step_sys_Subsystem_Reference_AEB_Function_Run_AsyEvlrCritEve_Step_Func_Run_AsyEvlrCritEve_Step_Func_TAWrapper_PreProcessor_ObjectPreProcessor_ObjectPreProcessorLoop_ValidObject_SafetyMarginFrontObjects_InPathCalculationWithPredictedObjPositions_CreateInPathDataTTM_CreateInPathData_DetermineIfObjectIsBraking autosar_swc_aeb_autosar_swc_aeb_Step_sys_Subsystem_Reference_AEB_Function_Run_AsyEvlrCritEve_Step_Func_Run_AsyEvlrCritEve_Step_Func_TAWrapper_PreProcessor_ObjectPreProcessor_ObjectPreProcessorLoop_ValidObject_SafetyMarginFrontObjects_InPathCalculationWithPredictedObjPositions_CreateInPathDataTTM_CreateInPathData_DetermineInPathDataLongPredTime autosar_swc_aeb_autosar_swc_aeb_Step_sys_Subsystem_Reference_AEB_Function_Run_AsyEvlrCritEve_Step_Func_Run_AsyEvlrCritEve_Step_Func_TAWrapper_PreProcessor_ObjectPreProcessor_ObjectPreProcessorLoop_ValidObject_SafetyMarginFrontObjects_InPathCalculationWithPredictedObjPositions_CreateInPathDataTTM_CreateInPathData_DetermineInPathDataShortPredTime /end SUB_GROUP
/end GROUP
/begin GROUP autosar_swc_aeb_autosar_swc_aeb_Step_sys_Subsystem_Reference_AEB_Function_Run_AsyEvlrCritEve_Step_Func_Run_AsyEvlrCritEve_Step_Func_TAWrapper_PreProcessor_ObjectPreProcessor_ObjectPreProcessorLoop_ValidObject_SafetyMarginFrontObjects_InPathCalculationWithPredictedObjPositions_CreateInPathDataTTM_CreateInPathData_DetermineIfObjectIsBraking "autosar_swc_aeb/autosar_swc_aeb_Step_sys/Subsystem Reference/AEB Function/Run_AsyEvlrCritEve_Step_Func/Run_AsyEvlrCritEve_Step_Func/TAWrapper/PreProcessor/ObjectPreProcessor/ObjectPreProcessorLoop/ValidObject/SafetyMarginFrontObjects/InPathCalculationWithPredictedObjPositions/CreateInPathDataTTM/CreateInPathData/DetermineIfObjectIsBraking" /begin REF_CHARACTERISTIC CLTS_ObjSpdMovgToSelfMaxForBrkgInAsyEvlrCritEve_Ca /end REF_CHARACTERISTIC /end GROUP
/begin GROUP autosar_swc_aeb_autosar_swc_aeb_Step_sys_Subsystem_Reference_AEB_Function_Run_AsyEvlrCritEve_Step_Func_Run_AsyEvlrCritEve_Step_Func_TAWrapper_PreProcessor_ObjectPreProcessor_ObjectPreProcessorLoop_ValidObject_SafetyMarginFrontObjects_InPathCalculationWithPredictedObjPositions_CreateInPathDataTTM_CreateInPathData_DetermineInPathDataLongPredTime "autosar_swc_aeb/autosar_swc_aeb_Step_sys/Subsystem Reference/AEB Function/Run_AsyEvlrCritEve_Step_Func/Run_AsyEvlrCritEve_Step_Func/TAWrapper/PreProcessor/ObjectPreProcessor/ObjectPreProcessorLoop/ValidObject/SafetyMarginFrontObjects/InPathCalculationWithPredictedObjPositions/CreateInPathDataTTM/CreateInPathData/DetermineInPathDataLongPredTime"
 /begin SUB_GROUP autosar_swc_aeb_autosar_swc_aeb_Step_sys_Subsystem_Reference_AEB_Function_Run_AsyEvlrCritEve_Step_Func_Run_AsyEvlrCritEve_Step_Func_TAWrapper_PreProcessor_ObjectPreProcessor_ObjectPreProcessorLoop_ValidObject_SafetyMarginFrontObjects_InPathCalculationWithPredictedObjPositions_CreateInPathDataTTM_CreateInPathData_DetermineInPathDataLongPredTime_ObjectWillBrake autosar_swc_aeb_autosar_swc_aeb_Step_sys_Subsystem_Reference_AEB_Function_Run_AsyEvlrCritEve_Step_Func_Run_AsyEvlrCritEve_Step_Func_TAWrapper_PreProcessor_ObjectPreProcessor_ObjectPreProcessorLoop_ValidObject_SafetyMarginFrontObjects_InPathCalculationWithPredictedObjPositions_CreateInPathDataTTM_CreateInPathData_DetermineInPathDataLongPredTime_ObjectWillSteerLeft autosar_swc_aeb_autosar_swc_aeb_Step_sys_Subsystem_Reference_AEB_Function_Run_AsyEvlrCritEve_Step_Func_Run_AsyEvlrCritEve_Step_Func_TAWrapper_PreProcessor_ObjectPreProcessor_ObjectPreProcessorLoop_ValidObject_SafetyMarginFrontObjects_InPathCalculationWithPredictedObjPositions_CreateInPathDataTTM_CreateInPathData_DetermineInPathDataLongPredTime_ObjectWillSteerRight /end SUB_GROUP
/end GROUP
/begin GROUP autosar_swc_aeb_autosar_swc_aeb_Step_sys_Subsystem_Reference_AEB_Function_Run_AsyEvlrCritEve_Step_Func_Run_AsyEvlrCritEve_Step_Func_TAWrapper_PreProcessor_ObjectPreProcessor_ObjectPreProcessorLoop_ValidObject_SafetyMarginFrontObjects_InPathCalculationWithPredictedObjPositions_CreateInPathDataTTM_CreateInPathData_DetermineInPathDataLongPredTime_ObjectWillBrake "autosar_swc_aeb/autosar_swc_aeb_Step_sys/Subsystem Reference/AEB Function/Run_AsyEvlrCritEve_Step_Func/Run_AsyEvlrCritEve_Step_Func/TAWrapper/PreProcessor/ObjectPreProcessor/ObjectPreProcessorLoop/ValidObject/SafetyMarginFrontObjects/InPathCalculationWithPredictedObjPositions/CreateInPathDataTTM/CreateInPathData/DetermineInPathDataLongPredTime/ObjectWillBrake"
 /begin SUB_GROUP autosar_swc_aeb_autosar_swc_aeb_Step_sys_Subsystem_Reference_AEB_Function_Run_AsyEvlrCritEve_Step_Func_Run_AsyEvlrCritEve_Step_Func_TAWrapper_PreProcessor_ObjectPreProcessor_ObjectPreProcessorLoop_ValidObject_SafetyMarginFrontObjects_InPathCalculationWithPredictedObjPositions_CreateInPathDataTTM_CreateInPathData_DetermineInPathDataLongPredTime_ObjectWillBrake_NoOperation_3 autosar_swc_aeb_autosar_swc_aeb_Step_sys_Subsystem_Reference_AEB_Function_Run_AsyEvlrCritEve_Step_Func_Run_AsyEvlrCritEve_Step_Func_TAWrapper_PreProcessor_ObjectPreProcessor_ObjectPreProcessorLoop_ValidObject_SafetyMarginFrontObjects_InPathCalculationWithPredictedObjPositions_CreateInPathDataTTM_CreateInPathData_DetermineInPathDataLongPredTime_ObjectWillBrake_NoOperation_4 /end SUB_GROUP
/end GROUP
/begin GROUP autosar_swc_aeb_autosar_swc_aeb_Step_sys_Subsystem_Reference_AEB_Function_Run_AsyEvlrCritEve_Step_Func_Run_AsyEvlrCritEve_Step_Func_TAWrapper_PreProcessor_ObjectPreProcessor_ObjectPreProcessorLoop_ValidObject_SafetyMarginFrontObjects_InPathCalculationWithPredictedObjPositions_CreateInPathDataTTM_CreateInPathData_DetermineInPathDataLongPredTime_ObjectWillSteerLeft "autosar_swc_aeb/autosar_swc_aeb_Step_sys/Subsystem Reference/AEB Function/Run_AsyEvlrCritEve_Step_Func/Run_AsyEvlrCritEve_Step_Func/TAWrapper/PreProcessor/ObjectPreProcessor/ObjectPreProcessorLoop/ValidObject/SafetyMarginFrontObjects/InPathCalculationWithPredictedObjPositions/CreateInPathDataTTM/CreateInPathData/DetermineInPathDataLongPredTime/ObjectWillSteerLeft"
 /begin SUB_GROUP autosar_swc_aeb_autosar_swc_aeb_Step_sys_Subsystem_Reference_AEB_Function_Run_AsyEvlrCritEve_Step_Func_Run_AsyEvlrCritEve_Step_Func_TAWrapper_PreProcessor_ObjectPreProcessor_ObjectPreProcessorLoop_ValidObject_SafetyMarginFrontObjects_InPathCalculationWithPredictedObjPositions_CreateInPathDataTTM_CreateInPathData_DetermineInPathDataLongPredTime_ObjectWillSteerLeft_NoOperation_3 autosar_swc_aeb_autosar_swc_aeb_Step_sys_Subsystem_Reference_AEB_Function_Run_AsyEvlrCritEve_Step_Func_Run_AsyEvlrCritEve_Step_Func_TAWrapper_PreProcessor_ObjectPreProcessor_ObjectPreProcessorLoop_ValidObject_SafetyMarginFrontObjects_InPathCalculationWithPredictedObjPositions_CreateInPathDataTTM_CreateInPathData_DetermineInPathDataLongPredTime_ObjectWillSteerLeft_NoOperation_4 autosar_swc_aeb_autosar_swc_aeb_Step_sys_Subsystem_Reference_AEB_Function_Run_AsyEvlrCritEve_Step_Func_Run_AsyEvlrCritEve_Step_Func_TAWrapper_PreProcessor_ObjectPreProcessor_ObjectPreProcessorLoop_ValidObject_SafetyMarginFrontObjects_InPathCalculationWithPredictedObjPositions_CreateInPathDataTTM_CreateInPathData_DetermineInPathDataLongPredTime_ObjectWillSteerLeft_NoOperation_5 /end SUB_GROUP
/end GROUP
/begin GROUP autosar_swc_aeb_autosar_swc_aeb_Step_sys_Subsystem_Reference_AEB_Function_Run_AsyEvlrCritEve_Step_Func_Run_AsyEvlrCritEve_Step_Func_TAWrapper_PreProcessor_ObjectPreProcessor_ObjectPreProcessorLoop_ValidObject_SafetyMarginFrontObjects_InPathCalculationWithPredictedObjPositions_CreateInPathDataTTM_CreateInPathData_DetermineInPathDataLongPredTime_ObjectWillSteerLeft_NoOperation_5 "autosar_swc_aeb/autosar_swc_aeb_Step_sys/Subsystem Reference/AEB Function/Run_AsyEvlrCritEve_Step_Func/Run_AsyEvlrCritEve_Step_Func/TAWrapper/PreProcessor/ObjectPreProcessor/ObjectPreProcessorLoop/ValidObject/SafetyMarginFrontObjects/InPathCalculationWithPredictedObjPositions/CreateInPathDataTTM/CreateInPathData/DetermineInPathDataLongPredTime/ObjectWillSteerLeft/NoOperation_5" /begin REF_MEASUREMENT autosar_swc_aeb_rtARID_DEF.CrvtObj_l /end REF_MEASUREMENT /end GROUP
/begin GROUP autosar_swc_aeb_autosar_swc_aeb_Step_sys_Subsystem_Reference_AEB_Function_Run_AsyEvlrCritEve_Step_Func_Run_AsyEvlrCritEve_Step_Func_TAWrapper_PreProcessor_ObjectPreProcessor_ObjectPreProcessorLoop_ValidObject_SafetyMarginFrontObjects_InPathCalculationWithPredictedObjPositions_CreateInPathDataTTM_CreateInPathData_DetermineInPathDataLongPredTime_ObjectWillSteerRight "autosar_swc_aeb/autosar_swc_aeb_Step_sys/Subsystem Reference/AEB Function/Run_AsyEvlrCritEve_Step_Func/Run_AsyEvlrCritEve_Step_Func/TAWrapper/PreProcessor/ObjectPreProcessor/ObjectPreProcessorLoop/ValidObject/SafetyMarginFrontObjects/InPathCalculationWithPredictedObjPositions/CreateInPathDataTTM/CreateInPathData/DetermineInPathDataLongPredTime/ObjectWillSteerRight"
 /begin SUB_GROUP autosar_swc_aeb_autosar_swc_aeb_Step_sys_Subsystem_Reference_AEB_Function_Run_AsyEvlrCritEve_Step_Func_Run_AsyEvlrCritEve_Step_Func_TAWrapper_PreProcessor_ObjectPreProcessor_ObjectPreProcessorLoop_ValidObject_SafetyMarginFrontObjects_InPathCalculationWithPredictedObjPositions_CreateInPathDataTTM_CreateInPathData_DetermineInPathDataLongPredTime_ObjectWillSteerRight_NoOperation_1 autosar_swc_aeb_autosar_swc_aeb_Step_sys_Subsystem_Reference_AEB_Function_Run_AsyEvlrCritEve_Step_Func_Run_AsyEvlrCritEve_Step_Func_TAWrapper_PreProcessor_ObjectPreProcessor_ObjectPreProcessorLoop_ValidObject_SafetyMarginFrontObjects_InPathCalculationWithPredictedObjPositions_CreateInPathDataTTM_CreateInPathData_DetermineInPathDataLongPredTime_ObjectWillSteerRight_NoOperation_2 autosar_swc_aeb_autosar_swc_aeb_Step_sys_Subsystem_Reference_AEB_Function_Run_AsyEvlrCritEve_Step_Func_Run_AsyEvlrCritEve_Step_Func_TAWrapper_PreProcessor_ObjectPreProcessor_ObjectPreProcessorLoop_ValidObject_SafetyMarginFrontObjects_InPathCalculationWithPredictedObjPositions_CreateInPathDataTTM_CreateInPathData_DetermineInPathDataLongPredTime_ObjectWillSteerRight_NoOperation_3 /end SUB_GROUP
/end GROUP
/begin GROUP autosar_swc_aeb_autosar_swc_aeb_Step_sys_Subsystem_Reference_AEB_Function_Run_AsyEvlrCritEve_Step_Func_Run_AsyEvlrCritEve_Step_Func_TAWrapper_PreProcessor_ObjectPreProcessor_ObjectPreProcessorLoop_ValidObject_SafetyMarginFrontObjects_InPathCalculationWithPredictedObjPositions_CreateInPathDataTTM_CreateInPathData_DetermineInPathDataShortPredTime "autosar_swc_aeb/autosar_swc_aeb_Step_sys/Subsystem Reference/AEB Function/Run_AsyEvlrCritEve_Step_Func/Run_AsyEvlrCritEve_Step_Func/TAWrapper/PreProcessor/ObjectPreProcessor/ObjectPreProcessorLoop/ValidObject/SafetyMarginFrontObjects/InPathCalculationWithPredictedObjPositions/CreateInPathDataTTM/CreateInPathData/DetermineInPathDataShortPredTime"
 /begin SUB_GROUP autosar_swc_aeb_autosar_swc_aeb_Step_sys_Subsystem_Reference_AEB_Function_Run_AsyEvlrCritEve_Step_Func_Run_AsyEvlrCritEve_Step_Func_TAWrapper_PreProcessor_ObjectPreProcessor_ObjectPreProcessorLoop_ValidObject_SafetyMarginFrontObjects_InPathCalculationWithPredictedObjPositions_CreateInPathDataTTM_CreateInPathData_DetermineInPathDataShortPredTime_ObjectWillBrake autosar_swc_aeb_autosar_swc_aeb_Step_sys_Subsystem_Reference_AEB_Function_Run_AsyEvlrCritEve_Step_Func_Run_AsyEvlrCritEve_Step_Func_TAWrapper_PreProcessor_ObjectPreProcessor_ObjectPreProcessorLoop_ValidObject_SafetyMarginFrontObjects_InPathCalculationWithPredictedObjPositions_CreateInPathDataTTM_CreateInPathData_DetermineInPathDataShortPredTime_ObjectWillSteerLeft autosar_swc_aeb_autosar_swc_aeb_Step_sys_Subsystem_Reference_AEB_Function_Run_AsyEvlrCritEve_Step_Func_Run_AsyEvlrCritEve_Step_Func_TAWrapper_PreProcessor_ObjectPreProcessor_ObjectPreProcessorLoop_ValidObject_SafetyMarginFrontObjects_InPathCalculationWithPredictedObjPositions_CreateInPathDataTTM_CreateInPathData_DetermineInPathDataShortPredTime_ObjectWillSteerRight /end SUB_GROUP
/end GROUP
/begin GROUP autosar_swc_aeb_autosar_swc_aeb_Step_sys_Subsystem_Reference_AEB_Function_Run_AsyEvlrCritEve_Step_Func_Run_AsyEvlrCritEve_Step_Func_TAWrapper_PreProcessor_ObjectPreProcessor_ObjectPreProcessorLoop_ValidObject_SafetyMarginFrontObjects_InPathCalculationWithPredictedObjPositions_CreateInPathDataTTM_CreateInPathData_DetermineInPathDataShortPredTime_ObjectWillBrake "autosar_swc_aeb/autosar_swc_aeb_Step_sys/Subsystem Reference/AEB Function/Run_AsyEvlrCritEve_Step_Func/Run_AsyEvlrCritEve_Step_Func/TAWrapper/PreProcessor/ObjectPreProcessor/ObjectPreProcessorLoop/ValidObject/SafetyMarginFrontObjects/InPathCalculationWithPredictedObjPositions/CreateInPathDataTTM/CreateInPathData/DetermineInPathDataShortPredTime/ObjectWillBrake"
 /begin SUB_GROUP autosar_swc_aeb_autosar_swc_aeb_Step_sys_Subsystem_Reference_AEB_Function_Run_AsyEvlrCritEve_Step_Func_Run_AsyEvlrCritEve_Step_Func_TAWrapper_PreProcessor_ObjectPreProcessor_ObjectPreProcessorLoop_ValidObject_SafetyMarginFrontObjects_InPathCalculationWithPredictedObjPositions_CreateInPathDataTTM_CreateInPathData_DetermineInPathDataShortPredTime_ObjectWillBrake_NoOperation_3 autosar_swc_aeb_autosar_swc_aeb_Step_sys_Subsystem_Reference_AEB_Function_Run_AsyEvlrCritEve_Step_Func_Run_AsyEvlrCritEve_Step_Func_TAWrapper_PreProcessor_ObjectPreProcessor_ObjectPreProcessorLoop_ValidObject_SafetyMarginFrontObjects_InPathCalculationWithPredictedObjPositions_CreateInPathDataTTM_CreateInPathData_DetermineInPathDataShortPredTime_ObjectWillBrake_NoOperation_4 /end SUB_GROUP
/end GROUP
/begin GROUP autosar_swc_aeb_autosar_swc_aeb_Step_sys_Subsystem_Reference_AEB_Function_Run_AsyEvlrCritEve_Step_Func_Run_AsyEvlrCritEve_Step_Func_TAWrapper_PreProcessor_ObjectPreProcessor_ObjectPreProcessorLoop_ValidObject_SafetyMarginFrontObjects_InPathCalculationWithPredictedObjPositions_CreateInPathDataTTM_CreateInPathData_DetermineInPathDataShortPredTime_ObjectWillSteerLeft "autosar_swc_aeb/autosar_swc_aeb_Step_sys/Subsystem Reference/AEB Function/Run_AsyEvlrCritEve_Step_Func/Run_AsyEvlrCritEve_Step_Func/TAWrapper/PreProcessor/ObjectPreProcessor/ObjectPreProcessorLoop/ValidObject/SafetyMarginFrontObjects/InPathCalculationWithPredictedObjPositions/CreateInPathDataTTM/CreateInPathData/DetermineInPathDataShortPredTime/ObjectWillSteerLeft"
 /begin SUB_GROUP autosar_swc_aeb_autosar_swc_aeb_Step_sys_Subsystem_Reference_AEB_Function_Run_AsyEvlrCritEve_Step_Func_Run_AsyEvlrCritEve_Step_Func_TAWrapper_PreProcessor_ObjectPreProcessor_ObjectPreProcessorLoop_ValidObject_SafetyMarginFrontObjects_InPathCalculationWithPredictedObjPositions_CreateInPathDataTTM_CreateInPathData_DetermineInPathDataShortPredTime_ObjectWillSteerLeft_NoOperation_3 autosar_swc_aeb_autosar_swc_aeb_Step_sys_Subsystem_Reference_AEB_Function_Run_AsyEvlrCritEve_Step_Func_Run_AsyEvlrCritEve_Step_Func_TAWrapper_PreProcessor_ObjectPreProcessor_ObjectPreProcessorLoop_ValidObject_SafetyMarginFrontObjects_InPathCalculationWithPredictedObjPositions_CreateInPathDataTTM_CreateInPathData_DetermineInPathDataShortPredTime_ObjectWillSteerLeft_NoOperation_4 autosar_swc_aeb_autosar_swc_aeb_Step_sys_Subsystem_Reference_AEB_Function_Run_AsyEvlrCritEve_Step_Func_Run_AsyEvlrCritEve_Step_Func_TAWrapper_PreProcessor_ObjectPreProcessor_ObjectPreProcessorLoop_ValidObject_SafetyMarginFrontObjects_InPathCalculationWithPredictedObjPositions_CreateInPathDataTTM_CreateInPathData_DetermineInPathDataShortPredTime_ObjectWillSteerLeft_NoOperation_5 /end SUB_GROUP
/end GROUP
/begin GROUP autosar_swc_aeb_autosar_swc_aeb_Step_sys_Subsystem_Reference_AEB_Function_Run_AsyEvlrCritEve_Step_Func_Run_AsyEvlrCritEve_Step_Func_TAWrapper_PreProcessor_ObjectPreProcessor_ObjectPreProcessorLoop_ValidObject_SafetyMarginFrontObjects_InPathCalculationWithPredictedObjPositions_CreateInPathDataTTM_CreateInPathData_DetermineInPathDataShortPredTime_ObjectWillSteerLeft_NoOperation_5 "autosar_swc_aeb/autosar_swc_aeb_Step_sys/Subsystem Reference/AEB Function/Run_AsyEvlrCritEve_Step_Func/Run_AsyEvlrCritEve_Step_Func/TAWrapper/PreProcessor/ObjectPreProcessor/ObjectPreProcessorLoop/ValidObject/SafetyMarginFrontObjects/InPathCalculationWithPredictedObjPositions/CreateInPathDataTTM/CreateInPathData/DetermineInPathDataShortPredTime/ObjectWillSteerLeft/NoOperation_5" /begin REF_MEASUREMENT autosar_swc_aeb_rtARID_DEF.CrvtObj_l /end REF_MEASUREMENT /end GROUP
/begin GROUP autosar_swc_aeb_autosar_swc_aeb_Step_sys_Subsystem_Reference_AEB_Function_Run_AsyEvlrCritEve_Step_Func_Run_AsyEvlrCritEve_Step_Func_TAWrapper_PreProcessor_ObjectPreProcessor_ObjectPreProcessorLoop_ValidObject_SafetyMarginFrontObjects_InPathCalculationWithPredictedObjPositions_CreateInPathDataTTM_CreateInPathData_DetermineInPathDataShortPredTime_ObjectWillSteerRight "autosar_swc_aeb/autosar_swc_aeb_Step_sys/Subsystem Reference/AEB Function/Run_AsyEvlrCritEve_Step_Func/Run_AsyEvlrCritEve_Step_Func/TAWrapper/PreProcessor/ObjectPreProcessor/ObjectPreProcessorLoop/ValidObject/SafetyMarginFrontObjects/InPathCalculationWithPredictedObjPositions/CreateInPathDataTTM/CreateInPathData/DetermineInPathDataShortPredTime/ObjectWillSteerRight"
 /begin SUB_GROUP autosar_swc_aeb_autosar_swc_aeb_Step_sys_Subsystem_Reference_AEB_Function_Run_AsyEvlrCritEve_Step_Func_Run_AsyEvlrCritEve_Step_Func_TAWrapper_PreProcessor_ObjectPreProcessor_ObjectPreProcessorLoop_ValidObject_SafetyMarginFrontObjects_InPathCalculationWithPredictedObjPositions_CreateInPathDataTTM_CreateInPathData_DetermineInPathDataShortPredTime_ObjectWillSteerRight_NoOperation_1 autosar_swc_aeb_autosar_swc_aeb_Step_sys_Subsystem_Reference_AEB_Function_Run_AsyEvlrCritEve_Step_Func_Run_AsyEvlrCritEve_Step_Func_TAWrapper_PreProcessor_ObjectPreProcessor_ObjectPreProcessorLoop_ValidObject_SafetyMarginFrontObjects_InPathCalculationWithPredictedObjPositions_CreateInPathDataTTM_CreateInPathData_DetermineInPathDataShortPredTime_ObjectWillSteerRight_NoOperation_2 autosar_swc_aeb_autosar_swc_aeb_Step_sys_Subsystem_Reference_AEB_Function_Run_AsyEvlrCritEve_Step_Func_Run_AsyEvlrCritEve_Step_Func_TAWrapper_PreProcessor_ObjectPreProcessor_ObjectPreProcessorLoop_ValidObject_SafetyMarginFrontObjects_InPathCalculationWithPredictedObjPositions_CreateInPathDataTTM_CreateInPathData_DetermineInPathDataShortPredTime_ObjectWillSteerRight_NoOperation_3 /end SUB_GROUP
/end GROUP
/begin GROUP autosar_swc_aeb_autosar_swc_aeb_Step_sys_Subsystem_Reference_AEB_Function_Run_AsyEvlrCritEve_Step_Func_Run_AsyEvlrCritEve_Step_Func_TAWrapper_PreProcessor_ObjectPreProcessor_ObjectPreProcessorLoop_ValidObject_SafetyMarginFrontObjects_InPathCalculationWithPredictedObjPositions_CreateInPathDataTTM_RelativePositionAtTTR "autosar_swc_aeb/autosar_swc_aeb_Step_sys/Subsystem Reference/AEB Function/Run_AsyEvlrCritEve_Step_Func/Run_AsyEvlrCritEve_Step_Func/TAWrapper/PreProcessor/ObjectPreProcessor/ObjectPreProcessorLoop/ValidObject/SafetyMarginFrontObjects/InPathCalculationWithPredictedObjPositions/CreateInPathDataTTM/RelativePositionAtTTR"
 /begin SUB_GROUP autosar_swc_aeb_autosar_swc_aeb_Step_sys_Subsystem_Reference_AEB_Function_Run_AsyEvlrCritEve_Step_Func_Run_AsyEvlrCritEve_Step_Func_TAWrapper_PreProcessor_ObjectPreProcessor_ObjectPreProcessorLoop_ValidObject_SafetyMarginFrontObjects_InPathCalculationWithPredictedObjPositions_CreateInPathDataTTM_RelativePositionAtTTR_RelativePositionToHostPath autosar_swc_aeb_autosar_swc_aeb_Step_sys_Subsystem_Reference_AEB_Function_Run_AsyEvlrCritEve_Step_Func_Run_AsyEvlrCritEve_Step_Func_TAWrapper_PreProcessor_ObjectPreProcessor_ObjectPreProcessorLoop_ValidObject_SafetyMarginFrontObjects_InPathCalculationWithPredictedObjPositions_CreateInPathDataTTM_RelativePositionAtTTR_RelativePositionToHostPath1 autosar_swc_aeb_autosar_swc_aeb_Step_sys_Subsystem_Reference_AEB_Function_Run_AsyEvlrCritEve_Step_Func_Run_AsyEvlrCritEve_Step_Func_TAWrapper_PreProcessor_ObjectPreProcessor_ObjectPreProcessorLoop_ValidObject_SafetyMarginFrontObjects_InPathCalculationWithPredictedObjPositions_CreateInPathDataTTM_RelativePositionAtTTR_RelativePositionToHostPath2 autosar_swc_aeb_autosar_swc_aeb_Step_sys_Subsystem_Reference_AEB_Function_Run_AsyEvlrCritEve_Step_Func_Run_AsyEvlrCritEve_Step_Func_TAWrapper_PreProcessor_ObjectPreProcessor_ObjectPreProcessorLoop_ValidObject_SafetyMarginFrontObjects_InPathCalculationWithPredictedObjPositions_CreateInPathDataTTM_RelativePositionAtTTR_RelativePositionToHostPath3 autosar_swc_aeb_autosar_swc_aeb_Step_sys_Subsystem_Reference_AEB_Function_Run_AsyEvlrCritEve_Step_Func_Run_AsyEvlrCritEve_Step_Func_TAWrapper_PreProcessor_ObjectPreProcessor_ObjectPreProcessorLoop_ValidObject_SafetyMarginFrontObjects_InPathCalculationWithPredictedObjPositions_CreateInPathDataTTM_RelativePositionAtTTR_RelativePositionToHostPath4 /end SUB_GROUP
/end GROUP
/begin GROUP autosar_swc_aeb_autosar_swc_aeb_Step_sys_Subsystem_Reference_AEB_Function_Run_AsyEvlrCritEve_Step_Func_Run_AsyEvlrCritEve_Step_Func_TAWrapper_PreProcessor_ObjectPreProcessor_ObjectPreProcessorLoop_ValidObject_SafetyMarginFrontObjects_InPathCalculationWithPredictedObjPositions_CreateInPathDataTTM_RelativePositionAtTTR_RelativePositionToHostPath "autosar_swc_aeb/autosar_swc_aeb_Step_sys/Subsystem Reference/AEB Function/Run_AsyEvlrCritEve_Step_Func/Run_AsyEvlrCritEve_Step_Func/TAWrapper/PreProcessor/ObjectPreProcessor/ObjectPreProcessorLoop/ValidObject/SafetyMarginFrontObjects/InPathCalculationWithPredictedObjPositions/CreateInPathDataTTM/RelativePositionAtTTR/RelativePositionToHostPath"
 /begin SUB_GROUP autosar_swc_aeb_autosar_swc_aeb_Step_sys_Subsystem_Reference_AEB_Function_Run_AsyEvlrCritEve_Step_Func_Run_AsyEvlrCritEve_Step_Func_TAWrapper_PreProcessor_ObjectPreProcessor_ObjectPreProcessorLoop_ValidObject_SafetyMarginFrontObjects_InPathCalculationWithPredictedObjPositions_CreateInPathDataTTM_RelativePositionAtTTR_RelativePositionToHostPath_RelativeHeadingAndRotation autosar_swc_aeb_autosar_swc_aeb_Step_sys_Subsystem_Reference_AEB_Function_Run_AsyEvlrCritEve_Step_Func_Run_AsyEvlrCritEve_Step_Func_TAWrapper_PreProcessor_ObjectPreProcessor_ObjectPreProcessorLoop_ValidObject_SafetyMarginFrontObjects_InPathCalculationWithPredictedObjPositions_CreateInPathDataTTM_RelativePositionAtTTR_RelativePositionToHostPath_RelativePosnLatAndVLat /end SUB_GROUP
/end GROUP
/begin GROUP autosar_swc_aeb_autosar_swc_aeb_Step_sys_Subsystem_Reference_AEB_Function_Run_AsyEvlrCritEve_Step_Func_Run_AsyEvlrCritEve_Step_Func_TAWrapper_PreProcessor_ObjectPreProcessor_ObjectPreProcessorLoop_ValidObject_SafetyMarginFrontObjects_InPathCalculationWithPredictedObjPositions_CreateInPathDataTTM_RelativePositionAtTTR_RelativePositionToHostPath1 "autosar_swc_aeb/autosar_swc_aeb_Step_sys/Subsystem Reference/AEB Function/Run_AsyEvlrCritEve_Step_Func/Run_AsyEvlrCritEve_Step_Func/TAWrapper/PreProcessor/ObjectPreProcessor/ObjectPreProcessorLoop/ValidObject/SafetyMarginFrontObjects/InPathCalculationWithPredictedObjPositions/CreateInPathDataTTM/RelativePositionAtTTR/RelativePositionToHostPath1"
 /begin SUB_GROUP autosar_swc_aeb_autosar_swc_aeb_Step_sys_Subsystem_Reference_AEB_Function_Run_AsyEvlrCritEve_Step_Func_Run_AsyEvlrCritEve_Step_Func_TAWrapper_PreProcessor_ObjectPreProcessor_ObjectPreProcessorLoop_ValidObject_SafetyMarginFrontObjects_InPathCalculationWithPredictedObjPositions_CreateInPathDataTTM_RelativePositionAtTTR_RelativePositionToHostPath1_RelativeHeadingAndRotation autosar_swc_aeb_autosar_swc_aeb_Step_sys_Subsystem_Reference_AEB_Function_Run_AsyEvlrCritEve_Step_Func_Run_AsyEvlrCritEve_Step_Func_TAWrapper_PreProcessor_ObjectPreProcessor_ObjectPreProcessorLoop_ValidObject_SafetyMarginFrontObjects_InPathCalculationWithPredictedObjPositions_CreateInPathDataTTM_RelativePositionAtTTR_RelativePositionToHostPath1_RelativePosnLatAndVLat /end SUB_GROUP
/end GROUP
/begin GROUP autosar_swc_aeb_autosar_swc_aeb_Step_sys_Subsystem_Reference_AEB_Function_Run_AsyEvlrCritEve_Step_Func_Run_AsyEvlrCritEve_Step_Func_TAWrapper_PreProcessor_ObjectPreProcessor_ObjectPreProcessorLoop_ValidObject_SafetyMarginFrontObjects_InPathCalculationWithPredictedObjPositions_CreateInPathDataTTM_RelativePositionAtTTR_RelativePositionToHostPath1_RelativeHeadingAndRotation "autosar_swc_aeb/autosar_swc_aeb_Step_sys/Subsystem Reference/AEB Function/Run_AsyEvlrCritEve_Step_Func/Run_AsyEvlrCritEve_Step_Func/TAWrapper/PreProcessor/ObjectPreProcessor/ObjectPreProcessorLoop/ValidObject/SafetyMarginFrontObjects/InPathCalculationWithPredictedObjPositions/CreateInPathDataTTM/RelativePositionAtTTR/RelativePositionToHostPath1/RelativeHeadingAndRotation"
 /begin SUB_GROUP autosar_swc_aeb_autosar_swc_aeb_Step_sys_Subsystem_Reference_AEB_Function_Run_AsyEvlrCritEve_Step_Func_Run_AsyEvlrCritEve_Step_Func_TAWrapper_PreProcessor_ObjectPreProcessor_ObjectPreProcessorLoop_ValidObject_SafetyMarginFrontObjects_InPathCalculationWithPredictedObjPositions_CreateInPathDataTTM_RelativePositionAtTTR_RelativePositionToHostPath1_RelativeHeadingAndRotation_MovingObject autosar_swc_aeb_autosar_swc_aeb_Step_sys_Subsystem_Reference_AEB_Function_Run_AsyEvlrCritEve_Step_Func_Run_AsyEvlrCritEve_Step_Func_TAWrapper_PreProcessor_ObjectPreProcessor_ObjectPreProcessorLoop_ValidObject_SafetyMarginFrontObjects_InPathCalculationWithPredictedObjPositions_CreateInPathDataTTM_RelativePositionAtTTR_RelativePositionToHostPath1_RelativeHeadingAndRotation_StationaryObject /end SUB_GROUP
/end GROUP
/begin GROUP autosar_swc_aeb_autosar_swc_aeb_Step_sys_Subsystem_Reference_AEB_Function_Run_AsyEvlrCritEve_Step_Func_Run_AsyEvlrCritEve_Step_Func_TAWrapper_PreProcessor_ObjectPreProcessor_ObjectPreProcessorLoop_ValidObject_SafetyMarginFrontObjects_InPathCalculationWithPredictedObjPositions_CreateInPathDataTTM_RelativePositionAtTTR_RelativePositionToHostPath2 "autosar_swc_aeb/autosar_swc_aeb_Step_sys/Subsystem Reference/AEB Function/Run_AsyEvlrCritEve_Step_Func/Run_AsyEvlrCritEve_Step_Func/TAWrapper/PreProcessor/ObjectPreProcessor/ObjectPreProcessorLoop/ValidObject/SafetyMarginFrontObjects/InPathCalculationWithPredictedObjPositions/CreateInPathDataTTM/RelativePositionAtTTR/RelativePositionToHostPath2"
 /begin SUB_GROUP autosar_swc_aeb_autosar_swc_aeb_Step_sys_Subsystem_Reference_AEB_Function_Run_AsyEvlrCritEve_Step_Func_Run_AsyEvlrCritEve_Step_Func_TAWrapper_PreProcessor_ObjectPreProcessor_ObjectPreProcessorLoop_ValidObject_SafetyMarginFrontObjects_InPathCalculationWithPredictedObjPositions_CreateInPathDataTTM_RelativePositionAtTTR_RelativePositionToHostPath2_RelativeHeadingAndRotation autosar_swc_aeb_autosar_swc_aeb_Step_sys_Subsystem_Reference_AEB_Function_Run_AsyEvlrCritEve_Step_Func_Run_AsyEvlrCritEve_Step_Func_TAWrapper_PreProcessor_ObjectPreProcessor_ObjectPreProcessorLoop_ValidObject_SafetyMarginFrontObjects_InPathCalculationWithPredictedObjPositions_CreateInPathDataTTM_RelativePositionAtTTR_RelativePositionToHostPath2_RelativePosnLatAndVLat /end SUB_GROUP
/end GROUP
/begin GROUP autosar_swc_aeb_autosar_swc_aeb_Step_sys_Subsystem_Reference_AEB_Function_Run_AsyEvlrCritEve_Step_Func_Run_AsyEvlrCritEve_Step_Func_TAWrapper_PreProcessor_ObjectPreProcessor_ObjectPreProcessorLoop_ValidObject_SafetyMarginFrontObjects_InPathCalculationWithPredictedObjPositions_CreateInPathDataTTM_RelativePositionAtTTR_RelativePositionToHostPath2_RelativeHeadingAndRotation "autosar_swc_aeb/autosar_swc_aeb_Step_sys/Subsystem Reference/AEB Function/Run_AsyEvlrCritEve_Step_Func/Run_AsyEvlrCritEve_Step_Func/TAWrapper/PreProcessor/ObjectPreProcessor/ObjectPreProcessorLoop/ValidObject/SafetyMarginFrontObjects/InPathCalculationWithPredictedObjPositions/CreateInPathDataTTM/RelativePositionAtTTR/RelativePositionToHostPath2/RelativeHeadingAndRotation"
 /begin SUB_GROUP autosar_swc_aeb_autosar_swc_aeb_Step_sys_Subsystem_Reference_AEB_Function_Run_AsyEvlrCritEve_Step_Func_Run_AsyEvlrCritEve_Step_Func_TAWrapper_PreProcessor_ObjectPreProcessor_ObjectPreProcessorLoop_ValidObject_SafetyMarginFrontObjects_InPathCalculationWithPredictedObjPositions_CreateInPathDataTTM_RelativePositionAtTTR_RelativePositionToHostPath2_RelativeHeadingAndRotation_MovingObject autosar_swc_aeb_autosar_swc_aeb_Step_sys_Subsystem_Reference_AEB_Function_Run_AsyEvlrCritEve_Step_Func_Run_AsyEvlrCritEve_Step_Func_TAWrapper_PreProcessor_ObjectPreProcessor_ObjectPreProcessorLoop_ValidObject_SafetyMarginFrontObjects_InPathCalculationWithPredictedObjPositions_CreateInPathDataTTM_RelativePositionAtTTR_RelativePositionToHostPath2_RelativeHeadingAndRotation_StationaryObject /end SUB_GROUP
/end GROUP
/begin GROUP autosar_swc_aeb_autosar_swc_aeb_Step_sys_Subsystem_Reference_AEB_Function_Run_AsyEvlrCritEve_Step_Func_Run_AsyEvlrCritEve_Step_Func_TAWrapper_PreProcessor_ObjectPreProcessor_ObjectPreProcessorLoop_ValidObject_SafetyMarginFrontObjects_InPathCalculationWithPredictedObjPositions_CreateInPathDataTTM_RelativePositionAtTTR_RelativePositionToHostPath3 "autosar_swc_aeb/autosar_swc_aeb_Step_sys/Subsystem Reference/AEB Function/Run_AsyEvlrCritEve_Step_Func/Run_AsyEvlrCritEve_Step_Func/TAWrapper/PreProcessor/ObjectPreProcessor/ObjectPreProcessorLoop/ValidObject/SafetyMarginFrontObjects/InPathCalculationWithPredictedObjPositions/CreateInPathDataTTM/RelativePositionAtTTR/RelativePositionToHostPath3"
 /begin SUB_GROUP autosar_swc_aeb_autosar_swc_aeb_Step_sys_Subsystem_Reference_AEB_Function_Run_AsyEvlrCritEve_Step_Func_Run_AsyEvlrCritEve_Step_Func_TAWrapper_PreProcessor_ObjectPreProcessor_ObjectPreProcessorLoop_ValidObject_SafetyMarginFrontObjects_InPathCalculationWithPredictedObjPositions_CreateInPathDataTTM_RelativePositionAtTTR_RelativePositionToHostPath3_RelativeHeadingAndRotation autosar_swc_aeb_autosar_swc_aeb_Step_sys_Subsystem_Reference_AEB_Function_Run_AsyEvlrCritEve_Step_Func_Run_AsyEvlrCritEve_Step_Func_TAWrapper_PreProcessor_ObjectPreProcessor_ObjectPreProcessorLoop_ValidObject_SafetyMarginFrontObjects_InPathCalculationWithPredictedObjPositions_CreateInPathDataTTM_RelativePositionAtTTR_RelativePositionToHostPath3_RelativePosnLatAndVLat /end SUB_GROUP
/end GROUP
/begin GROUP autosar_swc_aeb_autosar_swc_aeb_Step_sys_Subsystem_Reference_AEB_Function_Run_AsyEvlrCritEve_Step_Func_Run_AsyEvlrCritEve_Step_Func_TAWrapper_PreProcessor_ObjectPreProcessor_ObjectPreProcessorLoop_ValidObject_SafetyMarginFrontObjects_InPathCalculationWithPredictedObjPositions_CreateInPathDataTTM_RelativePositionAtTTR_RelativePositionToHostPath3_RelativeHeadingAndRotation "autosar_swc_aeb/autosar_swc_aeb_Step_sys/Subsystem Reference/AEB Function/Run_AsyEvlrCritEve_Step_Func/Run_AsyEvlrCritEve_Step_Func/TAWrapper/PreProcessor/ObjectPreProcessor/ObjectPreProcessorLoop/ValidObject/SafetyMarginFrontObjects/InPathCalculationWithPredictedObjPositions/CreateInPathDataTTM/RelativePositionAtTTR/RelativePositionToHostPath3/RelativeHeadingAndRotation"
 /begin SUB_GROUP autosar_swc_aeb_autosar_swc_aeb_Step_sys_Subsystem_Reference_AEB_Function_Run_AsyEvlrCritEve_Step_Func_Run_AsyEvlrCritEve_Step_Func_TAWrapper_PreProcessor_ObjectPreProcessor_ObjectPreProcessorLoop_ValidObject_SafetyMarginFrontObjects_InPathCalculationWithPredictedObjPositions_CreateInPathDataTTM_RelativePositionAtTTR_RelativePositionToHostPath3_RelativeHeadingAndRotation_MovingObject autosar_swc_aeb_autosar_swc_aeb_Step_sys_Subsystem_Reference_AEB_Function_Run_AsyEvlrCritEve_Step_Func_Run_AsyEvlrCritEve_Step_Func_TAWrapper_PreProcessor_ObjectPreProcessor_ObjectPreProcessorLoop_ValidObject_SafetyMarginFrontObjects_InPathCalculationWithPredictedObjPositions_CreateInPathDataTTM_RelativePositionAtTTR_RelativePositionToHostPath3_RelativeHeadingAndRotation_StationaryObject /end SUB_GROUP
/end GROUP
/begin GROUP autosar_swc_aeb_autosar_swc_aeb_Step_sys_Subsystem_Reference_AEB_Function_Run_AsyEvlrCritEve_Step_Func_Run_AsyEvlrCritEve_Step_Func_TAWrapper_PreProcessor_ObjectPreProcessor_ObjectPreProcessorLoop_ValidObject_SafetyMarginFrontObjects_InPathCalculationWithPredictedObjPositions_CreateInPathDataTTM_RelativePositionAtTTR_RelativePositionToHostPath3_RelativePosnLatAndVLat "autosar_swc_aeb/autosar_swc_aeb_Step_sys/Subsystem Reference/AEB Function/Run_AsyEvlrCritEve_Step_Func/Run_AsyEvlrCritEve_Step_Func/TAWrapper/PreProcessor/ObjectPreProcessor/ObjectPreProcessorLoop/ValidObject/SafetyMarginFrontObjects/InPathCalculationWithPredictedObjPositions/CreateInPathDataTTM/RelativePositionAtTTR/RelativePositionToHostPath3/RelativePosnLatAndVLat"
 /begin REF_MEASUREMENT autosar_swc_aeb_rtARID_DEF.PosnLatObj_p3h autosar_swc_aeb_rtARID_DEF.PosnLgtObj_o0e /end REF_MEASUREMENT
/end GROUP
/begin GROUP autosar_swc_aeb_autosar_swc_aeb_Step_sys_Subsystem_Reference_AEB_Function_Run_AsyEvlrCritEve_Step_Func_Run_AsyEvlrCritEve_Step_Func_TAWrapper_PreProcessor_ObjectPreProcessor_ObjectPreProcessorLoop_ValidObject_SafetyMarginFrontObjects_InPathCalculationWithPredictedObjPositions_CreateInPathDataTTM_RelativePositionAtTTR_RelativePositionToHostPath4 "autosar_swc_aeb/autosar_swc_aeb_Step_sys/Subsystem Reference/AEB Function/Run_AsyEvlrCritEve_Step_Func/Run_AsyEvlrCritEve_Step_Func/TAWrapper/PreProcessor/ObjectPreProcessor/ObjectPreProcessorLoop/ValidObject/SafetyMarginFrontObjects/InPathCalculationWithPredictedObjPositions/CreateInPathDataTTM/RelativePositionAtTTR/RelativePositionToHostPath4"
 /begin SUB_GROUP autosar_swc_aeb_autosar_swc_aeb_Step_sys_Subsystem_Reference_AEB_Function_Run_AsyEvlrCritEve_Step_Func_Run_AsyEvlrCritEve_Step_Func_TAWrapper_PreProcessor_ObjectPreProcessor_ObjectPreProcessorLoop_ValidObject_SafetyMarginFrontObjects_InPathCalculationWithPredictedObjPositions_CreateInPathDataTTM_RelativePositionAtTTR_RelativePositionToHostPath4_RelativeHeadingAndRotation autosar_swc_aeb_autosar_swc_aeb_Step_sys_Subsystem_Reference_AEB_Function_Run_AsyEvlrCritEve_Step_Func_Run_AsyEvlrCritEve_Step_Func_TAWrapper_PreProcessor_ObjectPreProcessor_ObjectPreProcessorLoop_ValidObject_SafetyMarginFrontObjects_InPathCalculationWithPredictedObjPositions_CreateInPathDataTTM_RelativePositionAtTTR_RelativePositionToHostPath4_RelativePosnLatAndVLat /end SUB_GROUP
/end GROUP
/begin GROUP autosar_swc_aeb_autosar_swc_aeb_Step_sys_Subsystem_Reference_AEB_Function_Run_AsyEvlrCritEve_Step_Func_Run_AsyEvlrCritEve_Step_Func_TAWrapper_PreProcessor_ObjectPreProcessor_ObjectPreProcessorLoop_ValidObject_SafetyMarginFrontObjects_InPathCalculationWithPredictedObjPositions_CreateInPathDataTTM_RelativePositionAtTTR_RelativePositionToHostPath4_RelativeHeadingAndRotation "autosar_swc_aeb/autosar_swc_aeb_Step_sys/Subsystem Reference/AEB Function/Run_AsyEvlrCritEve_Step_Func/Run_AsyEvlrCritEve_Step_Func/TAWrapper/PreProcessor/ObjectPreProcessor/ObjectPreProcessorLoop/ValidObject/SafetyMarginFrontObjects/InPathCalculationWithPredictedObjPositions/CreateInPathDataTTM/RelativePositionAtTTR/RelativePositionToHostPath4/RelativeHeadingAndRotation"
 /begin SUB_GROUP autosar_swc_aeb_autosar_swc_aeb_Step_sys_Subsystem_Reference_AEB_Function_Run_AsyEvlrCritEve_Step_Func_Run_AsyEvlrCritEve_Step_Func_TAWrapper_PreProcessor_ObjectPreProcessor_ObjectPreProcessorLoop_ValidObject_SafetyMarginFrontObjects_InPathCalculationWithPredictedObjPositions_CreateInPathDataTTM_RelativePositionAtTTR_RelativePositionToHostPath4_RelativeHeadingAndRotation_MovingObject autosar_swc_aeb_autosar_swc_aeb_Step_sys_Subsystem_Reference_AEB_Function_Run_AsyEvlrCritEve_Step_Func_Run_AsyEvlrCritEve_Step_Func_TAWrapper_PreProcessor_ObjectPreProcessor_ObjectPreProcessorLoop_ValidObject_SafetyMarginFrontObjects_InPathCalculationWithPredictedObjPositions_CreateInPathDataTTM_RelativePositionAtTTR_RelativePositionToHostPath4_RelativeHeadingAndRotation_StationaryObject /end SUB_GROUP
/end GROUP
/begin GROUP autosar_swc_aeb_autosar_swc_aeb_Step_sys_Subsystem_Reference_AEB_Function_Run_AsyEvlrCritEve_Step_Func_Run_AsyEvlrCritEve_Step_Func_TAWrapper_PreProcessor_ObjectPreProcessor_ObjectPreProcessorLoop_ValidObject_SafetyMarginFrontObjects_InPathCalculationWithPredictedObjPositions_CreateInPathDataTTM_RelativePositionAtTTR_RelativePositionToHostPath_RelativeHeadingAndRotation "autosar_swc_aeb/autosar_swc_aeb_Step_sys/Subsystem Reference/AEB Function/Run_AsyEvlrCritEve_Step_Func/Run_AsyEvlrCritEve_Step_Func/TAWrapper/PreProcessor/ObjectPreProcessor/ObjectPreProcessorLoop/ValidObject/SafetyMarginFrontObjects/InPathCalculationWithPredictedObjPositions/CreateInPathDataTTM/RelativePositionAtTTR/RelativePositionToHostPath/RelativeHeadingAndRotation"
 /begin SUB_GROUP autosar_swc_aeb_autosar_swc_aeb_Step_sys_Subsystem_Reference_AEB_Function_Run_AsyEvlrCritEve_Step_Func_Run_AsyEvlrCritEve_Step_Func_TAWrapper_PreProcessor_ObjectPreProcessor_ObjectPreProcessorLoop_ValidObject_SafetyMarginFrontObjects_InPathCalculationWithPredictedObjPositions_CreateInPathDataTTM_RelativePositionAtTTR_RelativePositionToHostPath_RelativeHeadingAndRotation_MovingObject autosar_swc_aeb_autosar_swc_aeb_Step_sys_Subsystem_Reference_AEB_Function_Run_AsyEvlrCritEve_Step_Func_Run_AsyEvlrCritEve_Step_Func_TAWrapper_PreProcessor_ObjectPreProcessor_ObjectPreProcessorLoop_ValidObject_SafetyMarginFrontObjects_InPathCalculationWithPredictedObjPositions_CreateInPathDataTTM_RelativePositionAtTTR_RelativePositionToHostPath_RelativeHeadingAndRotation_StationaryObject /end SUB_GROUP
/end GROUP
/begin GROUP autosar_swc_aeb_autosar_swc_aeb_Step_sys_Subsystem_Reference_AEB_Function_Run_AsyEvlrCritEve_Step_Func_Run_AsyEvlrCritEve_Step_Func_TAWrapper_PreProcessor_ObjectPreProcessor_ObjectPreProcessorLoop_ValidObject_SafetyMarginFrontObjects_InPathCalculationWithPredictedObjPositions_CreateInPathDataTTM_RelativePositionAtTTR_RelativePositionToHostPath_RelativeHeadingAndRotation_MovingObject "autosar_swc_aeb/autosar_swc_aeb_Step_sys/Subsystem Reference/AEB Function/Run_AsyEvlrCritEve_Step_Func/Run_AsyEvlrCritEve_Step_Func/TAWrapper/PreProcessor/ObjectPreProcessor/ObjectPreProcessorLoop/ValidObject/SafetyMarginFrontObjects/InPathCalculationWithPredictedObjPositions/CreateInPathDataTTM/RelativePositionAtTTR/RelativePositionToHostPath/RelativeHeadingAndRotation/MovingObject" /begin REF_MEASUREMENT autosar_swc_aeb_rtARID_DEF.HeadingObj_m /end REF_MEASUREMENT /end GROUP
/begin GROUP autosar_swc_aeb_autosar_swc_aeb_Step_sys_Subsystem_Reference_AEB_Function_Run_AsyEvlrCritEve_Step_Func_Run_AsyEvlrCritEve_Step_Func_TAWrapper_PreProcessor_ObjectPreProcessor_ObjectPreProcessorLoop_ValidObject_SafetyMarginFrontObjects_InPathCalculationWithPredictedObjPositions_CreateInPathDataTTM_RelativePositionAtTTR_RelativePositionToHostPath_RelativeHeadingAndRotation_StationaryObject "autosar_swc_aeb/autosar_swc_aeb_Step_sys/Subsystem Reference/AEB Function/Run_AsyEvlrCritEve_Step_Func/Run_AsyEvlrCritEve_Step_Func/TAWrapper/PreProcessor/ObjectPreProcessor/ObjectPreProcessorLoop/ValidObject/SafetyMarginFrontObjects/InPathCalculationWithPredictedObjPositions/CreateInPathDataTTM/RelativePositionAtTTR/RelativePositionToHostPath/RelativeHeadingAndRotation/StationaryObject" /begin REF_MEASUREMENT autosar_swc_aeb_rtARID_DEF.HeadingObj_m /end REF_MEASUREMENT /end GROUP
/begin GROUP autosar_swc_aeb_autosar_swc_aeb_Step_sys_Subsystem_Reference_AEB_Function_Run_AsyEvlrCritEve_Step_Func_Run_AsyEvlrCritEve_Step_Func_TAWrapper_PreProcessor_ObjectPreProcessor_ObjectPreProcessorLoop_ValidObject_SafetyMarginFrontObjects_InPathCalculationWithPredictedObjPositions_CreateInPathDataTTM_RelativePositionAtTTR_RelativePositionToHostPath_RelativePosnLatAndVLat "autosar_swc_aeb/autosar_swc_aeb_Step_sys/Subsystem Reference/AEB Function/Run_AsyEvlrCritEve_Step_Func/Run_AsyEvlrCritEve_Step_Func/TAWrapper/PreProcessor/ObjectPreProcessor/ObjectPreProcessorLoop/ValidObject/SafetyMarginFrontObjects/InPathCalculationWithPredictedObjPositions/CreateInPathDataTTM/RelativePositionAtTTR/RelativePositionToHostPath/RelativePosnLatAndVLat"
 /begin REF_MEASUREMENT autosar_swc_aeb_rtARID_DEF.PosnLatObj_p autosar_swc_aeb_rtARID_DEF.PosnLgtObj_o autosar_swc_aeb_rtARID_DEF.VLatObj_j autosar_swc_aeb_rtARID_DEF.VLgtObj_f /end REF_MEASUREMENT
/end GROUP
/begin GROUP autosar_swc_aeb_autosar_swc_aeb_Step_sys_Subsystem_Reference_AEB_Function_Run_AsyEvlrCritEve_Step_Func_Run_AsyEvlrCritEve_Step_Func_TAWrapper_PreProcessor_ObjectPreProcessor_ObjectPreProcessorLoop_ValidObject_SafetyMarginFrontObjects_InPathCalculationWithPredictedObjPositions_CreateInPathDataTTM_ToDiag "autosar_swc_aeb/autosar_swc_aeb_Step_sys/Subsystem Reference/AEB Function/Run_AsyEvlrCritEve_Step_Func/Run_AsyEvlrCritEve_Step_Func/TAWrapper/PreProcessor/ObjectPreProcessor/ObjectPreProcessorLoop/ValidObject/SafetyMarginFrontObjects/InPathCalculationWithPredictedObjPositions/CreateInPathDataTTM/ToDiag"
 /begin SUB_GROUP autosar_swc_aeb_autosar_swc_aeb_Step_sys_Subsystem_Reference_AEB_Function_Run_AsyEvlrCritEve_Step_Func_Run_AsyEvlrCritEve_Step_Func_TAWrapper_PreProcessor_ObjectPreProcessor_ObjectPreProcessorLoop_ValidObject_SafetyMarginFrontObjects_InPathCalculationWithPredictedObjPositions_CreateInPathDataTTM_ToDiag_DIAG_TA_Inpath_PredObjAnBL_TTM autosar_swc_aeb_autosar_swc_aeb_Step_sys_Subsystem_Reference_AEB_Function_Run_AsyEvlrCritEve_Step_Func_Run_AsyEvlrCritEve_Step_Func_TAWrapper_PreProcessor_ObjectPreProcessor_ObjectPreProcessorLoop_ValidObject_SafetyMarginFrontObjects_InPathCalculationWithPredictedObjPositions_CreateInPathDataTTM_ToDiag_DIAG_TA_Inpath_PredObjAnBS_TTM autosar_swc_aeb_autosar_swc_aeb_Step_sys_Subsystem_Reference_AEB_Function_Run_AsyEvlrCritEve_Step_Func_Run_AsyEvlrCritEve_Step_Func_TAWrapper_PreProcessor_ObjectPreProcessor_ObjectPreProcessorLoop_ValidObject_SafetyMarginFrontObjects_InPathCalculationWithPredictedObjPositions_CreateInPathDataTTM_ToDiag_DIAG_TA_Inpath_PredObjAn_Le_TTM autosar_swc_aeb_autosar_swc_aeb_Step_sys_Subsystem_Reference_AEB_Function_Run_AsyEvlrCritEve_Step_Func_Run_AsyEvlrCritEve_Step_Func_TAWrapper_PreProcessor_ObjectPreProcessor_ObjectPreProcessorLoop_ValidObject_SafetyMarginFrontObjects_InPathCalculationWithPredictedObjPositions_CreateInPathDataTTM_ToDiag_DIAG_TA_Inpath_PredObjAn_Ri_TTM autosar_swc_aeb_autosar_swc_aeb_Step_sys_Subsystem_Reference_AEB_Function_Run_AsyEvlrCritEve_Step_Func_Run_AsyEvlrCritEve_Step_Func_TAWrapper_PreProcessor_ObjectPreProcessor_ObjectPreProcessorLoop_ValidObject_SafetyMarginFrontObjects_InPathCalculationWithPredictedObjPositions_CreateInPathDataTTM_ToDiag_DIAG_TA_Inpath_PredObjAn_TTM autosar_swc_aeb_autosar_swc_aeb_Step_sys_Subsystem_Reference_AEB_Function_Run_AsyEvlrCritEve_Step_Func_Run_AsyEvlrCritEve_Step_Func_TAWrapper_PreProcessor_ObjectPreProcessor_ObjectPreProcessorLoop_ValidObject_SafetyMarginFrontObjects_InPathCalculationWithPredictedObjPositions_CreateInPathDataTTM_ToDiag_DIAG_TA_Inpath_PredObjLatBL_TTM autosar_swc_aeb_autosar_swc_aeb_Step_sys_Subsystem_Reference_AEB_Function_Run_AsyEvlrCritEve_Step_Func_Run_AsyEvlrCritEve_Step_Func_TAWrapper_PreProcessor_ObjectPreProcessor_ObjectPreProcessorLoop_ValidObject_SafetyMarginFrontObjects_InPathCalculationWithPredictedObjPositions_CreateInPathDataTTM_ToDiag_DIAG_TA_Inpath_PredObjLatBS_TTM autosar_swc_aeb_autosar_swc_aeb_Step_sys_Subsystem_Reference_AEB_Function_Run_AsyEvlrCritEve_Step_Func_Run_AsyEvlrCritEve_Step_Func_TAWrapper_PreProcessor_ObjectPreProcessor_ObjectPreProcessorLoop_ValidObject_SafetyMarginFrontObjects_InPathCalculationWithPredictedObjPositions_CreateInPathDataTTM_ToDiag_DIAG_TA_Inpath_PredObjLat_Le_TTM autosar_swc_aeb_autosar_swc_aeb_Step_sys_Subsystem_Reference_AEB_Function_Run_AsyEvlrCritEve_Step_Func_Run_AsyEvlrCritEve_Step_Func_TAWrapper_PreProcessor_ObjectPreProcessor_ObjectPreProcessorLoop_ValidObject_SafetyMarginFrontObjects_InPathCalculationWithPredictedObjPositions_CreateInPathDataTTM_ToDiag_DIAG_TA_Inpath_PredObjLat_Ri_TTM autosar_swc_aeb_autosar_swc_aeb_Step_sys_Subsystem_Reference_AEB_Function_Run_AsyEvlrCritEve_Step_Func_Run_AsyEvlrCritEve_Step_Func_TAWrapper_PreProcessor_ObjectPreProcessor_ObjectPreProcessorLoop_ValidObject_SafetyMarginFrontObjects_InPathCalculationWithPredictedObjPositions_CreateInPathDataTTM_ToDiag_DIAG_TA_Inpath_PredObjLat_TTM autosar_swc_aeb_autosar_swc_aeb_Step_sys_Subsystem_Reference_AEB_Function_Run_AsyEvlrCritEve_Step_Func_Run_AsyEvlrCritEve_Step_Func_TAWrapper_PreProcessor_ObjectPreProcessor_ObjectPreProcessorLoop_ValidObject_SafetyMarginFrontObjects_InPathCalculationWithPredictedObjPositions_CreateInPathDataTTM_ToDiag_DIAG_TA_Inpath_PredObjLgtBS_TTM autosar_swc_aeb_autosar_swc_aeb_Step_sys_Subsystem_Reference_AEB_Function_Run_AsyEvlrCritEve_Step_Func_Run_AsyEvlrCritEve_Step_Func_TAWrapper_PreProcessor_ObjectPreProcessor_ObjectPreProcessorLoop_ValidObject_SafetyMarginFrontObjects_InPathCalculationWithPredictedObjPositions_CreateInPathDataTTM_ToDiag_DIAG_TA_Inpath_PredObjLgt_BL_TTM autosar_swc_aeb_autosar_swc_aeb_Step_sys_Subsystem_Reference_AEB_Function_Run_AsyEvlrCritEve_Step_Func_Run_AsyEvlrCritEve_Step_Func_TAWrapper_PreProcessor_ObjectPreProcessor_ObjectPreProcessorLoop_ValidObject_SafetyMarginFrontObjects_InPathCalculationWithPredictedObjPositions_CreateInPathDataTTM_ToDiag_DIAG_TA_Inpath_PredObjLgt_Le_TTM autosar_swc_aeb_autosar_swc_aeb_Step_sys_Subsystem_Reference_AEB_Function_Run_AsyEvlrCritEve_Step_Func_Run_AsyEvlrCritEve_Step_Func_TAWrapper_PreProcessor_ObjectPreProcessor_ObjectPreProcessorLoop_ValidObject_SafetyMarginFrontObjects_InPathCalculationWithPredictedObjPositions_CreateInPathDataTTM_ToDiag_DIAG_TA_Inpath_PredObjLgt_Ri_TTM autosar_swc_aeb_autosar_swc_aeb_Step_sys_Subsystem_Reference_AEB_Function_Run_AsyEvlrCritEve_Step_Func_Run_AsyEvlrCritEve_Step_Func_TAWrapper_PreProcessor_ObjectPreProcessor_ObjectPreProcessorLoop_ValidObject_SafetyMarginFrontObjects_InPathCalculationWithPredictedObjPositions_CreateInPathDataTTM_ToDiag_DIAG_TA_Inpath_PredObjLgt_TTM /end SUB_GROUP
/end GROUP
/begin GROUP autosar_swc_aeb_autosar_swc_aeb_Step_sys_Subsystem_Reference_AEB_Function_Run_AsyEvlrCritEve_Step_Func_Run_AsyEvlrCritEve_Step_Func_TAWrapper_PreProcessor_ObjectPreProcessor_ObjectPreProcessorLoop_ValidObject_SafetyMarginFrontObjects_InPathCalculationWithPredictedObjPositions_CreateInPathDataTTM_ToDiag_DIAG_TA_Inpath_PredObjAnBL_TTM "autosar_swc_aeb/autosar_swc_aeb_Step_sys/Subsystem Reference/AEB Function/Run_AsyEvlrCritEve_Step_Func/Run_AsyEvlrCritEve_Step_Func/TAWrapper/PreProcessor/ObjectPreProcessor/ObjectPreProcessorLoop/ValidObject/SafetyMarginFrontObjects/InPathCalculationWithPredictedObjPositions/CreateInPathDataTTM/ToDiag/DIAG_TA_Inpath_PredObjAnBL_TTM"
 /begin SUB_GROUP autosar_swc_aeb_autosar_swc_aeb_Step_sys_Subsystem_Reference_AEB_Function_Run_AsyEvlrCritEve_Step_Func_Run_AsyEvlrCritEve_Step_Func_TAWrapper_PreProcessor_ObjectPreProcessor_ObjectPreProcessorLoop_ValidObject_SafetyMarginFrontObjects_InPathCalculationWithPredictedObjPositions_CreateInPathDataTTM_ToDiag_DIAG_TA_Inpath_PredObjAnBL_TTM_off /end SUB_GROUP
/end GROUP
/begin GROUP autosar_swc_aeb_autosar_swc_aeb_Step_sys_Subsystem_Reference_AEB_Function_Run_AsyEvlrCritEve_Step_Func_Run_AsyEvlrCritEve_Step_Func_TAWrapper_PreProcessor_ObjectPreProcessor_ObjectPreProcessorLoop_ValidObject_SafetyMarginFrontObjects_InPathCalculationWithPredictedObjPositions_CreateInPathDataTTM_ToDiag_DIAG_TA_Inpath_PredObjAnBL_TTM_off "autosar_swc_aeb/autosar_swc_aeb_Step_sys/Subsystem Reference/AEB Function/Run_AsyEvlrCritEve_Step_Func/Run_AsyEvlrCritEve_Step_Func/TAWrapper/PreProcessor/ObjectPreProcessor/ObjectPreProcessorLoop/ValidObject/SafetyMarginFrontObjects/InPathCalculationWithPredictedObjPositions/CreateInPathDataTTM/ToDiag/DIAG_TA_Inpath_PredObjAnBL_TTM/off"
 /begin SUB_GROUP autosar_swc_aeb_autosar_swc_aeb_Step_sys_Subsystem_Reference_AEB_Function_Run_AsyEvlrCritEve_Step_Func_Run_AsyEvlrCritEve_Step_Func_TAWrapper_PreProcessor_ObjectPreProcessor_ObjectPreProcessorLoop_ValidObject_SafetyMarginFrontObjects_InPathCalculationWithPredictedObjPositions_CreateInPathDataTTM_ToDiag_DIAG_TA_Inpath_PredObjAnBL_TTM_off_ALVTerm /end SUB_GROUP
/end GROUP
/begin GROUP autosar_swc_aeb_autosar_swc_aeb_Step_sys_Subsystem_Reference_AEB_Function_Run_AsyEvlrCritEve_Step_Func_Run_AsyEvlrCritEve_Step_Func_TAWrapper_PreProcessor_ObjectPreProcessor_ObjectPreProcessorLoop_ValidObject_SafetyMarginFrontObjects_InPathCalculationWithPredictedObjPositions_CreateInPathDataTTM_ToDiag_DIAG_TA_Inpath_PredObjAnBS_TTM "autosar_swc_aeb/autosar_swc_aeb_Step_sys/Subsystem Reference/AEB Function/Run_AsyEvlrCritEve_Step_Func/Run_AsyEvlrCritEve_Step_Func/TAWrapper/PreProcessor/ObjectPreProcessor/ObjectPreProcessorLoop/ValidObject/SafetyMarginFrontObjects/InPathCalculationWithPredictedObjPositions/CreateInPathDataTTM/ToDiag/DIAG_TA_Inpath_PredObjAnBS_TTM"
 /begin SUB_GROUP autosar_swc_aeb_autosar_swc_aeb_Step_sys_Subsystem_Reference_AEB_Function_Run_AsyEvlrCritEve_Step_Func_Run_AsyEvlrCritEve_Step_Func_TAWrapper_PreProcessor_ObjectPreProcessor_ObjectPreProcessorLoop_ValidObject_SafetyMarginFrontObjects_InPathCalculationWithPredictedObjPositions_CreateInPathDataTTM_ToDiag_DIAG_TA_Inpath_PredObjAnBS_TTM_off /end SUB_GROUP
/end GROUP
/begin GROUP autosar_swc_aeb_autosar_swc_aeb_Step_sys_Subsystem_Reference_AEB_Function_Run_AsyEvlrCritEve_Step_Func_Run_AsyEvlrCritEve_Step_Func_TAWrapper_PreProcessor_ObjectPreProcessor_ObjectPreProcessorLoop_ValidObject_SafetyMarginFrontObjects_InPathCalculationWithPredictedObjPositions_CreateInPathDataTTM_ToDiag_DIAG_TA_Inpath_PredObjAnBS_TTM_off "autosar_swc_aeb/autosar_swc_aeb_Step_sys/Subsystem Reference/AEB Function/Run_AsyEvlrCritEve_Step_Func/Run_AsyEvlrCritEve_Step_Func/TAWrapper/PreProcessor/ObjectPreProcessor/ObjectPreProcessorLoop/ValidObject/SafetyMarginFrontObjects/InPathCalculationWithPredictedObjPositions/CreateInPathDataTTM/ToDiag/DIAG_TA_Inpath_PredObjAnBS_TTM/off"
 /begin SUB_GROUP autosar_swc_aeb_autosar_swc_aeb_Step_sys_Subsystem_Reference_AEB_Function_Run_AsyEvlrCritEve_Step_Func_Run_AsyEvlrCritEve_Step_Func_TAWrapper_PreProcessor_ObjectPreProcessor_ObjectPreProcessorLoop_ValidObject_SafetyMarginFrontObjects_InPathCalculationWithPredictedObjPositions_CreateInPathDataTTM_ToDiag_DIAG_TA_Inpath_PredObjAnBS_TTM_off_ALVTerm /end SUB_GROUP
/end GROUP
/begin GROUP autosar_swc_aeb_autosar_swc_aeb_Step_sys_Subsystem_Reference_AEB_Function_Run_AsyEvlrCritEve_Step_Func_Run_AsyEvlrCritEve_Step_Func_TAWrapper_PreProcessor_ObjectPreProcessor_ObjectPreProcessorLoop_ValidObject_SafetyMarginFrontObjects_InPathCalculationWithPredictedObjPositions_CreateInPathDataTTM_ToDiag_DIAG_TA_Inpath_PredObjAn_Le_TTM "autosar_swc_aeb/autosar_swc_aeb_Step_sys/Subsystem Reference/AEB Function/Run_AsyEvlrCritEve_Step_Func/Run_AsyEvlrCritEve_Step_Func/TAWrapper/PreProcessor/ObjectPreProcessor/ObjectPreProcessorLoop/ValidObject/SafetyMarginFrontObjects/InPathCalculationWithPredictedObjPositions/CreateInPathDataTTM/ToDiag/DIAG_TA_Inpath_PredObjAn_Le_TTM"
 /begin SUB_GROUP autosar_swc_aeb_autosar_swc_aeb_Step_sys_Subsystem_Reference_AEB_Function_Run_AsyEvlrCritEve_Step_Func_Run_AsyEvlrCritEve_Step_Func_TAWrapper_PreProcessor_ObjectPreProcessor_ObjectPreProcessorLoop_ValidObject_SafetyMarginFrontObjects_InPathCalculationWithPredictedObjPositions_CreateInPathDataTTM_ToDiag_DIAG_TA_Inpath_PredObjAn_Le_TTM_off /end SUB_GROUP
/end GROUP
/begin GROUP autosar_swc_aeb_autosar_swc_aeb_Step_sys_Subsystem_Reference_AEB_Function_Run_AsyEvlrCritEve_Step_Func_Run_AsyEvlrCritEve_Step_Func_TAWrapper_PreProcessor_ObjectPreProcessor_ObjectPreProcessorLoop_ValidObject_SafetyMarginFrontObjects_InPathCalculationWithPredictedObjPositions_CreateInPathDataTTM_ToDiag_DIAG_TA_Inpath_PredObjAn_Le_TTM_off "autosar_swc_aeb/autosar_swc_aeb_Step_sys/Subsystem Reference/AEB Function/Run_AsyEvlrCritEve_Step_Func/Run_AsyEvlrCritEve_Step_Func/TAWrapper/PreProcessor/ObjectPreProcessor/ObjectPreProcessorLoop/ValidObject/SafetyMarginFrontObjects/InPathCalculationWithPredictedObjPositions/CreateInPathDataTTM/ToDiag/DIAG_TA_Inpath_PredObjAn_Le_TTM/off"
 /begin SUB_GROUP autosar_swc_aeb_autosar_swc_aeb_Step_sys_Subsystem_Reference_AEB_Function_Run_AsyEvlrCritEve_Step_Func_Run_AsyEvlrCritEve_Step_Func_TAWrapper_PreProcessor_ObjectPreProcessor_ObjectPreProcessorLoop_ValidObject_SafetyMarginFrontObjects_InPathCalculationWithPredictedObjPositions_CreateInPathDataTTM_ToDiag_DIAG_TA_Inpath_PredObjAn_Le_TTM_off_ALVTerm /end SUB_GROUP
/end GROUP
/begin GROUP autosar_swc_aeb_autosar_swc_aeb_Step_sys_Subsystem_Reference_AEB_Function_Run_AsyEvlrCritEve_Step_Func_Run_AsyEvlrCritEve_Step_Func_TAWrapper_PreProcessor_ObjectPreProcessor_ObjectPreProcessorLoop_ValidObject_SafetyMarginFrontObjects_InPathCalculationWithPredictedObjPositions_CreateInPathDataTTM_ToDiag_DIAG_TA_Inpath_PredObjAn_Ri_TTM "autosar_swc_aeb/autosar_swc_aeb_Step_sys/Subsystem Reference/AEB Function/Run_AsyEvlrCritEve_Step_Func/Run_AsyEvlrCritEve_Step_Func/TAWrapper/PreProcessor/ObjectPreProcessor/ObjectPreProcessorLoop/ValidObject/SafetyMarginFrontObjects/InPathCalculationWithPredictedObjPositions/CreateInPathDataTTM/ToDiag/DIAG_TA_Inpath_PredObjAn_Ri_TTM"
 /begin SUB_GROUP autosar_swc_aeb_autosar_swc_aeb_Step_sys_Subsystem_Reference_AEB_Function_Run_AsyEvlrCritEve_Step_Func_Run_AsyEvlrCritEve_Step_Func_TAWrapper_PreProcessor_ObjectPreProcessor_ObjectPreProcessorLoop_ValidObject_SafetyMarginFrontObjects_InPathCalculationWithPredictedObjPositions_CreateInPathDataTTM_ToDiag_DIAG_TA_Inpath_PredObjAn_Ri_TTM_off /end SUB_GROUP
/end GROUP
/begin GROUP autosar_swc_aeb_autosar_swc_aeb_Step_sys_Subsystem_Reference_AEB_Function_Run_AsyEvlrCritEve_Step_Func_Run_AsyEvlrCritEve_Step_Func_TAWrapper_PreProcessor_ObjectPreProcessor_ObjectPreProcessorLoop_ValidObject_SafetyMarginFrontObjects_InPathCalculationWithPredictedObjPositions_CreateInPathDataTTM_ToDiag_DIAG_TA_Inpath_PredObjAn_Ri_TTM_off "autosar_swc_aeb/autosar_swc_aeb_Step_sys/Subsystem Reference/AEB Function/Run_AsyEvlrCritEve_Step_Func/Run_AsyEvlrCritEve_Step_Func/TAWrapper/PreProcessor/ObjectPreProcessor/ObjectPreProcessorLoop/ValidObject/SafetyMarginFrontObjects/InPathCalculationWithPredictedObjPositions/CreateInPathDataTTM/ToDiag/DIAG_TA_Inpath_PredObjAn_Ri_TTM/off"
 /begin SUB_GROUP autosar_swc_aeb_autosar_swc_aeb_Step_sys_Subsystem_Reference_AEB_Function_Run_AsyEvlrCritEve_Step_Func_Run_AsyEvlrCritEve_Step_Func_TAWrapper_PreProcessor_ObjectPreProcessor_ObjectPreProcessorLoop_ValidObject_SafetyMarginFrontObjects_InPathCalculationWithPredictedObjPositions_CreateInPathDataTTM_ToDiag_DIAG_TA_Inpath_PredObjAn_Ri_TTM_off_ALVTerm /end SUB_GROUP
/end GROUP
/begin GROUP autosar_swc_aeb_autosar_swc_aeb_Step_sys_Subsystem_Reference_AEB_Function_Run_AsyEvlrCritEve_Step_Func_Run_AsyEvlrCritEve_Step_Func_TAWrapper_PreProcessor_ObjectPreProcessor_ObjectPreProcessorLoop_ValidObject_SafetyMarginFrontObjects_InPathCalculationWithPredictedObjPositions_CreateInPathDataTTM_ToDiag_DIAG_TA_Inpath_PredObjAn_TTM "autosar_swc_aeb/autosar_swc_aeb_Step_sys/Subsystem Reference/AEB Function/Run_AsyEvlrCritEve_Step_Func/Run_AsyEvlrCritEve_Step_Func/TAWrapper/PreProcessor/ObjectPreProcessor/ObjectPreProcessorLoop/ValidObject/SafetyMarginFrontObjects/InPathCalculationWithPredictedObjPositions/CreateInPathDataTTM/ToDiag/DIAG_TA_Inpath_PredObjAn_TTM"
 /begin SUB_GROUP autosar_swc_aeb_autosar_swc_aeb_Step_sys_Subsystem_Reference_AEB_Function_Run_AsyEvlrCritEve_Step_Func_Run_AsyEvlrCritEve_Step_Func_TAWrapper_PreProcessor_ObjectPreProcessor_ObjectPreProcessorLoop_ValidObject_SafetyMarginFrontObjects_InPathCalculationWithPredictedObjPositions_CreateInPathDataTTM_ToDiag_DIAG_TA_Inpath_PredObjAn_TTM_off /end SUB_GROUP
/end GROUP
/begin GROUP autosar_swc_aeb_autosar_swc_aeb_Step_sys_Subsystem_Reference_AEB_Function_Run_AsyEvlrCritEve_Step_Func_Run_AsyEvlrCritEve_Step_Func_TAWrapper_PreProcessor_ObjectPreProcessor_ObjectPreProcessorLoop_ValidObject_SafetyMarginFrontObjects_InPathCalculationWithPredictedObjPositions_CreateInPathDataTTM_ToDiag_DIAG_TA_Inpath_PredObjAn_TTM_off "autosar_swc_aeb/autosar_swc_aeb_Step_sys/Subsystem Reference/AEB Function/Run_AsyEvlrCritEve_Step_Func/Run_AsyEvlrCritEve_Step_Func/TAWrapper/PreProcessor/ObjectPreProcessor/ObjectPreProcessorLoop/ValidObject/SafetyMarginFrontObjects/InPathCalculationWithPredictedObjPositions/CreateInPathDataTTM/ToDiag/DIAG_TA_Inpath_PredObjAn_TTM/off"
 /begin SUB_GROUP autosar_swc_aeb_autosar_swc_aeb_Step_sys_Subsystem_Reference_AEB_Function_Run_AsyEvlrCritEve_Step_Func_Run_AsyEvlrCritEve_Step_Func_TAWrapper_PreProcessor_ObjectPreProcessor_ObjectPreProcessorLoop_ValidObject_SafetyMarginFrontObjects_InPathCalculationWithPredictedObjPositions_CreateInPathDataTTM_ToDiag_DIAG_TA_Inpath_PredObjAn_TTM_off_ALVTerm /end SUB_GROUP
/end GROUP
/begin GROUP autosar_swc_aeb_autosar_swc_aeb_Step_sys_Subsystem_Reference_AEB_Function_Run_AsyEvlrCritEve_Step_Func_Run_AsyEvlrCritEve_Step_Func_TAWrapper_PreProcessor_ObjectPreProcessor_ObjectPreProcessorLoop_ValidObject_SafetyMarginFrontObjects_InPathCalculationWithPredictedObjPositions_CreateInPathDataTTM_ToDiag_DIAG_TA_Inpath_PredObjAn_TTM_off_ALVTerm "autosar_swc_aeb/autosar_swc_aeb_Step_sys/Subsystem Reference/AEB Function/Run_AsyEvlrCritEve_Step_Func/Run_AsyEvlrCritEve_Step_Func/TAWrapper/PreProcessor/ObjectPreProcessor/ObjectPreProcessorLoop/ValidObject/SafetyMarginFrontObjects/InPathCalculationWithPredictedObjPositions/CreateInPathDataTTM/ToDiag/DIAG_TA_Inpath_PredObjAn_TTM/off/ALVTerm" /begin REF_MEASUREMENT autosar_swc_aeb_rtARID_DEF.HeadingObj_m /end REF_MEASUREMENT /end GROUP
/begin GROUP autosar_swc_aeb_autosar_swc_aeb_Step_sys_Subsystem_Reference_AEB_Function_Run_AsyEvlrCritEve_Step_Func_Run_AsyEvlrCritEve_Step_Func_TAWrapper_PreProcessor_ObjectPreProcessor_ObjectPreProcessorLoop_ValidObject_SafetyMarginFrontObjects_InPathCalculationWithPredictedObjPositions_CreateInPathDataTTM_ToDiag_DIAG_TA_Inpath_PredObjLatBL_TTM "autosar_swc_aeb/autosar_swc_aeb_Step_sys/Subsystem Reference/AEB Function/Run_AsyEvlrCritEve_Step_Func/Run_AsyEvlrCritEve_Step_Func/TAWrapper/PreProcessor/ObjectPreProcessor/ObjectPreProcessorLoop/ValidObject/SafetyMarginFrontObjects/InPathCalculationWithPredictedObjPositions/CreateInPathDataTTM/ToDiag/DIAG_TA_Inpath_PredObjLatBL_TTM"
 /begin SUB_GROUP autosar_swc_aeb_autosar_swc_aeb_Step_sys_Subsystem_Reference_AEB_Function_Run_AsyEvlrCritEve_Step_Func_Run_AsyEvlrCritEve_Step_Func_TAWrapper_PreProcessor_ObjectPreProcessor_ObjectPreProcessorLoop_ValidObject_SafetyMarginFrontObjects_InPathCalculationWithPredictedObjPositions_CreateInPathDataTTM_ToDiag_DIAG_TA_Inpath_PredObjLatBL_TTM_off /end SUB_GROUP
/end GROUP
/begin GROUP autosar_swc_aeb_autosar_swc_aeb_Step_sys_Subsystem_Reference_AEB_Function_Run_AsyEvlrCritEve_Step_Func_Run_AsyEvlrCritEve_Step_Func_TAWrapper_PreProcessor_ObjectPreProcessor_ObjectPreProcessorLoop_ValidObject_SafetyMarginFrontObjects_InPathCalculationWithPredictedObjPositions_CreateInPathDataTTM_ToDiag_DIAG_TA_Inpath_PredObjLatBL_TTM_off "autosar_swc_aeb/autosar_swc_aeb_Step_sys/Subsystem Reference/AEB Function/Run_AsyEvlrCritEve_Step_Func/Run_AsyEvlrCritEve_Step_Func/TAWrapper/PreProcessor/ObjectPreProcessor/ObjectPreProcessorLoop/ValidObject/SafetyMarginFrontObjects/InPathCalculationWithPredictedObjPositions/CreateInPathDataTTM/ToDiag/DIAG_TA_Inpath_PredObjLatBL_TTM/off"
 /begin SUB_GROUP autosar_swc_aeb_autosar_swc_aeb_Step_sys_Subsystem_Reference_AEB_Function_Run_AsyEvlrCritEve_Step_Func_Run_AsyEvlrCritEve_Step_Func_TAWrapper_PreProcessor_ObjectPreProcessor_ObjectPreProcessorLoop_ValidObject_SafetyMarginFrontObjects_InPathCalculationWithPredictedObjPositions_CreateInPathDataTTM_ToDiag_DIAG_TA_Inpath_PredObjLatBL_TTM_off_ALVTerm /end SUB_GROUP
/end GROUP
/begin GROUP autosar_swc_aeb_autosar_swc_aeb_Step_sys_Subsystem_Reference_AEB_Function_Run_AsyEvlrCritEve_Step_Func_Run_AsyEvlrCritEve_Step_Func_TAWrapper_PreProcessor_ObjectPreProcessor_ObjectPreProcessorLoop_ValidObject_SafetyMarginFrontObjects_InPathCalculationWithPredictedObjPositions_CreateInPathDataTTM_ToDiag_DIAG_TA_Inpath_PredObjLatBS_TTM "autosar_swc_aeb/autosar_swc_aeb_Step_sys/Subsystem Reference/AEB Function/Run_AsyEvlrCritEve_Step_Func/Run_AsyEvlrCritEve_Step_Func/TAWrapper/PreProcessor/ObjectPreProcessor/ObjectPreProcessorLoop/ValidObject/SafetyMarginFrontObjects/InPathCalculationWithPredictedObjPositions/CreateInPathDataTTM/ToDiag/DIAG_TA_Inpath_PredObjLatBS_TTM"
 /begin SUB_GROUP autosar_swc_aeb_autosar_swc_aeb_Step_sys_Subsystem_Reference_AEB_Function_Run_AsyEvlrCritEve_Step_Func_Run_AsyEvlrCritEve_Step_Func_TAWrapper_PreProcessor_ObjectPreProcessor_ObjectPreProcessorLoop_ValidObject_SafetyMarginFrontObjects_InPathCalculationWithPredictedObjPositions_CreateInPathDataTTM_ToDiag_DIAG_TA_Inpath_PredObjLatBS_TTM_off /end SUB_GROUP
/end GROUP
/begin GROUP autosar_swc_aeb_autosar_swc_aeb_Step_sys_Subsystem_Reference_AEB_Function_Run_AsyEvlrCritEve_Step_Func_Run_AsyEvlrCritEve_Step_Func_TAWrapper_PreProcessor_ObjectPreProcessor_ObjectPreProcessorLoop_ValidObject_SafetyMarginFrontObjects_InPathCalculationWithPredictedObjPositions_CreateInPathDataTTM_ToDiag_DIAG_TA_Inpath_PredObjLatBS_TTM_off "autosar_swc_aeb/autosar_swc_aeb_Step_sys/Subsystem Reference/AEB Function/Run_AsyEvlrCritEve_Step_Func/Run_AsyEvlrCritEve_Step_Func/TAWrapper/PreProcessor/ObjectPreProcessor/ObjectPreProcessorLoop/ValidObject/SafetyMarginFrontObjects/InPathCalculationWithPredictedObjPositions/CreateInPathDataTTM/ToDiag/DIAG_TA_Inpath_PredObjLatBS_TTM/off"
 /begin SUB_GROUP autosar_swc_aeb_autosar_swc_aeb_Step_sys_Subsystem_Reference_AEB_Function_Run_AsyEvlrCritEve_Step_Func_Run_AsyEvlrCritEve_Step_Func_TAWrapper_PreProcessor_ObjectPreProcessor_ObjectPreProcessorLoop_ValidObject_SafetyMarginFrontObjects_InPathCalculationWithPredictedObjPositions_CreateInPathDataTTM_ToDiag_DIAG_TA_Inpath_PredObjLatBS_TTM_off_ALVTerm /end SUB_GROUP
/end GROUP
/begin GROUP autosar_swc_aeb_autosar_swc_aeb_Step_sys_Subsystem_Reference_AEB_Function_Run_AsyEvlrCritEve_Step_Func_Run_AsyEvlrCritEve_Step_Func_TAWrapper_PreProcessor_ObjectPreProcessor_ObjectPreProcessorLoop_ValidObject_SafetyMarginFrontObjects_InPathCalculationWithPredictedObjPositions_CreateInPathDataTTM_ToDiag_DIAG_TA_Inpath_PredObjLat_Le_TTM "autosar_swc_aeb/autosar_swc_aeb_Step_sys/Subsystem Reference/AEB Function/Run_AsyEvlrCritEve_Step_Func/Run_AsyEvlrCritEve_Step_Func/TAWrapper/PreProcessor/ObjectPreProcessor/ObjectPreProcessorLoop/ValidObject/SafetyMarginFrontObjects/InPathCalculationWithPredictedObjPositions/CreateInPathDataTTM/ToDiag/DIAG_TA_Inpath_PredObjLat_Le_TTM"
 /begin SUB_GROUP autosar_swc_aeb_autosar_swc_aeb_Step_sys_Subsystem_Reference_AEB_Function_Run_AsyEvlrCritEve_Step_Func_Run_AsyEvlrCritEve_Step_Func_TAWrapper_PreProcessor_ObjectPreProcessor_ObjectPreProcessorLoop_ValidObject_SafetyMarginFrontObjects_InPathCalculationWithPredictedObjPositions_CreateInPathDataTTM_ToDiag_DIAG_TA_Inpath_PredObjLat_Le_TTM_off /end SUB_GROUP
/end GROUP
/begin GROUP autosar_swc_aeb_autosar_swc_aeb_Step_sys_Subsystem_Reference_AEB_Function_Run_AsyEvlrCritEve_Step_Func_Run_AsyEvlrCritEve_Step_Func_TAWrapper_PreProcessor_ObjectPreProcessor_ObjectPreProcessorLoop_ValidObject_SafetyMarginFrontObjects_InPathCalculationWithPredictedObjPositions_CreateInPathDataTTM_ToDiag_DIAG_TA_Inpath_PredObjLat_Le_TTM_off "autosar_swc_aeb/autosar_swc_aeb_Step_sys/Subsystem Reference/AEB Function/Run_AsyEvlrCritEve_Step_Func/Run_AsyEvlrCritEve_Step_Func/TAWrapper/PreProcessor/ObjectPreProcessor/ObjectPreProcessorLoop/ValidObject/SafetyMarginFrontObjects/InPathCalculationWithPredictedObjPositions/CreateInPathDataTTM/ToDiag/DIAG_TA_Inpath_PredObjLat_Le_TTM/off"
 /begin SUB_GROUP autosar_swc_aeb_autosar_swc_aeb_Step_sys_Subsystem_Reference_AEB_Function_Run_AsyEvlrCritEve_Step_Func_Run_AsyEvlrCritEve_Step_Func_TAWrapper_PreProcessor_ObjectPreProcessor_ObjectPreProcessorLoop_ValidObject_SafetyMarginFrontObjects_InPathCalculationWithPredictedObjPositions_CreateInPathDataTTM_ToDiag_DIAG_TA_Inpath_PredObjLat_Le_TTM_off_ALVTerm /end SUB_GROUP
/end GROUP
/begin GROUP autosar_swc_aeb_autosar_swc_aeb_Step_sys_Subsystem_Reference_AEB_Function_Run_AsyEvlrCritEve_Step_Func_Run_AsyEvlrCritEve_Step_Func_TAWrapper_PreProcessor_ObjectPreProcessor_ObjectPreProcessorLoop_ValidObject_SafetyMarginFrontObjects_InPathCalculationWithPredictedObjPositions_CreateInPathDataTTM_ToDiag_DIAG_TA_Inpath_PredObjLat_Le_TTM_off_ALVTerm "autosar_swc_aeb/autosar_swc_aeb_Step_sys/Subsystem Reference/AEB Function/Run_AsyEvlrCritEve_Step_Func/Run_AsyEvlrCritEve_Step_Func/TAWrapper/PreProcessor/ObjectPreProcessor/ObjectPreProcessorLoop/ValidObject/SafetyMarginFrontObjects/InPathCalculationWithPredictedObjPositions/CreateInPathDataTTM/ToDiag/DIAG_TA_Inpath_PredObjLat_Le_TTM/off/ALVTerm" /begin REF_MEASUREMENT autosar_swc_aeb_rtARID_DEF.PosnLatObj_p3h /end REF_MEASUREMENT /end GROUP
/begin GROUP autosar_swc_aeb_autosar_swc_aeb_Step_sys_Subsystem_Reference_AEB_Function_Run_AsyEvlrCritEve_Step_Func_Run_AsyEvlrCritEve_Step_Func_TAWrapper_PreProcessor_ObjectPreProcessor_ObjectPreProcessorLoop_ValidObject_SafetyMarginFrontObjects_InPathCalculationWithPredictedObjPositions_CreateInPathDataTTM_ToDiag_DIAG_TA_Inpath_PredObjLat_Ri_TTM "autosar_swc_aeb/autosar_swc_aeb_Step_sys/Subsystem Reference/AEB Function/Run_AsyEvlrCritEve_Step_Func/Run_AsyEvlrCritEve_Step_Func/TAWrapper/PreProcessor/ObjectPreProcessor/ObjectPreProcessorLoop/ValidObject/SafetyMarginFrontObjects/InPathCalculationWithPredictedObjPositions/CreateInPathDataTTM/ToDiag/DIAG_TA_Inpath_PredObjLat_Ri_TTM"
 /begin SUB_GROUP autosar_swc_aeb_autosar_swc_aeb_Step_sys_Subsystem_Reference_AEB_Function_Run_AsyEvlrCritEve_Step_Func_Run_AsyEvlrCritEve_Step_Func_TAWrapper_PreProcessor_ObjectPreProcessor_ObjectPreProcessorLoop_ValidObject_SafetyMarginFrontObjects_InPathCalculationWithPredictedObjPositions_CreateInPathDataTTM_ToDiag_DIAG_TA_Inpath_PredObjLat_Ri_TTM_off /end SUB_GROUP
/end GROUP
/begin GROUP autosar_swc_aeb_autosar_swc_aeb_Step_sys_Subsystem_Reference_AEB_Function_Run_AsyEvlrCritEve_Step_Func_Run_AsyEvlrCritEve_Step_Func_TAWrapper_PreProcessor_ObjectPreProcessor_ObjectPreProcessorLoop_ValidObject_SafetyMarginFrontObjects_InPathCalculationWithPredictedObjPositions_CreateInPathDataTTM_ToDiag_DIAG_TA_Inpath_PredObjLat_Ri_TTM_off "autosar_swc_aeb/autosar_swc_aeb_Step_sys/Subsystem Reference/AEB Function/Run_AsyEvlrCritEve_Step_Func/Run_AsyEvlrCritEve_Step_Func/TAWrapper/PreProcessor/ObjectPreProcessor/ObjectPreProcessorLoop/ValidObject/SafetyMarginFrontObjects/InPathCalculationWithPredictedObjPositions/CreateInPathDataTTM/ToDiag/DIAG_TA_Inpath_PredObjLat_Ri_TTM/off"
 /begin SUB_GROUP autosar_swc_aeb_autosar_swc_aeb_Step_sys_Subsystem_Reference_AEB_Function_Run_AsyEvlrCritEve_Step_Func_Run_AsyEvlrCritEve_Step_Func_TAWrapper_PreProcessor_ObjectPreProcessor_ObjectPreProcessorLoop_ValidObject_SafetyMarginFrontObjects_InPathCalculationWithPredictedObjPositions_CreateInPathDataTTM_ToDiag_DIAG_TA_Inpath_PredObjLat_Ri_TTM_off_ALVTerm /end SUB_GROUP
/end GROUP
/begin GROUP autosar_swc_aeb_autosar_swc_aeb_Step_sys_Subsystem_Reference_AEB_Function_Run_AsyEvlrCritEve_Step_Func_Run_AsyEvlrCritEve_Step_Func_TAWrapper_PreProcessor_ObjectPreProcessor_ObjectPreProcessorLoop_ValidObject_SafetyMarginFrontObjects_InPathCalculationWithPredictedObjPositions_CreateInPathDataTTM_ToDiag_DIAG_TA_Inpath_PredObjLat_TTM "autosar_swc_aeb/autosar_swc_aeb_Step_sys/Subsystem Reference/AEB Function/Run_AsyEvlrCritEve_Step_Func/Run_AsyEvlrCritEve_Step_Func/TAWrapper/PreProcessor/ObjectPreProcessor/ObjectPreProcessorLoop/ValidObject/SafetyMarginFrontObjects/InPathCalculationWithPredictedObjPositions/CreateInPathDataTTM/ToDiag/DIAG_TA_Inpath_PredObjLat_TTM"
 /begin SUB_GROUP autosar_swc_aeb_autosar_swc_aeb_Step_sys_Subsystem_Reference_AEB_Function_Run_AsyEvlrCritEve_Step_Func_Run_AsyEvlrCritEve_Step_Func_TAWrapper_PreProcessor_ObjectPreProcessor_ObjectPreProcessorLoop_ValidObject_SafetyMarginFrontObjects_InPathCalculationWithPredictedObjPositions_CreateInPathDataTTM_ToDiag_DIAG_TA_Inpath_PredObjLat_TTM_off /end SUB_GROUP
/end GROUP
/begin GROUP autosar_swc_aeb_autosar_swc_aeb_Step_sys_Subsystem_Reference_AEB_Function_Run_AsyEvlrCritEve_Step_Func_Run_AsyEvlrCritEve_Step_Func_TAWrapper_PreProcessor_ObjectPreProcessor_ObjectPreProcessorLoop_ValidObject_SafetyMarginFrontObjects_InPathCalculationWithPredictedObjPositions_CreateInPathDataTTM_ToDiag_DIAG_TA_Inpath_PredObjLat_TTM_off "autosar_swc_aeb/autosar_swc_aeb_Step_sys/Subsystem Reference/AEB Function/Run_AsyEvlrCritEve_Step_Func/Run_AsyEvlrCritEve_Step_Func/TAWrapper/PreProcessor/ObjectPreProcessor/ObjectPreProcessorLoop/ValidObject/SafetyMarginFrontObjects/InPathCalculationWithPredictedObjPositions/CreateInPathDataTTM/ToDiag/DIAG_TA_Inpath_PredObjLat_TTM/off"
 /begin SUB_GROUP autosar_swc_aeb_autosar_swc_aeb_Step_sys_Subsystem_Reference_AEB_Function_Run_AsyEvlrCritEve_Step_Func_Run_AsyEvlrCritEve_Step_Func_TAWrapper_PreProcessor_ObjectPreProcessor_ObjectPreProcessorLoop_ValidObject_SafetyMarginFrontObjects_InPathCalculationWithPredictedObjPositions_CreateInPathDataTTM_ToDiag_DIAG_TA_Inpath_PredObjLat_TTM_off_ALVTerm /end SUB_GROUP
/end GROUP
/begin GROUP autosar_swc_aeb_autosar_swc_aeb_Step_sys_Subsystem_Reference_AEB_Function_Run_AsyEvlrCritEve_Step_Func_Run_AsyEvlrCritEve_Step_Func_TAWrapper_PreProcessor_ObjectPreProcessor_ObjectPreProcessorLoop_ValidObject_SafetyMarginFrontObjects_InPathCalculationWithPredictedObjPositions_CreateInPathDataTTM_ToDiag_DIAG_TA_Inpath_PredObjLat_TTM_off_ALVTerm "autosar_swc_aeb/autosar_swc_aeb_Step_sys/Subsystem Reference/AEB Function/Run_AsyEvlrCritEve_Step_Func/Run_AsyEvlrCritEve_Step_Func/TAWrapper/PreProcessor/ObjectPreProcessor/ObjectPreProcessorLoop/ValidObject/SafetyMarginFrontObjects/InPathCalculationWithPredictedObjPositions/CreateInPathDataTTM/ToDiag/DIAG_TA_Inpath_PredObjLat_TTM/off/ALVTerm" /begin REF_MEASUREMENT autosar_swc_aeb_rtARID_DEF.PosnLatObj_p /end REF_MEASUREMENT /end GROUP
/begin GROUP autosar_swc_aeb_autosar_swc_aeb_Step_sys_Subsystem_Reference_AEB_Function_Run_AsyEvlrCritEve_Step_Func_Run_AsyEvlrCritEve_Step_Func_TAWrapper_PreProcessor_ObjectPreProcessor_ObjectPreProcessorLoop_ValidObject_SafetyMarginFrontObjects_InPathCalculationWithPredictedObjPositions_CreateInPathDataTTM_ToDiag_DIAG_TA_Inpath_PredObjLgtBS_TTM "autosar_swc_aeb/autosar_swc_aeb_Step_sys/Subsystem Reference/AEB Function/Run_AsyEvlrCritEve_Step_Func/Run_AsyEvlrCritEve_Step_Func/TAWrapper/PreProcessor/ObjectPreProcessor/ObjectPreProcessorLoop/ValidObject/SafetyMarginFrontObjects/InPathCalculationWithPredictedObjPositions/CreateInPathDataTTM/ToDiag/DIAG_TA_Inpath_PredObjLgtBS_TTM"
 /begin SUB_GROUP autosar_swc_aeb_autosar_swc_aeb_Step_sys_Subsystem_Reference_AEB_Function_Run_AsyEvlrCritEve_Step_Func_Run_AsyEvlrCritEve_Step_Func_TAWrapper_PreProcessor_ObjectPreProcessor_ObjectPreProcessorLoop_ValidObject_SafetyMarginFrontObjects_InPathCalculationWithPredictedObjPositions_CreateInPathDataTTM_ToDiag_DIAG_TA_Inpath_PredObjLgtBS_TTM_off /end SUB_GROUP
/end GROUP
/begin GROUP autosar_swc_aeb_autosar_swc_aeb_Step_sys_Subsystem_Reference_AEB_Function_Run_AsyEvlrCritEve_Step_Func_Run_AsyEvlrCritEve_Step_Func_TAWrapper_PreProcessor_ObjectPreProcessor_ObjectPreProcessorLoop_ValidObject_SafetyMarginFrontObjects_InPathCalculationWithPredictedObjPositions_CreateInPathDataTTM_ToDiag_DIAG_TA_Inpath_PredObjLgtBS_TTM_off "autosar_swc_aeb/autosar_swc_aeb_Step_sys/Subsystem Reference/AEB Function/Run_AsyEvlrCritEve_Step_Func/Run_AsyEvlrCritEve_Step_Func/TAWrapper/PreProcessor/ObjectPreProcessor/ObjectPreProcessorLoop/ValidObject/SafetyMarginFrontObjects/InPathCalculationWithPredictedObjPositions/CreateInPathDataTTM/ToDiag/DIAG_TA_Inpath_PredObjLgtBS_TTM/off"
 /begin SUB_GROUP autosar_swc_aeb_autosar_swc_aeb_Step_sys_Subsystem_Reference_AEB_Function_Run_AsyEvlrCritEve_Step_Func_Run_AsyEvlrCritEve_Step_Func_TAWrapper_PreProcessor_ObjectPreProcessor_ObjectPreProcessorLoop_ValidObject_SafetyMarginFrontObjects_InPathCalculationWithPredictedObjPositions_CreateInPathDataTTM_ToDiag_DIAG_TA_Inpath_PredObjLgtBS_TTM_off_ALVTerm /end SUB_GROUP
/end GROUP
/begin GROUP autosar_swc_aeb_autosar_swc_aeb_Step_sys_Subsystem_Reference_AEB_Function_Run_AsyEvlrCritEve_Step_Func_Run_AsyEvlrCritEve_Step_Func_TAWrapper_PreProcessor_ObjectPreProcessor_ObjectPreProcessorLoop_ValidObject_SafetyMarginFrontObjects_InPathCalculationWithPredictedObjPositions_CreateInPathDataTTM_ToDiag_DIAG_TA_Inpath_PredObjLgt_BL_TTM "autosar_swc_aeb/autosar_swc_aeb_Step_sys/Subsystem Reference/AEB Function/Run_AsyEvlrCritEve_Step_Func/Run_AsyEvlrCritEve_Step_Func/TAWrapper/PreProcessor/ObjectPreProcessor/ObjectPreProcessorLoop/ValidObject/SafetyMarginFrontObjects/InPathCalculationWithPredictedObjPositions/CreateInPathDataTTM/ToDiag/DIAG_TA_Inpath_PredObjLgt_BL_TTM"
 /begin SUB_GROUP autosar_swc_aeb_autosar_swc_aeb_Step_sys_Subsystem_Reference_AEB_Function_Run_AsyEvlrCritEve_Step_Func_Run_AsyEvlrCritEve_Step_Func_TAWrapper_PreProcessor_ObjectPreProcessor_ObjectPreProcessorLoop_ValidObject_SafetyMarginFrontObjects_InPathCalculationWithPredictedObjPositions_CreateInPathDataTTM_ToDiag_DIAG_TA_Inpath_PredObjLgt_BL_TTM_off /end SUB_GROUP
/end GROUP
/begin GROUP autosar_swc_aeb_autosar_swc_aeb_Step_sys_Subsystem_Reference_AEB_Function_Run_AsyEvlrCritEve_Step_Func_Run_AsyEvlrCritEve_Step_Func_TAWrapper_PreProcessor_ObjectPreProcessor_ObjectPreProcessorLoop_ValidObject_SafetyMarginFrontObjects_InPathCalculationWithPredictedObjPositions_CreateInPathDataTTM_ToDiag_DIAG_TA_Inpath_PredObjLgt_BL_TTM_off "autosar_swc_aeb/autosar_swc_aeb_Step_sys/Subsystem Reference/AEB Function/Run_AsyEvlrCritEve_Step_Func/Run_AsyEvlrCritEve_Step_Func/TAWrapper/PreProcessor/ObjectPreProcessor/ObjectPreProcessorLoop/ValidObject/SafetyMarginFrontObjects/InPathCalculationWithPredictedObjPositions/CreateInPathDataTTM/ToDiag/DIAG_TA_Inpath_PredObjLgt_BL_TTM/off"
 /begin SUB_GROUP autosar_swc_aeb_autosar_swc_aeb_Step_sys_Subsystem_Reference_AEB_Function_Run_AsyEvlrCritEve_Step_Func_Run_AsyEvlrCritEve_Step_Func_TAWrapper_PreProcessor_ObjectPreProcessor_ObjectPreProcessorLoop_ValidObject_SafetyMarginFrontObjects_InPathCalculationWithPredictedObjPositions_CreateInPathDataTTM_ToDiag_DIAG_TA_Inpath_PredObjLgt_BL_TTM_off_ALVTerm /end SUB_GROUP
/end GROUP
/begin GROUP autosar_swc_aeb_autosar_swc_aeb_Step_sys_Subsystem_Reference_AEB_Function_Run_AsyEvlrCritEve_Step_Func_Run_AsyEvlrCritEve_Step_Func_TAWrapper_PreProcessor_ObjectPreProcessor_ObjectPreProcessorLoop_ValidObject_SafetyMarginFrontObjects_InPathCalculationWithPredictedObjPositions_CreateInPathDataTTM_ToDiag_DIAG_TA_Inpath_PredObjLgt_Le_TTM "autosar_swc_aeb/autosar_swc_aeb_Step_sys/Subsystem Reference/AEB Function/Run_AsyEvlrCritEve_Step_Func/Run_AsyEvlrCritEve_Step_Func/TAWrapper/PreProcessor/ObjectPreProcessor/ObjectPreProcessorLoop/ValidObject/SafetyMarginFrontObjects/InPathCalculationWithPredictedObjPositions/CreateInPathDataTTM/ToDiag/DIAG_TA_Inpath_PredObjLgt_Le_TTM"
 /begin SUB_GROUP autosar_swc_aeb_autosar_swc_aeb_Step_sys_Subsystem_Reference_AEB_Function_Run_AsyEvlrCritEve_Step_Func_Run_AsyEvlrCritEve_Step_Func_TAWrapper_PreProcessor_ObjectPreProcessor_ObjectPreProcessorLoop_ValidObject_SafetyMarginFrontObjects_InPathCalculationWithPredictedObjPositions_CreateInPathDataTTM_ToDiag_DIAG_TA_Inpath_PredObjLgt_Le_TTM_off /end SUB_GROUP
/end GROUP
/begin GROUP autosar_swc_aeb_autosar_swc_aeb_Step_sys_Subsystem_Reference_AEB_Function_Run_AsyEvlrCritEve_Step_Func_Run_AsyEvlrCritEve_Step_Func_TAWrapper_PreProcessor_ObjectPreProcessor_ObjectPreProcessorLoop_ValidObject_SafetyMarginFrontObjects_InPathCalculationWithPredictedObjPositions_CreateInPathDataTTM_ToDiag_DIAG_TA_Inpath_PredObjLgt_Le_TTM_off "autosar_swc_aeb/autosar_swc_aeb_Step_sys/Subsystem Reference/AEB Function/Run_AsyEvlrCritEve_Step_Func/Run_AsyEvlrCritEve_Step_Func/TAWrapper/PreProcessor/ObjectPreProcessor/ObjectPreProcessorLoop/ValidObject/SafetyMarginFrontObjects/InPathCalculationWithPredictedObjPositions/CreateInPathDataTTM/ToDiag/DIAG_TA_Inpath_PredObjLgt_Le_TTM/off"
 /begin SUB_GROUP autosar_swc_aeb_autosar_swc_aeb_Step_sys_Subsystem_Reference_AEB_Function_Run_AsyEvlrCritEve_Step_Func_Run_AsyEvlrCritEve_Step_Func_TAWrapper_PreProcessor_ObjectPreProcessor_ObjectPreProcessorLoop_ValidObject_SafetyMarginFrontObjects_InPathCalculationWithPredictedObjPositions_CreateInPathDataTTM_ToDiag_DIAG_TA_Inpath_PredObjLgt_Le_TTM_off_ALVTerm /end SUB_GROUP
/end GROUP
/begin GROUP autosar_swc_aeb_autosar_swc_aeb_Step_sys_Subsystem_Reference_AEB_Function_Run_AsyEvlrCritEve_Step_Func_Run_AsyEvlrCritEve_Step_Func_TAWrapper_PreProcessor_ObjectPreProcessor_ObjectPreProcessorLoop_ValidObject_SafetyMarginFrontObjects_InPathCalculationWithPredictedObjPositions_CreateInPathDataTTM_ToDiag_DIAG_TA_Inpath_PredObjLgt_Le_TTM_off_ALVTerm "autosar_swc_aeb/autosar_swc_aeb_Step_sys/Subsystem Reference/AEB Function/Run_AsyEvlrCritEve_Step_Func/Run_AsyEvlrCritEve_Step_Func/TAWrapper/PreProcessor/ObjectPreProcessor/ObjectPreProcessorLoop/ValidObject/SafetyMarginFrontObjects/InPathCalculationWithPredictedObjPositions/CreateInPathDataTTM/ToDiag/DIAG_TA_Inpath_PredObjLgt_Le_TTM/off/ALVTerm" /begin REF_MEASUREMENT autosar_swc_aeb_rtARID_DEF.PosnLgtObj_o0e /end REF_MEASUREMENT /end GROUP
/begin GROUP autosar_swc_aeb_autosar_swc_aeb_Step_sys_Subsystem_Reference_AEB_Function_Run_AsyEvlrCritEve_Step_Func_Run_AsyEvlrCritEve_Step_Func_TAWrapper_PreProcessor_ObjectPreProcessor_ObjectPreProcessorLoop_ValidObject_SafetyMarginFrontObjects_InPathCalculationWithPredictedObjPositions_CreateInPathDataTTM_ToDiag_DIAG_TA_Inpath_PredObjLgt_Ri_TTM "autosar_swc_aeb/autosar_swc_aeb_Step_sys/Subsystem Reference/AEB Function/Run_AsyEvlrCritEve_Step_Func/Run_AsyEvlrCritEve_Step_Func/TAWrapper/PreProcessor/ObjectPreProcessor/ObjectPreProcessorLoop/ValidObject/SafetyMarginFrontObjects/InPathCalculationWithPredictedObjPositions/CreateInPathDataTTM/ToDiag/DIAG_TA_Inpath_PredObjLgt_Ri_TTM"
 /begin SUB_GROUP autosar_swc_aeb_autosar_swc_aeb_Step_sys_Subsystem_Reference_AEB_Function_Run_AsyEvlrCritEve_Step_Func_Run_AsyEvlrCritEve_Step_Func_TAWrapper_PreProcessor_ObjectPreProcessor_ObjectPreProcessorLoop_ValidObject_SafetyMarginFrontObjects_InPathCalculationWithPredictedObjPositions_CreateInPathDataTTM_ToDiag_DIAG_TA_Inpath_PredObjLgt_Ri_TTM_off /end SUB_GROUP
/end GROUP
/begin GROUP autosar_swc_aeb_autosar_swc_aeb_Step_sys_Subsystem_Reference_AEB_Function_Run_AsyEvlrCritEve_Step_Func_Run_AsyEvlrCritEve_Step_Func_TAWrapper_PreProcessor_ObjectPreProcessor_ObjectPreProcessorLoop_ValidObject_SafetyMarginFrontObjects_InPathCalculationWithPredictedObjPositions_CreateInPathDataTTM_ToDiag_DIAG_TA_Inpath_PredObjLgt_Ri_TTM_off "autosar_swc_aeb/autosar_swc_aeb_Step_sys/Subsystem Reference/AEB Function/Run_AsyEvlrCritEve_Step_Func/Run_AsyEvlrCritEve_Step_Func/TAWrapper/PreProcessor/ObjectPreProcessor/ObjectPreProcessorLoop/ValidObject/SafetyMarginFrontObjects/InPathCalculationWithPredictedObjPositions/CreateInPathDataTTM/ToDiag/DIAG_TA_Inpath_PredObjLgt_Ri_TTM/off"
 /begin SUB_GROUP autosar_swc_aeb_autosar_swc_aeb_Step_sys_Subsystem_Reference_AEB_Function_Run_AsyEvlrCritEve_Step_Func_Run_AsyEvlrCritEve_Step_Func_TAWrapper_PreProcessor_ObjectPreProcessor_ObjectPreProcessorLoop_ValidObject_SafetyMarginFrontObjects_InPathCalculationWithPredictedObjPositions_CreateInPathDataTTM_ToDiag_DIAG_TA_Inpath_PredObjLgt_Ri_TTM_off_ALVTerm /end SUB_GROUP
/end GROUP
/begin GROUP autosar_swc_aeb_autosar_swc_aeb_Step_sys_Subsystem_Reference_AEB_Function_Run_AsyEvlrCritEve_Step_Func_Run_AsyEvlrCritEve_Step_Func_TAWrapper_PreProcessor_ObjectPreProcessor_ObjectPreProcessorLoop_ValidObject_SafetyMarginFrontObjects_InPathCalculationWithPredictedObjPositions_CreateInPathDataTTM_ToDiag_DIAG_TA_Inpath_PredObjLgt_TTM "autosar_swc_aeb/autosar_swc_aeb_Step_sys/Subsystem Reference/AEB Function/Run_AsyEvlrCritEve_Step_Func/Run_AsyEvlrCritEve_Step_Func/TAWrapper/PreProcessor/ObjectPreProcessor/ObjectPreProcessorLoop/ValidObject/SafetyMarginFrontObjects/InPathCalculationWithPredictedObjPositions/CreateInPathDataTTM/ToDiag/DIAG_TA_Inpath_PredObjLgt_TTM"
 /begin SUB_GROUP autosar_swc_aeb_autosar_swc_aeb_Step_sys_Subsystem_Reference_AEB_Function_Run_AsyEvlrCritEve_Step_Func_Run_AsyEvlrCritEve_Step_Func_TAWrapper_PreProcessor_ObjectPreProcessor_ObjectPreProcessorLoop_ValidObject_SafetyMarginFrontObjects_InPathCalculationWithPredictedObjPositions_CreateInPathDataTTM_ToDiag_DIAG_TA_Inpath_PredObjLgt_TTM_off /end SUB_GROUP
/end GROUP
/begin GROUP autosar_swc_aeb_autosar_swc_aeb_Step_sys_Subsystem_Reference_AEB_Function_Run_AsyEvlrCritEve_Step_Func_Run_AsyEvlrCritEve_Step_Func_TAWrapper_PreProcessor_ObjectPreProcessor_ObjectPreProcessorLoop_ValidObject_SafetyMarginFrontObjects_InPathCalculationWithPredictedObjPositions_CreateInPathDataTTM_ToDiag_DIAG_TA_Inpath_PredObjLgt_TTM_off "autosar_swc_aeb/autosar_swc_aeb_Step_sys/Subsystem Reference/AEB Function/Run_AsyEvlrCritEve_Step_Func/Run_AsyEvlrCritEve_Step_Func/TAWrapper/PreProcessor/ObjectPreProcessor/ObjectPreProcessorLoop/ValidObject/SafetyMarginFrontObjects/InPathCalculationWithPredictedObjPositions/CreateInPathDataTTM/ToDiag/DIAG_TA_Inpath_PredObjLgt_TTM/off"
 /begin SUB_GROUP autosar_swc_aeb_autosar_swc_aeb_Step_sys_Subsystem_Reference_AEB_Function_Run_AsyEvlrCritEve_Step_Func_Run_AsyEvlrCritEve_Step_Func_TAWrapper_PreProcessor_ObjectPreProcessor_ObjectPreProcessorLoop_ValidObject_SafetyMarginFrontObjects_InPathCalculationWithPredictedObjPositions_CreateInPathDataTTM_ToDiag_DIAG_TA_Inpath_PredObjLgt_TTM_off_ALVTerm /end SUB_GROUP
/end GROUP
/begin GROUP autosar_swc_aeb_autosar_swc_aeb_Step_sys_Subsystem_Reference_AEB_Function_Run_AsyEvlrCritEve_Step_Func_Run_AsyEvlrCritEve_Step_Func_TAWrapper_PreProcessor_ObjectPreProcessor_ObjectPreProcessorLoop_ValidObject_SafetyMarginFrontObjects_InPathCalculationWithPredictedObjPositions_CreateInPathDataTTM_ToDiag_DIAG_TA_Inpath_PredObjLgt_TTM_off_ALVTerm "autosar_swc_aeb/autosar_swc_aeb_Step_sys/Subsystem Reference/AEB Function/Run_AsyEvlrCritEve_Step_Func/Run_AsyEvlrCritEve_Step_Func/TAWrapper/PreProcessor/ObjectPreProcessor/ObjectPreProcessorLoop/ValidObject/SafetyMarginFrontObjects/InPathCalculationWithPredictedObjPositions/CreateInPathDataTTM/ToDiag/DIAG_TA_Inpath_PredObjLgt_TTM/off/ALVTerm" /begin REF_MEASUREMENT autosar_swc_aeb_rtARID_DEF.PosnLgtObj_o /end REF_MEASUREMENT /end GROUP
/begin GROUP autosar_swc_aeb_autosar_swc_aeb_Step_sys_Subsystem_Reference_AEB_Function_Run_AsyEvlrCritEve_Step_Func_Run_AsyEvlrCritEve_Step_Func_TAWrapper_PreProcessor_ObjectPreProcessor_ObjectPreProcessorLoop_ValidObject_SafetyMarginFrontObjects_InPathCalculationWithPredictedObjPositions_CreateInPathDataTTR_CreateInPathData_DetermineIfObjectIsBraking "autosar_swc_aeb/autosar_swc_aeb_Step_sys/Subsystem Reference/AEB Function/Run_AsyEvlrCritEve_Step_Func/Run_AsyEvlrCritEve_Step_Func/TAWrapper/PreProcessor/ObjectPreProcessor/ObjectPreProcessorLoop/ValidObject/SafetyMarginFrontObjects/InPathCalculationWithPredictedObjPositions/CreateInPathDataTTR/CreateInPathData/DetermineIfObjectIsBraking" /begin REF_CHARACTERISTIC CLTS_ObjSpdMovgToSelfMaxForBrkgInAsyEvlrCritEve_Ca /end REF_CHARACTERISTIC /end GROUP
/begin RECORD_LAYOUT Record_FLOAT32_IEEE FNC_VALUES 1 FLOAT32_IEEE COLUMN_DIR DIRECT /end RECORD_LAYOUT
/begin RECORD_LAYOUT Record_FLOAT32_IEEE FNC_VALUES 1 FLOAT32_IEEE COLUMN_DIR DIRECT /end RECORD_LAYOUT
/begin RECORD_LAYOUT Record_FLOAT32_IEEE FNC_VALUES 1 FLOAT32_IEEE COLUMN_DIR DIRECT /end RECORD_LAYOUT
/begin RECORD_LAYOUT Record_FLOAT32_IEEE FNC_VALUES 1 FLOAT32_IEEE COLUMN_DIR DIRECT /end RECORD_LAYOUT
/begin RECORD_LAYOUT Record_FLOAT32_IEEE FNC_VALUES 1 FLOAT32_IEEE COLUMN_DIR DIRECT /end RECORD_LAYOUT
/begin RECORD_LAYOUT Record_FLOAT32_IEEE FNC_VALUES 1 FLOAT32_IEEE COLUMN_DIR DIRECT /end RECORD_LAYOUT
/begin RECORD_LAYOUT Record_FLOAT32_IEEE FNC_VALUES 1 FLOAT32_IEEE COLUMN_DIR DIRECT /end RECORD_LAYOUT
/begin RECORD_LAYOUT Record_FLOAT32_IEEE FNC_VALUES 1 FLOAT32_IEEE COLUMN_DIR DIRECT /end RECORD_LAYOUT
/begin RECORD_LAYOUT Record_FLOAT32_IEEE FNC_VALUES 1 FLOAT32_IEEE COLUMN_DIR DIRECT /end RECORD_LAYOUT
/begin RECORD_LAYOUT Record_FLOAT32_IEEE FNC_VALUES 1 FLOAT32_IEEE COLUMN_DIR DIRECT /end RECORD_LAYOUT
/end MODULE
/end PROJECT
