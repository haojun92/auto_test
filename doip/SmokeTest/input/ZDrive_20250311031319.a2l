ASAP2_VERSION 1 71
/begin PROJECT ProjectName ""
/begin MODULE ModuleName ""
/begin MOD_COMMON "" BYTE_ORDER MSB_LAST ALIGNMENT_BYTE 1 ALIGNMENT_WORD 1 ALIGNMENT_LONG 1 ALIGNMENT_INT64 1 ALIGNMENT_FLOAT16_IEEE 1 ALIGNMENT_FLOAT32_IEEE 1 ALIGNMENT_FLOAT64_IEEE 1 /end MOD_COMMON
/begin RECORD_LAYOUT Scalar_UWORD FNC_VALUES 1 UWORD COLUMN_DIR DIRECT /end RECORD_LAYOUT
/begin MEASUREMENT autosar_swc_vmp_rtARID_DEF.BusAssignment.Object_Hight "" FLOAT32_IEEE autosar_swc_vmp_CM_single 0 0 -3.4E+38 3.4E+38 ECU_ADDRESS 0xfe4cd0a4 /* @ECU_Address@autosar_swc_vmp_rtARID_DEF.BusAssignment.Object_Hight@ */ /end MEASUREMENT
/begin MEASUREMENT autosar_swc_vmp_rtARID_DEF.BusAssignment.Object_Length "" FLOAT32_IEEE autosar_swc_vmp_CM_single 0 0 -3.4E+38 3.4E+38 ECU_ADDRESS 0xfe4cd09c /* @ECU_Address@autosar_swc_vmp_rtARID_DEF.BusAssignment.Object_Length@ */ /end MEASUREMENT
/begin MEASUREMENT autosar_swc_vmp_rtARID_DEF.BusAssignment.Object_Width "" FLOAT32_IEEE autosar_swc_vmp_CM_single 0 0 -3.4E+38 3.4E+38 ECU_ADDRESS 0xfe4cd0a0 /* @ECU_Address@autosar_swc_vmp_rtARID_DEF.BusAssignment.Object_Width@ */ /end MEASUREMENT
/begin MEASUREMENT autosar_swc_vmp_rtARID_DEF.BusAssignment.age "" A_UINT64 autosar_swc_vmp_CM_uint64 0 0 0 18446744073709551615 ECU_ADDRESS 0xfe4cd0b0 /* @ECU_Address@autosar_swc_vmp_rtARID_DEF.BusAssignment.age@ */ /end MEASUREMENT
/begin MEASUREMENT autosar_swc_vmp_rtARID_DEF.BusAssignment.axAbs "" FLOAT32_IEEE autosar_swc_vmp_CM_single 0 0 -3.4E+38 3.4E+38 ECU_ADDRESS 0xfe4cd088 /* @ECU_Address@autosar_swc_vmp_rtARID_DEF.BusAssignment.axAbs@ */ /end MEASUREMENT
/begin MEASUREMENT autosar_swc_vmp_rtARID_DEF.BusAssignment.ayAbs "" FLOAT32_IEEE autosar_swc_vmp_CM_single 0 0 -3.4E+38 3.4E+38 ECU_ADDRESS 0xfe4cd08c /* @ECU_Address@autosar_swc_vmp_rtARID_DEF.BusAssignment.ayAbs@ */ /end MEASUREMENT
/begin MEASUREMENT autosar_swc_vmp_rtARID_DEF.BusAssignment.brakeIntention "" UBYTE autosar_swc_vmp_CM_logical 0 0 0 1 ECU_ADDRESS 0xfe4cd06a /* @ECU_Address@autosar_swc_vmp_rtARID_DEF.BusAssignment.brakeIntention@ */ /end MEASUREMENT
/begin MEASUREMENT autosar_swc_vmp_rtARID_DEF.BusAssignment.cutInflg "" UBYTE autosar_swc_vmp_CM_logical 0 0 0 1 ECU_ADDRESS 0xfe4cd069 /* @ECU_Address@autosar_swc_vmp_rtARID_DEF.BusAssignment.cutInflg@ */ /end MEASUREMENT
/begin MEASUREMENT autosar_swc_vmp_rtARID_DEF.BusAssignment.dx "" FLOAT32_IEEE autosar_swc_vmp_CM_single 0 0 -3.4E+38 3.4E+38 ECU_ADDRESS 0xfe4cd070 /* @ECU_Address@autosar_swc_vmp_rtARID_DEF.BusAssignment.dx@ */ /end MEASUREMENT
/begin MEASUREMENT autosar_swc_vmp_rtARID_DEF.BusAssignment.dy "" FLOAT32_IEEE autosar_swc_vmp_CM_single 0 0 -3.4E+38 3.4E+38 ECU_ADDRESS 0xfe4cd074 /* @ECU_Address@autosar_swc_vmp_rtARID_DEF.BusAssignment.dy@ */ /end MEASUREMENT
/begin MEASUREMENT autosar_swc_vmp_rtARID_DEF.BusAssignment.fu_type "" UWORD autosar_swc_vmp_CM_uint16 0 0 0 65535 ECU_ADDRESS 0xfe4cd06e /* @ECU_Address@autosar_swc_vmp_rtARID_DEF.BusAssignment.fu_type@ */ /end MEASUREMENT
/begin MEASUREMENT autosar_swc_vmp_rtARID_DEF.BusAssignment.headingAngle "" FLOAT32_IEEE autosar_swc_vmp_CM_single 0 0 -3.4E+38 3.4E+38 ECU_ADDRESS 0xfe4cd098 /* @ECU_Address@autosar_swc_vmp_rtARID_DEF.BusAssignment.headingAngle@ */ /end MEASUREMENT
/begin MEASUREMENT autosar_swc_vmp_rtARID_DEF.BusAssignment.id "" ULONG autosar_swc_vmp_CM_uint32 0 0 0 4294967295 ECU_ADDRESS 0xfe4cd0a8 /* @ECU_Address@autosar_swc_vmp_rtARID_DEF.BusAssignment.id@ */ /end MEASUREMENT
/begin MEASUREMENT autosar_swc_vmp_rtARID_DEF.BusAssignment.movingState "" UBYTE autosar_swc_vmp_CM_uint8 0 0 0 255 ECU_ADDRESS 0xfe4cd06b /* @ECU_Address@autosar_swc_vmp_rtARID_DEF.BusAssignment.movingState@ */ /end MEASUREMENT
/begin MEASUREMENT autosar_swc_vmp_rtARID_DEF.BusAssignment.objExist "" FLOAT32_IEEE autosar_swc_vmp_CM_single 0 0 -3.4E+38 3.4E+38 ECU_ADDRESS 0xfe4cd094 /* @ECU_Address@autosar_swc_vmp_rtARID_DEF.BusAssignment.objExist@ */ /end MEASUREMENT
/begin MEASUREMENT autosar_swc_vmp_rtARID_DEF.BusAssignment.orientation "" UBYTE autosar_swc_vmp_CM_uint8 0 0 0 255 ECU_ADDRESS 0xfe4cd06c /* @ECU_Address@autosar_swc_vmp_rtARID_DEF.BusAssignment.orientation@ */ /end MEASUREMENT
/begin MEASUREMENT autosar_swc_vmp_rtARID_DEF.BusAssignment.range "" FLOAT32_IEEE autosar_swc_vmp_CM_single 0 0 -3.4E+38 3.4E+38 ECU_ADDRESS 0xfe4cd090 /* @ECU_Address@autosar_swc_vmp_rtARID_DEF.BusAssignment.range@ */ /end MEASUREMENT
/begin MEASUREMENT autosar_swc_vmp_rtARID_DEF.BusAssignment.targetExist "" UBYTE autosar_swc_vmp_CM_logical 0 0 0 1 ECU_ADDRESS 0xfe4cd068 /* @ECU_Address@autosar_swc_vmp_rtARID_DEF.BusAssignment.targetExist@ */ /end MEASUREMENT
/begin MEASUREMENT autosar_swc_vmp_rtARID_DEF.BusAssignment.type "" UBYTE autosar_swc_vmp_CM_uint8 0 0 0 255 ECU_ADDRESS 0xfe4cd06d /* @ECU_Address@autosar_swc_vmp_rtARID_DEF.BusAssignment.type@ */ /end MEASUREMENT
/begin MEASUREMENT autosar_swc_vmp_rtARID_DEF.BusAssignment.vxAbs "" FLOAT32_IEEE autosar_swc_vmp_CM_single 0 0 -3.4E+38 3.4E+38 ECU_ADDRESS 0xfe4cd080 /* @ECU_Address@autosar_swc_vmp_rtARID_DEF.BusAssignment.vxAbs@ */ /end MEASUREMENT
/begin MEASUREMENT autosar_swc_vmp_rtARID_DEF.BusAssignment.vxRel "" FLOAT32_IEEE autosar_swc_vmp_CM_single 0 0 -3.4E+38 3.4E+38 ECU_ADDRESS 0xfe4cd078 /* @ECU_Address@autosar_swc_vmp_rtARID_DEF.BusAssignment.vxRel@ */ /end MEASUREMENT
/begin MEASUREMENT autosar_swc_vmp_rtARID_DEF.BusAssignment.vyAbs "" FLOAT32_IEEE autosar_swc_vmp_CM_single 0 0 -3.4E+38 3.4E+38 ECU_ADDRESS 0xfe4cd084 /* @ECU_Address@autosar_swc_vmp_rtARID_DEF.BusAssignment.vyAbs@ */ /end MEASUREMENT
/begin MEASUREMENT autosar_swc_vmp_rtARID_DEF.BusAssignment.vyRel "" FLOAT32_IEEE autosar_swc_vmp_CM_single 0 0 -3.4E+38 3.4E+38 ECU_ADDRESS 0xfe4cd07c /* @ECU_Address@autosar_swc_vmp_rtARID_DEF.BusAssignment.vyRel@ */ /end MEASUREMENT
/begin MEASUREMENT autosar_swc_vmp_rtARID_DEF.BusAssignment_f.Object_Hight "" FLOAT32_IEEE autosar_swc_vmp_CM_single 0 0 -3.4E+38 3.4E+38 ECU_ADDRESS 0xfe4cd144 /* @ECU_Address@autosar_swc_vmp_rtARID_DEF.BusAssignment_f.Object_Hight@ */ /end MEASUREMENT
/begin MEASUREMENT autosar_swc_vmp_rtARID_DEF.BusAssignment_f.Object_Length "" FLOAT32_IEEE autosar_swc_vmp_CM_single 0 0 -3.4E+38 3.4E+38 ECU_ADDRESS 0xfe4cd13c /* @ECU_Address@autosar_swc_vmp_rtARID_DEF.BusAssignment_f.Object_Length@ */ /end MEASUREMENT
/begin MEASUREMENT autosar_swc_vmp_rtARID_DEF.BusAssignment_f.Object_Width "" FLOAT32_IEEE autosar_swc_vmp_CM_single 0 0 -3.4E+38 3.4E+38 ECU_ADDRESS 0xfe4cd140 /* @ECU_Address@autosar_swc_vmp_rtARID_DEF.BusAssignment_f.Object_Width@ */ /end MEASUREMENT
/begin MEASUREMENT autosar_swc_vmp_rtARID_DEF.BusAssignment_f.age "" A_UINT64 autosar_swc_vmp_CM_uint64 0 0 0 18446744073709551615 ECU_ADDRESS 0xfe4cd150 /* @ECU_Address@autosar_swc_vmp_rtARID_DEF.BusAssignment_f.age@ */ /end MEASUREMENT
/begin MEASUREMENT autosar_swc_vmp_rtARID_DEF.BusAssignment_f.axAbs "" FLOAT32_IEEE autosar_swc_vmp_CM_single 0 0 -3.4E+38 3.4E+38 ECU_ADDRESS 0xfe4cd128 /* @ECU_Address@autosar_swc_vmp_rtARID_DEF.BusAssignment_f.axAbs@ */ /end MEASUREMENT
/begin MEASUREMENT autosar_swc_vmp_rtARID_DEF.BusAssignment_f.ayAbs "" FLOAT32_IEEE autosar_swc_vmp_CM_single 0 0 -3.4E+38 3.4E+38 ECU_ADDRESS 0xfe4cd12c /* @ECU_Address@autosar_swc_vmp_rtARID_DEF.BusAssignment_f.ayAbs@ */ /end MEASUREMENT
/begin MEASUREMENT autosar_swc_vmp_rtARID_DEF.BusAssignment_f.brakeIntention "" UBYTE autosar_swc_vmp_CM_logical 0 0 0 1 ECU_ADDRESS 0xfe4cd10a /* @ECU_Address@autosar_swc_vmp_rtARID_DEF.BusAssignment_f.brakeIntention@ */ /end MEASUREMENT
/begin MEASUREMENT autosar_swc_vmp_rtARID_DEF.BusAssignment_f.cutInflg "" UBYTE autosar_swc_vmp_CM_logical 0 0 0 1 ECU_ADDRESS 0xfe4cd109 /* @ECU_Address@autosar_swc_vmp_rtARID_DEF.BusAssignment_f.cutInflg@ */ /end MEASUREMENT
/begin MEASUREMENT autosar_swc_vmp_rtARID_DEF.BusAssignment_f.dx "" FLOAT32_IEEE autosar_swc_vmp_CM_single 0 0 -3.4E+38 3.4E+38 ECU_ADDRESS 0xfe4cd110 /* @ECU_Address@autosar_swc_vmp_rtARID_DEF.BusAssignment_f.dx@ */ /end MEASUREMENT
/begin MEASUREMENT autosar_swc_vmp_rtARID_DEF.BusAssignment_f.dy "" FLOAT32_IEEE autosar_swc_vmp_CM_single 0 0 -3.4E+38 3.4E+38 ECU_ADDRESS 0xfe4cd114 /* @ECU_Address@autosar_swc_vmp_rtARID_DEF.BusAssignment_f.dy@ */ /end MEASUREMENT
/begin MEASUREMENT autosar_swc_vmp_rtARID_DEF.BusAssignment_f.fu_type "" UWORD autosar_swc_vmp_CM_uint16 0 0 0 65535 ECU_ADDRESS 0xfe4cd10e /* @ECU_Address@autosar_swc_vmp_rtARID_DEF.BusAssignment_f.fu_type@ */ /end MEASUREMENT
/begin MEASUREMENT autosar_swc_vmp_rtARID_DEF.BusAssignment_f.headingAngle "" FLOAT32_IEEE autosar_swc_vmp_CM_single 0 0 -3.4E+38 3.4E+38 ECU_ADDRESS 0xfe4cd138 /* @ECU_Address@autosar_swc_vmp_rtARID_DEF.BusAssignment_f.headingAngle@ */ /end MEASUREMENT
/begin MEASUREMENT autosar_swc_vmp_rtARID_DEF.BusAssignment_f.id "" ULONG autosar_swc_vmp_CM_uint32 0 0 0 4294967295 ECU_ADDRESS 0xfe4cd148 /* @ECU_Address@autosar_swc_vmp_rtARID_DEF.BusAssignment_f.id@ */ /end MEASUREMENT
/begin MEASUREMENT autosar_swc_vmp_rtARID_DEF.BusAssignment_f.movingState "" UBYTE autosar_swc_vmp_CM_uint8 0 0 0 255 ECU_ADDRESS 0xfe4cd10b /* @ECU_Address@autosar_swc_vmp_rtARID_DEF.BusAssignment_f.movingState@ */ /end MEASUREMENT
/begin MEASUREMENT autosar_swc_vmp_rtARID_DEF.BusAssignment_f.objExist "" FLOAT32_IEEE autosar_swc_vmp_CM_single 0 0 -3.4E+38 3.4E+38 ECU_ADDRESS 0xfe4cd134 /* @ECU_Address@autosar_swc_vmp_rtARID_DEF.BusAssignment_f.objExist@ */ /end MEASUREMENT
/begin MEASUREMENT autosar_swc_vmp_rtARID_DEF.BusAssignment_f.orientation "" UBYTE autosar_swc_vmp_CM_uint8 0 0 0 255 ECU_ADDRESS 0xfe4cd10c /* @ECU_Address@autosar_swc_vmp_rtARID_DEF.BusAssignment_f.orientation@ */ /end MEASUREMENT
/begin MEASUREMENT autosar_swc_vmp_rtARID_DEF.BusAssignment_f.range "" FLOAT32_IEEE autosar_swc_vmp_CM_single 0 0 -3.4E+38 3.4E+38 ECU_ADDRESS 0xfe4cd130 /* @ECU_Address@autosar_swc_vmp_rtARID_DEF.BusAssignment_f.range@ */ /end MEASUREMENT
/begin MEASUREMENT autosar_swc_vmp_rtARID_DEF.BusAssignment_f.targetExist "" UBYTE autosar_swc_vmp_CM_logical 0 0 0 1 ECU_ADDRESS 0xfe4cd108 /* @ECU_Address@autosar_swc_vmp_rtARID_DEF.BusAssignment_f.targetExist@ */ /end MEASUREMENT
/begin MEASUREMENT autosar_swc_vmp_rtARID_DEF.BusAssignment_f.type "" UBYTE autosar_swc_vmp_CM_uint8 0 0 0 255 ECU_ADDRESS 0xfe4cd10d /* @ECU_Address@autosar_swc_vmp_rtARID_DEF.BusAssignment_f.type@ */ /end MEASUREMENT
/begin MEASUREMENT autosar_swc_vmp_rtARID_DEF.BusAssignment_f.vxAbs "" FLOAT32_IEEE autosar_swc_vmp_CM_single 0 0 -3.4E+38 3.4E+38 ECU_ADDRESS 0xfe4cd120 /* @ECU_Address@autosar_swc_vmp_rtARID_DEF.BusAssignment_f.vxAbs@ */ /end MEASUREMENT
/begin MEASUREMENT autosar_swc_vmp_rtARID_DEF.BusAssignment_f.vxRel "" FLOAT32_IEEE autosar_swc_vmp_CM_single 0 0 -3.4E+38 3.4E+38 ECU_ADDRESS 0xfe4cd118 /* @ECU_Address@autosar_swc_vmp_rtARID_DEF.BusAssignment_f.vxRel@ */ /end MEASUREMENT
/begin MEASUREMENT autosar_swc_vmp_rtARID_DEF.BusAssignment_f.vyAbs "" FLOAT32_IEEE autosar_swc_vmp_CM_single 0 0 -3.4E+38 3.4E+38 ECU_ADDRESS 0xfe4cd124 /* @ECU_Address@autosar_swc_vmp_rtARID_DEF.BusAssignment_f.vyAbs@ */ /end MEASUREMENT
/begin MEASUREMENT autosar_swc_vmp_rtARID_DEF.BusAssignment_f.vyRel "" FLOAT32_IEEE autosar_swc_vmp_CM_single 0 0 -3.4E+38 3.4E+38 ECU_ADDRESS 0xfe4cd11c /* @ECU_Address@autosar_swc_vmp_rtARID_DEF.BusAssignment_f.vyRel@ */ /end MEASUREMENT
/begin MEASUREMENT autosar_swc_vmp_rtARID_DEF.BusAssignment_f5.Object_Hight "" FLOAT32_IEEE autosar_swc_vmp_CM_single 0 0 -3.4E+38 3.4E+38 ECU_ADDRESS 0xfe4cd194 /* @ECU_Address@autosar_swc_vmp_rtARID_DEF.BusAssignment_f5.Object_Hight@ */ /end MEASUREMENT
/begin MEASUREMENT autosar_swc_vmp_rtARID_DEF.BusAssignment_f5.Object_Length "" FLOAT32_IEEE autosar_swc_vmp_CM_single 0 0 -3.4E+38 3.4E+38 ECU_ADDRESS 0xfe4cd18c /* @ECU_Address@autosar_swc_vmp_rtARID_DEF.BusAssignment_f5.Object_Length@ */ /end MEASUREMENT
/begin MEASUREMENT autosar_swc_vmp_rtARID_DEF.BusAssignment_f5.Object_Width "" FLOAT32_IEEE autosar_swc_vmp_CM_single 0 0 -3.4E+38 3.4E+38 ECU_ADDRESS 0xfe4cd190 /* @ECU_Address@autosar_swc_vmp_rtARID_DEF.BusAssignment_f5.Object_Width@ */ /end MEASUREMENT
/begin MEASUREMENT autosar_swc_vmp_rtARID_DEF.BusAssignment_f5.age "" A_UINT64 autosar_swc_vmp_CM_uint64 0 0 0 18446744073709551615 ECU_ADDRESS 0xfe4cd1a0 /* @ECU_Address@autosar_swc_vmp_rtARID_DEF.BusAssignment_f5.age@ */ /end MEASUREMENT
/begin MEASUREMENT autosar_swc_vmp_rtARID_DEF.BusAssignment_f5.axAbs "" FLOAT32_IEEE autosar_swc_vmp_CM_single 0 0 -3.4E+38 3.4E+38 ECU_ADDRESS 0xfe4cd178 /* @ECU_Address@autosar_swc_vmp_rtARID_DEF.BusAssignment_f5.axAbs@ */ /end MEASUREMENT
/begin MEASUREMENT autosar_swc_vmp_rtARID_DEF.BusAssignment_f5.ayAbs "" FLOAT32_IEEE autosar_swc_vmp_CM_single 0 0 -3.4E+38 3.4E+38 ECU_ADDRESS 0xfe4cd17c /* @ECU_Address@autosar_swc_vmp_rtARID_DEF.BusAssignment_f5.ayAbs@ */ /end MEASUREMENT
/begin MEASUREMENT autosar_swc_vmp_rtARID_DEF.BusAssignment_f5.brakeIntention "" UBYTE autosar_swc_vmp_CM_logical 0 0 0 1 ECU_ADDRESS 0xfe4cd15a /* @ECU_Address@autosar_swc_vmp_rtARID_DEF.BusAssignment_f5.brakeIntention@ */ /end MEASUREMENT
/begin MEASUREMENT autosar_swc_vmp_rtARID_DEF.BusAssignment_f5.cutInflg "" UBYTE autosar_swc_vmp_CM_logical 0 0 0 1 ECU_ADDRESS 0xfe4cd159 /* @ECU_Address@autosar_swc_vmp_rtARID_DEF.BusAssignment_f5.cutInflg@ */ /end MEASUREMENT
/begin MEASUREMENT autosar_swc_vmp_rtARID_DEF.BusAssignment_f5.dx "" FLOAT32_IEEE autosar_swc_vmp_CM_single 0 0 -3.4E+38 3.4E+38 ECU_ADDRESS 0xfe4cd160 /* @ECU_Address@autosar_swc_vmp_rtARID_DEF.BusAssignment_f5.dx@ */ /end MEASUREMENT
/begin MEASUREMENT autosar_swc_vmp_rtARID_DEF.BusAssignment_f5.dy "" FLOAT32_IEEE autosar_swc_vmp_CM_single 0 0 -3.4E+38 3.4E+38 ECU_ADDRESS 0xfe4cd164 /* @ECU_Address@autosar_swc_vmp_rtARID_DEF.BusAssignment_f5.dy@ */ /end MEASUREMENT
/begin MEASUREMENT autosar_swc_vmp_rtARID_DEF.BusAssignment_f5.fu_type "" UWORD autosar_swc_vmp_CM_uint16 0 0 0 65535 ECU_ADDRESS 0xfe4cd15e /* @ECU_Address@autosar_swc_vmp_rtARID_DEF.BusAssignment_f5.fu_type@ */ /end MEASUREMENT
/begin MEASUREMENT autosar_swc_vmp_rtARID_DEF.BusAssignment_f5.headingAngle "" FLOAT32_IEEE autosar_swc_vmp_CM_single 0 0 -3.4E+38 3.4E+38 ECU_ADDRESS 0xfe4cd188 /* @ECU_Address@autosar_swc_vmp_rtARID_DEF.BusAssignment_f5.headingAngle@ */ /end MEASUREMENT
/begin MEASUREMENT autosar_swc_vmp_rtARID_DEF.BusAssignment_f5.id "" ULONG autosar_swc_vmp_CM_uint32 0 0 0 4294967295 ECU_ADDRESS 0xfe4cd198 /* @ECU_Address@autosar_swc_vmp_rtARID_DEF.BusAssignment_f5.id@ */ /end MEASUREMENT
/begin MEASUREMENT autosar_swc_vmp_rtARID_DEF.BusAssignment_f5.movingState "" UBYTE autosar_swc_vmp_CM_uint8 0 0 0 255 ECU_ADDRESS 0xfe4cd15b /* @ECU_Address@autosar_swc_vmp_rtARID_DEF.BusAssignment_f5.movingState@ */ /end MEASUREMENT
/begin MEASUREMENT autosar_swc_vmp_rtARID_DEF.BusAssignment_f5.objExist "" FLOAT32_IEEE autosar_swc_vmp_CM_single 0 0 -3.4E+38 3.4E+38 ECU_ADDRESS 0xfe4cd184 /* @ECU_Address@autosar_swc_vmp_rtARID_DEF.BusAssignment_f5.objExist@ */ /end MEASUREMENT
/begin MEASUREMENT autosar_swc_vmp_rtARID_DEF.BusAssignment_f5.orientation "" UBYTE autosar_swc_vmp_CM_uint8 0 0 0 255 ECU_ADDRESS 0xfe4cd15c /* @ECU_Address@autosar_swc_vmp_rtARID_DEF.BusAssignment_f5.orientation@ */ /end MEASUREMENT
/begin MEASUREMENT autosar_swc_vmp_rtARID_DEF.BusAssignment_f5.range "" FLOAT32_IEEE autosar_swc_vmp_CM_single 0 0 -3.4E+38 3.4E+38 ECU_ADDRESS 0xfe4cd180 /* @ECU_Address@autosar_swc_vmp_rtARID_DEF.BusAssignment_f5.range@ */ /end MEASUREMENT
/begin MEASUREMENT autosar_swc_vmp_rtARID_DEF.BusAssignment_f5.targetExist "" UBYTE autosar_swc_vmp_CM_logical 0 0 0 1 ECU_ADDRESS 0xfe4cd158 /* @ECU_Address@autosar_swc_vmp_rtARID_DEF.BusAssignment_f5.targetExist@ */ /end MEASUREMENT
/begin MEASUREMENT autosar_swc_vmp_rtARID_DEF.BusAssignment_f5.type "" UBYTE autosar_swc_vmp_CM_uint8 0 0 0 255 ECU_ADDRESS 0xfe4cd15d /* @ECU_Address@autosar_swc_vmp_rtARID_DEF.BusAssignment_f5.type@ */ /end MEASUREMENT
/begin MEASUREMENT autosar_swc_vmp_rtARID_DEF.BusAssignment_f5.vxAbs "" FLOAT32_IEEE autosar_swc_vmp_CM_single 0 0 -3.4E+38 3.4E+38 ECU_ADDRESS 0xfe4cd170 /* @ECU_Address@autosar_swc_vmp_rtARID_DEF.BusAssignment_f5.vxAbs@ */ /end MEASUREMENT
/begin MEASUREMENT autosar_swc_vmp_rtARID_DEF.BusAssignment_f5.vxRel "" FLOAT32_IEEE autosar_swc_vmp_CM_single 0 0 -3.4E+38 3.4E+38 ECU_ADDRESS 0xfe4cd168 /* @ECU_Address@autosar_swc_vmp_rtARID_DEF.BusAssignment_f5.vxRel@ */ /end MEASUREMENT
/begin MEASUREMENT autosar_swc_vmp_rtARID_DEF.BusAssignment_f5.vyAbs "" FLOAT32_IEEE autosar_swc_vmp_CM_single 0 0 -3.4E+38 3.4E+38 ECU_ADDRESS 0xfe4cd174 /* @ECU_Address@autosar_swc_vmp_rtARID_DEF.BusAssignment_f5.vyAbs@ */ /end MEASUREMENT
/begin MEASUREMENT autosar_swc_vmp_rtARID_DEF.BusAssignment_f5.vyRel "" FLOAT32_IEEE autosar_swc_vmp_CM_single 0 0 -3.4E+38 3.4E+38 ECU_ADDRESS 0xfe4cd16c /* @ECU_Address@autosar_swc_vmp_rtARID_DEF.BusAssignment_f5.vyRel@ */ /end MEASUREMENT
/begin MEASUREMENT autosar_swc_vmp_rtARID_DEF.BusAssignment_p.Object_Hight "" FLOAT32_IEEE autosar_swc_vmp_CM_single 0 0 -3.4E+38 3.4E+38 ECU_ADDRESS 0xfe4cd0f4 /* @ECU_Address@autosar_swc_vmp_rtARID_DEF.BusAssignment_p.Object_Hight@ */ /end MEASUREMENT
/begin MEASUREMENT autosar_swc_vmp_rtARID_DEF.BusAssignment_p.Object_Length "" FLOAT32_IEEE autosar_swc_vmp_CM_single 0 0 -3.4E+38 3.4E+38 ECU_ADDRESS 0xfe4cd0ec /* @ECU_Address@autosar_swc_vmp_rtARID_DEF.BusAssignment_p.Object_Length@ */ /end MEASUREMENT
/begin MEASUREMENT autosar_swc_vmp_rtARID_DEF.BusAssignment_p.Object_Width "" FLOAT32_IEEE autosar_swc_vmp_CM_single 0 0 -3.4E+38 3.4E+38 ECU_ADDRESS 0xfe4cd0f0 /* @ECU_Address@autosar_swc_vmp_rtARID_DEF.BusAssignment_p.Object_Width@ */ /end MEASUREMENT
/begin MEASUREMENT autosar_swc_vmp_rtARID_DEF.BusAssignment_p.age "" A_UINT64 autosar_swc_vmp_CM_uint64 0 0 0 18446744073709551615 ECU_ADDRESS 0xfe4cd100 /* @ECU_Address@autosar_swc_vmp_rtARID_DEF.BusAssignment_p.age@ */ /end MEASUREMENT
/begin MEASUREMENT autosar_swc_vmp_rtARID_DEF.BusAssignment_p.axAbs "" FLOAT32_IEEE autosar_swc_vmp_CM_single 0 0 -3.4E+38 3.4E+38 ECU_ADDRESS 0xfe4cd0d8 /* @ECU_Address@autosar_swc_vmp_rtARID_DEF.BusAssignment_p.axAbs@ */ /end MEASUREMENT
/begin MEASUREMENT autosar_swc_vmp_rtARID_DEF.BusAssignment_p.ayAbs "" FLOAT32_IEEE autosar_swc_vmp_CM_single 0 0 -3.4E+38 3.4E+38 ECU_ADDRESS 0xfe4cd0dc /* @ECU_Address@autosar_swc_vmp_rtARID_DEF.BusAssignment_p.ayAbs@ */ /end MEASUREMENT
/begin MEASUREMENT autosar_swc_vmp_rtARID_DEF.BusAssignment_p.brakeIntention "" UBYTE autosar_swc_vmp_CM_logical 0 0 0 1 ECU_ADDRESS 0xfe4cd0ba /* @ECU_Address@autosar_swc_vmp_rtARID_DEF.BusAssignment_p.brakeIntention@ */ /end MEASUREMENT
/begin MEASUREMENT autosar_swc_vmp_rtARID_DEF.BusAssignment_p.cutInflg "" UBYTE autosar_swc_vmp_CM_logical 0 0 0 1 ECU_ADDRESS 0xfe4cd0b9 /* @ECU_Address@autosar_swc_vmp_rtARID_DEF.BusAssignment_p.cutInflg@ */ /end MEASUREMENT
/begin MEASUREMENT autosar_swc_vmp_rtARID_DEF.BusAssignment_p.dx "" FLOAT32_IEEE autosar_swc_vmp_CM_single 0 0 -3.4E+38 3.4E+38 ECU_ADDRESS 0xfe4cd0c0 /* @ECU_Address@autosar_swc_vmp_rtARID_DEF.BusAssignment_p.dx@ */ /end MEASUREMENT
/begin MEASUREMENT autosar_swc_vmp_rtARID_DEF.BusAssignment_p.dy "" FLOAT32_IEEE autosar_swc_vmp_CM_single 0 0 -3.4E+38 3.4E+38 ECU_ADDRESS 0xfe4cd0c4 /* @ECU_Address@autosar_swc_vmp_rtARID_DEF.BusAssignment_p.dy@ */ /end MEASUREMENT
/begin MEASUREMENT autosar_swc_vmp_rtARID_DEF.BusAssignment_p.fu_type "" UWORD autosar_swc_vmp_CM_uint16 0 0 0 65535 ECU_ADDRESS 0xfe4cd0be /* @ECU_Address@autosar_swc_vmp_rtARID_DEF.BusAssignment_p.fu_type@ */ /end MEASUREMENT
/begin MEASUREMENT autosar_swc_vmp_rtARID_DEF.BusAssignment_p.headingAngle "" FLOAT32_IEEE autosar_swc_vmp_CM_single 0 0 -3.4E+38 3.4E+38 ECU_ADDRESS 0xfe4cd0e8 /* @ECU_Address@autosar_swc_vmp_rtARID_DEF.BusAssignment_p.headingAngle@ */ /end MEASUREMENT
/begin MEASUREMENT autosar_swc_vmp_rtARID_DEF.BusAssignment_p.id "" ULONG autosar_swc_vmp_CM_uint32 0 0 0 4294967295 ECU_ADDRESS 0xfe4cd0f8 /* @ECU_Address@autosar_swc_vmp_rtARID_DEF.BusAssignment_p.id@ */ /end MEASUREMENT
/begin MEASUREMENT autosar_swc_vmp_rtARID_DEF.BusAssignment_p.movingState "" UBYTE autosar_swc_vmp_CM_uint8 0 0 0 255 ECU_ADDRESS 0xfe4cd0bb /* @ECU_Address@autosar_swc_vmp_rtARID_DEF.BusAssignment_p.movingState@ */ /end MEASUREMENT
/begin MEASUREMENT autosar_swc_vmp_rtARID_DEF.BusAssignment_p.objExist "" FLOAT32_IEEE autosar_swc_vmp_CM_single 0 0 -3.4E+38 3.4E+38 ECU_ADDRESS 0xfe4cd0e4 /* @ECU_Address@autosar_swc_vmp_rtARID_DEF.BusAssignment_p.objExist@ */ /end MEASUREMENT
/begin MEASUREMENT autosar_swc_vmp_rtARID_DEF.BusAssignment_p.orientation "" UBYTE autosar_swc_vmp_CM_uint8 0 0 0 255 ECU_ADDRESS 0xfe4cd0bc /* @ECU_Address@autosar_swc_vmp_rtARID_DEF.BusAssignment_p.orientation@ */ /end MEASUREMENT
/begin MEASUREMENT autosar_swc_vmp_rtARID_DEF.BusAssignment_p.range "" FLOAT32_IEEE autosar_swc_vmp_CM_single 0 0 -3.4E+38 3.4E+38 ECU_ADDRESS 0xfe4cd0e0 /* @ECU_Address@autosar_swc_vmp_rtARID_DEF.BusAssignment_p.range@ */ /end MEASUREMENT
/begin MEASUREMENT autosar_swc_vmp_rtARID_DEF.BusAssignment_p.targetExist "" UBYTE autosar_swc_vmp_CM_logical 0 0 0 1 ECU_ADDRESS 0xfe4cd0b8 /* @ECU_Address@autosar_swc_vmp_rtARID_DEF.BusAssignment_p.targetExist@ */ /end MEASUREMENT
/begin MEASUREMENT autosar_swc_vmp_rtARID_DEF.BusAssignment_p.type "" UBYTE autosar_swc_vmp_CM_uint8 0 0 0 255 ECU_ADDRESS 0xfe4cd0bd /* @ECU_Address@autosar_swc_vmp_rtARID_DEF.BusAssignment_p.type@ */ /end MEASUREMENT
/begin MEASUREMENT autosar_swc_vmp_rtARID_DEF.BusAssignment_p.vxAbs "" FLOAT32_IEEE autosar_swc_vmp_CM_single 0 0 -3.4E+38 3.4E+38 ECU_ADDRESS 0xfe4cd0d0 /* @ECU_Address@autosar_swc_vmp_rtARID_DEF.BusAssignment_p.vxAbs@ */ /end MEASUREMENT
/begin MEASUREMENT autosar_swc_vmp_rtARID_DEF.BusAssignment_p.vxRel "" FLOAT32_IEEE autosar_swc_vmp_CM_single 0 0 -3.4E+38 3.4E+38 ECU_ADDRESS 0xfe4cd0c8 /* @ECU_Address@autosar_swc_vmp_rtARID_DEF.BusAssignment_p.vxRel@ */ /end MEASUREMENT
/begin MEASUREMENT autosar_swc_vmp_rtARID_DEF.BusAssignment_p.vyAbs "" FLOAT32_IEEE autosar_swc_vmp_CM_single 0 0 -3.4E+38 3.4E+38 ECU_ADDRESS 0xfe4cd0d4 /* @ECU_Address@autosar_swc_vmp_rtARID_DEF.BusAssignment_p.vyAbs@ */ /end MEASUREMENT
/begin MEASUREMENT autosar_swc_vmp_rtARID_DEF.BusAssignment_p.vyRel "" FLOAT32_IEEE autosar_swc_vmp_CM_single 0 0 -3.4E+38 3.4E+38 ECU_ADDRESS 0xfe4cd0cc /* @ECU_Address@autosar_swc_vmp_rtARID_DEF.BusAssignment_p.vyRel@ */ /end MEASUREMENT
/begin MEASUREMENT autosar_swc_vmp_rtARID_DEF.ICAS_STATEOut.acc_exit_reason "" ULONG autosar_swc_vmp_CM_uint32 0 0 0 4294967295 ECU_ADDRESS 0xfe4cd260 /* @ECU_Address@autosar_swc_vmp_rtARID_DEF.ICAS_STATEOut.acc_exit_reason@ */ /end MEASUREMENT
/begin MEASUREMENT autosar_swc_vmp_rtARID_DEF.ICAS_STATEOut.acc_manual_act_faile_reason "" ULONG autosar_swc_vmp_CM_uint32 0 0 0 4294967295 ECU_ADDRESS 0xfe4cd25c /* @ECU_Address@autosar_swc_vmp_rtARID_DEF.ICAS_STATEOut.acc_manual_act_faile_reason@ */ /end MEASUREMENT
/begin MEASUREMENT autosar_swc_vmp_rtARID_DEF.ICAS_STATEOut.acc_sts "" UBYTE autosar_swc_vmp_CM_uint8 0 0 0 255 ECU_ADDRESS 0xfe4cd254 /* @ECU_Address@autosar_swc_vmp_rtARID_DEF.ICAS_STATEOut.acc_sts@ */ /end MEASUREMENT
/begin MEASUREMENT autosar_swc_vmp_rtARID_DEF.ICAS_STATEOut.alc_sts "" UBYTE autosar_swc_vmp_CM_uint8 0 0 0 255 ECU_ADDRESS 0xfe4cd257 /* @ECU_Address@autosar_swc_vmp_rtARID_DEF.ICAS_STATEOut.alc_sts@ */ /end MEASUREMENT
/begin MEASUREMENT autosar_swc_vmp_rtARID_DEF.ICAS_STATEOut.lc_req_sync_id "" UBYTE autosar_swc_vmp_CM_uint8 0 0 0 255 ECU_ADDRESS 0xfe4cd259 /* @ECU_Address@autosar_swc_vmp_rtARID_DEF.ICAS_STATEOut.lc_req_sync_id@ */ /end MEASUREMENT
/begin MEASUREMENT autosar_swc_vmp_rtARID_DEF.ICAS_STATEOut.lcc_auto_act_faile_reason "" ULONG autosar_swc_vmp_CM_uint32 0 0 0 4294967295 ECU_ADDRESS 0xfe4cd268 /* @ECU_Address@autosar_swc_vmp_rtARID_DEF.ICAS_STATEOut.lcc_auto_act_faile_reason@ */ /end MEASUREMENT
/begin MEASUREMENT autosar_swc_vmp_rtARID_DEF.ICAS_STATEOut.lcc_exit_to_idle_reason "" ULONG autosar_swc_vmp_CM_uint32 0 0 0 4294967295 ECU_ADDRESS 0xfe4cd26c /* @ECU_Address@autosar_swc_vmp_rtARID_DEF.ICAS_STATEOut.lcc_exit_to_idle_reason@ */ /end MEASUREMENT
/begin MEASUREMENT autosar_swc_vmp_rtARID_DEF.ICAS_STATEOut.lcc_exit_to_mrc_reason "" ULONG autosar_swc_vmp_CM_uint32 0 0 0 4294967295 ECU_ADDRESS 0xfe4cd274 /* @ECU_Address@autosar_swc_vmp_rtARID_DEF.ICAS_STATEOut.lcc_exit_to_mrc_reason@ */ /end MEASUREMENT
/begin MEASUREMENT autosar_swc_vmp_rtARID_DEF.ICAS_STATEOut.lcc_exit_to_wait_reason "" ULONG autosar_swc_vmp_CM_uint32 0 0 0 4294967295 ECU_ADDRESS 0xfe4cd270 /* @ECU_Address@autosar_swc_vmp_rtARID_DEF.ICAS_STATEOut.lcc_exit_to_wait_reason@ */ /end MEASUREMENT
/begin MEASUREMENT autosar_swc_vmp_rtARID_DEF.ICAS_STATEOut.lcc_manual_act_faile_reason "" ULONG autosar_swc_vmp_CM_uint32 0 0 0 4294967295 ECU_ADDRESS 0xfe4cd264 /* @ECU_Address@autosar_swc_vmp_rtARID_DEF.ICAS_STATEOut.lcc_manual_act_faile_reason@ */ /end MEASUREMENT
/begin MEASUREMENT autosar_swc_vmp_rtARID_DEF.ICAS_STATEOut.lcc_mrc_exit_reason "" ULONG autosar_swc_vmp_CM_uint32 0 0 0 4294967295 ECU_ADDRESS 0xfe4cd278 /* @ECU_Address@autosar_swc_vmp_rtARID_DEF.ICAS_STATEOut.lcc_mrc_exit_reason@ */ /end MEASUREMENT
/begin MEASUREMENT autosar_swc_vmp_rtARID_DEF.ICAS_STATEOut.lcc_sts "" UBYTE autosar_swc_vmp_CM_uint8 0 0 0 255 ECU_ADDRESS 0xfe4cd255 /* @ECU_Address@autosar_swc_vmp_rtARID_DEF.ICAS_STATEOut.lcc_sts@ */ /end MEASUREMENT
/begin MEASUREMENT autosar_swc_vmp_rtARID_DEF.ICAS_STATEOut.noa_auto_act_faile_reason "" ULONG autosar_swc_vmp_CM_uint32 0 0 0 4294967295 ECU_ADDRESS 0xfe4cd27c /* @ECU_Address@autosar_swc_vmp_rtARID_DEF.ICAS_STATEOut.noa_auto_act_faile_reason@ */ /end MEASUREMENT
/begin MEASUREMENT autosar_swc_vmp_rtARID_DEF.ICAS_STATEOut.noa_exit_reason "" ULONG autosar_swc_vmp_CM_uint32 0 0 0 4294967295 ECU_ADDRESS 0xfe4cd280 /* @ECU_Address@autosar_swc_vmp_rtARID_DEF.ICAS_STATEOut.noa_exit_reason@ */ /end MEASUREMENT
/begin MEASUREMENT autosar_swc_vmp_rtARID_DEF.ICAS_STATEOut.noa_sts "" UBYTE autosar_swc_vmp_CM_uint8 0 0 0 255 ECU_ADDRESS 0xfe4cd258 /* @ECU_Address@autosar_swc_vmp_rtARID_DEF.ICAS_STATEOut.noa_sts@ */ /end MEASUREMENT
/begin MEASUREMENT autosar_swc_vmp_rtARID_DEF.ICAS_STATEOut.nudge_sts "" UBYTE autosar_swc_vmp_CM_uint8 0 0 0 255 ECU_ADDRESS 0xfe4cd256 /* @ECU_Address@autosar_swc_vmp_rtARID_DEF.ICAS_STATEOut.nudge_sts@ */ /end MEASUREMENT
/begin MEASUREMENT autosar_swc_vmp_rtARID_DEF.TappedDelay1_X "" FLOAT32_IEEE autosar_swc_vmp_CM_single 0 0 -3.4E+38 3.4E+38 LAYOUT COLUMN_DIR MATRIX_DIM 19 ECU_ADDRESS 0xfe4cd468 /* @ECU_Address@autosar_swc_vmp_rtARID_DEF.TappedDelay1_X@ */ /end MEASUREMENT
/begin MEASUREMENT autosar_swc_vmp_rtARID_DEF.TappedDelay_X_n "" UBYTE autosar_swc_vmp_CM_uint8 0 0 0 255 ECU_ADDRESS 0xfe4d2f53 /* @ECU_Address@autosar_swc_vmp_rtARID_DEF.TappedDelay_X_n@ */ /end MEASUREMENT
/begin MEASUREMENT autosar_swc_vmp_rtARID_DEF.TmpSignalConversionAtCSM_CTRLOutport1.CruiseSpdCtrlLevel "" UBYTE autosar_swc_vmp_CM_uint8 0 0 0 255 ECU_ADDRESS 0xfe4cd2d9 /* @ECU_Address@autosar_swc_vmp_rtARID_DEF.TmpSignalConversionAtCSM_CTRLOutport1.CruiseSpdCtrlLevel@ */ /end MEASUREMENT
/begin MEASUREMENT autosar_swc_vmp_rtARID_DEF.TmpSignalConversionAtCSM_CTRLOutport1.CruiseSpdKmh "" FLOAT32_IEEE autosar_swc_vmp_CM_single 0 0 -3.4E+38 3.4E+38 ECU_ADDRESS 0xfe4cd2dc /* @ECU_Address@autosar_swc_vmp_rtARID_DEF.TmpSignalConversionAtCSM_CTRLOutport1.CruiseSpdKmh@ */ /end MEASUREMENT
/begin MEASUREMENT autosar_swc_vmp_rtARID_DEF.TmpSignalConversionAtCSM_CTRLOutport1.ISL_APSpdLimDist "" FLOAT32_IEEE autosar_swc_vmp_CM_single 0 0 -3.4E+38 3.4E+38 ECU_ADDRESS 0xfe4cd2e4 /* @ECU_Address@autosar_swc_vmp_rtARID_DEF.TmpSignalConversionAtCSM_CTRLOutport1.ISL_APSpdLimDist@ */ /end MEASUREMENT
/begin MEASUREMENT autosar_swc_vmp_rtARID_DEF.TmpSignalConversionAtCSM_CTRLOutport1.ISL_APSpdLimSPL "" FLOAT32_IEEE autosar_swc_vmp_CM_single 0 0 -3.4E+38 3.4E+38 ECU_ADDRESS 0xfe4cd2e0 /* @ECU_Address@autosar_swc_vmp_rtARID_DEF.TmpSignalConversionAtCSM_CTRLOutport1.ISL_APSpdLimSPL@ */ /end MEASUREMENT
/begin MEASUREMENT autosar_swc_vmp_rtARID_DEF.TmpSignalConversionAtCSM_CTRLOutport1.TimeGapLevel "" UBYTE autosar_swc_vmp_CM_uint8 0 0 0 255 ECU_ADDRESS 0xfe4cd2da /* @ECU_Address@autosar_swc_vmp_rtARID_DEF.TmpSignalConversionAtCSM_CTRLOutport1.TimeGapLevel@ */ /end MEASUREMENT
/begin MEASUREMENT autosar_swc_vmp_rtARID_DEF.TmpSignalConversionAtCSM_CTRLOutport1.VsetBelowMin "" UBYTE autosar_swc_vmp_CM_logical 0 0 0 1 ECU_ADDRESS 0xfe4cd2d8 /* @ECU_Address@autosar_swc_vmp_rtARID_DEF.TmpSignalConversionAtCSM_CTRLOutport1.VsetBelowMin@ */ /end MEASUREMENT
/begin MEASUREMENT autosar_swc_vmp_rtARID_DEF.TmpSignalConversionAtEVM_CIPVOutport1[0].accel_gnd.mod "" FLOAT32_IEEE autosar_swc_vmp_CM_single 0 0 -3.4E+38 3.4E+38 ECU_ADDRESS 0xfe4cc9ac /* @ECU_Address@autosar_swc_vmp_rtARID_DEF.TmpSignalConversionAtEVM_CIPVOutport1[0].accel_gnd.mod@ */ /end MEASUREMENT
/begin MEASUREMENT autosar_swc_vmp_rtARID_DEF.TmpSignalConversionAtEVM_CIPVOutport1[0].accel_gnd.x "" FLOAT32_IEEE autosar_swc_vmp_CM_single 0 0 -3.4E+38 3.4E+38 ECU_ADDRESS 0xfe4cc9a4 /* @ECU_Address@autosar_swc_vmp_rtARID_DEF.TmpSignalConversionAtEVM_CIPVOutport1[0].accel_gnd.x@ */ /end MEASUREMENT
/begin MEASUREMENT autosar_swc_vmp_rtARID_DEF.TmpSignalConversionAtEVM_CIPVOutport1[0].accel_gnd.y "" FLOAT32_IEEE autosar_swc_vmp_CM_single 0 0 -3.4E+38 3.4E+38 ECU_ADDRESS 0xfe4cc9a8 /* @ECU_Address@autosar_swc_vmp_rtARID_DEF.TmpSignalConversionAtEVM_CIPVOutport1[0].accel_gnd.y@ */ /end MEASUREMENT
/begin MEASUREMENT autosar_swc_vmp_rtARID_DEF.TmpSignalConversionAtEVM_CIPVOutport1[0].accel_gnd_sl.mod "" FLOAT32_IEEE autosar_swc_vmp_CM_single 0 0 -3.4E+38 3.4E+38 ECU_ADDRESS 0xfe4cc9c4 /* @ECU_Address@autosar_swc_vmp_rtARID_DEF.TmpSignalConversionAtEVM_CIPVOutport1[0].accel_gnd_sl.mod@ */ /end MEASUREMENT
/begin MEASUREMENT autosar_swc_vmp_rtARID_DEF.TmpSignalConversionAtEVM_CIPVOutport1[0].accel_gnd_sl.x "" FLOAT32_IEEE autosar_swc_vmp_CM_single 0 0 -3.4E+38 3.4E+38 ECU_ADDRESS 0xfe4cc9bc /* @ECU_Address@autosar_swc_vmp_rtARID_DEF.TmpSignalConversionAtEVM_CIPVOutport1[0].accel_gnd_sl.x@ */ /end MEASUREMENT
/begin MEASUREMENT autosar_swc_vmp_rtARID_DEF.TmpSignalConversionAtEVM_CIPVOutport1[0].accel_gnd_sl.y "" FLOAT32_IEEE autosar_swc_vmp_CM_single 0 0 -3.4E+38 3.4E+38 ECU_ADDRESS 0xfe4cc9c0 /* @ECU_Address@autosar_swc_vmp_rtARID_DEF.TmpSignalConversionAtEVM_CIPVOutport1[0].accel_gnd_sl.y@ */ /end MEASUREMENT
/begin MEASUREMENT autosar_swc_vmp_rtARID_DEF.TmpSignalConversionAtEVM_CIPVOutport1[0].box.corner_x_vec "" FLOAT32_IEEE autosar_swc_vmp_CM_single 0 0 -3.4E+38 3.4E+38 LAYOUT COLUMN_DIR MATRIX_DIM 4 ECU_ADDRESS 0xfe4cc954 /* @ECU_Address@autosar_swc_vmp_rtARID_DEF.TmpSignalConversionAtEVM_CIPVOutport1[0].box.corner_x_vec@ */ /end MEASUREMENT
/begin MEASUREMENT autosar_swc_vmp_rtARID_DEF.TmpSignalConversionAtEVM_CIPVOutport1[0].box.corner_y_vec "" FLOAT32_IEEE autosar_swc_vmp_CM_single 0 0 -3.4E+38 3.4E+38 LAYOUT COLUMN_DIR MATRIX_DIM 4 ECU_ADDRESS 0xfe4cc964 /* @ECU_Address@autosar_swc_vmp_rtARID_DEF.TmpSignalConversionAtEVM_CIPVOutport1[0].box.corner_y_vec@ */ /end MEASUREMENT
/begin MEASUREMENT autosar_swc_vmp_rtARID_DEF.TmpSignalConversionAtEVM_CIPVOutport1[0].class_type "" UBYTE autosar_swc_vmp_CM_uint8 0 0 0 255 ECU_ADDRESS 0xfe4cc94a /* @ECU_Address@autosar_swc_vmp_rtARID_DEF.TmpSignalConversionAtEVM_CIPVOutport1[0].class_type@ */ /end MEASUREMENT
/begin MEASUREMENT autosar_swc_vmp_rtARID_DEF.TmpSignalConversionAtEVM_CIPVOutport1[0].cut_type "" UBYTE autosar_swc_vmp_CM_uint8 0 0 0 255 ECU_ADDRESS 0xfe4cc94b /* @ECU_Address@autosar_swc_vmp_rtARID_DEF.TmpSignalConversionAtEVM_CIPVOutport1[0].cut_type@ */ /end MEASUREMENT
/begin MEASUREMENT autosar_swc_vmp_rtARID_DEF.TmpSignalConversionAtEVM_CIPVOutport1[0].fus_type "" UBYTE autosar_swc_vmp_CM_uint8 0 0 0 255 ECU_ADDRESS 0xfe4cc949 /* @ECU_Address@autosar_swc_vmp_rtARID_DEF.TmpSignalConversionAtEVM_CIPVOutport1[0].fus_type@ */ /end MEASUREMENT
/begin MEASUREMENT autosar_swc_vmp_rtARID_DEF.TmpSignalConversionAtEVM_CIPVOutport1[0].id "" ULONG autosar_swc_vmp_CM_uint32 0 0 0 4294967295 ECU_ADDRESS 0xfe4cc950 /* @ECU_Address@autosar_swc_vmp_rtARID_DEF.TmpSignalConversionAtEVM_CIPVOutport1[0].id@ */ /end MEASUREMENT
/begin MEASUREMENT autosar_swc_vmp_rtARID_DEF.TmpSignalConversionAtEVM_CIPVOutport1[0].meas_state "" UBYTE autosar_swc_vmp_CM_uint8 0 0 0 255 ECU_ADDRESS 0xfe4cc948 /* @ECU_Address@autosar_swc_vmp_rtARID_DEF.TmpSignalConversionAtEVM_CIPVOutport1[0].meas_state@ */ /end MEASUREMENT
/begin MEASUREMENT autosar_swc_vmp_rtARID_DEF.TmpSignalConversionAtEVM_CIPVOutport1[0].position.heading_angle "" FLOAT32_IEEE autosar_swc_vmp_CM_single 0 0 -3.4E+38 3.4E+38 ECU_ADDRESS 0xfe4cc97c /* @ECU_Address@autosar_swc_vmp_rtARID_DEF.TmpSignalConversionAtEVM_CIPVOutport1[0].position.heading_angle@ */ /end MEASUREMENT
/begin MEASUREMENT autosar_swc_vmp_rtARID_DEF.TmpSignalConversionAtEVM_CIPVOutport1[0].position.x "" FLOAT32_IEEE autosar_swc_vmp_CM_single 0 0 -3.4E+38 3.4E+38 ECU_ADDRESS 0xfe4cc974 /* @ECU_Address@autosar_swc_vmp_rtARID_DEF.TmpSignalConversionAtEVM_CIPVOutport1[0].position.x@ */ /end MEASUREMENT
/begin MEASUREMENT autosar_swc_vmp_rtARID_DEF.TmpSignalConversionAtEVM_CIPVOutport1[0].position.y "" FLOAT32_IEEE autosar_swc_vmp_CM_single 0 0 -3.4E+38 3.4E+38 ECU_ADDRESS 0xfe4cc978 /* @ECU_Address@autosar_swc_vmp_rtARID_DEF.TmpSignalConversionAtEVM_CIPVOutport1[0].position.y@ */ /end MEASUREMENT
/begin MEASUREMENT autosar_swc_vmp_rtARID_DEF.TmpSignalConversionAtEVM_CIPVOutport1[0].position_sl.heading_angle "" FLOAT32_IEEE autosar_swc_vmp_CM_single 0 0 -3.4E+38 3.4E+38 ECU_ADDRESS 0xfe4cc988 /* @ECU_Address@autosar_swc_vmp_rtARID_DEF.TmpSignalConversionAtEVM_CIPVOutport1[0].position_sl.heading_angle@ */ /end MEASUREMENT
/begin MEASUREMENT autosar_swc_vmp_rtARID_DEF.TmpSignalConversionAtEVM_CIPVOutport1[0].position_sl.x "" FLOAT32_IEEE autosar_swc_vmp_CM_single 0 0 -3.4E+38 3.4E+38 ECU_ADDRESS 0xfe4cc980 /* @ECU_Address@autosar_swc_vmp_rtARID_DEF.TmpSignalConversionAtEVM_CIPVOutport1[0].position_sl.x@ */ /end MEASUREMENT
/begin MEASUREMENT autosar_swc_vmp_rtARID_DEF.TmpSignalConversionAtEVM_CIPVOutport1[0].position_sl.y "" FLOAT32_IEEE autosar_swc_vmp_CM_single 0 0 -3.4E+38 3.4E+38 ECU_ADDRESS 0xfe4cc984 /* @ECU_Address@autosar_swc_vmp_rtARID_DEF.TmpSignalConversionAtEVM_CIPVOutport1[0].position_sl.y@ */ /end MEASUREMENT
/begin MEASUREMENT autosar_swc_vmp_rtARID_DEF.TmpSignalConversionAtEVM_CIPVOutport1[0].ref_lane_id "" UBYTE autosar_swc_vmp_CM_uint8 0 0 0 255 ECU_ADDRESS 0xfe4cc94c /* @ECU_Address@autosar_swc_vmp_rtARID_DEF.TmpSignalConversionAtEVM_CIPVOutport1[0].ref_lane_id@ */ /end MEASUREMENT
/begin MEASUREMENT autosar_swc_vmp_rtARID_DEF.TmpSignalConversionAtEVM_CIPVOutport1[0].size.higth "" FLOAT32_IEEE autosar_swc_vmp_CM_single 0 0 -3.4E+38 3.4E+38 ECU_ADDRESS 0xfe4cc994 /* @ECU_Address@autosar_swc_vmp_rtARID_DEF.TmpSignalConversionAtEVM_CIPVOutport1[0].size.higth@ */ /end MEASUREMENT
/begin MEASUREMENT autosar_swc_vmp_rtARID_DEF.TmpSignalConversionAtEVM_CIPVOutport1[0].size.length "" FLOAT32_IEEE autosar_swc_vmp_CM_single 0 0 -3.4E+38 3.4E+38 ECU_ADDRESS 0xfe4cc98c /* @ECU_Address@autosar_swc_vmp_rtARID_DEF.TmpSignalConversionAtEVM_CIPVOutport1[0].size.length@ */ /end MEASUREMENT
/begin MEASUREMENT autosar_swc_vmp_rtARID_DEF.TmpSignalConversionAtEVM_CIPVOutport1[0].size.width "" FLOAT32_IEEE autosar_swc_vmp_CM_single 0 0 -3.4E+38 3.4E+38 ECU_ADDRESS 0xfe4cc990 /* @ECU_Address@autosar_swc_vmp_rtARID_DEF.TmpSignalConversionAtEVM_CIPVOutport1[0].size.width@ */ /end MEASUREMENT
/begin MEASUREMENT autosar_swc_vmp_rtARID_DEF.TmpSignalConversionAtEVM_CIPVOutport1[0].velocity_gnd.mod "" FLOAT32_IEEE autosar_swc_vmp_CM_single 0 0 -3.4E+38 3.4E+38 ECU_ADDRESS 0xfe4cc9a0 /* @ECU_Address@autosar_swc_vmp_rtARID_DEF.TmpSignalConversionAtEVM_CIPVOutport1[0].velocity_gnd.mod@ */ /end MEASUREMENT
/begin MEASUREMENT autosar_swc_vmp_rtARID_DEF.TmpSignalConversionAtEVM_CIPVOutport1[0].velocity_gnd.x "" FLOAT32_IEEE autosar_swc_vmp_CM_single 0 0 -3.4E+38 3.4E+38 ECU_ADDRESS 0xfe4cc998 /* @ECU_Address@autosar_swc_vmp_rtARID_DEF.TmpSignalConversionAtEVM_CIPVOutport1[0].velocity_gnd.x@ */ /end MEASUREMENT
/begin MEASUREMENT autosar_swc_vmp_rtARID_DEF.TmpSignalConversionAtEVM_CIPVOutport1[0].velocity_gnd.y "" FLOAT32_IEEE autosar_swc_vmp_CM_single 0 0 -3.4E+38 3.4E+38 ECU_ADDRESS 0xfe4cc99c /* @ECU_Address@autosar_swc_vmp_rtARID_DEF.TmpSignalConversionAtEVM_CIPVOutport1[0].velocity_gnd.y@ */ /end MEASUREMENT
/begin MEASUREMENT autosar_swc_vmp_rtARID_DEF.TmpSignalConversionAtEVM_CIPVOutport1[0].velocity_gnd_sl.mod "" FLOAT32_IEEE autosar_swc_vmp_CM_single 0 0 -3.4E+38 3.4E+38 ECU_ADDRESS 0xfe4cc9b8 /* @ECU_Address@autosar_swc_vmp_rtARID_DEF.TmpSignalConversionAtEVM_CIPVOutport1[0].velocity_gnd_sl.mod@ */ /end MEASUREMENT
/begin MEASUREMENT autosar_swc_vmp_rtARID_DEF.TmpSignalConversionAtEVM_CIPVOutport1[0].velocity_gnd_sl.x "" FLOAT32_IEEE autosar_swc_vmp_CM_single 0 0 -3.4E+38 3.4E+38 ECU_ADDRESS 0xfe4cc9b0 /* @ECU_Address@autosar_swc_vmp_rtARID_DEF.TmpSignalConversionAtEVM_CIPVOutport1[0].velocity_gnd_sl.x@ */ /end MEASUREMENT
/begin MEASUREMENT autosar_swc_vmp_rtARID_DEF.TmpSignalConversionAtEVM_CIPVOutport1[0].velocity_gnd_sl.y "" FLOAT32_IEEE autosar_swc_vmp_CM_single 0 0 -3.4E+38 3.4E+38 ECU_ADDRESS 0xfe4cc9b4 /* @ECU_Address@autosar_swc_vmp_rtARID_DEF.TmpSignalConversionAtEVM_CIPVOutport1[0].velocity_gnd_sl.y@ */ /end MEASUREMENT
/begin MEASUREMENT autosar_swc_vmp_rtARID_DEF.TmpSignalConversionAtEVM_CIPVOutport1[1].accel_gnd.mod "" FLOAT32_IEEE autosar_swc_vmp_CM_single 0 0 -3.4E+38 3.4E+38 ECU_ADDRESS 0xfe4cca2c /* @ECU_Address@autosar_swc_vmp_rtARID_DEF.TmpSignalConversionAtEVM_CIPVOutport1[1].accel_gnd.mod@ */ /end MEASUREMENT
/begin MEASUREMENT autosar_swc_vmp_rtARID_DEF.TmpSignalConversionAtEVM_CIPVOutport1[1].accel_gnd.x "" FLOAT32_IEEE autosar_swc_vmp_CM_single 0 0 -3.4E+38 3.4E+38 ECU_ADDRESS 0xfe4cca24 /* @ECU_Address@autosar_swc_vmp_rtARID_DEF.TmpSignalConversionAtEVM_CIPVOutport1[1].accel_gnd.x@ */ /end MEASUREMENT
/begin MEASUREMENT autosar_swc_vmp_rtARID_DEF.TmpSignalConversionAtEVM_CIPVOutport1[1].accel_gnd.y "" FLOAT32_IEEE autosar_swc_vmp_CM_single 0 0 -3.4E+38 3.4E+38 ECU_ADDRESS 0xfe4cca28 /* @ECU_Address@autosar_swc_vmp_rtARID_DEF.TmpSignalConversionAtEVM_CIPVOutport1[1].accel_gnd.y@ */ /end MEASUREMENT
/begin MEASUREMENT autosar_swc_vmp_rtARID_DEF.TmpSignalConversionAtEVM_CIPVOutport1[1].accel_gnd_sl.mod "" FLOAT32_IEEE autosar_swc_vmp_CM_single 0 0 -3.4E+38 3.4E+38 ECU_ADDRESS 0xfe4cca44 /* @ECU_Address@autosar_swc_vmp_rtARID_DEF.TmpSignalConversionAtEVM_CIPVOutport1[1].accel_gnd_sl.mod@ */ /end MEASUREMENT
/begin MEASUREMENT autosar_swc_vmp_rtARID_DEF.TmpSignalConversionAtEVM_CIPVOutport1[1].accel_gnd_sl.x "" FLOAT32_IEEE autosar_swc_vmp_CM_single 0 0 -3.4E+38 3.4E+38 ECU_ADDRESS 0xfe4cca3c /* @ECU_Address@autosar_swc_vmp_rtARID_DEF.TmpSignalConversionAtEVM_CIPVOutport1[1].accel_gnd_sl.x@ */ /end MEASUREMENT
/begin MEASUREMENT autosar_swc_vmp_rtARID_DEF.TmpSignalConversionAtEVM_CIPVOutport1[1].accel_gnd_sl.y "" FLOAT32_IEEE autosar_swc_vmp_CM_single 0 0 -3.4E+38 3.4E+38 ECU_ADDRESS 0xfe4cca40 /* @ECU_Address@autosar_swc_vmp_rtARID_DEF.TmpSignalConversionAtEVM_CIPVOutport1[1].accel_gnd_sl.y@ */ /end MEASUREMENT
/begin MEASUREMENT autosar_swc_vmp_rtARID_DEF.TmpSignalConversionAtEVM_CIPVOutport1[1].box.corner_x_vec "" FLOAT32_IEEE autosar_swc_vmp_CM_single 0 0 -3.4E+38 3.4E+38 LAYOUT COLUMN_DIR MATRIX_DIM 4 ECU_ADDRESS 0xfe4cc9d4 /* @ECU_Address@autosar_swc_vmp_rtARID_DEF.TmpSignalConversionAtEVM_CIPVOutport1[1].box.corner_x_vec@ */ /end MEASUREMENT
/begin MEASUREMENT autosar_swc_vmp_rtARID_DEF.TmpSignalConversionAtEVM_CIPVOutport1[1].box.corner_y_vec "" FLOAT32_IEEE autosar_swc_vmp_CM_single 0 0 -3.4E+38 3.4E+38 LAYOUT COLUMN_DIR MATRIX_DIM 4 ECU_ADDRESS 0xfe4cc9e4 /* @ECU_Address@autosar_swc_vmp_rtARID_DEF.TmpSignalConversionAtEVM_CIPVOutport1[1].box.corner_y_vec@ */ /end MEASUREMENT
/begin MEASUREMENT autosar_swc_vmp_rtARID_DEF.TmpSignalConversionAtEVM_CIPVOutport1[1].class_type "" UBYTE autosar_swc_vmp_CM_uint8 0 0 0 255 ECU_ADDRESS 0xfe4cc9ca /* @ECU_Address@autosar_swc_vmp_rtARID_DEF.TmpSignalConversionAtEVM_CIPVOutport1[1].class_type@ */ /end MEASUREMENT
/begin MEASUREMENT autosar_swc_vmp_rtARID_DEF.TmpSignalConversionAtEVM_CIPVOutport1[1].cut_type "" UBYTE autosar_swc_vmp_CM_uint8 0 0 0 255 ECU_ADDRESS 0xfe4cc9cb /* @ECU_Address@autosar_swc_vmp_rtARID_DEF.TmpSignalConversionAtEVM_CIPVOutport1[1].cut_type@ */ /end MEASUREMENT
/begin MEASUREMENT autosar_swc_vmp_rtARID_DEF.TmpSignalConversionAtEVM_CIPVOutport1[1].fus_type "" UBYTE autosar_swc_vmp_CM_uint8 0 0 0 255 ECU_ADDRESS 0xfe4cc9c9 /* @ECU_Address@autosar_swc_vmp_rtARID_DEF.TmpSignalConversionAtEVM_CIPVOutport1[1].fus_type@ */ /end MEASUREMENT
/begin MEASUREMENT autosar_swc_vmp_rtARID_DEF.TmpSignalConversionAtEVM_CIPVOutport1[1].id "" ULONG autosar_swc_vmp_CM_uint32 0 0 0 4294967295 ECU_ADDRESS 0xfe4cc9d0 /* @ECU_Address@autosar_swc_vmp_rtARID_DEF.TmpSignalConversionAtEVM_CIPVOutport1[1].id@ */ /end MEASUREMENT
/begin MEASUREMENT autosar_swc_vmp_rtARID_DEF.TmpSignalConversionAtEVM_CIPVOutport1[1].meas_state "" UBYTE autosar_swc_vmp_CM_uint8 0 0 0 255 ECU_ADDRESS 0xfe4cc9c8 /* @ECU_Address@autosar_swc_vmp_rtARID_DEF.TmpSignalConversionAtEVM_CIPVOutport1[1].meas_state@ */ /end MEASUREMENT
/begin MEASUREMENT autosar_swc_vmp_rtARID_DEF.TmpSignalConversionAtEVM_CIPVOutport1[1].position.heading_angle "" FLOAT32_IEEE autosar_swc_vmp_CM_single 0 0 -3.4E+38 3.4E+38 ECU_ADDRESS 0xfe4cc9fc /* @ECU_Address@autosar_swc_vmp_rtARID_DEF.TmpSignalConversionAtEVM_CIPVOutport1[1].position.heading_angle@ */ /end MEASUREMENT
/begin MEASUREMENT autosar_swc_vmp_rtARID_DEF.TmpSignalConversionAtEVM_CIPVOutport1[1].position.x "" FLOAT32_IEEE autosar_swc_vmp_CM_single 0 0 -3.4E+38 3.4E+38 ECU_ADDRESS 0xfe4cc9f4 /* @ECU_Address@autosar_swc_vmp_rtARID_DEF.TmpSignalConversionAtEVM_CIPVOutport1[1].position.x@ */ /end MEASUREMENT
/begin MEASUREMENT autosar_swc_vmp_rtARID_DEF.TmpSignalConversionAtEVM_CIPVOutport1[1].position.y "" FLOAT32_IEEE autosar_swc_vmp_CM_single 0 0 -3.4E+38 3.4E+38 ECU_ADDRESS 0xfe4cc9f8 /* @ECU_Address@autosar_swc_vmp_rtARID_DEF.TmpSignalConversionAtEVM_CIPVOutport1[1].position.y@ */ /end MEASUREMENT
/begin MEASUREMENT autosar_swc_vmp_rtARID_DEF.TmpSignalConversionAtEVM_CIPVOutport1[1].position_sl.heading_angle "" FLOAT32_IEEE autosar_swc_vmp_CM_single 0 0 -3.4E+38 3.4E+38 ECU_ADDRESS 0xfe4cca08 /* @ECU_Address@autosar_swc_vmp_rtARID_DEF.TmpSignalConversionAtEVM_CIPVOutport1[1].position_sl.heading_angle@ */ /end MEASUREMENT
/begin MEASUREMENT autosar_swc_vmp_rtARID_DEF.TmpSignalConversionAtEVM_CIPVOutport1[1].position_sl.x "" FLOAT32_IEEE autosar_swc_vmp_CM_single 0 0 -3.4E+38 3.4E+38 ECU_ADDRESS 0xfe4cca00 /* @ECU_Address@autosar_swc_vmp_rtARID_DEF.TmpSignalConversionAtEVM_CIPVOutport1[1].position_sl.x@ */ /end MEASUREMENT
/begin MEASUREMENT autosar_swc_vmp_rtARID_DEF.TmpSignalConversionAtEVM_CIPVOutport1[1].position_sl.y "" FLOAT32_IEEE autosar_swc_vmp_CM_single 0 0 -3.4E+38 3.4E+38 ECU_ADDRESS 0xfe4cca04 /* @ECU_Address@autosar_swc_vmp_rtARID_DEF.TmpSignalConversionAtEVM_CIPVOutport1[1].position_sl.y@ */ /end MEASUREMENT
/begin MEASUREMENT autosar_swc_vmp_rtARID_DEF.TmpSignalConversionAtEVM_CIPVOutport1[1].ref_lane_id "" UBYTE autosar_swc_vmp_CM_uint8 0 0 0 255 ECU_ADDRESS 0xfe4cc9cc /* @ECU_Address@autosar_swc_vmp_rtARID_DEF.TmpSignalConversionAtEVM_CIPVOutport1[1].ref_lane_id@ */ /end MEASUREMENT
/begin MEASUREMENT autosar_swc_vmp_rtARID_DEF.TmpSignalConversionAtEVM_CIPVOutport1[1].size.higth "" FLOAT32_IEEE autosar_swc_vmp_CM_single 0 0 -3.4E+38 3.4E+38 ECU_ADDRESS 0xfe4cca14 /* @ECU_Address@autosar_swc_vmp_rtARID_DEF.TmpSignalConversionAtEVM_CIPVOutport1[1].size.higth@ */ /end MEASUREMENT
/begin MEASUREMENT autosar_swc_vmp_rtARID_DEF.TmpSignalConversionAtEVM_CIPVOutport1[1].size.length "" FLOAT32_IEEE autosar_swc_vmp_CM_single 0 0 -3.4E+38 3.4E+38 ECU_ADDRESS 0xfe4cca0c /* @ECU_Address@autosar_swc_vmp_rtARID_DEF.TmpSignalConversionAtEVM_CIPVOutport1[1].size.length@ */ /end MEASUREMENT
/begin MEASUREMENT autosar_swc_vmp_rtARID_DEF.TmpSignalConversionAtEVM_CIPVOutport1[1].size.width "" FLOAT32_IEEE autosar_swc_vmp_CM_single 0 0 -3.4E+38 3.4E+38 ECU_ADDRESS 0xfe4cca10 /* @ECU_Address@autosar_swc_vmp_rtARID_DEF.TmpSignalConversionAtEVM_CIPVOutport1[1].size.width@ */ /end MEASUREMENT
/begin MEASUREMENT autosar_swc_vmp_rtARID_DEF.TmpSignalConversionAtEVM_CIPVOutport1[1].velocity_gnd.mod "" FLOAT32_IEEE autosar_swc_vmp_CM_single 0 0 -3.4E+38 3.4E+38 ECU_ADDRESS 0xfe4cca20 /* @ECU_Address@autosar_swc_vmp_rtARID_DEF.TmpSignalConversionAtEVM_CIPVOutport1[1].velocity_gnd.mod@ */ /end MEASUREMENT
/begin MEASUREMENT autosar_swc_vmp_rtARID_DEF.TmpSignalConversionAtEVM_CIPVOutport1[1].velocity_gnd.x "" FLOAT32_IEEE autosar_swc_vmp_CM_single 0 0 -3.4E+38 3.4E+38 ECU_ADDRESS 0xfe4cca18 /* @ECU_Address@autosar_swc_vmp_rtARID_DEF.TmpSignalConversionAtEVM_CIPVOutport1[1].velocity_gnd.x@ */ /end MEASUREMENT
/begin MEASUREMENT autosar_swc_vmp_rtARID_DEF.TmpSignalConversionAtEVM_CIPVOutport1[1].velocity_gnd.y "" FLOAT32_IEEE autosar_swc_vmp_CM_single 0 0 -3.4E+38 3.4E+38 ECU_ADDRESS 0xfe4cca1c /* @ECU_Address@autosar_swc_vmp_rtARID_DEF.TmpSignalConversionAtEVM_CIPVOutport1[1].velocity_gnd.y@ */ /end MEASUREMENT
/begin MEASUREMENT autosar_swc_vmp_rtARID_DEF.TmpSignalConversionAtEVM_CIPVOutport1[1].velocity_gnd_sl.mod "" FLOAT32_IEEE autosar_swc_vmp_CM_single 0 0 -3.4E+38 3.4E+38 ECU_ADDRESS 0xfe4cca38 /* @ECU_Address@autosar_swc_vmp_rtARID_DEF.TmpSignalConversionAtEVM_CIPVOutport1[1].velocity_gnd_sl.mod@ */ /end MEASUREMENT
/begin MEASUREMENT autosar_swc_vmp_rtARID_DEF.TmpSignalConversionAtEVM_CIPVOutport1[1].velocity_gnd_sl.x "" FLOAT32_IEEE autosar_swc_vmp_CM_single 0 0 -3.4E+38 3.4E+38 ECU_ADDRESS 0xfe4cca30 /* @ECU_Address@autosar_swc_vmp_rtARID_DEF.TmpSignalConversionAtEVM_CIPVOutport1[1].velocity_gnd_sl.x@ */ /end MEASUREMENT
/begin MEASUREMENT autosar_swc_vmp_rtARID_DEF.TmpSignalConversionAtEVM_CIPVOutport1[1].velocity_gnd_sl.y "" FLOAT32_IEEE autosar_swc_vmp_CM_single 0 0 -3.4E+38 3.4E+38 ECU_ADDRESS 0xfe4cca34 /* @ECU_Address@autosar_swc_vmp_rtARID_DEF.TmpSignalConversionAtEVM_CIPVOutport1[1].velocity_gnd_sl.y@ */ /end MEASUREMENT
/begin MEASUREMENT autosar_swc_vmp_rtARID_DEF.TmpSignalConversionAtEVM_CIPVOutport1[2].accel_gnd.mod "" FLOAT32_IEEE autosar_swc_vmp_CM_single 0 0 -3.4E+38 3.4E+38 ECU_ADDRESS 0xfe4ccaac /* @ECU_Address@autosar_swc_vmp_rtARID_DEF.TmpSignalConversionAtEVM_CIPVOutport1[2].accel_gnd.mod@ */ /end MEASUREMENT
/begin MEASUREMENT autosar_swc_vmp_rtARID_DEF.TmpSignalConversionAtEVM_CIPVOutport1[2].accel_gnd.x "" FLOAT32_IEEE autosar_swc_vmp_CM_single 0 0 -3.4E+38 3.4E+38 ECU_ADDRESS 0xfe4ccaa4 /* @ECU_Address@autosar_swc_vmp_rtARID_DEF.TmpSignalConversionAtEVM_CIPVOutport1[2].accel_gnd.x@ */ /end MEASUREMENT
/begin MEASUREMENT autosar_swc_vmp_rtARID_DEF.TmpSignalConversionAtEVM_CIPVOutport1[2].accel_gnd.y "" FLOAT32_IEEE autosar_swc_vmp_CM_single 0 0 -3.4E+38 3.4E+38 ECU_ADDRESS 0xfe4ccaa8 /* @ECU_Address@autosar_swc_vmp_rtARID_DEF.TmpSignalConversionAtEVM_CIPVOutport1[2].accel_gnd.y@ */ /end MEASUREMENT
/begin MEASUREMENT autosar_swc_vmp_rtARID_DEF.TmpSignalConversionAtEVM_CIPVOutport1[2].accel_gnd_sl.mod "" FLOAT32_IEEE autosar_swc_vmp_CM_single 0 0 -3.4E+38 3.4E+38 ECU_ADDRESS 0xfe4ccac4 /* @ECU_Address@autosar_swc_vmp_rtARID_DEF.TmpSignalConversionAtEVM_CIPVOutport1[2].accel_gnd_sl.mod@ */ /end MEASUREMENT
/begin MEASUREMENT autosar_swc_vmp_rtARID_DEF.TmpSignalConversionAtEVM_CIPVOutport1[2].accel_gnd_sl.x "" FLOAT32_IEEE autosar_swc_vmp_CM_single 0 0 -3.4E+38 3.4E+38 ECU_ADDRESS 0xfe4ccabc /* @ECU_Address@autosar_swc_vmp_rtARID_DEF.TmpSignalConversionAtEVM_CIPVOutport1[2].accel_gnd_sl.x@ */ /end MEASUREMENT
/begin MEASUREMENT autosar_swc_vmp_rtARID_DEF.TmpSignalConversionAtEVM_CIPVOutport1[2].accel_gnd_sl.y "" FLOAT32_IEEE autosar_swc_vmp_CM_single 0 0 -3.4E+38 3.4E+38 ECU_ADDRESS 0xfe4ccac0 /* @ECU_Address@autosar_swc_vmp_rtARID_DEF.TmpSignalConversionAtEVM_CIPVOutport1[2].accel_gnd_sl.y@ */ /end MEASUREMENT
/begin MEASUREMENT autosar_swc_vmp_rtARID_DEF.TmpSignalConversionAtEVM_CIPVOutport1[2].box.corner_x_vec "" FLOAT32_IEEE autosar_swc_vmp_CM_single 0 0 -3.4E+38 3.4E+38 LAYOUT COLUMN_DIR MATRIX_DIM 4 ECU_ADDRESS 0xfe4cca54 /* @ECU_Address@autosar_swc_vmp_rtARID_DEF.TmpSignalConversionAtEVM_CIPVOutport1[2].box.corner_x_vec@ */ /end MEASUREMENT
/begin MEASUREMENT autosar_swc_vmp_rtARID_DEF.TmpSignalConversionAtEVM_CIPVOutport1[2].box.corner_y_vec "" FLOAT32_IEEE autosar_swc_vmp_CM_single 0 0 -3.4E+38 3.4E+38 LAYOUT COLUMN_DIR MATRIX_DIM 4 ECU_ADDRESS 0xfe4cca64 /* @ECU_Address@autosar_swc_vmp_rtARID_DEF.TmpSignalConversionAtEVM_CIPVOutport1[2].box.corner_y_vec@ */ /end MEASUREMENT
/begin MEASUREMENT autosar_swc_vmp_rtARID_DEF.TmpSignalConversionAtEVM_CIPVOutport1[2].class_type "" UBYTE autosar_swc_vmp_CM_uint8 0 0 0 255 ECU_ADDRESS 0xfe4cca4a /* @ECU_Address@autosar_swc_vmp_rtARID_DEF.TmpSignalConversionAtEVM_CIPVOutport1[2].class_type@ */ /end MEASUREMENT
/begin MEASUREMENT autosar_swc_vmp_rtARID_DEF.TmpSignalConversionAtEVM_CIPVOutport1[2].cut_type "" UBYTE autosar_swc_vmp_CM_uint8 0 0 0 255 ECU_ADDRESS 0xfe4cca4b /* @ECU_Address@autosar_swc_vmp_rtARID_DEF.TmpSignalConversionAtEVM_CIPVOutport1[2].cut_type@ */ /end MEASUREMENT
/begin MEASUREMENT autosar_swc_vmp_rtARID_DEF.TmpSignalConversionAtEVM_CIPVOutport1[2].fus_type "" UBYTE autosar_swc_vmp_CM_uint8 0 0 0 255 ECU_ADDRESS 0xfe4cca49 /* @ECU_Address@autosar_swc_vmp_rtARID_DEF.TmpSignalConversionAtEVM_CIPVOutport1[2].fus_type@ */ /end MEASUREMENT
/begin MEASUREMENT autosar_swc_vmp_rtARID_DEF.TmpSignalConversionAtEVM_CIPVOutport1[2].id "" ULONG autosar_swc_vmp_CM_uint32 0 0 0 4294967295 ECU_ADDRESS 0xfe4cca50 /* @ECU_Address@autosar_swc_vmp_rtARID_DEF.TmpSignalConversionAtEVM_CIPVOutport1[2].id@ */ /end MEASUREMENT
/begin MEASUREMENT autosar_swc_vmp_rtARID_DEF.TmpSignalConversionAtEVM_CIPVOutport1[2].meas_state "" UBYTE autosar_swc_vmp_CM_uint8 0 0 0 255 ECU_ADDRESS 0xfe4cca48 /* @ECU_Address@autosar_swc_vmp_rtARID_DEF.TmpSignalConversionAtEVM_CIPVOutport1[2].meas_state@ */ /end MEASUREMENT
/begin MEASUREMENT autosar_swc_vmp_rtARID_DEF.TmpSignalConversionAtEVM_CIPVOutport1[2].position.heading_angle "" FLOAT32_IEEE autosar_swc_vmp_CM_single 0 0 -3.4E+38 3.4E+38 ECU_ADDRESS 0xfe4cca7c /* @ECU_Address@autosar_swc_vmp_rtARID_DEF.TmpSignalConversionAtEVM_CIPVOutport1[2].position.heading_angle@ */ /end MEASUREMENT
/begin MEASUREMENT autosar_swc_vmp_rtARID_DEF.TmpSignalConversionAtEVM_CIPVOutport1[2].position.x "" FLOAT32_IEEE autosar_swc_vmp_CM_single 0 0 -3.4E+38 3.4E+38 ECU_ADDRESS 0xfe4cca74 /* @ECU_Address@autosar_swc_vmp_rtARID_DEF.TmpSignalConversionAtEVM_CIPVOutport1[2].position.x@ */ /end MEASUREMENT
/begin MEASUREMENT autosar_swc_vmp_rtARID_DEF.TmpSignalConversionAtEVM_CIPVOutport1[2].position.y "" FLOAT32_IEEE autosar_swc_vmp_CM_single 0 0 -3.4E+38 3.4E+38 ECU_ADDRESS 0xfe4cca78 /* @ECU_Address@autosar_swc_vmp_rtARID_DEF.TmpSignalConversionAtEVM_CIPVOutport1[2].position.y@ */ /end MEASUREMENT
/begin MEASUREMENT autosar_swc_vmp_rtARID_DEF.TmpSignalConversionAtEVM_CIPVOutport1[2].position_sl.heading_angle "" FLOAT32_IEEE autosar_swc_vmp_CM_single 0 0 -3.4E+38 3.4E+38 ECU_ADDRESS 0xfe4cca88 /* @ECU_Address@autosar_swc_vmp_rtARID_DEF.TmpSignalConversionAtEVM_CIPVOutport1[2].position_sl.heading_angle@ */ /end MEASUREMENT
/begin MEASUREMENT autosar_swc_vmp_rtARID_DEF.TmpSignalConversionAtEVM_CIPVOutport1[2].position_sl.x "" FLOAT32_IEEE autosar_swc_vmp_CM_single 0 0 -3.4E+38 3.4E+38 ECU_ADDRESS 0xfe4cca80 /* @ECU_Address@autosar_swc_vmp_rtARID_DEF.TmpSignalConversionAtEVM_CIPVOutport1[2].position_sl.x@ */ /end MEASUREMENT
/begin MEASUREMENT autosar_swc_vmp_rtARID_DEF.TmpSignalConversionAtEVM_CIPVOutport1[2].position_sl.y "" FLOAT32_IEEE autosar_swc_vmp_CM_single 0 0 -3.4E+38 3.4E+38 ECU_ADDRESS 0xfe4cca84 /* @ECU_Address@autosar_swc_vmp_rtARID_DEF.TmpSignalConversionAtEVM_CIPVOutport1[2].position_sl.y@ */ /end MEASUREMENT
/begin MEASUREMENT autosar_swc_vmp_rtARID_DEF.TmpSignalConversionAtEVM_CIPVOutport1[2].ref_lane_id "" UBYTE autosar_swc_vmp_CM_uint8 0 0 0 255 ECU_ADDRESS 0xfe4cca4c /* @ECU_Address@autosar_swc_vmp_rtARID_DEF.TmpSignalConversionAtEVM_CIPVOutport1[2].ref_lane_id@ */ /end MEASUREMENT
/begin MEASUREMENT autosar_swc_vmp_rtARID_DEF.TmpSignalConversionAtEVM_CIPVOutport1[2].size.higth "" FLOAT32_IEEE autosar_swc_vmp_CM_single 0 0 -3.4E+38 3.4E+38 ECU_ADDRESS 0xfe4cca94 /* @ECU_Address@autosar_swc_vmp_rtARID_DEF.TmpSignalConversionAtEVM_CIPVOutport1[2].size.higth@ */ /end MEASUREMENT
/begin MEASUREMENT autosar_swc_vmp_rtARID_DEF.TmpSignalConversionAtEVM_CIPVOutport1[2].size.length "" FLOAT32_IEEE autosar_swc_vmp_CM_single 0 0 -3.4E+38 3.4E+38 ECU_ADDRESS 0xfe4cca8c /* @ECU_Address@autosar_swc_vmp_rtARID_DEF.TmpSignalConversionAtEVM_CIPVOutport1[2].size.length@ */ /end MEASUREMENT
/begin MEASUREMENT autosar_swc_vmp_rtARID_DEF.TmpSignalConversionAtEVM_CIPVOutport1[2].size.width "" FLOAT32_IEEE autosar_swc_vmp_CM_single 0 0 -3.4E+38 3.4E+38 ECU_ADDRESS 0xfe4cca90 /* @ECU_Address@autosar_swc_vmp_rtARID_DEF.TmpSignalConversionAtEVM_CIPVOutport1[2].size.width@ */ /end MEASUREMENT
/begin MEASUREMENT autosar_swc_vmp_rtARID_DEF.TmpSignalConversionAtEVM_CIPVOutport1[2].velocity_gnd.mod "" FLOAT32_IEEE autosar_swc_vmp_CM_single 0 0 -3.4E+38 3.4E+38 ECU_ADDRESS 0xfe4ccaa0 /* @ECU_Address@autosar_swc_vmp_rtARID_DEF.TmpSignalConversionAtEVM_CIPVOutport1[2].velocity_gnd.mod@ */ /end MEASUREMENT
/begin MEASUREMENT autosar_swc_vmp_rtARID_DEF.TmpSignalConversionAtEVM_CIPVOutport1[2].velocity_gnd.x "" FLOAT32_IEEE autosar_swc_vmp_CM_single 0 0 -3.4E+38 3.4E+38 ECU_ADDRESS 0xfe4cca98 /* @ECU_Address@autosar_swc_vmp_rtARID_DEF.TmpSignalConversionAtEVM_CIPVOutport1[2].velocity_gnd.x@ */ /end MEASUREMENT
/begin MEASUREMENT autosar_swc_vmp_rtARID_DEF.TmpSignalConversionAtEVM_CIPVOutport1[2].velocity_gnd.y "" FLOAT32_IEEE autosar_swc_vmp_CM_single 0 0 -3.4E+38 3.4E+38 ECU_ADDRESS 0xfe4cca9c /* @ECU_Address@autosar_swc_vmp_rtARID_DEF.TmpSignalConversionAtEVM_CIPVOutport1[2].velocity_gnd.y@ */ /end MEASUREMENT
/begin MEASUREMENT autosar_swc_vmp_rtARID_DEF.TmpSignalConversionAtEVM_CIPVOutport1[2].velocity_gnd_sl.mod "" FLOAT32_IEEE autosar_swc_vmp_CM_single 0 0 -3.4E+38 3.4E+38 ECU_ADDRESS 0xfe4ccab8 /* @ECU_Address@autosar_swc_vmp_rtARID_DEF.TmpSignalConversionAtEVM_CIPVOutport1[2].velocity_gnd_sl.mod@ */ /end MEASUREMENT
/begin MEASUREMENT autosar_swc_vmp_rtARID_DEF.TmpSignalConversionAtEVM_CIPVOutport1[2].velocity_gnd_sl.x "" FLOAT32_IEEE autosar_swc_vmp_CM_single 0 0 -3.4E+38 3.4E+38 ECU_ADDRESS 0xfe4ccab0 /* @ECU_Address@autosar_swc_vmp_rtARID_DEF.TmpSignalConversionAtEVM_CIPVOutport1[2].velocity_gnd_sl.x@ */ /end MEASUREMENT
/begin MEASUREMENT autosar_swc_vmp_rtARID_DEF.TmpSignalConversionAtEVM_CIPVOutport1[2].velocity_gnd_sl.y "" FLOAT32_IEEE autosar_swc_vmp_CM_single 0 0 -3.4E+38 3.4E+38 ECU_ADDRESS 0xfe4ccab4 /* @ECU_Address@autosar_swc_vmp_rtARID_DEF.TmpSignalConversionAtEVM_CIPVOutport1[2].velocity_gnd_sl.y@ */ /end MEASUREMENT
/begin MEASUREMENT autosar_swc_vmp_rtARID_DEF.TmpSignalConversionAtEVM_CIPVOutport1[3].accel_gnd.mod "" FLOAT32_IEEE autosar_swc_vmp_CM_single 0 0 -3.4E+38 3.4E+38 ECU_ADDRESS 0xfe4ccb2c /* @ECU_Address@autosar_swc_vmp_rtARID_DEF.TmpSignalConversionAtEVM_CIPVOutport1[3].accel_gnd.mod@ */ /end MEASUREMENT
/begin MEASUREMENT autosar_swc_vmp_rtARID_DEF.TmpSignalConversionAtEVM_CIPVOutport1[3].accel_gnd.x "" FLOAT32_IEEE autosar_swc_vmp_CM_single 0 0 -3.4E+38 3.4E+38 ECU_ADDRESS 0xfe4ccb24 /* @ECU_Address@autosar_swc_vmp_rtARID_DEF.TmpSignalConversionAtEVM_CIPVOutport1[3].accel_gnd.x@ */ /end MEASUREMENT
/begin MEASUREMENT autosar_swc_vmp_rtARID_DEF.TmpSignalConversionAtEVM_CIPVOutport1[3].accel_gnd.y "" FLOAT32_IEEE autosar_swc_vmp_CM_single 0 0 -3.4E+38 3.4E+38 ECU_ADDRESS 0xfe4ccb28 /* @ECU_Address@autosar_swc_vmp_rtARID_DEF.TmpSignalConversionAtEVM_CIPVOutport1[3].accel_gnd.y@ */ /end MEASUREMENT
/begin MEASUREMENT autosar_swc_vmp_rtARID_DEF.TmpSignalConversionAtEVM_CIPVOutport1[3].accel_gnd_sl.mod "" FLOAT32_IEEE autosar_swc_vmp_CM_single 0 0 -3.4E+38 3.4E+38 ECU_ADDRESS 0xfe4ccb44 /* @ECU_Address@autosar_swc_vmp_rtARID_DEF.TmpSignalConversionAtEVM_CIPVOutport1[3].accel_gnd_sl.mod@ */ /end MEASUREMENT
/begin MEASUREMENT autosar_swc_vmp_rtARID_DEF.TmpSignalConversionAtEVM_CIPVOutport1[3].accel_gnd_sl.x "" FLOAT32_IEEE autosar_swc_vmp_CM_single 0 0 -3.4E+38 3.4E+38 ECU_ADDRESS 0xfe4ccb3c /* @ECU_Address@autosar_swc_vmp_rtARID_DEF.TmpSignalConversionAtEVM_CIPVOutport1[3].accel_gnd_sl.x@ */ /end MEASUREMENT
/begin MEASUREMENT autosar_swc_vmp_rtARID_DEF.TmpSignalConversionAtEVM_CIPVOutport1[3].accel_gnd_sl.y "" FLOAT32_IEEE autosar_swc_vmp_CM_single 0 0 -3.4E+38 3.4E+38 ECU_ADDRESS 0xfe4ccb40 /* @ECU_Address@autosar_swc_vmp_rtARID_DEF.TmpSignalConversionAtEVM_CIPVOutport1[3].accel_gnd_sl.y@ */ /end MEASUREMENT
/begin MEASUREMENT autosar_swc_vmp_rtARID_DEF.TmpSignalConversionAtEVM_CIPVOutport1[3].box.corner_x_vec "" FLOAT32_IEEE autosar_swc_vmp_CM_single 0 0 -3.4E+38 3.4E+38 LAYOUT COLUMN_DIR MATRIX_DIM 4 ECU_ADDRESS 0xfe4ccad4 /* @ECU_Address@autosar_swc_vmp_rtARID_DEF.TmpSignalConversionAtEVM_CIPVOutport1[3].box.corner_x_vec@ */ /end MEASUREMENT
/begin MEASUREMENT autosar_swc_vmp_rtARID_DEF.TmpSignalConversionAtEVM_CIPVOutport1[3].box.corner_y_vec "" FLOAT32_IEEE autosar_swc_vmp_CM_single 0 0 -3.4E+38 3.4E+38 LAYOUT COLUMN_DIR MATRIX_DIM 4 ECU_ADDRESS 0xfe4ccae4 /* @ECU_Address@autosar_swc_vmp_rtARID_DEF.TmpSignalConversionAtEVM_CIPVOutport1[3].box.corner_y_vec@ */ /end MEASUREMENT
/begin MEASUREMENT autosar_swc_vmp_rtARID_DEF.TmpSignalConversionAtEVM_CIPVOutport1[3].class_type "" UBYTE autosar_swc_vmp_CM_uint8 0 0 0 255 ECU_ADDRESS 0xfe4ccaca /* @ECU_Address@autosar_swc_vmp_rtARID_DEF.TmpSignalConversionAtEVM_CIPVOutport1[3].class_type@ */ /end MEASUREMENT
/begin MEASUREMENT autosar_swc_vmp_rtARID_DEF.TmpSignalConversionAtEVM_CIPVOutport1[3].cut_type "" UBYTE autosar_swc_vmp_CM_uint8 0 0 0 255 ECU_ADDRESS 0xfe4ccacb /* @ECU_Address@autosar_swc_vmp_rtARID_DEF.TmpSignalConversionAtEVM_CIPVOutport1[3].cut_type@ */ /end MEASUREMENT
/begin MEASUREMENT autosar_swc_vmp_rtARID_DEF.TmpSignalConversionAtEVM_CIPVOutport1[3].fus_type "" UBYTE autosar_swc_vmp_CM_uint8 0 0 0 255 ECU_ADDRESS 0xfe4ccac9 /* @ECU_Address@autosar_swc_vmp_rtARID_DEF.TmpSignalConversionAtEVM_CIPVOutport1[3].fus_type@ */ /end MEASUREMENT
/begin MEASUREMENT autosar_swc_vmp_rtARID_DEF.TmpSignalConversionAtEVM_CIPVOutport1[3].id "" ULONG autosar_swc_vmp_CM_uint32 0 0 0 4294967295 ECU_ADDRESS 0xfe4ccad0 /* @ECU_Address@autosar_swc_vmp_rtARID_DEF.TmpSignalConversionAtEVM_CIPVOutport1[3].id@ */ /end MEASUREMENT
/begin MEASUREMENT autosar_swc_vmp_rtARID_DEF.TmpSignalConversionAtEVM_CIPVOutport1[3].meas_state "" UBYTE autosar_swc_vmp_CM_uint8 0 0 0 255 ECU_ADDRESS 0xfe4ccac8 /* @ECU_Address@autosar_swc_vmp_rtARID_DEF.TmpSignalConversionAtEVM_CIPVOutport1[3].meas_state@ */ /end MEASUREMENT
/begin MEASUREMENT autosar_swc_vmp_rtARID_DEF.TmpSignalConversionAtEVM_CIPVOutport1[3].position.heading_angle "" FLOAT32_IEEE autosar_swc_vmp_CM_single 0 0 -3.4E+38 3.4E+38 ECU_ADDRESS 0xfe4ccafc /* @ECU_Address@autosar_swc_vmp_rtARID_DEF.TmpSignalConversionAtEVM_CIPVOutport1[3].position.heading_angle@ */ /end MEASUREMENT
/begin MEASUREMENT autosar_swc_vmp_rtARID_DEF.TmpSignalConversionAtEVM_CIPVOutport1[3].position.x "" FLOAT32_IEEE autosar_swc_vmp_CM_single 0 0 -3.4E+38 3.4E+38 ECU_ADDRESS 0xfe4ccaf4 /* @ECU_Address@autosar_swc_vmp_rtARID_DEF.TmpSignalConversionAtEVM_CIPVOutport1[3].position.x@ */ /end MEASUREMENT
/begin MEASUREMENT autosar_swc_vmp_rtARID_DEF.TmpSignalConversionAtEVM_CIPVOutport1[3].position.y "" FLOAT32_IEEE autosar_swc_vmp_CM_single 0 0 -3.4E+38 3.4E+38 ECU_ADDRESS 0xfe4ccaf8 /* @ECU_Address@autosar_swc_vmp_rtARID_DEF.TmpSignalConversionAtEVM_CIPVOutport1[3].position.y@ */ /end MEASUREMENT
/begin MEASUREMENT autosar_swc_vmp_rtARID_DEF.TmpSignalConversionAtEVM_CIPVOutport1[3].position_sl.heading_angle "" FLOAT32_IEEE autosar_swc_vmp_CM_single 0 0 -3.4E+38 3.4E+38 ECU_ADDRESS 0xfe4ccb08 /* @ECU_Address@autosar_swc_vmp_rtARID_DEF.TmpSignalConversionAtEVM_CIPVOutport1[3].position_sl.heading_angle@ */ /end MEASUREMENT
/begin MEASUREMENT autosar_swc_vmp_rtARID_DEF.TmpSignalConversionAtEVM_CIPVOutport1[3].position_sl.x "" FLOAT32_IEEE autosar_swc_vmp_CM_single 0 0 -3.4E+38 3.4E+38 ECU_ADDRESS 0xfe4ccb00 /* @ECU_Address@autosar_swc_vmp_rtARID_DEF.TmpSignalConversionAtEVM_CIPVOutport1[3].position_sl.x@ */ /end MEASUREMENT
/begin MEASUREMENT autosar_swc_vmp_rtARID_DEF.TmpSignalConversionAtEVM_CIPVOutport1[3].position_sl.y "" FLOAT32_IEEE autosar_swc_vmp_CM_single 0 0 -3.4E+38 3.4E+38 ECU_ADDRESS 0xfe4ccb04 /* @ECU_Address@autosar_swc_vmp_rtARID_DEF.TmpSignalConversionAtEVM_CIPVOutport1[3].position_sl.y@ */ /end MEASUREMENT
/begin MEASUREMENT autosar_swc_vmp_rtARID_DEF.TmpSignalConversionAtEVM_CIPVOutport1[3].ref_lane_id "" UBYTE autosar_swc_vmp_CM_uint8 0 0 0 255 ECU_ADDRESS 0xfe4ccacc /* @ECU_Address@autosar_swc_vmp_rtARID_DEF.TmpSignalConversionAtEVM_CIPVOutport1[3].ref_lane_id@ */ /end MEASUREMENT
/begin MEASUREMENT autosar_swc_vmp_rtARID_DEF.TmpSignalConversionAtEVM_CIPVOutport1[3].size.higth "" FLOAT32_IEEE autosar_swc_vmp_CM_single 0 0 -3.4E+38 3.4E+38 ECU_ADDRESS 0xfe4ccb14 /* @ECU_Address@autosar_swc_vmp_rtARID_DEF.TmpSignalConversionAtEVM_CIPVOutport1[3].size.higth@ */ /end MEASUREMENT
/begin MEASUREMENT autosar_swc_vmp_rtARID_DEF.TmpSignalConversionAtEVM_CIPVOutport1[3].size.length "" FLOAT32_IEEE autosar_swc_vmp_CM_single 0 0 -3.4E+38 3.4E+38 ECU_ADDRESS 0xfe4ccb0c /* @ECU_Address@autosar_swc_vmp_rtARID_DEF.TmpSignalConversionAtEVM_CIPVOutport1[3].size.length@ */ /end MEASUREMENT
/begin MEASUREMENT autosar_swc_vmp_rtARID_DEF.TmpSignalConversionAtEVM_CIPVOutport1[3].size.width "" FLOAT32_IEEE autosar_swc_vmp_CM_single 0 0 -3.4E+38 3.4E+38 ECU_ADDRESS 0xfe4ccb10 /* @ECU_Address@autosar_swc_vmp_rtARID_DEF.TmpSignalConversionAtEVM_CIPVOutport1[3].size.width@ */ /end MEASUREMENT
/begin MEASUREMENT autosar_swc_vmp_rtARID_DEF.TmpSignalConversionAtEVM_CIPVOutport1[3].velocity_gnd.mod "" FLOAT32_IEEE autosar_swc_vmp_CM_single 0 0 -3.4E+38 3.4E+38 ECU_ADDRESS 0xfe4ccb20 /* @ECU_Address@autosar_swc_vmp_rtARID_DEF.TmpSignalConversionAtEVM_CIPVOutport1[3].velocity_gnd.mod@ */ /end MEASUREMENT
/begin MEASUREMENT autosar_swc_vmp_rtARID_DEF.TmpSignalConversionAtEVM_CIPVOutport1[3].velocity_gnd.x "" FLOAT32_IEEE autosar_swc_vmp_CM_single 0 0 -3.4E+38 3.4E+38 ECU_ADDRESS 0xfe4ccb18 /* @ECU_Address@autosar_swc_vmp_rtARID_DEF.TmpSignalConversionAtEVM_CIPVOutport1[3].velocity_gnd.x@ */ /end MEASUREMENT
/begin MEASUREMENT autosar_swc_vmp_rtARID_DEF.TmpSignalConversionAtEVM_CIPVOutport1[3].velocity_gnd.y "" FLOAT32_IEEE autosar_swc_vmp_CM_single 0 0 -3.4E+38 3.4E+38 ECU_ADDRESS 0xfe4ccb1c /* @ECU_Address@autosar_swc_vmp_rtARID_DEF.TmpSignalConversionAtEVM_CIPVOutport1[3].velocity_gnd.y@ */ /end MEASUREMENT
/begin MEASUREMENT autosar_swc_vmp_rtARID_DEF.TmpSignalConversionAtEVM_CIPVOutport1[3].velocity_gnd_sl.mod "" FLOAT32_IEEE autosar_swc_vmp_CM_single 0 0 -3.4E+38 3.4E+38 ECU_ADDRESS 0xfe4ccb38 /* @ECU_Address@autosar_swc_vmp_rtARID_DEF.TmpSignalConversionAtEVM_CIPVOutport1[3].velocity_gnd_sl.mod@ */ /end MEASUREMENT
/begin MEASUREMENT autosar_swc_vmp_rtARID_DEF.TmpSignalConversionAtEVM_CIPVOutport1[3].velocity_gnd_sl.x "" FLOAT32_IEEE autosar_swc_vmp_CM_single 0 0 -3.4E+38 3.4E+38 ECU_ADDRESS 0xfe4ccb30 /* @ECU_Address@autosar_swc_vmp_rtARID_DEF.TmpSignalConversionAtEVM_CIPVOutport1[3].velocity_gnd_sl.x@ */ /end MEASUREMENT
/begin MEASUREMENT autosar_swc_vmp_rtARID_DEF.TmpSignalConversionAtEVM_CIPVOutport1[3].velocity_gnd_sl.y "" FLOAT32_IEEE autosar_swc_vmp_CM_single 0 0 -3.4E+38 3.4E+38 ECU_ADDRESS 0xfe4ccb34 /* @ECU_Address@autosar_swc_vmp_rtARID_DEF.TmpSignalConversionAtEVM_CIPVOutport1[3].velocity_gnd_sl.y@ */ /end MEASUREMENT
/begin MEASUREMENT autosar_swc_vmp_rtARID_DEF.TmpSignalConversionAtEVM_CIPVOutport1[4].accel_gnd.mod "" FLOAT32_IEEE autosar_swc_vmp_CM_single 0 0 -3.4E+38 3.4E+38 ECU_ADDRESS 0xfe4ccbac /* @ECU_Address@autosar_swc_vmp_rtARID_DEF.TmpSignalConversionAtEVM_CIPVOutport1[4].accel_gnd.mod@ */ /end MEASUREMENT
/begin MEASUREMENT autosar_swc_vmp_rtARID_DEF.TmpSignalConversionAtEVM_CIPVOutport1[4].accel_gnd.x "" FLOAT32_IEEE autosar_swc_vmp_CM_single 0 0 -3.4E+38 3.4E+38 ECU_ADDRESS 0xfe4ccba4 /* @ECU_Address@autosar_swc_vmp_rtARID_DEF.TmpSignalConversionAtEVM_CIPVOutport1[4].accel_gnd.x@ */ /end MEASUREMENT
/begin MEASUREMENT autosar_swc_vmp_rtARID_DEF.TmpSignalConversionAtEVM_CIPVOutport1[4].accel_gnd.y "" FLOAT32_IEEE autosar_swc_vmp_CM_single 0 0 -3.4E+38 3.4E+38 ECU_ADDRESS 0xfe4ccba8 /* @ECU_Address@autosar_swc_vmp_rtARID_DEF.TmpSignalConversionAtEVM_CIPVOutport1[4].accel_gnd.y@ */ /end MEASUREMENT
/begin MEASUREMENT autosar_swc_vmp_rtARID_DEF.TmpSignalConversionAtEVM_CIPVOutport1[4].accel_gnd_sl.mod "" FLOAT32_IEEE autosar_swc_vmp_CM_single 0 0 -3.4E+38 3.4E+38 ECU_ADDRESS 0xfe4ccbc4 /* @ECU_Address@autosar_swc_vmp_rtARID_DEF.TmpSignalConversionAtEVM_CIPVOutport1[4].accel_gnd_sl.mod@ */ /end MEASUREMENT
/begin MEASUREMENT autosar_swc_vmp_rtARID_DEF.TmpSignalConversionAtEVM_CIPVOutport1[4].accel_gnd_sl.x "" FLOAT32_IEEE autosar_swc_vmp_CM_single 0 0 -3.4E+38 3.4E+38 ECU_ADDRESS 0xfe4ccbbc /* @ECU_Address@autosar_swc_vmp_rtARID_DEF.TmpSignalConversionAtEVM_CIPVOutport1[4].accel_gnd_sl.x@ */ /end MEASUREMENT
/begin MEASUREMENT autosar_swc_vmp_rtARID_DEF.TmpSignalConversionAtEVM_CIPVOutport1[4].accel_gnd_sl.y "" FLOAT32_IEEE autosar_swc_vmp_CM_single 0 0 -3.4E+38 3.4E+38 ECU_ADDRESS 0xfe4ccbc0 /* @ECU_Address@autosar_swc_vmp_rtARID_DEF.TmpSignalConversionAtEVM_CIPVOutport1[4].accel_gnd_sl.y@ */ /end MEASUREMENT
/begin MEASUREMENT autosar_swc_vmp_rtARID_DEF.TmpSignalConversionAtEVM_CIPVOutport1[4].box.corner_x_vec "" FLOAT32_IEEE autosar_swc_vmp_CM_single 0 0 -3.4E+38 3.4E+38 LAYOUT COLUMN_DIR MATRIX_DIM 4 ECU_ADDRESS 0xfe4ccb54 /* @ECU_Address@autosar_swc_vmp_rtARID_DEF.TmpSignalConversionAtEVM_CIPVOutport1[4].box.corner_x_vec@ */ /end MEASUREMENT
/begin MEASUREMENT autosar_swc_vmp_rtARID_DEF.TmpSignalConversionAtEVM_CIPVOutport1[4].box.corner_y_vec "" FLOAT32_IEEE autosar_swc_vmp_CM_single 0 0 -3.4E+38 3.4E+38 LAYOUT COLUMN_DIR MATRIX_DIM 4 ECU_ADDRESS 0xfe4ccb64 /* @ECU_Address@autosar_swc_vmp_rtARID_DEF.TmpSignalConversionAtEVM_CIPVOutport1[4].box.corner_y_vec@ */ /end MEASUREMENT
/begin MEASUREMENT autosar_swc_vmp_rtARID_DEF.TmpSignalConversionAtEVM_CIPVOutport1[4].class_type "" UBYTE autosar_swc_vmp_CM_uint8 0 0 0 255 ECU_ADDRESS 0xfe4ccb4a /* @ECU_Address@autosar_swc_vmp_rtARID_DEF.TmpSignalConversionAtEVM_CIPVOutport1[4].class_type@ */ /end MEASUREMENT
/begin MEASUREMENT autosar_swc_vmp_rtARID_DEF.TmpSignalConversionAtEVM_CIPVOutport1[4].cut_type "" UBYTE autosar_swc_vmp_CM_uint8 0 0 0 255 ECU_ADDRESS 0xfe4ccb4b /* @ECU_Address@autosar_swc_vmp_rtARID_DEF.TmpSignalConversionAtEVM_CIPVOutport1[4].cut_type@ */ /end MEASUREMENT
/begin MEASUREMENT autosar_swc_vmp_rtARID_DEF.TmpSignalConversionAtEVM_CIPVOutport1[4].fus_type "" UBYTE autosar_swc_vmp_CM_uint8 0 0 0 255 ECU_ADDRESS 0xfe4ccb49 /* @ECU_Address@autosar_swc_vmp_rtARID_DEF.TmpSignalConversionAtEVM_CIPVOutport1[4].fus_type@ */ /end MEASUREMENT
/begin MEASUREMENT autosar_swc_vmp_rtARID_DEF.TmpSignalConversionAtEVM_CIPVOutport1[4].id "" ULONG autosar_swc_vmp_CM_uint32 0 0 0 4294967295 ECU_ADDRESS 0xfe4ccb50 /* @ECU_Address@autosar_swc_vmp_rtARID_DEF.TmpSignalConversionAtEVM_CIPVOutport1[4].id@ */ /end MEASUREMENT
/begin MEASUREMENT autosar_swc_vmp_rtARID_DEF.TmpSignalConversionAtEVM_CIPVOutport1[4].meas_state "" UBYTE autosar_swc_vmp_CM_uint8 0 0 0 255 ECU_ADDRESS 0xfe4ccb48 /* @ECU_Address@autosar_swc_vmp_rtARID_DEF.TmpSignalConversionAtEVM_CIPVOutport1[4].meas_state@ */ /end MEASUREMENT
/begin MEASUREMENT autosar_swc_vmp_rtARID_DEF.TmpSignalConversionAtEVM_CIPVOutport1[4].position.heading_angle "" FLOAT32_IEEE autosar_swc_vmp_CM_single 0 0 -3.4E+38 3.4E+38 ECU_ADDRESS 0xfe4ccb7c /* @ECU_Address@autosar_swc_vmp_rtARID_DEF.TmpSignalConversionAtEVM_CIPVOutport1[4].position.heading_angle@ */ /end MEASUREMENT
/begin MEASUREMENT autosar_swc_vmp_rtARID_DEF.TmpSignalConversionAtEVM_CIPVOutport1[4].position.x "" FLOAT32_IEEE autosar_swc_vmp_CM_single 0 0 -3.4E+38 3.4E+38 ECU_ADDRESS 0xfe4ccb74 /* @ECU_Address@autosar_swc_vmp_rtARID_DEF.TmpSignalConversionAtEVM_CIPVOutport1[4].position.x@ */ /end MEASUREMENT
/begin MEASUREMENT autosar_swc_vmp_rtARID_DEF.TmpSignalConversionAtEVM_CIPVOutport1[4].position.y "" FLOAT32_IEEE autosar_swc_vmp_CM_single 0 0 -3.4E+38 3.4E+38 ECU_ADDRESS 0xfe4ccb78 /* @ECU_Address@autosar_swc_vmp_rtARID_DEF.TmpSignalConversionAtEVM_CIPVOutport1[4].position.y@ */ /end MEASUREMENT
/begin MEASUREMENT autosar_swc_vmp_rtARID_DEF.TmpSignalConversionAtEVM_CIPVOutport1[4].position_sl.heading_angle "" FLOAT32_IEEE autosar_swc_vmp_CM_single 0 0 -3.4E+38 3.4E+38 ECU_ADDRESS 0xfe4ccb88 /* @ECU_Address@autosar_swc_vmp_rtARID_DEF.TmpSignalConversionAtEVM_CIPVOutport1[4].position_sl.heading_angle@ */ /end MEASUREMENT
/begin MEASUREMENT autosar_swc_vmp_rtARID_DEF.TmpSignalConversionAtEVM_CIPVOutport1[4].position_sl.x "" FLOAT32_IEEE autosar_swc_vmp_CM_single 0 0 -3.4E+38 3.4E+38 ECU_ADDRESS 0xfe4ccb80 /* @ECU_Address@autosar_swc_vmp_rtARID_DEF.TmpSignalConversionAtEVM_CIPVOutport1[4].position_sl.x@ */ /end MEASUREMENT
/begin MEASUREMENT autosar_swc_vmp_rtARID_DEF.TmpSignalConversionAtEVM_CIPVOutport1[4].position_sl.y "" FLOAT32_IEEE autosar_swc_vmp_CM_single 0 0 -3.4E+38 3.4E+38 ECU_ADDRESS 0xfe4ccb84 /* @ECU_Address@autosar_swc_vmp_rtARID_DEF.TmpSignalConversionAtEVM_CIPVOutport1[4].position_sl.y@ */ /end MEASUREMENT
/begin MEASUREMENT autosar_swc_vmp_rtARID_DEF.TmpSignalConversionAtEVM_CIPVOutport1[4].ref_lane_id "" UBYTE autosar_swc_vmp_CM_uint8 0 0 0 255 ECU_ADDRESS 0xfe4ccb4c /* @ECU_Address@autosar_swc_vmp_rtARID_DEF.TmpSignalConversionAtEVM_CIPVOutport1[4].ref_lane_id@ */ /end MEASUREMENT
/begin MEASUREMENT autosar_swc_vmp_rtARID_DEF.TmpSignalConversionAtEVM_CIPVOutport1[4].size.higth "" FLOAT32_IEEE autosar_swc_vmp_CM_single 0 0 -3.4E+38 3.4E+38 ECU_ADDRESS 0xfe4ccb94 /* @ECU_Address@autosar_swc_vmp_rtARID_DEF.TmpSignalConversionAtEVM_CIPVOutport1[4].size.higth@ */ /end MEASUREMENT
/begin MEASUREMENT autosar_swc_vmp_rtARID_DEF.TmpSignalConversionAtEVM_CIPVOutport1[4].size.length "" FLOAT32_IEEE autosar_swc_vmp_CM_single 0 0 -3.4E+38 3.4E+38 ECU_ADDRESS 0xfe4ccb8c /* @ECU_Address@autosar_swc_vmp_rtARID_DEF.TmpSignalConversionAtEVM_CIPVOutport1[4].size.length@ */ /end MEASUREMENT
/begin MEASUREMENT autosar_swc_vmp_rtARID_DEF.TmpSignalConversionAtEVM_CIPVOutport1[4].size.width "" FLOAT32_IEEE autosar_swc_vmp_CM_single 0 0 -3.4E+38 3.4E+38 ECU_ADDRESS 0xfe4ccb90 /* @ECU_Address@autosar_swc_vmp_rtARID_DEF.TmpSignalConversionAtEVM_CIPVOutport1[4].size.width@ */ /end MEASUREMENT
/begin MEASUREMENT autosar_swc_vmp_rtARID_DEF.TmpSignalConversionAtEVM_CIPVOutport1[4].velocity_gnd.mod "" FLOAT32_IEEE autosar_swc_vmp_CM_single 0 0 -3.4E+38 3.4E+38 ECU_ADDRESS 0xfe4ccba0 /* @ECU_Address@autosar_swc_vmp_rtARID_DEF.TmpSignalConversionAtEVM_CIPVOutport1[4].velocity_gnd.mod@ */ /end MEASUREMENT
/begin MEASUREMENT autosar_swc_vmp_rtARID_DEF.TmpSignalConversionAtEVM_CIPVOutport1[4].velocity_gnd.x "" FLOAT32_IEEE autosar_swc_vmp_CM_single 0 0 -3.4E+38 3.4E+38 ECU_ADDRESS 0xfe4ccb98 /* @ECU_Address@autosar_swc_vmp_rtARID_DEF.TmpSignalConversionAtEVM_CIPVOutport1[4].velocity_gnd.x@ */ /end MEASUREMENT
/begin MEASUREMENT autosar_swc_vmp_rtARID_DEF.TmpSignalConversionAtEVM_CIPVOutport1[4].velocity_gnd.y "" FLOAT32_IEEE autosar_swc_vmp_CM_single 0 0 -3.4E+38 3.4E+38 ECU_ADDRESS 0xfe4ccb9c /* @ECU_Address@autosar_swc_vmp_rtARID_DEF.TmpSignalConversionAtEVM_CIPVOutport1[4].velocity_gnd.y@ */ /end MEASUREMENT
/begin MEASUREMENT autosar_swc_vmp_rtARID_DEF.TmpSignalConversionAtEVM_CIPVOutport1[4].velocity_gnd_sl.mod "" FLOAT32_IEEE autosar_swc_vmp_CM_single 0 0 -3.4E+38 3.4E+38 ECU_ADDRESS 0xfe4ccbb8 /* @ECU_Address@autosar_swc_vmp_rtARID_DEF.TmpSignalConversionAtEVM_CIPVOutport1[4].velocity_gnd_sl.mod@ */ /end MEASUREMENT
/begin MEASUREMENT autosar_swc_vmp_rtARID_DEF.TmpSignalConversionAtEVM_CIPVOutport1[4].velocity_gnd_sl.x "" FLOAT32_IEEE autosar_swc_vmp_CM_single 0 0 -3.4E+38 3.4E+38 ECU_ADDRESS 0xfe4ccbb0 /* @ECU_Address@autosar_swc_vmp_rtARID_DEF.TmpSignalConversionAtEVM_CIPVOutport1[4].velocity_gnd_sl.x@ */ /end MEASUREMENT
/begin MEASUREMENT autosar_swc_vmp_rtARID_DEF.TmpSignalConversionAtEVM_CIPVOutport1[4].velocity_gnd_sl.y "" FLOAT32_IEEE autosar_swc_vmp_CM_single 0 0 -3.4E+38 3.4E+38 ECU_ADDRESS 0xfe4ccbb4 /* @ECU_Address@autosar_swc_vmp_rtARID_DEF.TmpSignalConversionAtEVM_CIPVOutport1[4].velocity_gnd_sl.y@ */ /end MEASUREMENT
/begin MEASUREMENT autosar_swc_vmp_rtARID_DEF.TmpSignalConversionAtEVM_CIPVOutport1[5].accel_gnd.mod "" FLOAT32_IEEE autosar_swc_vmp_CM_single 0 0 -3.4E+38 3.4E+38 ECU_ADDRESS 0xfe4ccc2c /* @ECU_Address@autosar_swc_vmp_rtARID_DEF.TmpSignalConversionAtEVM_CIPVOutport1[5].accel_gnd.mod@ */ /end MEASUREMENT
/begin MEASUREMENT autosar_swc_vmp_rtARID_DEF.TmpSignalConversionAtEVM_CIPVOutport1[5].accel_gnd.x "" FLOAT32_IEEE autosar_swc_vmp_CM_single 0 0 -3.4E+38 3.4E+38 ECU_ADDRESS 0xfe4ccc24 /* @ECU_Address@autosar_swc_vmp_rtARID_DEF.TmpSignalConversionAtEVM_CIPVOutport1[5].accel_gnd.x@ */ /end MEASUREMENT
/begin MEASUREMENT autosar_swc_vmp_rtARID_DEF.TmpSignalConversionAtEVM_CIPVOutport1[5].accel_gnd.y "" FLOAT32_IEEE autosar_swc_vmp_CM_single 0 0 -3.4E+38 3.4E+38 ECU_ADDRESS 0xfe4ccc28 /* @ECU_Address@autosar_swc_vmp_rtARID_DEF.TmpSignalConversionAtEVM_CIPVOutport1[5].accel_gnd.y@ */ /end MEASUREMENT
/begin MEASUREMENT autosar_swc_vmp_rtARID_DEF.TmpSignalConversionAtEVM_CIPVOutport1[5].accel_gnd_sl.mod "" FLOAT32_IEEE autosar_swc_vmp_CM_single 0 0 -3.4E+38 3.4E+38 ECU_ADDRESS 0xfe4ccc44 /* @ECU_Address@autosar_swc_vmp_rtARID_DEF.TmpSignalConversionAtEVM_CIPVOutport1[5].accel_gnd_sl.mod@ */ /end MEASUREMENT
/begin MEASUREMENT autosar_swc_vmp_rtARID_DEF.TmpSignalConversionAtEVM_CIPVOutport1[5].accel_gnd_sl.x "" FLOAT32_IEEE autosar_swc_vmp_CM_single 0 0 -3.4E+38 3.4E+38 ECU_ADDRESS 0xfe4ccc3c /* @ECU_Address@autosar_swc_vmp_rtARID_DEF.TmpSignalConversionAtEVM_CIPVOutport1[5].accel_gnd_sl.x@ */ /end MEASUREMENT
/begin MEASUREMENT autosar_swc_vmp_rtARID_DEF.TmpSignalConversionAtEVM_CIPVOutport1[5].accel_gnd_sl.y "" FLOAT32_IEEE autosar_swc_vmp_CM_single 0 0 -3.4E+38 3.4E+38 ECU_ADDRESS 0xfe4ccc40 /* @ECU_Address@autosar_swc_vmp_rtARID_DEF.TmpSignalConversionAtEVM_CIPVOutport1[5].accel_gnd_sl.y@ */ /end MEASUREMENT
/begin MEASUREMENT autosar_swc_vmp_rtARID_DEF.TmpSignalConversionAtEVM_CIPVOutport1[5].box.corner_x_vec "" FLOAT32_IEEE autosar_swc_vmp_CM_single 0 0 -3.4E+38 3.4E+38 LAYOUT COLUMN_DIR MATRIX_DIM 4 ECU_ADDRESS 0xfe4ccbd4 /* @ECU_Address@autosar_swc_vmp_rtARID_DEF.TmpSignalConversionAtEVM_CIPVOutport1[5].box.corner_x_vec@ */ /end MEASUREMENT
/begin MEASUREMENT autosar_swc_vmp_rtARID_DEF.TmpSignalConversionAtEVM_CIPVOutport1[5].box.corner_y_vec "" FLOAT32_IEEE autosar_swc_vmp_CM_single 0 0 -3.4E+38 3.4E+38 LAYOUT COLUMN_DIR MATRIX_DIM 4 ECU_ADDRESS 0xfe4ccbe4 /* @ECU_Address@autosar_swc_vmp_rtARID_DEF.TmpSignalConversionAtEVM_CIPVOutport1[5].box.corner_y_vec@ */ /end MEASUREMENT
/begin MEASUREMENT autosar_swc_vmp_rtARID_DEF.TmpSignalConversionAtEVM_CIPVOutport1[5].class_type "" UBYTE autosar_swc_vmp_CM_uint8 0 0 0 255 ECU_ADDRESS 0xfe4ccbca /* @ECU_Address@autosar_swc_vmp_rtARID_DEF.TmpSignalConversionAtEVM_CIPVOutport1[5].class_type@ */ /end MEASUREMENT
/begin MEASUREMENT autosar_swc_vmp_rtARID_DEF.TmpSignalConversionAtEVM_CIPVOutport1[5].cut_type "" UBYTE autosar_swc_vmp_CM_uint8 0 0 0 255 ECU_ADDRESS 0xfe4ccbcb /* @ECU_Address@autosar_swc_vmp_rtARID_DEF.TmpSignalConversionAtEVM_CIPVOutport1[5].cut_type@ */ /end MEASUREMENT
/begin MEASUREMENT autosar_swc_vmp_rtARID_DEF.TmpSignalConversionAtEVM_CIPVOutport1[5].fus_type "" UBYTE autosar_swc_vmp_CM_uint8 0 0 0 255 ECU_ADDRESS 0xfe4ccbc9 /* @ECU_Address@autosar_swc_vmp_rtARID_DEF.TmpSignalConversionAtEVM_CIPVOutport1[5].fus_type@ */ /end MEASUREMENT
/begin MEASUREMENT autosar_swc_vmp_rtARID_DEF.TmpSignalConversionAtEVM_CIPVOutport1[5].id "" ULONG autosar_swc_vmp_CM_uint32 0 0 0 4294967295 ECU_ADDRESS 0xfe4ccbd0 /* @ECU_Address@autosar_swc_vmp_rtARID_DEF.TmpSignalConversionAtEVM_CIPVOutport1[5].id@ */ /end MEASUREMENT
/begin MEASUREMENT autosar_swc_vmp_rtARID_DEF.TmpSignalConversionAtEVM_CIPVOutport1[5].meas_state "" UBYTE autosar_swc_vmp_CM_uint8 0 0 0 255 ECU_ADDRESS 0xfe4ccbc8 /* @ECU_Address@autosar_swc_vmp_rtARID_DEF.TmpSignalConversionAtEVM_CIPVOutport1[5].meas_state@ */ /end MEASUREMENT
/begin MEASUREMENT autosar_swc_vmp_rtARID_DEF.TmpSignalConversionAtEVM_CIPVOutport1[5].position.heading_angle "" FLOAT32_IEEE autosar_swc_vmp_CM_single 0 0 -3.4E+38 3.4E+38 ECU_ADDRESS 0xfe4ccbfc /* @ECU_Address@autosar_swc_vmp_rtARID_DEF.TmpSignalConversionAtEVM_CIPVOutport1[5].position.heading_angle@ */ /end MEASUREMENT
/begin MEASUREMENT autosar_swc_vmp_rtARID_DEF.TmpSignalConversionAtEVM_CIPVOutport1[5].position.x "" FLOAT32_IEEE autosar_swc_vmp_CM_single 0 0 -3.4E+38 3.4E+38 ECU_ADDRESS 0xfe4ccbf4 /* @ECU_Address@autosar_swc_vmp_rtARID_DEF.TmpSignalConversionAtEVM_CIPVOutport1[5].position.x@ */ /end MEASUREMENT
/begin MEASUREMENT autosar_swc_vmp_rtARID_DEF.TmpSignalConversionAtEVM_CIPVOutport1[5].position.y "" FLOAT32_IEEE autosar_swc_vmp_CM_single 0 0 -3.4E+38 3.4E+38 ECU_ADDRESS 0xfe4ccbf8 /* @ECU_Address@autosar_swc_vmp_rtARID_DEF.TmpSignalConversionAtEVM_CIPVOutport1[5].position.y@ */ /end MEASUREMENT
/begin MEASUREMENT autosar_swc_vmp_rtARID_DEF.TmpSignalConversionAtEVM_CIPVOutport1[5].position_sl.heading_angle "" FLOAT32_IEEE autosar_swc_vmp_CM_single 0 0 -3.4E+38 3.4E+38 ECU_ADDRESS 0xfe4ccc08 /* @ECU_Address@autosar_swc_vmp_rtARID_DEF.TmpSignalConversionAtEVM_CIPVOutport1[5].position_sl.heading_angle@ */ /end MEASUREMENT
/begin MEASUREMENT autosar_swc_vmp_rtARID_DEF.TmpSignalConversionAtEVM_CIPVOutport1[5].position_sl.x "" FLOAT32_IEEE autosar_swc_vmp_CM_single 0 0 -3.4E+38 3.4E+38 ECU_ADDRESS 0xfe4ccc00 /* @ECU_Address@autosar_swc_vmp_rtARID_DEF.TmpSignalConversionAtEVM_CIPVOutport1[5].position_sl.x@ */ /end MEASUREMENT
/begin MEASUREMENT autosar_swc_vmp_rtARID_DEF.TmpSignalConversionAtEVM_CIPVOutport1[5].position_sl.y "" FLOAT32_IEEE autosar_swc_vmp_CM_single 0 0 -3.4E+38 3.4E+38 ECU_ADDRESS 0xfe4ccc04 /* @ECU_Address@autosar_swc_vmp_rtARID_DEF.TmpSignalConversionAtEVM_CIPVOutport1[5].position_sl.y@ */ /end MEASUREMENT
/begin MEASUREMENT autosar_swc_vmp_rtARID_DEF.TmpSignalConversionAtEVM_CIPVOutport1[5].ref_lane_id "" UBYTE autosar_swc_vmp_CM_uint8 0 0 0 255 ECU_ADDRESS 0xfe4ccbcc /* @ECU_Address@autosar_swc_vmp_rtARID_DEF.TmpSignalConversionAtEVM_CIPVOutport1[5].ref_lane_id@ */ /end MEASUREMENT
/begin MEASUREMENT autosar_swc_vmp_rtARID_DEF.TmpSignalConversionAtEVM_CIPVOutport1[5].size.higth "" FLOAT32_IEEE autosar_swc_vmp_CM_single 0 0 -3.4E+38 3.4E+38 ECU_ADDRESS 0xfe4ccc14 /* @ECU_Address@autosar_swc_vmp_rtARID_DEF.TmpSignalConversionAtEVM_CIPVOutport1[5].size.higth@ */ /end MEASUREMENT
/begin MEASUREMENT autosar_swc_vmp_rtARID_DEF.TmpSignalConversionAtEVM_CIPVOutport1[5].size.length "" FLOAT32_IEEE autosar_swc_vmp_CM_single 0 0 -3.4E+38 3.4E+38 ECU_ADDRESS 0xfe4ccc0c /* @ECU_Address@autosar_swc_vmp_rtARID_DEF.TmpSignalConversionAtEVM_CIPVOutport1[5].size.length@ */ /end MEASUREMENT
/begin MEASUREMENT autosar_swc_vmp_rtARID_DEF.TmpSignalConversionAtEVM_CIPVOutport1[5].size.width "" FLOAT32_IEEE autosar_swc_vmp_CM_single 0 0 -3.4E+38 3.4E+38 ECU_ADDRESS 0xfe4ccc10 /* @ECU_Address@autosar_swc_vmp_rtARID_DEF.TmpSignalConversionAtEVM_CIPVOutport1[5].size.width@ */ /end MEASUREMENT
/begin MEASUREMENT autosar_swc_vmp_rtARID_DEF.TmpSignalConversionAtEVM_CIPVOutport1[5].velocity_gnd.mod "" FLOAT32_IEEE autosar_swc_vmp_CM_single 0 0 -3.4E+38 3.4E+38 ECU_ADDRESS 0xfe4ccc20 /* @ECU_Address@autosar_swc_vmp_rtARID_DEF.TmpSignalConversionAtEVM_CIPVOutport1[5].velocity_gnd.mod@ */ /end MEASUREMENT
/begin MEASUREMENT autosar_swc_vmp_rtARID_DEF.TmpSignalConversionAtEVM_CIPVOutport1[5].velocity_gnd.x "" FLOAT32_IEEE autosar_swc_vmp_CM_single 0 0 -3.4E+38 3.4E+38 ECU_ADDRESS 0xfe4ccc18 /* @ECU_Address@autosar_swc_vmp_rtARID_DEF.TmpSignalConversionAtEVM_CIPVOutport1[5].velocity_gnd.x@ */ /end MEASUREMENT
/begin MEASUREMENT autosar_swc_vmp_rtARID_DEF.TmpSignalConversionAtEVM_CIPVOutport1[5].velocity_gnd.y "" FLOAT32_IEEE autosar_swc_vmp_CM_single 0 0 -3.4E+38 3.4E+38 ECU_ADDRESS 0xfe4ccc1c /* @ECU_Address@autosar_swc_vmp_rtARID_DEF.TmpSignalConversionAtEVM_CIPVOutport1[5].velocity_gnd.y@ */ /end MEASUREMENT
/begin MEASUREMENT autosar_swc_vmp_rtARID_DEF.TmpSignalConversionAtEVM_CIPVOutport1[5].velocity_gnd_sl.mod "" FLOAT32_IEEE autosar_swc_vmp_CM_single 0 0 -3.4E+38 3.4E+38 ECU_ADDRESS 0xfe4ccc38 /* @ECU_Address@autosar_swc_vmp_rtARID_DEF.TmpSignalConversionAtEVM_CIPVOutport1[5].velocity_gnd_sl.mod@ */ /end MEASUREMENT
/begin MEASUREMENT autosar_swc_vmp_rtARID_DEF.TmpSignalConversionAtEVM_CIPVOutport1[5].velocity_gnd_sl.x "" FLOAT32_IEEE autosar_swc_vmp_CM_single 0 0 -3.4E+38 3.4E+38 ECU_ADDRESS 0xfe4ccc30 /* @ECU_Address@autosar_swc_vmp_rtARID_DEF.TmpSignalConversionAtEVM_CIPVOutport1[5].velocity_gnd_sl.x@ */ /end MEASUREMENT
/begin MEASUREMENT autosar_swc_vmp_rtARID_DEF.TmpSignalConversionAtEVM_CIPVOutport1[5].velocity_gnd_sl.y "" FLOAT32_IEEE autosar_swc_vmp_CM_single 0 0 -3.4E+38 3.4E+38 ECU_ADDRESS 0xfe4ccc34 /* @ECU_Address@autosar_swc_vmp_rtARID_DEF.TmpSignalConversionAtEVM_CIPVOutport1[5].velocity_gnd_sl.y@ */ /end MEASUREMENT
/begin MEASUREMENT autosar_swc_vmp_rtARID_DEF.TmpSignalConversionAtEVM_CIPVOutport1[6].accel_gnd.mod "" FLOAT32_IEEE autosar_swc_vmp_CM_single 0 0 -3.4E+38 3.4E+38 ECU_ADDRESS 0xfe4cccac /* @ECU_Address@autosar_swc_vmp_rtARID_DEF.TmpSignalConversionAtEVM_CIPVOutport1[6].accel_gnd.mod@ */ /end MEASUREMENT
/begin MEASUREMENT autosar_swc_vmp_rtARID_DEF.TmpSignalConversionAtEVM_CIPVOutport1[6].accel_gnd.x "" FLOAT32_IEEE autosar_swc_vmp_CM_single 0 0 -3.4E+38 3.4E+38 ECU_ADDRESS 0xfe4ccca4 /* @ECU_Address@autosar_swc_vmp_rtARID_DEF.TmpSignalConversionAtEVM_CIPVOutport1[6].accel_gnd.x@ */ /end MEASUREMENT
/begin MEASUREMENT autosar_swc_vmp_rtARID_DEF.TmpSignalConversionAtEVM_CIPVOutport1[6].accel_gnd.y "" FLOAT32_IEEE autosar_swc_vmp_CM_single 0 0 -3.4E+38 3.4E+38 ECU_ADDRESS 0xfe4ccca8 /* @ECU_Address@autosar_swc_vmp_rtARID_DEF.TmpSignalConversionAtEVM_CIPVOutport1[6].accel_gnd.y@ */ /end MEASUREMENT
/begin MEASUREMENT autosar_swc_vmp_rtARID_DEF.TmpSignalConversionAtEVM_CIPVOutport1[6].accel_gnd_sl.mod "" FLOAT32_IEEE autosar_swc_vmp_CM_single 0 0 -3.4E+38 3.4E+38 ECU_ADDRESS 0xfe4cccc4 /* @ECU_Address@autosar_swc_vmp_rtARID_DEF.TmpSignalConversionAtEVM_CIPVOutport1[6].accel_gnd_sl.mod@ */ /end MEASUREMENT
/begin MEASUREMENT autosar_swc_vmp_rtARID_DEF.TmpSignalConversionAtEVM_CIPVOutport1[6].accel_gnd_sl.x "" FLOAT32_IEEE autosar_swc_vmp_CM_single 0 0 -3.4E+38 3.4E+38 ECU_ADDRESS 0xfe4cccbc /* @ECU_Address@autosar_swc_vmp_rtARID_DEF.TmpSignalConversionAtEVM_CIPVOutport1[6].accel_gnd_sl.x@ */ /end MEASUREMENT
/begin MEASUREMENT autosar_swc_vmp_rtARID_DEF.TmpSignalConversionAtEVM_CIPVOutport1[6].accel_gnd_sl.y "" FLOAT32_IEEE autosar_swc_vmp_CM_single 0 0 -3.4E+38 3.4E+38 ECU_ADDRESS 0xfe4cccc0 /* @ECU_Address@autosar_swc_vmp_rtARID_DEF.TmpSignalConversionAtEVM_CIPVOutport1[6].accel_gnd_sl.y@ */ /end MEASUREMENT
/begin MEASUREMENT autosar_swc_vmp_rtARID_DEF.TmpSignalConversionAtEVM_CIPVOutport1[6].box.corner_x_vec "" FLOAT32_IEEE autosar_swc_vmp_CM_single 0 0 -3.4E+38 3.4E+38 LAYOUT COLUMN_DIR MATRIX_DIM 4 ECU_ADDRESS 0xfe4ccc54 /* @ECU_Address@autosar_swc_vmp_rtARID_DEF.TmpSignalConversionAtEVM_CIPVOutport1[6].box.corner_x_vec@ */ /end MEASUREMENT
/begin MEASUREMENT autosar_swc_vmp_rtARID_DEF.TmpSignalConversionAtEVM_CIPVOutport1[6].box.corner_y_vec "" FLOAT32_IEEE autosar_swc_vmp_CM_single 0 0 -3.4E+38 3.4E+38 LAYOUT COLUMN_DIR MATRIX_DIM 4 ECU_ADDRESS 0xfe4ccc64 /* @ECU_Address@autosar_swc_vmp_rtARID_DEF.TmpSignalConversionAtEVM_CIPVOutport1[6].box.corner_y_vec@ */ /end MEASUREMENT
/begin MEASUREMENT autosar_swc_vmp_rtARID_DEF.TmpSignalConversionAtEVM_CIPVOutport1[6].class_type "" UBYTE autosar_swc_vmp_CM_uint8 0 0 0 255 ECU_ADDRESS 0xfe4ccc4a /* @ECU_Address@autosar_swc_vmp_rtARID_DEF.TmpSignalConversionAtEVM_CIPVOutport1[6].class_type@ */ /end MEASUREMENT
/begin MEASUREMENT autosar_swc_vmp_rtARID_DEF.TmpSignalConversionAtEVM_CIPVOutport1[6].cut_type "" UBYTE autosar_swc_vmp_CM_uint8 0 0 0 255 ECU_ADDRESS 0xfe4ccc4b /* @ECU_Address@autosar_swc_vmp_rtARID_DEF.TmpSignalConversionAtEVM_CIPVOutport1[6].cut_type@ */ /end MEASUREMENT
/begin MEASUREMENT autosar_swc_vmp_rtARID_DEF.TmpSignalConversionAtEVM_CIPVOutport1[6].fus_type "" UBYTE autosar_swc_vmp_CM_uint8 0 0 0 255 ECU_ADDRESS 0xfe4ccc49 /* @ECU_Address@autosar_swc_vmp_rtARID_DEF.TmpSignalConversionAtEVM_CIPVOutport1[6].fus_type@ */ /end MEASUREMENT
/begin MEASUREMENT autosar_swc_vmp_rtARID_DEF.TmpSignalConversionAtEVM_CIPVOutport1[6].id "" ULONG autosar_swc_vmp_CM_uint32 0 0 0 4294967295 ECU_ADDRESS 0xfe4ccc50 /* @ECU_Address@autosar_swc_vmp_rtARID_DEF.TmpSignalConversionAtEVM_CIPVOutport1[6].id@ */ /end MEASUREMENT
/begin MEASUREMENT autosar_swc_vmp_rtARID_DEF.TmpSignalConversionAtEVM_CIPVOutport1[6].meas_state "" UBYTE autosar_swc_vmp_CM_uint8 0 0 0 255 ECU_ADDRESS 0xfe4ccc48 /* @ECU_Address@autosar_swc_vmp_rtARID_DEF.TmpSignalConversionAtEVM_CIPVOutport1[6].meas_state@ */ /end MEASUREMENT
/begin MEASUREMENT autosar_swc_vmp_rtARID_DEF.TmpSignalConversionAtEVM_CIPVOutport1[6].position.heading_angle "" FLOAT32_IEEE autosar_swc_vmp_CM_single 0 0 -3.4E+38 3.4E+38 ECU_ADDRESS 0xfe4ccc7c /* @ECU_Address@autosar_swc_vmp_rtARID_DEF.TmpSignalConversionAtEVM_CIPVOutport1[6].position.heading_angle@ */ /end MEASUREMENT
/begin MEASUREMENT autosar_swc_vmp_rtARID_DEF.TmpSignalConversionAtEVM_CIPVOutport1[6].position.x "" FLOAT32_IEEE autosar_swc_vmp_CM_single 0 0 -3.4E+38 3.4E+38 ECU_ADDRESS 0xfe4ccc74 /* @ECU_Address@autosar_swc_vmp_rtARID_DEF.TmpSignalConversionAtEVM_CIPVOutport1[6].position.x@ */ /end MEASUREMENT
/begin MEASUREMENT autosar_swc_vmp_rtARID_DEF.TmpSignalConversionAtEVM_CIPVOutport1[6].position.y "" FLOAT32_IEEE autosar_swc_vmp_CM_single 0 0 -3.4E+38 3.4E+38 ECU_ADDRESS 0xfe4ccc78 /* @ECU_Address@autosar_swc_vmp_rtARID_DEF.TmpSignalConversionAtEVM_CIPVOutport1[6].position.y@ */ /end MEASUREMENT
/begin MEASUREMENT autosar_swc_vmp_rtARID_DEF.TmpSignalConversionAtEVM_CIPVOutport1[6].position_sl.heading_angle "" FLOAT32_IEEE autosar_swc_vmp_CM_single 0 0 -3.4E+38 3.4E+38 ECU_ADDRESS 0xfe4ccc88 /* @ECU_Address@autosar_swc_vmp_rtARID_DEF.TmpSignalConversionAtEVM_CIPVOutport1[6].position_sl.heading_angle@ */ /end MEASUREMENT
/begin MEASUREMENT autosar_swc_vmp_rtARID_DEF.TmpSignalConversionAtEVM_CIPVOutport1[6].position_sl.x "" FLOAT32_IEEE autosar_swc_vmp_CM_single 0 0 -3.4E+38 3.4E+38 ECU_ADDRESS 0xfe4ccc80 /* @ECU_Address@autosar_swc_vmp_rtARID_DEF.TmpSignalConversionAtEVM_CIPVOutport1[6].position_sl.x@ */ /end MEASUREMENT
/begin MEASUREMENT autosar_swc_vmp_rtARID_DEF.TmpSignalConversionAtEVM_CIPVOutport1[6].position_sl.y "" FLOAT32_IEEE autosar_swc_vmp_CM_single 0 0 -3.4E+38 3.4E+38 ECU_ADDRESS 0xfe4ccc84 /* @ECU_Address@autosar_swc_vmp_rtARID_DEF.TmpSignalConversionAtEVM_CIPVOutport1[6].position_sl.y@ */ /end MEASUREMENT
/begin MEASUREMENT autosar_swc_vmp_rtARID_DEF.TmpSignalConversionAtEVM_CIPVOutport1[6].ref_lane_id "" UBYTE autosar_swc_vmp_CM_uint8 0 0 0 255 ECU_ADDRESS 0xfe4ccc4c /* @ECU_Address@autosar_swc_vmp_rtARID_DEF.TmpSignalConversionAtEVM_CIPVOutport1[6].ref_lane_id@ */ /end MEASUREMENT
/begin MEASUREMENT autosar_swc_vmp_rtARID_DEF.TmpSignalConversionAtEVM_CIPVOutport1[6].size.higth "" FLOAT32_IEEE autosar_swc_vmp_CM_single 0 0 -3.4E+38 3.4E+38 ECU_ADDRESS 0xfe4ccc94 /* @ECU_Address@autosar_swc_vmp_rtARID_DEF.TmpSignalConversionAtEVM_CIPVOutport1[6].size.higth@ */ /end MEASUREMENT
/begin MEASUREMENT autosar_swc_vmp_rtARID_DEF.TmpSignalConversionAtEVM_CIPVOutport1[6].size.length "" FLOAT32_IEEE autosar_swc_vmp_CM_single 0 0 -3.4E+38 3.4E+38 ECU_ADDRESS 0xfe4ccc8c /* @ECU_Address@autosar_swc_vmp_rtARID_DEF.TmpSignalConversionAtEVM_CIPVOutport1[6].size.length@ */ /end MEASUREMENT
/begin MEASUREMENT autosar_swc_vmp_rtARID_DEF.TmpSignalConversionAtEVM_CIPVOutport1[6].size.width "" FLOAT32_IEEE autosar_swc_vmp_CM_single 0 0 -3.4E+38 3.4E+38 ECU_ADDRESS 0xfe4ccc90 /* @ECU_Address@autosar_swc_vmp_rtARID_DEF.TmpSignalConversionAtEVM_CIPVOutport1[6].size.width@ */ /end MEASUREMENT
/begin MEASUREMENT autosar_swc_vmp_rtARID_DEF.TmpSignalConversionAtEVM_CIPVOutport1[6].velocity_gnd.mod "" FLOAT32_IEEE autosar_swc_vmp_CM_single 0 0 -3.4E+38 3.4E+38 ECU_ADDRESS 0xfe4ccca0 /* @ECU_Address@autosar_swc_vmp_rtARID_DEF.TmpSignalConversionAtEVM_CIPVOutport1[6].velocity_gnd.mod@ */ /end MEASUREMENT
/begin MEASUREMENT autosar_swc_vmp_rtARID_DEF.TmpSignalConversionAtEVM_CIPVOutport1[6].velocity_gnd.x "" FLOAT32_IEEE autosar_swc_vmp_CM_single 0 0 -3.4E+38 3.4E+38 ECU_ADDRESS 0xfe4ccc98 /* @ECU_Address@autosar_swc_vmp_rtARID_DEF.TmpSignalConversionAtEVM_CIPVOutport1[6].velocity_gnd.x@ */ /end MEASUREMENT
/begin MEASUREMENT autosar_swc_vmp_rtARID_DEF.TmpSignalConversionAtEVM_CIPVOutport1[6].velocity_gnd.y "" FLOAT32_IEEE autosar_swc_vmp_CM_single 0 0 -3.4E+38 3.4E+38 ECU_ADDRESS 0xfe4ccc9c /* @ECU_Address@autosar_swc_vmp_rtARID_DEF.TmpSignalConversionAtEVM_CIPVOutport1[6].velocity_gnd.y@ */ /end MEASUREMENT
/begin MEASUREMENT autosar_swc_vmp_rtARID_DEF.TmpSignalConversionAtEVM_CIPVOutport1[6].velocity_gnd_sl.mod "" FLOAT32_IEEE autosar_swc_vmp_CM_single 0 0 -3.4E+38 3.4E+38 ECU_ADDRESS 0xfe4cccb8 /* @ECU_Address@autosar_swc_vmp_rtARID_DEF.TmpSignalConversionAtEVM_CIPVOutport1[6].velocity_gnd_sl.mod@ */ /end MEASUREMENT
/begin MEASUREMENT autosar_swc_vmp_rtARID_DEF.TmpSignalConversionAtEVM_CIPVOutport1[6].velocity_gnd_sl.x "" FLOAT32_IEEE autosar_swc_vmp_CM_single 0 0 -3.4E+38 3.4E+38 ECU_ADDRESS 0xfe4cccb0 /* @ECU_Address@autosar_swc_vmp_rtARID_DEF.TmpSignalConversionAtEVM_CIPVOutport1[6].velocity_gnd_sl.x@ */ /end MEASUREMENT
/begin MEASUREMENT autosar_swc_vmp_rtARID_DEF.TmpSignalConversionAtEVM_CIPVOutport1[6].velocity_gnd_sl.y "" FLOAT32_IEEE autosar_swc_vmp_CM_single 0 0 -3.4E+38 3.4E+38 ECU_ADDRESS 0xfe4cccb4 /* @ECU_Address@autosar_swc_vmp_rtARID_DEF.TmpSignalConversionAtEVM_CIPVOutport1[6].velocity_gnd_sl.y@ */ /end MEASUREMENT
/begin MEASUREMENT autosar_swc_vmp_rtARID_DEF.TmpSignalConversionAtEVM_CIPVOutport1[7].accel_gnd.mod "" FLOAT32_IEEE autosar_swc_vmp_CM_single 0 0 -3.4E+38 3.4E+38 ECU_ADDRESS 0xfe4ccd2c /* @ECU_Address@autosar_swc_vmp_rtARID_DEF.TmpSignalConversionAtEVM_CIPVOutport1[7].accel_gnd.mod@ */ /end MEASUREMENT
/begin MEASUREMENT autosar_swc_vmp_rtARID_DEF.TmpSignalConversionAtEVM_CIPVOutport1[7].accel_gnd.x "" FLOAT32_IEEE autosar_swc_vmp_CM_single 0 0 -3.4E+38 3.4E+38 ECU_ADDRESS 0xfe4ccd24 /* @ECU_Address@autosar_swc_vmp_rtARID_DEF.TmpSignalConversionAtEVM_CIPVOutport1[7].accel_gnd.x@ */ /end MEASUREMENT
/begin MEASUREMENT autosar_swc_vmp_rtARID_DEF.TmpSignalConversionAtEVM_CIPVOutport1[7].accel_gnd.y "" FLOAT32_IEEE autosar_swc_vmp_CM_single 0 0 -3.4E+38 3.4E+38 ECU_ADDRESS 0xfe4ccd28 /* @ECU_Address@autosar_swc_vmp_rtARID_DEF.TmpSignalConversionAtEVM_CIPVOutport1[7].accel_gnd.y@ */ /end MEASUREMENT
/begin MEASUREMENT autosar_swc_vmp_rtARID_DEF.TmpSignalConversionAtEVM_CIPVOutport1[7].accel_gnd_sl.mod "" FLOAT32_IEEE autosar_swc_vmp_CM_single 0 0 -3.4E+38 3.4E+38 ECU_ADDRESS 0xfe4ccd44 /* @ECU_Address@autosar_swc_vmp_rtARID_DEF.TmpSignalConversionAtEVM_CIPVOutport1[7].accel_gnd_sl.mod@ */ /end MEASUREMENT
/begin MEASUREMENT autosar_swc_vmp_rtARID_DEF.TmpSignalConversionAtEVM_CIPVOutport1[7].accel_gnd_sl.x "" FLOAT32_IEEE autosar_swc_vmp_CM_single 0 0 -3.4E+38 3.4E+38 ECU_ADDRESS 0xfe4ccd3c /* @ECU_Address@autosar_swc_vmp_rtARID_DEF.TmpSignalConversionAtEVM_CIPVOutport1[7].accel_gnd_sl.x@ */ /end MEASUREMENT
/begin MEASUREMENT autosar_swc_vmp_rtARID_DEF.TmpSignalConversionAtEVM_CIPVOutport1[7].accel_gnd_sl.y "" FLOAT32_IEEE autosar_swc_vmp_CM_single 0 0 -3.4E+38 3.4E+38 ECU_ADDRESS 0xfe4ccd40 /* @ECU_Address@autosar_swc_vmp_rtARID_DEF.TmpSignalConversionAtEVM_CIPVOutport1[7].accel_gnd_sl.y@ */ /end MEASUREMENT
/begin MEASUREMENT autosar_swc_vmp_rtARID_DEF.TmpSignalConversionAtEVM_CIPVOutport1[7].box.corner_x_vec "" FLOAT32_IEEE autosar_swc_vmp_CM_single 0 0 -3.4E+38 3.4E+38 LAYOUT COLUMN_DIR MATRIX_DIM 4 ECU_ADDRESS 0xfe4cccd4 /* @ECU_Address@autosar_swc_vmp_rtARID_DEF.TmpSignalConversionAtEVM_CIPVOutport1[7].box.corner_x_vec@ */ /end MEASUREMENT
/begin MEASUREMENT autosar_swc_vmp_rtARID_DEF.TmpSignalConversionAtEVM_CIPVOutport1[7].box.corner_y_vec "" FLOAT32_IEEE autosar_swc_vmp_CM_single 0 0 -3.4E+38 3.4E+38 LAYOUT COLUMN_DIR MATRIX_DIM 4 ECU_ADDRESS 0xfe4ccce4 /* @ECU_Address@autosar_swc_vmp_rtARID_DEF.TmpSignalConversionAtEVM_CIPVOutport1[7].box.corner_y_vec@ */ /end MEASUREMENT
/begin MEASUREMENT autosar_swc_vmp_rtARID_DEF.TmpSignalConversionAtEVM_CIPVOutport1[7].class_type "" UBYTE autosar_swc_vmp_CM_uint8 0 0 0 255 ECU_ADDRESS 0xfe4cccca /* @ECU_Address@autosar_swc_vmp_rtARID_DEF.TmpSignalConversionAtEVM_CIPVOutport1[7].class_type@ */ /end MEASUREMENT
/begin MEASUREMENT autosar_swc_vmp_rtARID_DEF.TmpSignalConversionAtEVM_CIPVOutport1[7].cut_type "" UBYTE autosar_swc_vmp_CM_uint8 0 0 0 255 ECU_ADDRESS 0xfe4ccccb /* @ECU_Address@autosar_swc_vmp_rtARID_DEF.TmpSignalConversionAtEVM_CIPVOutport1[7].cut_type@ */ /end MEASUREMENT
/begin MEASUREMENT autosar_swc_vmp_rtARID_DEF.TmpSignalConversionAtEVM_CIPVOutport1[7].fus_type "" UBYTE autosar_swc_vmp_CM_uint8 0 0 0 255 ECU_ADDRESS 0xfe4cccc9 /* @ECU_Address@autosar_swc_vmp_rtARID_DEF.TmpSignalConversionAtEVM_CIPVOutport1[7].fus_type@ */ /end MEASUREMENT
/begin MEASUREMENT autosar_swc_vmp_rtARID_DEF.TmpSignalConversionAtEVM_CIPVOutport1[7].id "" ULONG autosar_swc_vmp_CM_uint32 0 0 0 4294967295 ECU_ADDRESS 0xfe4cccd0 /* @ECU_Address@autosar_swc_vmp_rtARID_DEF.TmpSignalConversionAtEVM_CIPVOutport1[7].id@ */ /end MEASUREMENT
/begin MEASUREMENT autosar_swc_vmp_rtARID_DEF.TmpSignalConversionAtEVM_CIPVOutport1[7].meas_state "" UBYTE autosar_swc_vmp_CM_uint8 0 0 0 255 ECU_ADDRESS 0xfe4cccc8 /* @ECU_Address@autosar_swc_vmp_rtARID_DEF.TmpSignalConversionAtEVM_CIPVOutport1[7].meas_state@ */ /end MEASUREMENT
/begin MEASUREMENT autosar_swc_vmp_rtARID_DEF.TmpSignalConversionAtEVM_CIPVOutport1[7].position.heading_angle "" FLOAT32_IEEE autosar_swc_vmp_CM_single 0 0 -3.4E+38 3.4E+38 ECU_ADDRESS 0xfe4cccfc /* @ECU_Address@autosar_swc_vmp_rtARID_DEF.TmpSignalConversionAtEVM_CIPVOutport1[7].position.heading_angle@ */ /end MEASUREMENT
/begin MEASUREMENT autosar_swc_vmp_rtARID_DEF.TmpSignalConversionAtEVM_CIPVOutport1[7].position.x "" FLOAT32_IEEE autosar_swc_vmp_CM_single 0 0 -3.4E+38 3.4E+38 ECU_ADDRESS 0xfe4cccf4 /* @ECU_Address@autosar_swc_vmp_rtARID_DEF.TmpSignalConversionAtEVM_CIPVOutport1[7].position.x@ */ /end MEASUREMENT
/begin MEASUREMENT autosar_swc_vmp_rtARID_DEF.TmpSignalConversionAtEVM_CIPVOutport1[7].position.y "" FLOAT32_IEEE autosar_swc_vmp_CM_single 0 0 -3.4E+38 3.4E+38 ECU_ADDRESS 0xfe4cccf8 /* @ECU_Address@autosar_swc_vmp_rtARID_DEF.TmpSignalConversionAtEVM_CIPVOutport1[7].position.y@ */ /end MEASUREMENT
/begin MEASUREMENT autosar_swc_vmp_rtARID_DEF.TmpSignalConversionAtEVM_CIPVOutport1[7].position_sl.heading_angle "" FLOAT32_IEEE autosar_swc_vmp_CM_single 0 0 -3.4E+38 3.4E+38 ECU_ADDRESS 0xfe4ccd08 /* @ECU_Address@autosar_swc_vmp_rtARID_DEF.TmpSignalConversionAtEVM_CIPVOutport1[7].position_sl.heading_angle@ */ /end MEASUREMENT
/begin MEASUREMENT autosar_swc_vmp_rtARID_DEF.TmpSignalConversionAtEVM_CIPVOutport1[7].position_sl.x "" FLOAT32_IEEE autosar_swc_vmp_CM_single 0 0 -3.4E+38 3.4E+38 ECU_ADDRESS 0xfe4ccd00 /* @ECU_Address@autosar_swc_vmp_rtARID_DEF.TmpSignalConversionAtEVM_CIPVOutport1[7].position_sl.x@ */ /end MEASUREMENT
/begin MEASUREMENT autosar_swc_vmp_rtARID_DEF.TmpSignalConversionAtEVM_CIPVOutport1[7].position_sl.y "" FLOAT32_IEEE autosar_swc_vmp_CM_single 0 0 -3.4E+38 3.4E+38 ECU_ADDRESS 0xfe4ccd04 /* @ECU_Address@autosar_swc_vmp_rtARID_DEF.TmpSignalConversionAtEVM_CIPVOutport1[7].position_sl.y@ */ /end MEASUREMENT
/begin MEASUREMENT autosar_swc_vmp_rtARID_DEF.TmpSignalConversionAtEVM_CIPVOutport1[7].ref_lane_id "" UBYTE autosar_swc_vmp_CM_uint8 0 0 0 255 ECU_ADDRESS 0xfe4ccccc /* @ECU_Address@autosar_swc_vmp_rtARID_DEF.TmpSignalConversionAtEVM_CIPVOutport1[7].ref_lane_id@ */ /end MEASUREMENT
/begin MEASUREMENT autosar_swc_vmp_rtARID_DEF.TmpSignalConversionAtEVM_CIPVOutport1[7].size.higth "" FLOAT32_IEEE autosar_swc_vmp_CM_single 0 0 -3.4E+38 3.4E+38 ECU_ADDRESS 0xfe4ccd14 /* @ECU_Address@autosar_swc_vmp_rtARID_DEF.TmpSignalConversionAtEVM_CIPVOutport1[7].size.higth@ */ /end MEASUREMENT
/begin MEASUREMENT autosar_swc_vmp_rtARID_DEF.TmpSignalConversionAtEVM_CIPVOutport1[7].size.length "" FLOAT32_IEEE autosar_swc_vmp_CM_single 0 0 -3.4E+38 3.4E+38 ECU_ADDRESS 0xfe4ccd0c /* @ECU_Address@autosar_swc_vmp_rtARID_DEF.TmpSignalConversionAtEVM_CIPVOutport1[7].size.length@ */ /end MEASUREMENT
/begin MEASUREMENT autosar_swc_vmp_rtARID_DEF.TmpSignalConversionAtEVM_CIPVOutport1[7].size.width "" FLOAT32_IEEE autosar_swc_vmp_CM_single 0 0 -3.4E+38 3.4E+38 ECU_ADDRESS 0xfe4ccd10 /* @ECU_Address@autosar_swc_vmp_rtARID_DEF.TmpSignalConversionAtEVM_CIPVOutport1[7].size.width@ */ /end MEASUREMENT
/begin MEASUREMENT autosar_swc_vmp_rtARID_DEF.TmpSignalConversionAtEVM_CIPVOutport1[7].velocity_gnd.mod "" FLOAT32_IEEE autosar_swc_vmp_CM_single 0 0 -3.4E+38 3.4E+38 ECU_ADDRESS 0xfe4ccd20 /* @ECU_Address@autosar_swc_vmp_rtARID_DEF.TmpSignalConversionAtEVM_CIPVOutport1[7].velocity_gnd.mod@ */ /end MEASUREMENT
/begin MEASUREMENT autosar_swc_vmp_rtARID_DEF.TmpSignalConversionAtEVM_CIPVOutport1[7].velocity_gnd.x "" FLOAT32_IEEE autosar_swc_vmp_CM_single 0 0 -3.4E+38 3.4E+38 ECU_ADDRESS 0xfe4ccd18 /* @ECU_Address@autosar_swc_vmp_rtARID_DEF.TmpSignalConversionAtEVM_CIPVOutport1[7].velocity_gnd.x@ */ /end MEASUREMENT
/begin MEASUREMENT autosar_swc_vmp_rtARID_DEF.TmpSignalConversionAtEVM_CIPVOutport1[7].velocity_gnd.y "" FLOAT32_IEEE autosar_swc_vmp_CM_single 0 0 -3.4E+38 3.4E+38 ECU_ADDRESS 0xfe4ccd1c /* @ECU_Address@autosar_swc_vmp_rtARID_DEF.TmpSignalConversionAtEVM_CIPVOutport1[7].velocity_gnd.y@ */ /end MEASUREMENT
/begin MEASUREMENT autosar_swc_vmp_rtARID_DEF.TmpSignalConversionAtEVM_CIPVOutport1[7].velocity_gnd_sl.mod "" FLOAT32_IEEE autosar_swc_vmp_CM_single 0 0 -3.4E+38 3.4E+38 ECU_ADDRESS 0xfe4ccd38 /* @ECU_Address@autosar_swc_vmp_rtARID_DEF.TmpSignalConversionAtEVM_CIPVOutport1[7].velocity_gnd_sl.mod@ */ /end MEASUREMENT
/begin MEASUREMENT autosar_swc_vmp_rtARID_DEF.TmpSignalConversionAtEVM_CIPVOutport1[7].velocity_gnd_sl.x "" FLOAT32_IEEE autosar_swc_vmp_CM_single 0 0 -3.4E+38 3.4E+38 ECU_ADDRESS 0xfe4ccd30 /* @ECU_Address@autosar_swc_vmp_rtARID_DEF.TmpSignalConversionAtEVM_CIPVOutport1[7].velocity_gnd_sl.x@ */ /end MEASUREMENT
/begin MEASUREMENT autosar_swc_vmp_rtARID_DEF.TmpSignalConversionAtEVM_CIPVOutport1[7].velocity_gnd_sl.y "" FLOAT32_IEEE autosar_swc_vmp_CM_single 0 0 -3.4E+38 3.4E+38 ECU_ADDRESS 0xfe4ccd34 /* @ECU_Address@autosar_swc_vmp_rtARID_DEF.TmpSignalConversionAtEVM_CIPVOutport1[7].velocity_gnd_sl.y@ */ /end MEASUREMENT
/begin MEASUREMENT autosar_swc_vmp_rtARID_DEF.TmpSignalConversionAtEVM_CIPVOutport1[8].accel_gnd.mod "" FLOAT32_IEEE autosar_swc_vmp_CM_single 0 0 -3.4E+38 3.4E+38 ECU_ADDRESS 0xfe4ccdac /* @ECU_Address@autosar_swc_vmp_rtARID_DEF.TmpSignalConversionAtEVM_CIPVOutport1[8].accel_gnd.mod@ */ /end MEASUREMENT
/begin MEASUREMENT autosar_swc_vmp_rtARID_DEF.TmpSignalConversionAtEVM_CIPVOutport1[8].accel_gnd.x "" FLOAT32_IEEE autosar_swc_vmp_CM_single 0 0 -3.4E+38 3.4E+38 ECU_ADDRESS 0xfe4ccda4 /* @ECU_Address@autosar_swc_vmp_rtARID_DEF.TmpSignalConversionAtEVM_CIPVOutport1[8].accel_gnd.x@ */ /end MEASUREMENT
/begin MEASUREMENT autosar_swc_vmp_rtARID_DEF.TmpSignalConversionAtEVM_CIPVOutport1[8].accel_gnd.y "" FLOAT32_IEEE autosar_swc_vmp_CM_single 0 0 -3.4E+38 3.4E+38 ECU_ADDRESS 0xfe4ccda8 /* @ECU_Address@autosar_swc_vmp_rtARID_DEF.TmpSignalConversionAtEVM_CIPVOutport1[8].accel_gnd.y@ */ /end MEASUREMENT
/begin MEASUREMENT autosar_swc_vmp_rtARID_DEF.TmpSignalConversionAtEVM_CIPVOutport1[8].accel_gnd_sl.mod "" FLOAT32_IEEE autosar_swc_vmp_CM_single 0 0 -3.4E+38 3.4E+38 ECU_ADDRESS 0xfe4ccdc4 /* @ECU_Address@autosar_swc_vmp_rtARID_DEF.TmpSignalConversionAtEVM_CIPVOutport1[8].accel_gnd_sl.mod@ */ /end MEASUREMENT
/begin MEASUREMENT autosar_swc_vmp_rtARID_DEF.TmpSignalConversionAtEVM_CIPVOutport1[8].accel_gnd_sl.x "" FLOAT32_IEEE autosar_swc_vmp_CM_single 0 0 -3.4E+38 3.4E+38 ECU_ADDRESS 0xfe4ccdbc /* @ECU_Address@autosar_swc_vmp_rtARID_DEF.TmpSignalConversionAtEVM_CIPVOutport1[8].accel_gnd_sl.x@ */ /end MEASUREMENT
/begin MEASUREMENT autosar_swc_vmp_rtARID_DEF.TmpSignalConversionAtEVM_CIPVOutport1[8].accel_gnd_sl.y "" FLOAT32_IEEE autosar_swc_vmp_CM_single 0 0 -3.4E+38 3.4E+38 ECU_ADDRESS 0xfe4ccdc0 /* @ECU_Address@autosar_swc_vmp_rtARID_DEF.TmpSignalConversionAtEVM_CIPVOutport1[8].accel_gnd_sl.y@ */ /end MEASUREMENT
/begin MEASUREMENT autosar_swc_vmp_rtARID_DEF.TmpSignalConversionAtEVM_CIPVOutport1[8].box.corner_x_vec "" FLOAT32_IEEE autosar_swc_vmp_CM_single 0 0 -3.4E+38 3.4E+38 LAYOUT COLUMN_DIR MATRIX_DIM 4 ECU_ADDRESS 0xfe4ccd54 /* @ECU_Address@autosar_swc_vmp_rtARID_DEF.TmpSignalConversionAtEVM_CIPVOutport1[8].box.corner_x_vec@ */ /end MEASUREMENT
/begin MEASUREMENT autosar_swc_vmp_rtARID_DEF.TmpSignalConversionAtEVM_CIPVOutport1[8].box.corner_y_vec "" FLOAT32_IEEE autosar_swc_vmp_CM_single 0 0 -3.4E+38 3.4E+38 LAYOUT COLUMN_DIR MATRIX_DIM 4 ECU_ADDRESS 0xfe4ccd64 /* @ECU_Address@autosar_swc_vmp_rtARID_DEF.TmpSignalConversionAtEVM_CIPVOutport1[8].box.corner_y_vec@ */ /end MEASUREMENT
/begin MEASUREMENT autosar_swc_vmp_rtARID_DEF.TmpSignalConversionAtEVM_CIPVOutport1[8].class_type "" UBYTE autosar_swc_vmp_CM_uint8 0 0 0 255 ECU_ADDRESS 0xfe4ccd4a /* @ECU_Address@autosar_swc_vmp_rtARID_DEF.TmpSignalConversionAtEVM_CIPVOutport1[8].class_type@ */ /end MEASUREMENT
/begin MEASUREMENT autosar_swc_vmp_rtARID_DEF.TmpSignalConversionAtEVM_CIPVOutport1[8].cut_type "" UBYTE autosar_swc_vmp_CM_uint8 0 0 0 255 ECU_ADDRESS 0xfe4ccd4b /* @ECU_Address@autosar_swc_vmp_rtARID_DEF.TmpSignalConversionAtEVM_CIPVOutport1[8].cut_type@ */ /end MEASUREMENT
/begin MEASUREMENT autosar_swc_vmp_rtARID_DEF.TmpSignalConversionAtEVM_CIPVOutport1[8].fus_type "" UBYTE autosar_swc_vmp_CM_uint8 0 0 0 255 ECU_ADDRESS 0xfe4ccd49 /* @ECU_Address@autosar_swc_vmp_rtARID_DEF.TmpSignalConversionAtEVM_CIPVOutport1[8].fus_type@ */ /end MEASUREMENT
/begin MEASUREMENT autosar_swc_vmp_rtARID_DEF.TmpSignalConversionAtEVM_CIPVOutport1[8].id "" ULONG autosar_swc_vmp_CM_uint32 0 0 0 4294967295 ECU_ADDRESS 0xfe4ccd50 /* @ECU_Address@autosar_swc_vmp_rtARID_DEF.TmpSignalConversionAtEVM_CIPVOutport1[8].id@ */ /end MEASUREMENT
/begin MEASUREMENT autosar_swc_vmp_rtARID_DEF.TmpSignalConversionAtEVM_CIPVOutport1[8].meas_state "" UBYTE autosar_swc_vmp_CM_uint8 0 0 0 255 ECU_ADDRESS 0xfe4ccd48 /* @ECU_Address@autosar_swc_vmp_rtARID_DEF.TmpSignalConversionAtEVM_CIPVOutport1[8].meas_state@ */ /end MEASUREMENT
/begin MEASUREMENT autosar_swc_vmp_rtARID_DEF.TmpSignalConversionAtEVM_CIPVOutport1[8].position.heading_angle "" FLOAT32_IEEE autosar_swc_vmp_CM_single 0 0 -3.4E+38 3.4E+38 ECU_ADDRESS 0xfe4ccd7c /* @ECU_Address@autosar_swc_vmp_rtARID_DEF.TmpSignalConversionAtEVM_CIPVOutport1[8].position.heading_angle@ */ /end MEASUREMENT
/begin MEASUREMENT autosar_swc_vmp_rtARID_DEF.TmpSignalConversionAtEVM_CIPVOutport1[8].position.x "" FLOAT32_IEEE autosar_swc_vmp_CM_single 0 0 -3.4E+38 3.4E+38 ECU_ADDRESS 0xfe4ccd74 /* @ECU_Address@autosar_swc_vmp_rtARID_DEF.TmpSignalConversionAtEVM_CIPVOutport1[8].position.x@ */ /end MEASUREMENT
/begin MEASUREMENT autosar_swc_vmp_rtARID_DEF.TmpSignalConversionAtEVM_CIPVOutport1[8].position.y "" FLOAT32_IEEE autosar_swc_vmp_CM_single 0 0 -3.4E+38 3.4E+38 ECU_ADDRESS 0xfe4ccd78 /* @ECU_Address@autosar_swc_vmp_rtARID_DEF.TmpSignalConversionAtEVM_CIPVOutport1[8].position.y@ */ /end MEASUREMENT
/begin MEASUREMENT autosar_swc_vmp_rtARID_DEF.TmpSignalConversionAtEVM_CIPVOutport1[8].position_sl.heading_angle "" FLOAT32_IEEE autosar_swc_vmp_CM_single 0 0 -3.4E+38 3.4E+38 ECU_ADDRESS 0xfe4ccd88 /* @ECU_Address@autosar_swc_vmp_rtARID_DEF.TmpSignalConversionAtEVM_CIPVOutport1[8].position_sl.heading_angle@ */ /end MEASUREMENT
/begin MEASUREMENT autosar_swc_vmp_rtARID_DEF.TmpSignalConversionAtEVM_CIPVOutport1[8].position_sl.x "" FLOAT32_IEEE autosar_swc_vmp_CM_single 0 0 -3.4E+38 3.4E+38 ECU_ADDRESS 0xfe4ccd80 /* @ECU_Address@autosar_swc_vmp_rtARID_DEF.TmpSignalConversionAtEVM_CIPVOutport1[8].position_sl.x@ */ /end MEASUREMENT
/begin MEASUREMENT autosar_swc_vmp_rtARID_DEF.TmpSignalConversionAtEVM_CIPVOutport1[8].position_sl.y "" FLOAT32_IEEE autosar_swc_vmp_CM_single 0 0 -3.4E+38 3.4E+38 ECU_ADDRESS 0xfe4ccd84 /* @ECU_Address@autosar_swc_vmp_rtARID_DEF.TmpSignalConversionAtEVM_CIPVOutport1[8].position_sl.y@ */ /end MEASUREMENT
/begin MEASUREMENT autosar_swc_vmp_rtARID_DEF.TmpSignalConversionAtEVM_CIPVOutport1[8].ref_lane_id "" UBYTE autosar_swc_vmp_CM_uint8 0 0 0 255 ECU_ADDRESS 0xfe4ccd4c /* @ECU_Address@autosar_swc_vmp_rtARID_DEF.TmpSignalConversionAtEVM_CIPVOutport1[8].ref_lane_id@ */ /end MEASUREMENT
/begin MEASUREMENT autosar_swc_vmp_rtARID_DEF.TmpSignalConversionAtEVM_CIPVOutport1[8].size.higth "" FLOAT32_IEEE autosar_swc_vmp_CM_single 0 0 -3.4E+38 3.4E+38 ECU_ADDRESS 0xfe4ccd94 /* @ECU_Address@autosar_swc_vmp_rtARID_DEF.TmpSignalConversionAtEVM_CIPVOutport1[8].size.higth@ */ /end MEASUREMENT
/begin MEASUREMENT autosar_swc_vmp_rtARID_DEF.TmpSignalConversionAtEVM_CIPVOutport1[8].size.length "" FLOAT32_IEEE autosar_swc_vmp_CM_single 0 0 -3.4E+38 3.4E+38 ECU_ADDRESS 0xfe4ccd8c /* @ECU_Address@autosar_swc_vmp_rtARID_DEF.TmpSignalConversionAtEVM_CIPVOutport1[8].size.length@ */ /end MEASUREMENT
/begin MEASUREMENT autosar_swc_vmp_rtARID_DEF.TmpSignalConversionAtEVM_CIPVOutport1[8].size.width "" FLOAT32_IEEE autosar_swc_vmp_CM_single 0 0 -3.4E+38 3.4E+38 ECU_ADDRESS 0xfe4ccd90 /* @ECU_Address@autosar_swc_vmp_rtARID_DEF.TmpSignalConversionAtEVM_CIPVOutport1[8].size.width@ */ /end MEASUREMENT
/begin MEASUREMENT autosar_swc_vmp_rtARID_DEF.TmpSignalConversionAtEVM_CIPVOutport1[8].velocity_gnd.mod "" FLOAT32_IEEE autosar_swc_vmp_CM_single 0 0 -3.4E+38 3.4E+38 ECU_ADDRESS 0xfe4ccda0 /* @ECU_Address@autosar_swc_vmp_rtARID_DEF.TmpSignalConversionAtEVM_CIPVOutport1[8].velocity_gnd.mod@ */ /end MEASUREMENT
/begin MEASUREMENT autosar_swc_vmp_rtARID_DEF.TmpSignalConversionAtEVM_CIPVOutport1[8].velocity_gnd.x "" FLOAT32_IEEE autosar_swc_vmp_CM_single 0 0 -3.4E+38 3.4E+38 ECU_ADDRESS 0xfe4ccd98 /* @ECU_Address@autosar_swc_vmp_rtARID_DEF.TmpSignalConversionAtEVM_CIPVOutport1[8].velocity_gnd.x@ */ /end MEASUREMENT
/begin MEASUREMENT autosar_swc_vmp_rtARID_DEF.TmpSignalConversionAtEVM_CIPVOutport1[8].velocity_gnd.y "" FLOAT32_IEEE autosar_swc_vmp_CM_single 0 0 -3.4E+38 3.4E+38 ECU_ADDRESS 0xfe4ccd9c /* @ECU_Address@autosar_swc_vmp_rtARID_DEF.TmpSignalConversionAtEVM_CIPVOutport1[8].velocity_gnd.y@ */ /end MEASUREMENT
/begin MEASUREMENT autosar_swc_vmp_rtARID_DEF.TmpSignalConversionAtEVM_CIPVOutport1[8].velocity_gnd_sl.mod "" FLOAT32_IEEE autosar_swc_vmp_CM_single 0 0 -3.4E+38 3.4E+38 ECU_ADDRESS 0xfe4ccdb8 /* @ECU_Address@autosar_swc_vmp_rtARID_DEF.TmpSignalConversionAtEVM_CIPVOutport1[8].velocity_gnd_sl.mod@ */ /end MEASUREMENT
/begin MEASUREMENT autosar_swc_vmp_rtARID_DEF.TmpSignalConversionAtEVM_CIPVOutport1[8].velocity_gnd_sl.x "" FLOAT32_IEEE autosar_swc_vmp_CM_single 0 0 -3.4E+38 3.4E+38 ECU_ADDRESS 0xfe4ccdb0 /* @ECU_Address@autosar_swc_vmp_rtARID_DEF.TmpSignalConversionAtEVM_CIPVOutport1[8].velocity_gnd_sl.x@ */ /end MEASUREMENT
/begin MEASUREMENT autosar_swc_vmp_rtARID_DEF.TmpSignalConversionAtEVM_CIPVOutport1[8].velocity_gnd_sl.y "" FLOAT32_IEEE autosar_swc_vmp_CM_single 0 0 -3.4E+38 3.4E+38 ECU_ADDRESS 0xfe4ccdb4 /* @ECU_Address@autosar_swc_vmp_rtARID_DEF.TmpSignalConversionAtEVM_CIPVOutport1[8].velocity_gnd_sl.y@ */ /end MEASUREMENT
/begin MEASUREMENT autosar_swc_vmp_rtARID_DEF.TmpSignalConversionAtEVM_CIPVOutport1[9].accel_gnd.mod "" FLOAT32_IEEE autosar_swc_vmp_CM_single 0 0 -3.4E+38 3.4E+38 ECU_ADDRESS 0xfe4cce2c /* @ECU_Address@autosar_swc_vmp_rtARID_DEF.TmpSignalConversionAtEVM_CIPVOutport1[9].accel_gnd.mod@ */ /end MEASUREMENT
/begin MEASUREMENT autosar_swc_vmp_rtARID_DEF.TmpSignalConversionAtEVM_CIPVOutport1[9].accel_gnd.x "" FLOAT32_IEEE autosar_swc_vmp_CM_single 0 0 -3.4E+38 3.4E+38 ECU_ADDRESS 0xfe4cce24 /* @ECU_Address@autosar_swc_vmp_rtARID_DEF.TmpSignalConversionAtEVM_CIPVOutport1[9].accel_gnd.x@ */ /end MEASUREMENT
/begin MEASUREMENT autosar_swc_vmp_rtARID_DEF.TmpSignalConversionAtEVM_CIPVOutport1[9].accel_gnd.y "" FLOAT32_IEEE autosar_swc_vmp_CM_single 0 0 -3.4E+38 3.4E+38 ECU_ADDRESS 0xfe4cce28 /* @ECU_Address@autosar_swc_vmp_rtARID_DEF.TmpSignalConversionAtEVM_CIPVOutport1[9].accel_gnd.y@ */ /end MEASUREMENT
/begin MEASUREMENT autosar_swc_vmp_rtARID_DEF.TmpSignalConversionAtEVM_CIPVOutport1[9].accel_gnd_sl.mod "" FLOAT32_IEEE autosar_swc_vmp_CM_single 0 0 -3.4E+38 3.4E+38 ECU_ADDRESS 0xfe4cce44 /* @ECU_Address@autosar_swc_vmp_rtARID_DEF.TmpSignalConversionAtEVM_CIPVOutport1[9].accel_gnd_sl.mod@ */ /end MEASUREMENT
/begin MEASUREMENT autosar_swc_vmp_rtARID_DEF.TmpSignalConversionAtEVM_CIPVOutport1[9].accel_gnd_sl.x "" FLOAT32_IEEE autosar_swc_vmp_CM_single 0 0 -3.4E+38 3.4E+38 ECU_ADDRESS 0xfe4cce3c /* @ECU_Address@autosar_swc_vmp_rtARID_DEF.TmpSignalConversionAtEVM_CIPVOutport1[9].accel_gnd_sl.x@ */ /end MEASUREMENT
/begin MEASUREMENT autosar_swc_vmp_rtARID_DEF.TmpSignalConversionAtEVM_CIPVOutport1[9].accel_gnd_sl.y "" FLOAT32_IEEE autosar_swc_vmp_CM_single 0 0 -3.4E+38 3.4E+38 ECU_ADDRESS 0xfe4cce40 /* @ECU_Address@autosar_swc_vmp_rtARID_DEF.TmpSignalConversionAtEVM_CIPVOutport1[9].accel_gnd_sl.y@ */ /end MEASUREMENT
/begin MEASUREMENT autosar_swc_vmp_rtARID_DEF.TmpSignalConversionAtEVM_CIPVOutport1[9].box.corner_x_vec "" FLOAT32_IEEE autosar_swc_vmp_CM_single 0 0 -3.4E+38 3.4E+38 LAYOUT COLUMN_DIR MATRIX_DIM 4 ECU_ADDRESS 0xfe4ccdd4 /* @ECU_Address@autosar_swc_vmp_rtARID_DEF.TmpSignalConversionAtEVM_CIPVOutport1[9].box.corner_x_vec@ */ /end MEASUREMENT
/begin MEASUREMENT autosar_swc_vmp_rtARID_DEF.TmpSignalConversionAtEVM_CIPVOutport1[9].box.corner_y_vec "" FLOAT32_IEEE autosar_swc_vmp_CM_single 0 0 -3.4E+38 3.4E+38 LAYOUT COLUMN_DIR MATRIX_DIM 4 ECU_ADDRESS 0xfe4ccde4 /* @ECU_Address@autosar_swc_vmp_rtARID_DEF.TmpSignalConversionAtEVM_CIPVOutport1[9].box.corner_y_vec@ */ /end MEASUREMENT
/begin MEASUREMENT autosar_swc_vmp_rtARID_DEF.TmpSignalConversionAtEVM_CIPVOutport1[9].class_type "" UBYTE autosar_swc_vmp_CM_uint8 0 0 0 255 ECU_ADDRESS 0xfe4ccdca /* @ECU_Address@autosar_swc_vmp_rtARID_DEF.TmpSignalConversionAtEVM_CIPVOutport1[9].class_type@ */ /end MEASUREMENT
/begin MEASUREMENT autosar_swc_vmp_rtARID_DEF.TmpSignalConversionAtEVM_CIPVOutport1[9].cut_type "" UBYTE autosar_swc_vmp_CM_uint8 0 0 0 255 ECU_ADDRESS 0xfe4ccdcb /* @ECU_Address@autosar_swc_vmp_rtARID_DEF.TmpSignalConversionAtEVM_CIPVOutport1[9].cut_type@ */ /end MEASUREMENT
/begin MEASUREMENT autosar_swc_vmp_rtARID_DEF.TmpSignalConversionAtEVM_CIPVOutport1[9].fus_type "" UBYTE autosar_swc_vmp_CM_uint8 0 0 0 255 ECU_ADDRESS 0xfe4ccdc9 /* @ECU_Address@autosar_swc_vmp_rtARID_DEF.TmpSignalConversionAtEVM_CIPVOutport1[9].fus_type@ */ /end MEASUREMENT
/begin MEASUREMENT autosar_swc_vmp_rtARID_DEF.TmpSignalConversionAtEVM_CIPVOutport1[9].id "" ULONG autosar_swc_vmp_CM_uint32 0 0 0 4294967295 ECU_ADDRESS 0xfe4ccdd0 /* @ECU_Address@autosar_swc_vmp_rtARID_DEF.TmpSignalConversionAtEVM_CIPVOutport1[9].id@ */ /end MEASUREMENT
/begin MEASUREMENT autosar_swc_vmp_rtARID_DEF.TmpSignalConversionAtEVM_CIPVOutport1[9].meas_state "" UBYTE autosar_swc_vmp_CM_uint8 0 0 0 255 ECU_ADDRESS 0xfe4ccdc8 /* @ECU_Address@autosar_swc_vmp_rtARID_DEF.TmpSignalConversionAtEVM_CIPVOutport1[9].meas_state@ */ /end MEASUREMENT
/begin MEASUREMENT autosar_swc_vmp_rtARID_DEF.TmpSignalConversionAtEVM_CIPVOutport1[9].position.heading_angle "" FLOAT32_IEEE autosar_swc_vmp_CM_single 0 0 -3.4E+38 3.4E+38 ECU_ADDRESS 0xfe4ccdfc /* @ECU_Address@autosar_swc_vmp_rtARID_DEF.TmpSignalConversionAtEVM_CIPVOutport1[9].position.heading_angle@ */ /end MEASUREMENT
/begin MEASUREMENT autosar_swc_vmp_rtARID_DEF.TmpSignalConversionAtEVM_CIPVOutport1[9].position.x "" FLOAT32_IEEE autosar_swc_vmp_CM_single 0 0 -3.4E+38 3.4E+38 ECU_ADDRESS 0xfe4ccdf4 /* @ECU_Address@autosar_swc_vmp_rtARID_DEF.TmpSignalConversionAtEVM_CIPVOutport1[9].position.x@ */ /end MEASUREMENT
/begin MEASUREMENT autosar_swc_vmp_rtARID_DEF.TmpSignalConversionAtEVM_CIPVOutport1[9].position.y "" FLOAT32_IEEE autosar_swc_vmp_CM_single 0 0 -3.4E+38 3.4E+38 ECU_ADDRESS 0xfe4ccdf8 /* @ECU_Address@autosar_swc_vmp_rtARID_DEF.TmpSignalConversionAtEVM_CIPVOutport1[9].position.y@ */ /end MEASUREMENT
/begin MEASUREMENT autosar_swc_vmp_rtARID_DEF.TmpSignalConversionAtEVM_CIPVOutport1[9].position_sl.heading_angle "" FLOAT32_IEEE autosar_swc_vmp_CM_single 0 0 -3.4E+38 3.4E+38 ECU_ADDRESS 0xfe4cce08 /* @ECU_Address@autosar_swc_vmp_rtARID_DEF.TmpSignalConversionAtEVM_CIPVOutport1[9].position_sl.heading_angle@ */ /end MEASUREMENT
/begin MEASUREMENT autosar_swc_vmp_rtARID_DEF.TmpSignalConversionAtEVM_CIPVOutport1[9].position_sl.x "" FLOAT32_IEEE autosar_swc_vmp_CM_single 0 0 -3.4E+38 3.4E+38 ECU_ADDRESS 0xfe4cce00 /* @ECU_Address@autosar_swc_vmp_rtARID_DEF.TmpSignalConversionAtEVM_CIPVOutport1[9].position_sl.x@ */ /end MEASUREMENT
/begin MEASUREMENT autosar_swc_vmp_rtARID_DEF.TmpSignalConversionAtEVM_CIPVOutport1[9].position_sl.y "" FLOAT32_IEEE autosar_swc_vmp_CM_single 0 0 -3.4E+38 3.4E+38 ECU_ADDRESS 0xfe4cce04 /* @ECU_Address@autosar_swc_vmp_rtARID_DEF.TmpSignalConversionAtEVM_CIPVOutport1[9].position_sl.y@ */ /end MEASUREMENT
/begin MEASUREMENT autosar_swc_vmp_rtARID_DEF.TmpSignalConversionAtEVM_CIPVOutport1[9].ref_lane_id "" UBYTE autosar_swc_vmp_CM_uint8 0 0 0 255 ECU_ADDRESS 0xfe4ccdcc /* @ECU_Address@autosar_swc_vmp_rtARID_DEF.TmpSignalConversionAtEVM_CIPVOutport1[9].ref_lane_id@ */ /end MEASUREMENT
/begin MEASUREMENT autosar_swc_vmp_rtARID_DEF.TmpSignalConversionAtEVM_CIPVOutport1[9].size.higth "" FLOAT32_IEEE autosar_swc_vmp_CM_single 0 0 -3.4E+38 3.4E+38 ECU_ADDRESS 0xfe4cce14 /* @ECU_Address@autosar_swc_vmp_rtARID_DEF.TmpSignalConversionAtEVM_CIPVOutport1[9].size.higth@ */ /end MEASUREMENT
/begin MEASUREMENT autosar_swc_vmp_rtARID_DEF.TmpSignalConversionAtEVM_CIPVOutport1[9].size.length "" FLOAT32_IEEE autosar_swc_vmp_CM_single 0 0 -3.4E+38 3.4E+38 ECU_ADDRESS 0xfe4cce0c /* @ECU_Address@autosar_swc_vmp_rtARID_DEF.TmpSignalConversionAtEVM_CIPVOutport1[9].size.length@ */ /end MEASUREMENT
/begin MEASUREMENT autosar_swc_vmp_rtARID_DEF.TmpSignalConversionAtEVM_CIPVOutport1[9].size.width "" FLOAT32_IEEE autosar_swc_vmp_CM_single 0 0 -3.4E+38 3.4E+38 ECU_ADDRESS 0xfe4cce10 /* @ECU_Address@autosar_swc_vmp_rtARID_DEF.TmpSignalConversionAtEVM_CIPVOutport1[9].size.width@ */ /end MEASUREMENT
/begin MEASUREMENT autosar_swc_vmp_rtARID_DEF.TmpSignalConversionAtEVM_CIPVOutport1[9].velocity_gnd.mod "" FLOAT32_IEEE autosar_swc_vmp_CM_single 0 0 -3.4E+38 3.4E+38 ECU_ADDRESS 0xfe4cce20 /* @ECU_Address@autosar_swc_vmp_rtARID_DEF.TmpSignalConversionAtEVM_CIPVOutport1[9].velocity_gnd.mod@ */ /end MEASUREMENT
/begin MEASUREMENT autosar_swc_vmp_rtARID_DEF.TmpSignalConversionAtEVM_CIPVOutport1[9].velocity_gnd.x "" FLOAT32_IEEE autosar_swc_vmp_CM_single 0 0 -3.4E+38 3.4E+38 ECU_ADDRESS 0xfe4cce18 /* @ECU_Address@autosar_swc_vmp_rtARID_DEF.TmpSignalConversionAtEVM_CIPVOutport1[9].velocity_gnd.x@ */ /end MEASUREMENT
/begin MEASUREMENT autosar_swc_vmp_rtARID_DEF.TmpSignalConversionAtEVM_CIPVOutport1[9].velocity_gnd.y "" FLOAT32_IEEE autosar_swc_vmp_CM_single 0 0 -3.4E+38 3.4E+38 ECU_ADDRESS 0xfe4cce1c /* @ECU_Address@autosar_swc_vmp_rtARID_DEF.TmpSignalConversionAtEVM_CIPVOutport1[9].velocity_gnd.y@ */ /end MEASUREMENT
/begin MEASUREMENT autosar_swc_vmp_rtARID_DEF.TmpSignalConversionAtEVM_CIPVOutport1[9].velocity_gnd_sl.mod "" FLOAT32_IEEE autosar_swc_vmp_CM_single 0 0 -3.4E+38 3.4E+38 ECU_ADDRESS 0xfe4cce38 /* @ECU_Address@autosar_swc_vmp_rtARID_DEF.TmpSignalConversionAtEVM_CIPVOutport1[9].velocity_gnd_sl.mod@ */ /end MEASUREMENT
/begin MEASUREMENT autosar_swc_vmp_rtARID_DEF.TmpSignalConversionAtEVM_CIPVOutport1[9].velocity_gnd_sl.x "" FLOAT32_IEEE autosar_swc_vmp_CM_single 0 0 -3.4E+38 3.4E+38 ECU_ADDRESS 0xfe4cce30 /* @ECU_Address@autosar_swc_vmp_rtARID_DEF.TmpSignalConversionAtEVM_CIPVOutport1[9].velocity_gnd_sl.x@ */ /end MEASUREMENT
/begin MEASUREMENT autosar_swc_vmp_rtARID_DEF.TmpSignalConversionAtEVM_CIPVOutport1[9].velocity_gnd_sl.y "" FLOAT32_IEEE autosar_swc_vmp_CM_single 0 0 -3.4E+38 3.4E+38 ECU_ADDRESS 0xfe4cce34 /* @ECU_Address@autosar_swc_vmp_rtARID_DEF.TmpSignalConversionAtEVM_CIPVOutport1[9].velocity_gnd_sl.y@ */ /end MEASUREMENT
/begin MEASUREMENT autosar_swc_vmp_rtARID_DEF.TmpSignalConversionAtEVM_DECSOutport1.host_lane_idx "" UBYTE autosar_swc_vmp_CM_uint8 0 0 0 255 ECU_ADDRESS 0xfe4cd224 /* @ECU_Address@autosar_swc_vmp_rtARID_DEF.TmpSignalConversionAtEVM_DECSOutport1.host_lane_idx@ */ /end MEASUREMENT
/begin MEASUREMENT autosar_swc_vmp_rtARID_DEF.TmpSignalConversionAtEVM_DECSOutport1.lc_level "" UBYTE autosar_swc_vmp_CM_uint8 0 0 0 255 ECU_ADDRESS 0xfe4cd228 /* @ECU_Address@autosar_swc_vmp_rtARID_DEF.TmpSignalConversionAtEVM_DECSOutport1.lc_level@ */ /end MEASUREMENT
/begin MEASUREMENT autosar_swc_vmp_rtARID_DEF.TmpSignalConversionAtEVM_DECSOutport1.lc_lntention_conds "" ULONG autosar_swc_vmp_CM_uint32 0 0 0 4294967295 LAYOUT COLUMN_DIR MATRIX_DIM 10 ECU_ADDRESS 0xfe4cd22c /* @ECU_Address@autosar_swc_vmp_rtARID_DEF.TmpSignalConversionAtEVM_DECSOutport1.lc_lntention_conds@ */ /end MEASUREMENT
/begin MEASUREMENT autosar_swc_vmp_rtARID_DEF.TmpSignalConversionAtEVM_DECSOutport1.lc_req "" UBYTE autosar_swc_vmp_CM_uint8 0 0 0 255 ECU_ADDRESS 0xfe4cd226 /* @ECU_Address@autosar_swc_vmp_rtARID_DEF.TmpSignalConversionAtEVM_DECSOutport1.lc_req@ */ /end MEASUREMENT
/begin MEASUREMENT autosar_swc_vmp_rtARID_DEF.TmpSignalConversionAtEVM_DECSOutport1.lc_req_reason "" UBYTE autosar_swc_vmp_CM_uint8 0 0 0 255 ECU_ADDRESS 0xfe4cd229 /* @ECU_Address@autosar_swc_vmp_rtARID_DEF.TmpSignalConversionAtEVM_DECSOutport1.lc_req_reason@ */ /end MEASUREMENT
/begin MEASUREMENT autosar_swc_vmp_rtARID_DEF.TmpSignalConversionAtEVM_DECSOutport1.lc_req_sync_id "" UBYTE autosar_swc_vmp_CM_uint8 0 0 0 255 ECU_ADDRESS 0xfe4cd227 /* @ECU_Address@autosar_swc_vmp_rtARID_DEF.TmpSignalConversionAtEVM_DECSOutport1.lc_req_sync_id@ */ /end MEASUREMENT
/begin MEASUREMENT autosar_swc_vmp_rtARID_DEF.TmpSignalConversionAtEVM_DECSOutport1.target_lane_idx "" UBYTE autosar_swc_vmp_CM_uint8 0 0 0 255 ECU_ADDRESS 0xfe4cd225 /* @ECU_Address@autosar_swc_vmp_rtARID_DEF.TmpSignalConversionAtEVM_DECSOutport1.target_lane_idx@ */ /end MEASUREMENT
/begin MEASUREMENT autosar_swc_vmp_rtARID_DEF.UnitDelay1_DSTATE.ACC_AccelerateJerk "" FLOAT32_IEEE autosar_swc_vmp_CM_single 0 0 -3.4E+38 3.4E+38 ECU_ADDRESS 0xfe4cd2d0 /* @ECU_Address@autosar_swc_vmp_rtARID_DEF.UnitDelay1_DSTATE.ACC_AccelerateJerk@ */ /end MEASUREMENT
/begin MEASUREMENT autosar_swc_vmp_rtARID_DEF.UnitDelay1_DSTATE.ACC_BrakePrefer "" UBYTE autosar_swc_vmp_CM_logical 0 0 0 1 ECU_ADDRESS 0xfe4cd2bc /* @ECU_Address@autosar_swc_vmp_rtARID_DEF.UnitDelay1_DSTATE.ACC_BrakePrefer@ */ /end MEASUREMENT
/begin MEASUREMENT autosar_swc_vmp_rtARID_DEF.UnitDelay1_DSTATE.ACC_DecelerateJerk "" FLOAT32_IEEE autosar_swc_vmp_CM_single 0 0 -3.4E+38 3.4E+38 ECU_ADDRESS 0xfe4cd2cc /* @ECU_Address@autosar_swc_vmp_rtARID_DEF.UnitDelay1_DSTATE.ACC_DecelerateJerk@ */ /end MEASUREMENT
/begin MEASUREMENT autosar_swc_vmp_rtARID_DEF.UnitDelay1_DSTATE.ACC_axvCvAim "" FLOAT32_IEEE autosar_swc_vmp_CM_single 0 0 -3.4E+38 3.4E+38 ECU_ADDRESS 0xfe4cd2c0 /* @ECU_Address@autosar_swc_vmp_rtARID_DEF.UnitDelay1_DSTATE.ACC_axvCvAim@ */ /end MEASUREMENT
/begin MEASUREMENT autosar_swc_vmp_rtARID_DEF.UnitDelay1_DSTATE.ACC_axv_ComfortBandLowerValue "" FLOAT32_IEEE autosar_swc_vmp_CM_single 0 0 -3.4E+38 3.4E+38 ECU_ADDRESS 0xfe4cd2c4 /* @ECU_Address@autosar_swc_vmp_rtARID_DEF.UnitDelay1_DSTATE.ACC_axv_ComfortBandLowerValue@ */ /end MEASUREMENT
/begin MEASUREMENT autosar_swc_vmp_rtARID_DEF.UnitDelay1_DSTATE.ACC_axv_ComfortBandUpperValue "" FLOAT32_IEEE autosar_swc_vmp_CM_single 0 0 -3.4E+38 3.4E+38 ECU_ADDRESS 0xfe4cd2c8 /* @ECU_Address@autosar_swc_vmp_rtARID_DEF.UnitDelay1_DSTATE.ACC_axv_ComfortBandUpperValue@ */ /end MEASUREMENT
/begin MEASUREMENT autosar_swc_vmp_rtARID_DEF.UnitDelay1_DSTATE.CurvSpdLim "" FLOAT32_IEEE autosar_swc_vmp_CM_single 0 0 -3.4E+38 3.4E+38 ECU_ADDRESS 0xfe4cd2d4 /* @ECU_Address@autosar_swc_vmp_rtARID_DEF.UnitDelay1_DSTATE.CurvSpdLim@ */ /end MEASUREMENT
/begin MEASUREMENT autosar_swc_vmp_rtARID_DEF.tNoneActive2Active "" FLOAT32_IEEE autosar_swc_vmp_CM_single 0 0 -3.4E+38 3.4E+38 ECU_ADDRESS 0xfe4d2e3c /* @ECU_Address@autosar_swc_vmp_rtARID_DEF.tNoneActive2Active@ */ /end MEASUREMENT
/begin COMPU_METHOD autosar_swc_vmp_CM_logical "Q = V" IDENTICAL "%1.0" "" /end COMPU_METHOD
/begin COMPU_METHOD autosar_swc_vmp_CM_single "Q = V" IDENTICAL "%8.6" "" /end COMPU_METHOD
/begin COMPU_METHOD autosar_swc_vmp_CM_uint16 "Q = V" IDENTICAL "%5.0" "" /end COMPU_METHOD
/begin COMPU_METHOD autosar_swc_vmp_CM_uint32 "Q = V" IDENTICAL "%10.0" "" /end COMPU_METHOD
/begin COMPU_METHOD autosar_swc_vmp_CM_uint64 "Q = V" IDENTICAL "%20.0" "" /end COMPU_METHOD
/begin COMPU_METHOD autosar_swc_vmp_CM_uint8 "Q = V" IDENTICAL "%3.0" "" /end COMPU_METHOD
/begin GROUP autosar_swc_vmp_autosar_swc_vmp_Step_sys_lgt_pln_lonap_grp_stateJudge_ttc_3_Subsystem "autosar_swc_vmp/autosar_swc_vmp_Step_sys/lgt_pln/lonap_grp_stateJudge/ttc<3/Subsystem"
 /begin SUB_GROUP autosar_swc_vmp_autosar_swc_vmp_Step_sys_lgt_pln_lonap_grp_stateJudge_ttc_3_Subsystem_Subsystem /end SUB_GROUP
/end GROUP
/begin GROUP autosar_swc_vmp_autosar_swc_vmp_Step_sys_lgt_pln_lonap_grp_stateJudge_ttc_3_Subsystem_Subsystem "autosar_swc_vmp/autosar_swc_vmp_Step_sys/lgt_pln/lonap_grp_stateJudge/ttc<3/Subsystem/Subsystem"
 /begin SUB_GROUP autosar_swc_vmp_autosar_swc_vmp_Step_sys_lgt_pln_lonap_grp_stateJudge_ttc_3_Subsystem_Subsystem_Compare_To_Constant /end SUB_GROUP
/end GROUP
/begin GROUP autosar_swc_vmp_autosar_swc_vmp_Step_sys_lgt_pln_lonap_vlcInternalAccCalc "autosar_swc_vmp/autosar_swc_vmp_Step_sys/lgt_pln/lonap_vlcInternalAccCalc"
 /begin REF_MEASUREMENT autosar_swc_vmp_rtARID_DEF.TappedDelay1_X autosar_swc_vmp_rtARID_DEF.TappedDelay_X_n autosar_swc_vmp_rtARID_DEF.tNoneActive2Active /end REF_MEASUREMENT
/end GROUP
/begin GROUP autosar_swc_vmp_rtARID_DEF.BusAssignment ""
 /begin REF_MEASUREMENT autosar_swc_vmp_rtARID_DEF.BusAssignment.targetExist autosar_swc_vmp_rtARID_DEF.BusAssignment.cutInflg autosar_swc_vmp_rtARID_DEF.BusAssignment.brakeIntention autosar_swc_vmp_rtARID_DEF.BusAssignment.movingState autosar_swc_vmp_rtARID_DEF.BusAssignment.orientation autosar_swc_vmp_rtARID_DEF.BusAssignment.type autosar_swc_vmp_rtARID_DEF.BusAssignment.fu_type autosar_swc_vmp_rtARID_DEF.BusAssignment.dx autosar_swc_vmp_rtARID_DEF.BusAssignment.dy autosar_swc_vmp_rtARID_DEF.BusAssignment.vxRel autosar_swc_vmp_rtARID_DEF.BusAssignment.vyRel autosar_swc_vmp_rtARID_DEF.BusAssignment.vxAbs autosar_swc_vmp_rtARID_DEF.BusAssignment.vyAbs autosar_swc_vmp_rtARID_DEF.BusAssignment.axAbs autosar_swc_vmp_rtARID_DEF.BusAssignment.ayAbs autosar_swc_vmp_rtARID_DEF.BusAssignment.range autosar_swc_vmp_rtARID_DEF.BusAssignment.objExist autosar_swc_vmp_rtARID_DEF.BusAssignment.headingAngle autosar_swc_vmp_rtARID_DEF.BusAssignment.Object_Length autosar_swc_vmp_rtARID_DEF.BusAssignment.Object_Width autosar_swc_vmp_rtARID_DEF.BusAssignment.Object_Hight autosar_swc_vmp_rtARID_DEF.BusAssignment.id autosar_swc_vmp_rtARID_DEF.BusAssignment.age /end REF_MEASUREMENT
/end GROUP
/begin GROUP autosar_swc_vmp_rtARID_DEF.BusAssignment_f ""
 /begin REF_MEASUREMENT autosar_swc_vmp_rtARID_DEF.BusAssignment_f.targetExist autosar_swc_vmp_rtARID_DEF.BusAssignment_f.cutInflg autosar_swc_vmp_rtARID_DEF.BusAssignment_f.brakeIntention autosar_swc_vmp_rtARID_DEF.BusAssignment_f.movingState autosar_swc_vmp_rtARID_DEF.BusAssignment_f.orientation autosar_swc_vmp_rtARID_DEF.BusAssignment_f.type autosar_swc_vmp_rtARID_DEF.BusAssignment_f.fu_type autosar_swc_vmp_rtARID_DEF.BusAssignment_f.dx autosar_swc_vmp_rtARID_DEF.BusAssignment_f.dy autosar_swc_vmp_rtARID_DEF.BusAssignment_f.vxRel autosar_swc_vmp_rtARID_DEF.BusAssignment_f.vyRel autosar_swc_vmp_rtARID_DEF.BusAssignment_f.vxAbs autosar_swc_vmp_rtARID_DEF.BusAssignment_f.vyAbs autosar_swc_vmp_rtARID_DEF.BusAssignment_f.axAbs autosar_swc_vmp_rtARID_DEF.BusAssignment_f.ayAbs autosar_swc_vmp_rtARID_DEF.BusAssignment_f.range autosar_swc_vmp_rtARID_DEF.BusAssignment_f.objExist autosar_swc_vmp_rtARID_DEF.BusAssignment_f.headingAngle autosar_swc_vmp_rtARID_DEF.BusAssignment_f.Object_Length autosar_swc_vmp_rtARID_DEF.BusAssignment_f.Object_Width autosar_swc_vmp_rtARID_DEF.BusAssignment_f.Object_Hight autosar_swc_vmp_rtARID_DEF.BusAssignment_f.id autosar_swc_vmp_rtARID_DEF.BusAssignment_f.age /end REF_MEASUREMENT
/end GROUP
/begin GROUP autosar_swc_vmp_rtARID_DEF.BusAssignment_f5 ""
 /begin REF_MEASUREMENT autosar_swc_vmp_rtARID_DEF.BusAssignment_f5.targetExist autosar_swc_vmp_rtARID_DEF.BusAssignment_f5.cutInflg autosar_swc_vmp_rtARID_DEF.BusAssignment_f5.brakeIntention autosar_swc_vmp_rtARID_DEF.BusAssignment_f5.movingState autosar_swc_vmp_rtARID_DEF.BusAssignment_f5.orientation autosar_swc_vmp_rtARID_DEF.BusAssignment_f5.type autosar_swc_vmp_rtARID_DEF.BusAssignment_f5.fu_type autosar_swc_vmp_rtARID_DEF.BusAssignment_f5.dx autosar_swc_vmp_rtARID_DEF.BusAssignment_f5.dy autosar_swc_vmp_rtARID_DEF.BusAssignment_f5.vxRel autosar_swc_vmp_rtARID_DEF.BusAssignment_f5.vyRel autosar_swc_vmp_rtARID_DEF.BusAssignment_f5.vxAbs autosar_swc_vmp_rtARID_DEF.BusAssignment_f5.vyAbs autosar_swc_vmp_rtARID_DEF.BusAssignment_f5.axAbs autosar_swc_vmp_rtARID_DEF.BusAssignment_f5.ayAbs autosar_swc_vmp_rtARID_DEF.BusAssignment_f5.range autosar_swc_vmp_rtARID_DEF.BusAssignment_f5.objExist autosar_swc_vmp_rtARID_DEF.BusAssignment_f5.headingAngle autosar_swc_vmp_rtARID_DEF.BusAssignment_f5.Object_Length autosar_swc_vmp_rtARID_DEF.BusAssignment_f5.Object_Width autosar_swc_vmp_rtARID_DEF.BusAssignment_f5.Object_Hight autosar_swc_vmp_rtARID_DEF.BusAssignment_f5.id autosar_swc_vmp_rtARID_DEF.BusAssignment_f5.age /end REF_MEASUREMENT
/end GROUP
/begin GROUP autosar_swc_vmp_rtARID_DEF.BusAssignment_p ""
 /begin REF_MEASUREMENT autosar_swc_vmp_rtARID_DEF.BusAssignment_p.targetExist autosar_swc_vmp_rtARID_DEF.BusAssignment_p.cutInflg autosar_swc_vmp_rtARID_DEF.BusAssignment_p.brakeIntention autosar_swc_vmp_rtARID_DEF.BusAssignment_p.movingState autosar_swc_vmp_rtARID_DEF.BusAssignment_p.orientation autosar_swc_vmp_rtARID_DEF.BusAssignment_p.type autosar_swc_vmp_rtARID_DEF.BusAssignment_p.fu_type autosar_swc_vmp_rtARID_DEF.BusAssignment_p.dx autosar_swc_vmp_rtARID_DEF.BusAssignment_p.dy autosar_swc_vmp_rtARID_DEF.BusAssignment_p.vxRel autosar_swc_vmp_rtARID_DEF.BusAssignment_p.vyRel autosar_swc_vmp_rtARID_DEF.BusAssignment_p.vxAbs autosar_swc_vmp_rtARID_DEF.BusAssignment_p.vyAbs autosar_swc_vmp_rtARID_DEF.BusAssignment_p.axAbs autosar_swc_vmp_rtARID_DEF.BusAssignment_p.ayAbs autosar_swc_vmp_rtARID_DEF.BusAssignment_p.range autosar_swc_vmp_rtARID_DEF.BusAssignment_p.objExist autosar_swc_vmp_rtARID_DEF.BusAssignment_p.headingAngle autosar_swc_vmp_rtARID_DEF.BusAssignment_p.Object_Length autosar_swc_vmp_rtARID_DEF.BusAssignment_p.Object_Width autosar_swc_vmp_rtARID_DEF.BusAssignment_p.Object_Hight autosar_swc_vmp_rtARID_DEF.BusAssignment_p.id autosar_swc_vmp_rtARID_DEF.BusAssignment_p.age /end REF_MEASUREMENT
/end GROUP
/begin GROUP autosar_swc_vmp_rtARID_DEF.ICAS_STATEOut ""
 /begin REF_MEASUREMENT autosar_swc_vmp_rtARID_DEF.ICAS_STATEOut.acc_sts autosar_swc_vmp_rtARID_DEF.ICAS_STATEOut.lcc_sts autosar_swc_vmp_rtARID_DEF.ICAS_STATEOut.nudge_sts autosar_swc_vmp_rtARID_DEF.ICAS_STATEOut.alc_sts autosar_swc_vmp_rtARID_DEF.ICAS_STATEOut.noa_sts autosar_swc_vmp_rtARID_DEF.ICAS_STATEOut.lc_req_sync_id autosar_swc_vmp_rtARID_DEF.ICAS_STATEOut.acc_manual_act_faile_reason autosar_swc_vmp_rtARID_DEF.ICAS_STATEOut.acc_exit_reason autosar_swc_vmp_rtARID_DEF.ICAS_STATEOut.lcc_manual_act_faile_reason autosar_swc_vmp_rtARID_DEF.ICAS_STATEOut.lcc_auto_act_faile_reason autosar_swc_vmp_rtARID_DEF.ICAS_STATEOut.lcc_exit_to_idle_reason autosar_swc_vmp_rtARID_DEF.ICAS_STATEOut.lcc_exit_to_wait_reason autosar_swc_vmp_rtARID_DEF.ICAS_STATEOut.lcc_exit_to_mrc_reason autosar_swc_vmp_rtARID_DEF.ICAS_STATEOut.lcc_mrc_exit_reason autosar_swc_vmp_rtARID_DEF.ICAS_STATEOut.noa_auto_act_faile_reason autosar_swc_vmp_rtARID_DEF.ICAS_STATEOut.noa_exit_reason /end REF_MEASUREMENT
/end GROUP
/begin GROUP autosar_swc_vmp_rtARID_DEF.TmpSignalConversionAtCSM_CTRLOutport1 ""
 /begin REF_MEASUREMENT autosar_swc_vmp_rtARID_DEF.TmpSignalConversionAtCSM_CTRLOutport1.VsetBelowMin autosar_swc_vmp_rtARID_DEF.TmpSignalConversionAtCSM_CTRLOutport1.CruiseSpdCtrlLevel autosar_swc_vmp_rtARID_DEF.TmpSignalConversionAtCSM_CTRLOutport1.TimeGapLevel autosar_swc_vmp_rtARID_DEF.TmpSignalConversionAtCSM_CTRLOutport1.CruiseSpdKmh autosar_swc_vmp_rtARID_DEF.TmpSignalConversionAtCSM_CTRLOutport1.ISL_APSpdLimSPL autosar_swc_vmp_rtARID_DEF.TmpSignalConversionAtCSM_CTRLOutport1.ISL_APSpdLimDist /end REF_MEASUREMENT
/end GROUP
/begin GROUP autosar_swc_vmp_rtARID_DEF.TmpSignalConversionAtEVM_CIPVOutport1[0] ""
 /begin SUB_GROUP autosar_swc_vmp_rtARID_DEF.TmpSignalConversionAtEVM_CIPVOutport1[0].box autosar_swc_vmp_rtARID_DEF.TmpSignalConversionAtEVM_CIPVOutport1[0].position autosar_swc_vmp_rtARID_DEF.TmpSignalConversionAtEVM_CIPVOutport1[0].position_sl autosar_swc_vmp_rtARID_DEF.TmpSignalConversionAtEVM_CIPVOutport1[0].size autosar_swc_vmp_rtARID_DEF.TmpSignalConversionAtEVM_CIPVOutport1[0].velocity_gnd autosar_swc_vmp_rtARID_DEF.TmpSignalConversionAtEVM_CIPVOutport1[0].accel_gnd autosar_swc_vmp_rtARID_DEF.TmpSignalConversionAtEVM_CIPVOutport1[0].velocity_gnd_sl autosar_swc_vmp_rtARID_DEF.TmpSignalConversionAtEVM_CIPVOutport1[0].accel_gnd_sl /end SUB_GROUP
 /begin REF_MEASUREMENT autosar_swc_vmp_rtARID_DEF.TmpSignalConversionAtEVM_CIPVOutport1[0].meas_state autosar_swc_vmp_rtARID_DEF.TmpSignalConversionAtEVM_CIPVOutport1[0].fus_type autosar_swc_vmp_rtARID_DEF.TmpSignalConversionAtEVM_CIPVOutport1[0].class_type autosar_swc_vmp_rtARID_DEF.TmpSignalConversionAtEVM_CIPVOutport1[0].cut_type autosar_swc_vmp_rtARID_DEF.TmpSignalConversionAtEVM_CIPVOutport1[0].ref_lane_id autosar_swc_vmp_rtARID_DEF.TmpSignalConversionAtEVM_CIPVOutport1[0].id /end REF_MEASUREMENT
/end GROUP
/begin GROUP autosar_swc_vmp_rtARID_DEF.TmpSignalConversionAtEVM_CIPVOutport1[0].accel_gnd ""
 /begin REF_MEASUREMENT autosar_swc_vmp_rtARID_DEF.TmpSignalConversionAtEVM_CIPVOutport1[0].accel_gnd.x autosar_swc_vmp_rtARID_DEF.TmpSignalConversionAtEVM_CIPVOutport1[0].accel_gnd.y autosar_swc_vmp_rtARID_DEF.TmpSignalConversionAtEVM_CIPVOutport1[0].accel_gnd.mod /end REF_MEASUREMENT
/end GROUP
/begin GROUP autosar_swc_vmp_rtARID_DEF.TmpSignalConversionAtEVM_CIPVOutport1[0].accel_gnd_sl ""
 /begin REF_MEASUREMENT autosar_swc_vmp_rtARID_DEF.TmpSignalConversionAtEVM_CIPVOutport1[0].accel_gnd_sl.x autosar_swc_vmp_rtARID_DEF.TmpSignalConversionAtEVM_CIPVOutport1[0].accel_gnd_sl.y autosar_swc_vmp_rtARID_DEF.TmpSignalConversionAtEVM_CIPVOutport1[0].accel_gnd_sl.mod /end REF_MEASUREMENT
/end GROUP
/begin GROUP autosar_swc_vmp_rtARID_DEF.TmpSignalConversionAtEVM_CIPVOutport1[0].box ""
 /begin REF_MEASUREMENT autosar_swc_vmp_rtARID_DEF.TmpSignalConversionAtEVM_CIPVOutport1[0].box.corner_x_vec autosar_swc_vmp_rtARID_DEF.TmpSignalConversionAtEVM_CIPVOutport1[0].box.corner_y_vec /end REF_MEASUREMENT
/end GROUP
/begin GROUP autosar_swc_vmp_rtARID_DEF.TmpSignalConversionAtEVM_CIPVOutport1[0].position ""
 /begin REF_MEASUREMENT autosar_swc_vmp_rtARID_DEF.TmpSignalConversionAtEVM_CIPVOutport1[0].position.x autosar_swc_vmp_rtARID_DEF.TmpSignalConversionAtEVM_CIPVOutport1[0].position.y autosar_swc_vmp_rtARID_DEF.TmpSignalConversionAtEVM_CIPVOutport1[0].position.heading_angle /end REF_MEASUREMENT
/end GROUP
/begin GROUP autosar_swc_vmp_rtARID_DEF.TmpSignalConversionAtEVM_CIPVOutport1[0].position_sl ""
 /begin REF_MEASUREMENT autosar_swc_vmp_rtARID_DEF.TmpSignalConversionAtEVM_CIPVOutport1[0].position_sl.x autosar_swc_vmp_rtARID_DEF.TmpSignalConversionAtEVM_CIPVOutport1[0].position_sl.y autosar_swc_vmp_rtARID_DEF.TmpSignalConversionAtEVM_CIPVOutport1[0].position_sl.heading_angle /end REF_MEASUREMENT
/end GROUP
/begin GROUP autosar_swc_vmp_rtARID_DEF.TmpSignalConversionAtEVM_CIPVOutport1[0].size ""
 /begin REF_MEASUREMENT autosar_swc_vmp_rtARID_DEF.TmpSignalConversionAtEVM_CIPVOutport1[0].size.length autosar_swc_vmp_rtARID_DEF.TmpSignalConversionAtEVM_CIPVOutport1[0].size.width autosar_swc_vmp_rtARID_DEF.TmpSignalConversionAtEVM_CIPVOutport1[0].size.higth /end REF_MEASUREMENT
/end GROUP
/begin GROUP autosar_swc_vmp_rtARID_DEF.TmpSignalConversionAtEVM_CIPVOutport1[0].velocity_gnd ""
 /begin REF_MEASUREMENT autosar_swc_vmp_rtARID_DEF.TmpSignalConversionAtEVM_CIPVOutport1[0].velocity_gnd.x autosar_swc_vmp_rtARID_DEF.TmpSignalConversionAtEVM_CIPVOutport1[0].velocity_gnd.y autosar_swc_vmp_rtARID_DEF.TmpSignalConversionAtEVM_CIPVOutport1[0].velocity_gnd.mod /end REF_MEASUREMENT
/end GROUP
/begin GROUP autosar_swc_vmp_rtARID_DEF.TmpSignalConversionAtEVM_CIPVOutport1[0].velocity_gnd_sl ""
 /begin REF_MEASUREMENT autosar_swc_vmp_rtARID_DEF.TmpSignalConversionAtEVM_CIPVOutport1[0].velocity_gnd_sl.x autosar_swc_vmp_rtARID_DEF.TmpSignalConversionAtEVM_CIPVOutport1[0].velocity_gnd_sl.y autosar_swc_vmp_rtARID_DEF.TmpSignalConversionAtEVM_CIPVOutport1[0].velocity_gnd_sl.mod /end REF_MEASUREMENT
/end GROUP
/begin GROUP autosar_swc_vmp_rtARID_DEF.TmpSignalConversionAtEVM_CIPVOutport1[1] ""
 /begin SUB_GROUP autosar_swc_vmp_rtARID_DEF.TmpSignalConversionAtEVM_CIPVOutport1[1].box autosar_swc_vmp_rtARID_DEF.TmpSignalConversionAtEVM_CIPVOutport1[1].position autosar_swc_vmp_rtARID_DEF.TmpSignalConversionAtEVM_CIPVOutport1[1].position_sl autosar_swc_vmp_rtARID_DEF.TmpSignalConversionAtEVM_CIPVOutport1[1].size autosar_swc_vmp_rtARID_DEF.TmpSignalConversionAtEVM_CIPVOutport1[1].velocity_gnd autosar_swc_vmp_rtARID_DEF.TmpSignalConversionAtEVM_CIPVOutport1[1].accel_gnd autosar_swc_vmp_rtARID_DEF.TmpSignalConversionAtEVM_CIPVOutport1[1].velocity_gnd_sl autosar_swc_vmp_rtARID_DEF.TmpSignalConversionAtEVM_CIPVOutport1[1].accel_gnd_sl /end SUB_GROUP
 /begin REF_MEASUREMENT autosar_swc_vmp_rtARID_DEF.TmpSignalConversionAtEVM_CIPVOutport1[1].meas_state autosar_swc_vmp_rtARID_DEF.TmpSignalConversionAtEVM_CIPVOutport1[1].fus_type autosar_swc_vmp_rtARID_DEF.TmpSignalConversionAtEVM_CIPVOutport1[1].class_type autosar_swc_vmp_rtARID_DEF.TmpSignalConversionAtEVM_CIPVOutport1[1].cut_type autosar_swc_vmp_rtARID_DEF.TmpSignalConversionAtEVM_CIPVOutport1[1].ref_lane_id autosar_swc_vmp_rtARID_DEF.TmpSignalConversionAtEVM_CIPVOutport1[1].id /end REF_MEASUREMENT
/end GROUP
/begin GROUP autosar_swc_vmp_rtARID_DEF.TmpSignalConversionAtEVM_CIPVOutport1[1].accel_gnd ""
 /begin REF_MEASUREMENT autosar_swc_vmp_rtARID_DEF.TmpSignalConversionAtEVM_CIPVOutport1[1].accel_gnd.x autosar_swc_vmp_rtARID_DEF.TmpSignalConversionAtEVM_CIPVOutport1[1].accel_gnd.y autosar_swc_vmp_rtARID_DEF.TmpSignalConversionAtEVM_CIPVOutport1[1].accel_gnd.mod /end REF_MEASUREMENT
/end GROUP
/begin GROUP autosar_swc_vmp_rtARID_DEF.TmpSignalConversionAtEVM_CIPVOutport1[1].accel_gnd_sl ""
 /begin REF_MEASUREMENT autosar_swc_vmp_rtARID_DEF.TmpSignalConversionAtEVM_CIPVOutport1[1].accel_gnd_sl.x autosar_swc_vmp_rtARID_DEF.TmpSignalConversionAtEVM_CIPVOutport1[1].accel_gnd_sl.y autosar_swc_vmp_rtARID_DEF.TmpSignalConversionAtEVM_CIPVOutport1[1].accel_gnd_sl.mod /end REF_MEASUREMENT
/end GROUP
/begin GROUP autosar_swc_vmp_rtARID_DEF.TmpSignalConversionAtEVM_CIPVOutport1[1].box ""
 /begin REF_MEASUREMENT autosar_swc_vmp_rtARID_DEF.TmpSignalConversionAtEVM_CIPVOutport1[1].box.corner_x_vec autosar_swc_vmp_rtARID_DEF.TmpSignalConversionAtEVM_CIPVOutport1[1].box.corner_y_vec /end REF_MEASUREMENT
/end GROUP
/begin GROUP autosar_swc_vmp_rtARID_DEF.TmpSignalConversionAtEVM_CIPVOutport1[1].position ""
 /begin REF_MEASUREMENT autosar_swc_vmp_rtARID_DEF.TmpSignalConversionAtEVM_CIPVOutport1[1].position.x autosar_swc_vmp_rtARID_DEF.TmpSignalConversionAtEVM_CIPVOutport1[1].position.y autosar_swc_vmp_rtARID_DEF.TmpSignalConversionAtEVM_CIPVOutport1[1].position.heading_angle /end REF_MEASUREMENT
/end GROUP
/begin GROUP autosar_swc_vmp_rtARID_DEF.TmpSignalConversionAtEVM_CIPVOutport1[1].position_sl ""
 /begin REF_MEASUREMENT autosar_swc_vmp_rtARID_DEF.TmpSignalConversionAtEVM_CIPVOutport1[1].position_sl.x autosar_swc_vmp_rtARID_DEF.TmpSignalConversionAtEVM_CIPVOutport1[1].position_sl.y autosar_swc_vmp_rtARID_DEF.TmpSignalConversionAtEVM_CIPVOutport1[1].position_sl.heading_angle /end REF_MEASUREMENT
/end GROUP
/begin GROUP autosar_swc_vmp_rtARID_DEF.TmpSignalConversionAtEVM_CIPVOutport1[1].size ""
 /begin REF_MEASUREMENT autosar_swc_vmp_rtARID_DEF.TmpSignalConversionAtEVM_CIPVOutport1[1].size.length autosar_swc_vmp_rtARID_DEF.TmpSignalConversionAtEVM_CIPVOutport1[1].size.width autosar_swc_vmp_rtARID_DEF.TmpSignalConversionAtEVM_CIPVOutport1[1].size.higth /end REF_MEASUREMENT
/end GROUP
/begin GROUP autosar_swc_vmp_rtARID_DEF.TmpSignalConversionAtEVM_CIPVOutport1[1].velocity_gnd ""
 /begin REF_MEASUREMENT autosar_swc_vmp_rtARID_DEF.TmpSignalConversionAtEVM_CIPVOutport1[1].velocity_gnd.x autosar_swc_vmp_rtARID_DEF.TmpSignalConversionAtEVM_CIPVOutport1[1].velocity_gnd.y autosar_swc_vmp_rtARID_DEF.TmpSignalConversionAtEVM_CIPVOutport1[1].velocity_gnd.mod /end REF_MEASUREMENT
/end GROUP
/begin GROUP autosar_swc_vmp_rtARID_DEF.TmpSignalConversionAtEVM_CIPVOutport1[1].velocity_gnd_sl ""
 /begin REF_MEASUREMENT autosar_swc_vmp_rtARID_DEF.TmpSignalConversionAtEVM_CIPVOutport1[1].velocity_gnd_sl.x autosar_swc_vmp_rtARID_DEF.TmpSignalConversionAtEVM_CIPVOutport1[1].velocity_gnd_sl.y autosar_swc_vmp_rtARID_DEF.TmpSignalConversionAtEVM_CIPVOutport1[1].velocity_gnd_sl.mod /end REF_MEASUREMENT
/end GROUP
/begin GROUP autosar_swc_vmp_rtARID_DEF.TmpSignalConversionAtEVM_CIPVOutport1[2] ""
 /begin SUB_GROUP autosar_swc_vmp_rtARID_DEF.TmpSignalConversionAtEVM_CIPVOutport1[2].box autosar_swc_vmp_rtARID_DEF.TmpSignalConversionAtEVM_CIPVOutport1[2].position autosar_swc_vmp_rtARID_DEF.TmpSignalConversionAtEVM_CIPVOutport1[2].position_sl autosar_swc_vmp_rtARID_DEF.TmpSignalConversionAtEVM_CIPVOutport1[2].size autosar_swc_vmp_rtARID_DEF.TmpSignalConversionAtEVM_CIPVOutport1[2].velocity_gnd autosar_swc_vmp_rtARID_DEF.TmpSignalConversionAtEVM_CIPVOutport1[2].accel_gnd autosar_swc_vmp_rtARID_DEF.TmpSignalConversionAtEVM_CIPVOutport1[2].velocity_gnd_sl autosar_swc_vmp_rtARID_DEF.TmpSignalConversionAtEVM_CIPVOutport1[2].accel_gnd_sl /end SUB_GROUP
 /begin REF_MEASUREMENT autosar_swc_vmp_rtARID_DEF.TmpSignalConversionAtEVM_CIPVOutport1[2].meas_state autosar_swc_vmp_rtARID_DEF.TmpSignalConversionAtEVM_CIPVOutport1[2].fus_type autosar_swc_vmp_rtARID_DEF.TmpSignalConversionAtEVM_CIPVOutport1[2].class_type autosar_swc_vmp_rtARID_DEF.TmpSignalConversionAtEVM_CIPVOutport1[2].cut_type autosar_swc_vmp_rtARID_DEF.TmpSignalConversionAtEVM_CIPVOutport1[2].ref_lane_id autosar_swc_vmp_rtARID_DEF.TmpSignalConversionAtEVM_CIPVOutport1[2].id /end REF_MEASUREMENT
/end GROUP
/begin GROUP autosar_swc_vmp_rtARID_DEF.TmpSignalConversionAtEVM_CIPVOutport1[2].accel_gnd ""
 /begin REF_MEASUREMENT autosar_swc_vmp_rtARID_DEF.TmpSignalConversionAtEVM_CIPVOutport1[2].accel_gnd.x autosar_swc_vmp_rtARID_DEF.TmpSignalConversionAtEVM_CIPVOutport1[2].accel_gnd.y autosar_swc_vmp_rtARID_DEF.TmpSignalConversionAtEVM_CIPVOutport1[2].accel_gnd.mod /end REF_MEASUREMENT
/end GROUP
/begin GROUP autosar_swc_vmp_rtARID_DEF.TmpSignalConversionAtEVM_CIPVOutport1[2].accel_gnd_sl ""
 /begin REF_MEASUREMENT autosar_swc_vmp_rtARID_DEF.TmpSignalConversionAtEVM_CIPVOutport1[2].accel_gnd_sl.x autosar_swc_vmp_rtARID_DEF.TmpSignalConversionAtEVM_CIPVOutport1[2].accel_gnd_sl.y autosar_swc_vmp_rtARID_DEF.TmpSignalConversionAtEVM_CIPVOutport1[2].accel_gnd_sl.mod /end REF_MEASUREMENT
/end GROUP
/begin GROUP autosar_swc_vmp_rtARID_DEF.TmpSignalConversionAtEVM_CIPVOutport1[2].box ""
 /begin REF_MEASUREMENT autosar_swc_vmp_rtARID_DEF.TmpSignalConversionAtEVM_CIPVOutport1[2].box.corner_x_vec autosar_swc_vmp_rtARID_DEF.TmpSignalConversionAtEVM_CIPVOutport1[2].box.corner_y_vec /end REF_MEASUREMENT
/end GROUP
/begin GROUP autosar_swc_vmp_rtARID_DEF.TmpSignalConversionAtEVM_CIPVOutport1[2].position ""
 /begin REF_MEASUREMENT autosar_swc_vmp_rtARID_DEF.TmpSignalConversionAtEVM_CIPVOutport1[2].position.x autosar_swc_vmp_rtARID_DEF.TmpSignalConversionAtEVM_CIPVOutport1[2].position.y autosar_swc_vmp_rtARID_DEF.TmpSignalConversionAtEVM_CIPVOutport1[2].position.heading_angle /end REF_MEASUREMENT
/end GROUP
/begin GROUP autosar_swc_vmp_rtARID_DEF.TmpSignalConversionAtEVM_CIPVOutport1[2].position_sl ""
 /begin REF_MEASUREMENT autosar_swc_vmp_rtARID_DEF.TmpSignalConversionAtEVM_CIPVOutport1[2].position_sl.x autosar_swc_vmp_rtARID_DEF.TmpSignalConversionAtEVM_CIPVOutport1[2].position_sl.y autosar_swc_vmp_rtARID_DEF.TmpSignalConversionAtEVM_CIPVOutport1[2].position_sl.heading_angle /end REF_MEASUREMENT
/end GROUP
/begin GROUP autosar_swc_vmp_rtARID_DEF.TmpSignalConversionAtEVM_CIPVOutport1[2].size ""
 /begin REF_MEASUREMENT autosar_swc_vmp_rtARID_DEF.TmpSignalConversionAtEVM_CIPVOutport1[2].size.length autosar_swc_vmp_rtARID_DEF.TmpSignalConversionAtEVM_CIPVOutport1[2].size.width autosar_swc_vmp_rtARID_DEF.TmpSignalConversionAtEVM_CIPVOutport1[2].size.higth /end REF_MEASUREMENT
/end GROUP
/begin GROUP autosar_swc_vmp_rtARID_DEF.TmpSignalConversionAtEVM_CIPVOutport1[2].velocity_gnd ""
 /begin REF_MEASUREMENT autosar_swc_vmp_rtARID_DEF.TmpSignalConversionAtEVM_CIPVOutport1[2].velocity_gnd.x autosar_swc_vmp_rtARID_DEF.TmpSignalConversionAtEVM_CIPVOutport1[2].velocity_gnd.y autosar_swc_vmp_rtARID_DEF.TmpSignalConversionAtEVM_CIPVOutport1[2].velocity_gnd.mod /end REF_MEASUREMENT
/end GROUP
/begin GROUP autosar_swc_vmp_rtARID_DEF.TmpSignalConversionAtEVM_CIPVOutport1[2].velocity_gnd_sl ""
 /begin REF_MEASUREMENT autosar_swc_vmp_rtARID_DEF.TmpSignalConversionAtEVM_CIPVOutport1[2].velocity_gnd_sl.x autosar_swc_vmp_rtARID_DEF.TmpSignalConversionAtEVM_CIPVOutport1[2].velocity_gnd_sl.y autosar_swc_vmp_rtARID_DEF.TmpSignalConversionAtEVM_CIPVOutport1[2].velocity_gnd_sl.mod /end REF_MEASUREMENT
/end GROUP
/begin GROUP autosar_swc_vmp_rtARID_DEF.TmpSignalConversionAtEVM_CIPVOutport1[3] ""
 /begin SUB_GROUP autosar_swc_vmp_rtARID_DEF.TmpSignalConversionAtEVM_CIPVOutport1[3].box autosar_swc_vmp_rtARID_DEF.TmpSignalConversionAtEVM_CIPVOutport1[3].position autosar_swc_vmp_rtARID_DEF.TmpSignalConversionAtEVM_CIPVOutport1[3].position_sl autosar_swc_vmp_rtARID_DEF.TmpSignalConversionAtEVM_CIPVOutport1[3].size autosar_swc_vmp_rtARID_DEF.TmpSignalConversionAtEVM_CIPVOutport1[3].velocity_gnd autosar_swc_vmp_rtARID_DEF.TmpSignalConversionAtEVM_CIPVOutport1[3].accel_gnd autosar_swc_vmp_rtARID_DEF.TmpSignalConversionAtEVM_CIPVOutport1[3].velocity_gnd_sl autosar_swc_vmp_rtARID_DEF.TmpSignalConversionAtEVM_CIPVOutport1[3].accel_gnd_sl /end SUB_GROUP
 /begin REF_MEASUREMENT autosar_swc_vmp_rtARID_DEF.TmpSignalConversionAtEVM_CIPVOutport1[3].meas_state autosar_swc_vmp_rtARID_DEF.TmpSignalConversionAtEVM_CIPVOutport1[3].fus_type autosar_swc_vmp_rtARID_DEF.TmpSignalConversionAtEVM_CIPVOutport1[3].class_type autosar_swc_vmp_rtARID_DEF.TmpSignalConversionAtEVM_CIPVOutport1[3].cut_type autosar_swc_vmp_rtARID_DEF.TmpSignalConversionAtEVM_CIPVOutport1[3].ref_lane_id autosar_swc_vmp_rtARID_DEF.TmpSignalConversionAtEVM_CIPVOutport1[3].id /end REF_MEASUREMENT
/end GROUP
/begin GROUP autosar_swc_vmp_rtARID_DEF.TmpSignalConversionAtEVM_CIPVOutport1[3].accel_gnd ""
 /begin REF_MEASUREMENT autosar_swc_vmp_rtARID_DEF.TmpSignalConversionAtEVM_CIPVOutport1[3].accel_gnd.x autosar_swc_vmp_rtARID_DEF.TmpSignalConversionAtEVM_CIPVOutport1[3].accel_gnd.y autosar_swc_vmp_rtARID_DEF.TmpSignalConversionAtEVM_CIPVOutport1[3].accel_gnd.mod /end REF_MEASUREMENT
/end GROUP
/begin GROUP autosar_swc_vmp_rtARID_DEF.TmpSignalConversionAtEVM_CIPVOutport1[3].accel_gnd_sl ""
 /begin REF_MEASUREMENT autosar_swc_vmp_rtARID_DEF.TmpSignalConversionAtEVM_CIPVOutport1[3].accel_gnd_sl.x autosar_swc_vmp_rtARID_DEF.TmpSignalConversionAtEVM_CIPVOutport1[3].accel_gnd_sl.y autosar_swc_vmp_rtARID_DEF.TmpSignalConversionAtEVM_CIPVOutport1[3].accel_gnd_sl.mod /end REF_MEASUREMENT
/end GROUP
/begin GROUP autosar_swc_vmp_rtARID_DEF.TmpSignalConversionAtEVM_CIPVOutport1[3].box ""
 /begin REF_MEASUREMENT autosar_swc_vmp_rtARID_DEF.TmpSignalConversionAtEVM_CIPVOutport1[3].box.corner_x_vec autosar_swc_vmp_rtARID_DEF.TmpSignalConversionAtEVM_CIPVOutport1[3].box.corner_y_vec /end REF_MEASUREMENT
/end GROUP
/begin GROUP autosar_swc_vmp_rtARID_DEF.TmpSignalConversionAtEVM_CIPVOutport1[3].position ""
 /begin REF_MEASUREMENT autosar_swc_vmp_rtARID_DEF.TmpSignalConversionAtEVM_CIPVOutport1[3].position.x autosar_swc_vmp_rtARID_DEF.TmpSignalConversionAtEVM_CIPVOutport1[3].position.y autosar_swc_vmp_rtARID_DEF.TmpSignalConversionAtEVM_CIPVOutport1[3].position.heading_angle /end REF_MEASUREMENT
/end GROUP
/begin GROUP autosar_swc_vmp_rtARID_DEF.TmpSignalConversionAtEVM_CIPVOutport1[3].position_sl ""
 /begin REF_MEASUREMENT autosar_swc_vmp_rtARID_DEF.TmpSignalConversionAtEVM_CIPVOutport1[3].position_sl.x autosar_swc_vmp_rtARID_DEF.TmpSignalConversionAtEVM_CIPVOutport1[3].position_sl.y autosar_swc_vmp_rtARID_DEF.TmpSignalConversionAtEVM_CIPVOutport1[3].position_sl.heading_angle /end REF_MEASUREMENT
/end GROUP
/begin GROUP autosar_swc_vmp_rtARID_DEF.TmpSignalConversionAtEVM_CIPVOutport1[3].size ""
 /begin REF_MEASUREMENT autosar_swc_vmp_rtARID_DEF.TmpSignalConversionAtEVM_CIPVOutport1[3].size.length autosar_swc_vmp_rtARID_DEF.TmpSignalConversionAtEVM_CIPVOutport1[3].size.width autosar_swc_vmp_rtARID_DEF.TmpSignalConversionAtEVM_CIPVOutport1[3].size.higth /end REF_MEASUREMENT
/end GROUP
/begin GROUP autosar_swc_vmp_rtARID_DEF.TmpSignalConversionAtEVM_CIPVOutport1[3].velocity_gnd ""
 /begin REF_MEASUREMENT autosar_swc_vmp_rtARID_DEF.TmpSignalConversionAtEVM_CIPVOutport1[3].velocity_gnd.x autosar_swc_vmp_rtARID_DEF.TmpSignalConversionAtEVM_CIPVOutport1[3].velocity_gnd.y autosar_swc_vmp_rtARID_DEF.TmpSignalConversionAtEVM_CIPVOutport1[3].velocity_gnd.mod /end REF_MEASUREMENT
/end GROUP
/begin GROUP autosar_swc_vmp_rtARID_DEF.TmpSignalConversionAtEVM_CIPVOutport1[3].velocity_gnd_sl ""
 /begin REF_MEASUREMENT autosar_swc_vmp_rtARID_DEF.TmpSignalConversionAtEVM_CIPVOutport1[3].velocity_gnd_sl.x autosar_swc_vmp_rtARID_DEF.TmpSignalConversionAtEVM_CIPVOutport1[3].velocity_gnd_sl.y autosar_swc_vmp_rtARID_DEF.TmpSignalConversionAtEVM_CIPVOutport1[3].velocity_gnd_sl.mod /end REF_MEASUREMENT
/end GROUP
/begin GROUP autosar_swc_vmp_rtARID_DEF.TmpSignalConversionAtEVM_CIPVOutport1[4] ""
 /begin SUB_GROUP autosar_swc_vmp_rtARID_DEF.TmpSignalConversionAtEVM_CIPVOutport1[4].box autosar_swc_vmp_rtARID_DEF.TmpSignalConversionAtEVM_CIPVOutport1[4].position autosar_swc_vmp_rtARID_DEF.TmpSignalConversionAtEVM_CIPVOutport1[4].position_sl autosar_swc_vmp_rtARID_DEF.TmpSignalConversionAtEVM_CIPVOutport1[4].size autosar_swc_vmp_rtARID_DEF.TmpSignalConversionAtEVM_CIPVOutport1[4].velocity_gnd autosar_swc_vmp_rtARID_DEF.TmpSignalConversionAtEVM_CIPVOutport1[4].accel_gnd autosar_swc_vmp_rtARID_DEF.TmpSignalConversionAtEVM_CIPVOutport1[4].velocity_gnd_sl autosar_swc_vmp_rtARID_DEF.TmpSignalConversionAtEVM_CIPVOutport1[4].accel_gnd_sl /end SUB_GROUP
 /begin REF_MEASUREMENT autosar_swc_vmp_rtARID_DEF.TmpSignalConversionAtEVM_CIPVOutport1[4].meas_state autosar_swc_vmp_rtARID_DEF.TmpSignalConversionAtEVM_CIPVOutport1[4].fus_type autosar_swc_vmp_rtARID_DEF.TmpSignalConversionAtEVM_CIPVOutport1[4].class_type autosar_swc_vmp_rtARID_DEF.TmpSignalConversionAtEVM_CIPVOutport1[4].cut_type autosar_swc_vmp_rtARID_DEF.TmpSignalConversionAtEVM_CIPVOutport1[4].ref_lane_id autosar_swc_vmp_rtARID_DEF.TmpSignalConversionAtEVM_CIPVOutport1[4].id /end REF_MEASUREMENT
/end GROUP
/begin GROUP autosar_swc_vmp_rtARID_DEF.TmpSignalConversionAtEVM_CIPVOutport1[4].accel_gnd ""
 /begin REF_MEASUREMENT autosar_swc_vmp_rtARID_DEF.TmpSignalConversionAtEVM_CIPVOutport1[4].accel_gnd.x autosar_swc_vmp_rtARID_DEF.TmpSignalConversionAtEVM_CIPVOutport1[4].accel_gnd.y autosar_swc_vmp_rtARID_DEF.TmpSignalConversionAtEVM_CIPVOutport1[4].accel_gnd.mod /end REF_MEASUREMENT
/end GROUP
/begin GROUP autosar_swc_vmp_rtARID_DEF.TmpSignalConversionAtEVM_CIPVOutport1[4].accel_gnd_sl ""
 /begin REF_MEASUREMENT autosar_swc_vmp_rtARID_DEF.TmpSignalConversionAtEVM_CIPVOutport1[4].accel_gnd_sl.x autosar_swc_vmp_rtARID_DEF.TmpSignalConversionAtEVM_CIPVOutport1[4].accel_gnd_sl.y autosar_swc_vmp_rtARID_DEF.TmpSignalConversionAtEVM_CIPVOutport1[4].accel_gnd_sl.mod /end REF_MEASUREMENT
/end GROUP
/begin GROUP autosar_swc_vmp_rtARID_DEF.TmpSignalConversionAtEVM_CIPVOutport1[4].box ""
 /begin REF_MEASUREMENT autosar_swc_vmp_rtARID_DEF.TmpSignalConversionAtEVM_CIPVOutport1[4].box.corner_x_vec autosar_swc_vmp_rtARID_DEF.TmpSignalConversionAtEVM_CIPVOutport1[4].box.corner_y_vec /end REF_MEASUREMENT
/end GROUP
/begin GROUP autosar_swc_vmp_rtARID_DEF.TmpSignalConversionAtEVM_CIPVOutport1[4].position ""
 /begin REF_MEASUREMENT autosar_swc_vmp_rtARID_DEF.TmpSignalConversionAtEVM_CIPVOutport1[4].position.x autosar_swc_vmp_rtARID_DEF.TmpSignalConversionAtEVM_CIPVOutport1[4].position.y autosar_swc_vmp_rtARID_DEF.TmpSignalConversionAtEVM_CIPVOutport1[4].position.heading_angle /end REF_MEASUREMENT
/end GROUP
/begin GROUP autosar_swc_vmp_rtARID_DEF.TmpSignalConversionAtEVM_CIPVOutport1[4].position_sl ""
 /begin REF_MEASUREMENT autosar_swc_vmp_rtARID_DEF.TmpSignalConversionAtEVM_CIPVOutport1[4].position_sl.x autosar_swc_vmp_rtARID_DEF.TmpSignalConversionAtEVM_CIPVOutport1[4].position_sl.y autosar_swc_vmp_rtARID_DEF.TmpSignalConversionAtEVM_CIPVOutport1[4].position_sl.heading_angle /end REF_MEASUREMENT
/end GROUP
/begin GROUP autosar_swc_vmp_rtARID_DEF.TmpSignalConversionAtEVM_CIPVOutport1[4].size ""
 /begin REF_MEASUREMENT autosar_swc_vmp_rtARID_DEF.TmpSignalConversionAtEVM_CIPVOutport1[4].size.length autosar_swc_vmp_rtARID_DEF.TmpSignalConversionAtEVM_CIPVOutport1[4].size.width autosar_swc_vmp_rtARID_DEF.TmpSignalConversionAtEVM_CIPVOutport1[4].size.higth /end REF_MEASUREMENT
/end GROUP
/begin GROUP autosar_swc_vmp_rtARID_DEF.TmpSignalConversionAtEVM_CIPVOutport1[4].velocity_gnd ""
 /begin REF_MEASUREMENT autosar_swc_vmp_rtARID_DEF.TmpSignalConversionAtEVM_CIPVOutport1[4].velocity_gnd.x autosar_swc_vmp_rtARID_DEF.TmpSignalConversionAtEVM_CIPVOutport1[4].velocity_gnd.y autosar_swc_vmp_rtARID_DEF.TmpSignalConversionAtEVM_CIPVOutport1[4].velocity_gnd.mod /end REF_MEASUREMENT
/end GROUP
/begin GROUP autosar_swc_vmp_rtARID_DEF.TmpSignalConversionAtEVM_CIPVOutport1[4].velocity_gnd_sl ""
 /begin REF_MEASUREMENT autosar_swc_vmp_rtARID_DEF.TmpSignalConversionAtEVM_CIPVOutport1[4].velocity_gnd_sl.x autosar_swc_vmp_rtARID_DEF.TmpSignalConversionAtEVM_CIPVOutport1[4].velocity_gnd_sl.y autosar_swc_vmp_rtARID_DEF.TmpSignalConversionAtEVM_CIPVOutport1[4].velocity_gnd_sl.mod /end REF_MEASUREMENT
/end GROUP
/begin GROUP autosar_swc_vmp_rtARID_DEF.TmpSignalConversionAtEVM_CIPVOutport1[5] ""
 /begin SUB_GROUP autosar_swc_vmp_rtARID_DEF.TmpSignalConversionAtEVM_CIPVOutport1[5].box autosar_swc_vmp_rtARID_DEF.TmpSignalConversionAtEVM_CIPVOutport1[5].position autosar_swc_vmp_rtARID_DEF.TmpSignalConversionAtEVM_CIPVOutport1[5].position_sl autosar_swc_vmp_rtARID_DEF.TmpSignalConversionAtEVM_CIPVOutport1[5].size autosar_swc_vmp_rtARID_DEF.TmpSignalConversionAtEVM_CIPVOutport1[5].velocity_gnd autosar_swc_vmp_rtARID_DEF.TmpSignalConversionAtEVM_CIPVOutport1[5].accel_gnd autosar_swc_vmp_rtARID_DEF.TmpSignalConversionAtEVM_CIPVOutport1[5].velocity_gnd_sl autosar_swc_vmp_rtARID_DEF.TmpSignalConversionAtEVM_CIPVOutport1[5].accel_gnd_sl /end SUB_GROUP
 /begin REF_MEASUREMENT autosar_swc_vmp_rtARID_DEF.TmpSignalConversionAtEVM_CIPVOutport1[5].meas_state autosar_swc_vmp_rtARID_DEF.TmpSignalConversionAtEVM_CIPVOutport1[5].fus_type autosar_swc_vmp_rtARID_DEF.TmpSignalConversionAtEVM_CIPVOutport1[5].class_type autosar_swc_vmp_rtARID_DEF.TmpSignalConversionAtEVM_CIPVOutport1[5].cut_type autosar_swc_vmp_rtARID_DEF.TmpSignalConversionAtEVM_CIPVOutport1[5].ref_lane_id autosar_swc_vmp_rtARID_DEF.TmpSignalConversionAtEVM_CIPVOutport1[5].id /end REF_MEASUREMENT
/end GROUP
/begin GROUP autosar_swc_vmp_rtARID_DEF.TmpSignalConversionAtEVM_CIPVOutport1[5].accel_gnd ""
 /begin REF_MEASUREMENT autosar_swc_vmp_rtARID_DEF.TmpSignalConversionAtEVM_CIPVOutport1[5].accel_gnd.x autosar_swc_vmp_rtARID_DEF.TmpSignalConversionAtEVM_CIPVOutport1[5].accel_gnd.y autosar_swc_vmp_rtARID_DEF.TmpSignalConversionAtEVM_CIPVOutport1[5].accel_gnd.mod /end REF_MEASUREMENT
/end GROUP
/begin GROUP autosar_swc_vmp_rtARID_DEF.TmpSignalConversionAtEVM_CIPVOutport1[5].accel_gnd_sl ""
 /begin REF_MEASUREMENT autosar_swc_vmp_rtARID_DEF.TmpSignalConversionAtEVM_CIPVOutport1[5].accel_gnd_sl.x autosar_swc_vmp_rtARID_DEF.TmpSignalConversionAtEVM_CIPVOutport1[5].accel_gnd_sl.y autosar_swc_vmp_rtARID_DEF.TmpSignalConversionAtEVM_CIPVOutport1[5].accel_gnd_sl.mod /end REF_MEASUREMENT
/end GROUP
/begin GROUP autosar_swc_vmp_rtARID_DEF.TmpSignalConversionAtEVM_CIPVOutport1[5].box ""
 /begin REF_MEASUREMENT autosar_swc_vmp_rtARID_DEF.TmpSignalConversionAtEVM_CIPVOutport1[5].box.corner_x_vec autosar_swc_vmp_rtARID_DEF.TmpSignalConversionAtEVM_CIPVOutport1[5].box.corner_y_vec /end REF_MEASUREMENT
/end GROUP
/begin GROUP autosar_swc_vmp_rtARID_DEF.TmpSignalConversionAtEVM_CIPVOutport1[5].position ""
 /begin REF_MEASUREMENT autosar_swc_vmp_rtARID_DEF.TmpSignalConversionAtEVM_CIPVOutport1[5].position.x autosar_swc_vmp_rtARID_DEF.TmpSignalConversionAtEVM_CIPVOutport1[5].position.y autosar_swc_vmp_rtARID_DEF.TmpSignalConversionAtEVM_CIPVOutport1[5].position.heading_angle /end REF_MEASUREMENT
/end GROUP
/begin GROUP autosar_swc_vmp_rtARID_DEF.TmpSignalConversionAtEVM_CIPVOutport1[5].position_sl ""
 /begin REF_MEASUREMENT autosar_swc_vmp_rtARID_DEF.TmpSignalConversionAtEVM_CIPVOutport1[5].position_sl.x autosar_swc_vmp_rtARID_DEF.TmpSignalConversionAtEVM_CIPVOutport1[5].position_sl.y autosar_swc_vmp_rtARID_DEF.TmpSignalConversionAtEVM_CIPVOutport1[5].position_sl.heading_angle /end REF_MEASUREMENT
/end GROUP
/begin GROUP autosar_swc_vmp_rtARID_DEF.TmpSignalConversionAtEVM_CIPVOutport1[5].size ""
 /begin REF_MEASUREMENT autosar_swc_vmp_rtARID_DEF.TmpSignalConversionAtEVM_CIPVOutport1[5].size.length autosar_swc_vmp_rtARID_DEF.TmpSignalConversionAtEVM_CIPVOutport1[5].size.width autosar_swc_vmp_rtARID_DEF.TmpSignalConversionAtEVM_CIPVOutport1[5].size.higth /end REF_MEASUREMENT
/end GROUP
/begin GROUP autosar_swc_vmp_rtARID_DEF.TmpSignalConversionAtEVM_CIPVOutport1[5].velocity_gnd ""
 /begin REF_MEASUREMENT autosar_swc_vmp_rtARID_DEF.TmpSignalConversionAtEVM_CIPVOutport1[5].velocity_gnd.x autosar_swc_vmp_rtARID_DEF.TmpSignalConversionAtEVM_CIPVOutport1[5].velocity_gnd.y autosar_swc_vmp_rtARID_DEF.TmpSignalConversionAtEVM_CIPVOutport1[5].velocity_gnd.mod /end REF_MEASUREMENT
/end GROUP
/begin GROUP autosar_swc_vmp_rtARID_DEF.TmpSignalConversionAtEVM_CIPVOutport1[5].velocity_gnd_sl ""
 /begin REF_MEASUREMENT autosar_swc_vmp_rtARID_DEF.TmpSignalConversionAtEVM_CIPVOutport1[5].velocity_gnd_sl.x autosar_swc_vmp_rtARID_DEF.TmpSignalConversionAtEVM_CIPVOutport1[5].velocity_gnd_sl.y autosar_swc_vmp_rtARID_DEF.TmpSignalConversionAtEVM_CIPVOutport1[5].velocity_gnd_sl.mod /end REF_MEASUREMENT
/end GROUP
/begin GROUP autosar_swc_vmp_rtARID_DEF.TmpSignalConversionAtEVM_CIPVOutport1[6] ""
 /begin SUB_GROUP autosar_swc_vmp_rtARID_DEF.TmpSignalConversionAtEVM_CIPVOutport1[6].box autosar_swc_vmp_rtARID_DEF.TmpSignalConversionAtEVM_CIPVOutport1[6].position autosar_swc_vmp_rtARID_DEF.TmpSignalConversionAtEVM_CIPVOutport1[6].position_sl autosar_swc_vmp_rtARID_DEF.TmpSignalConversionAtEVM_CIPVOutport1[6].size autosar_swc_vmp_rtARID_DEF.TmpSignalConversionAtEVM_CIPVOutport1[6].velocity_gnd autosar_swc_vmp_rtARID_DEF.TmpSignalConversionAtEVM_CIPVOutport1[6].accel_gnd autosar_swc_vmp_rtARID_DEF.TmpSignalConversionAtEVM_CIPVOutport1[6].velocity_gnd_sl autosar_swc_vmp_rtARID_DEF.TmpSignalConversionAtEVM_CIPVOutport1[6].accel_gnd_sl /end SUB_GROUP
 /begin REF_MEASUREMENT autosar_swc_vmp_rtARID_DEF.TmpSignalConversionAtEVM_CIPVOutport1[6].meas_state autosar_swc_vmp_rtARID_DEF.TmpSignalConversionAtEVM_CIPVOutport1[6].fus_type autosar_swc_vmp_rtARID_DEF.TmpSignalConversionAtEVM_CIPVOutport1[6].class_type autosar_swc_vmp_rtARID_DEF.TmpSignalConversionAtEVM_CIPVOutport1[6].cut_type autosar_swc_vmp_rtARID_DEF.TmpSignalConversionAtEVM_CIPVOutport1[6].ref_lane_id autosar_swc_vmp_rtARID_DEF.TmpSignalConversionAtEVM_CIPVOutport1[6].id /end REF_MEASUREMENT
/end GROUP
/begin GROUP autosar_swc_vmp_rtARID_DEF.TmpSignalConversionAtEVM_CIPVOutport1[6].accel_gnd ""
 /begin REF_MEASUREMENT autosar_swc_vmp_rtARID_DEF.TmpSignalConversionAtEVM_CIPVOutport1[6].accel_gnd.x autosar_swc_vmp_rtARID_DEF.TmpSignalConversionAtEVM_CIPVOutport1[6].accel_gnd.y autosar_swc_vmp_rtARID_DEF.TmpSignalConversionAtEVM_CIPVOutport1[6].accel_gnd.mod /end REF_MEASUREMENT
/end GROUP
/begin GROUP autosar_swc_vmp_rtARID_DEF.TmpSignalConversionAtEVM_CIPVOutport1[6].accel_gnd_sl ""
 /begin REF_MEASUREMENT autosar_swc_vmp_rtARID_DEF.TmpSignalConversionAtEVM_CIPVOutport1[6].accel_gnd_sl.x autosar_swc_vmp_rtARID_DEF.TmpSignalConversionAtEVM_CIPVOutport1[6].accel_gnd_sl.y autosar_swc_vmp_rtARID_DEF.TmpSignalConversionAtEVM_CIPVOutport1[6].accel_gnd_sl.mod /end REF_MEASUREMENT
/end GROUP
/begin GROUP autosar_swc_vmp_rtARID_DEF.TmpSignalConversionAtEVM_CIPVOutport1[6].box ""
 /begin REF_MEASUREMENT autosar_swc_vmp_rtARID_DEF.TmpSignalConversionAtEVM_CIPVOutport1[6].box.corner_x_vec autosar_swc_vmp_rtARID_DEF.TmpSignalConversionAtEVM_CIPVOutport1[6].box.corner_y_vec /end REF_MEASUREMENT
/end GROUP
/begin GROUP autosar_swc_vmp_rtARID_DEF.TmpSignalConversionAtEVM_CIPVOutport1[6].position ""
 /begin REF_MEASUREMENT autosar_swc_vmp_rtARID_DEF.TmpSignalConversionAtEVM_CIPVOutport1[6].position.x autosar_swc_vmp_rtARID_DEF.TmpSignalConversionAtEVM_CIPVOutport1[6].position.y autosar_swc_vmp_rtARID_DEF.TmpSignalConversionAtEVM_CIPVOutport1[6].position.heading_angle /end REF_MEASUREMENT
/end GROUP
/begin GROUP autosar_swc_vmp_rtARID_DEF.TmpSignalConversionAtEVM_CIPVOutport1[6].position_sl ""
 /begin REF_MEASUREMENT autosar_swc_vmp_rtARID_DEF.TmpSignalConversionAtEVM_CIPVOutport1[6].position_sl.x autosar_swc_vmp_rtARID_DEF.TmpSignalConversionAtEVM_CIPVOutport1[6].position_sl.y autosar_swc_vmp_rtARID_DEF.TmpSignalConversionAtEVM_CIPVOutport1[6].position_sl.heading_angle /end REF_MEASUREMENT
/end GROUP
/begin GROUP autosar_swc_vmp_rtARID_DEF.TmpSignalConversionAtEVM_CIPVOutport1[6].size ""
 /begin REF_MEASUREMENT autosar_swc_vmp_rtARID_DEF.TmpSignalConversionAtEVM_CIPVOutport1[6].size.length autosar_swc_vmp_rtARID_DEF.TmpSignalConversionAtEVM_CIPVOutport1[6].size.width autosar_swc_vmp_rtARID_DEF.TmpSignalConversionAtEVM_CIPVOutport1[6].size.higth /end REF_MEASUREMENT
/end GROUP
/begin GROUP autosar_swc_vmp_rtARID_DEF.TmpSignalConversionAtEVM_CIPVOutport1[6].velocity_gnd ""
 /begin REF_MEASUREMENT autosar_swc_vmp_rtARID_DEF.TmpSignalConversionAtEVM_CIPVOutport1[6].velocity_gnd.x autosar_swc_vmp_rtARID_DEF.TmpSignalConversionAtEVM_CIPVOutport1[6].velocity_gnd.y autosar_swc_vmp_rtARID_DEF.TmpSignalConversionAtEVM_CIPVOutport1[6].velocity_gnd.mod /end REF_MEASUREMENT
/end GROUP
/begin GROUP autosar_swc_vmp_rtARID_DEF.TmpSignalConversionAtEVM_CIPVOutport1[6].velocity_gnd_sl ""
 /begin REF_MEASUREMENT autosar_swc_vmp_rtARID_DEF.TmpSignalConversionAtEVM_CIPVOutport1[6].velocity_gnd_sl.x autosar_swc_vmp_rtARID_DEF.TmpSignalConversionAtEVM_CIPVOutport1[6].velocity_gnd_sl.y autosar_swc_vmp_rtARID_DEF.TmpSignalConversionAtEVM_CIPVOutport1[6].velocity_gnd_sl.mod /end REF_MEASUREMENT
/end GROUP
/begin GROUP autosar_swc_vmp_rtARID_DEF.TmpSignalConversionAtEVM_CIPVOutport1[7] ""
 /begin SUB_GROUP autosar_swc_vmp_rtARID_DEF.TmpSignalConversionAtEVM_CIPVOutport1[7].box autosar_swc_vmp_rtARID_DEF.TmpSignalConversionAtEVM_CIPVOutport1[7].position autosar_swc_vmp_rtARID_DEF.TmpSignalConversionAtEVM_CIPVOutport1[7].position_sl autosar_swc_vmp_rtARID_DEF.TmpSignalConversionAtEVM_CIPVOutport1[7].size autosar_swc_vmp_rtARID_DEF.TmpSignalConversionAtEVM_CIPVOutport1[7].velocity_gnd autosar_swc_vmp_rtARID_DEF.TmpSignalConversionAtEVM_CIPVOutport1[7].accel_gnd autosar_swc_vmp_rtARID_DEF.TmpSignalConversionAtEVM_CIPVOutport1[7].velocity_gnd_sl autosar_swc_vmp_rtARID_DEF.TmpSignalConversionAtEVM_CIPVOutport1[7].accel_gnd_sl /end SUB_GROUP
 /begin REF_MEASUREMENT autosar_swc_vmp_rtARID_DEF.TmpSignalConversionAtEVM_CIPVOutport1[7].meas_state autosar_swc_vmp_rtARID_DEF.TmpSignalConversionAtEVM_CIPVOutport1[7].fus_type autosar_swc_vmp_rtARID_DEF.TmpSignalConversionAtEVM_CIPVOutport1[7].class_type autosar_swc_vmp_rtARID_DEF.TmpSignalConversionAtEVM_CIPVOutport1[7].cut_type autosar_swc_vmp_rtARID_DEF.TmpSignalConversionAtEVM_CIPVOutport1[7].ref_lane_id autosar_swc_vmp_rtARID_DEF.TmpSignalConversionAtEVM_CIPVOutport1[7].id /end REF_MEASUREMENT
/end GROUP
/begin GROUP autosar_swc_vmp_rtARID_DEF.TmpSignalConversionAtEVM_CIPVOutport1[7].accel_gnd ""
 /begin REF_MEASUREMENT autosar_swc_vmp_rtARID_DEF.TmpSignalConversionAtEVM_CIPVOutport1[7].accel_gnd.x autosar_swc_vmp_rtARID_DEF.TmpSignalConversionAtEVM_CIPVOutport1[7].accel_gnd.y autosar_swc_vmp_rtARID_DEF.TmpSignalConversionAtEVM_CIPVOutport1[7].accel_gnd.mod /end REF_MEASUREMENT
/end GROUP
/begin GROUP autosar_swc_vmp_rtARID_DEF.TmpSignalConversionAtEVM_CIPVOutport1[7].accel_gnd_sl ""
 /begin REF_MEASUREMENT autosar_swc_vmp_rtARID_DEF.TmpSignalConversionAtEVM_CIPVOutport1[7].accel_gnd_sl.x autosar_swc_vmp_rtARID_DEF.TmpSignalConversionAtEVM_CIPVOutport1[7].accel_gnd_sl.y autosar_swc_vmp_rtARID_DEF.TmpSignalConversionAtEVM_CIPVOutport1[7].accel_gnd_sl.mod /end REF_MEASUREMENT
/end GROUP
/begin GROUP autosar_swc_vmp_rtARID_DEF.TmpSignalConversionAtEVM_CIPVOutport1[7].box ""
 /begin REF_MEASUREMENT autosar_swc_vmp_rtARID_DEF.TmpSignalConversionAtEVM_CIPVOutport1[7].box.corner_x_vec autosar_swc_vmp_rtARID_DEF.TmpSignalConversionAtEVM_CIPVOutport1[7].box.corner_y_vec /end REF_MEASUREMENT
/end GROUP
/begin GROUP autosar_swc_vmp_rtARID_DEF.TmpSignalConversionAtEVM_CIPVOutport1[7].position ""
 /begin REF_MEASUREMENT autosar_swc_vmp_rtARID_DEF.TmpSignalConversionAtEVM_CIPVOutport1[7].position.x autosar_swc_vmp_rtARID_DEF.TmpSignalConversionAtEVM_CIPVOutport1[7].position.y autosar_swc_vmp_rtARID_DEF.TmpSignalConversionAtEVM_CIPVOutport1[7].position.heading_angle /end REF_MEASUREMENT
/end GROUP
/begin GROUP autosar_swc_vmp_rtARID_DEF.TmpSignalConversionAtEVM_CIPVOutport1[7].position_sl ""
 /begin REF_MEASUREMENT autosar_swc_vmp_rtARID_DEF.TmpSignalConversionAtEVM_CIPVOutport1[7].position_sl.x autosar_swc_vmp_rtARID_DEF.TmpSignalConversionAtEVM_CIPVOutport1[7].position_sl.y autosar_swc_vmp_rtARID_DEF.TmpSignalConversionAtEVM_CIPVOutport1[7].position_sl.heading_angle /end REF_MEASUREMENT
/end GROUP
/begin GROUP autosar_swc_vmp_rtARID_DEF.TmpSignalConversionAtEVM_CIPVOutport1[7].size ""
 /begin REF_MEASUREMENT autosar_swc_vmp_rtARID_DEF.TmpSignalConversionAtEVM_CIPVOutport1[7].size.length autosar_swc_vmp_rtARID_DEF.TmpSignalConversionAtEVM_CIPVOutport1[7].size.width autosar_swc_vmp_rtARID_DEF.TmpSignalConversionAtEVM_CIPVOutport1[7].size.higth /end REF_MEASUREMENT
/end GROUP
/begin GROUP autosar_swc_vmp_rtARID_DEF.TmpSignalConversionAtEVM_CIPVOutport1[7].velocity_gnd ""
 /begin REF_MEASUREMENT autosar_swc_vmp_rtARID_DEF.TmpSignalConversionAtEVM_CIPVOutport1[7].velocity_gnd.x autosar_swc_vmp_rtARID_DEF.TmpSignalConversionAtEVM_CIPVOutport1[7].velocity_gnd.y autosar_swc_vmp_rtARID_DEF.TmpSignalConversionAtEVM_CIPVOutport1[7].velocity_gnd.mod /end REF_MEASUREMENT
/end GROUP
/begin GROUP autosar_swc_vmp_rtARID_DEF.TmpSignalConversionAtEVM_CIPVOutport1[7].velocity_gnd_sl ""
 /begin REF_MEASUREMENT autosar_swc_vmp_rtARID_DEF.TmpSignalConversionAtEVM_CIPVOutport1[7].velocity_gnd_sl.x autosar_swc_vmp_rtARID_DEF.TmpSignalConversionAtEVM_CIPVOutport1[7].velocity_gnd_sl.y autosar_swc_vmp_rtARID_DEF.TmpSignalConversionAtEVM_CIPVOutport1[7].velocity_gnd_sl.mod /end REF_MEASUREMENT
/end GROUP
/begin GROUP autosar_swc_vmp_rtARID_DEF.TmpSignalConversionAtEVM_CIPVOutport1[8] ""
 /begin SUB_GROUP autosar_swc_vmp_rtARID_DEF.TmpSignalConversionAtEVM_CIPVOutport1[8].box autosar_swc_vmp_rtARID_DEF.TmpSignalConversionAtEVM_CIPVOutport1[8].position autosar_swc_vmp_rtARID_DEF.TmpSignalConversionAtEVM_CIPVOutport1[8].position_sl autosar_swc_vmp_rtARID_DEF.TmpSignalConversionAtEVM_CIPVOutport1[8].size autosar_swc_vmp_rtARID_DEF.TmpSignalConversionAtEVM_CIPVOutport1[8].velocity_gnd autosar_swc_vmp_rtARID_DEF.TmpSignalConversionAtEVM_CIPVOutport1[8].accel_gnd autosar_swc_vmp_rtARID_DEF.TmpSignalConversionAtEVM_CIPVOutport1[8].velocity_gnd_sl autosar_swc_vmp_rtARID_DEF.TmpSignalConversionAtEVM_CIPVOutport1[8].accel_gnd_sl /end SUB_GROUP
 /begin REF_MEASUREMENT autosar_swc_vmp_rtARID_DEF.TmpSignalConversionAtEVM_CIPVOutport1[8].meas_state autosar_swc_vmp_rtARID_DEF.TmpSignalConversionAtEVM_CIPVOutport1[8].fus_type autosar_swc_vmp_rtARID_DEF.TmpSignalConversionAtEVM_CIPVOutport1[8].class_type autosar_swc_vmp_rtARID_DEF.TmpSignalConversionAtEVM_CIPVOutport1[8].cut_type autosar_swc_vmp_rtARID_DEF.TmpSignalConversionAtEVM_CIPVOutport1[8].ref_lane_id autosar_swc_vmp_rtARID_DEF.TmpSignalConversionAtEVM_CIPVOutport1[8].id /end REF_MEASUREMENT
/end GROUP
/begin GROUP autosar_swc_vmp_rtARID_DEF.TmpSignalConversionAtEVM_CIPVOutport1[8].accel_gnd ""
 /begin REF_MEASUREMENT autosar_swc_vmp_rtARID_DEF.TmpSignalConversionAtEVM_CIPVOutport1[8].accel_gnd.x autosar_swc_vmp_rtARID_DEF.TmpSignalConversionAtEVM_CIPVOutport1[8].accel_gnd.y autosar_swc_vmp_rtARID_DEF.TmpSignalConversionAtEVM_CIPVOutport1[8].accel_gnd.mod /end REF_MEASUREMENT
/end GROUP
/begin GROUP autosar_swc_vmp_rtARID_DEF.TmpSignalConversionAtEVM_CIPVOutport1[8].accel_gnd_sl ""
 /begin REF_MEASUREMENT autosar_swc_vmp_rtARID_DEF.TmpSignalConversionAtEVM_CIPVOutport1[8].accel_gnd_sl.x autosar_swc_vmp_rtARID_DEF.TmpSignalConversionAtEVM_CIPVOutport1[8].accel_gnd_sl.y autosar_swc_vmp_rtARID_DEF.TmpSignalConversionAtEVM_CIPVOutport1[8].accel_gnd_sl.mod /end REF_MEASUREMENT
/end GROUP
/begin GROUP autosar_swc_vmp_rtARID_DEF.TmpSignalConversionAtEVM_CIPVOutport1[8].box ""
 /begin REF_MEASUREMENT autosar_swc_vmp_rtARID_DEF.TmpSignalConversionAtEVM_CIPVOutport1[8].box.corner_x_vec autosar_swc_vmp_rtARID_DEF.TmpSignalConversionAtEVM_CIPVOutport1[8].box.corner_y_vec /end REF_MEASUREMENT
/end GROUP
/begin GROUP autosar_swc_vmp_rtARID_DEF.TmpSignalConversionAtEVM_CIPVOutport1[8].position ""
 /begin REF_MEASUREMENT autosar_swc_vmp_rtARID_DEF.TmpSignalConversionAtEVM_CIPVOutport1[8].position.x autosar_swc_vmp_rtARID_DEF.TmpSignalConversionAtEVM_CIPVOutport1[8].position.y autosar_swc_vmp_rtARID_DEF.TmpSignalConversionAtEVM_CIPVOutport1[8].position.heading_angle /end REF_MEASUREMENT
/end GROUP
/begin GROUP autosar_swc_vmp_rtARID_DEF.TmpSignalConversionAtEVM_CIPVOutport1[8].position_sl ""
 /begin REF_MEASUREMENT autosar_swc_vmp_rtARID_DEF.TmpSignalConversionAtEVM_CIPVOutport1[8].position_sl.x autosar_swc_vmp_rtARID_DEF.TmpSignalConversionAtEVM_CIPVOutport1[8].position_sl.y autosar_swc_vmp_rtARID_DEF.TmpSignalConversionAtEVM_CIPVOutport1[8].position_sl.heading_angle /end REF_MEASUREMENT
/end GROUP
/begin GROUP autosar_swc_vmp_rtARID_DEF.TmpSignalConversionAtEVM_CIPVOutport1[8].size ""
 /begin REF_MEASUREMENT autosar_swc_vmp_rtARID_DEF.TmpSignalConversionAtEVM_CIPVOutport1[8].size.length autosar_swc_vmp_rtARID_DEF.TmpSignalConversionAtEVM_CIPVOutport1[8].size.width autosar_swc_vmp_rtARID_DEF.TmpSignalConversionAtEVM_CIPVOutport1[8].size.higth /end REF_MEASUREMENT
/end GROUP
/begin GROUP autosar_swc_vmp_rtARID_DEF.TmpSignalConversionAtEVM_CIPVOutport1[8].velocity_gnd ""
 /begin REF_MEASUREMENT autosar_swc_vmp_rtARID_DEF.TmpSignalConversionAtEVM_CIPVOutport1[8].velocity_gnd.x autosar_swc_vmp_rtARID_DEF.TmpSignalConversionAtEVM_CIPVOutport1[8].velocity_gnd.y autosar_swc_vmp_rtARID_DEF.TmpSignalConversionAtEVM_CIPVOutport1[8].velocity_gnd.mod /end REF_MEASUREMENT
/end GROUP
/begin GROUP autosar_swc_vmp_rtARID_DEF.TmpSignalConversionAtEVM_CIPVOutport1[8].velocity_gnd_sl ""
 /begin REF_MEASUREMENT autosar_swc_vmp_rtARID_DEF.TmpSignalConversionAtEVM_CIPVOutport1[8].velocity_gnd_sl.x autosar_swc_vmp_rtARID_DEF.TmpSignalConversionAtEVM_CIPVOutport1[8].velocity_gnd_sl.y autosar_swc_vmp_rtARID_DEF.TmpSignalConversionAtEVM_CIPVOutport1[8].velocity_gnd_sl.mod /end REF_MEASUREMENT
/end GROUP
/begin GROUP autosar_swc_vmp_rtARID_DEF.TmpSignalConversionAtEVM_CIPVOutport1[9] ""
 /begin SUB_GROUP autosar_swc_vmp_rtARID_DEF.TmpSignalConversionAtEVM_CIPVOutport1[9].box autosar_swc_vmp_rtARID_DEF.TmpSignalConversionAtEVM_CIPVOutport1[9].position autosar_swc_vmp_rtARID_DEF.TmpSignalConversionAtEVM_CIPVOutport1[9].position_sl autosar_swc_vmp_rtARID_DEF.TmpSignalConversionAtEVM_CIPVOutport1[9].size autosar_swc_vmp_rtARID_DEF.TmpSignalConversionAtEVM_CIPVOutport1[9].velocity_gnd autosar_swc_vmp_rtARID_DEF.TmpSignalConversionAtEVM_CIPVOutport1[9].accel_gnd autosar_swc_vmp_rtARID_DEF.TmpSignalConversionAtEVM_CIPVOutport1[9].velocity_gnd_sl autosar_swc_vmp_rtARID_DEF.TmpSignalConversionAtEVM_CIPVOutport1[9].accel_gnd_sl /end SUB_GROUP
 /begin REF_MEASUREMENT autosar_swc_vmp_rtARID_DEF.TmpSignalConversionAtEVM_CIPVOutport1[9].meas_state autosar_swc_vmp_rtARID_DEF.TmpSignalConversionAtEVM_CIPVOutport1[9].fus_type autosar_swc_vmp_rtARID_DEF.TmpSignalConversionAtEVM_CIPVOutport1[9].class_type autosar_swc_vmp_rtARID_DEF.TmpSignalConversionAtEVM_CIPVOutport1[9].cut_type autosar_swc_vmp_rtARID_DEF.TmpSignalConversionAtEVM_CIPVOutport1[9].ref_lane_id autosar_swc_vmp_rtARID_DEF.TmpSignalConversionAtEVM_CIPVOutport1[9].id /end REF_MEASUREMENT
/end GROUP
/begin GROUP autosar_swc_vmp_rtARID_DEF.TmpSignalConversionAtEVM_CIPVOutport1[9].accel_gnd ""
 /begin REF_MEASUREMENT autosar_swc_vmp_rtARID_DEF.TmpSignalConversionAtEVM_CIPVOutport1[9].accel_gnd.x autosar_swc_vmp_rtARID_DEF.TmpSignalConversionAtEVM_CIPVOutport1[9].accel_gnd.y autosar_swc_vmp_rtARID_DEF.TmpSignalConversionAtEVM_CIPVOutport1[9].accel_gnd.mod /end REF_MEASUREMENT
/end GROUP
/begin GROUP autosar_swc_vmp_rtARID_DEF.TmpSignalConversionAtEVM_CIPVOutport1[9].accel_gnd_sl ""
 /begin REF_MEASUREMENT autosar_swc_vmp_rtARID_DEF.TmpSignalConversionAtEVM_CIPVOutport1[9].accel_gnd_sl.x autosar_swc_vmp_rtARID_DEF.TmpSignalConversionAtEVM_CIPVOutport1[9].accel_gnd_sl.y autosar_swc_vmp_rtARID_DEF.TmpSignalConversionAtEVM_CIPVOutport1[9].accel_gnd_sl.mod /end REF_MEASUREMENT
/end GROUP
/begin GROUP autosar_swc_vmp_rtARID_DEF.TmpSignalConversionAtEVM_CIPVOutport1[9].box ""
 /begin REF_MEASUREMENT autosar_swc_vmp_rtARID_DEF.TmpSignalConversionAtEVM_CIPVOutport1[9].box.corner_x_vec autosar_swc_vmp_rtARID_DEF.TmpSignalConversionAtEVM_CIPVOutport1[9].box.corner_y_vec /end REF_MEASUREMENT
/end GROUP
/begin GROUP autosar_swc_vmp_rtARID_DEF.TmpSignalConversionAtEVM_CIPVOutport1[9].position ""
 /begin REF_MEASUREMENT autosar_swc_vmp_rtARID_DEF.TmpSignalConversionAtEVM_CIPVOutport1[9].position.x autosar_swc_vmp_rtARID_DEF.TmpSignalConversionAtEVM_CIPVOutport1[9].position.y autosar_swc_vmp_rtARID_DEF.TmpSignalConversionAtEVM_CIPVOutport1[9].position.heading_angle /end REF_MEASUREMENT
/end GROUP
/begin GROUP autosar_swc_vmp_rtARID_DEF.TmpSignalConversionAtEVM_CIPVOutport1[9].position_sl ""
 /begin REF_MEASUREMENT autosar_swc_vmp_rtARID_DEF.TmpSignalConversionAtEVM_CIPVOutport1[9].position_sl.x autosar_swc_vmp_rtARID_DEF.TmpSignalConversionAtEVM_CIPVOutport1[9].position_sl.y autosar_swc_vmp_rtARID_DEF.TmpSignalConversionAtEVM_CIPVOutport1[9].position_sl.heading_angle /end REF_MEASUREMENT
/end GROUP
/begin GROUP autosar_swc_vmp_rtARID_DEF.TmpSignalConversionAtEVM_CIPVOutport1[9].size ""
 /begin REF_MEASUREMENT autosar_swc_vmp_rtARID_DEF.TmpSignalConversionAtEVM_CIPVOutport1[9].size.length autosar_swc_vmp_rtARID_DEF.TmpSignalConversionAtEVM_CIPVOutport1[9].size.width autosar_swc_vmp_rtARID_DEF.TmpSignalConversionAtEVM_CIPVOutport1[9].size.higth /end REF_MEASUREMENT
/end GROUP
/begin GROUP autosar_swc_vmp_rtARID_DEF.TmpSignalConversionAtEVM_CIPVOutport1[9].velocity_gnd ""
 /begin REF_MEASUREMENT autosar_swc_vmp_rtARID_DEF.TmpSignalConversionAtEVM_CIPVOutport1[9].velocity_gnd.x autosar_swc_vmp_rtARID_DEF.TmpSignalConversionAtEVM_CIPVOutport1[9].velocity_gnd.y autosar_swc_vmp_rtARID_DEF.TmpSignalConversionAtEVM_CIPVOutport1[9].velocity_gnd.mod /end REF_MEASUREMENT
/end GROUP
/begin GROUP autosar_swc_vmp_rtARID_DEF.TmpSignalConversionAtEVM_CIPVOutport1[9].velocity_gnd_sl ""
 /begin REF_MEASUREMENT autosar_swc_vmp_rtARID_DEF.TmpSignalConversionAtEVM_CIPVOutport1[9].velocity_gnd_sl.x autosar_swc_vmp_rtARID_DEF.TmpSignalConversionAtEVM_CIPVOutport1[9].velocity_gnd_sl.y autosar_swc_vmp_rtARID_DEF.TmpSignalConversionAtEVM_CIPVOutport1[9].velocity_gnd_sl.mod /end REF_MEASUREMENT
/end GROUP
/begin GROUP autosar_swc_vmp_rtARID_DEF.TmpSignalConversionAtEVM_DECSOutport1 ""
 /begin REF_MEASUREMENT autosar_swc_vmp_rtARID_DEF.TmpSignalConversionAtEVM_DECSOutport1.host_lane_idx autosar_swc_vmp_rtARID_DEF.TmpSignalConversionAtEVM_DECSOutport1.target_lane_idx autosar_swc_vmp_rtARID_DEF.TmpSignalConversionAtEVM_DECSOutport1.lc_req autosar_swc_vmp_rtARID_DEF.TmpSignalConversionAtEVM_DECSOutport1.lc_req_sync_id autosar_swc_vmp_rtARID_DEF.TmpSignalConversionAtEVM_DECSOutport1.lc_level autosar_swc_vmp_rtARID_DEF.TmpSignalConversionAtEVM_DECSOutport1.lc_req_reason autosar_swc_vmp_rtARID_DEF.TmpSignalConversionAtEVM_DECSOutport1.lc_lntention_conds /end REF_MEASUREMENT
/end GROUP
/begin GROUP autosar_swc_vmp_rtARID_DEF.UnitDelay1_DSTATE ""
 /begin REF_MEASUREMENT autosar_swc_vmp_rtARID_DEF.UnitDelay1_DSTATE.ACC_BrakePrefer autosar_swc_vmp_rtARID_DEF.UnitDelay1_DSTATE.ACC_axvCvAim autosar_swc_vmp_rtARID_DEF.UnitDelay1_DSTATE.ACC_axv_ComfortBandLowerValue autosar_swc_vmp_rtARID_DEF.UnitDelay1_DSTATE.ACC_axv_ComfortBandUpperValue autosar_swc_vmp_rtARID_DEF.UnitDelay1_DSTATE.ACC_DecelerateJerk autosar_swc_vmp_rtARID_DEF.UnitDelay1_DSTATE.ACC_AccelerateJerk autosar_swc_vmp_rtARID_DEF.UnitDelay1_DSTATE.CurvSpdLim /end REF_MEASUREMENT
/end GROUP
/begin MEASUREMENT SwcIn_ACU_1.ACU_1_CRC1 "" UBYTE autosar_swc_val_CM_ACU_1_CRC1_1180_dt 0 0 0 255 ECU_ADDRESS 0xfe4cbb5e /* @ECU_Address@SwcIn_ACU_1.ACU_1_CRC1@ */ /end MEASUREMENT
/begin MEASUREMENT SwcIn_ACU_1.ACU_1_PsngrSeatBeltWarning "" UBYTE autosar_swc_val_CM_ACU_1_PsngrSeatBeltWarning_1180_dt 0 0 0 255 ECU_ADDRESS 0xfe4cbb61 /* @ECU_Address@SwcIn_ACU_1.ACU_1_PsngrSeatBeltWarning@ */ /end MEASUREMENT
/begin MEASUREMENT SwcIn_ACU_1.ACU_1_PsngrSeatOccupiedSts "" UBYTE autosar_swc_val_CM_ACU_1_PsngrSeatOccupiedSts_1180_dt 0 0 0 255 ECU_ADDRESS 0xfe4cbb62 /* @ECU_Address@SwcIn_ACU_1.ACU_1_PsngrSeatOccupiedSts@ */ /end MEASUREMENT
/begin MEASUREMENT SwcIn_ACU_1.ACU_1_Resd1 "" UBYTE autosar_swc_val_CM_ACU_1_Resd1_1180_dt 0 0 0 255 ECU_ADDRESS 0xfe4cbb60 /* @ECU_Address@SwcIn_ACU_1.ACU_1_Resd1@ */ /end MEASUREMENT
/begin MEASUREMENT SwcIn_ACU_1.ACU_1_RollgCntr1 "" UBYTE autosar_swc_val_CM_ACU_1_RollgCntr1_1180_dt 0 0 0 255 ECU_ADDRESS 0xfe4cbb5f /* @ECU_Address@SwcIn_ACU_1.ACU_1_RollgCntr1@ */ /end MEASUREMENT
/begin MEASUREMENT SwcIn_ACU_2.ACU_2_CRC1 "" UBYTE autosar_swc_val_CM_ACU_2_CRC1_49_dt 0 0 0 255 ECU_ADDRESS 0xfe4c9248 /* @ECU_Address@SwcIn_ACU_2.ACU_2_CRC1@ */ /end MEASUREMENT
/begin MEASUREMENT SwcIn_ACU_2.ACU_2_LateralAcceleration "" FLOAT32_IEEE autosar_swc_val_CM_ACU_2_LateralAcceleration_49_dt 0 0 -3.4E+38 3.4E+38 ECU_ADDRESS 0xfe4c924c /* @ECU_Address@SwcIn_ACU_2.ACU_2_LateralAcceleration@ */ /end MEASUREMENT
/begin MEASUREMENT SwcIn_ACU_2.ACU_2_LateralAccelerationSigVD "" UBYTE autosar_swc_val_CM_ACU_2_LateralAccelerationSigVD_49_dt 0 0 0 255 ECU_ADDRESS 0xfe4c9256 /* @ECU_Address@SwcIn_ACU_2.ACU_2_LateralAccelerationSigVD@ */ /end MEASUREMENT
/begin MEASUREMENT SwcIn_ACU_2.ACU_2_Resd1 "" UBYTE autosar_swc_val_CM_ACU_2_Resd1_49_dt 0 0 0 255 ECU_ADDRESS 0xfe4c924a /* @ECU_Address@SwcIn_ACU_2.ACU_2_Resd1@ */ /end MEASUREMENT
/begin MEASUREMENT SwcIn_ACU_2.ACU_2_RollgCntr1 "" UBYTE autosar_swc_val_CM_ACU_2_RollgCntr1_49_dt 0 0 0 255 ECU_ADDRESS 0xfe4c9249 /* @ECU_Address@SwcIn_ACU_2.ACU_2_RollgCntr1@ */ /end MEASUREMENT
/begin MEASUREMENT SwcIn_ACU_2.ACU_2_YASCalibrationSts "" UBYTE autosar_swc_val_CM_ACU_2_YASCalibrationSts_49_dt 0 0 0 255 ECU_ADDRESS 0xfe4c9254 /* @ECU_Address@SwcIn_ACU_2.ACU_2_YASCalibrationSts@ */ /end MEASUREMENT
/begin MEASUREMENT SwcIn_ACU_2.ACU_2_YawRate "" FLOAT32_IEEE autosar_swc_val_CM_ACU_2_YawRate_49_dt 0 0 -3.4E+38 3.4E+38 ECU_ADDRESS 0xfe4c9250 /* @ECU_Address@SwcIn_ACU_2.ACU_2_YawRate@ */ /end MEASUREMENT
/begin MEASUREMENT SwcIn_ACU_2.ACU_2_YawrateSigValidData "" UBYTE autosar_swc_val_CM_ACU_2_YawrateSigValidData_49_dt 0 0 0 255 ECU_ADDRESS 0xfe4c9255 /* @ECU_Address@SwcIn_ACU_2.ACU_2_YawrateSigValidData@ */ /end MEASUREMENT
/begin MEASUREMENT SwcIn_ACU_3.ACU_3_CRC1 "" UBYTE autosar_swc_val_CM_ACU_3_CRC1_33_dt 0 0 0 255 ECU_ADDRESS 0xfe4cb670 /* @ECU_Address@SwcIn_ACU_3.ACU_3_CRC1@ */ /end MEASUREMENT
/begin MEASUREMENT SwcIn_ACU_3.ACU_3_CrashOutputSts "" UBYTE autosar_swc_val_CM_ACU_3_CrashOutputSts_33_dt 0 0 0 255 ECU_ADDRESS 0xfe4cb679 /* @ECU_Address@SwcIn_ACU_3.ACU_3_CrashOutputSts@ */ /end MEASUREMENT
/begin MEASUREMENT SwcIn_ACU_3.ACU_3_LongitudinalAcceleration "" FLOAT32_IEEE autosar_swc_val_CM_ACU_3_LongitudinalAcceleration_33_dt 0 0 -3.4E+38 3.4E+38 ECU_ADDRESS 0xfe4cb674 /* @ECU_Address@SwcIn_ACU_3.ACU_3_LongitudinalAcceleration@ */ /end MEASUREMENT
/begin MEASUREMENT SwcIn_ACU_3.ACU_3_LongitudinalAccelerationVD "" UBYTE autosar_swc_val_CM_ACU_3_LongitudinalAccelerationVD_33_dt 0 0 0 255 ECU_ADDRESS 0xfe4cb678 /* @ECU_Address@SwcIn_ACU_3.ACU_3_LongitudinalAccelerationVD@ */ /end MEASUREMENT
/begin MEASUREMENT SwcIn_ACU_3.ACU_3_Resd1 "" UBYTE autosar_swc_val_CM_ACU_3_Resd1_33_dt 0 0 0 255 ECU_ADDRESS 0xfe4cb672 /* @ECU_Address@SwcIn_ACU_3.ACU_3_Resd1@ */ /end MEASUREMENT
/begin MEASUREMENT SwcIn_ACU_3.ACU_3_RollgCntr1 "" UBYTE autosar_swc_val_CM_ACU_3_RollgCntr1_33_dt 0 0 0 255 ECU_ADDRESS 0xfe4cb671 /* @ECU_Address@SwcIn_ACU_3.ACU_3_RollgCntr1@ */ /end MEASUREMENT
/begin MEASUREMENT SwcIn_ACU_3.ACU_3_SCMRequest "" UBYTE autosar_swc_val_CM_ACU_3_SCMRequest_33_dt 0 0 0 255 ECU_ADDRESS 0xfe4cb67a /* @ECU_Address@SwcIn_ACU_3.ACU_3_SCMRequest@ */ /end MEASUREMENT
/begin MEASUREMENT SwcIn_ADASFuncConfig.CONFIG_ACC "" UBYTE autosar_swc_val_CM_uint8 0 0 0 255 ECU_ADDRESS 0xfe4cbb63 /* @ECU_Address@SwcIn_ADASFuncConfig.CONFIG_ACC@ */ /end MEASUREMENT
/begin MEASUREMENT SwcIn_ADASFuncConfig.CONFIG_ACCIC "" UBYTE autosar_swc_val_CM_uint8 0 0 0 255 ECU_ADDRESS 0xfe4cbb75 /* @ECU_Address@SwcIn_ADASFuncConfig.CONFIG_ACCIC@ */ /end MEASUREMENT
/begin MEASUREMENT SwcIn_ADASFuncConfig.CONFIG_AEB "" UBYTE autosar_swc_val_CM_uint8 0 0 0 255 ECU_ADDRESS 0xfe4cbb6c /* @ECU_Address@SwcIn_ADASFuncConfig.CONFIG_AEB@ */ /end MEASUREMENT
/begin MEASUREMENT SwcIn_ADASFuncConfig.CONFIG_AES "" UBYTE autosar_swc_val_CM_uint8 0 0 0 255 ECU_ADDRESS 0xfe4cbb6e /* @ECU_Address@SwcIn_ADASFuncConfig.CONFIG_AES@ */ /end MEASUREMENT
/begin MEASUREMENT SwcIn_ADASFuncConfig.CONFIG_ALC "" UBYTE autosar_swc_val_CM_uint8 0 0 0 255 ECU_ADDRESS 0xfe4cbb65 /* @ECU_Address@SwcIn_ADASFuncConfig.CONFIG_ALC@ */ /end MEASUREMENT
/begin MEASUREMENT SwcIn_ADASFuncConfig.CONFIG_DAI "" UBYTE autosar_swc_val_CM_uint8 0 0 0 255 ECU_ADDRESS 0xfe4cbb71 /* @ECU_Address@SwcIn_ADASFuncConfig.CONFIG_DAI@ */ /end MEASUREMENT
/begin MEASUREMENT SwcIn_ADASFuncConfig.CONFIG_ELK "" UBYTE autosar_swc_val_CM_uint8 0 0 0 255 ECU_ADDRESS 0xfe4cbb69 /* @ECU_Address@SwcIn_ADASFuncConfig.CONFIG_ELK@ */ /end MEASUREMENT
/begin MEASUREMENT SwcIn_ADASFuncConfig.CONFIG_ESS "" UBYTE autosar_swc_val_CM_uint8 0 0 0 255 ECU_ADDRESS 0xfe4cbb6d /* @ECU_Address@SwcIn_ADASFuncConfig.CONFIG_ESS@ */ /end MEASUREMENT
/begin MEASUREMENT SwcIn_ADASFuncConfig.CONFIG_FCW "" UBYTE autosar_swc_val_CM_uint8 0 0 0 255 ECU_ADDRESS 0xfe4cbb6b /* @ECU_Address@SwcIn_ADASFuncConfig.CONFIG_FCW@ */ /end MEASUREMENT
/begin MEASUREMENT SwcIn_ADASFuncConfig.CONFIG_IE "" UBYTE autosar_swc_val_CM_uint8 0 0 0 255 ECU_ADDRESS 0xfe4cbb6a /* @ECU_Address@SwcIn_ADASFuncConfig.CONFIG_IE@ */ /end MEASUREMENT
/begin MEASUREMENT SwcIn_ADASFuncConfig.CONFIG_IHC "" UBYTE autosar_swc_val_CM_uint8 0 0 0 255 ECU_ADDRESS 0xfe4cbb74 /* @ECU_Address@SwcIn_ADASFuncConfig.CONFIG_IHC@ */ /end MEASUREMENT
/begin MEASUREMENT SwcIn_ADASFuncConfig.CONFIG_ISL "" UBYTE autosar_swc_val_CM_uint8 0 0 0 255 ECU_ADDRESS 0xfe4cbb6f /* @ECU_Address@SwcIn_ADASFuncConfig.CONFIG_ISL@ */ /end MEASUREMENT
/begin MEASUREMENT SwcIn_ADASFuncConfig.CONFIG_IntellgntCurve "" UBYTE autosar_swc_val_CM_uint8 0 0 0 255 ECU_ADDRESS 0xfe4cbb70 /* @ECU_Address@SwcIn_ADASFuncConfig.CONFIG_IntellgntCurve@ */ /end MEASUREMENT
/begin MEASUREMENT SwcIn_ADASFuncConfig.CONFIG_LCC "" UBYTE autosar_swc_val_CM_uint8 0 0 0 255 ECU_ADDRESS 0xfe4cbb64 /* @ECU_Address@SwcIn_ADASFuncConfig.CONFIG_LCC@ */ /end MEASUREMENT
/begin MEASUREMENT SwcIn_ADASFuncConfig.CONFIG_LDW "" UBYTE autosar_swc_val_CM_uint8 0 0 0 255 ECU_ADDRESS 0xfe4cbb67 /* @ECU_Address@SwcIn_ADASFuncConfig.CONFIG_LDW@ */ /end MEASUREMENT
/begin MEASUREMENT SwcIn_ADASFuncConfig.CONFIG_LKA "" UBYTE autosar_swc_val_CM_uint8 0 0 0 255 ECU_ADDRESS 0xfe4cbb68 /* @ECU_Address@SwcIn_ADASFuncConfig.CONFIG_LKA@ */ /end MEASUREMENT
/begin MEASUREMENT SwcIn_ADASFuncConfig.CONFIG_NOH "" UBYTE autosar_swc_val_CM_uint8 0 0 0 255 ECU_ADDRESS 0xfe4cbb66 /* @ECU_Address@SwcIn_ADASFuncConfig.CONFIG_NOH@ */ /end MEASUREMENT
/begin MEASUREMENT SwcIn_ADASFuncConfig.CONFIG_SLA "" UBYTE autosar_swc_val_CM_uint8 0 0 0 255 ECU_ADDRESS 0xfe4cbb73 /* @ECU_Address@SwcIn_ADASFuncConfig.CONFIG_SLA@ */ /end MEASUREMENT
/begin MEASUREMENT SwcIn_ADASFuncConfig.CONFIG_TSR "" UBYTE autosar_swc_val_CM_uint8 0 0 0 255 ECU_ADDRESS 0xfe4cbb72 /* @ECU_Address@SwcIn_ADASFuncConfig.CONFIG_TSR@ */ /end MEASUREMENT
/begin COMPU_METHOD autosar_swc_val_CM_ACU_1_CRC1_1180_dt "Q = V" IDENTICAL "%0.6" "" /end COMPU_METHOD
/begin COMPU_METHOD autosar_swc_val_CM_ACU_1_PsngrSeatBeltWarning_1180_dt "Q = V" IDENTICAL "%0.6" "" /end COMPU_METHOD
/begin COMPU_METHOD autosar_swc_val_CM_ACU_1_PsngrSeatOccupiedSts_1180_dt "Q = V" IDENTICAL "%0.6" "" /end COMPU_METHOD
/begin COMPU_METHOD autosar_swc_val_CM_ACU_1_Resd1_1180_dt "Q = V" IDENTICAL "%0.6" "" /end COMPU_METHOD
/begin COMPU_METHOD autosar_swc_val_CM_ACU_1_RollgCntr1_1180_dt "Q = V" IDENTICAL "%0.6" "" /end COMPU_METHOD
/begin COMPU_METHOD autosar_swc_val_CM_ACU_2_CRC1_49_dt "Q = V" IDENTICAL "%0.6" "" /end COMPU_METHOD
/begin COMPU_METHOD autosar_swc_val_CM_ACU_2_LateralAccelerationSigVD_49_dt "Q = V" IDENTICAL "%0.6" "" /end COMPU_METHOD
/begin COMPU_METHOD autosar_swc_val_CM_ACU_2_LateralAcceleration_49_dt "Q = V" IDENTICAL "%8.6" "" /end COMPU_METHOD
/begin COMPU_METHOD autosar_swc_val_CM_ACU_2_Resd1_49_dt "Q = V" IDENTICAL "%0.6" "" /end COMPU_METHOD
/begin COMPU_METHOD autosar_swc_val_CM_ACU_2_RollgCntr1_49_dt "Q = V" IDENTICAL "%0.6" "" /end COMPU_METHOD
/begin COMPU_METHOD autosar_swc_val_CM_ACU_2_YASCalibrationSts_49_dt "Q = V" IDENTICAL "%0.6" "" /end COMPU_METHOD
/begin COMPU_METHOD autosar_swc_val_CM_ACU_2_YawRate_49_dt "Q = V" IDENTICAL "%8.6" "" /end COMPU_METHOD
/begin COMPU_METHOD autosar_swc_val_CM_ACU_2_YawrateSigValidData_49_dt "Q = V" IDENTICAL "%0.6" "" /end COMPU_METHOD
/begin COMPU_METHOD autosar_swc_val_CM_ACU_3_CRC1_33_dt "Q = V" IDENTICAL "%0.6" "" /end COMPU_METHOD
/begin COMPU_METHOD autosar_swc_val_CM_ACU_3_CrashOutputSts_33_dt "Q = V" IDENTICAL "%0.6" "" /end COMPU_METHOD
/begin COMPU_METHOD autosar_swc_val_CM_ACU_3_LongitudinalAccelerationVD_33_dt "Q = V" IDENTICAL "%0.6" "" /end COMPU_METHOD
/begin COMPU_METHOD autosar_swc_val_CM_ACU_3_LongitudinalAcceleration_33_dt "Q = V" IDENTICAL "%8.6" "" /end COMPU_METHOD
/begin COMPU_METHOD autosar_swc_val_CM_ACU_3_Resd1_33_dt "Q = V" IDENTICAL "%0.6" "" /end COMPU_METHOD
/begin COMPU_METHOD autosar_swc_val_CM_ACU_3_RollgCntr1_33_dt "Q = V" IDENTICAL "%0.6" "" /end COMPU_METHOD
/begin COMPU_METHOD autosar_swc_val_CM_ACU_3_SCMRequest_33_dt "Q = V" IDENTICAL "%0.6" "" /end COMPU_METHOD
/begin COMPU_METHOD autosar_swc_val_CM_uint8 "Q = V" IDENTICAL "%3.0" "" /end COMPU_METHOD
/begin GROUP SwcIn_ACU_1 ""
 /begin REF_MEASUREMENT SwcIn_ACU_1.ACU_1_CRC1 SwcIn_ACU_1.ACU_1_RollgCntr1 SwcIn_ACU_1.ACU_1_Resd1 SwcIn_ACU_1.ACU_1_PsngrSeatBeltWarning SwcIn_ACU_1.ACU_1_PsngrSeatOccupiedSts /end REF_MEASUREMENT
/end GROUP
/begin GROUP SwcIn_ACU_2 ""
 /begin REF_MEASUREMENT SwcIn_ACU_2.ACU_2_CRC1 SwcIn_ACU_2.ACU_2_RollgCntr1 SwcIn_ACU_2.ACU_2_Resd1 SwcIn_ACU_2.ACU_2_LateralAcceleration SwcIn_ACU_2.ACU_2_YawRate SwcIn_ACU_2.ACU_2_YASCalibrationSts SwcIn_ACU_2.ACU_2_YawrateSigValidData SwcIn_ACU_2.ACU_2_LateralAccelerationSigVD /end REF_MEASUREMENT
/end GROUP
/begin GROUP SwcIn_ACU_3 ""
 /begin REF_MEASUREMENT SwcIn_ACU_3.ACU_3_CRC1 SwcIn_ACU_3.ACU_3_RollgCntr1 SwcIn_ACU_3.ACU_3_Resd1 SwcIn_ACU_3.ACU_3_LongitudinalAcceleration SwcIn_ACU_3.ACU_3_LongitudinalAccelerationVD SwcIn_ACU_3.ACU_3_CrashOutputSts SwcIn_ACU_3.ACU_3_SCMRequest /end REF_MEASUREMENT
/end GROUP
/begin GROUP SwcIn_ADASFuncConfig ""
 /begin REF_MEASUREMENT SwcIn_ADASFuncConfig.CONFIG_ACC SwcIn_ADASFuncConfig.CONFIG_LCC SwcIn_ADASFuncConfig.CONFIG_ALC SwcIn_ADASFuncConfig.CONFIG_NOH SwcIn_ADASFuncConfig.CONFIG_LDW SwcIn_ADASFuncConfig.CONFIG_LKA SwcIn_ADASFuncConfig.CONFIG_ELK SwcIn_ADASFuncConfig.CONFIG_IE SwcIn_ADASFuncConfig.CONFIG_FCW SwcIn_ADASFuncConfig.CONFIG_AEB SwcIn_ADASFuncConfig.CONFIG_ESS SwcIn_ADASFuncConfig.CONFIG_AES SwcIn_ADASFuncConfig.CONFIG_ISL SwcIn_ADASFuncConfig.CONFIG_IntellgntCurve SwcIn_ADASFuncConfig.CONFIG_DAI SwcIn_ADASFuncConfig.CONFIG_TSR SwcIn_ADASFuncConfig.CONFIG_SLA SwcIn_ADASFuncConfig.CONFIG_IHC SwcIn_ADASFuncConfig.CONFIG_ACCIC /end REF_MEASUREMENT
/end GROUP
/end MODULE
/end PROJECT
