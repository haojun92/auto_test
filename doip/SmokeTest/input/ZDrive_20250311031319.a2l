ASAP2_VERSION 1 71
/begin PROJECT ProjectName ""
/begin MODULE ModuleName ""
/begin MOD_COMMON "" BYTE_ORDER MSB_LAST ALIGNMENT_BYTE 1 ALIGNMENT_WORD 1 ALIGNMENT_LONG 1 ALIGNMENT_INT64 1 ALIGNMENT_FLOAT16_IEEE 1 ALIGNMENT_FLOAT32_IEEE 1 ALIGNMENT_FLOAT64_IEEE 1 /end MOD_COMMON
/begin RECORD_LAYOUT __A_INT64_Z FNC_VALUES 1 A_INT64 ROW_DIR DIRECT /end RECORD_LAYOUT
/begin MEASUREMENT SwcOut_TOS_AEB[17].CllsnMtgtnByBrkgPrimQly "" UBYTE autosar_swc_tos_CM_uint8 0 0 0 255 ECU_ADDRESS 0xfe4b14b8 /* @ECU_Address@SwcOut_TOS_AEB[17].CllsnMtgtnByBrkgPrimQly@ */ /end MEASUREMENT
/begin MEASUREMENT SwcOut_TOS_AEB[17].CllsnMtgtnByBrkgSecQly "" UBYTE autosar_swc_tos_CM_uint8 0 0 0 255 ECU_ADDRESS 0xfe4b14b9 /* @ECU_Address@SwcOut_TOS_AEB[17].CllsnMtgtnByBrkgSecQly@ */ /end MEASUREMENT
/begin MEASUREMENT SwcOut_TOS_AEB[17].CllsnWarnFwdQly "" UBYTE autosar_swc_tos_CM_uint8 0 0 0 255 ECU_ADDRESS 0xfe4b14ba /* @ECU_Address@SwcOut_TOS_AEB[17].CllsnWarnFwdQly@ */ /end MEASUREMENT
/begin MEASUREMENT SwcOut_TOS_AEB[17].LeftLane_flag "" UBYTE autosar_swc_tos_CM_boolean 0 0 0 1 ECU_ADDRESS 0xfe4b14b0 /* @ECU_Address@SwcOut_TOS_AEB[17].LeftLane_flag@ */ /end MEASUREMENT
/begin MEASUREMENT SwcOut_TOS_AEB[17].Object_AX "" FLOAT32_IEEE autosar_swc_tos_CM_single 0 0 -3.4E+38 3.4E+38 ECU_ADDRESS 0xfe4b14fc /* @ECU_Address@SwcOut_TOS_AEB[17].Object_AX@ */ /end MEASUREMENT
/begin MEASUREMENT SwcOut_TOS_AEB[17].Object_AY "" FLOAT32_IEEE autosar_swc_tos_CM_single 0 0 -3.4E+38 3.4E+38 ECU_ADDRESS 0xfe4b1500 /* @ECU_Address@SwcOut_TOS_AEB[17].Object_AY@ */ /end MEASUREMENT
/begin MEASUREMENT SwcOut_TOS_AEB[17].Object_Abs_AX "" FLOAT32_IEEE autosar_swc_tos_CM_single 0 0 -3.4E+38 3.4E+38 ECU_ADDRESS 0xfe4b1504 /* @ECU_Address@SwcOut_TOS_AEB[17].Object_Abs_AX@ */ /end MEASUREMENT
/begin MEASUREMENT SwcOut_TOS_AEB[17].Object_Abs_AY "" FLOAT32_IEEE autosar_swc_tos_CM_single 0 0 -3.4E+38 3.4E+38 ECU_ADDRESS 0xfe4b1508 /* @ECU_Address@SwcOut_TOS_AEB[17].Object_Abs_AY@ */ /end MEASUREMENT
/begin MEASUREMENT SwcOut_TOS_AEB[17].Object_Abs_SPEED "" FLOAT32_IEEE autosar_swc_tos_CM_single 0 0 -3.4E+38 3.4E+38 ECU_ADDRESS 0xfe4b14f0 /* @ECU_Address@SwcOut_TOS_AEB[17].Object_Abs_SPEED@ */ /end MEASUREMENT
/begin MEASUREMENT SwcOut_TOS_AEB[17].Object_Abs_VX "" FLOAT32_IEEE autosar_swc_tos_CM_single 0 0 -3.4E+38 3.4E+38 ECU_ADDRESS 0xfe4b14f4 /* @ECU_Address@SwcOut_TOS_AEB[17].Object_Abs_VX@ */ /end MEASUREMENT
/begin MEASUREMENT SwcOut_TOS_AEB[17].Object_Abs_VY "" FLOAT32_IEEE autosar_swc_tos_CM_single 0 0 -3.4E+38 3.4E+38 ECU_ADDRESS 0xfe4b14f8 /* @ECU_Address@SwcOut_TOS_AEB[17].Object_Abs_VY@ */ /end MEASUREMENT
/begin MEASUREMENT SwcOut_TOS_AEB[17].Object_Age "" A_UINT64 autosar_swc_tos_CM_uint64 0 0 0 18446744073709551615 ECU_ADDRESS 0xfe4b1538 /* @ECU_Address@SwcOut_TOS_AEB[17].Object_Age@ */ /end MEASUREMENT
/begin MEASUREMENT SwcOut_TOS_AEB[17].Object_DX "" FLOAT32_IEEE autosar_swc_tos_CM_single 0 0 -3.4E+38 3.4E+38 ECU_ADDRESS 0xfe4b14d8 /* @ECU_Address@SwcOut_TOS_AEB[17].Object_DX@ */ /end MEASUREMENT
/begin MEASUREMENT SwcOut_TOS_AEB[17].Object_DY "" FLOAT32_IEEE autosar_swc_tos_CM_single 0 0 -3.4E+38 3.4E+38 ECU_ADDRESS 0xfe4b14dc /* @ECU_Address@SwcOut_TOS_AEB[17].Object_DY@ */ /end MEASUREMENT
/begin MEASUREMENT SwcOut_TOS_AEB[17].Object_Fus_Type "" UWORD autosar_swc_tos_CM_uint16 0 0 0 65535 ECU_ADDRESS 0xfe4b14bc /* @ECU_Address@SwcOut_TOS_AEB[17].Object_Fus_Type@ */ /end MEASUREMENT
/begin MEASUREMENT SwcOut_TOS_AEB[17].Object_HeadingAngle "" FLOAT32_IEEE autosar_swc_tos_CM_single 0 0 -3.4E+38 3.4E+38 ECU_ADDRESS 0xfe4b14d0 /* @ECU_Address@SwcOut_TOS_AEB[17].Object_HeadingAngle@ */ /end MEASUREMENT
/begin MEASUREMENT SwcOut_TOS_AEB[17].Object_Hight "" FLOAT32_IEEE autosar_swc_tos_CM_single 0 0 -3.4E+38 3.4E+38 ECU_ADDRESS 0xfe4b14cc /* @ECU_Address@SwcOut_TOS_AEB[17].Object_Hight@ */ /end MEASUREMENT
/begin MEASUREMENT SwcOut_TOS_AEB[17].Object_ID "" ULONG autosar_swc_tos_CM_uint32 0 0 0 4294967295 ECU_ADDRESS 0xfe4b152c /* @ECU_Address@SwcOut_TOS_AEB[17].Object_ID@ */ /end MEASUREMENT
/begin MEASUREMENT SwcOut_TOS_AEB[17].Object_Length "" FLOAT32_IEEE autosar_swc_tos_CM_single 0 0 -3.4E+38 3.4E+38 ECU_ADDRESS 0xfe4b14c4 /* @ECU_Address@SwcOut_TOS_AEB[17].Object_Length@ */ /end MEASUREMENT
/begin MEASUREMENT SwcOut_TOS_AEB[17].Object_MovingState "" UBYTE autosar_swc_tos_CM_uint8 0 0 0 255 ECU_ADDRESS 0xfe4b14b4 /* @ECU_Address@SwcOut_TOS_AEB[17].Object_MovingState@ */ /end MEASUREMENT
/begin MEASUREMENT SwcOut_TOS_AEB[17].Object_Orientation "" UBYTE autosar_swc_tos_CM_uint8 0 0 0 255 ECU_ADDRESS 0xfe4b14b5 /* @ECU_Address@SwcOut_TOS_AEB[17].Object_Orientation@ */ /end MEASUREMENT
/begin MEASUREMENT SwcOut_TOS_AEB[17].Object_RangeX "" FLOAT32_IEEE autosar_swc_tos_CM_single 0 0 -3.4E+38 3.4E+38 ECU_ADDRESS 0xfe4b14e0 /* @ECU_Address@SwcOut_TOS_AEB[17].Object_RangeX@ */ /end MEASUREMENT
/begin MEASUREMENT SwcOut_TOS_AEB[17].Object_RangeY "" FLOAT32_IEEE autosar_swc_tos_CM_single 0 0 -3.4E+38 3.4E+38 ECU_ADDRESS 0xfe4b14e4 /* @ECU_Address@SwcOut_TOS_AEB[17].Object_RangeY@ */ /end MEASUREMENT
/begin MEASUREMENT SwcOut_TOS_AEB[17].Object_Turn_Signal "" UBYTE autosar_swc_tos_CM_uint8 0 0 0 255 ECU_ADDRESS 0xfe4b14b6 /* @ECU_Address@SwcOut_TOS_AEB[17].Object_Turn_Signal@ */ /end MEASUREMENT
/begin MEASUREMENT SwcOut_TOS_AEB[17].Object_Type "" UBYTE autosar_swc_tos_CM_uint8 0 0 0 255 ECU_ADDRESS 0xfe4b14b3 /* @ECU_Address@SwcOut_TOS_AEB[17].Object_Type@ */ /end MEASUREMENT
/begin MEASUREMENT SwcOut_TOS_AEB[17].Object_VX "" FLOAT32_IEEE autosar_swc_tos_CM_single 0 0 -3.4E+38 3.4E+38 ECU_ADDRESS 0xfe4b14e8 /* @ECU_Address@SwcOut_TOS_AEB[17].Object_VX@ */ /end MEASUREMENT
/begin MEASUREMENT SwcOut_TOS_AEB[17].Object_VY "" FLOAT32_IEEE autosar_swc_tos_CM_single 0 0 -3.4E+38 3.4E+38 ECU_ADDRESS 0xfe4b14ec /* @ECU_Address@SwcOut_TOS_AEB[17].Object_VY@ */ /end MEASUREMENT
/begin MEASUREMENT SwcOut_TOS_AEB[17].Object_Width "" FLOAT32_IEEE autosar_swc_tos_CM_single 0 0 -3.4E+38 3.4E+38 ECU_ADDRESS 0xfe4b14c8 /* @ECU_Address@SwcOut_TOS_AEB[17].Object_Width@ */ /end MEASUREMENT
/begin MEASUREMENT SwcOut_TOS_AEB[17].Object_YawAngle "" FLOAT32_IEEE autosar_swc_tos_CM_single 0 0 -3.4E+38 3.4E+38 ECU_ADDRESS 0xfe4b14d4 /* @ECU_Address@SwcOut_TOS_AEB[17].Object_YawAngle@ */ /end MEASUREMENT
/begin MEASUREMENT SwcOut_TOS_AEB[17].RightLane_flag "" UBYTE autosar_swc_tos_CM_boolean 0 0 0 1 ECU_ADDRESS 0xfe4b14b2 /* @ECU_Address@SwcOut_TOS_AEB[17].RightLane_flag@ */ /end MEASUREMENT
/begin MEASUREMENT SwcOut_TOS_AEB[17].SameLane_flag "" UBYTE autosar_swc_tos_CM_boolean 0 0 0 1 ECU_ADDRESS 0xfe4b14b1 /* @ECU_Address@SwcOut_TOS_AEB[17].SameLane_flag@ */ /end MEASUREMENT
/begin MEASUREMENT SwcOut_TOS_AEB[17].Sceniaro_Flag "" UBYTE autosar_swc_tos_CM_uint8 0 0 0 255 ECU_ADDRESS 0xfe4b14b7 /* @ECU_Address@SwcOut_TOS_AEB[17].Sceniaro_Flag@ */ /end MEASUREMENT
/begin MEASUREMENT SwcOut_TOS_AEB[17].TimeStamp "" A_UINT64 autosar_swc_tos_CM_uint64 0 0 0 18446744073709551615 ECU_ADDRESS 0xfe4b1540 /* @ECU_Address@SwcOut_TOS_AEB[17].TimeStamp@ */ /end MEASUREMENT
/begin MEASUREMENT SwcOut_TOS_AEB[17].camID "" ULONG autosar_swc_tos_CM_uint32 0 0 0 4294967295 ECU_ADDRESS 0xfe4b1530 /* @ECU_Address@SwcOut_TOS_AEB[17].camID@ */ /end MEASUREMENT
/begin MEASUREMENT SwcOut_TOS_AEB[17].corner_left_front_x "" FLOAT32_IEEE autosar_swc_tos_CM_single 0 0 -3.4E+38 3.4E+38 ECU_ADDRESS 0xfe4b150c /* @ECU_Address@SwcOut_TOS_AEB[17].corner_left_front_x@ */ /end MEASUREMENT
/begin MEASUREMENT SwcOut_TOS_AEB[17].corner_left_front_y "" FLOAT32_IEEE autosar_swc_tos_CM_single 0 0 -3.4E+38 3.4E+38 ECU_ADDRESS 0xfe4b1510 /* @ECU_Address@SwcOut_TOS_AEB[17].corner_left_front_y@ */ /end MEASUREMENT
/begin MEASUREMENT SwcOut_TOS_AEB[17].corner_left_rear_x "" FLOAT32_IEEE autosar_swc_tos_CM_single 0 0 -3.4E+38 3.4E+38 ECU_ADDRESS 0xfe4b151c /* @ECU_Address@SwcOut_TOS_AEB[17].corner_left_rear_x@ */ /end MEASUREMENT
/begin MEASUREMENT SwcOut_TOS_AEB[17].corner_left_rear_y "" FLOAT32_IEEE autosar_swc_tos_CM_single 0 0 -3.4E+38 3.4E+38 ECU_ADDRESS 0xfe4b1520 /* @ECU_Address@SwcOut_TOS_AEB[17].corner_left_rear_y@ */ /end MEASUREMENT
/begin MEASUREMENT SwcOut_TOS_AEB[17].corner_right_front_x "" FLOAT32_IEEE autosar_swc_tos_CM_single 0 0 -3.4E+38 3.4E+38 ECU_ADDRESS 0xfe4b1514 /* @ECU_Address@SwcOut_TOS_AEB[17].corner_right_front_x@ */ /end MEASUREMENT
/begin MEASUREMENT SwcOut_TOS_AEB[17].corner_right_front_y "" FLOAT32_IEEE autosar_swc_tos_CM_single 0 0 -3.4E+38 3.4E+38 ECU_ADDRESS 0xfe4b1518 /* @ECU_Address@SwcOut_TOS_AEB[17].corner_right_front_y@ */ /end MEASUREMENT
/begin MEASUREMENT SwcOut_TOS_AEB[17].corner_right_rear_x "" FLOAT32_IEEE autosar_swc_tos_CM_single 0 0 -3.4E+38 3.4E+38 ECU_ADDRESS 0xfe4b1524 /* @ECU_Address@SwcOut_TOS_AEB[17].corner_right_rear_x@ */ /end MEASUREMENT
/begin MEASUREMENT SwcOut_TOS_AEB[17].corner_right_rear_y "" FLOAT32_IEEE autosar_swc_tos_CM_single 0 0 -3.4E+38 3.4E+38 ECU_ADDRESS 0xfe4b1528 /* @ECU_Address@SwcOut_TOS_AEB[17].corner_right_rear_y@ */ /end MEASUREMENT
/begin MEASUREMENT SwcOut_TOS_AEB[17].pro_flag "" SLONG autosar_swc_tos_CM_int32 0 0 -2147483648 2147483647 ECU_ADDRESS 0xfe4b14c0 /* @ECU_Address@SwcOut_TOS_AEB[17].pro_flag@ */ /end MEASUREMENT
/begin MEASUREMENT SwcOut_TOS_AEB[17].ramp "" UBYTE autosar_swc_tos_CM_uint8 0 0 0 255 ECU_ADDRESS 0xfe4b14bb /* @ECU_Address@SwcOut_TOS_AEB[17].ramp@ */ /end MEASUREMENT
/begin MEASUREMENT SwcOut_TOS_AEB[18].CllsnMtgtnByBrkgPrimQly "" UBYTE autosar_swc_tos_CM_uint8 0 0 0 255 ECU_ADDRESS 0xfe4b1550 /* @ECU_Address@SwcOut_TOS_AEB[18].CllsnMtgtnByBrkgPrimQly@ */ /end MEASUREMENT
/begin MEASUREMENT SwcOut_TOS_AEB[18].CllsnMtgtnByBrkgSecQly "" UBYTE autosar_swc_tos_CM_uint8 0 0 0 255 ECU_ADDRESS 0xfe4b1551 /* @ECU_Address@SwcOut_TOS_AEB[18].CllsnMtgtnByBrkgSecQly@ */ /end MEASUREMENT
/begin MEASUREMENT SwcOut_TOS_AEB[18].CllsnWarnFwdQly "" UBYTE autosar_swc_tos_CM_uint8 0 0 0 255 ECU_ADDRESS 0xfe4b1552 /* @ECU_Address@SwcOut_TOS_AEB[18].CllsnWarnFwdQly@ */ /end MEASUREMENT
/begin MEASUREMENT SwcOut_TOS_AEB[18].LeftLane_flag "" UBYTE autosar_swc_tos_CM_boolean 0 0 0 1 ECU_ADDRESS 0xfe4b1548 /* @ECU_Address@SwcOut_TOS_AEB[18].LeftLane_flag@ */ /end MEASUREMENT
/begin MEASUREMENT SwcOut_TOS_AEB[18].Object_AX "" FLOAT32_IEEE autosar_swc_tos_CM_single 0 0 -3.4E+38 3.4E+38 ECU_ADDRESS 0xfe4b1594 /* @ECU_Address@SwcOut_TOS_AEB[18].Object_AX@ */ /end MEASUREMENT
/begin MEASUREMENT SwcOut_TOS_AEB[18].Object_AY "" FLOAT32_IEEE autosar_swc_tos_CM_single 0 0 -3.4E+38 3.4E+38 ECU_ADDRESS 0xfe4b1598 /* @ECU_Address@SwcOut_TOS_AEB[18].Object_AY@ */ /end MEASUREMENT
/begin MEASUREMENT SwcOut_TOS_AEB[18].Object_Abs_AX "" FLOAT32_IEEE autosar_swc_tos_CM_single 0 0 -3.4E+38 3.4E+38 ECU_ADDRESS 0xfe4b159c /* @ECU_Address@SwcOut_TOS_AEB[18].Object_Abs_AX@ */ /end MEASUREMENT
/begin MEASUREMENT SwcOut_TOS_AEB[18].Object_Abs_AY "" FLOAT32_IEEE autosar_swc_tos_CM_single 0 0 -3.4E+38 3.4E+38 ECU_ADDRESS 0xfe4b15a0 /* @ECU_Address@SwcOut_TOS_AEB[18].Object_Abs_AY@ */ /end MEASUREMENT
/begin MEASUREMENT SwcOut_TOS_AEB[18].Object_Abs_SPEED "" FLOAT32_IEEE autosar_swc_tos_CM_single 0 0 -3.4E+38 3.4E+38 ECU_ADDRESS 0xfe4b1588 /* @ECU_Address@SwcOut_TOS_AEB[18].Object_Abs_SPEED@ */ /end MEASUREMENT
/begin MEASUREMENT SwcOut_TOS_AEB[18].Object_Abs_VX "" FLOAT32_IEEE autosar_swc_tos_CM_single 0 0 -3.4E+38 3.4E+38 ECU_ADDRESS 0xfe4b158c /* @ECU_Address@SwcOut_TOS_AEB[18].Object_Abs_VX@ */ /end MEASUREMENT
/begin MEASUREMENT SwcOut_TOS_AEB[18].Object_Abs_VY "" FLOAT32_IEEE autosar_swc_tos_CM_single 0 0 -3.4E+38 3.4E+38 ECU_ADDRESS 0xfe4b1590 /* @ECU_Address@SwcOut_TOS_AEB[18].Object_Abs_VY@ */ /end MEASUREMENT
/begin MEASUREMENT SwcOut_TOS_AEB[18].Object_Age "" A_UINT64 autosar_swc_tos_CM_uint64 0 0 0 18446744073709551615 ECU_ADDRESS 0xfe4b15d0 /* @ECU_Address@SwcOut_TOS_AEB[18].Object_Age@ */ /end MEASUREMENT
/begin MEASUREMENT SwcOut_TOS_AEB[18].Object_DX "" FLOAT32_IEEE autosar_swc_tos_CM_single 0 0 -3.4E+38 3.4E+38 ECU_ADDRESS 0xfe4b1570 /* @ECU_Address@SwcOut_TOS_AEB[18].Object_DX@ */ /end MEASUREMENT
/begin MEASUREMENT SwcOut_TOS_AEB[18].Object_DY "" FLOAT32_IEEE autosar_swc_tos_CM_single 0 0 -3.4E+38 3.4E+38 ECU_ADDRESS 0xfe4b1574 /* @ECU_Address@SwcOut_TOS_AEB[18].Object_DY@ */ /end MEASUREMENT
/begin MEASUREMENT SwcOut_TOS_AEB[18].Object_Fus_Type "" UWORD autosar_swc_tos_CM_uint16 0 0 0 65535 ECU_ADDRESS 0xfe4b1554 /* @ECU_Address@SwcOut_TOS_AEB[18].Object_Fus_Type@ */ /end MEASUREMENT
/begin MEASUREMENT SwcOut_TOS_AEB[18].Object_HeadingAngle "" FLOAT32_IEEE autosar_swc_tos_CM_single 0 0 -3.4E+38 3.4E+38 ECU_ADDRESS 0xfe4b1568 /* @ECU_Address@SwcOut_TOS_AEB[18].Object_HeadingAngle@ */ /end MEASUREMENT
/begin MEASUREMENT SwcOut_TOS_AEB[18].Object_Hight "" FLOAT32_IEEE autosar_swc_tos_CM_single 0 0 -3.4E+38 3.4E+38 ECU_ADDRESS 0xfe4b1564 /* @ECU_Address@SwcOut_TOS_AEB[18].Object_Hight@ */ /end MEASUREMENT
/begin MEASUREMENT SwcOut_TOS_AEB[18].Object_ID "" ULONG autosar_swc_tos_CM_uint32 0 0 0 4294967295 ECU_ADDRESS 0xfe4b15c4 /* @ECU_Address@SwcOut_TOS_AEB[18].Object_ID@ */ /end MEASUREMENT
/begin MEASUREMENT SwcOut_TOS_AEB[18].Object_Length "" FLOAT32_IEEE autosar_swc_tos_CM_single 0 0 -3.4E+38 3.4E+38 ECU_ADDRESS 0xfe4b155c /* @ECU_Address@SwcOut_TOS_AEB[18].Object_Length@ */ /end MEASUREMENT
/begin MEASUREMENT SwcOut_TOS_AEB[18].Object_MovingState "" UBYTE autosar_swc_tos_CM_uint8 0 0 0 255 ECU_ADDRESS 0xfe4b154c /* @ECU_Address@SwcOut_TOS_AEB[18].Object_MovingState@ */ /end MEASUREMENT
/begin MEASUREMENT SwcOut_TOS_AEB[18].Object_Orientation "" UBYTE autosar_swc_tos_CM_uint8 0 0 0 255 ECU_ADDRESS 0xfe4b154d /* @ECU_Address@SwcOut_TOS_AEB[18].Object_Orientation@ */ /end MEASUREMENT
/begin MEASUREMENT SwcOut_TOS_AEB[18].Object_RangeX "" FLOAT32_IEEE autosar_swc_tos_CM_single 0 0 -3.4E+38 3.4E+38 ECU_ADDRESS 0xfe4b1578 /* @ECU_Address@SwcOut_TOS_AEB[18].Object_RangeX@ */ /end MEASUREMENT
/begin MEASUREMENT SwcOut_TOS_AEB[18].Object_RangeY "" FLOAT32_IEEE autosar_swc_tos_CM_single 0 0 -3.4E+38 3.4E+38 ECU_ADDRESS 0xfe4b157c /* @ECU_Address@SwcOut_TOS_AEB[18].Object_RangeY@ */ /end MEASUREMENT
/begin MEASUREMENT SwcOut_TOS_AEB[18].Object_Turn_Signal "" UBYTE autosar_swc_tos_CM_uint8 0 0 0 255 ECU_ADDRESS 0xfe4b154e /* @ECU_Address@SwcOut_TOS_AEB[18].Object_Turn_Signal@ */ /end MEASUREMENT
/begin MEASUREMENT SwcOut_TOS_AEB[18].Object_Type "" UBYTE autosar_swc_tos_CM_uint8 0 0 0 255 ECU_ADDRESS 0xfe4b154b /* @ECU_Address@SwcOut_TOS_AEB[18].Object_Type@ */ /end MEASUREMENT
/begin MEASUREMENT SwcOut_TOS_AEB[18].Object_VX "" FLOAT32_IEEE autosar_swc_tos_CM_single 0 0 -3.4E+38 3.4E+38 ECU_ADDRESS 0xfe4b1580 /* @ECU_Address@SwcOut_TOS_AEB[18].Object_VX@ */ /end MEASUREMENT
/begin MEASUREMENT SwcOut_TOS_AEB[18].Object_VY "" FLOAT32_IEEE autosar_swc_tos_CM_single 0 0 -3.4E+38 3.4E+38 ECU_ADDRESS 0xfe4b1584 /* @ECU_Address@SwcOut_TOS_AEB[18].Object_VY@ */ /end MEASUREMENT
/begin MEASUREMENT SwcOut_TOS_AEB[18].Object_Width "" FLOAT32_IEEE autosar_swc_tos_CM_single 0 0 -3.4E+38 3.4E+38 ECU_ADDRESS 0xfe4b1560 /* @ECU_Address@SwcOut_TOS_AEB[18].Object_Width@ */ /end MEASUREMENT
/begin MEASUREMENT SwcOut_TOS_AEB[18].Object_YawAngle "" FLOAT32_IEEE autosar_swc_tos_CM_single 0 0 -3.4E+38 3.4E+38 ECU_ADDRESS 0xfe4b156c /* @ECU_Address@SwcOut_TOS_AEB[18].Object_YawAngle@ */ /end MEASUREMENT
/begin MEASUREMENT SwcOut_TOS_AEB[18].RightLane_flag "" UBYTE autosar_swc_tos_CM_boolean 0 0 0 1 ECU_ADDRESS 0xfe4b154a /* @ECU_Address@SwcOut_TOS_AEB[18].RightLane_flag@ */ /end MEASUREMENT
/begin MEASUREMENT SwcOut_TOS_AEB[18].SameLane_flag "" UBYTE autosar_swc_tos_CM_boolean 0 0 0 1 ECU_ADDRESS 0xfe4b1549 /* @ECU_Address@SwcOut_TOS_AEB[18].SameLane_flag@ */ /end MEASUREMENT
/begin MEASUREMENT SwcOut_TOS_AEB[18].Sceniaro_Flag "" UBYTE autosar_swc_tos_CM_uint8 0 0 0 255 ECU_ADDRESS 0xfe4b154f /* @ECU_Address@SwcOut_TOS_AEB[18].Sceniaro_Flag@ */ /end MEASUREMENT
/begin MEASUREMENT SwcOut_TOS_AEB[18].TimeStamp "" A_UINT64 autosar_swc_tos_CM_uint64 0 0 0 18446744073709551615 ECU_ADDRESS 0xfe4b15d8 /* @ECU_Address@SwcOut_TOS_AEB[18].TimeStamp@ */ /end MEASUREMENT
/begin MEASUREMENT SwcOut_TOS_AEB[18].camID "" ULONG autosar_swc_tos_CM_uint32 0 0 0 4294967295 ECU_ADDRESS 0xfe4b15c8 /* @ECU_Address@SwcOut_TOS_AEB[18].camID@ */ /end MEASUREMENT
/begin MEASUREMENT SwcOut_TOS_AEB[18].corner_left_front_x "" FLOAT32_IEEE autosar_swc_tos_CM_single 0 0 -3.4E+38 3.4E+38 ECU_ADDRESS 0xfe4b15a4 /* @ECU_Address@SwcOut_TOS_AEB[18].corner_left_front_x@ */ /end MEASUREMENT
/begin MEASUREMENT SwcOut_TOS_AEB[18].corner_left_front_y "" FLOAT32_IEEE autosar_swc_tos_CM_single 0 0 -3.4E+38 3.4E+38 ECU_ADDRESS 0xfe4b15a8 /* @ECU_Address@SwcOut_TOS_AEB[18].corner_left_front_y@ */ /end MEASUREMENT
/begin MEASUREMENT SwcOut_TOS_AEB[18].corner_left_rear_x "" FLOAT32_IEEE autosar_swc_tos_CM_single 0 0 -3.4E+38 3.4E+38 ECU_ADDRESS 0xfe4b15b4 /* @ECU_Address@SwcOut_TOS_AEB[18].corner_left_rear_x@ */ /end MEASUREMENT
/begin MEASUREMENT SwcOut_TOS_AEB[18].corner_left_rear_y "" FLOAT32_IEEE autosar_swc_tos_CM_single 0 0 -3.4E+38 3.4E+38 ECU_ADDRESS 0xfe4b15b8 /* @ECU_Address@SwcOut_TOS_AEB[18].corner_left_rear_y@ */ /end MEASUREMENT
/begin MEASUREMENT SwcOut_TOS_AEB[18].corner_right_front_x "" FLOAT32_IEEE autosar_swc_tos_CM_single 0 0 -3.4E+38 3.4E+38 ECU_ADDRESS 0xfe4b15ac /* @ECU_Address@SwcOut_TOS_AEB[18].corner_right_front_x@ */ /end MEASUREMENT
/begin MEASUREMENT SwcOut_TOS_AEB[18].corner_right_front_y "" FLOAT32_IEEE autosar_swc_tos_CM_single 0 0 -3.4E+38 3.4E+38 ECU_ADDRESS 0xfe4b15b0 /* @ECU_Address@SwcOut_TOS_AEB[18].corner_right_front_y@ */ /end MEASUREMENT
/begin MEASUREMENT SwcOut_TOS_AEB[18].corner_right_rear_x "" FLOAT32_IEEE autosar_swc_tos_CM_single 0 0 -3.4E+38 3.4E+38 ECU_ADDRESS 0xfe4b15bc /* @ECU_Address@SwcOut_TOS_AEB[18].corner_right_rear_x@ */ /end MEASUREMENT
/begin MEASUREMENT SwcOut_TOS_AEB[18].corner_right_rear_y "" FLOAT32_IEEE autosar_swc_tos_CM_single 0 0 -3.4E+38 3.4E+38 ECU_ADDRESS 0xfe4b15c0 /* @ECU_Address@SwcOut_TOS_AEB[18].corner_right_rear_y@ */ /end MEASUREMENT
/begin MEASUREMENT SwcOut_TOS_AEB[18].pro_flag "" SLONG autosar_swc_tos_CM_int32 0 0 -2147483648 2147483647 ECU_ADDRESS 0xfe4b1558 /* @ECU_Address@SwcOut_TOS_AEB[18].pro_flag@ */ /end MEASUREMENT
/begin MEASUREMENT SwcOut_TOS_AEB[18].ramp "" UBYTE autosar_swc_tos_CM_uint8 0 0 0 255 ECU_ADDRESS 0xfe4b1553 /* @ECU_Address@SwcOut_TOS_AEB[18].ramp@ */ /end MEASUREMENT
/begin MEASUREMENT SwcOut_TOS_AEB[19].CllsnMtgtnByBrkgPrimQly "" UBYTE autosar_swc_tos_CM_uint8 0 0 0 255 ECU_ADDRESS 0xfe4b15e8 /* @ECU_Address@SwcOut_TOS_AEB[19].CllsnMtgtnByBrkgPrimQly@ */ /end MEASUREMENT
/begin MEASUREMENT SwcOut_TOS_AEB[19].CllsnMtgtnByBrkgSecQly "" UBYTE autosar_swc_tos_CM_uint8 0 0 0 255 ECU_ADDRESS 0xfe4b15e9 /* @ECU_Address@SwcOut_TOS_AEB[19].CllsnMtgtnByBrkgSecQly@ */ /end MEASUREMENT
/begin MEASUREMENT SwcOut_TOS_AEB[19].CllsnWarnFwdQly "" UBYTE autosar_swc_tos_CM_uint8 0 0 0 255 ECU_ADDRESS 0xfe4b15ea /* @ECU_Address@SwcOut_TOS_AEB[19].CllsnWarnFwdQly@ */ /end MEASUREMENT
/begin MEASUREMENT SwcOut_TOS_AEB[19].LeftLane_flag "" UBYTE autosar_swc_tos_CM_boolean 0 0 0 1 ECU_ADDRESS 0xfe4b15e0 /* @ECU_Address@SwcOut_TOS_AEB[19].LeftLane_flag@ */ /end MEASUREMENT
/begin MEASUREMENT SwcOut_TOS_AEB[19].Object_AX "" FLOAT32_IEEE autosar_swc_tos_CM_single 0 0 -3.4E+38 3.4E+38 ECU_ADDRESS 0xfe4b162c /* @ECU_Address@SwcOut_TOS_AEB[19].Object_AX@ */ /end MEASUREMENT
/begin MEASUREMENT SwcOut_TOS_AEB[19].Object_AY "" FLOAT32_IEEE autosar_swc_tos_CM_single 0 0 -3.4E+38 3.4E+38 ECU_ADDRESS 0xfe4b1630 /* @ECU_Address@SwcOut_TOS_AEB[19].Object_AY@ */ /end MEASUREMENT
/begin MEASUREMENT SwcOut_TOS_AEB[19].Object_Abs_AX "" FLOAT32_IEEE autosar_swc_tos_CM_single 0 0 -3.4E+38 3.4E+38 ECU_ADDRESS 0xfe4b1634 /* @ECU_Address@SwcOut_TOS_AEB[19].Object_Abs_AX@ */ /end MEASUREMENT
/begin MEASUREMENT SwcOut_TOS_AEB[19].Object_Abs_AY "" FLOAT32_IEEE autosar_swc_tos_CM_single 0 0 -3.4E+38 3.4E+38 ECU_ADDRESS 0xfe4b1638 /* @ECU_Address@SwcOut_TOS_AEB[19].Object_Abs_AY@ */ /end MEASUREMENT
/begin MEASUREMENT SwcOut_TOS_AEB[19].Object_Abs_SPEED "" FLOAT32_IEEE autosar_swc_tos_CM_single 0 0 -3.4E+38 3.4E+38 ECU_ADDRESS 0xfe4b1620 /* @ECU_Address@SwcOut_TOS_AEB[19].Object_Abs_SPEED@ */ /end MEASUREMENT
/begin MEASUREMENT SwcOut_TOS_AEB[19].Object_Abs_VX "" FLOAT32_IEEE autosar_swc_tos_CM_single 0 0 -3.4E+38 3.4E+38 ECU_ADDRESS 0xfe4b1624 /* @ECU_Address@SwcOut_TOS_AEB[19].Object_Abs_VX@ */ /end MEASUREMENT
/begin MEASUREMENT SwcOut_TOS_AEB[19].Object_Abs_VY "" FLOAT32_IEEE autosar_swc_tos_CM_single 0 0 -3.4E+38 3.4E+38 ECU_ADDRESS 0xfe4b1628 /* @ECU_Address@SwcOut_TOS_AEB[19].Object_Abs_VY@ */ /end MEASUREMENT
/begin MEASUREMENT SwcOut_TOS_AEB[19].Object_Age "" A_UINT64 autosar_swc_tos_CM_uint64 0 0 0 18446744073709551615 ECU_ADDRESS 0xfe4b1668 /* @ECU_Address@SwcOut_TOS_AEB[19].Object_Age@ */ /end MEASUREMENT
/begin MEASUREMENT SwcOut_TOS_AEB[19].Object_DX "" FLOAT32_IEEE autosar_swc_tos_CM_single 0 0 -3.4E+38 3.4E+38 ECU_ADDRESS 0xfe4b1608 /* @ECU_Address@SwcOut_TOS_AEB[19].Object_DX@ */ /end MEASUREMENT
/begin MEASUREMENT SwcOut_TOS_AEB[19].Object_DY "" FLOAT32_IEEE autosar_swc_tos_CM_single 0 0 -3.4E+38 3.4E+38 ECU_ADDRESS 0xfe4b160c /* @ECU_Address@SwcOut_TOS_AEB[19].Object_DY@ */ /end MEASUREMENT
/begin MEASUREMENT SwcOut_TOS_AEB[19].Object_Fus_Type "" UWORD autosar_swc_tos_CM_uint16 0 0 0 65535 ECU_ADDRESS 0xfe4b15ec /* @ECU_Address@SwcOut_TOS_AEB[19].Object_Fus_Type@ */ /end MEASUREMENT
/begin MEASUREMENT SwcOut_TOS_AEB[19].Object_HeadingAngle "" FLOAT32_IEEE autosar_swc_tos_CM_single 0 0 -3.4E+38 3.4E+38 ECU_ADDRESS 0xfe4b1600 /* @ECU_Address@SwcOut_TOS_AEB[19].Object_HeadingAngle@ */ /end MEASUREMENT
/begin MEASUREMENT SwcOut_TOS_AEB[19].Object_Hight "" FLOAT32_IEEE autosar_swc_tos_CM_single 0 0 -3.4E+38 3.4E+38 ECU_ADDRESS 0xfe4b15fc /* @ECU_Address@SwcOut_TOS_AEB[19].Object_Hight@ */ /end MEASUREMENT
/begin MEASUREMENT SwcOut_TOS_AEB[19].Object_ID "" ULONG autosar_swc_tos_CM_uint32 0 0 0 4294967295 ECU_ADDRESS 0xfe4b165c /* @ECU_Address@SwcOut_TOS_AEB[19].Object_ID@ */ /end MEASUREMENT
/begin MEASUREMENT SwcOut_TOS_AEB[19].Object_Length "" FLOAT32_IEEE autosar_swc_tos_CM_single 0 0 -3.4E+38 3.4E+38 ECU_ADDRESS 0xfe4b15f4 /* @ECU_Address@SwcOut_TOS_AEB[19].Object_Length@ */ /end MEASUREMENT
/begin MEASUREMENT SwcOut_TOS_AEB[19].Object_MovingState "" UBYTE autosar_swc_tos_CM_uint8 0 0 0 255 ECU_ADDRESS 0xfe4b15e4 /* @ECU_Address@SwcOut_TOS_AEB[19].Object_MovingState@ */ /end MEASUREMENT
/begin MEASUREMENT SwcOut_TOS_AEB[19].Object_Orientation "" UBYTE autosar_swc_tos_CM_uint8 0 0 0 255 ECU_ADDRESS 0xfe4b15e5 /* @ECU_Address@SwcOut_TOS_AEB[19].Object_Orientation@ */ /end MEASUREMENT
/begin MEASUREMENT SwcOut_TOS_AEB[19].Object_RangeX "" FLOAT32_IEEE autosar_swc_tos_CM_single 0 0 -3.4E+38 3.4E+38 ECU_ADDRESS 0xfe4b1610 /* @ECU_Address@SwcOut_TOS_AEB[19].Object_RangeX@ */ /end MEASUREMENT
/begin MEASUREMENT SwcOut_TOS_AEB[19].Object_RangeY "" FLOAT32_IEEE autosar_swc_tos_CM_single 0 0 -3.4E+38 3.4E+38 ECU_ADDRESS 0xfe4b1614 /* @ECU_Address@SwcOut_TOS_AEB[19].Object_RangeY@ */ /end MEASUREMENT
/begin MEASUREMENT SwcOut_TOS_AEB[19].Object_Turn_Signal "" UBYTE autosar_swc_tos_CM_uint8 0 0 0 255 ECU_ADDRESS 0xfe4b15e6 /* @ECU_Address@SwcOut_TOS_AEB[19].Object_Turn_Signal@ */ /end MEASUREMENT
/begin MEASUREMENT SwcOut_TOS_AEB[19].Object_Type "" UBYTE autosar_swc_tos_CM_uint8 0 0 0 255 ECU_ADDRESS 0xfe4b15e3 /* @ECU_Address@SwcOut_TOS_AEB[19].Object_Type@ */ /end MEASUREMENT
/begin MEASUREMENT SwcOut_TOS_AEB[19].Object_VX "" FLOAT32_IEEE autosar_swc_tos_CM_single 0 0 -3.4E+38 3.4E+38 ECU_ADDRESS 0xfe4b1618 /* @ECU_Address@SwcOut_TOS_AEB[19].Object_VX@ */ /end MEASUREMENT
/begin MEASUREMENT SwcOut_TOS_AEB[19].Object_VY "" FLOAT32_IEEE autosar_swc_tos_CM_single 0 0 -3.4E+38 3.4E+38 ECU_ADDRESS 0xfe4b161c /* @ECU_Address@SwcOut_TOS_AEB[19].Object_VY@ */ /end MEASUREMENT
/begin MEASUREMENT SwcOut_TOS_AEB[19].Object_Width "" FLOAT32_IEEE autosar_swc_tos_CM_single 0 0 -3.4E+38 3.4E+38 ECU_ADDRESS 0xfe4b15f8 /* @ECU_Address@SwcOut_TOS_AEB[19].Object_Width@ */ /end MEASUREMENT
/begin MEASUREMENT SwcOut_TOS_AEB[19].Object_YawAngle "" FLOAT32_IEEE autosar_swc_tos_CM_single 0 0 -3.4E+38 3.4E+38 ECU_ADDRESS 0xfe4b1604 /* @ECU_Address@SwcOut_TOS_AEB[19].Object_YawAngle@ */ /end MEASUREMENT
/begin MEASUREMENT SwcOut_TOS_AEB[19].RightLane_flag "" UBYTE autosar_swc_tos_CM_boolean 0 0 0 1 ECU_ADDRESS 0xfe4b15e2 /* @ECU_Address@SwcOut_TOS_AEB[19].RightLane_flag@ */ /end MEASUREMENT
/begin MEASUREMENT SwcOut_TOS_AEB[19].SameLane_flag "" UBYTE autosar_swc_tos_CM_boolean 0 0 0 1 ECU_ADDRESS 0xfe4b15e1 /* @ECU_Address@SwcOut_TOS_AEB[19].SameLane_flag@ */ /end MEASUREMENT
/begin MEASUREMENT SwcOut_TOS_AEB[19].Sceniaro_Flag "" UBYTE autosar_swc_tos_CM_uint8 0 0 0 255 ECU_ADDRESS 0xfe4b15e7 /* @ECU_Address@SwcOut_TOS_AEB[19].Sceniaro_Flag@ */ /end MEASUREMENT
/begin MEASUREMENT SwcOut_TOS_AEB[19].TimeStamp "" A_UINT64 autosar_swc_tos_CM_uint64 0 0 0 18446744073709551615 ECU_ADDRESS 0xfe4b1670 /* @ECU_Address@SwcOut_TOS_AEB[19].TimeStamp@ */ /end MEASUREMENT
/begin MEASUREMENT SwcOut_TOS_AEB[19].camID "" ULONG autosar_swc_tos_CM_uint32 0 0 0 4294967295 ECU_ADDRESS 0xfe4b1660 /* @ECU_Address@SwcOut_TOS_AEB[19].camID@ */ /end MEASUREMENT
/begin MEASUREMENT SwcOut_TOS_AEB[19].corner_left_front_x "" FLOAT32_IEEE autosar_swc_tos_CM_single 0 0 -3.4E+38 3.4E+38 ECU_ADDRESS 0xfe4b163c /* @ECU_Address@SwcOut_TOS_AEB[19].corner_left_front_x@ */ /end MEASUREMENT
/begin MEASUREMENT SwcOut_TOS_AEB[19].corner_left_front_y "" FLOAT32_IEEE autosar_swc_tos_CM_single 0 0 -3.4E+38 3.4E+38 ECU_ADDRESS 0xfe4b1640 /* @ECU_Address@SwcOut_TOS_AEB[19].corner_left_front_y@ */ /end MEASUREMENT
/begin MEASUREMENT SwcOut_TOS_AEB[19].corner_left_rear_x "" FLOAT32_IEEE autosar_swc_tos_CM_single 0 0 -3.4E+38 3.4E+38 ECU_ADDRESS 0xfe4b164c /* @ECU_Address@SwcOut_TOS_AEB[19].corner_left_rear_x@ */ /end MEASUREMENT
/begin MEASUREMENT SwcOut_TOS_AEB[19].corner_left_rear_y "" FLOAT32_IEEE autosar_swc_tos_CM_single 0 0 -3.4E+38 3.4E+38 ECU_ADDRESS 0xfe4b1650 /* @ECU_Address@SwcOut_TOS_AEB[19].corner_left_rear_y@ */ /end MEASUREMENT
/begin MEASUREMENT SwcOut_TOS_AEB[19].corner_right_front_x "" FLOAT32_IEEE autosar_swc_tos_CM_single 0 0 -3.4E+38 3.4E+38 ECU_ADDRESS 0xfe4b1644 /* @ECU_Address@SwcOut_TOS_AEB[19].corner_right_front_x@ */ /end MEASUREMENT
/begin MEASUREMENT SwcOut_TOS_AEB[19].corner_right_front_y "" FLOAT32_IEEE autosar_swc_tos_CM_single 0 0 -3.4E+38 3.4E+38 ECU_ADDRESS 0xfe4b1648 /* @ECU_Address@SwcOut_TOS_AEB[19].corner_right_front_y@ */ /end MEASUREMENT
/begin MEASUREMENT SwcOut_TOS_AEB[19].corner_right_rear_x "" FLOAT32_IEEE autosar_swc_tos_CM_single 0 0 -3.4E+38 3.4E+38 ECU_ADDRESS 0xfe4b1654 /* @ECU_Address@SwcOut_TOS_AEB[19].corner_right_rear_x@ */ /end MEASUREMENT
/begin MEASUREMENT SwcOut_TOS_AEB[19].corner_right_rear_y "" FLOAT32_IEEE autosar_swc_tos_CM_single 0 0 -3.4E+38 3.4E+38 ECU_ADDRESS 0xfe4b1658 /* @ECU_Address@SwcOut_TOS_AEB[19].corner_right_rear_y@ */ /end MEASUREMENT
/begin MEASUREMENT SwcOut_TOS_AEB[19].pro_flag "" SLONG autosar_swc_tos_CM_int32 0 0 -2147483648 2147483647 ECU_ADDRESS 0xfe4b15f0 /* @ECU_Address@SwcOut_TOS_AEB[19].pro_flag@ */ /end MEASUREMENT
/begin MEASUREMENT SwcOut_TOS_AEB[19].ramp "" UBYTE autosar_swc_tos_CM_uint8 0 0 0 255 ECU_ADDRESS 0xfe4b15eb /* @ECU_Address@SwcOut_TOS_AEB[19].ramp@ */ /end MEASUREMENT
/begin MEASUREMENT SwcOut_TOS_AEB[1].CllsnMtgtnByBrkgPrimQly "" UBYTE autosar_swc_tos_CM_uint8 0 0 0 255 ECU_ADDRESS 0xfe4b0b38 /* @ECU_Address@SwcOut_TOS_AEB[1].CllsnMtgtnByBrkgPrimQly@ */ /end MEASUREMENT
/begin MEASUREMENT SwcOut_TOS_AEB[1].CllsnMtgtnByBrkgSecQly "" UBYTE autosar_swc_tos_CM_uint8 0 0 0 255 ECU_ADDRESS 0xfe4b0b39 /* @ECU_Address@SwcOut_TOS_AEB[1].CllsnMtgtnByBrkgSecQly@ */ /end MEASUREMENT
/begin MEASUREMENT SwcOut_TOS_AEB[1].CllsnWarnFwdQly "" UBYTE autosar_swc_tos_CM_uint8 0 0 0 255 ECU_ADDRESS 0xfe4b0b3a /* @ECU_Address@SwcOut_TOS_AEB[1].CllsnWarnFwdQly@ */ /end MEASUREMENT
/begin MEASUREMENT SwcOut_TOS_AEB[1].LeftLane_flag "" UBYTE autosar_swc_tos_CM_boolean 0 0 0 1 ECU_ADDRESS 0xfe4b0b30 /* @ECU_Address@SwcOut_TOS_AEB[1].LeftLane_flag@ */ /end MEASUREMENT
/begin MEASUREMENT SwcOut_TOS_AEB[1].Object_AX "" FLOAT32_IEEE autosar_swc_tos_CM_single 0 0 -3.4E+38 3.4E+38 ECU_ADDRESS 0xfe4b0b7c /* @ECU_Address@SwcOut_TOS_AEB[1].Object_AX@ */ /end MEASUREMENT
/begin MEASUREMENT SwcOut_TOS_AEB[1].Object_AY "" FLOAT32_IEEE autosar_swc_tos_CM_single 0 0 -3.4E+38 3.4E+38 ECU_ADDRESS 0xfe4b0b80 /* @ECU_Address@SwcOut_TOS_AEB[1].Object_AY@ */ /end MEASUREMENT
/begin MEASUREMENT SwcOut_TOS_AEB[1].Object_Abs_AX "" FLOAT32_IEEE autosar_swc_tos_CM_single 0 0 -3.4E+38 3.4E+38 ECU_ADDRESS 0xfe4b0b84 /* @ECU_Address@SwcOut_TOS_AEB[1].Object_Abs_AX@ */ /end MEASUREMENT
/begin MEASUREMENT SwcOut_TOS_AEB[1].Object_Abs_AY "" FLOAT32_IEEE autosar_swc_tos_CM_single 0 0 -3.4E+38 3.4E+38 ECU_ADDRESS 0xfe4b0b88 /* @ECU_Address@SwcOut_TOS_AEB[1].Object_Abs_AY@ */ /end MEASUREMENT
/begin MEASUREMENT SwcOut_TOS_AEB[1].Object_Abs_SPEED "" FLOAT32_IEEE autosar_swc_tos_CM_single 0 0 -3.4E+38 3.4E+38 ECU_ADDRESS 0xfe4b0b70 /* @ECU_Address@SwcOut_TOS_AEB[1].Object_Abs_SPEED@ */ /end MEASUREMENT
/begin MEASUREMENT SwcOut_TOS_AEB[1].Object_Abs_VX "" FLOAT32_IEEE autosar_swc_tos_CM_single 0 0 -3.4E+38 3.4E+38 ECU_ADDRESS 0xfe4b0b74 /* @ECU_Address@SwcOut_TOS_AEB[1].Object_Abs_VX@ */ /end MEASUREMENT
/begin MEASUREMENT SwcOut_TOS_AEB[1].Object_Abs_VY "" FLOAT32_IEEE autosar_swc_tos_CM_single 0 0 -3.4E+38 3.4E+38 ECU_ADDRESS 0xfe4b0b78 /* @ECU_Address@SwcOut_TOS_AEB[1].Object_Abs_VY@ */ /end MEASUREMENT
/begin MEASUREMENT SwcOut_TOS_AEB[1].Object_Age "" A_UINT64 autosar_swc_tos_CM_uint64 0 0 0 18446744073709551615 ECU_ADDRESS 0xfe4b0bb8 /* @ECU_Address@SwcOut_TOS_AEB[1].Object_Age@ */ /end MEASUREMENT
/begin MEASUREMENT SwcOut_TOS_AEB[1].Object_DX "" FLOAT32_IEEE autosar_swc_tos_CM_single 0 0 -3.4E+38 3.4E+38 ECU_ADDRESS 0xfe4b0b58 /* @ECU_Address@SwcOut_TOS_AEB[1].Object_DX@ */ /end MEASUREMENT
/begin MEASUREMENT SwcOut_TOS_AEB[1].Object_DY "" FLOAT32_IEEE autosar_swc_tos_CM_single 0 0 -3.4E+38 3.4E+38 ECU_ADDRESS 0xfe4b0b5c /* @ECU_Address@SwcOut_TOS_AEB[1].Object_DY@ */ /end MEASUREMENT
/begin MEASUREMENT SwcOut_TOS_AEB[1].Object_Fus_Type "" UWORD autosar_swc_tos_CM_uint16 0 0 0 65535 ECU_ADDRESS 0xfe4b0b3c /* @ECU_Address@SwcOut_TOS_AEB[1].Object_Fus_Type@ */ /end MEASUREMENT
/begin MEASUREMENT SwcOut_TOS_AEB[1].Object_HeadingAngle "" FLOAT32_IEEE autosar_swc_tos_CM_single 0 0 -3.4E+38 3.4E+38 ECU_ADDRESS 0xfe4b0b50 /* @ECU_Address@SwcOut_TOS_AEB[1].Object_HeadingAngle@ */ /end MEASUREMENT
/begin MEASUREMENT SwcOut_TOS_AEB[1].Object_Hight "" FLOAT32_IEEE autosar_swc_tos_CM_single 0 0 -3.4E+38 3.4E+38 ECU_ADDRESS 0xfe4b0b4c /* @ECU_Address@SwcOut_TOS_AEB[1].Object_Hight@ */ /end MEASUREMENT
/begin MEASUREMENT SwcOut_TOS_AEB[1].Object_ID "" ULONG autosar_swc_tos_CM_uint32 0 0 0 4294967295 ECU_ADDRESS 0xfe4b0bac /* @ECU_Address@SwcOut_TOS_AEB[1].Object_ID@ */ /end MEASUREMENT
/begin MEASUREMENT SwcOut_TOS_AEB[1].Object_Length "" FLOAT32_IEEE autosar_swc_tos_CM_single 0 0 -3.4E+38 3.4E+38 ECU_ADDRESS 0xfe4b0b44 /* @ECU_Address@SwcOut_TOS_AEB[1].Object_Length@ */ /end MEASUREMENT
/begin MEASUREMENT SwcOut_TOS_AEB[1].Object_MovingState "" UBYTE autosar_swc_tos_CM_uint8 0 0 0 255 ECU_ADDRESS 0xfe4b0b34 /* @ECU_Address@SwcOut_TOS_AEB[1].Object_MovingState@ */ /end MEASUREMENT
/begin MEASUREMENT SwcOut_TOS_AEB[1].Object_Orientation "" UBYTE autosar_swc_tos_CM_uint8 0 0 0 255 ECU_ADDRESS 0xfe4b0b35 /* @ECU_Address@SwcOut_TOS_AEB[1].Object_Orientation@ */ /end MEASUREMENT
/begin MEASUREMENT SwcOut_TOS_AEB[1].Object_RangeX "" FLOAT32_IEEE autosar_swc_tos_CM_single 0 0 -3.4E+38 3.4E+38 ECU_ADDRESS 0xfe4b0b60 /* @ECU_Address@SwcOut_TOS_AEB[1].Object_RangeX@ */ /end MEASUREMENT
/begin MEASUREMENT SwcOut_TOS_AEB[1].Object_RangeY "" FLOAT32_IEEE autosar_swc_tos_CM_single 0 0 -3.4E+38 3.4E+38 ECU_ADDRESS 0xfe4b0b64 /* @ECU_Address@SwcOut_TOS_AEB[1].Object_RangeY@ */ /end MEASUREMENT
/begin MEASUREMENT SwcOut_TOS_AEB[1].Object_Turn_Signal "" UBYTE autosar_swc_tos_CM_uint8 0 0 0 255 ECU_ADDRESS 0xfe4b0b36 /* @ECU_Address@SwcOut_TOS_AEB[1].Object_Turn_Signal@ */ /end MEASUREMENT
/begin MEASUREMENT SwcOut_TOS_AEB[1].Object_Type "" UBYTE autosar_swc_tos_CM_uint8 0 0 0 255 ECU_ADDRESS 0xfe4b0b33 /* @ECU_Address@SwcOut_TOS_AEB[1].Object_Type@ */ /end MEASUREMENT
/begin MEASUREMENT SwcOut_TOS_AEB[1].Object_VX "" FLOAT32_IEEE autosar_swc_tos_CM_single 0 0 -3.4E+38 3.4E+38 ECU_ADDRESS 0xfe4b0b68 /* @ECU_Address@SwcOut_TOS_AEB[1].Object_VX@ */ /end MEASUREMENT
/begin MEASUREMENT SwcOut_TOS_AEB[1].Object_VY "" FLOAT32_IEEE autosar_swc_tos_CM_single 0 0 -3.4E+38 3.4E+38 ECU_ADDRESS 0xfe4b0b6c /* @ECU_Address@SwcOut_TOS_AEB[1].Object_VY@ */ /end MEASUREMENT
/begin MEASUREMENT SwcOut_TOS_AEB[1].Object_Width "" FLOAT32_IEEE autosar_swc_tos_CM_single 0 0 -3.4E+38 3.4E+38 ECU_ADDRESS 0xfe4b0b48 /* @ECU_Address@SwcOut_TOS_AEB[1].Object_Width@ */ /end MEASUREMENT
/begin MEASUREMENT SwcOut_TOS_AEB[1].Object_YawAngle "" FLOAT32_IEEE autosar_swc_tos_CM_single 0 0 -3.4E+38 3.4E+38 ECU_ADDRESS 0xfe4b0b54 /* @ECU_Address@SwcOut_TOS_AEB[1].Object_YawAngle@ */ /end MEASUREMENT
/begin MEASUREMENT SwcOut_TOS_AEB[1].RightLane_flag "" UBYTE autosar_swc_tos_CM_boolean 0 0 0 1 ECU_ADDRESS 0xfe4b0b32 /* @ECU_Address@SwcOut_TOS_AEB[1].RightLane_flag@ */ /end MEASUREMENT
/begin MEASUREMENT SwcOut_TOS_AEB[1].SameLane_flag "" UBYTE autosar_swc_tos_CM_boolean 0 0 0 1 ECU_ADDRESS 0xfe4b0b31 /* @ECU_Address@SwcOut_TOS_AEB[1].SameLane_flag@ */ /end MEASUREMENT
/begin MEASUREMENT SwcOut_TOS_AEB[1].Sceniaro_Flag "" UBYTE autosar_swc_tos_CM_uint8 0 0 0 255 ECU_ADDRESS 0xfe4b0b37 /* @ECU_Address@SwcOut_TOS_AEB[1].Sceniaro_Flag@ */ /end MEASUREMENT
/begin MEASUREMENT SwcOut_TOS_AEB[1].TimeStamp "" A_UINT64 autosar_swc_tos_CM_uint64 0 0 0 18446744073709551615 ECU_ADDRESS 0xfe4b0bc0 /* @ECU_Address@SwcOut_TOS_AEB[1].TimeStamp@ */ /end MEASUREMENT
/begin MEASUREMENT SwcOut_TOS_AEB[1].camID "" ULONG autosar_swc_tos_CM_uint32 0 0 0 4294967295 ECU_ADDRESS 0xfe4b0bb0 /* @ECU_Address@SwcOut_TOS_AEB[1].camID@ */ /end MEASUREMENT
/begin MEASUREMENT SwcOut_TOS_AEB[1].corner_left_front_x "" FLOAT32_IEEE autosar_swc_tos_CM_single 0 0 -3.4E+38 3.4E+38 ECU_ADDRESS 0xfe4b0b8c /* @ECU_Address@SwcOut_TOS_AEB[1].corner_left_front_x@ */ /end MEASUREMENT
/begin MEASUREMENT SwcOut_TOS_AEB[1].corner_left_front_y "" FLOAT32_IEEE autosar_swc_tos_CM_single 0 0 -3.4E+38 3.4E+38 ECU_ADDRESS 0xfe4b0b90 /* @ECU_Address@SwcOut_TOS_AEB[1].corner_left_front_y@ */ /end MEASUREMENT
/begin MEASUREMENT SwcOut_TOS_AEB[1].corner_left_rear_x "" FLOAT32_IEEE autosar_swc_tos_CM_single 0 0 -3.4E+38 3.4E+38 ECU_ADDRESS 0xfe4b0b9c /* @ECU_Address@SwcOut_TOS_AEB[1].corner_left_rear_x@ */ /end MEASUREMENT
/begin MEASUREMENT SwcOut_TOS_AEB[1].corner_left_rear_y "" FLOAT32_IEEE autosar_swc_tos_CM_single 0 0 -3.4E+38 3.4E+38 ECU_ADDRESS 0xfe4b0ba0 /* @ECU_Address@SwcOut_TOS_AEB[1].corner_left_rear_y@ */ /end MEASUREMENT
/begin MEASUREMENT SwcOut_TOS_AEB[1].corner_right_front_x "" FLOAT32_IEEE autosar_swc_tos_CM_single 0 0 -3.4E+38 3.4E+38 ECU_ADDRESS 0xfe4b0b94 /* @ECU_Address@SwcOut_TOS_AEB[1].corner_right_front_x@ */ /end MEASUREMENT
/begin MEASUREMENT SwcOut_TOS_AEB[1].corner_right_front_y "" FLOAT32_IEEE autosar_swc_tos_CM_single 0 0 -3.4E+38 3.4E+38 ECU_ADDRESS 0xfe4b0b98 /* @ECU_Address@SwcOut_TOS_AEB[1].corner_right_front_y@ */ /end MEASUREMENT
/begin MEASUREMENT SwcOut_TOS_AEB[1].corner_right_rear_x "" FLOAT32_IEEE autosar_swc_tos_CM_single 0 0 -3.4E+38 3.4E+38 ECU_ADDRESS 0xfe4b0ba4 /* @ECU_Address@SwcOut_TOS_AEB[1].corner_right_rear_x@ */ /end MEASUREMENT
/begin MEASUREMENT SwcOut_TOS_AEB[1].corner_right_rear_y "" FLOAT32_IEEE autosar_swc_tos_CM_single 0 0 -3.4E+38 3.4E+38 ECU_ADDRESS 0xfe4b0ba8 /* @ECU_Address@SwcOut_TOS_AEB[1].corner_right_rear_y@ */ /end MEASUREMENT
/begin MEASUREMENT SwcOut_TOS_AEB[1].pro_flag "" SLONG autosar_swc_tos_CM_int32 0 0 -2147483648 2147483647 ECU_ADDRESS 0xfe4b0b40 /* @ECU_Address@SwcOut_TOS_AEB[1].pro_flag@ */ /end MEASUREMENT
/begin MEASUREMENT SwcOut_TOS_AEB[1].ramp "" UBYTE autosar_swc_tos_CM_uint8 0 0 0 255 ECU_ADDRESS 0xfe4b0b3b /* @ECU_Address@SwcOut_TOS_AEB[1].ramp@ */ /end MEASUREMENT
/begin MEASUREMENT SwcOut_TOS_AEB[2].CllsnMtgtnByBrkgPrimQly "" UBYTE autosar_swc_tos_CM_uint8 0 0 0 255 ECU_ADDRESS 0xfe4b0bd0 /* @ECU_Address@SwcOut_TOS_AEB[2].CllsnMtgtnByBrkgPrimQly@ */ /end MEASUREMENT
/begin MEASUREMENT SwcOut_TOS_AEB[2].CllsnMtgtnByBrkgSecQly "" UBYTE autosar_swc_tos_CM_uint8 0 0 0 255 ECU_ADDRESS 0xfe4b0bd1 /* @ECU_Address@SwcOut_TOS_AEB[2].CllsnMtgtnByBrkgSecQly@ */ /end MEASUREMENT
/begin MEASUREMENT SwcOut_TOS_AEB[2].CllsnWarnFwdQly "" UBYTE autosar_swc_tos_CM_uint8 0 0 0 255 ECU_ADDRESS 0xfe4b0bd2 /* @ECU_Address@SwcOut_TOS_AEB[2].CllsnWarnFwdQly@ */ /end MEASUREMENT
/begin MEASUREMENT SwcOut_TOS_AEB[2].LeftLane_flag "" UBYTE autosar_swc_tos_CM_boolean 0 0 0 1 ECU_ADDRESS 0xfe4b0bc8 /* @ECU_Address@SwcOut_TOS_AEB[2].LeftLane_flag@ */ /end MEASUREMENT
/begin MEASUREMENT SwcOut_TOS_AEB[2].Object_AX "" FLOAT32_IEEE autosar_swc_tos_CM_single 0 0 -3.4E+38 3.4E+38 ECU_ADDRESS 0xfe4b0c14 /* @ECU_Address@SwcOut_TOS_AEB[2].Object_AX@ */ /end MEASUREMENT
/begin MEASUREMENT SwcOut_TOS_AEB[2].Object_AY "" FLOAT32_IEEE autosar_swc_tos_CM_single 0 0 -3.4E+38 3.4E+38 ECU_ADDRESS 0xfe4b0c18 /* @ECU_Address@SwcOut_TOS_AEB[2].Object_AY@ */ /end MEASUREMENT
/begin MEASUREMENT SwcOut_TOS_AEB[2].Object_Abs_AX "" FLOAT32_IEEE autosar_swc_tos_CM_single 0 0 -3.4E+38 3.4E+38 ECU_ADDRESS 0xfe4b0c1c /* @ECU_Address@SwcOut_TOS_AEB[2].Object_Abs_AX@ */ /end MEASUREMENT
/begin MEASUREMENT SwcOut_TOS_AEB[2].Object_Abs_AY "" FLOAT32_IEEE autosar_swc_tos_CM_single 0 0 -3.4E+38 3.4E+38 ECU_ADDRESS 0xfe4b0c20 /* @ECU_Address@SwcOut_TOS_AEB[2].Object_Abs_AY@ */ /end MEASUREMENT
/begin MEASUREMENT SwcOut_TOS_AEB[2].Object_Abs_SPEED "" FLOAT32_IEEE autosar_swc_tos_CM_single 0 0 -3.4E+38 3.4E+38 ECU_ADDRESS 0xfe4b0c08 /* @ECU_Address@SwcOut_TOS_AEB[2].Object_Abs_SPEED@ */ /end MEASUREMENT
/begin MEASUREMENT SwcOut_TOS_AEB[2].Object_Abs_VX "" FLOAT32_IEEE autosar_swc_tos_CM_single 0 0 -3.4E+38 3.4E+38 ECU_ADDRESS 0xfe4b0c0c /* @ECU_Address@SwcOut_TOS_AEB[2].Object_Abs_VX@ */ /end MEASUREMENT
/begin MEASUREMENT SwcOut_TOS_AEB[2].Object_Abs_VY "" FLOAT32_IEEE autosar_swc_tos_CM_single 0 0 -3.4E+38 3.4E+38 ECU_ADDRESS 0xfe4b0c10 /* @ECU_Address@SwcOut_TOS_AEB[2].Object_Abs_VY@ */ /end MEASUREMENT
/begin MEASUREMENT SwcOut_TOS_AEB[2].Object_Age "" A_UINT64 autosar_swc_tos_CM_uint64 0 0 0 18446744073709551615 ECU_ADDRESS 0xfe4b0c50 /* @ECU_Address@SwcOut_TOS_AEB[2].Object_Age@ */ /end MEASUREMENT
/begin MEASUREMENT SwcOut_TOS_AEB[2].Object_DX "" FLOAT32_IEEE autosar_swc_tos_CM_single 0 0 -3.4E+38 3.4E+38 ECU_ADDRESS 0xfe4b0bf0 /* @ECU_Address@SwcOut_TOS_AEB[2].Object_DX@ */ /end MEASUREMENT
/begin MEASUREMENT SwcOut_TOS_AEB[2].Object_DY "" FLOAT32_IEEE autosar_swc_tos_CM_single 0 0 -3.4E+38 3.4E+38 ECU_ADDRESS 0xfe4b0bf4 /* @ECU_Address@SwcOut_TOS_AEB[2].Object_DY@ */ /end MEASUREMENT
/begin MEASUREMENT SwcOut_TOS_AEB[2].Object_Fus_Type "" UWORD autosar_swc_tos_CM_uint16 0 0 0 65535 ECU_ADDRESS 0xfe4b0bd4 /* @ECU_Address@SwcOut_TOS_AEB[2].Object_Fus_Type@ */ /end MEASUREMENT
/begin MEASUREMENT SwcOut_TOS_AEB[2].Object_HeadingAngle "" FLOAT32_IEEE autosar_swc_tos_CM_single 0 0 -3.4E+38 3.4E+38 ECU_ADDRESS 0xfe4b0be8 /* @ECU_Address@SwcOut_TOS_AEB[2].Object_HeadingAngle@ */ /end MEASUREMENT
/begin MEASUREMENT SwcOut_TOS_AEB[2].Object_Hight "" FLOAT32_IEEE autosar_swc_tos_CM_single 0 0 -3.4E+38 3.4E+38 ECU_ADDRESS 0xfe4b0be4 /* @ECU_Address@SwcOut_TOS_AEB[2].Object_Hight@ */ /end MEASUREMENT
/begin MEASUREMENT SwcOut_TOS_AEB[2].Object_ID "" ULONG autosar_swc_tos_CM_uint32 0 0 0 4294967295 ECU_ADDRESS 0xfe4b0c44 /* @ECU_Address@SwcOut_TOS_AEB[2].Object_ID@ */ /end MEASUREMENT
/begin MEASUREMENT SwcOut_TOS_AEB[2].Object_Length "" FLOAT32_IEEE autosar_swc_tos_CM_single 0 0 -3.4E+38 3.4E+38 ECU_ADDRESS 0xfe4b0bdc /* @ECU_Address@SwcOut_TOS_AEB[2].Object_Length@ */ /end MEASUREMENT
/begin MEASUREMENT SwcOut_TOS_AEB[2].Object_MovingState "" UBYTE autosar_swc_tos_CM_uint8 0 0 0 255 ECU_ADDRESS 0xfe4b0bcc /* @ECU_Address@SwcOut_TOS_AEB[2].Object_MovingState@ */ /end MEASUREMENT
/begin MEASUREMENT SwcOut_TOS_AEB[2].Object_Orientation "" UBYTE autosar_swc_tos_CM_uint8 0 0 0 255 ECU_ADDRESS 0xfe4b0bcd /* @ECU_Address@SwcOut_TOS_AEB[2].Object_Orientation@ */ /end MEASUREMENT
/begin MEASUREMENT SwcOut_TOS_AEB[2].Object_RangeX "" FLOAT32_IEEE autosar_swc_tos_CM_single 0 0 -3.4E+38 3.4E+38 ECU_ADDRESS 0xfe4b0bf8 /* @ECU_Address@SwcOut_TOS_AEB[2].Object_RangeX@ */ /end MEASUREMENT
/begin MEASUREMENT SwcOut_TOS_AEB[2].Object_RangeY "" FLOAT32_IEEE autosar_swc_tos_CM_single 0 0 -3.4E+38 3.4E+38 ECU_ADDRESS 0xfe4b0bfc /* @ECU_Address@SwcOut_TOS_AEB[2].Object_RangeY@ */ /end MEASUREMENT
/begin MEASUREMENT SwcOut_TOS_AEB[2].Object_Turn_Signal "" UBYTE autosar_swc_tos_CM_uint8 0 0 0 255 ECU_ADDRESS 0xfe4b0bce /* @ECU_Address@SwcOut_TOS_AEB[2].Object_Turn_Signal@ */ /end MEASUREMENT
/begin MEASUREMENT SwcOut_TOS_AEB[2].Object_Type "" UBYTE autosar_swc_tos_CM_uint8 0 0 0 255 ECU_ADDRESS 0xfe4b0bcb /* @ECU_Address@SwcOut_TOS_AEB[2].Object_Type@ */ /end MEASUREMENT
/begin MEASUREMENT SwcOut_TOS_AEB[2].Object_VX "" FLOAT32_IEEE autosar_swc_tos_CM_single 0 0 -3.4E+38 3.4E+38 ECU_ADDRESS 0xfe4b0c00 /* @ECU_Address@SwcOut_TOS_AEB[2].Object_VX@ */ /end MEASUREMENT
/begin MEASUREMENT SwcOut_TOS_AEB[2].Object_VY "" FLOAT32_IEEE autosar_swc_tos_CM_single 0 0 -3.4E+38 3.4E+38 ECU_ADDRESS 0xfe4b0c04 /* @ECU_Address@SwcOut_TOS_AEB[2].Object_VY@ */ /end MEASUREMENT
/begin MEASUREMENT SwcOut_TOS_AEB[2].Object_Width "" FLOAT32_IEEE autosar_swc_tos_CM_single 0 0 -3.4E+38 3.4E+38 ECU_ADDRESS 0xfe4b0be0 /* @ECU_Address@SwcOut_TOS_AEB[2].Object_Width@ */ /end MEASUREMENT
/begin MEASUREMENT SwcOut_TOS_AEB[2].Object_YawAngle "" FLOAT32_IEEE autosar_swc_tos_CM_single 0 0 -3.4E+38 3.4E+38 ECU_ADDRESS 0xfe4b0bec /* @ECU_Address@SwcOut_TOS_AEB[2].Object_YawAngle@ */ /end MEASUREMENT
/begin MEASUREMENT SwcOut_TOS_AEB[2].RightLane_flag "" UBYTE autosar_swc_tos_CM_boolean 0 0 0 1 ECU_ADDRESS 0xfe4b0bca /* @ECU_Address@SwcOut_TOS_AEB[2].RightLane_flag@ */ /end MEASUREMENT
/begin MEASUREMENT SwcOut_TOS_AEB[2].SameLane_flag "" UBYTE autosar_swc_tos_CM_boolean 0 0 0 1 ECU_ADDRESS 0xfe4b0bc9 /* @ECU_Address@SwcOut_TOS_AEB[2].SameLane_flag@ */ /end MEASUREMENT
/begin MEASUREMENT SwcOut_TOS_AEB[2].Sceniaro_Flag "" UBYTE autosar_swc_tos_CM_uint8 0 0 0 255 ECU_ADDRESS 0xfe4b0bcf /* @ECU_Address@SwcOut_TOS_AEB[2].Sceniaro_Flag@ */ /end MEASUREMENT
/begin MEASUREMENT SwcOut_TOS_AEB[2].TimeStamp "" A_UINT64 autosar_swc_tos_CM_uint64 0 0 0 18446744073709551615 ECU_ADDRESS 0xfe4b0c58 /* @ECU_Address@SwcOut_TOS_AEB[2].TimeStamp@ */ /end MEASUREMENT
/begin MEASUREMENT SwcOut_TOS_AEB[2].camID "" ULONG autosar_swc_tos_CM_uint32 0 0 0 4294967295 ECU_ADDRESS 0xfe4b0c48 /* @ECU_Address@SwcOut_TOS_AEB[2].camID@ */ /end MEASUREMENT
/begin MEASUREMENT SwcOut_TOS_AEB[2].corner_left_front_x "" FLOAT32_IEEE autosar_swc_tos_CM_single 0 0 -3.4E+38 3.4E+38 ECU_ADDRESS 0xfe4b0c24 /* @ECU_Address@SwcOut_TOS_AEB[2].corner_left_front_x@ */ /end MEASUREMENT
/begin MEASUREMENT SwcOut_TOS_AEB[2].corner_left_front_y "" FLOAT32_IEEE autosar_swc_tos_CM_single 0 0 -3.4E+38 3.4E+38 ECU_ADDRESS 0xfe4b0c28 /* @ECU_Address@SwcOut_TOS_AEB[2].corner_left_front_y@ */ /end MEASUREMENT
/begin MEASUREMENT SwcOut_TOS_AEB[2].corner_left_rear_x "" FLOAT32_IEEE autosar_swc_tos_CM_single 0 0 -3.4E+38 3.4E+38 ECU_ADDRESS 0xfe4b0c34 /* @ECU_Address@SwcOut_TOS_AEB[2].corner_left_rear_x@ */ /end MEASUREMENT
/begin MEASUREMENT SwcOut_TOS_AEB[2].corner_left_rear_y "" FLOAT32_IEEE autosar_swc_tos_CM_single 0 0 -3.4E+38 3.4E+38 ECU_ADDRESS 0xfe4b0c38 /* @ECU_Address@SwcOut_TOS_AEB[2].corner_left_rear_y@ */ /end MEASUREMENT
/begin MEASUREMENT SwcOut_TOS_AEB[2].corner_right_front_x "" FLOAT32_IEEE autosar_swc_tos_CM_single 0 0 -3.4E+38 3.4E+38 ECU_ADDRESS 0xfe4b0c2c /* @ECU_Address@SwcOut_TOS_AEB[2].corner_right_front_x@ */ /end MEASUREMENT
/begin MEASUREMENT SwcOut_TOS_AEB[2].corner_right_front_y "" FLOAT32_IEEE autosar_swc_tos_CM_single 0 0 -3.4E+38 3.4E+38 ECU_ADDRESS 0xfe4b0c30 /* @ECU_Address@SwcOut_TOS_AEB[2].corner_right_front_y@ */ /end MEASUREMENT
/begin MEASUREMENT SwcOut_TOS_AEB[2].corner_right_rear_x "" FLOAT32_IEEE autosar_swc_tos_CM_single 0 0 -3.4E+38 3.4E+38 ECU_ADDRESS 0xfe4b0c3c /* @ECU_Address@SwcOut_TOS_AEB[2].corner_right_rear_x@ */ /end MEASUREMENT
/begin MEASUREMENT SwcOut_TOS_AEB[2].corner_right_rear_y "" FLOAT32_IEEE autosar_swc_tos_CM_single 0 0 -3.4E+38 3.4E+38 ECU_ADDRESS 0xfe4b0c40 /* @ECU_Address@SwcOut_TOS_AEB[2].corner_right_rear_y@ */ /end MEASUREMENT
/begin MEASUREMENT SwcOut_TOS_AEB[2].pro_flag "" SLONG autosar_swc_tos_CM_int32 0 0 -2147483648 2147483647 ECU_ADDRESS 0xfe4b0bd8 /* @ECU_Address@SwcOut_TOS_AEB[2].pro_flag@ */ /end MEASUREMENT
/begin MEASUREMENT SwcOut_TOS_AEB[2].ramp "" UBYTE autosar_swc_tos_CM_uint8 0 0 0 255 ECU_ADDRESS 0xfe4b0bd3 /* @ECU_Address@SwcOut_TOS_AEB[2].ramp@ */ /end MEASUREMENT
/begin MEASUREMENT SwcOut_TOS_AEB[3].CllsnMtgtnByBrkgPrimQly "" UBYTE autosar_swc_tos_CM_uint8 0 0 0 255 ECU_ADDRESS 0xfe4b0c68 /* @ECU_Address@SwcOut_TOS_AEB[3].CllsnMtgtnByBrkgPrimQly@ */ /end MEASUREMENT
/begin MEASUREMENT SwcOut_TOS_AEB[3].CllsnMtgtnByBrkgSecQly "" UBYTE autosar_swc_tos_CM_uint8 0 0 0 255 ECU_ADDRESS 0xfe4b0c69 /* @ECU_Address@SwcOut_TOS_AEB[3].CllsnMtgtnByBrkgSecQly@ */ /end MEASUREMENT
/begin MEASUREMENT SwcOut_TOS_AEB[3].CllsnWarnFwdQly "" UBYTE autosar_swc_tos_CM_uint8 0 0 0 255 ECU_ADDRESS 0xfe4b0c6a /* @ECU_Address@SwcOut_TOS_AEB[3].CllsnWarnFwdQly@ */ /end MEASUREMENT
/begin MEASUREMENT SwcOut_TOS_AEB[3].LeftLane_flag "" UBYTE autosar_swc_tos_CM_boolean 0 0 0 1 ECU_ADDRESS 0xfe4b0c60 /* @ECU_Address@SwcOut_TOS_AEB[3].LeftLane_flag@ */ /end MEASUREMENT
/begin MEASUREMENT SwcOut_TOS_AEB[3].Object_AX "" FLOAT32_IEEE autosar_swc_tos_CM_single 0 0 -3.4E+38 3.4E+38 ECU_ADDRESS 0xfe4b0cac /* @ECU_Address@SwcOut_TOS_AEB[3].Object_AX@ */ /end MEASUREMENT
/begin MEASUREMENT SwcOut_TOS_AEB[3].Object_AY "" FLOAT32_IEEE autosar_swc_tos_CM_single 0 0 -3.4E+38 3.4E+38 ECU_ADDRESS 0xfe4b0cb0 /* @ECU_Address@SwcOut_TOS_AEB[3].Object_AY@ */ /end MEASUREMENT
/begin MEASUREMENT SwcOut_TOS_AEB[3].Object_Abs_AX "" FLOAT32_IEEE autosar_swc_tos_CM_single 0 0 -3.4E+38 3.4E+38 ECU_ADDRESS 0xfe4b0cb4 /* @ECU_Address@SwcOut_TOS_AEB[3].Object_Abs_AX@ */ /end MEASUREMENT
/begin MEASUREMENT SwcOut_TOS_AEB[3].Object_Abs_AY "" FLOAT32_IEEE autosar_swc_tos_CM_single 0 0 -3.4E+38 3.4E+38 ECU_ADDRESS 0xfe4b0cb8 /* @ECU_Address@SwcOut_TOS_AEB[3].Object_Abs_AY@ */ /end MEASUREMENT
/begin MEASUREMENT SwcOut_TOS_AEB[3].Object_Abs_SPEED "" FLOAT32_IEEE autosar_swc_tos_CM_single 0 0 -3.4E+38 3.4E+38 ECU_ADDRESS 0xfe4b0ca0 /* @ECU_Address@SwcOut_TOS_AEB[3].Object_Abs_SPEED@ */ /end MEASUREMENT
/begin MEASUREMENT SwcOut_TOS_AEB[3].Object_Abs_VX "" FLOAT32_IEEE autosar_swc_tos_CM_single 0 0 -3.4E+38 3.4E+38 ECU_ADDRESS 0xfe4b0ca4 /* @ECU_Address@SwcOut_TOS_AEB[3].Object_Abs_VX@ */ /end MEASUREMENT
/begin MEASUREMENT SwcOut_TOS_AEB[3].Object_Abs_VY "" FLOAT32_IEEE autosar_swc_tos_CM_single 0 0 -3.4E+38 3.4E+38 ECU_ADDRESS 0xfe4b0ca8 /* @ECU_Address@SwcOut_TOS_AEB[3].Object_Abs_VY@ */ /end MEASUREMENT
/begin MEASUREMENT SwcOut_TOS_AEB[3].Object_Age "" A_UINT64 autosar_swc_tos_CM_uint64 0 0 0 18446744073709551615 ECU_ADDRESS 0xfe4b0ce8 /* @ECU_Address@SwcOut_TOS_AEB[3].Object_Age@ */ /end MEASUREMENT
/begin MEASUREMENT SwcOut_TOS_AEB[3].Object_DX "" FLOAT32_IEEE autosar_swc_tos_CM_single 0 0 -3.4E+38 3.4E+38 ECU_ADDRESS 0xfe4b0c88 /* @ECU_Address@SwcOut_TOS_AEB[3].Object_DX@ */ /end MEASUREMENT
/begin MEASUREMENT SwcOut_TOS_AEB[3].Object_DY "" FLOAT32_IEEE autosar_swc_tos_CM_single 0 0 -3.4E+38 3.4E+38 ECU_ADDRESS 0xfe4b0c8c /* @ECU_Address@SwcOut_TOS_AEB[3].Object_DY@ */ /end MEASUREMENT
/begin MEASUREMENT SwcOut_TOS_AEB[3].Object_Fus_Type "" UWORD autosar_swc_tos_CM_uint16 0 0 0 65535 ECU_ADDRESS 0xfe4b0c6c /* @ECU_Address@SwcOut_TOS_AEB[3].Object_Fus_Type@ */ /end MEASUREMENT
/begin MEASUREMENT SwcOut_TOS_AEB[3].Object_HeadingAngle "" FLOAT32_IEEE autosar_swc_tos_CM_single 0 0 -3.4E+38 3.4E+38 ECU_ADDRESS 0xfe4b0c80 /* @ECU_Address@SwcOut_TOS_AEB[3].Object_HeadingAngle@ */ /end MEASUREMENT
/begin MEASUREMENT SwcOut_TOS_AEB[3].Object_Hight "" FLOAT32_IEEE autosar_swc_tos_CM_single 0 0 -3.4E+38 3.4E+38 ECU_ADDRESS 0xfe4b0c7c /* @ECU_Address@SwcOut_TOS_AEB[3].Object_Hight@ */ /end MEASUREMENT
/begin MEASUREMENT SwcOut_TOS_AEB[3].Object_ID "" ULONG autosar_swc_tos_CM_uint32 0 0 0 4294967295 ECU_ADDRESS 0xfe4b0cdc /* @ECU_Address@SwcOut_TOS_AEB[3].Object_ID@ */ /end MEASUREMENT
/begin MEASUREMENT SwcOut_TOS_AEB[3].Object_Length "" FLOAT32_IEEE autosar_swc_tos_CM_single 0 0 -3.4E+38 3.4E+38 ECU_ADDRESS 0xfe4b0c74 /* @ECU_Address@SwcOut_TOS_AEB[3].Object_Length@ */ /end MEASUREMENT
/begin MEASUREMENT SwcOut_TOS_AEB[3].Object_MovingState "" UBYTE autosar_swc_tos_CM_uint8 0 0 0 255 ECU_ADDRESS 0xfe4b0c64 /* @ECU_Address@SwcOut_TOS_AEB[3].Object_MovingState@ */ /end MEASUREMENT
/begin MEASUREMENT SwcOut_TOS_AEB[3].Object_Orientation "" UBYTE autosar_swc_tos_CM_uint8 0 0 0 255 ECU_ADDRESS 0xfe4b0c65 /* @ECU_Address@SwcOut_TOS_AEB[3].Object_Orientation@ */ /end MEASUREMENT
/begin MEASUREMENT SwcOut_TOS_AEB[3].Object_RangeX "" FLOAT32_IEEE autosar_swc_tos_CM_single 0 0 -3.4E+38 3.4E+38 ECU_ADDRESS 0xfe4b0c90 /* @ECU_Address@SwcOut_TOS_AEB[3].Object_RangeX@ */ /end MEASUREMENT
/begin MEASUREMENT SwcOut_TOS_AEB[3].Object_RangeY "" FLOAT32_IEEE autosar_swc_tos_CM_single 0 0 -3.4E+38 3.4E+38 ECU_ADDRESS 0xfe4b0c94 /* @ECU_Address@SwcOut_TOS_AEB[3].Object_RangeY@ */ /end MEASUREMENT
/begin MEASUREMENT SwcOut_TOS_AEB[3].Object_Turn_Signal "" UBYTE autosar_swc_tos_CM_uint8 0 0 0 255 ECU_ADDRESS 0xfe4b0c66 /* @ECU_Address@SwcOut_TOS_AEB[3].Object_Turn_Signal@ */ /end MEASUREMENT
/begin MEASUREMENT SwcOut_TOS_AEB[3].Object_Type "" UBYTE autosar_swc_tos_CM_uint8 0 0 0 255 ECU_ADDRESS 0xfe4b0c63 /* @ECU_Address@SwcOut_TOS_AEB[3].Object_Type@ */ /end MEASUREMENT
/begin MEASUREMENT SwcOut_TOS_AEB[3].Object_VX "" FLOAT32_IEEE autosar_swc_tos_CM_single 0 0 -3.4E+38 3.4E+38 ECU_ADDRESS 0xfe4b0c98 /* @ECU_Address@SwcOut_TOS_AEB[3].Object_VX@ */ /end MEASUREMENT
/begin MEASUREMENT SwcOut_TOS_AEB[3].Object_VY "" FLOAT32_IEEE autosar_swc_tos_CM_single 0 0 -3.4E+38 3.4E+38 ECU_ADDRESS 0xfe4b0c9c /* @ECU_Address@SwcOut_TOS_AEB[3].Object_VY@ */ /end MEASUREMENT
/begin MEASUREMENT SwcOut_TOS_AEB[3].Object_Width "" FLOAT32_IEEE autosar_swc_tos_CM_single 0 0 -3.4E+38 3.4E+38 ECU_ADDRESS 0xfe4b0c78 /* @ECU_Address@SwcOut_TOS_AEB[3].Object_Width@ */ /end MEASUREMENT
/begin MEASUREMENT SwcOut_TOS_AEB[3].Object_YawAngle "" FLOAT32_IEEE autosar_swc_tos_CM_single 0 0 -3.4E+38 3.4E+38 ECU_ADDRESS 0xfe4b0c84 /* @ECU_Address@SwcOut_TOS_AEB[3].Object_YawAngle@ */ /end MEASUREMENT
/begin MEASUREMENT SwcOut_TOS_AEB[3].RightLane_flag "" UBYTE autosar_swc_tos_CM_boolean 0 0 0 1 ECU_ADDRESS 0xfe4b0c62 /* @ECU_Address@SwcOut_TOS_AEB[3].RightLane_flag@ */ /end MEASUREMENT
/begin MEASUREMENT SwcOut_TOS_AEB[3].SameLane_flag "" UBYTE autosar_swc_tos_CM_boolean 0 0 0 1 ECU_ADDRESS 0xfe4b0c61 /* @ECU_Address@SwcOut_TOS_AEB[3].SameLane_flag@ */ /end MEASUREMENT
/begin MEASUREMENT SwcOut_TOS_AEB[3].Sceniaro_Flag "" UBYTE autosar_swc_tos_CM_uint8 0 0 0 255 ECU_ADDRESS 0xfe4b0c67 /* @ECU_Address@SwcOut_TOS_AEB[3].Sceniaro_Flag@ */ /end MEASUREMENT
/begin MEASUREMENT SwcOut_TOS_AEB[3].TimeStamp "" A_UINT64 autosar_swc_tos_CM_uint64 0 0 0 18446744073709551615 ECU_ADDRESS 0xfe4b0cf0 /* @ECU_Address@SwcOut_TOS_AEB[3].TimeStamp@ */ /end MEASUREMENT
/begin MEASUREMENT SwcOut_TOS_AEB[3].camID "" ULONG autosar_swc_tos_CM_uint32 0 0 0 4294967295 ECU_ADDRESS 0xfe4b0ce0 /* @ECU_Address@SwcOut_TOS_AEB[3].camID@ */ /end MEASUREMENT
/begin MEASUREMENT SwcOut_TOS_AEB[3].corner_left_front_x "" FLOAT32_IEEE autosar_swc_tos_CM_single 0 0 -3.4E+38 3.4E+38 ECU_ADDRESS 0xfe4b0cbc /* @ECU_Address@SwcOut_TOS_AEB[3].corner_left_front_x@ */ /end MEASUREMENT
/begin MEASUREMENT SwcOut_TOS_AEB[3].corner_left_front_y "" FLOAT32_IEEE autosar_swc_tos_CM_single 0 0 -3.4E+38 3.4E+38 ECU_ADDRESS 0xfe4b0cc0 /* @ECU_Address@SwcOut_TOS_AEB[3].corner_left_front_y@ */ /end MEASUREMENT
/begin MEASUREMENT SwcOut_TOS_AEB[3].corner_left_rear_x "" FLOAT32_IEEE autosar_swc_tos_CM_single 0 0 -3.4E+38 3.4E+38 ECU_ADDRESS 0xfe4b0ccc /* @ECU_Address@SwcOut_TOS_AEB[3].corner_left_rear_x@ */ /end MEASUREMENT
/begin MEASUREMENT SwcOut_TOS_AEB[3].corner_left_rear_y "" FLOAT32_IEEE autosar_swc_tos_CM_single 0 0 -3.4E+38 3.4E+38 ECU_ADDRESS 0xfe4b0cd0 /* @ECU_Address@SwcOut_TOS_AEB[3].corner_left_rear_y@ */ /end MEASUREMENT
/begin MEASUREMENT SwcOut_TOS_AEB[3].corner_right_front_x "" FLOAT32_IEEE autosar_swc_tos_CM_single 0 0 -3.4E+38 3.4E+38 ECU_ADDRESS 0xfe4b0cc4 /* @ECU_Address@SwcOut_TOS_AEB[3].corner_right_front_x@ */ /end MEASUREMENT
/begin MEASUREMENT SwcOut_TOS_AEB[3].corner_right_front_y "" FLOAT32_IEEE autosar_swc_tos_CM_single 0 0 -3.4E+38 3.4E+38 ECU_ADDRESS 0xfe4b0cc8 /* @ECU_Address@SwcOut_TOS_AEB[3].corner_right_front_y@ */ /end MEASUREMENT
/begin MEASUREMENT SwcOut_TOS_AEB[3].corner_right_rear_x "" FLOAT32_IEEE autosar_swc_tos_CM_single 0 0 -3.4E+38 3.4E+38 ECU_ADDRESS 0xfe4b0cd4 /* @ECU_Address@SwcOut_TOS_AEB[3].corner_right_rear_x@ */ /end MEASUREMENT
/begin MEASUREMENT SwcOut_TOS_AEB[3].corner_right_rear_y "" FLOAT32_IEEE autosar_swc_tos_CM_single 0 0 -3.4E+38 3.4E+38 ECU_ADDRESS 0xfe4b0cd8 /* @ECU_Address@SwcOut_TOS_AEB[3].corner_right_rear_y@ */ /end MEASUREMENT
/begin MEASUREMENT SwcOut_TOS_AEB[3].pro_flag "" SLONG autosar_swc_tos_CM_int32 0 0 -2147483648 2147483647 ECU_ADDRESS 0xfe4b0c70 /* @ECU_Address@SwcOut_TOS_AEB[3].pro_flag@ */ /end MEASUREMENT
/begin MEASUREMENT SwcOut_TOS_AEB[3].ramp "" UBYTE autosar_swc_tos_CM_uint8 0 0 0 255 ECU_ADDRESS 0xfe4b0c6b /* @ECU_Address@SwcOut_TOS_AEB[3].ramp@ */ /end MEASUREMENT
/begin MEASUREMENT SwcOut_TOS_AEB[4].CllsnMtgtnByBrkgPrimQly "" UBYTE autosar_swc_tos_CM_uint8 0 0 0 255 ECU_ADDRESS 0xfe4b0d00 /* @ECU_Address@SwcOut_TOS_AEB[4].CllsnMtgtnByBrkgPrimQly@ */ /end MEASUREMENT
/begin MEASUREMENT SwcOut_TOS_AEB[4].CllsnMtgtnByBrkgSecQly "" UBYTE autosar_swc_tos_CM_uint8 0 0 0 255 ECU_ADDRESS 0xfe4b0d01 /* @ECU_Address@SwcOut_TOS_AEB[4].CllsnMtgtnByBrkgSecQly@ */ /end MEASUREMENT
/begin MEASUREMENT SwcOut_TOS_AEB[4].CllsnWarnFwdQly "" UBYTE autosar_swc_tos_CM_uint8 0 0 0 255 ECU_ADDRESS 0xfe4b0d02 /* @ECU_Address@SwcOut_TOS_AEB[4].CllsnWarnFwdQly@ */ /end MEASUREMENT
/begin MEASUREMENT SwcOut_TOS_AEB[4].LeftLane_flag "" UBYTE autosar_swc_tos_CM_boolean 0 0 0 1 ECU_ADDRESS 0xfe4b0cf8 /* @ECU_Address@SwcOut_TOS_AEB[4].LeftLane_flag@ */ /end MEASUREMENT
/begin MEASUREMENT SwcOut_TOS_AEB[4].Object_AX "" FLOAT32_IEEE autosar_swc_tos_CM_single 0 0 -3.4E+38 3.4E+38 ECU_ADDRESS 0xfe4b0d44 /* @ECU_Address@SwcOut_TOS_AEB[4].Object_AX@ */ /end MEASUREMENT
/begin MEASUREMENT SwcOut_TOS_AEB[4].Object_AY "" FLOAT32_IEEE autosar_swc_tos_CM_single 0 0 -3.4E+38 3.4E+38 ECU_ADDRESS 0xfe4b0d48 /* @ECU_Address@SwcOut_TOS_AEB[4].Object_AY@ */ /end MEASUREMENT
/begin MEASUREMENT SwcOut_TOS_AEB[4].Object_Abs_AX "" FLOAT32_IEEE autosar_swc_tos_CM_single 0 0 -3.4E+38 3.4E+38 ECU_ADDRESS 0xfe4b0d4c /* @ECU_Address@SwcOut_TOS_AEB[4].Object_Abs_AX@ */ /end MEASUREMENT
/begin MEASUREMENT SwcOut_TOS_AEB[4].Object_Abs_AY "" FLOAT32_IEEE autosar_swc_tos_CM_single 0 0 -3.4E+38 3.4E+38 ECU_ADDRESS 0xfe4b0d50 /* @ECU_Address@SwcOut_TOS_AEB[4].Object_Abs_AY@ */ /end MEASUREMENT
/begin MEASUREMENT SwcOut_TOS_AEB[4].Object_Abs_SPEED "" FLOAT32_IEEE autosar_swc_tos_CM_single 0 0 -3.4E+38 3.4E+38 ECU_ADDRESS 0xfe4b0d38 /* @ECU_Address@SwcOut_TOS_AEB[4].Object_Abs_SPEED@ */ /end MEASUREMENT
/begin MEASUREMENT SwcOut_TOS_AEB[4].Object_Abs_VX "" FLOAT32_IEEE autosar_swc_tos_CM_single 0 0 -3.4E+38 3.4E+38 ECU_ADDRESS 0xfe4b0d3c /* @ECU_Address@SwcOut_TOS_AEB[4].Object_Abs_VX@ */ /end MEASUREMENT
/begin MEASUREMENT SwcOut_TOS_AEB[4].Object_Abs_VY "" FLOAT32_IEEE autosar_swc_tos_CM_single 0 0 -3.4E+38 3.4E+38 ECU_ADDRESS 0xfe4b0d40 /* @ECU_Address@SwcOut_TOS_AEB[4].Object_Abs_VY@ */ /end MEASUREMENT
/begin MEASUREMENT SwcOut_TOS_AEB[4].Object_Age "" A_UINT64 autosar_swc_tos_CM_uint64 0 0 0 18446744073709551615 ECU_ADDRESS 0xfe4b0d80 /* @ECU_Address@SwcOut_TOS_AEB[4].Object_Age@ */ /end MEASUREMENT
/begin MEASUREMENT SwcOut_TOS_AEB[4].Object_DX "" FLOAT32_IEEE autosar_swc_tos_CM_single 0 0 -3.4E+38 3.4E+38 ECU_ADDRESS 0xfe4b0d20 /* @ECU_Address@SwcOut_TOS_AEB[4].Object_DX@ */ /end MEASUREMENT
/begin MEASUREMENT SwcOut_TOS_AEB[4].Object_DY "" FLOAT32_IEEE autosar_swc_tos_CM_single 0 0 -3.4E+38 3.4E+38 ECU_ADDRESS 0xfe4b0d24 /* @ECU_Address@SwcOut_TOS_AEB[4].Object_DY@ */ /end MEASUREMENT
/begin MEASUREMENT SwcOut_TOS_AEB[4].Object_Fus_Type "" UWORD autosar_swc_tos_CM_uint16 0 0 0 65535 ECU_ADDRESS 0xfe4b0d04 /* @ECU_Address@SwcOut_TOS_AEB[4].Object_Fus_Type@ */ /end MEASUREMENT
/begin MEASUREMENT SwcOut_TOS_AEB[4].Object_HeadingAngle "" FLOAT32_IEEE autosar_swc_tos_CM_single 0 0 -3.4E+38 3.4E+38 ECU_ADDRESS 0xfe4b0d18 /* @ECU_Address@SwcOut_TOS_AEB[4].Object_HeadingAngle@ */ /end MEASUREMENT
/begin MEASUREMENT SwcOut_TOS_AEB[4].Object_Hight "" FLOAT32_IEEE autosar_swc_tos_CM_single 0 0 -3.4E+38 3.4E+38 ECU_ADDRESS 0xfe4b0d14 /* @ECU_Address@SwcOut_TOS_AEB[4].Object_Hight@ */ /end MEASUREMENT
/begin MEASUREMENT SwcOut_TOS_AEB[4].Object_ID "" ULONG autosar_swc_tos_CM_uint32 0 0 0 4294967295 ECU_ADDRESS 0xfe4b0d74 /* @ECU_Address@SwcOut_TOS_AEB[4].Object_ID@ */ /end MEASUREMENT
/begin MEASUREMENT SwcOut_TOS_AEB[4].Object_Length "" FLOAT32_IEEE autosar_swc_tos_CM_single 0 0 -3.4E+38 3.4E+38 ECU_ADDRESS 0xfe4b0d0c /* @ECU_Address@SwcOut_TOS_AEB[4].Object_Length@ */ /end MEASUREMENT
/begin MEASUREMENT SwcOut_TOS_AEB[4].Object_MovingState "" UBYTE autosar_swc_tos_CM_uint8 0 0 0 255 ECU_ADDRESS 0xfe4b0cfc /* @ECU_Address@SwcOut_TOS_AEB[4].Object_MovingState@ */ /end MEASUREMENT
/begin MEASUREMENT SwcOut_TOS_AEB[4].Object_Orientation "" UBYTE autosar_swc_tos_CM_uint8 0 0 0 255 ECU_ADDRESS 0xfe4b0cfd /* @ECU_Address@SwcOut_TOS_AEB[4].Object_Orientation@ */ /end MEASUREMENT
/begin MEASUREMENT SwcOut_TOS_AEB[4].Object_RangeX "" FLOAT32_IEEE autosar_swc_tos_CM_single 0 0 -3.4E+38 3.4E+38 ECU_ADDRESS 0xfe4b0d28 /* @ECU_Address@SwcOut_TOS_AEB[4].Object_RangeX@ */ /end MEASUREMENT
/begin MEASUREMENT SwcOut_TOS_AEB[4].Object_RangeY "" FLOAT32_IEEE autosar_swc_tos_CM_single 0 0 -3.4E+38 3.4E+38 ECU_ADDRESS 0xfe4b0d2c /* @ECU_Address@SwcOut_TOS_AEB[4].Object_RangeY@ */ /end MEASUREMENT
/begin MEASUREMENT SwcOut_TOS_AEB[4].Object_Turn_Signal "" UBYTE autosar_swc_tos_CM_uint8 0 0 0 255 ECU_ADDRESS 0xfe4b0cfe /* @ECU_Address@SwcOut_TOS_AEB[4].Object_Turn_Signal@ */ /end MEASUREMENT
/begin MEASUREMENT SwcOut_TOS_AEB[4].Object_Type "" UBYTE autosar_swc_tos_CM_uint8 0 0 0 255 ECU_ADDRESS 0xfe4b0cfb /* @ECU_Address@SwcOut_TOS_AEB[4].Object_Type@ */ /end MEASUREMENT
/begin MEASUREMENT SwcOut_TOS_AEB[4].Object_VX "" FLOAT32_IEEE autosar_swc_tos_CM_single 0 0 -3.4E+38 3.4E+38 ECU_ADDRESS 0xfe4b0d30 /* @ECU_Address@SwcOut_TOS_AEB[4].Object_VX@ */ /end MEASUREMENT
/begin MEASUREMENT SwcOut_TOS_AEB[4].Object_VY "" FLOAT32_IEEE autosar_swc_tos_CM_single 0 0 -3.4E+38 3.4E+38 ECU_ADDRESS 0xfe4b0d34 /* @ECU_Address@SwcOut_TOS_AEB[4].Object_VY@ */ /end MEASUREMENT
/begin MEASUREMENT SwcOut_TOS_AEB[4].Object_Width "" FLOAT32_IEEE autosar_swc_tos_CM_single 0 0 -3.4E+38 3.4E+38 ECU_ADDRESS 0xfe4b0d10 /* @ECU_Address@SwcOut_TOS_AEB[4].Object_Width@ */ /end MEASUREMENT
/begin MEASUREMENT SwcOut_TOS_AEB[4].Object_YawAngle "" FLOAT32_IEEE autosar_swc_tos_CM_single 0 0 -3.4E+38 3.4E+38 ECU_ADDRESS 0xfe4b0d1c /* @ECU_Address@SwcOut_TOS_AEB[4].Object_YawAngle@ */ /end MEASUREMENT
/begin MEASUREMENT SwcOut_TOS_AEB[4].RightLane_flag "" UBYTE autosar_swc_tos_CM_boolean 0 0 0 1 ECU_ADDRESS 0xfe4b0cfa /* @ECU_Address@SwcOut_TOS_AEB[4].RightLane_flag@ */ /end MEASUREMENT
/begin MEASUREMENT SwcOut_TOS_AEB[4].SameLane_flag "" UBYTE autosar_swc_tos_CM_boolean 0 0 0 1 ECU_ADDRESS 0xfe4b0cf9 /* @ECU_Address@SwcOut_TOS_AEB[4].SameLane_flag@ */ /end MEASUREMENT
/begin MEASUREMENT SwcOut_TOS_AEB[4].Sceniaro_Flag "" UBYTE autosar_swc_tos_CM_uint8 0 0 0 255 ECU_ADDRESS 0xfe4b0cff /* @ECU_Address@SwcOut_TOS_AEB[4].Sceniaro_Flag@ */ /end MEASUREMENT
/begin MEASUREMENT SwcOut_TOS_AEB[4].TimeStamp "" A_UINT64 autosar_swc_tos_CM_uint64 0 0 0 18446744073709551615 ECU_ADDRESS 0xfe4b0d88 /* @ECU_Address@SwcOut_TOS_AEB[4].TimeStamp@ */ /end MEASUREMENT
/begin MEASUREMENT SwcOut_TOS_AEB[4].camID "" ULONG autosar_swc_tos_CM_uint32 0 0 0 4294967295 ECU_ADDRESS 0xfe4b0d78 /* @ECU_Address@SwcOut_TOS_AEB[4].camID@ */ /end MEASUREMENT
/begin MEASUREMENT SwcOut_TOS_AEB[4].corner_left_front_x "" FLOAT32_IEEE autosar_swc_tos_CM_single 0 0 -3.4E+38 3.4E+38 ECU_ADDRESS 0xfe4b0d54 /* @ECU_Address@SwcOut_TOS_AEB[4].corner_left_front_x@ */ /end MEASUREMENT
/begin MEASUREMENT SwcOut_TOS_AEB[4].corner_left_front_y "" FLOAT32_IEEE autosar_swc_tos_CM_single 0 0 -3.4E+38 3.4E+38 ECU_ADDRESS 0xfe4b0d58 /* @ECU_Address@SwcOut_TOS_AEB[4].corner_left_front_y@ */ /end MEASUREMENT
/begin MEASUREMENT SwcOut_TOS_AEB[4].corner_left_rear_x "" FLOAT32_IEEE autosar_swc_tos_CM_single 0 0 -3.4E+38 3.4E+38 ECU_ADDRESS 0xfe4b0d64 /* @ECU_Address@SwcOut_TOS_AEB[4].corner_left_rear_x@ */ /end MEASUREMENT
/begin MEASUREMENT SwcOut_TOS_AEB[4].corner_left_rear_y "" FLOAT32_IEEE autosar_swc_tos_CM_single 0 0 -3.4E+38 3.4E+38 ECU_ADDRESS 0xfe4b0d68 /* @ECU_Address@SwcOut_TOS_AEB[4].corner_left_rear_y@ */ /end MEASUREMENT
/begin MEASUREMENT SwcOut_TOS_AEB[4].corner_right_front_x "" FLOAT32_IEEE autosar_swc_tos_CM_single 0 0 -3.4E+38 3.4E+38 ECU_ADDRESS 0xfe4b0d5c /* @ECU_Address@SwcOut_TOS_AEB[4].corner_right_front_x@ */ /end MEASUREMENT
/begin MEASUREMENT SwcOut_TOS_AEB[4].corner_right_front_y "" FLOAT32_IEEE autosar_swc_tos_CM_single 0 0 -3.4E+38 3.4E+38 ECU_ADDRESS 0xfe4b0d60 /* @ECU_Address@SwcOut_TOS_AEB[4].corner_right_front_y@ */ /end MEASUREMENT
/begin MEASUREMENT SwcOut_TOS_AEB[4].corner_right_rear_x "" FLOAT32_IEEE autosar_swc_tos_CM_single 0 0 -3.4E+38 3.4E+38 ECU_ADDRESS 0xfe4b0d6c /* @ECU_Address@SwcOut_TOS_AEB[4].corner_right_rear_x@ */ /end MEASUREMENT
/begin MEASUREMENT SwcOut_TOS_AEB[4].corner_right_rear_y "" FLOAT32_IEEE autosar_swc_tos_CM_single 0 0 -3.4E+38 3.4E+38 ECU_ADDRESS 0xfe4b0d70 /* @ECU_Address@SwcOut_TOS_AEB[4].corner_right_rear_y@ */ /end MEASUREMENT
/begin MEASUREMENT SwcOut_TOS_AEB[4].pro_flag "" SLONG autosar_swc_tos_CM_int32 0 0 -2147483648 2147483647 ECU_ADDRESS 0xfe4b0d08 /* @ECU_Address@SwcOut_TOS_AEB[4].pro_flag@ */ /end MEASUREMENT
/begin MEASUREMENT SwcOut_TOS_AEB[4].ramp "" UBYTE autosar_swc_tos_CM_uint8 0 0 0 255 ECU_ADDRESS 0xfe4b0d03 /* @ECU_Address@SwcOut_TOS_AEB[4].ramp@ */ /end MEASUREMENT
/begin MEASUREMENT SwcOut_TOS_AEB[5].CllsnMtgtnByBrkgPrimQly "" UBYTE autosar_swc_tos_CM_uint8 0 0 0 255 ECU_ADDRESS 0xfe4b0d98 /* @ECU_Address@SwcOut_TOS_AEB[5].CllsnMtgtnByBrkgPrimQly@ */ /end MEASUREMENT
/begin MEASUREMENT SwcOut_TOS_AEB[5].CllsnMtgtnByBrkgSecQly "" UBYTE autosar_swc_tos_CM_uint8 0 0 0 255 ECU_ADDRESS 0xfe4b0d99 /* @ECU_Address@SwcOut_TOS_AEB[5].CllsnMtgtnByBrkgSecQly@ */ /end MEASUREMENT
/begin MEASUREMENT SwcOut_TOS_AEB[5].CllsnWarnFwdQly "" UBYTE autosar_swc_tos_CM_uint8 0 0 0 255 ECU_ADDRESS 0xfe4b0d9a /* @ECU_Address@SwcOut_TOS_AEB[5].CllsnWarnFwdQly@ */ /end MEASUREMENT
/begin MEASUREMENT SwcOut_TOS_AEB[5].LeftLane_flag "" UBYTE autosar_swc_tos_CM_boolean 0 0 0 1 ECU_ADDRESS 0xfe4b0d90 /* @ECU_Address@SwcOut_TOS_AEB[5].LeftLane_flag@ */ /end MEASUREMENT
/begin MEASUREMENT SwcOut_TOS_AEB[5].Object_AX "" FLOAT32_IEEE autosar_swc_tos_CM_single 0 0 -3.4E+38 3.4E+38 ECU_ADDRESS 0xfe4b0ddc /* @ECU_Address@SwcOut_TOS_AEB[5].Object_AX@ */ /end MEASUREMENT
/begin MEASUREMENT SwcOut_TOS_AEB[5].Object_AY "" FLOAT32_IEEE autosar_swc_tos_CM_single 0 0 -3.4E+38 3.4E+38 ECU_ADDRESS 0xfe4b0de0 /* @ECU_Address@SwcOut_TOS_AEB[5].Object_AY@ */ /end MEASUREMENT
/begin MEASUREMENT SwcOut_TOS_AEB[5].Object_Abs_AX "" FLOAT32_IEEE autosar_swc_tos_CM_single 0 0 -3.4E+38 3.4E+38 ECU_ADDRESS 0xfe4b0de4 /* @ECU_Address@SwcOut_TOS_AEB[5].Object_Abs_AX@ */ /end MEASUREMENT
/begin MEASUREMENT SwcOut_TOS_AEB[5].Object_Abs_AY "" FLOAT32_IEEE autosar_swc_tos_CM_single 0 0 -3.4E+38 3.4E+38 ECU_ADDRESS 0xfe4b0de8 /* @ECU_Address@SwcOut_TOS_AEB[5].Object_Abs_AY@ */ /end MEASUREMENT
/begin MEASUREMENT SwcOut_TOS_AEB[5].Object_Abs_SPEED "" FLOAT32_IEEE autosar_swc_tos_CM_single 0 0 -3.4E+38 3.4E+38 ECU_ADDRESS 0xfe4b0dd0 /* @ECU_Address@SwcOut_TOS_AEB[5].Object_Abs_SPEED@ */ /end MEASUREMENT
/begin MEASUREMENT SwcOut_TOS_AEB[5].Object_Abs_VX "" FLOAT32_IEEE autosar_swc_tos_CM_single 0 0 -3.4E+38 3.4E+38 ECU_ADDRESS 0xfe4b0dd4 /* @ECU_Address@SwcOut_TOS_AEB[5].Object_Abs_VX@ */ /end MEASUREMENT
/begin MEASUREMENT SwcOut_TOS_AEB[5].Object_Abs_VY "" FLOAT32_IEEE autosar_swc_tos_CM_single 0 0 -3.4E+38 3.4E+38 ECU_ADDRESS 0xfe4b0dd8 /* @ECU_Address@SwcOut_TOS_AEB[5].Object_Abs_VY@ */ /end MEASUREMENT
/begin MEASUREMENT SwcOut_TOS_AEB[5].Object_Age "" A_UINT64 autosar_swc_tos_CM_uint64 0 0 0 18446744073709551615 ECU_ADDRESS 0xfe4b0e18 /* @ECU_Address@SwcOut_TOS_AEB[5].Object_Age@ */ /end MEASUREMENT
/begin MEASUREMENT SwcOut_TOS_AEB[5].Object_DX "" FLOAT32_IEEE autosar_swc_tos_CM_single 0 0 -3.4E+38 3.4E+38 ECU_ADDRESS 0xfe4b0db8 /* @ECU_Address@SwcOut_TOS_AEB[5].Object_DX@ */ /end MEASUREMENT
/begin MEASUREMENT SwcOut_TOS_AEB[5].Object_DY "" FLOAT32_IEEE autosar_swc_tos_CM_single 0 0 -3.4E+38 3.4E+38 ECU_ADDRESS 0xfe4b0dbc /* @ECU_Address@SwcOut_TOS_AEB[5].Object_DY@ */ /end MEASUREMENT
/begin MEASUREMENT SwcOut_TOS_AEB[5].Object_Fus_Type "" UWORD autosar_swc_tos_CM_uint16 0 0 0 65535 ECU_ADDRESS 0xfe4b0d9c /* @ECU_Address@SwcOut_TOS_AEB[5].Object_Fus_Type@ */ /end MEASUREMENT
/begin MEASUREMENT SwcOut_TOS_AEB[5].Object_HeadingAngle "" FLOAT32_IEEE autosar_swc_tos_CM_single 0 0 -3.4E+38 3.4E+38 ECU_ADDRESS 0xfe4b0db0 /* @ECU_Address@SwcOut_TOS_AEB[5].Object_HeadingAngle@ */ /end MEASUREMENT
/begin MEASUREMENT SwcOut_TOS_AEB[5].Object_Hight "" FLOAT32_IEEE autosar_swc_tos_CM_single 0 0 -3.4E+38 3.4E+38 ECU_ADDRESS 0xfe4b0dac /* @ECU_Address@SwcOut_TOS_AEB[5].Object_Hight@ */ /end MEASUREMENT
/begin MEASUREMENT SwcOut_TOS_AEB[5].Object_ID "" ULONG autosar_swc_tos_CM_uint32 0 0 0 4294967295 ECU_ADDRESS 0xfe4b0e0c /* @ECU_Address@SwcOut_TOS_AEB[5].Object_ID@ */ /end MEASUREMENT
/begin MEASUREMENT SwcOut_TOS_AEB[5].Object_Length "" FLOAT32_IEEE autosar_swc_tos_CM_single 0 0 -3.4E+38 3.4E+38 ECU_ADDRESS 0xfe4b0da4 /* @ECU_Address@SwcOut_TOS_AEB[5].Object_Length@ */ /end MEASUREMENT
/begin MEASUREMENT SwcOut_TOS_AEB[5].Object_MovingState "" UBYTE autosar_swc_tos_CM_uint8 0 0 0 255 ECU_ADDRESS 0xfe4b0d94 /* @ECU_Address@SwcOut_TOS_AEB[5].Object_MovingState@ */ /end MEASUREMENT
/begin MEASUREMENT SwcOut_TOS_AEB[5].Object_Orientation "" UBYTE autosar_swc_tos_CM_uint8 0 0 0 255 ECU_ADDRESS 0xfe4b0d95 /* @ECU_Address@SwcOut_TOS_AEB[5].Object_Orientation@ */ /end MEASUREMENT
/begin MEASUREMENT SwcOut_TOS_AEB[5].Object_RangeX "" FLOAT32_IEEE autosar_swc_tos_CM_single 0 0 -3.4E+38 3.4E+38 ECU_ADDRESS 0xfe4b0dc0 /* @ECU_Address@SwcOut_TOS_AEB[5].Object_RangeX@ */ /end MEASUREMENT
/begin MEASUREMENT SwcOut_TOS_AEB[5].Object_RangeY "" FLOAT32_IEEE autosar_swc_tos_CM_single 0 0 -3.4E+38 3.4E+38 ECU_ADDRESS 0xfe4b0dc4 /* @ECU_Address@SwcOut_TOS_AEB[5].Object_RangeY@ */ /end MEASUREMENT
/begin MEASUREMENT SwcOut_TOS_AEB[5].Object_Turn_Signal "" UBYTE autosar_swc_tos_CM_uint8 0 0 0 255 ECU_ADDRESS 0xfe4b0d96 /* @ECU_Address@SwcOut_TOS_AEB[5].Object_Turn_Signal@ */ /end MEASUREMENT
/begin MEASUREMENT SwcOut_TOS_AEB[5].Object_Type "" UBYTE autosar_swc_tos_CM_uint8 0 0 0 255 ECU_ADDRESS 0xfe4b0d93 /* @ECU_Address@SwcOut_TOS_AEB[5].Object_Type@ */ /end MEASUREMENT
/begin MEASUREMENT SwcOut_TOS_AEB[5].Object_VX "" FLOAT32_IEEE autosar_swc_tos_CM_single 0 0 -3.4E+38 3.4E+38 ECU_ADDRESS 0xfe4b0dc8 /* @ECU_Address@SwcOut_TOS_AEB[5].Object_VX@ */ /end MEASUREMENT
/begin MEASUREMENT SwcOut_TOS_AEB[5].Object_VY "" FLOAT32_IEEE autosar_swc_tos_CM_single 0 0 -3.4E+38 3.4E+38 ECU_ADDRESS 0xfe4b0dcc /* @ECU_Address@SwcOut_TOS_AEB[5].Object_VY@ */ /end MEASUREMENT
/begin MEASUREMENT SwcOut_TOS_AEB[5].Object_Width "" FLOAT32_IEEE autosar_swc_tos_CM_single 0 0 -3.4E+38 3.4E+38 ECU_ADDRESS 0xfe4b0da8 /* @ECU_Address@SwcOut_TOS_AEB[5].Object_Width@ */ /end MEASUREMENT
/begin MEASUREMENT SwcOut_TOS_AEB[5].Object_YawAngle "" FLOAT32_IEEE autosar_swc_tos_CM_single 0 0 -3.4E+38 3.4E+38 ECU_ADDRESS 0xfe4b0db4 /* @ECU_Address@SwcOut_TOS_AEB[5].Object_YawAngle@ */ /end MEASUREMENT
/begin MEASUREMENT SwcOut_TOS_AEB[5].RightLane_flag "" UBYTE autosar_swc_tos_CM_boolean 0 0 0 1 ECU_ADDRESS 0xfe4b0d92 /* @ECU_Address@SwcOut_TOS_AEB[5].RightLane_flag@ */ /end MEASUREMENT
/begin MEASUREMENT SwcOut_TOS_AEB[5].SameLane_flag "" UBYTE autosar_swc_tos_CM_boolean 0 0 0 1 ECU_ADDRESS 0xfe4b0d91 /* @ECU_Address@SwcOut_TOS_AEB[5].SameLane_flag@ */ /end MEASUREMENT
/begin MEASUREMENT SwcOut_TOS_AEB[5].Sceniaro_Flag "" UBYTE autosar_swc_tos_CM_uint8 0 0 0 255 ECU_ADDRESS 0xfe4b0d97 /* @ECU_Address@SwcOut_TOS_AEB[5].Sceniaro_Flag@ */ /end MEASUREMENT
/begin MEASUREMENT SwcOut_TOS_AEB[5].TimeStamp "" A_UINT64 autosar_swc_tos_CM_uint64 0 0 0 18446744073709551615 ECU_ADDRESS 0xfe4b0e20 /* @ECU_Address@SwcOut_TOS_AEB[5].TimeStamp@ */ /end MEASUREMENT
/begin MEASUREMENT SwcOut_TOS_AEB[5].camID "" ULONG autosar_swc_tos_CM_uint32 0 0 0 4294967295 ECU_ADDRESS 0xfe4b0e10 /* @ECU_Address@SwcOut_TOS_AEB[5].camID@ */ /end MEASUREMENT
/begin MEASUREMENT SwcOut_TOS_AEB[5].corner_left_front_x "" FLOAT32_IEEE autosar_swc_tos_CM_single 0 0 -3.4E+38 3.4E+38 ECU_ADDRESS 0xfe4b0dec /* @ECU_Address@SwcOut_TOS_AEB[5].corner_left_front_x@ */ /end MEASUREMENT
/begin MEASUREMENT SwcOut_TOS_AEB[5].corner_left_front_y "" FLOAT32_IEEE autosar_swc_tos_CM_single 0 0 -3.4E+38 3.4E+38 ECU_ADDRESS 0xfe4b0df0 /* @ECU_Address@SwcOut_TOS_AEB[5].corner_left_front_y@ */ /end MEASUREMENT
/begin MEASUREMENT SwcOut_TOS_AEB[5].corner_left_rear_x "" FLOAT32_IEEE autosar_swc_tos_CM_single 0 0 -3.4E+38 3.4E+38 ECU_ADDRESS 0xfe4b0dfc /* @ECU_Address@SwcOut_TOS_AEB[5].corner_left_rear_x@ */ /end MEASUREMENT
/begin MEASUREMENT SwcOut_TOS_AEB[5].corner_left_rear_y "" FLOAT32_IEEE autosar_swc_tos_CM_single 0 0 -3.4E+38 3.4E+38 ECU_ADDRESS 0xfe4b0e00 /* @ECU_Address@SwcOut_TOS_AEB[5].corner_left_rear_y@ */ /end MEASUREMENT
/begin MEASUREMENT SwcOut_TOS_AEB[5].corner_right_front_x "" FLOAT32_IEEE autosar_swc_tos_CM_single 0 0 -3.4E+38 3.4E+38 ECU_ADDRESS 0xfe4b0df4 /* @ECU_Address@SwcOut_TOS_AEB[5].corner_right_front_x@ */ /end MEASUREMENT
/begin MEASUREMENT SwcOut_TOS_AEB[5].corner_right_front_y "" FLOAT32_IEEE autosar_swc_tos_CM_single 0 0 -3.4E+38 3.4E+38 ECU_ADDRESS 0xfe4b0df8 /* @ECU_Address@SwcOut_TOS_AEB[5].corner_right_front_y@ */ /end MEASUREMENT
/begin MEASUREMENT SwcOut_TOS_AEB[5].corner_right_rear_x "" FLOAT32_IEEE autosar_swc_tos_CM_single 0 0 -3.4E+38 3.4E+38 ECU_ADDRESS 0xfe4b0e04 /* @ECU_Address@SwcOut_TOS_AEB[5].corner_right_rear_x@ */ /end MEASUREMENT
/begin MEASUREMENT SwcOut_TOS_AEB[5].corner_right_rear_y "" FLOAT32_IEEE autosar_swc_tos_CM_single 0 0 -3.4E+38 3.4E+38 ECU_ADDRESS 0xfe4b0e08 /* @ECU_Address@SwcOut_TOS_AEB[5].corner_right_rear_y@ */ /end MEASUREMENT
/begin MEASUREMENT SwcOut_TOS_AEB[5].pro_flag "" SLONG autosar_swc_tos_CM_int32 0 0 -2147483648 2147483647 ECU_ADDRESS 0xfe4b0da0 /* @ECU_Address@SwcOut_TOS_AEB[5].pro_flag@ */ /end MEASUREMENT
/begin MEASUREMENT SwcOut_TOS_AEB[5].ramp "" UBYTE autosar_swc_tos_CM_uint8 0 0 0 255 ECU_ADDRESS 0xfe4b0d9b /* @ECU_Address@SwcOut_TOS_AEB[5].ramp@ */ /end MEASUREMENT
/begin MEASUREMENT SwcOut_TOS_AEB[6].CllsnMtgtnByBrkgPrimQly "" UBYTE autosar_swc_tos_CM_uint8 0 0 0 255 ECU_ADDRESS 0xfe4b0e30 /* @ECU_Address@SwcOut_TOS_AEB[6].CllsnMtgtnByBrkgPrimQly@ */ /end MEASUREMENT
/begin MEASUREMENT SwcOut_TOS_AEB[6].CllsnMtgtnByBrkgSecQly "" UBYTE autosar_swc_tos_CM_uint8 0 0 0 255 ECU_ADDRESS 0xfe4b0e31 /* @ECU_Address@SwcOut_TOS_AEB[6].CllsnMtgtnByBrkgSecQly@ */ /end MEASUREMENT
/begin MEASUREMENT SwcOut_TOS_AEB[6].CllsnWarnFwdQly "" UBYTE autosar_swc_tos_CM_uint8 0 0 0 255 ECU_ADDRESS 0xfe4b0e32 /* @ECU_Address@SwcOut_TOS_AEB[6].CllsnWarnFwdQly@ */ /end MEASUREMENT
/begin MEASUREMENT SwcOut_TOS_AEB[6].LeftLane_flag "" UBYTE autosar_swc_tos_CM_boolean 0 0 0 1 ECU_ADDRESS 0xfe4b0e28 /* @ECU_Address@SwcOut_TOS_AEB[6].LeftLane_flag@ */ /end MEASUREMENT
/begin MEASUREMENT SwcOut_TOS_AEB[6].Object_AX "" FLOAT32_IEEE autosar_swc_tos_CM_single 0 0 -3.4E+38 3.4E+38 ECU_ADDRESS 0xfe4b0e74 /* @ECU_Address@SwcOut_TOS_AEB[6].Object_AX@ */ /end MEASUREMENT
/begin MEASUREMENT SwcOut_TOS_AEB[6].Object_AY "" FLOAT32_IEEE autosar_swc_tos_CM_single 0 0 -3.4E+38 3.4E+38 ECU_ADDRESS 0xfe4b0e78 /* @ECU_Address@SwcOut_TOS_AEB[6].Object_AY@ */ /end MEASUREMENT
/begin MEASUREMENT SwcOut_TOS_AEB[6].Object_Abs_AX "" FLOAT32_IEEE autosar_swc_tos_CM_single 0 0 -3.4E+38 3.4E+38 ECU_ADDRESS 0xfe4b0e7c /* @ECU_Address@SwcOut_TOS_AEB[6].Object_Abs_AX@ */ /end MEASUREMENT
/begin MEASUREMENT SwcOut_TOS_AEB[6].Object_Abs_AY "" FLOAT32_IEEE autosar_swc_tos_CM_single 0 0 -3.4E+38 3.4E+38 ECU_ADDRESS 0xfe4b0e80 /* @ECU_Address@SwcOut_TOS_AEB[6].Object_Abs_AY@ */ /end MEASUREMENT
/begin MEASUREMENT SwcOut_TOS_AEB[6].Object_Abs_SPEED "" FLOAT32_IEEE autosar_swc_tos_CM_single 0 0 -3.4E+38 3.4E+38 ECU_ADDRESS 0xfe4b0e68 /* @ECU_Address@SwcOut_TOS_AEB[6].Object_Abs_SPEED@ */ /end MEASUREMENT
/begin MEASUREMENT SwcOut_TOS_AEB[6].Object_Abs_VX "" FLOAT32_IEEE autosar_swc_tos_CM_single 0 0 -3.4E+38 3.4E+38 ECU_ADDRESS 0xfe4b0e6c /* @ECU_Address@SwcOut_TOS_AEB[6].Object_Abs_VX@ */ /end MEASUREMENT
/begin MEASUREMENT SwcOut_TOS_AEB[6].Object_Abs_VY "" FLOAT32_IEEE autosar_swc_tos_CM_single 0 0 -3.4E+38 3.4E+38 ECU_ADDRESS 0xfe4b0e70 /* @ECU_Address@SwcOut_TOS_AEB[6].Object_Abs_VY@ */ /end MEASUREMENT
/begin MEASUREMENT SwcOut_TOS_AEB[6].Object_Age "" A_UINT64 autosar_swc_tos_CM_uint64 0 0 0 18446744073709551615 ECU_ADDRESS 0xfe4b0eb0 /* @ECU_Address@SwcOut_TOS_AEB[6].Object_Age@ */ /end MEASUREMENT
/begin MEASUREMENT SwcOut_TOS_AEB[6].Object_DX "" FLOAT32_IEEE autosar_swc_tos_CM_single 0 0 -3.4E+38 3.4E+38 ECU_ADDRESS 0xfe4b0e50 /* @ECU_Address@SwcOut_TOS_AEB[6].Object_DX@ */ /end MEASUREMENT
/begin MEASUREMENT SwcOut_TOS_AEB[6].Object_DY "" FLOAT32_IEEE autosar_swc_tos_CM_single 0 0 -3.4E+38 3.4E+38 ECU_ADDRESS 0xfe4b0e54 /* @ECU_Address@SwcOut_TOS_AEB[6].Object_DY@ */ /end MEASUREMENT
/begin MEASUREMENT SwcOut_TOS_AEB[6].Object_Fus_Type "" UWORD autosar_swc_tos_CM_uint16 0 0 0 65535 ECU_ADDRESS 0xfe4b0e34 /* @ECU_Address@SwcOut_TOS_AEB[6].Object_Fus_Type@ */ /end MEASUREMENT
/begin MEASUREMENT SwcOut_TOS_AEB[6].Object_HeadingAngle "" FLOAT32_IEEE autosar_swc_tos_CM_single 0 0 -3.4E+38 3.4E+38 ECU_ADDRESS 0xfe4b0e48 /* @ECU_Address@SwcOut_TOS_AEB[6].Object_HeadingAngle@ */ /end MEASUREMENT
/begin MEASUREMENT SwcOut_TOS_AEB[6].Object_Hight "" FLOAT32_IEEE autosar_swc_tos_CM_single 0 0 -3.4E+38 3.4E+38 ECU_ADDRESS 0xfe4b0e44 /* @ECU_Address@SwcOut_TOS_AEB[6].Object_Hight@ */ /end MEASUREMENT
/begin MEASUREMENT SwcOut_TOS_AEB[6].Object_ID "" ULONG autosar_swc_tos_CM_uint32 0 0 0 4294967295 ECU_ADDRESS 0xfe4b0ea4 /* @ECU_Address@SwcOut_TOS_AEB[6].Object_ID@ */ /end MEASUREMENT
/begin MEASUREMENT SwcOut_TOS_AEB[6].Object_Length "" FLOAT32_IEEE autosar_swc_tos_CM_single 0 0 -3.4E+38 3.4E+38 ECU_ADDRESS 0xfe4b0e3c /* @ECU_Address@SwcOut_TOS_AEB[6].Object_Length@ */ /end MEASUREMENT
/begin MEASUREMENT SwcOut_TOS_AEB[6].Object_MovingState "" UBYTE autosar_swc_tos_CM_uint8 0 0 0 255 ECU_ADDRESS 0xfe4b0e2c /* @ECU_Address@SwcOut_TOS_AEB[6].Object_MovingState@ */ /end MEASUREMENT
/begin MEASUREMENT SwcOut_TOS_AEB[6].Object_Orientation "" UBYTE autosar_swc_tos_CM_uint8 0 0 0 255 ECU_ADDRESS 0xfe4b0e2d /* @ECU_Address@SwcOut_TOS_AEB[6].Object_Orientation@ */ /end MEASUREMENT
/begin MEASUREMENT SwcOut_TOS_AEB[6].Object_RangeX "" FLOAT32_IEEE autosar_swc_tos_CM_single 0 0 -3.4E+38 3.4E+38 ECU_ADDRESS 0xfe4b0e58 /* @ECU_Address@SwcOut_TOS_AEB[6].Object_RangeX@ */ /end MEASUREMENT
/begin MEASUREMENT SwcOut_TOS_AEB[6].Object_RangeY "" FLOAT32_IEEE autosar_swc_tos_CM_single 0 0 -3.4E+38 3.4E+38 ECU_ADDRESS 0xfe4b0e5c /* @ECU_Address@SwcOut_TOS_AEB[6].Object_RangeY@ */ /end MEASUREMENT
/begin MEASUREMENT SwcOut_TOS_AEB[6].Object_Turn_Signal "" UBYTE autosar_swc_tos_CM_uint8 0 0 0 255 ECU_ADDRESS 0xfe4b0e2e /* @ECU_Address@SwcOut_TOS_AEB[6].Object_Turn_Signal@ */ /end MEASUREMENT
/begin MEASUREMENT SwcOut_TOS_AEB[6].Object_Type "" UBYTE autosar_swc_tos_CM_uint8 0 0 0 255 ECU_ADDRESS 0xfe4b0e2b /* @ECU_Address@SwcOut_TOS_AEB[6].Object_Type@ */ /end MEASUREMENT
/begin MEASUREMENT SwcOut_TOS_AEB[6].Object_VX "" FLOAT32_IEEE autosar_swc_tos_CM_single 0 0 -3.4E+38 3.4E+38 ECU_ADDRESS 0xfe4b0e60 /* @ECU_Address@SwcOut_TOS_AEB[6].Object_VX@ */ /end MEASUREMENT
/begin MEASUREMENT SwcOut_TOS_AEB[6].Object_VY "" FLOAT32_IEEE autosar_swc_tos_CM_single 0 0 -3.4E+38 3.4E+38 ECU_ADDRESS 0xfe4b0e64 /* @ECU_Address@SwcOut_TOS_AEB[6].Object_VY@ */ /end MEASUREMENT
/begin MEASUREMENT SwcOut_TOS_AEB[6].Object_Width "" FLOAT32_IEEE autosar_swc_tos_CM_single 0 0 -3.4E+38 3.4E+38 ECU_ADDRESS 0xfe4b0e40 /* @ECU_Address@SwcOut_TOS_AEB[6].Object_Width@ */ /end MEASUREMENT
/begin MEASUREMENT SwcOut_TOS_AEB[6].Object_YawAngle "" FLOAT32_IEEE autosar_swc_tos_CM_single 0 0 -3.4E+38 3.4E+38 ECU_ADDRESS 0xfe4b0e4c /* @ECU_Address@SwcOut_TOS_AEB[6].Object_YawAngle@ */ /end MEASUREMENT
/begin MEASUREMENT SwcOut_TOS_AEB[6].RightLane_flag "" UBYTE autosar_swc_tos_CM_boolean 0 0 0 1 ECU_ADDRESS 0xfe4b0e2a /* @ECU_Address@SwcOut_TOS_AEB[6].RightLane_flag@ */ /end MEASUREMENT
/begin MEASUREMENT SwcOut_TOS_AEB[6].SameLane_flag "" UBYTE autosar_swc_tos_CM_boolean 0 0 0 1 ECU_ADDRESS 0xfe4b0e29 /* @ECU_Address@SwcOut_TOS_AEB[6].SameLane_flag@ */ /end MEASUREMENT
/begin MEASUREMENT SwcOut_TOS_AEB[6].Sceniaro_Flag "" UBYTE autosar_swc_tos_CM_uint8 0 0 0 255 ECU_ADDRESS 0xfe4b0e2f /* @ECU_Address@SwcOut_TOS_AEB[6].Sceniaro_Flag@ */ /end MEASUREMENT
/begin MEASUREMENT SwcOut_TOS_AEB[6].TimeStamp "" A_UINT64 autosar_swc_tos_CM_uint64 0 0 0 18446744073709551615 ECU_ADDRESS 0xfe4b0eb8 /* @ECU_Address@SwcOut_TOS_AEB[6].TimeStamp@ */ /end MEASUREMENT
/begin MEASUREMENT SwcOut_TOS_AEB[6].camID "" ULONG autosar_swc_tos_CM_uint32 0 0 0 4294967295 ECU_ADDRESS 0xfe4b0ea8 /* @ECU_Address@SwcOut_TOS_AEB[6].camID@ */ /end MEASUREMENT
/begin MEASUREMENT SwcOut_TOS_AEB[6].corner_left_front_x "" FLOAT32_IEEE autosar_swc_tos_CM_single 0 0 -3.4E+38 3.4E+38 ECU_ADDRESS 0xfe4b0e84 /* @ECU_Address@SwcOut_TOS_AEB[6].corner_left_front_x@ */ /end MEASUREMENT
/begin MEASUREMENT SwcOut_TOS_AEB[6].corner_left_front_y "" FLOAT32_IEEE autosar_swc_tos_CM_single 0 0 -3.4E+38 3.4E+38 ECU_ADDRESS 0xfe4b0e88 /* @ECU_Address@SwcOut_TOS_AEB[6].corner_left_front_y@ */ /end MEASUREMENT
/begin MEASUREMENT SwcOut_TOS_AEB[6].corner_left_rear_x "" FLOAT32_IEEE autosar_swc_tos_CM_single 0 0 -3.4E+38 3.4E+38 ECU_ADDRESS 0xfe4b0e94 /* @ECU_Address@SwcOut_TOS_AEB[6].corner_left_rear_x@ */ /end MEASUREMENT
/begin MEASUREMENT SwcOut_TOS_AEB[6].corner_left_rear_y "" FLOAT32_IEEE autosar_swc_tos_CM_single 0 0 -3.4E+38 3.4E+38 ECU_ADDRESS 0xfe4b0e98 /* @ECU_Address@SwcOut_TOS_AEB[6].corner_left_rear_y@ */ /end MEASUREMENT
/begin MEASUREMENT SwcOut_TOS_AEB[6].corner_right_front_x "" FLOAT32_IEEE autosar_swc_tos_CM_single 0 0 -3.4E+38 3.4E+38 ECU_ADDRESS 0xfe4b0e8c /* @ECU_Address@SwcOut_TOS_AEB[6].corner_right_front_x@ */ /end MEASUREMENT
/begin MEASUREMENT SwcOut_TOS_AEB[6].corner_right_front_y "" FLOAT32_IEEE autosar_swc_tos_CM_single 0 0 -3.4E+38 3.4E+38 ECU_ADDRESS 0xfe4b0e90 /* @ECU_Address@SwcOut_TOS_AEB[6].corner_right_front_y@ */ /end MEASUREMENT
/begin MEASUREMENT SwcOut_TOS_AEB[6].corner_right_rear_x "" FLOAT32_IEEE autosar_swc_tos_CM_single 0 0 -3.4E+38 3.4E+38 ECU_ADDRESS 0xfe4b0e9c /* @ECU_Address@SwcOut_TOS_AEB[6].corner_right_rear_x@ */ /end MEASUREMENT
/begin MEASUREMENT SwcOut_TOS_AEB[6].corner_right_rear_y "" FLOAT32_IEEE autosar_swc_tos_CM_single 0 0 -3.4E+38 3.4E+38 ECU_ADDRESS 0xfe4b0ea0 /* @ECU_Address@SwcOut_TOS_AEB[6].corner_right_rear_y@ */ /end MEASUREMENT
/begin MEASUREMENT SwcOut_TOS_AEB[6].pro_flag "" SLONG autosar_swc_tos_CM_int32 0 0 -2147483648 2147483647 ECU_ADDRESS 0xfe4b0e38 /* @ECU_Address@SwcOut_TOS_AEB[6].pro_flag@ */ /end MEASUREMENT
/begin MEASUREMENT SwcOut_TOS_AEB[6].ramp "" UBYTE autosar_swc_tos_CM_uint8 0 0 0 255 ECU_ADDRESS 0xfe4b0e33 /* @ECU_Address@SwcOut_TOS_AEB[6].ramp@ */ /end MEASUREMENT
/begin MEASUREMENT SwcOut_TOS_AEB[7].CllsnMtgtnByBrkgPrimQly "" UBYTE autosar_swc_tos_CM_uint8 0 0 0 255 ECU_ADDRESS 0xfe4b0ec8 /* @ECU_Address@SwcOut_TOS_AEB[7].CllsnMtgtnByBrkgPrimQly@ */ /end MEASUREMENT
/begin MEASUREMENT SwcOut_TOS_AEB[7].CllsnMtgtnByBrkgSecQly "" UBYTE autosar_swc_tos_CM_uint8 0 0 0 255 ECU_ADDRESS 0xfe4b0ec9 /* @ECU_Address@SwcOut_TOS_AEB[7].CllsnMtgtnByBrkgSecQly@ */ /end MEASUREMENT
/begin MEASUREMENT SwcOut_TOS_AEB[7].CllsnWarnFwdQly "" UBYTE autosar_swc_tos_CM_uint8 0 0 0 255 ECU_ADDRESS 0xfe4b0eca /* @ECU_Address@SwcOut_TOS_AEB[7].CllsnWarnFwdQly@ */ /end MEASUREMENT
/begin MEASUREMENT SwcOut_TOS_AEB[7].LeftLane_flag "" UBYTE autosar_swc_tos_CM_boolean 0 0 0 1 ECU_ADDRESS 0xfe4b0ec0 /* @ECU_Address@SwcOut_TOS_AEB[7].LeftLane_flag@ */ /end MEASUREMENT
/begin MEASUREMENT SwcOut_TOS_AEB[7].Object_AX "" FLOAT32_IEEE autosar_swc_tos_CM_single 0 0 -3.4E+38 3.4E+38 ECU_ADDRESS 0xfe4b0f0c /* @ECU_Address@SwcOut_TOS_AEB[7].Object_AX@ */ /end MEASUREMENT
/begin MEASUREMENT SwcOut_TOS_AEB[7].Object_AY "" FLOAT32_IEEE autosar_swc_tos_CM_single 0 0 -3.4E+38 3.4E+38 ECU_ADDRESS 0xfe4b0f10 /* @ECU_Address@SwcOut_TOS_AEB[7].Object_AY@ */ /end MEASUREMENT
/begin MEASUREMENT SwcOut_TOS_AEB[7].Object_Abs_AX "" FLOAT32_IEEE autosar_swc_tos_CM_single 0 0 -3.4E+38 3.4E+38 ECU_ADDRESS 0xfe4b0f14 /* @ECU_Address@SwcOut_TOS_AEB[7].Object_Abs_AX@ */ /end MEASUREMENT
/begin MEASUREMENT SwcOut_TOS_AEB[7].Object_Abs_AY "" FLOAT32_IEEE autosar_swc_tos_CM_single 0 0 -3.4E+38 3.4E+38 ECU_ADDRESS 0xfe4b0f18 /* @ECU_Address@SwcOut_TOS_AEB[7].Object_Abs_AY@ */ /end MEASUREMENT
/begin MEASUREMENT SwcOut_TOS_AEB[7].Object_Abs_SPEED "" FLOAT32_IEEE autosar_swc_tos_CM_single 0 0 -3.4E+38 3.4E+38 ECU_ADDRESS 0xfe4b0f00 /* @ECU_Address@SwcOut_TOS_AEB[7].Object_Abs_SPEED@ */ /end MEASUREMENT
/begin MEASUREMENT SwcOut_TOS_AEB[7].Object_Abs_VX "" FLOAT32_IEEE autosar_swc_tos_CM_single 0 0 -3.4E+38 3.4E+38 ECU_ADDRESS 0xfe4b0f04 /* @ECU_Address@SwcOut_TOS_AEB[7].Object_Abs_VX@ */ /end MEASUREMENT
/begin MEASUREMENT SwcOut_TOS_AEB[7].Object_Abs_VY "" FLOAT32_IEEE autosar_swc_tos_CM_single 0 0 -3.4E+38 3.4E+38 ECU_ADDRESS 0xfe4b0f08 /* @ECU_Address@SwcOut_TOS_AEB[7].Object_Abs_VY@ */ /end MEASUREMENT
/begin MEASUREMENT SwcOut_TOS_AEB[7].Object_Age "" A_UINT64 autosar_swc_tos_CM_uint64 0 0 0 18446744073709551615 ECU_ADDRESS 0xfe4b0f48 /* @ECU_Address@SwcOut_TOS_AEB[7].Object_Age@ */ /end MEASUREMENT
/begin MEASUREMENT SwcOut_TOS_AEB[7].Object_DX "" FLOAT32_IEEE autosar_swc_tos_CM_single 0 0 -3.4E+38 3.4E+38 ECU_ADDRESS 0xfe4b0ee8 /* @ECU_Address@SwcOut_TOS_AEB[7].Object_DX@ */ /end MEASUREMENT
/begin MEASUREMENT SwcOut_TOS_AEB[7].Object_DY "" FLOAT32_IEEE autosar_swc_tos_CM_single 0 0 -3.4E+38 3.4E+38 ECU_ADDRESS 0xfe4b0eec /* @ECU_Address@SwcOut_TOS_AEB[7].Object_DY@ */ /end MEASUREMENT
/begin MEASUREMENT SwcOut_TOS_AEB[7].Object_Fus_Type "" UWORD autosar_swc_tos_CM_uint16 0 0 0 65535 ECU_ADDRESS 0xfe4b0ecc /* @ECU_Address@SwcOut_TOS_AEB[7].Object_Fus_Type@ */ /end MEASUREMENT
/begin MEASUREMENT SwcOut_TOS_AEB[7].Object_HeadingAngle "" FLOAT32_IEEE autosar_swc_tos_CM_single 0 0 -3.4E+38 3.4E+38 ECU_ADDRESS 0xfe4b0ee0 /* @ECU_Address@SwcOut_TOS_AEB[7].Object_HeadingAngle@ */ /end MEASUREMENT
/begin MEASUREMENT SwcOut_TOS_AEB[7].Object_Hight "" FLOAT32_IEEE autosar_swc_tos_CM_single 0 0 -3.4E+38 3.4E+38 ECU_ADDRESS 0xfe4b0edc /* @ECU_Address@SwcOut_TOS_AEB[7].Object_Hight@ */ /end MEASUREMENT
/begin MEASUREMENT SwcOut_TOS_AEB[7].Object_ID "" ULONG autosar_swc_tos_CM_uint32 0 0 0 4294967295 ECU_ADDRESS 0xfe4b0f3c /* @ECU_Address@SwcOut_TOS_AEB[7].Object_ID@ */ /end MEASUREMENT
/begin MEASUREMENT SwcOut_TOS_AEB[7].Object_Length "" FLOAT32_IEEE autosar_swc_tos_CM_single 0 0 -3.4E+38 3.4E+38 ECU_ADDRESS 0xfe4b0ed4 /* @ECU_Address@SwcOut_TOS_AEB[7].Object_Length@ */ /end MEASUREMENT
/begin MEASUREMENT SwcOut_TOS_AEB[7].Object_MovingState "" UBYTE autosar_swc_tos_CM_uint8 0 0 0 255 ECU_ADDRESS 0xfe4b0ec4 /* @ECU_Address@SwcOut_TOS_AEB[7].Object_MovingState@ */ /end MEASUREMENT
/begin MEASUREMENT SwcOut_TOS_AEB[7].Object_Orientation "" UBYTE autosar_swc_tos_CM_uint8 0 0 0 255 ECU_ADDRESS 0xfe4b0ec5 /* @ECU_Address@SwcOut_TOS_AEB[7].Object_Orientation@ */ /end MEASUREMENT
/begin MEASUREMENT SwcOut_TOS_AEB[7].Object_RangeX "" FLOAT32_IEEE autosar_swc_tos_CM_single 0 0 -3.4E+38 3.4E+38 ECU_ADDRESS 0xfe4b0ef0 /* @ECU_Address@SwcOut_TOS_AEB[7].Object_RangeX@ */ /end MEASUREMENT
/begin MEASUREMENT SwcOut_TOS_AEB[7].Object_RangeY "" FLOAT32_IEEE autosar_swc_tos_CM_single 0 0 -3.4E+38 3.4E+38 ECU_ADDRESS 0xfe4b0ef4 /* @ECU_Address@SwcOut_TOS_AEB[7].Object_RangeY@ */ /end MEASUREMENT
/begin MEASUREMENT SwcOut_TOS_AEB[7].Object_Turn_Signal "" UBYTE autosar_swc_tos_CM_uint8 0 0 0 255 ECU_ADDRESS 0xfe4b0ec6 /* @ECU_Address@SwcOut_TOS_AEB[7].Object_Turn_Signal@ */ /end MEASUREMENT
/begin MEASUREMENT SwcOut_TOS_AEB[7].Object_Type "" UBYTE autosar_swc_tos_CM_uint8 0 0 0 255 ECU_ADDRESS 0xfe4b0ec3 /* @ECU_Address@SwcOut_TOS_AEB[7].Object_Type@ */ /end MEASUREMENT
/begin MEASUREMENT SwcOut_TOS_AEB[7].Object_VX "" FLOAT32_IEEE autosar_swc_tos_CM_single 0 0 -3.4E+38 3.4E+38 ECU_ADDRESS 0xfe4b0ef8 /* @ECU_Address@SwcOut_TOS_AEB[7].Object_VX@ */ /end MEASUREMENT
/begin MEASUREMENT SwcOut_TOS_AEB[7].Object_VY "" FLOAT32_IEEE autosar_swc_tos_CM_single 0 0 -3.4E+38 3.4E+38 ECU_ADDRESS 0xfe4b0efc /* @ECU_Address@SwcOut_TOS_AEB[7].Object_VY@ */ /end MEASUREMENT
/begin MEASUREMENT SwcOut_TOS_AEB[7].Object_Width "" FLOAT32_IEEE autosar_swc_tos_CM_single 0 0 -3.4E+38 3.4E+38 ECU_ADDRESS 0xfe4b0ed8 /* @ECU_Address@SwcOut_TOS_AEB[7].Object_Width@ */ /end MEASUREMENT
/begin MEASUREMENT SwcOut_TOS_AEB[7].Object_YawAngle "" FLOAT32_IEEE autosar_swc_tos_CM_single 0 0 -3.4E+38 3.4E+38 ECU_ADDRESS 0xfe4b0ee4 /* @ECU_Address@SwcOut_TOS_AEB[7].Object_YawAngle@ */ /end MEASUREMENT
/begin MEASUREMENT SwcOut_TOS_AEB[7].RightLane_flag "" UBYTE autosar_swc_tos_CM_boolean 0 0 0 1 ECU_ADDRESS 0xfe4b0ec2 /* @ECU_Address@SwcOut_TOS_AEB[7].RightLane_flag@ */ /end MEASUREMENT
/begin MEASUREMENT SwcOut_TOS_AEB[7].SameLane_flag "" UBYTE autosar_swc_tos_CM_boolean 0 0 0 1 ECU_ADDRESS 0xfe4b0ec1 /* @ECU_Address@SwcOut_TOS_AEB[7].SameLane_flag@ */ /end MEASUREMENT
/begin MEASUREMENT SwcOut_TOS_AEB[7].Sceniaro_Flag "" UBYTE autosar_swc_tos_CM_uint8 0 0 0 255 ECU_ADDRESS 0xfe4b0ec7 /* @ECU_Address@SwcOut_TOS_AEB[7].Sceniaro_Flag@ */ /end MEASUREMENT
/begin MEASUREMENT SwcOut_TOS_AEB[7].TimeStamp "" A_UINT64 autosar_swc_tos_CM_uint64 0 0 0 18446744073709551615 ECU_ADDRESS 0xfe4b0f50 /* @ECU_Address@SwcOut_TOS_AEB[7].TimeStamp@ */ /end MEASUREMENT
/begin MEASUREMENT SwcOut_TOS_AEB[7].camID "" ULONG autosar_swc_tos_CM_uint32 0 0 0 4294967295 ECU_ADDRESS 0xfe4b0f40 /* @ECU_Address@SwcOut_TOS_AEB[7].camID@ */ /end MEASUREMENT
/begin MEASUREMENT SwcOut_TOS_AEB[7].corner_left_front_x "" FLOAT32_IEEE autosar_swc_tos_CM_single 0 0 -3.4E+38 3.4E+38 ECU_ADDRESS 0xfe4b0f1c /* @ECU_Address@SwcOut_TOS_AEB[7].corner_left_front_x@ */ /end MEASUREMENT
/begin MEASUREMENT SwcOut_TOS_AEB[7].corner_left_front_y "" FLOAT32_IEEE autosar_swc_tos_CM_single 0 0 -3.4E+38 3.4E+38 ECU_ADDRESS 0xfe4b0f20 /* @ECU_Address@SwcOut_TOS_AEB[7].corner_left_front_y@ */ /end MEASUREMENT
/begin MEASUREMENT SwcOut_TOS_AEB[7].corner_left_rear_x "" FLOAT32_IEEE autosar_swc_tos_CM_single 0 0 -3.4E+38 3.4E+38 ECU_ADDRESS 0xfe4b0f2c /* @ECU_Address@SwcOut_TOS_AEB[7].corner_left_rear_x@ */ /end MEASUREMENT
/begin MEASUREMENT SwcOut_TOS_AEB[7].corner_left_rear_y "" FLOAT32_IEEE autosar_swc_tos_CM_single 0 0 -3.4E+38 3.4E+38 ECU_ADDRESS 0xfe4b0f30 /* @ECU_Address@SwcOut_TOS_AEB[7].corner_left_rear_y@ */ /end MEASUREMENT
/begin MEASUREMENT SwcOut_TOS_AEB[7].corner_right_front_x "" FLOAT32_IEEE autosar_swc_tos_CM_single 0 0 -3.4E+38 3.4E+38 ECU_ADDRESS 0xfe4b0f24 /* @ECU_Address@SwcOut_TOS_AEB[7].corner_right_front_x@ */ /end MEASUREMENT
/begin MEASUREMENT SwcOut_TOS_AEB[7].corner_right_front_y "" FLOAT32_IEEE autosar_swc_tos_CM_single 0 0 -3.4E+38 3.4E+38 ECU_ADDRESS 0xfe4b0f28 /* @ECU_Address@SwcOut_TOS_AEB[7].corner_right_front_y@ */ /end MEASUREMENT
/begin MEASUREMENT SwcOut_TOS_AEB[7].corner_right_rear_x "" FLOAT32_IEEE autosar_swc_tos_CM_single 0 0 -3.4E+38 3.4E+38 ECU_ADDRESS 0xfe4b0f34 /* @ECU_Address@SwcOut_TOS_AEB[7].corner_right_rear_x@ */ /end MEASUREMENT
/begin MEASUREMENT SwcOut_TOS_AEB[7].corner_right_rear_y "" FLOAT32_IEEE autosar_swc_tos_CM_single 0 0 -3.4E+38 3.4E+38 ECU_ADDRESS 0xfe4b0f38 /* @ECU_Address@SwcOut_TOS_AEB[7].corner_right_rear_y@ */ /end MEASUREMENT
/begin MEASUREMENT SwcOut_TOS_AEB[7].pro_flag "" SLONG autosar_swc_tos_CM_int32 0 0 -2147483648 2147483647 ECU_ADDRESS 0xfe4b0ed0 /* @ECU_Address@SwcOut_TOS_AEB[7].pro_flag@ */ /end MEASUREMENT
/begin MEASUREMENT SwcOut_TOS_AEB[7].ramp "" UBYTE autosar_swc_tos_CM_uint8 0 0 0 255 ECU_ADDRESS 0xfe4b0ecb /* @ECU_Address@SwcOut_TOS_AEB[7].ramp@ */ /end MEASUREMENT
/begin MEASUREMENT SwcOut_TOS_AEB[8].CllsnMtgtnByBrkgPrimQly "" UBYTE autosar_swc_tos_CM_uint8 0 0 0 255 ECU_ADDRESS 0xfe4b0f60 /* @ECU_Address@SwcOut_TOS_AEB[8].CllsnMtgtnByBrkgPrimQly@ */ /end MEASUREMENT
/begin MEASUREMENT SwcOut_TOS_AEB[8].CllsnMtgtnByBrkgSecQly "" UBYTE autosar_swc_tos_CM_uint8 0 0 0 255 ECU_ADDRESS 0xfe4b0f61 /* @ECU_Address@SwcOut_TOS_AEB[8].CllsnMtgtnByBrkgSecQly@ */ /end MEASUREMENT
/begin MEASUREMENT SwcOut_TOS_AEB[8].CllsnWarnFwdQly "" UBYTE autosar_swc_tos_CM_uint8 0 0 0 255 ECU_ADDRESS 0xfe4b0f62 /* @ECU_Address@SwcOut_TOS_AEB[8].CllsnWarnFwdQly@ */ /end MEASUREMENT
/begin MEASUREMENT SwcOut_TOS_AEB[8].LeftLane_flag "" UBYTE autosar_swc_tos_CM_boolean 0 0 0 1 ECU_ADDRESS 0xfe4b0f58 /* @ECU_Address@SwcOut_TOS_AEB[8].LeftLane_flag@ */ /end MEASUREMENT
/begin MEASUREMENT SwcOut_TOS_AEB[8].Object_AX "" FLOAT32_IEEE autosar_swc_tos_CM_single 0 0 -3.4E+38 3.4E+38 ECU_ADDRESS 0xfe4b0fa4 /* @ECU_Address@SwcOut_TOS_AEB[8].Object_AX@ */ /end MEASUREMENT
/begin MEASUREMENT SwcOut_TOS_AEB[8].Object_AY "" FLOAT32_IEEE autosar_swc_tos_CM_single 0 0 -3.4E+38 3.4E+38 ECU_ADDRESS 0xfe4b0fa8 /* @ECU_Address@SwcOut_TOS_AEB[8].Object_AY@ */ /end MEASUREMENT
/begin MEASUREMENT SwcOut_TOS_AEB[8].Object_Abs_AX "" FLOAT32_IEEE autosar_swc_tos_CM_single 0 0 -3.4E+38 3.4E+38 ECU_ADDRESS 0xfe4b0fac /* @ECU_Address@SwcOut_TOS_AEB[8].Object_Abs_AX@ */ /end MEASUREMENT
/begin MEASUREMENT SwcOut_TOS_AEB[8].Object_Abs_AY "" FLOAT32_IEEE autosar_swc_tos_CM_single 0 0 -3.4E+38 3.4E+38 ECU_ADDRESS 0xfe4b0fb0 /* @ECU_Address@SwcOut_TOS_AEB[8].Object_Abs_AY@ */ /end MEASUREMENT
/begin MEASUREMENT SwcOut_TOS_AEB[8].Object_Abs_SPEED "" FLOAT32_IEEE autosar_swc_tos_CM_single 0 0 -3.4E+38 3.4E+38 ECU_ADDRESS 0xfe4b0f98 /* @ECU_Address@SwcOut_TOS_AEB[8].Object_Abs_SPEED@ */ /end MEASUREMENT
/begin MEASUREMENT SwcOut_TOS_AEB[8].Object_Abs_VX "" FLOAT32_IEEE autosar_swc_tos_CM_single 0 0 -3.4E+38 3.4E+38 ECU_ADDRESS 0xfe4b0f9c /* @ECU_Address@SwcOut_TOS_AEB[8].Object_Abs_VX@ */ /end MEASUREMENT
/begin MEASUREMENT SwcOut_TOS_AEB[8].Object_Abs_VY "" FLOAT32_IEEE autosar_swc_tos_CM_single 0 0 -3.4E+38 3.4E+38 ECU_ADDRESS 0xfe4b0fa0 /* @ECU_Address@SwcOut_TOS_AEB[8].Object_Abs_VY@ */ /end MEASUREMENT
/begin MEASUREMENT SwcOut_TOS_AEB[8].Object_Age "" A_UINT64 autosar_swc_tos_CM_uint64 0 0 0 18446744073709551615 ECU_ADDRESS 0xfe4b0fe0 /* @ECU_Address@SwcOut_TOS_AEB[8].Object_Age@ */ /end MEASUREMENT
/begin MEASUREMENT SwcOut_TOS_AEB[8].Object_DX "" FLOAT32_IEEE autosar_swc_tos_CM_single 0 0 -3.4E+38 3.4E+38 ECU_ADDRESS 0xfe4b0f80 /* @ECU_Address@SwcOut_TOS_AEB[8].Object_DX@ */ /end MEASUREMENT
/begin MEASUREMENT SwcOut_TOS_AEB[8].Object_DY "" FLOAT32_IEEE autosar_swc_tos_CM_single 0 0 -3.4E+38 3.4E+38 ECU_ADDRESS 0xfe4b0f84 /* @ECU_Address@SwcOut_TOS_AEB[8].Object_DY@ */ /end MEASUREMENT
/begin MEASUREMENT SwcOut_TOS_AEB[8].Object_Fus_Type "" UWORD autosar_swc_tos_CM_uint16 0 0 0 65535 ECU_ADDRESS 0xfe4b0f64 /* @ECU_Address@SwcOut_TOS_AEB[8].Object_Fus_Type@ */ /end MEASUREMENT
/begin MEASUREMENT SwcOut_TOS_AEB[8].Object_HeadingAngle "" FLOAT32_IEEE autosar_swc_tos_CM_single 0 0 -3.4E+38 3.4E+38 ECU_ADDRESS 0xfe4b0f78 /* @ECU_Address@SwcOut_TOS_AEB[8].Object_HeadingAngle@ */ /end MEASUREMENT
/begin MEASUREMENT SwcOut_TOS_AEB[8].Object_Hight "" FLOAT32_IEEE autosar_swc_tos_CM_single 0 0 -3.4E+38 3.4E+38 ECU_ADDRESS 0xfe4b0f74 /* @ECU_Address@SwcOut_TOS_AEB[8].Object_Hight@ */ /end MEASUREMENT
/begin MEASUREMENT SwcOut_TOS_AEB[8].Object_ID "" ULONG autosar_swc_tos_CM_uint32 0 0 0 4294967295 ECU_ADDRESS 0xfe4b0fd4 /* @ECU_Address@SwcOut_TOS_AEB[8].Object_ID@ */ /end MEASUREMENT
/begin MEASUREMENT SwcOut_TOS_AEB[8].Object_Length "" FLOAT32_IEEE autosar_swc_tos_CM_single 0 0 -3.4E+38 3.4E+38 ECU_ADDRESS 0xfe4b0f6c /* @ECU_Address@SwcOut_TOS_AEB[8].Object_Length@ */ /end MEASUREMENT
/begin MEASUREMENT SwcOut_TOS_AEB[8].Object_MovingState "" UBYTE autosar_swc_tos_CM_uint8 0 0 0 255 ECU_ADDRESS 0xfe4b0f5c /* @ECU_Address@SwcOut_TOS_AEB[8].Object_MovingState@ */ /end MEASUREMENT
/begin MEASUREMENT SwcOut_TOS_AEB[8].Object_Orientation "" UBYTE autosar_swc_tos_CM_uint8 0 0 0 255 ECU_ADDRESS 0xfe4b0f5d /* @ECU_Address@SwcOut_TOS_AEB[8].Object_Orientation@ */ /end MEASUREMENT
/begin MEASUREMENT SwcOut_TOS_AEB[8].Object_RangeX "" FLOAT32_IEEE autosar_swc_tos_CM_single 0 0 -3.4E+38 3.4E+38 ECU_ADDRESS 0xfe4b0f88 /* @ECU_Address@SwcOut_TOS_AEB[8].Object_RangeX@ */ /end MEASUREMENT
/begin MEASUREMENT SwcOut_TOS_AEB[8].Object_RangeY "" FLOAT32_IEEE autosar_swc_tos_CM_single 0 0 -3.4E+38 3.4E+38 ECU_ADDRESS 0xfe4b0f8c /* @ECU_Address@SwcOut_TOS_AEB[8].Object_RangeY@ */ /end MEASUREMENT
/begin MEASUREMENT SwcOut_TOS_AEB[8].Object_Turn_Signal "" UBYTE autosar_swc_tos_CM_uint8 0 0 0 255 ECU_ADDRESS 0xfe4b0f5e /* @ECU_Address@SwcOut_TOS_AEB[8].Object_Turn_Signal@ */ /end MEASUREMENT
/begin MEASUREMENT SwcOut_TOS_AEB[8].Object_Type "" UBYTE autosar_swc_tos_CM_uint8 0 0 0 255 ECU_ADDRESS 0xfe4b0f5b /* @ECU_Address@SwcOut_TOS_AEB[8].Object_Type@ */ /end MEASUREMENT
/begin MEASUREMENT SwcOut_TOS_AEB[8].Object_VX "" FLOAT32_IEEE autosar_swc_tos_CM_single 0 0 -3.4E+38 3.4E+38 ECU_ADDRESS 0xfe4b0f90 /* @ECU_Address@SwcOut_TOS_AEB[8].Object_VX@ */ /end MEASUREMENT
/begin MEASUREMENT SwcOut_TOS_AEB[8].Object_VY "" FLOAT32_IEEE autosar_swc_tos_CM_single 0 0 -3.4E+38 3.4E+38 ECU_ADDRESS 0xfe4b0f94 /* @ECU_Address@SwcOut_TOS_AEB[8].Object_VY@ */ /end MEASUREMENT
/begin MEASUREMENT SwcOut_TOS_AEB[8].Object_Width "" FLOAT32_IEEE autosar_swc_tos_CM_single 0 0 -3.4E+38 3.4E+38 ECU_ADDRESS 0xfe4b0f70 /* @ECU_Address@SwcOut_TOS_AEB[8].Object_Width@ */ /end MEASUREMENT
/begin MEASUREMENT SwcOut_TOS_AEB[8].Object_YawAngle "" FLOAT32_IEEE autosar_swc_tos_CM_single 0 0 -3.4E+38 3.4E+38 ECU_ADDRESS 0xfe4b0f7c /* @ECU_Address@SwcOut_TOS_AEB[8].Object_YawAngle@ */ /end MEASUREMENT
/begin MEASUREMENT SwcOut_TOS_AEB[8].RightLane_flag "" UBYTE autosar_swc_tos_CM_boolean 0 0 0 1 ECU_ADDRESS 0xfe4b0f5a /* @ECU_Address@SwcOut_TOS_AEB[8].RightLane_flag@ */ /end MEASUREMENT
/begin MEASUREMENT SwcOut_TOS_AEB[8].SameLane_flag "" UBYTE autosar_swc_tos_CM_boolean 0 0 0 1 ECU_ADDRESS 0xfe4b0f59 /* @ECU_Address@SwcOut_TOS_AEB[8].SameLane_flag@ */ /end MEASUREMENT
/begin MEASUREMENT SwcOut_TOS_AEB[8].Sceniaro_Flag "" UBYTE autosar_swc_tos_CM_uint8 0 0 0 255 ECU_ADDRESS 0xfe4b0f5f /* @ECU_Address@SwcOut_TOS_AEB[8].Sceniaro_Flag@ */ /end MEASUREMENT
/begin MEASUREMENT SwcOut_TOS_AEB[8].TimeStamp "" A_UINT64 autosar_swc_tos_CM_uint64 0 0 0 18446744073709551615 ECU_ADDRESS 0xfe4b0fe8 /* @ECU_Address@SwcOut_TOS_AEB[8].TimeStamp@ */ /end MEASUREMENT
/begin MEASUREMENT SwcOut_TOS_AEB[8].camID "" ULONG autosar_swc_tos_CM_uint32 0 0 0 4294967295 ECU_ADDRESS 0xfe4b0fd8 /* @ECU_Address@SwcOut_TOS_AEB[8].camID@ */ /end MEASUREMENT
/begin MEASUREMENT SwcOut_TOS_AEB[8].corner_left_front_x "" FLOAT32_IEEE autosar_swc_tos_CM_single 0 0 -3.4E+38 3.4E+38 ECU_ADDRESS 0xfe4b0fb4 /* @ECU_Address@SwcOut_TOS_AEB[8].corner_left_front_x@ */ /end MEASUREMENT
/begin MEASUREMENT SwcOut_TOS_AEB[8].corner_left_front_y "" FLOAT32_IEEE autosar_swc_tos_CM_single 0 0 -3.4E+38 3.4E+38 ECU_ADDRESS 0xfe4b0fb8 /* @ECU_Address@SwcOut_TOS_AEB[8].corner_left_front_y@ */ /end MEASUREMENT
/begin MEASUREMENT SwcOut_TOS_AEB[8].corner_left_rear_x "" FLOAT32_IEEE autosar_swc_tos_CM_single 0 0 -3.4E+38 3.4E+38 ECU_ADDRESS 0xfe4b0fc4 /* @ECU_Address@SwcOut_TOS_AEB[8].corner_left_rear_x@ */ /end MEASUREMENT
/begin MEASUREMENT SwcOut_TOS_AEB[8].corner_left_rear_y "" FLOAT32_IEEE autosar_swc_tos_CM_single 0 0 -3.4E+38 3.4E+38 ECU_ADDRESS 0xfe4b0fc8 /* @ECU_Address@SwcOut_TOS_AEB[8].corner_left_rear_y@ */ /end MEASUREMENT
/begin MEASUREMENT SwcOut_TOS_AEB[8].corner_right_front_x "" FLOAT32_IEEE autosar_swc_tos_CM_single 0 0 -3.4E+38 3.4E+38 ECU_ADDRESS 0xfe4b0fbc /* @ECU_Address@SwcOut_TOS_AEB[8].corner_right_front_x@ */ /end MEASUREMENT
/begin MEASUREMENT SwcOut_TOS_AEB[8].corner_right_front_y "" FLOAT32_IEEE autosar_swc_tos_CM_single 0 0 -3.4E+38 3.4E+38 ECU_ADDRESS 0xfe4b0fc0 /* @ECU_Address@SwcOut_TOS_AEB[8].corner_right_front_y@ */ /end MEASUREMENT
/begin MEASUREMENT SwcOut_TOS_AEB[8].corner_right_rear_x "" FLOAT32_IEEE autosar_swc_tos_CM_single 0 0 -3.4E+38 3.4E+38 ECU_ADDRESS 0xfe4b0fcc /* @ECU_Address@SwcOut_TOS_AEB[8].corner_right_rear_x@ */ /end MEASUREMENT
/begin MEASUREMENT SwcOut_TOS_AEB[8].corner_right_rear_y "" FLOAT32_IEEE autosar_swc_tos_CM_single 0 0 -3.4E+38 3.4E+38 ECU_ADDRESS 0xfe4b0fd0 /* @ECU_Address@SwcOut_TOS_AEB[8].corner_right_rear_y@ */ /end MEASUREMENT
/begin MEASUREMENT SwcOut_TOS_AEB[8].pro_flag "" SLONG autosar_swc_tos_CM_int32 0 0 -2147483648 2147483647 ECU_ADDRESS 0xfe4b0f68 /* @ECU_Address@SwcOut_TOS_AEB[8].pro_flag@ */ /end MEASUREMENT
/begin MEASUREMENT SwcOut_TOS_AEB[8].ramp "" UBYTE autosar_swc_tos_CM_uint8 0 0 0 255 ECU_ADDRESS 0xfe4b0f63 /* @ECU_Address@SwcOut_TOS_AEB[8].ramp@ */ /end MEASUREMENT
/begin MEASUREMENT SwcOut_TOS_AEB[9].CllsnMtgtnByBrkgPrimQly "" UBYTE autosar_swc_tos_CM_uint8 0 0 0 255 ECU_ADDRESS 0xfe4b0ff8 /* @ECU_Address@SwcOut_TOS_AEB[9].CllsnMtgtnByBrkgPrimQly@ */ /end MEASUREMENT
/begin MEASUREMENT SwcOut_TOS_AEB[9].CllsnMtgtnByBrkgSecQly "" UBYTE autosar_swc_tos_CM_uint8 0 0 0 255 ECU_ADDRESS 0xfe4b0ff9 /* @ECU_Address@SwcOut_TOS_AEB[9].CllsnMtgtnByBrkgSecQly@ */ /end MEASUREMENT
/begin MEASUREMENT SwcOut_TOS_AEB[9].CllsnWarnFwdQly "" UBYTE autosar_swc_tos_CM_uint8 0 0 0 255 ECU_ADDRESS 0xfe4b0ffa /* @ECU_Address@SwcOut_TOS_AEB[9].CllsnWarnFwdQly@ */ /end MEASUREMENT
/begin MEASUREMENT SwcOut_TOS_AEB[9].LeftLane_flag "" UBYTE autosar_swc_tos_CM_boolean 0 0 0 1 ECU_ADDRESS 0xfe4b0ff0 /* @ECU_Address@SwcOut_TOS_AEB[9].LeftLane_flag@ */ /end MEASUREMENT
/begin MEASUREMENT SwcOut_TOS_AEB[9].Object_AX "" FLOAT32_IEEE autosar_swc_tos_CM_single 0 0 -3.4E+38 3.4E+38 ECU_ADDRESS 0xfe4b103c /* @ECU_Address@SwcOut_TOS_AEB[9].Object_AX@ */ /end MEASUREMENT
/begin MEASUREMENT SwcOut_TOS_AEB[9].Object_AY "" FLOAT32_IEEE autosar_swc_tos_CM_single 0 0 -3.4E+38 3.4E+38 ECU_ADDRESS 0xfe4b1040 /* @ECU_Address@SwcOut_TOS_AEB[9].Object_AY@ */ /end MEASUREMENT
/begin MEASUREMENT SwcOut_TOS_AEB[9].Object_Abs_AX "" FLOAT32_IEEE autosar_swc_tos_CM_single 0 0 -3.4E+38 3.4E+38 ECU_ADDRESS 0xfe4b1044 /* @ECU_Address@SwcOut_TOS_AEB[9].Object_Abs_AX@ */ /end MEASUREMENT
/begin MEASUREMENT SwcOut_TOS_AEB[9].Object_Abs_AY "" FLOAT32_IEEE autosar_swc_tos_CM_single 0 0 -3.4E+38 3.4E+38 ECU_ADDRESS 0xfe4b1048 /* @ECU_Address@SwcOut_TOS_AEB[9].Object_Abs_AY@ */ /end MEASUREMENT
/begin MEASUREMENT SwcOut_TOS_AEB[9].Object_Abs_SPEED "" FLOAT32_IEEE autosar_swc_tos_CM_single 0 0 -3.4E+38 3.4E+38 ECU_ADDRESS 0xfe4b1030 /* @ECU_Address@SwcOut_TOS_AEB[9].Object_Abs_SPEED@ */ /end MEASUREMENT
/begin MEASUREMENT SwcOut_TOS_AEB[9].Object_Abs_VX "" FLOAT32_IEEE autosar_swc_tos_CM_single 0 0 -3.4E+38 3.4E+38 ECU_ADDRESS 0xfe4b1034 /* @ECU_Address@SwcOut_TOS_AEB[9].Object_Abs_VX@ */ /end MEASUREMENT
/begin MEASUREMENT SwcOut_TOS_AEB[9].Object_Abs_VY "" FLOAT32_IEEE autosar_swc_tos_CM_single 0 0 -3.4E+38 3.4E+38 ECU_ADDRESS 0xfe4b1038 /* @ECU_Address@SwcOut_TOS_AEB[9].Object_Abs_VY@ */ /end MEASUREMENT
/begin MEASUREMENT SwcOut_TOS_AEB[9].Object_Age "" A_UINT64 autosar_swc_tos_CM_uint64 0 0 0 18446744073709551615 ECU_ADDRESS 0xfe4b1078 /* @ECU_Address@SwcOut_TOS_AEB[9].Object_Age@ */ /end MEASUREMENT
/begin MEASUREMENT SwcOut_TOS_AEB[9].Object_DX "" FLOAT32_IEEE autosar_swc_tos_CM_single 0 0 -3.4E+38 3.4E+38 ECU_ADDRESS 0xfe4b1018 /* @ECU_Address@SwcOut_TOS_AEB[9].Object_DX@ */ /end MEASUREMENT
/begin MEASUREMENT SwcOut_TOS_AEB[9].Object_DY "" FLOAT32_IEEE autosar_swc_tos_CM_single 0 0 -3.4E+38 3.4E+38 ECU_ADDRESS 0xfe4b101c /* @ECU_Address@SwcOut_TOS_AEB[9].Object_DY@ */ /end MEASUREMENT
/begin MEASUREMENT SwcOut_TOS_AEB[9].Object_Fus_Type "" UWORD autosar_swc_tos_CM_uint16 0 0 0 65535 ECU_ADDRESS 0xfe4b0ffc /* @ECU_Address@SwcOut_TOS_AEB[9].Object_Fus_Type@ */ /end MEASUREMENT
/begin MEASUREMENT SwcOut_TOS_AEB[9].Object_HeadingAngle "" FLOAT32_IEEE autosar_swc_tos_CM_single 0 0 -3.4E+38 3.4E+38 ECU_ADDRESS 0xfe4b1010 /* @ECU_Address@SwcOut_TOS_AEB[9].Object_HeadingAngle@ */ /end MEASUREMENT
/begin MEASUREMENT SwcOut_TOS_AEB[9].Object_Hight "" FLOAT32_IEEE autosar_swc_tos_CM_single 0 0 -3.4E+38 3.4E+38 ECU_ADDRESS 0xfe4b100c /* @ECU_Address@SwcOut_TOS_AEB[9].Object_Hight@ */ /end MEASUREMENT
/begin MEASUREMENT SwcOut_TOS_AEB[9].Object_ID "" ULONG autosar_swc_tos_CM_uint32 0 0 0 4294967295 ECU_ADDRESS 0xfe4b106c /* @ECU_Address@SwcOut_TOS_AEB[9].Object_ID@ */ /end MEASUREMENT
/begin MEASUREMENT SwcOut_TOS_AEB[9].Object_Length "" FLOAT32_IEEE autosar_swc_tos_CM_single 0 0 -3.4E+38 3.4E+38 ECU_ADDRESS 0xfe4b1004 /* @ECU_Address@SwcOut_TOS_AEB[9].Object_Length@ */ /end MEASUREMENT
/begin MEASUREMENT SwcOut_TOS_AEB[9].Object_MovingState "" UBYTE autosar_swc_tos_CM_uint8 0 0 0 255 ECU_ADDRESS 0xfe4b0ff4 /* @ECU_Address@SwcOut_TOS_AEB[9].Object_MovingState@ */ /end MEASUREMENT
/begin MEASUREMENT SwcOut_TOS_AEB[9].Object_Orientation "" UBYTE autosar_swc_tos_CM_uint8 0 0 0 255 ECU_ADDRESS 0xfe4b0ff5 /* @ECU_Address@SwcOut_TOS_AEB[9].Object_Orientation@ */ /end MEASUREMENT
/begin MEASUREMENT SwcOut_TOS_AEB[9].Object_RangeX "" FLOAT32_IEEE autosar_swc_tos_CM_single 0 0 -3.4E+38 3.4E+38 ECU_ADDRESS 0xfe4b1020 /* @ECU_Address@SwcOut_TOS_AEB[9].Object_RangeX@ */ /end MEASUREMENT
/begin MEASUREMENT SwcOut_TOS_AEB[9].Object_RangeY "" FLOAT32_IEEE autosar_swc_tos_CM_single 0 0 -3.4E+38 3.4E+38 ECU_ADDRESS 0xfe4b1024 /* @ECU_Address@SwcOut_TOS_AEB[9].Object_RangeY@ */ /end MEASUREMENT
/begin MEASUREMENT SwcOut_TOS_AEB[9].Object_Turn_Signal "" UBYTE autosar_swc_tos_CM_uint8 0 0 0 255 ECU_ADDRESS 0xfe4b0ff6 /* @ECU_Address@SwcOut_TOS_AEB[9].Object_Turn_Signal@ */ /end MEASUREMENT
/begin MEASUREMENT SwcOut_TOS_AEB[9].Object_Type "" UBYTE autosar_swc_tos_CM_uint8 0 0 0 255 ECU_ADDRESS 0xfe4b0ff3 /* @ECU_Address@SwcOut_TOS_AEB[9].Object_Type@ */ /end MEASUREMENT
/begin MEASUREMENT SwcOut_TOS_AEB[9].Object_VX "" FLOAT32_IEEE autosar_swc_tos_CM_single 0 0 -3.4E+38 3.4E+38 ECU_ADDRESS 0xfe4b1028 /* @ECU_Address@SwcOut_TOS_AEB[9].Object_VX@ */ /end MEASUREMENT
/begin MEASUREMENT SwcOut_TOS_AEB[9].Object_VY "" FLOAT32_IEEE autosar_swc_tos_CM_single 0 0 -3.4E+38 3.4E+38 ECU_ADDRESS 0xfe4b102c /* @ECU_Address@SwcOut_TOS_AEB[9].Object_VY@ */ /end MEASUREMENT
/begin MEASUREMENT SwcOut_TOS_AEB[9].Object_Width "" FLOAT32_IEEE autosar_swc_tos_CM_single 0 0 -3.4E+38 3.4E+38 ECU_ADDRESS 0xfe4b1008 /* @ECU_Address@SwcOut_TOS_AEB[9].Object_Width@ */ /end MEASUREMENT
/begin MEASUREMENT SwcOut_TOS_AEB[9].Object_YawAngle "" FLOAT32_IEEE autosar_swc_tos_CM_single 0 0 -3.4E+38 3.4E+38 ECU_ADDRESS 0xfe4b1014 /* @ECU_Address@SwcOut_TOS_AEB[9].Object_YawAngle@ */ /end MEASUREMENT
/begin MEASUREMENT SwcOut_TOS_AEB[9].RightLane_flag "" UBYTE autosar_swc_tos_CM_boolean 0 0 0 1 ECU_ADDRESS 0xfe4b0ff2 /* @ECU_Address@SwcOut_TOS_AEB[9].RightLane_flag@ */ /end MEASUREMENT
/begin MEASUREMENT SwcOut_TOS_AEB[9].SameLane_flag "" UBYTE autosar_swc_tos_CM_boolean 0 0 0 1 ECU_ADDRESS 0xfe4b0ff1 /* @ECU_Address@SwcOut_TOS_AEB[9].SameLane_flag@ */ /end MEASUREMENT
/begin MEASUREMENT SwcOut_TOS_AEB[9].Sceniaro_Flag "" UBYTE autosar_swc_tos_CM_uint8 0 0 0 255 ECU_ADDRESS 0xfe4b0ff7 /* @ECU_Address@SwcOut_TOS_AEB[9].Sceniaro_Flag@ */ /end MEASUREMENT
/begin MEASUREMENT SwcOut_TOS_AEB[9].TimeStamp "" A_UINT64 autosar_swc_tos_CM_uint64 0 0 0 18446744073709551615 ECU_ADDRESS 0xfe4b1080 /* @ECU_Address@SwcOut_TOS_AEB[9].TimeStamp@ */ /end MEASUREMENT
/begin MEASUREMENT SwcOut_TOS_AEB[9].camID "" ULONG autosar_swc_tos_CM_uint32 0 0 0 4294967295 ECU_ADDRESS 0xfe4b1070 /* @ECU_Address@SwcOut_TOS_AEB[9].camID@ */ /end MEASUREMENT
/begin MEASUREMENT SwcOut_TOS_AEB[9].corner_left_front_x "" FLOAT32_IEEE autosar_swc_tos_CM_single 0 0 -3.4E+38 3.4E+38 ECU_ADDRESS 0xfe4b104c /* @ECU_Address@SwcOut_TOS_AEB[9].corner_left_front_x@ */ /end MEASUREMENT
/begin MEASUREMENT SwcOut_TOS_AEB[9].corner_left_front_y "" FLOAT32_IEEE autosar_swc_tos_CM_single 0 0 -3.4E+38 3.4E+38 ECU_ADDRESS 0xfe4b1050 /* @ECU_Address@SwcOut_TOS_AEB[9].corner_left_front_y@ */ /end MEASUREMENT
/begin MEASUREMENT SwcOut_TOS_AEB[9].corner_left_rear_x "" FLOAT32_IEEE autosar_swc_tos_CM_single 0 0 -3.4E+38 3.4E+38 ECU_ADDRESS 0xfe4b105c /* @ECU_Address@SwcOut_TOS_AEB[9].corner_left_rear_x@ */ /end MEASUREMENT
/begin MEASUREMENT SwcOut_TOS_AEB[9].corner_left_rear_y "" FLOAT32_IEEE autosar_swc_tos_CM_single 0 0 -3.4E+38 3.4E+38 ECU_ADDRESS 0xfe4b1060 /* @ECU_Address@SwcOut_TOS_AEB[9].corner_left_rear_y@ */ /end MEASUREMENT
/begin MEASUREMENT SwcOut_TOS_AEB[9].corner_right_front_x "" FLOAT32_IEEE autosar_swc_tos_CM_single 0 0 -3.4E+38 3.4E+38 ECU_ADDRESS 0xfe4b1054 /* @ECU_Address@SwcOut_TOS_AEB[9].corner_right_front_x@ */ /end MEASUREMENT
/begin MEASUREMENT SwcOut_TOS_AEB[9].corner_right_front_y "" FLOAT32_IEEE autosar_swc_tos_CM_single 0 0 -3.4E+38 3.4E+38 ECU_ADDRESS 0xfe4b1058 /* @ECU_Address@SwcOut_TOS_AEB[9].corner_right_front_y@ */ /end MEASUREMENT
/begin MEASUREMENT SwcOut_TOS_AEB[9].corner_right_rear_x "" FLOAT32_IEEE autosar_swc_tos_CM_single 0 0 -3.4E+38 3.4E+38 ECU_ADDRESS 0xfe4b1064 /* @ECU_Address@SwcOut_TOS_AEB[9].corner_right_rear_x@ */ /end MEASUREMENT
/begin MEASUREMENT SwcOut_TOS_AEB[9].corner_right_rear_y "" FLOAT32_IEEE autosar_swc_tos_CM_single 0 0 -3.4E+38 3.4E+38 ECU_ADDRESS 0xfe4b1068 /* @ECU_Address@SwcOut_TOS_AEB[9].corner_right_rear_y@ */ /end MEASUREMENT
/begin MEASUREMENT SwcOut_TOS_AEB[9].pro_flag "" SLONG autosar_swc_tos_CM_int32 0 0 -2147483648 2147483647 ECU_ADDRESS 0xfe4b1000 /* @ECU_Address@SwcOut_TOS_AEB[9].pro_flag@ */ /end MEASUREMENT
/begin MEASUREMENT SwcOut_TOS_AEB[9].ramp "" UBYTE autosar_swc_tos_CM_uint8 0 0 0 255 ECU_ADDRESS 0xfe4b0ffb /* @ECU_Address@SwcOut_TOS_AEB[9].ramp@ */ /end MEASUREMENT
/begin MEASUREMENT SwcOut_TOS_HWA.LeftLane_flag "" UBYTE autosar_swc_tos_CM_boolean 0 0 0 1 LAYOUT COLUMN_DIR MATRIX_DIM 4 ECU_ADDRESS 0xfe4b1678 /* @ECU_Address@SwcOut_TOS_HWA.LeftLane_flag@ */ /end MEASUREMENT
/begin MEASUREMENT SwcOut_TOS_HWA.Object_Abs_AX "" FLOAT32_IEEE autosar_swc_tos_CM_single 0 0 -3.4E+38 3.4E+38 LAYOUT COLUMN_DIR MATRIX_DIM 4 ECU_ADDRESS 0xfe4b174c /* @ECU_Address@SwcOut_TOS_HWA.Object_Abs_AX@ */ /end MEASUREMENT
/begin MEASUREMENT SwcOut_TOS_HWA.Object_Abs_AY "" FLOAT32_IEEE autosar_swc_tos_CM_single 0 0 -3.4E+38 3.4E+38 LAYOUT COLUMN_DIR MATRIX_DIM 4 ECU_ADDRESS 0xfe4b175c /* @ECU_Address@SwcOut_TOS_HWA.Object_Abs_AY@ */ /end MEASUREMENT
/begin MEASUREMENT SwcOut_TOS_HWA.Object_Abs_VX "" FLOAT32_IEEE autosar_swc_tos_CM_single 0 0 -3.4E+38 3.4E+38 LAYOUT COLUMN_DIR MATRIX_DIM 4 ECU_ADDRESS 0xfe4b172c /* @ECU_Address@SwcOut_TOS_HWA.Object_Abs_VX@ */ /end MEASUREMENT
/begin MEASUREMENT SwcOut_TOS_HWA.Object_Abs_VY "" FLOAT32_IEEE autosar_swc_tos_CM_single 0 0 -3.4E+38 3.4E+38 LAYOUT COLUMN_DIR MATRIX_DIM 4 ECU_ADDRESS 0xfe4b173c /* @ECU_Address@SwcOut_TOS_HWA.Object_Abs_VY@ */ /end MEASUREMENT
/begin MEASUREMENT SwcOut_TOS_HWA.Object_Age "" A_UINT64 autosar_swc_tos_CM_uint64 0 0 0 18446744073709551615 LAYOUT COLUMN_DIR MATRIX_DIM 4 ECU_ADDRESS 0xfe4b1800 /* @ECU_Address@SwcOut_TOS_HWA.Object_Age@ */ /end MEASUREMENT
/begin MEASUREMENT SwcOut_TOS_HWA.Object_DX "" FLOAT32_IEEE autosar_swc_tos_CM_single 0 0 -3.4E+38 3.4E+38 LAYOUT COLUMN_DIR MATRIX_DIM 4 ECU_ADDRESS 0xfe4b16ec /* @ECU_Address@SwcOut_TOS_HWA.Object_DX@ */ /end MEASUREMENT
/begin MEASUREMENT SwcOut_TOS_HWA.Object_DY "" FLOAT32_IEEE autosar_swc_tos_CM_single 0 0 -3.4E+38 3.4E+38 LAYOUT COLUMN_DIR MATRIX_DIM 4 ECU_ADDRESS 0xfe4b16fc /* @ECU_Address@SwcOut_TOS_HWA.Object_DY@ */ /end MEASUREMENT
/begin MEASUREMENT SwcOut_TOS_HWA.Object_Fus_Type "" UWORD autosar_swc_tos_CM_uint16 0 0 0 65535 LAYOUT COLUMN_DIR MATRIX_DIM 4 ECU_ADDRESS 0xfe4b1694 /* @ECU_Address@SwcOut_TOS_HWA.Object_Fus_Type@ */ /end MEASUREMENT
/begin MEASUREMENT SwcOut_TOS_HWA.Object_HeadingAngle "" FLOAT32_IEEE autosar_swc_tos_CM_single 0 0 -3.4E+38 3.4E+38 LAYOUT COLUMN_DIR MATRIX_DIM 4 ECU_ADDRESS 0xfe4b16cc /* @ECU_Address@SwcOut_TOS_HWA.Object_HeadingAngle@ */ /end MEASUREMENT
/begin MEASUREMENT SwcOut_TOS_HWA.Object_Hight "" FLOAT32_IEEE autosar_swc_tos_CM_single 0 0 -3.4E+38 3.4E+38 LAYOUT COLUMN_DIR MATRIX_DIM 4 ECU_ADDRESS 0xfe4b16bc /* @ECU_Address@SwcOut_TOS_HWA.Object_Hight@ */ /end MEASUREMENT
/begin MEASUREMENT SwcOut_TOS_HWA.Object_ID "" ULONG autosar_swc_tos_CM_uint32 0 0 0 4294967295 LAYOUT COLUMN_DIR MATRIX_DIM 4 ECU_ADDRESS 0xfe4b17ec /* @ECU_Address@SwcOut_TOS_HWA.Object_ID@ */ /end MEASUREMENT
/begin MEASUREMENT SwcOut_TOS_HWA.Object_Length "" FLOAT32_IEEE autosar_swc_tos_CM_single 0 0 -3.4E+38 3.4E+38 LAYOUT COLUMN_DIR MATRIX_DIM 4 ECU_ADDRESS 0xfe4b169c /* @ECU_Address@SwcOut_TOS_HWA.Object_Length@ */ /end MEASUREMENT
/begin MEASUREMENT SwcOut_TOS_HWA.Object_MovingState "" UBYTE autosar_swc_tos_CM_uint8 0 0 0 255 LAYOUT COLUMN_DIR MATRIX_DIM 4 ECU_ADDRESS 0xfe4b1688 /* @ECU_Address@SwcOut_TOS_HWA.Object_MovingState@ */ /end MEASUREMENT
/begin MEASUREMENT SwcOut_TOS_HWA.Object_Orientation "" UBYTE autosar_swc_tos_CM_uint8 0 0 0 255 LAYOUT COLUMN_DIR MATRIX_DIM 4 ECU_ADDRESS 0xfe4b168c /* @ECU_Address@SwcOut_TOS_HWA.Object_Orientation@ */ /end MEASUREMENT
/begin MEASUREMENT SwcOut_TOS_HWA.Object_Turn_Signal "" UBYTE autosar_swc_tos_CM_uint8 0 0 0 255 LAYOUT COLUMN_DIR MATRIX_DIM 4 ECU_ADDRESS 0xfe4b1690 /* @ECU_Address@SwcOut_TOS_HWA.Object_Turn_Signal@ */ /end MEASUREMENT
/begin MEASUREMENT SwcOut_TOS_HWA.Object_Type "" UBYTE autosar_swc_tos_CM_uint8 0 0 0 255 LAYOUT COLUMN_DIR MATRIX_DIM 4 ECU_ADDRESS 0xfe4b1684 /* @ECU_Address@SwcOut_TOS_HWA.Object_Type@ */ /end MEASUREMENT
/begin MEASUREMENT SwcOut_TOS_HWA.Object_VX "" FLOAT32_IEEE autosar_swc_tos_CM_single 0 0 -3.4E+38 3.4E+38 LAYOUT COLUMN_DIR MATRIX_DIM 4 ECU_ADDRESS 0xfe4b170c /* @ECU_Address@SwcOut_TOS_HWA.Object_VX@ */ /end MEASUREMENT
/begin MEASUREMENT SwcOut_TOS_HWA.Object_VY "" FLOAT32_IEEE autosar_swc_tos_CM_single 0 0 -3.4E+38 3.4E+38 LAYOUT COLUMN_DIR MATRIX_DIM 4 ECU_ADDRESS 0xfe4b171c /* @ECU_Address@SwcOut_TOS_HWA.Object_VY@ */ /end MEASUREMENT
/begin MEASUREMENT SwcOut_TOS_HWA.Object_Width "" FLOAT32_IEEE autosar_swc_tos_CM_single 0 0 -3.4E+38 3.4E+38 LAYOUT COLUMN_DIR MATRIX_DIM 4 ECU_ADDRESS 0xfe4b16ac /* @ECU_Address@SwcOut_TOS_HWA.Object_Width@ */ /end MEASUREMENT
/begin MEASUREMENT SwcOut_TOS_HWA.Object_YawAngle "" FLOAT32_IEEE autosar_swc_tos_CM_single 0 0 -3.4E+38 3.4E+38 LAYOUT COLUMN_DIR MATRIX_DIM 4 ECU_ADDRESS 0xfe4b16dc /* @ECU_Address@SwcOut_TOS_HWA.Object_YawAngle@ */ /end MEASUREMENT
/begin MEASUREMENT SwcOut_TOS_HWA.RightLane_flag "" UBYTE autosar_swc_tos_CM_boolean 0 0 0 1 LAYOUT COLUMN_DIR MATRIX_DIM 4 ECU_ADDRESS 0xfe4b1680 /* @ECU_Address@SwcOut_TOS_HWA.RightLane_flag@ */ /end MEASUREMENT
/begin MEASUREMENT SwcOut_TOS_HWA.SameLane_flag "" UBYTE autosar_swc_tos_CM_boolean 0 0 0 1 LAYOUT COLUMN_DIR MATRIX_DIM 4 ECU_ADDRESS 0xfe4b167c /* @ECU_Address@SwcOut_TOS_HWA.SameLane_flag@ */ /end MEASUREMENT
/begin MEASUREMENT SwcOut_TOS_HWA.corner_left_front_x "" FLOAT32_IEEE autosar_swc_tos_CM_single 0 0 -3.4E+38 3.4E+38 LAYOUT COLUMN_DIR MATRIX_DIM 4 ECU_ADDRESS 0xfe4b176c /* @ECU_Address@SwcOut_TOS_HWA.corner_left_front_x@ */ /end MEASUREMENT
/begin MEASUREMENT SwcOut_TOS_HWA.corner_left_front_y "" FLOAT32_IEEE autosar_swc_tos_CM_single 0 0 -3.4E+38 3.4E+38 LAYOUT COLUMN_DIR MATRIX_DIM 4 ECU_ADDRESS 0xfe4b177c /* @ECU_Address@SwcOut_TOS_HWA.corner_left_front_y@ */ /end MEASUREMENT
/begin MEASUREMENT SwcOut_TOS_HWA.corner_left_rear_x "" FLOAT32_IEEE autosar_swc_tos_CM_single 0 0 -3.4E+38 3.4E+38 LAYOUT COLUMN_DIR MATRIX_DIM 4 ECU_ADDRESS 0xfe4b17ac /* @ECU_Address@SwcOut_TOS_HWA.corner_left_rear_x@ */ /end MEASUREMENT
/begin MEASUREMENT SwcOut_TOS_HWA.corner_left_rear_y "" FLOAT32_IEEE autosar_swc_tos_CM_single 0 0 -3.4E+38 3.4E+38 LAYOUT COLUMN_DIR MATRIX_DIM 4 ECU_ADDRESS 0xfe4b17bc /* @ECU_Address@SwcOut_TOS_HWA.corner_left_rear_y@ */ /end MEASUREMENT
/begin MEASUREMENT SwcOut_TOS_HWA.corner_right_front_x "" FLOAT32_IEEE autosar_swc_tos_CM_single 0 0 -3.4E+38 3.4E+38 LAYOUT COLUMN_DIR MATRIX_DIM 4 ECU_ADDRESS 0xfe4b178c /* @ECU_Address@SwcOut_TOS_HWA.corner_right_front_x@ */ /end MEASUREMENT
/begin MEASUREMENT SwcOut_TOS_HWA.corner_right_front_y "" FLOAT32_IEEE autosar_swc_tos_CM_single 0 0 -3.4E+38 3.4E+38 LAYOUT COLUMN_DIR MATRIX_DIM 4 ECU_ADDRESS 0xfe4b179c /* @ECU_Address@SwcOut_TOS_HWA.corner_right_front_y@ */ /end MEASUREMENT
/begin MEASUREMENT SwcOut_TOS_HWA.corner_right_rear_x "" FLOAT32_IEEE autosar_swc_tos_CM_single 0 0 -3.4E+38 3.4E+38 LAYOUT COLUMN_DIR MATRIX_DIM 4 ECU_ADDRESS 0xfe4b17cc /* @ECU_Address@SwcOut_TOS_HWA.corner_right_rear_x@ */ /end MEASUREMENT
/begin MEASUREMENT SwcOut_TOS_HWA.corner_right_rear_y "" FLOAT32_IEEE autosar_swc_tos_CM_single 0 0 -3.4E+38 3.4E+38 LAYOUT COLUMN_DIR MATRIX_DIM 4 ECU_ADDRESS 0xfe4b17dc /* @ECU_Address@SwcOut_TOS_HWA.corner_right_rear_y@ */ /end MEASUREMENT
/begin MEASUREMENT SwcOut_TOS_Herbeat_Info.inner_error "" ULONG autosar_swc_tos_CM_uint32 0 0 0 4294967295 ECU_ADDRESS 0xfe4b46a8 /* @ECU_Address@SwcOut_TOS_Herbeat_Info.inner_error@ */ /end MEASUREMENT
/begin MEASUREMENT SwcOut_TOS_Herbeat_Info.module_status "" UBYTE autosar_swc_tos_CM_SM_MODULE_STATUS 0 0 0 3 ECU_ADDRESS 0xfe4b46ac /* @ECU_Address@SwcOut_TOS_Herbeat_Info.module_status@ */ /end MEASUREMENT
/begin MEASUREMENT SwcOut_TOS_Herbeat_Info.sequence_num "" UBYTE autosar_swc_tos_CM_uint8 0 0 0 255 ECU_ADDRESS 0xfe4b46a5 /* @ECU_Address@SwcOut_TOS_Herbeat_Info.sequence_num@ */ /end MEASUREMENT
/begin MEASUREMENT SwcOut_TOS_Herbeat_Info.swc_id "" UBYTE autosar_swc_tos_CM_uint8 0 0 0 255 ECU_ADDRESS 0xfe4b46a4 /* @ECU_Address@SwcOut_TOS_Herbeat_Info.swc_id@ */ /end MEASUREMENT
/begin MEASUREMENT SwcOut_TOS_LM_LL.dDisEnd "" FLOAT32_IEEE autosar_swc_tos_CM_single 0 0 -3.4E+38 3.4E+38 ECU_ADDRESS 0xfe4b183c /* @ECU_Address@SwcOut_TOS_LM_LL.dDisEnd@ */ /end MEASUREMENT
/begin MEASUREMENT SwcOut_TOS_LM_LL.dDisStart "" FLOAT32_IEEE autosar_swc_tos_CM_single 0 0 -3.4E+38 3.4E+38 ECU_ADDRESS 0xfe4b1838 /* @ECU_Address@SwcOut_TOS_LM_LL.dDisStart@ */ /end MEASUREMENT
/begin MEASUREMENT SwcOut_TOS_LM_LL.dQuality "" FLOAT32_IEEE autosar_swc_tos_CM_single 0 0 -3.4E+38 3.4E+38 ECU_ADDRESS 0xfe4b1840 /* @ECU_Address@SwcOut_TOS_LM_LL.dQuality@ */ /end MEASUREMENT
/begin MEASUREMENT SwcOut_TOS_LM_LL.fCamValid "" UBYTE autosar_swc_tos_CM_uint8 0 0 0 255 ECU_ADDRESS 0xfe4b1844 /* @ECU_Address@SwcOut_TOS_LM_LL.fCamValid@ */ /end MEASUREMENT
/begin MEASUREMENT SwcOut_TOS_LM_LL.pC0 "" FLOAT32_IEEE autosar_swc_tos_CM_single 0 0 -3.4E+38 3.4E+38 ECU_ADDRESS 0xfe4b1820 /* @ECU_Address@SwcOut_TOS_LM_LL.pC0@ */ /end MEASUREMENT
/begin MEASUREMENT SwcOut_TOS_LM_LL.pC1 "" FLOAT32_IEEE autosar_swc_tos_CM_single 0 0 -3.4E+38 3.4E+38 ECU_ADDRESS 0xfe4b1824 /* @ECU_Address@SwcOut_TOS_LM_LL.pC1@ */ /end MEASUREMENT
/begin MEASUREMENT SwcOut_TOS_LM_LL.pC2 "" FLOAT32_IEEE autosar_swc_tos_CM_single 0 0 -3.4E+38 3.4E+38 ECU_ADDRESS 0xfe4b1828 /* @ECU_Address@SwcOut_TOS_LM_LL.pC2@ */ /end MEASUREMENT
/begin MEASUREMENT SwcOut_TOS_LM_LL.pC3 "" FLOAT32_IEEE autosar_swc_tos_CM_single 0 0 -3.4E+38 3.4E+38 ECU_ADDRESS 0xfe4b182c /* @ECU_Address@SwcOut_TOS_LM_LL.pC3@ */ /end MEASUREMENT
/begin MEASUREMENT SwcOut_TOS_LM_LL.pC4 "" FLOAT32_IEEE autosar_swc_tos_CM_single 0 0 -3.4E+38 3.4E+38 ECU_ADDRESS 0xfe4b1830 /* @ECU_Address@SwcOut_TOS_LM_LL.pC4@ */ /end MEASUREMENT
/begin MEASUREMENT SwcOut_TOS_LM_LL.pC5 "" FLOAT32_IEEE autosar_swc_tos_CM_single 0 0 -3.4E+38 3.4E+38 ECU_ADDRESS 0xfe4b1834 /* @ECU_Address@SwcOut_TOS_LM_LL.pC5@ */ /end MEASUREMENT
/begin MEASUREMENT SwcOut_TOS_LM_LR.dDisEnd "" FLOAT32_IEEE autosar_swc_tos_CM_single 0 0 -3.4E+38 3.4E+38 ECU_ADDRESS 0xfe4b1864 /* @ECU_Address@SwcOut_TOS_LM_LR.dDisEnd@ */ /end MEASUREMENT
/begin MEASUREMENT SwcOut_TOS_LM_LR.dDisStart "" FLOAT32_IEEE autosar_swc_tos_CM_single 0 0 -3.4E+38 3.4E+38 ECU_ADDRESS 0xfe4b1860 /* @ECU_Address@SwcOut_TOS_LM_LR.dDisStart@ */ /end MEASUREMENT
/begin MEASUREMENT SwcOut_TOS_LM_LR.dQuality "" FLOAT32_IEEE autosar_swc_tos_CM_single 0 0 -3.4E+38 3.4E+38 ECU_ADDRESS 0xfe4b1868 /* @ECU_Address@SwcOut_TOS_LM_LR.dQuality@ */ /end MEASUREMENT
/begin MEASUREMENT SwcOut_TOS_LM_LR.fCamValid "" UBYTE autosar_swc_tos_CM_uint8 0 0 0 255 ECU_ADDRESS 0xfe4b186c /* @ECU_Address@SwcOut_TOS_LM_LR.fCamValid@ */ /end MEASUREMENT
/begin MEASUREMENT SwcOut_TOS_LM_LR.pC0 "" FLOAT32_IEEE autosar_swc_tos_CM_single 0 0 -3.4E+38 3.4E+38 ECU_ADDRESS 0xfe4b1848 /* @ECU_Address@SwcOut_TOS_LM_LR.pC0@ */ /end MEASUREMENT
/begin MEASUREMENT SwcOut_TOS_LM_LR.pC1 "" FLOAT32_IEEE autosar_swc_tos_CM_single 0 0 -3.4E+38 3.4E+38 ECU_ADDRESS 0xfe4b184c /* @ECU_Address@SwcOut_TOS_LM_LR.pC1@ */ /end MEASUREMENT
/begin MEASUREMENT SwcOut_TOS_LM_LR.pC2 "" FLOAT32_IEEE autosar_swc_tos_CM_single 0 0 -3.4E+38 3.4E+38 ECU_ADDRESS 0xfe4b1850 /* @ECU_Address@SwcOut_TOS_LM_LR.pC2@ */ /end MEASUREMENT
/begin MEASUREMENT SwcOut_TOS_LM_LR.pC3 "" FLOAT32_IEEE autosar_swc_tos_CM_single 0 0 -3.4E+38 3.4E+38 ECU_ADDRESS 0xfe4b1854 /* @ECU_Address@SwcOut_TOS_LM_LR.pC3@ */ /end MEASUREMENT
/begin MEASUREMENT SwcOut_TOS_LM_LR.pC4 "" FLOAT32_IEEE autosar_swc_tos_CM_single 0 0 -3.4E+38 3.4E+38 ECU_ADDRESS 0xfe4b1858 /* @ECU_Address@SwcOut_TOS_LM_LR.pC4@ */ /end MEASUREMENT
/begin MEASUREMENT SwcOut_TOS_LM_LR.pC5 "" FLOAT32_IEEE autosar_swc_tos_CM_single 0 0 -3.4E+38 3.4E+38 ECU_ADDRESS 0xfe4b185c /* @ECU_Address@SwcOut_TOS_LM_LR.pC5@ */ /end MEASUREMENT
/begin MEASUREMENT SwcOut_TOS_LM_RL.dDisEnd "" FLOAT32_IEEE autosar_swc_tos_CM_single 0 0 -3.4E+38 3.4E+38 ECU_ADDRESS 0xfe4b188c /* @ECU_Address@SwcOut_TOS_LM_RL.dDisEnd@ */ /end MEASUREMENT
/begin MEASUREMENT SwcOut_TOS_LM_RL.dDisStart "" FLOAT32_IEEE autosar_swc_tos_CM_single 0 0 -3.4E+38 3.4E+38 ECU_ADDRESS 0xfe4b1888 /* @ECU_Address@SwcOut_TOS_LM_RL.dDisStart@ */ /end MEASUREMENT
/begin MEASUREMENT SwcOut_TOS_LM_RL.dQuality "" FLOAT32_IEEE autosar_swc_tos_CM_single 0 0 -3.4E+38 3.4E+38 ECU_ADDRESS 0xfe4b1890 /* @ECU_Address@SwcOut_TOS_LM_RL.dQuality@ */ /end MEASUREMENT
/begin MEASUREMENT SwcOut_TOS_LM_RL.fCamValid "" UBYTE autosar_swc_tos_CM_uint8 0 0 0 255 ECU_ADDRESS 0xfe4b1894 /* @ECU_Address@SwcOut_TOS_LM_RL.fCamValid@ */ /end MEASUREMENT
/begin MEASUREMENT SwcOut_TOS_LM_RL.pC0 "" FLOAT32_IEEE autosar_swc_tos_CM_single 0 0 -3.4E+38 3.4E+38 ECU_ADDRESS 0xfe4b1870 /* @ECU_Address@SwcOut_TOS_LM_RL.pC0@ */ /end MEASUREMENT
/begin MEASUREMENT SwcOut_TOS_LM_RL.pC1 "" FLOAT32_IEEE autosar_swc_tos_CM_single 0 0 -3.4E+38 3.4E+38 ECU_ADDRESS 0xfe4b1874 /* @ECU_Address@SwcOut_TOS_LM_RL.pC1@ */ /end MEASUREMENT
/begin MEASUREMENT SwcOut_TOS_LM_RL.pC2 "" FLOAT32_IEEE autosar_swc_tos_CM_single 0 0 -3.4E+38 3.4E+38 ECU_ADDRESS 0xfe4b1878 /* @ECU_Address@SwcOut_TOS_LM_RL.pC2@ */ /end MEASUREMENT
/begin MEASUREMENT SwcOut_TOS_LM_RL.pC3 "" FLOAT32_IEEE autosar_swc_tos_CM_single 0 0 -3.4E+38 3.4E+38 ECU_ADDRESS 0xfe4b187c /* @ECU_Address@SwcOut_TOS_LM_RL.pC3@ */ /end MEASUREMENT
/begin MEASUREMENT SwcOut_TOS_LM_RL.pC4 "" FLOAT32_IEEE autosar_swc_tos_CM_single 0 0 -3.4E+38 3.4E+38 ECU_ADDRESS 0xfe4b1880 /* @ECU_Address@SwcOut_TOS_LM_RL.pC4@ */ /end MEASUREMENT
/begin MEASUREMENT SwcOut_TOS_LM_RL.pC5 "" FLOAT32_IEEE autosar_swc_tos_CM_single 0 0 -3.4E+38 3.4E+38 ECU_ADDRESS 0xfe4b1884 /* @ECU_Address@SwcOut_TOS_LM_RL.pC5@ */ /end MEASUREMENT
/begin MEASUREMENT SwcOut_TOS_LM_RR.dDisEnd "" FLOAT32_IEEE autosar_swc_tos_CM_single 0 0 -3.4E+38 3.4E+38 ECU_ADDRESS 0xfe4b18b4 /* @ECU_Address@SwcOut_TOS_LM_RR.dDisEnd@ */ /end MEASUREMENT
/begin MEASUREMENT SwcOut_TOS_LM_RR.dDisStart "" FLOAT32_IEEE autosar_swc_tos_CM_single 0 0 -3.4E+38 3.4E+38 ECU_ADDRESS 0xfe4b18b0 /* @ECU_Address@SwcOut_TOS_LM_RR.dDisStart@ */ /end MEASUREMENT
/begin MEASUREMENT SwcOut_TOS_LM_RR.dQuality "" FLOAT32_IEEE autosar_swc_tos_CM_single 0 0 -3.4E+38 3.4E+38 ECU_ADDRESS 0xfe4b18b8 /* @ECU_Address@SwcOut_TOS_LM_RR.dQuality@ */ /end MEASUREMENT
/begin MEASUREMENT SwcOut_TOS_LM_RR.fCamValid "" UBYTE autosar_swc_tos_CM_uint8 0 0 0 255 ECU_ADDRESS 0xfe4b18bc /* @ECU_Address@SwcOut_TOS_LM_RR.fCamValid@ */ /end MEASUREMENT
/begin MEASUREMENT SwcOut_TOS_LM_RR.pC0 "" FLOAT32_IEEE autosar_swc_tos_CM_single 0 0 -3.4E+38 3.4E+38 ECU_ADDRESS 0xfe4b1898 /* @ECU_Address@SwcOut_TOS_LM_RR.pC0@ */ /end MEASUREMENT
/begin MEASUREMENT SwcOut_TOS_LM_RR.pC1 "" FLOAT32_IEEE autosar_swc_tos_CM_single 0 0 -3.4E+38 3.4E+38 ECU_ADDRESS 0xfe4b189c /* @ECU_Address@SwcOut_TOS_LM_RR.pC1@ */ /end MEASUREMENT
/begin MEASUREMENT SwcOut_TOS_LM_RR.pC2 "" FLOAT32_IEEE autosar_swc_tos_CM_single 0 0 -3.4E+38 3.4E+38 ECU_ADDRESS 0xfe4b18a0 /* @ECU_Address@SwcOut_TOS_LM_RR.pC2@ */ /end MEASUREMENT
/begin MEASUREMENT SwcOut_TOS_LM_RR.pC3 "" FLOAT32_IEEE autosar_swc_tos_CM_single 0 0 -3.4E+38 3.4E+38 ECU_ADDRESS 0xfe4b18a4 /* @ECU_Address@SwcOut_TOS_LM_RR.pC3@ */ /end MEASUREMENT
/begin MEASUREMENT SwcOut_TOS_LM_RR.pC4 "" FLOAT32_IEEE autosar_swc_tos_CM_single 0 0 -3.4E+38 3.4E+38 ECU_ADDRESS 0xfe4b18a8 /* @ECU_Address@SwcOut_TOS_LM_RR.pC4@ */ /end MEASUREMENT
/begin MEASUREMENT SwcOut_TOS_LM_RR.pC5 "" FLOAT32_IEEE autosar_swc_tos_CM_single 0 0 -3.4E+38 3.4E+38 ECU_ADDRESS 0xfe4b18ac /* @ECU_Address@SwcOut_TOS_LM_RR.pC5@ */ /end MEASUREMENT
/begin MEASUREMENT SwcOut_TOS_LcSts.LC_Left "" UBYTE autosar_swc_tos_CM_uint8 0 0 0 255 ECU_ADDRESS 0xfe4b4909 /* @ECU_Address@SwcOut_TOS_LcSts.LC_Left@ */ /end MEASUREMENT
/begin MEASUREMENT SwcOut_TOS_LcSts.LC_Right "" UBYTE autosar_swc_tos_CM_uint8 0 0 0 255 ECU_ADDRESS 0xfe4b490a /* @ECU_Address@SwcOut_TOS_LcSts.LC_Right@ */ /end MEASUREMENT
/begin MEASUREMENT SwcOut_TOS_LcSts.Lc "" UBYTE autosar_swc_tos_CM_boolean 0 0 0 1 ECU_ADDRESS 0xfe4b4908 /* @ECU_Address@SwcOut_TOS_LcSts.Lc@ */ /end MEASUREMENT
/begin MEASUREMENT SwcOut_TOS_SecondSele_Object.ax "" FLOAT32_IEEE autosar_swc_tos_CM_single 0 0 -3.4E+38 3.4E+38 LAYOUT COLUMN_DIR MATRIX_DIM 4 ECU_ADDRESS 0xfe4b4748 /* @ECU_Address@SwcOut_TOS_SecondSele_Object.ax@ */ /end MEASUREMENT
/begin MEASUREMENT SwcOut_TOS_SecondSele_Object.ay "" FLOAT32_IEEE autosar_swc_tos_CM_single 0 0 -3.4E+38 3.4E+38 LAYOUT COLUMN_DIR MATRIX_DIM 4 ECU_ADDRESS 0xfe4b4758 /* @ECU_Address@SwcOut_TOS_SecondSele_Object.ay@ */ /end MEASUREMENT
/begin MEASUREMENT SwcOut_TOS_SecondSele_Object.dx "" FLOAT32_IEEE autosar_swc_tos_CM_single 0 0 -3.4E+38 3.4E+38 LAYOUT COLUMN_DIR MATRIX_DIM 4 ECU_ADDRESS 0xfe4b46d8 /* @ECU_Address@SwcOut_TOS_SecondSele_Object.dx@ */ /end MEASUREMENT
/begin MEASUREMENT SwcOut_TOS_SecondSele_Object.dy "" FLOAT32_IEEE autosar_swc_tos_CM_single 0 0 -3.4E+38 3.4E+38 LAYOUT COLUMN_DIR MATRIX_DIM 4 ECU_ADDRESS 0xfe4b46e8 /* @ECU_Address@SwcOut_TOS_SecondSele_Object.dy@ */ /end MEASUREMENT
/begin MEASUREMENT SwcOut_TOS_SecondSele_Object.fu_type "" UWORD autosar_swc_tos_CM_uint16 0 0 0 65535 LAYOUT COLUMN_DIR MATRIX_DIM 4 ECU_ADDRESS 0xfe4b46c0 /* @ECU_Address@SwcOut_TOS_SecondSele_Object.fu_type@ */ /end MEASUREMENT
/begin MEASUREMENT SwcOut_TOS_SecondSele_Object.headingAngle "" FLOAT32_IEEE autosar_swc_tos_CM_single 0 0 -3.4E+38 3.4E+38 LAYOUT COLUMN_DIR MATRIX_DIM 4 ECU_ADDRESS 0xfe4b4718 /* @ECU_Address@SwcOut_TOS_SecondSele_Object.headingAngle@ */ /end MEASUREMENT
/begin MEASUREMENT SwcOut_TOS_SecondSele_Object.id "" FLOAT32_IEEE autosar_swc_tos_CM_single 0 0 -3.4E+38 3.4E+38 LAYOUT COLUMN_DIR MATRIX_DIM 4 ECU_ADDRESS 0xfe4b46c8 /* @ECU_Address@SwcOut_TOS_SecondSele_Object.id@ */ /end MEASUREMENT
/begin MEASUREMENT SwcOut_TOS_SecondSele_Object.length "" FLOAT32_IEEE autosar_swc_tos_CM_single 0 0 -3.4E+38 3.4E+38 LAYOUT COLUMN_DIR MATRIX_DIM 4 ECU_ADDRESS 0xfe4b4728 /* @ECU_Address@SwcOut_TOS_SecondSele_Object.length@ */ /end MEASUREMENT
/begin MEASUREMENT SwcOut_TOS_SecondSele_Object.movingState "" UBYTE autosar_swc_tos_CM_uint8 0 0 0 255 LAYOUT COLUMN_DIR MATRIX_DIM 4 ECU_ADDRESS 0xfe4b46b4 /* @ECU_Address@SwcOut_TOS_SecondSele_Object.movingState@ */ /end MEASUREMENT
/begin MEASUREMENT SwcOut_TOS_SecondSele_Object.orientation "" UBYTE autosar_swc_tos_CM_uint8 0 0 0 255 LAYOUT COLUMN_DIR MATRIX_DIM 4 ECU_ADDRESS 0xfe4b46b8 /* @ECU_Address@SwcOut_TOS_SecondSele_Object.orientation@ */ /end MEASUREMENT
/begin MEASUREMENT SwcOut_TOS_SecondSele_Object.type "" UBYTE autosar_swc_tos_CM_uint8 0 0 0 255 LAYOUT COLUMN_DIR MATRIX_DIM 4 ECU_ADDRESS 0xfe4b46bc /* @ECU_Address@SwcOut_TOS_SecondSele_Object.type@ */ /end MEASUREMENT
/begin MEASUREMENT SwcOut_TOS_SecondSele_Object.vxRel "" FLOAT32_IEEE autosar_swc_tos_CM_single 0 0 -3.4E+38 3.4E+38 LAYOUT COLUMN_DIR MATRIX_DIM 4 ECU_ADDRESS 0xfe4b46f8 /* @ECU_Address@SwcOut_TOS_SecondSele_Object.vxRel@ */ /end MEASUREMENT
/begin MEASUREMENT SwcOut_TOS_SecondSele_Object.vyRel "" FLOAT32_IEEE autosar_swc_tos_CM_single 0 0 -3.4E+38 3.4E+38 LAYOUT COLUMN_DIR MATRIX_DIM 4 ECU_ADDRESS 0xfe4b4708 /* @ECU_Address@SwcOut_TOS_SecondSele_Object.vyRel@ */ /end MEASUREMENT
/begin MEASUREMENT SwcOut_TOS_SecondSele_Object.width "" FLOAT32_IEEE autosar_swc_tos_CM_single 0 0 -3.4E+38 3.4E+38 LAYOUT COLUMN_DIR MATRIX_DIM 4 ECU_ADDRESS 0xfe4b4738 /* @ECU_Address@SwcOut_TOS_SecondSele_Object.width@ */ /end MEASUREMENT
/begin MEASUREMENT TOS_ExecTimestamp.nanoseconds "" ULONG autosar_swc_tos_CM_uint32 0 0 0 4294967295 ECU_ADDRESS 0xfe4b18dc /* @ECU_Address@TOS_ExecTimestamp.nanoseconds@ */ /end MEASUREMENT
/begin MEASUREMENT TOS_ExecTimestamp.seconds "" A_UINT64 autosar_swc_tos_CM_uint64 0 0 0 18446744073709551615 ECU_ADDRESS 0xfe4b18e0 /* @ECU_Address@TOS_ExecTimestamp.seconds@ */ /end MEASUREMENT
/begin MEASUREMENT TOS_ExecTimestamp.timeBaseStatus "" UBYTE autosar_swc_tos_CM_uint8 0 0 0 255 ECU_ADDRESS 0xfe4b18d8 /* @ECU_Address@TOS_ExecTimestamp.timeBaseStatus@ */ /end MEASUREMENT
/begin MEASUREMENT TOS_HLane.Source "" UBYTE autosar_swc_tos_CM_uint8 0 0 0 255 ECU_ADDRESS 0xfe4b4768 /* @ECU_Address@TOS_HLane.Source@ */ /end MEASUREMENT
/begin MEASUREMENT TOS_HLane.bIsLineExist "" UBYTE autosar_swc_tos_CM_uint8 0 0 0 255 ECU_ADDRESS 0xfe4b4769 /* @ECU_Address@TOS_HLane.bIsLineExist@ */ /end MEASUREMENT
/begin MEASUREMENT TOS_HLane.dC0V "" FLOAT32_IEEE autosar_swc_tos_CM_single 0 0 -3.4E+38 3.4E+38 ECU_ADDRESS 0xfe4b476c /* @ECU_Address@TOS_HLane.dC0V@ */ /end MEASUREMENT
/begin MEASUREMENT TOS_HLane.dC1V "" FLOAT32_IEEE autosar_swc_tos_CM_single 0 0 -3.4E+38 3.4E+38 ECU_ADDRESS 0xfe4b4770 /* @ECU_Address@TOS_HLane.dC1V@ */ /end MEASUREMENT
/begin MEASUREMENT TOS_HLane.dC2V "" FLOAT32_IEEE autosar_swc_tos_CM_single 0 0 -3.4E+38 3.4E+38 ECU_ADDRESS 0xfe4b4774 /* @ECU_Address@TOS_HLane.dC2V@ */ /end MEASUREMENT
/begin MEASUREMENT TOS_HLane.dC3V "" FLOAT32_IEEE autosar_swc_tos_CM_single 0 0 -3.4E+38 3.4E+38 ECU_ADDRESS 0xfe4b4778 /* @ECU_Address@TOS_HLane.dC3V@ */ /end MEASUREMENT
/begin MEASUREMENT TOS_HLane.dC4V "" FLOAT32_IEEE autosar_swc_tos_CM_single 0 0 -3.4E+38 3.4E+38 ECU_ADDRESS 0xfe4b477c /* @ECU_Address@TOS_HLane.dC4V@ */ /end MEASUREMENT
/begin MEASUREMENT TOS_HLane.dC5V "" FLOAT32_IEEE autosar_swc_tos_CM_single 0 0 -3.4E+38 3.4E+38 ECU_ADDRESS 0xfe4b4780 /* @ECU_Address@TOS_HLane.dC5V@ */ /end MEASUREMENT
/begin MEASUREMENT TOS_HLane.dDisFront "" FLOAT32_IEEE autosar_swc_tos_CM_single 0 0 -3.4E+38 3.4E+38 ECU_ADDRESS 0xfe4b478c /* @ECU_Address@TOS_HLane.dDisFront@ */ /end MEASUREMENT
/begin MEASUREMENT TOS_HLane.dDisStart "" FLOAT32_IEEE autosar_swc_tos_CM_single 0 0 -3.4E+38 3.4E+38 ECU_ADDRESS 0xfe4b4788 /* @ECU_Address@TOS_HLane.dDisStart@ */ /end MEASUREMENT
/begin MEASUREMENT TOS_HLane.dLaneWidth "" FLOAT32_IEEE autosar_swc_tos_CM_single 0 0 -3.4E+38 3.4E+38 ECU_ADDRESS 0xfe4b4794 /* @ECU_Address@TOS_HLane.dLaneWidth@ */ /end MEASUREMENT
/begin MEASUREMENT TOS_HLane.dQuality "" FLOAT32_IEEE autosar_swc_tos_CM_single 0 0 -3.4E+38 3.4E+38 ECU_ADDRESS 0xfe4b4790 /* @ECU_Address@TOS_HLane.dQuality@ */ /end MEASUREMENT
/begin MEASUREMENT TOS_HLane.eLineType "" UBYTE autosar_swc_tos_CM_uint8 0 0 0 255 ECU_ADDRESS 0xfe4b4784 /* @ECU_Address@TOS_HLane.eLineType@ */ /end MEASUREMENT
/begin MEASUREMENT TOS_HLane.eLinefusType "" UBYTE autosar_swc_tos_CM_uint8 0 0 0 255 ECU_ADDRESS 0xfe4b4798 /* @ECU_Address@TOS_HLane.eLinefusType@ */ /end MEASUREMENT
/begin MEASUREMENT TOS_LL.Source "" UBYTE autosar_swc_tos_CM_uint8 0 0 0 255 ECU_ADDRESS 0xfe4b479c /* @ECU_Address@TOS_LL.Source@ */ /end MEASUREMENT
/begin MEASUREMENT TOS_LL.bIsLineExist "" UBYTE autosar_swc_tos_CM_uint8 0 0 0 255 ECU_ADDRESS 0xfe4b479d /* @ECU_Address@TOS_LL.bIsLineExist@ */ /end MEASUREMENT
/begin MEASUREMENT TOS_LL.dC0V "" FLOAT32_IEEE autosar_swc_tos_CM_single 0 0 -3.4E+38 3.4E+38 ECU_ADDRESS 0xfe4b47a0 /* @ECU_Address@TOS_LL.dC0V@ */ /end MEASUREMENT
/begin MEASUREMENT TOS_LL.dC1V "" FLOAT32_IEEE autosar_swc_tos_CM_single 0 0 -3.4E+38 3.4E+38 ECU_ADDRESS 0xfe4b47a4 /* @ECU_Address@TOS_LL.dC1V@ */ /end MEASUREMENT
/begin MEASUREMENT TOS_LL.dC2V "" FLOAT32_IEEE autosar_swc_tos_CM_single 0 0 -3.4E+38 3.4E+38 ECU_ADDRESS 0xfe4b47a8 /* @ECU_Address@TOS_LL.dC2V@ */ /end MEASUREMENT
/begin MEASUREMENT TOS_LL.dC3V "" FLOAT32_IEEE autosar_swc_tos_CM_single 0 0 -3.4E+38 3.4E+38 ECU_ADDRESS 0xfe4b47ac /* @ECU_Address@TOS_LL.dC3V@ */ /end MEASUREMENT
/begin MEASUREMENT TOS_LL.dC4V "" FLOAT32_IEEE autosar_swc_tos_CM_single 0 0 -3.4E+38 3.4E+38 ECU_ADDRESS 0xfe4b47b0 /* @ECU_Address@TOS_LL.dC4V@ */ /end MEASUREMENT
/begin MEASUREMENT TOS_LL.dC5V "" FLOAT32_IEEE autosar_swc_tos_CM_single 0 0 -3.4E+38 3.4E+38 ECU_ADDRESS 0xfe4b47b4 /* @ECU_Address@TOS_LL.dC5V@ */ /end MEASUREMENT
/begin MEASUREMENT TOS_LL.dDisFront "" FLOAT32_IEEE autosar_swc_tos_CM_single 0 0 -3.4E+38 3.4E+38 ECU_ADDRESS 0xfe4b47c0 /* @ECU_Address@TOS_LL.dDisFront@ */ /end MEASUREMENT
/begin MEASUREMENT TOS_LL.dDisStart "" FLOAT32_IEEE autosar_swc_tos_CM_single 0 0 -3.4E+38 3.4E+38 ECU_ADDRESS 0xfe4b47bc /* @ECU_Address@TOS_LL.dDisStart@ */ /end MEASUREMENT
/begin MEASUREMENT TOS_LL.dLaneWidth "" FLOAT32_IEEE autosar_swc_tos_CM_single 0 0 -3.4E+38 3.4E+38 ECU_ADDRESS 0xfe4b47c8 /* @ECU_Address@TOS_LL.dLaneWidth@ */ /end MEASUREMENT
/begin MEASUREMENT TOS_LL.dQuality "" FLOAT32_IEEE autosar_swc_tos_CM_single 0 0 -3.4E+38 3.4E+38 ECU_ADDRESS 0xfe4b47c4 /* @ECU_Address@TOS_LL.dQuality@ */ /end MEASUREMENT
/begin MEASUREMENT TOS_LL.eLineType "" UBYTE autosar_swc_tos_CM_uint8 0 0 0 255 ECU_ADDRESS 0xfe4b47b8 /* @ECU_Address@TOS_LL.eLineType@ */ /end MEASUREMENT
/begin MEASUREMENT TOS_LL.eLinefusType "" UBYTE autosar_swc_tos_CM_uint8 0 0 0 255 ECU_ADDRESS 0xfe4b47cc /* @ECU_Address@TOS_LL.eLinefusType@ */ /end MEASUREMENT
/begin MEASUREMENT TOS_LLane.Source "" UBYTE autosar_swc_tos_CM_uint8 0 0 0 255 ECU_ADDRESS 0xfe4b47d0 /* @ECU_Address@TOS_LLane.Source@ */ /end MEASUREMENT
/begin MEASUREMENT TOS_LLane.bIsLineExist "" UBYTE autosar_swc_tos_CM_uint8 0 0 0 255 ECU_ADDRESS 0xfe4b47d1 /* @ECU_Address@TOS_LLane.bIsLineExist@ */ /end MEASUREMENT
/begin MEASUREMENT TOS_LLane.dC0V "" FLOAT32_IEEE autosar_swc_tos_CM_single 0 0 -3.4E+38 3.4E+38 ECU_ADDRESS 0xfe4b47d4 /* @ECU_Address@TOS_LLane.dC0V@ */ /end MEASUREMENT
/begin MEASUREMENT TOS_LLane.dC1V "" FLOAT32_IEEE autosar_swc_tos_CM_single 0 0 -3.4E+38 3.4E+38 ECU_ADDRESS 0xfe4b47d8 /* @ECU_Address@TOS_LLane.dC1V@ */ /end MEASUREMENT
/begin MEASUREMENT TOS_LLane.dC2V "" FLOAT32_IEEE autosar_swc_tos_CM_single 0 0 -3.4E+38 3.4E+38 ECU_ADDRESS 0xfe4b47dc /* @ECU_Address@TOS_LLane.dC2V@ */ /end MEASUREMENT
/begin MEASUREMENT TOS_LLane.dC3V "" FLOAT32_IEEE autosar_swc_tos_CM_single 0 0 -3.4E+38 3.4E+38 ECU_ADDRESS 0xfe4b47e0 /* @ECU_Address@TOS_LLane.dC3V@ */ /end MEASUREMENT
/begin MEASUREMENT TOS_LLane.dC4V "" FLOAT32_IEEE autosar_swc_tos_CM_single 0 0 -3.4E+38 3.4E+38 ECU_ADDRESS 0xfe4b47e4 /* @ECU_Address@TOS_LLane.dC4V@ */ /end MEASUREMENT
/begin MEASUREMENT TOS_LLane.dC5V "" FLOAT32_IEEE autosar_swc_tos_CM_single 0 0 -3.4E+38 3.4E+38 ECU_ADDRESS 0xfe4b47e8 /* @ECU_Address@TOS_LLane.dC5V@ */ /end MEASUREMENT
/begin MEASUREMENT TOS_LLane.dDisFront "" FLOAT32_IEEE autosar_swc_tos_CM_single 0 0 -3.4E+38 3.4E+38 ECU_ADDRESS 0xfe4b47f4 /* @ECU_Address@TOS_LLane.dDisFront@ */ /end MEASUREMENT
/begin MEASUREMENT TOS_LLane.dDisStart "" FLOAT32_IEEE autosar_swc_tos_CM_single 0 0 -3.4E+38 3.4E+38 ECU_ADDRESS 0xfe4b47f0 /* @ECU_Address@TOS_LLane.dDisStart@ */ /end MEASUREMENT
/begin MEASUREMENT TOS_LLane.dLaneWidth "" FLOAT32_IEEE autosar_swc_tos_CM_single 0 0 -3.4E+38 3.4E+38 ECU_ADDRESS 0xfe4b47fc /* @ECU_Address@TOS_LLane.dLaneWidth@ */ /end MEASUREMENT
/begin MEASUREMENT TOS_LLane.dQuality "" FLOAT32_IEEE autosar_swc_tos_CM_single 0 0 -3.4E+38 3.4E+38 ECU_ADDRESS 0xfe4b47f8 /* @ECU_Address@TOS_LLane.dQuality@ */ /end MEASUREMENT
/begin MEASUREMENT TOS_LLane.eLineType "" UBYTE autosar_swc_tos_CM_uint8 0 0 0 255 ECU_ADDRESS 0xfe4b47ec /* @ECU_Address@TOS_LLane.eLineType@ */ /end MEASUREMENT
/begin MEASUREMENT TOS_LLane.eLinefusType "" UBYTE autosar_swc_tos_CM_uint8 0 0 0 255 ECU_ADDRESS 0xfe4b4800 /* @ECU_Address@TOS_LLane.eLinefusType@ */ /end MEASUREMENT
/begin MEASUREMENT TOS_LR.Source "" UBYTE autosar_swc_tos_CM_uint8 0 0 0 255 ECU_ADDRESS 0xfe4b4804 /* @ECU_Address@TOS_LR.Source@ */ /end MEASUREMENT
/begin MEASUREMENT TOS_LR.bIsLineExist "" UBYTE autosar_swc_tos_CM_uint8 0 0 0 255 ECU_ADDRESS 0xfe4b4805 /* @ECU_Address@TOS_LR.bIsLineExist@ */ /end MEASUREMENT
/begin MEASUREMENT TOS_LR.dC0V "" FLOAT32_IEEE autosar_swc_tos_CM_single 0 0 -3.4E+38 3.4E+38 ECU_ADDRESS 0xfe4b4808 /* @ECU_Address@TOS_LR.dC0V@ */ /end MEASUREMENT
/begin MEASUREMENT TOS_LR.dC1V "" FLOAT32_IEEE autosar_swc_tos_CM_single 0 0 -3.4E+38 3.4E+38 ECU_ADDRESS 0xfe4b480c /* @ECU_Address@TOS_LR.dC1V@ */ /end MEASUREMENT
/begin MEASUREMENT TOS_LR.dC2V "" FLOAT32_IEEE autosar_swc_tos_CM_single 0 0 -3.4E+38 3.4E+38 ECU_ADDRESS 0xfe4b4810 /* @ECU_Address@TOS_LR.dC2V@ */ /end MEASUREMENT
/begin MEASUREMENT TOS_LR.dC3V "" FLOAT32_IEEE autosar_swc_tos_CM_single 0 0 -3.4E+38 3.4E+38 ECU_ADDRESS 0xfe4b4814 /* @ECU_Address@TOS_LR.dC3V@ */ /end MEASUREMENT
/begin MEASUREMENT TOS_LR.dC4V "" FLOAT32_IEEE autosar_swc_tos_CM_single 0 0 -3.4E+38 3.4E+38 ECU_ADDRESS 0xfe4b4818 /* @ECU_Address@TOS_LR.dC4V@ */ /end MEASUREMENT
/begin MEASUREMENT TOS_LR.dC5V "" FLOAT32_IEEE autosar_swc_tos_CM_single 0 0 -3.4E+38 3.4E+38 ECU_ADDRESS 0xfe4b481c /* @ECU_Address@TOS_LR.dC5V@ */ /end MEASUREMENT
/begin MEASUREMENT TOS_LR.dDisFront "" FLOAT32_IEEE autosar_swc_tos_CM_single 0 0 -3.4E+38 3.4E+38 ECU_ADDRESS 0xfe4b4828 /* @ECU_Address@TOS_LR.dDisFront@ */ /end MEASUREMENT
/begin MEASUREMENT TOS_LR.dDisStart "" FLOAT32_IEEE autosar_swc_tos_CM_single 0 0 -3.4E+38 3.4E+38 ECU_ADDRESS 0xfe4b4824 /* @ECU_Address@TOS_LR.dDisStart@ */ /end MEASUREMENT
/begin MEASUREMENT TOS_LR.dLaneWidth "" FLOAT32_IEEE autosar_swc_tos_CM_single 0 0 -3.4E+38 3.4E+38 ECU_ADDRESS 0xfe4b4830 /* @ECU_Address@TOS_LR.dLaneWidth@ */ /end MEASUREMENT
/begin MEASUREMENT TOS_LR.dQuality "" FLOAT32_IEEE autosar_swc_tos_CM_single 0 0 -3.4E+38 3.4E+38 ECU_ADDRESS 0xfe4b482c /* @ECU_Address@TOS_LR.dQuality@ */ /end MEASUREMENT
/begin MEASUREMENT TOS_LR.eLineType "" UBYTE autosar_swc_tos_CM_uint8 0 0 0 255 ECU_ADDRESS 0xfe4b4820 /* @ECU_Address@TOS_LR.eLineType@ */ /end MEASUREMENT
/begin MEASUREMENT TOS_LR.eLinefusType "" UBYTE autosar_swc_tos_CM_uint8 0 0 0 255 ECU_ADDRESS 0xfe4b4834 /* @ECU_Address@TOS_LR.eLinefusType@ */ /end MEASUREMENT
/begin MEASUREMENT TOS_OFM_OBJs.Cipv_flag "" UBYTE autosar_swc_tos_CM_boolean 0 0 0 1 LAYOUT COLUMN_DIR MATRIX_DIM 64 ECU_ADDRESS 0xfe4b1d68 /* @ECU_Address@TOS_OFM_OBJs.Cipv_flag@ */ /end MEASUREMENT
/begin MEASUREMENT TOS_OFM_OBJs.CutIn_Flag "" UBYTE autosar_swc_tos_CM_boolean 0 0 0 1 LAYOUT COLUMN_DIR MATRIX_DIM 64 ECU_ADDRESS 0xfe4b42e8 /* @ECU_Address@TOS_OFM_OBJs.CutIn_Flag@ */ /end MEASUREMENT
/begin MEASUREMENT TOS_OFM_OBJs.Dis_Lateral "" FLOAT32_IEEE autosar_swc_tos_CM_single 0 0 -3.4E+38 3.4E+38 LAYOUT COLUMN_DIR MATRIX_DIM 64 ECU_ADDRESS 0xfe4b43e8 /* @ECU_Address@TOS_OFM_OBJs.Dis_Lateral@ */ /end MEASUREMENT
/begin MEASUREMENT TOS_OFM_OBJs.DistIn_Lane "" FLOAT32_IEEE autosar_swc_tos_CM_single 0 0 -3.4E+38 3.4E+38 LAYOUT COLUMN_DIR MATRIX_DIM 64 ECU_ADDRESS 0xfe4b40e8 /* @ECU_Address@TOS_OFM_OBJs.DistIn_Lane@ */ /end MEASUREMENT
/begin MEASUREMENT TOS_OFM_OBJs.DistOut_Lane "" FLOAT32_IEEE autosar_swc_tos_CM_single 0 0 -3.4E+38 3.4E+38 LAYOUT COLUMN_DIR MATRIX_DIM 64 ECU_ADDRESS 0xfe4b41e8 /* @ECU_Address@TOS_OFM_OBJs.DistOut_Lane@ */ /end MEASUREMENT
/begin MEASUREMENT TOS_OFM_OBJs.FL_dx "" FLOAT32_IEEE autosar_swc_tos_CM_single 0 0 -3.4E+38 3.4E+38 LAYOUT COLUMN_DIR MATRIX_DIM 64 ECU_ADDRESS 0xfe4b2aa8 /* @ECU_Address@TOS_OFM_OBJs.FL_dx@ */ /end MEASUREMENT
/begin MEASUREMENT TOS_OFM_OBJs.FL_dy "" FLOAT32_IEEE autosar_swc_tos_CM_single 0 0 -3.4E+38 3.4E+38 LAYOUT COLUMN_DIR MATRIX_DIM 64 ECU_ADDRESS 0xfe4b2ba8 /* @ECU_Address@TOS_OFM_OBJs.FL_dy@ */ /end MEASUREMENT
/begin MEASUREMENT TOS_OFM_OBJs.FR_dx "" FLOAT32_IEEE autosar_swc_tos_CM_single 0 0 -3.4E+38 3.4E+38 LAYOUT COLUMN_DIR MATRIX_DIM 64 ECU_ADDRESS 0xfe4b2ca8 /* @ECU_Address@TOS_OFM_OBJs.FR_dx@ */ /end MEASUREMENT
/begin MEASUREMENT TOS_OFM_OBJs.FR_dy "" FLOAT32_IEEE autosar_swc_tos_CM_single 0 0 -3.4E+38 3.4E+38 LAYOUT COLUMN_DIR MATRIX_DIM 64 ECU_ADDRESS 0xfe4b2da8 /* @ECU_Address@TOS_OFM_OBJs.FR_dy@ */ /end MEASUREMENT
/begin MEASUREMENT TOS_OFM_OBJs.Hight "" FLOAT32_IEEE autosar_swc_tos_CM_single 0 0 -3.4E+38 3.4E+38 LAYOUT COLUMN_DIR MATRIX_DIM 64 ECU_ADDRESS 0xfe4b2628 /* @ECU_Address@TOS_OFM_OBJs.Hight@ */ /end MEASUREMENT
/begin MEASUREMENT TOS_OFM_OBJs.ID "" ULONG autosar_swc_tos_CM_uint32 0 0 0 4294967295 LAYOUT COLUMN_DIR MATRIX_DIM 64 ECU_ADDRESS 0xfe4b1c68 /* @ECU_Address@TOS_OFM_OBJs.ID@ */ /end MEASUREMENT
/begin MEASUREMENT TOS_OFM_OBJs.LcDis_Lateral "" FLOAT32_IEEE autosar_swc_tos_CM_single 0 0 -3.4E+38 3.4E+38 LAYOUT COLUMN_DIR MATRIX_DIM 64 ECU_ADDRESS 0xfe4b44e8 /* @ECU_Address@TOS_OFM_OBJs.LcDis_Lateral@ */ /end MEASUREMENT
/begin MEASUREMENT TOS_OFM_OBJs.Length "" FLOAT32_IEEE autosar_swc_tos_CM_single 0 0 -3.4E+38 3.4E+38 LAYOUT COLUMN_DIR MATRIX_DIM 64 ECU_ADDRESS 0xfe4b2428 /* @ECU_Address@TOS_OFM_OBJs.Length@ */ /end MEASUREMENT
/begin MEASUREMENT TOS_OFM_OBJs.MovDir "" UBYTE autosar_swc_tos_CM_uint8 0 0 0 255 LAYOUT COLUMN_DIR MATRIX_DIM 64 ECU_ADDRESS 0xfe4b2a68 /* @ECU_Address@TOS_OFM_OBJs.MovDir@ */ /end MEASUREMENT
/begin MEASUREMENT TOS_OFM_OBJs.Obj_CutIn "" UBYTE autosar_swc_tos_CM_boolean 0 0 0 1 LAYOUT COLUMN_DIR MATRIX_DIM 64 ECU_ADDRESS 0xfe4b4328 /* @ECU_Address@TOS_OFM_OBJs.Obj_CutIn@ */ /end MEASUREMENT
/begin MEASUREMENT TOS_OFM_OBJs.Obj_CutOut "" UBYTE autosar_swc_tos_CM_boolean 0 0 0 1 LAYOUT COLUMN_DIR MATRIX_DIM 64 ECU_ADDRESS 0xfe4b4368 /* @ECU_Address@TOS_OFM_OBJs.Obj_CutOut@ */ /end MEASUREMENT
/begin MEASUREMENT TOS_OFM_OBJs.OverlapRatio_LM "" FLOAT32_IEEE autosar_swc_tos_CM_single 0 0 -3.4E+38 3.4E+38 LAYOUT COLUMN_DIR MATRIX_DIM 64 ECU_ADDRESS 0xfe4b3ee8 /* @ECU_Address@TOS_OFM_OBJs.OverlapRatio_LM@ */ /end MEASUREMENT
/begin MEASUREMENT TOS_OFM_OBJs.OverlapRatio_OTL "" FLOAT32_IEEE autosar_swc_tos_CM_single 0 0 -3.4E+38 3.4E+38 LAYOUT COLUMN_DIR MATRIX_DIM 64 ECU_ADDRESS 0xfe4b3fe8 /* @ECU_Address@TOS_OFM_OBJs.OverlapRatio_OTL@ */ /end MEASUREMENT
/begin MEASUREMENT TOS_OFM_OBJs.PressedLaneSts "" UBYTE autosar_swc_tos_CM_uint8 0 0 0 255 LAYOUT COLUMN_DIR MATRIX_DIM 64 ECU_ADDRESS 0xfe4b43a8 /* @ECU_Address@TOS_OFM_OBJs.PressedLaneSts@ */ /end MEASUREMENT
/begin MEASUREMENT TOS_OFM_OBJs.RL_dx "" FLOAT32_IEEE autosar_swc_tos_CM_single 0 0 -3.4E+38 3.4E+38 LAYOUT COLUMN_DIR MATRIX_DIM 64 ECU_ADDRESS 0xfe4b2ea8 /* @ECU_Address@TOS_OFM_OBJs.RL_dx@ */ /end MEASUREMENT
/begin MEASUREMENT TOS_OFM_OBJs.RL_dy "" FLOAT32_IEEE autosar_swc_tos_CM_single 0 0 -3.4E+38 3.4E+38 LAYOUT COLUMN_DIR MATRIX_DIM 64 ECU_ADDRESS 0xfe4b2fa8 /* @ECU_Address@TOS_OFM_OBJs.RL_dy@ */ /end MEASUREMENT
/begin MEASUREMENT TOS_OFM_OBJs.RR_dx "" FLOAT32_IEEE autosar_swc_tos_CM_single 0 0 -3.4E+38 3.4E+38 LAYOUT COLUMN_DIR MATRIX_DIM 64 ECU_ADDRESS 0xfe4b30a8 /* @ECU_Address@TOS_OFM_OBJs.RR_dx@ */ /end MEASUREMENT
/begin MEASUREMENT TOS_OFM_OBJs.RR_dy "" FLOAT32_IEEE autosar_swc_tos_CM_single 0 0 -3.4E+38 3.4E+38 LAYOUT COLUMN_DIR MATRIX_DIM 64 ECU_ADDRESS 0xfe4b31a8 /* @ECU_Address@TOS_OFM_OBJs.RR_dy@ */ /end MEASUREMENT
/begin MEASUREMENT TOS_OFM_OBJs.SameLaneConfirms "" UBYTE autosar_swc_tos_CM_boolean 0 0 0 1 LAYOUT COLUMN_DIR MATRIX_DIM 64 ECU_ADDRESS 0xfe4b45e8 /* @ECU_Address@TOS_OFM_OBJs.SameLaneConfirms@ */ /end MEASUREMENT
/begin MEASUREMENT TOS_OFM_OBJs.Width "" FLOAT32_IEEE autosar_swc_tos_CM_single 0 0 -3.4E+38 3.4E+38 LAYOUT COLUMN_DIR MATRIX_DIM 64 ECU_ADDRESS 0xfe4b2528 /* @ECU_Address@TOS_OFM_OBJs.Width@ */ /end MEASUREMENT
/begin MEASUREMENT TOS_OFM_OBJs.age "" A_UINT64 autosar_swc_tos_CM_uint64 0 0 0 18446744073709551615 LAYOUT COLUMN_DIR MATRIX_DIM 64 ECU_ADDRESS 0xfe4b1da8 /* @ECU_Address@TOS_OFM_OBJs.age@ */ /end MEASUREMENT
/begin MEASUREMENT TOS_OFM_OBJs.axAbs "" FLOAT32_IEEE autosar_swc_tos_CM_single 0 0 -3.4E+38 3.4E+38 LAYOUT COLUMN_DIR MATRIX_DIM 64 ECU_ADDRESS 0xfe4b2228 /* @ECU_Address@TOS_OFM_OBJs.axAbs@ */ /end MEASUREMENT
/begin MEASUREMENT TOS_OFM_OBJs.axRel "" FLOAT32_IEEE autosar_swc_tos_CM_single 0 0 -3.4E+38 3.4E+38 LAYOUT COLUMN_DIR MATRIX_DIM 64 ECU_ADDRESS 0xfe4b3ba8 /* @ECU_Address@TOS_OFM_OBJs.axRel@ */ /end MEASUREMENT
/begin MEASUREMENT TOS_OFM_OBJs.ayAbs "" FLOAT32_IEEE autosar_swc_tos_CM_single 0 0 -3.4E+38 3.4E+38 LAYOUT COLUMN_DIR MATRIX_DIM 64 ECU_ADDRESS 0xfe4b2328 /* @ECU_Address@TOS_OFM_OBJs.ayAbs@ */ /end MEASUREMENT
/begin MEASUREMENT TOS_OFM_OBJs.ayRel "" FLOAT32_IEEE autosar_swc_tos_CM_single 0 0 -3.4E+38 3.4E+38 LAYOUT COLUMN_DIR MATRIX_DIM 64 ECU_ADDRESS 0xfe4b3ca8 /* @ECU_Address@TOS_OFM_OBJs.ayRel@ */ /end MEASUREMENT
/begin MEASUREMENT TOS_OFM_OBJs.breakLmpSts "" UBYTE autosar_swc_tos_CM_boolean 0 0 0 1 LAYOUT COLUMN_DIR MATRIX_DIM 64 ECU_ADDRESS 0xfe4b32a8 /* @ECU_Address@TOS_OFM_OBJs.breakLmpSts@ */ /end MEASUREMENT
/begin MEASUREMENT TOS_OFM_OBJs.camCutInDist "" FLOAT64_IEEE autosar_swc_tos_CM_double 0 0 -1.7E+308 1.7E+308 LAYOUT COLUMN_DIR MATRIX_DIM 64 ECU_ADDRESS 0xfe4b37a8 /* @ECU_Address@TOS_OFM_OBJs.camCutInDist@ */ /end MEASUREMENT
/begin MEASUREMENT TOS_OFM_OBJs.camCutInFlag "" UBYTE autosar_swc_tos_CM_boolean 0 0 0 1 LAYOUT COLUMN_DIR MATRIX_DIM 64 ECU_ADDRESS 0xfe4b32e8 /* @ECU_Address@TOS_OFM_OBJs.camCutInFlag@ */ /end MEASUREMENT
/begin MEASUREMENT TOS_OFM_OBJs.camCutInSpd "" FLOAT32_IEEE autosar_swc_tos_CM_single 0 0 -3.4E+38 3.4E+38 LAYOUT COLUMN_DIR MATRIX_DIM 64 ECU_ADDRESS 0xfe4b35a8 /* @ECU_Address@TOS_OFM_OBJs.camCutInSpd@ */ /end MEASUREMENT
/begin MEASUREMENT TOS_OFM_OBJs.camDx "" FLOAT32_IEEE autosar_swc_tos_CM_single 0 0 -3.4E+38 3.4E+38 LAYOUT COLUMN_DIR MATRIX_DIM 64 ECU_ADDRESS 0xfe4b33a8 /* @ECU_Address@TOS_OFM_OBJs.camDx@ */ /end MEASUREMENT
/begin MEASUREMENT TOS_OFM_OBJs.camDy "" FLOAT32_IEEE autosar_swc_tos_CM_single 0 0 -3.4E+38 3.4E+38 LAYOUT COLUMN_DIR MATRIX_DIM 64 ECU_ADDRESS 0xfe4b34a8 /* @ECU_Address@TOS_OFM_OBJs.camDy@ */ /end MEASUREMENT
/begin MEASUREMENT TOS_OFM_OBJs.camID "" ULONG autosar_swc_tos_CM_uint32 0 0 0 4294967295 LAYOUT COLUMN_DIR MATRIX_DIM 64 ECU_ADDRESS 0xfe4b36a8 /* @ECU_Address@TOS_OFM_OBJs.camID@ */ /end MEASUREMENT
/begin MEASUREMENT TOS_OFM_OBJs.camObjLaneAssignment "" UBYTE autosar_swc_tos_CM_uint8 0 0 0 255 LAYOUT COLUMN_DIR MATRIX_DIM 64 ECU_ADDRESS 0xfe4b3368 /* @ECU_Address@TOS_OFM_OBJs.camObjLaneAssignment@ */ /end MEASUREMENT
/begin MEASUREMENT TOS_OFM_OBJs.dx "" FLOAT32_IEEE autosar_swc_tos_CM_single 0 0 -3.4E+38 3.4E+38 LAYOUT COLUMN_DIR MATRIX_DIM 64 ECU_ADDRESS 0xfe4b2728 /* @ECU_Address@TOS_OFM_OBJs.dx@ */ /end MEASUREMENT
/begin MEASUREMENT TOS_OFM_OBJs.dy "" FLOAT32_IEEE autosar_swc_tos_CM_single 0 0 -3.4E+38 3.4E+38 LAYOUT COLUMN_DIR MATRIX_DIM 64 ECU_ADDRESS 0xfe4b2828 /* @ECU_Address@TOS_OFM_OBJs.dy@ */ /end MEASUREMENT
/begin MEASUREMENT TOS_OFM_OBJs.exist_prob "" FLOAT32_IEEE autosar_swc_tos_CM_single 0 0 -3.4E+38 3.4E+38 LAYOUT COLUMN_DIR MATRIX_DIM 64 ECU_ADDRESS 0xfe4b1968 /* @ECU_Address@TOS_OFM_OBJs.exist_prob@ */ /end MEASUREMENT
/begin MEASUREMENT TOS_OFM_OBJs.fu_type "" UWORD autosar_swc_tos_CM_uint16 0 0 0 65535 LAYOUT COLUMN_DIR MATRIX_DIM 64 ECU_ADDRESS 0xfe4b18e8 /* @ECU_Address@TOS_OFM_OBJs.fu_type@ */ /end MEASUREMENT
/begin MEASUREMENT TOS_OFM_OBJs.headingAngle "" FLOAT32_IEEE autosar_swc_tos_CM_single 0 0 -3.4E+38 3.4E+38 LAYOUT COLUMN_DIR MATRIX_DIM 64 ECU_ADDRESS 0xfe4b1b68 /* @ECU_Address@TOS_OFM_OBJs.headingAngle@ */ /end MEASUREMENT
/begin MEASUREMENT TOS_OFM_OBJs.movingSts "" UBYTE autosar_swc_tos_CM_uint8 0 0 0 255 LAYOUT COLUMN_DIR MATRIX_DIM 64 ECU_ADDRESS 0xfe4b1fa8 /* @ECU_Address@TOS_OFM_OBJs.movingSts@ */ /end MEASUREMENT
/begin MEASUREMENT TOS_OFM_OBJs.offset_flag "" UBYTE autosar_swc_tos_CM_boolean 0 0 0 1 LAYOUT COLUMN_DIR MATRIX_DIM 64 ECU_ADDRESS 0xfe4b3da8 /* @ECU_Address@TOS_OFM_OBJs.offset_flag@ */ /end MEASUREMENT
/begin MEASUREMENT TOS_OFM_OBJs.offset_value "" FLOAT32_IEEE autosar_swc_tos_CM_single 0 0 -3.4E+38 3.4E+38 LAYOUT COLUMN_DIR MATRIX_DIM 64 ECU_ADDRESS 0xfe4b3de8 /* @ECU_Address@TOS_OFM_OBJs.offset_value@ */ /end MEASUREMENT
/begin MEASUREMENT TOS_OFM_OBJs.orientation "" UBYTE autosar_swc_tos_CM_uint8 0 0 0 255 LAYOUT COLUMN_DIR MATRIX_DIM 64 ECU_ADDRESS 0xfe4b2a28 /* @ECU_Address@TOS_OFM_OBJs.orientation@ */ /end MEASUREMENT
/begin MEASUREMENT TOS_OFM_OBJs.turnLmpSts "" UBYTE autosar_swc_tos_CM_uint8 0 0 0 255 LAYOUT COLUMN_DIR MATRIX_DIM 64 ECU_ADDRESS 0xfe4b3328 /* @ECU_Address@TOS_OFM_OBJs.turnLmpSts@ */ /end MEASUREMENT
/begin MEASUREMENT TOS_OFM_OBJs.type "" UBYTE autosar_swc_tos_CM_uint8 0 0 0 255 LAYOUT COLUMN_DIR MATRIX_DIM 64 ECU_ADDRESS 0xfe4b1fe8 /* @ECU_Address@TOS_OFM_OBJs.type@ */ /end MEASUREMENT
/begin MEASUREMENT TOS_OFM_OBJs.type_prob "" FLOAT32_IEEE autosar_swc_tos_CM_single 0 0 -3.4E+38 3.4E+38 LAYOUT COLUMN_DIR MATRIX_DIM 64 ECU_ADDRESS 0xfe4b1a68 /* @ECU_Address@TOS_OFM_OBJs.type_prob@ */ /end MEASUREMENT
/begin MEASUREMENT TOS_OFM_OBJs.vxAbs "" FLOAT32_IEEE autosar_swc_tos_CM_single 0 0 -3.4E+38 3.4E+38 LAYOUT COLUMN_DIR MATRIX_DIM 64 ECU_ADDRESS 0xfe4b2028 /* @ECU_Address@TOS_OFM_OBJs.vxAbs@ */ /end MEASUREMENT
/begin MEASUREMENT TOS_OFM_OBJs.vxRel "" FLOAT32_IEEE autosar_swc_tos_CM_single 0 0 -3.4E+38 3.4E+38 LAYOUT COLUMN_DIR MATRIX_DIM 64 ECU_ADDRESS 0xfe4b39a8 /* @ECU_Address@TOS_OFM_OBJs.vxRel@ */ /end MEASUREMENT
/begin MEASUREMENT TOS_OFM_OBJs.vyAbs "" FLOAT32_IEEE autosar_swc_tos_CM_single 0 0 -3.4E+38 3.4E+38 LAYOUT COLUMN_DIR MATRIX_DIM 64 ECU_ADDRESS 0xfe4b2128 /* @ECU_Address@TOS_OFM_OBJs.vyAbs@ */ /end MEASUREMENT
/begin MEASUREMENT TOS_OFM_OBJs.vyRel "" FLOAT32_IEEE autosar_swc_tos_CM_single 0 0 -3.4E+38 3.4E+38 LAYOUT COLUMN_DIR MATRIX_DIM 64 ECU_ADDRESS 0xfe4b3aa8 /* @ECU_Address@TOS_OFM_OBJs.vyRel@ */ /end MEASUREMENT
/begin MEASUREMENT TOS_OFM_OBJs.yawAngle "" FLOAT32_IEEE autosar_swc_tos_CM_single 0 0 -3.4E+38 3.4E+38 LAYOUT COLUMN_DIR MATRIX_DIM 64 ECU_ADDRESS 0xfe4b2928 /* @ECU_Address@TOS_OFM_OBJs.yawAngle@ */ /end MEASUREMENT
/begin MEASUREMENT TOS_RL.Source "" UBYTE autosar_swc_tos_CM_uint8 0 0 0 255 ECU_ADDRESS 0xfe4b4838 /* @ECU_Address@TOS_RL.Source@ */ /end MEASUREMENT
/begin MEASUREMENT TOS_RL.bIsLineExist "" UBYTE autosar_swc_tos_CM_uint8 0 0 0 255 ECU_ADDRESS 0xfe4b4839 /* @ECU_Address@TOS_RL.bIsLineExist@ */ /end MEASUREMENT
/begin MEASUREMENT TOS_RL.dC0V "" FLOAT32_IEEE autosar_swc_tos_CM_single 0 0 -3.4E+38 3.4E+38 ECU_ADDRESS 0xfe4b483c /* @ECU_Address@TOS_RL.dC0V@ */ /end MEASUREMENT
/begin MEASUREMENT TOS_RL.dC1V "" FLOAT32_IEEE autosar_swc_tos_CM_single 0 0 -3.4E+38 3.4E+38 ECU_ADDRESS 0xfe4b4840 /* @ECU_Address@TOS_RL.dC1V@ */ /end MEASUREMENT
/begin MEASUREMENT TOS_RL.dC2V "" FLOAT32_IEEE autosar_swc_tos_CM_single 0 0 -3.4E+38 3.4E+38 ECU_ADDRESS 0xfe4b4844 /* @ECU_Address@TOS_RL.dC2V@ */ /end MEASUREMENT
/begin MEASUREMENT TOS_RL.dC3V "" FLOAT32_IEEE autosar_swc_tos_CM_single 0 0 -3.4E+38 3.4E+38 ECU_ADDRESS 0xfe4b4848 /* @ECU_Address@TOS_RL.dC3V@ */ /end MEASUREMENT
/begin MEASUREMENT TOS_RL.dC4V "" FLOAT32_IEEE autosar_swc_tos_CM_single 0 0 -3.4E+38 3.4E+38 ECU_ADDRESS 0xfe4b484c /* @ECU_Address@TOS_RL.dC4V@ */ /end MEASUREMENT
/begin MEASUREMENT TOS_RL.dC5V "" FLOAT32_IEEE autosar_swc_tos_CM_single 0 0 -3.4E+38 3.4E+38 ECU_ADDRESS 0xfe4b4850 /* @ECU_Address@TOS_RL.dC5V@ */ /end MEASUREMENT
/begin MEASUREMENT TOS_RL.dDisFront "" FLOAT32_IEEE autosar_swc_tos_CM_single 0 0 -3.4E+38 3.4E+38 ECU_ADDRESS 0xfe4b485c /* @ECU_Address@TOS_RL.dDisFront@ */ /end MEASUREMENT
/begin MEASUREMENT TOS_RL.dDisStart "" FLOAT32_IEEE autosar_swc_tos_CM_single 0 0 -3.4E+38 3.4E+38 ECU_ADDRESS 0xfe4b4858 /* @ECU_Address@TOS_RL.dDisStart@ */ /end MEASUREMENT
/begin MEASUREMENT TOS_RL.dLaneWidth "" FLOAT32_IEEE autosar_swc_tos_CM_single 0 0 -3.4E+38 3.4E+38 ECU_ADDRESS 0xfe4b4864 /* @ECU_Address@TOS_RL.dLaneWidth@ */ /end MEASUREMENT
/begin MEASUREMENT TOS_RL.dQuality "" FLOAT32_IEEE autosar_swc_tos_CM_single 0 0 -3.4E+38 3.4E+38 ECU_ADDRESS 0xfe4b4860 /* @ECU_Address@TOS_RL.dQuality@ */ /end MEASUREMENT
/begin MEASUREMENT TOS_RL.eLineType "" UBYTE autosar_swc_tos_CM_uint8 0 0 0 255 ECU_ADDRESS 0xfe4b4854 /* @ECU_Address@TOS_RL.eLineType@ */ /end MEASUREMENT
/begin MEASUREMENT TOS_RL.eLinefusType "" UBYTE autosar_swc_tos_CM_uint8 0 0 0 255 ECU_ADDRESS 0xfe4b4868 /* @ECU_Address@TOS_RL.eLinefusType@ */ /end MEASUREMENT
/begin MEASUREMENT TOS_RLane.Source "" UBYTE autosar_swc_tos_CM_uint8 0 0 0 255 ECU_ADDRESS 0xfe4b486c /* @ECU_Address@TOS_RLane.Source@ */ /end MEASUREMENT
/begin MEASUREMENT TOS_RLane.bIsLineExist "" UBYTE autosar_swc_tos_CM_uint8 0 0 0 255 ECU_ADDRESS 0xfe4b486d /* @ECU_Address@TOS_RLane.bIsLineExist@ */ /end MEASUREMENT
/begin MEASUREMENT TOS_RLane.dC0V "" FLOAT32_IEEE autosar_swc_tos_CM_single 0 0 -3.4E+38 3.4E+38 ECU_ADDRESS 0xfe4b4870 /* @ECU_Address@TOS_RLane.dC0V@ */ /end MEASUREMENT
/begin MEASUREMENT TOS_RLane.dC1V "" FLOAT32_IEEE autosar_swc_tos_CM_single 0 0 -3.4E+38 3.4E+38 ECU_ADDRESS 0xfe4b4874 /* @ECU_Address@TOS_RLane.dC1V@ */ /end MEASUREMENT
/begin MEASUREMENT TOS_RLane.dC2V "" FLOAT32_IEEE autosar_swc_tos_CM_single 0 0 -3.4E+38 3.4E+38 ECU_ADDRESS 0xfe4b4878 /* @ECU_Address@TOS_RLane.dC2V@ */ /end MEASUREMENT
/begin MEASUREMENT TOS_RLane.dC3V "" FLOAT32_IEEE autosar_swc_tos_CM_single 0 0 -3.4E+38 3.4E+38 ECU_ADDRESS 0xfe4b487c /* @ECU_Address@TOS_RLane.dC3V@ */ /end MEASUREMENT
/begin MEASUREMENT TOS_RLane.dC4V "" FLOAT32_IEEE autosar_swc_tos_CM_single 0 0 -3.4E+38 3.4E+38 ECU_ADDRESS 0xfe4b4880 /* @ECU_Address@TOS_RLane.dC4V@ */ /end MEASUREMENT
/begin MEASUREMENT TOS_RLane.dC5V "" FLOAT32_IEEE autosar_swc_tos_CM_single 0 0 -3.4E+38 3.4E+38 ECU_ADDRESS 0xfe4b4884 /* @ECU_Address@TOS_RLane.dC5V@ */ /end MEASUREMENT
/begin MEASUREMENT TOS_RLane.dDisFront "" FLOAT32_IEEE autosar_swc_tos_CM_single 0 0 -3.4E+38 3.4E+38 ECU_ADDRESS 0xfe4b4890 /* @ECU_Address@TOS_RLane.dDisFront@ */ /end MEASUREMENT
/begin MEASUREMENT TOS_RLane.dDisStart "" FLOAT32_IEEE autosar_swc_tos_CM_single 0 0 -3.4E+38 3.4E+38 ECU_ADDRESS 0xfe4b488c /* @ECU_Address@TOS_RLane.dDisStart@ */ /end MEASUREMENT
/begin MEASUREMENT TOS_RLane.dLaneWidth "" FLOAT32_IEEE autosar_swc_tos_CM_single 0 0 -3.4E+38 3.4E+38 ECU_ADDRESS 0xfe4b4898 /* @ECU_Address@TOS_RLane.dLaneWidth@ */ /end MEASUREMENT
/begin MEASUREMENT TOS_RLane.dQuality "" FLOAT32_IEEE autosar_swc_tos_CM_single 0 0 -3.4E+38 3.4E+38 ECU_ADDRESS 0xfe4b4894 /* @ECU_Address@TOS_RLane.dQuality@ */ /end MEASUREMENT
/begin MEASUREMENT TOS_RLane.eLineType "" UBYTE autosar_swc_tos_CM_uint8 0 0 0 255 ECU_ADDRESS 0xfe4b4888 /* @ECU_Address@TOS_RLane.eLineType@ */ /end MEASUREMENT
/begin MEASUREMENT TOS_RLane.eLinefusType "" UBYTE autosar_swc_tos_CM_uint8 0 0 0 255 ECU_ADDRESS 0xfe4b489c /* @ECU_Address@TOS_RLane.eLinefusType@ */ /end MEASUREMENT
/begin MEASUREMENT TOS_RR.Source "" UBYTE autosar_swc_tos_CM_uint8 0 0 0 255 ECU_ADDRESS 0xfe4b48a0 /* @ECU_Address@TOS_RR.Source@ */ /end MEASUREMENT
/begin MEASUREMENT TOS_RR.bIsLineExist "" UBYTE autosar_swc_tos_CM_uint8 0 0 0 255 ECU_ADDRESS 0xfe4b48a1 /* @ECU_Address@TOS_RR.bIsLineExist@ */ /end MEASUREMENT
/begin MEASUREMENT TOS_RR.dC0V "" FLOAT32_IEEE autosar_swc_tos_CM_single 0 0 -3.4E+38 3.4E+38 ECU_ADDRESS 0xfe4b48a4 /* @ECU_Address@TOS_RR.dC0V@ */ /end MEASUREMENT
/begin MEASUREMENT TOS_RR.dC1V "" FLOAT32_IEEE autosar_swc_tos_CM_single 0 0 -3.4E+38 3.4E+38 ECU_ADDRESS 0xfe4b48a8 /* @ECU_Address@TOS_RR.dC1V@ */ /end MEASUREMENT
/begin MEASUREMENT TOS_RR.dC2V "" FLOAT32_IEEE autosar_swc_tos_CM_single 0 0 -3.4E+38 3.4E+38 ECU_ADDRESS 0xfe4b48ac /* @ECU_Address@TOS_RR.dC2V@ */ /end MEASUREMENT
/begin MEASUREMENT TOS_RR.dC3V "" FLOAT32_IEEE autosar_swc_tos_CM_single 0 0 -3.4E+38 3.4E+38 ECU_ADDRESS 0xfe4b48b0 /* @ECU_Address@TOS_RR.dC3V@ */ /end MEASUREMENT
/begin MEASUREMENT TOS_RR.dC4V "" FLOAT32_IEEE autosar_swc_tos_CM_single 0 0 -3.4E+38 3.4E+38 ECU_ADDRESS 0xfe4b48b4 /* @ECU_Address@TOS_RR.dC4V@ */ /end MEASUREMENT
/begin MEASUREMENT TOS_RR.dC5V "" FLOAT32_IEEE autosar_swc_tos_CM_single 0 0 -3.4E+38 3.4E+38 ECU_ADDRESS 0xfe4b48b8 /* @ECU_Address@TOS_RR.dC5V@ */ /end MEASUREMENT
/begin MEASUREMENT TOS_RR.dDisFront "" FLOAT32_IEEE autosar_swc_tos_CM_single 0 0 -3.4E+38 3.4E+38 ECU_ADDRESS 0xfe4b48c4 /* @ECU_Address@TOS_RR.dDisFront@ */ /end MEASUREMENT
/begin MEASUREMENT TOS_RR.dDisStart "" FLOAT32_IEEE autosar_swc_tos_CM_single 0 0 -3.4E+38 3.4E+38 ECU_ADDRESS 0xfe4b48c0 /* @ECU_Address@TOS_RR.dDisStart@ */ /end MEASUREMENT
/begin MEASUREMENT TOS_RR.dLaneWidth "" FLOAT32_IEEE autosar_swc_tos_CM_single 0 0 -3.4E+38 3.4E+38 ECU_ADDRESS 0xfe4b48cc /* @ECU_Address@TOS_RR.dLaneWidth@ */ /end MEASUREMENT
/begin MEASUREMENT TOS_RR.dQuality "" FLOAT32_IEEE autosar_swc_tos_CM_single 0 0 -3.4E+38 3.4E+38 ECU_ADDRESS 0xfe4b48c8 /* @ECU_Address@TOS_RR.dQuality@ */ /end MEASUREMENT
/begin MEASUREMENT TOS_RR.eLineType "" UBYTE autosar_swc_tos_CM_uint8 0 0 0 255 ECU_ADDRESS 0xfe4b48bc /* @ECU_Address@TOS_RR.eLineType@ */ /end MEASUREMENT
/begin MEASUREMENT TOS_RR.eLinefusType "" UBYTE autosar_swc_tos_CM_uint8 0 0 0 255 ECU_ADDRESS 0xfe4b48d0 /* @ECU_Address@TOS_RR.eLinefusType@ */ /end MEASUREMENT
/begin MEASUREMENT TOS_UpdateCnt "" ULONG autosar_swc_tos_CM_uint32 0 0 0 4294967295 ECU_ADDRESS 0xfe4b48d4 /* @ECU_Address@TOS_UpdateCnt@ */ /end MEASUREMENT
/begin MEASUREMENT TOS_Version "" ULONG autosar_swc_tos_CM_uint32 0 0 0 4294967295 MATRIX_DIM 1 1 ECU_ADDRESS 0xfe4b48d8 /* @ECU_Address@TOS_Version@ */ /end MEASUREMENT
/begin MEASUREMENT TOS_reserve05 "" FLOAT32_IEEE autosar_swc_tos_CM_single 0 0 -3.4E+38 3.4E+38 ECU_ADDRESS 0xfe4b48e8 /* @ECU_Address@TOS_reserve05@ */ /end MEASUREMENT
/begin MEASUREMENT autosar_swc_tos_rtARID_DEF.LCSTS "" UBYTE autosar_swc_tos_CM_uint8 0 0 0 255 ECU_ADDRESS 0xfe4c9178 /* @ECU_Address@autosar_swc_tos_rtARID_DEF.LCSTS@ */ /end MEASUREMENT
/begin MEASUREMENT autosar_swc_tos_rtARID_DEF.Output_DSTATE_k "" UBYTE autosar_swc_tos_CM_uint8 0 0 0 255 ECU_ADDRESS 0xfe4c9181 /* @ECU_Address@autosar_swc_tos_rtARID_DEF.Output_DSTATE_k@ */ /end MEASUREMENT
/begin MEASUREMENT autosar_swc_tos_rtARID_DEF.is_active_c392_autosar_swc_tos "" UBYTE autosar_swc_tos_CM_uint8 0 0 0 255 ECU_ADDRESS 0xfe4c91ab /* @ECU_Address@autosar_swc_tos_rtARID_DEF.is_active_c392_autosar_swc_tos@ */ /end MEASUREMENT
/begin MEASUREMENT autosar_swc_tos_rtARID_DEF.is_c392_autosar_swc_tos "" UBYTE autosar_swc_tos_CM_uint8 0 0 0 255 ECU_ADDRESS 0xfe4c91ac /* @ECU_Address@autosar_swc_tos_rtARID_DEF.is_c392_autosar_swc_tos@ */ /end MEASUREMENT
/begin MEASUREMENT autosar_swc_tos_rtARID_DEF.time_cnt_l "" UBYTE autosar_swc_tos_CM_uint8 0 0 0 255 ECU_ADDRESS 0xfe4c91a9 /* @ECU_Address@autosar_swc_tos_rtARID_DEF.time_cnt_l@ */ /end MEASUREMENT
/begin MEASUREMENT autosar_swc_tos_rtARID_DEF.time_cnt_r "" UBYTE autosar_swc_tos_CM_uint8 0 0 0 255 ECU_ADDRESS 0xfe4c91aa /* @ECU_Address@autosar_swc_tos_rtARID_DEF.time_cnt_r@ */ /end MEASUREMENT
/begin COMPU_METHOD autosar_swc_tos_CM_SM_MODULE_STATUS "Enumerated data type: SM_MODULE_STATUS" TAB_VERB "%0.6" "" COMPU_TAB_REF VTAB_FOR_autosar_swc_tos_CM_SM_MODULE_STATUS /end COMPU_METHOD
/begin COMPU_VTAB VTAB_FOR_autosar_swc_tos_CM_SM_MODULE_STATUS "Enumerated data type: SM_MODULE_STATUS" TAB_VERB 4 0 "STATUS_NORMAL" 1 "STATUS_NOT_CONNECTED" 2 "STATUS_HEARTBEAT_MISSED" 3 "STATUS_ABNORMAL" /end COMPU_VTAB
/begin COMPU_METHOD autosar_swc_tos_CM_boolean "Q = V" IDENTICAL "%1.0" "" /end COMPU_METHOD
/begin COMPU_METHOD autosar_swc_tos_CM_double "Q = V" IDENTICAL "%15.10" "" /end COMPU_METHOD
/begin COMPU_METHOD autosar_swc_tos_CM_int32 "Q = V" IDENTICAL "%10.0" "" /end COMPU_METHOD
/begin COMPU_METHOD autosar_swc_tos_CM_single "Q = V" IDENTICAL "%8.6" "" /end COMPU_METHOD
/begin COMPU_METHOD autosar_swc_tos_CM_uint16 "Q = V" IDENTICAL "%5.0" "" /end COMPU_METHOD
/begin COMPU_METHOD autosar_swc_tos_CM_uint32 "Q = V" IDENTICAL "%10.0" "" /end COMPU_METHOD
/begin COMPU_METHOD autosar_swc_tos_CM_uint64 "Q = V" IDENTICAL "%20.0" "" /end COMPU_METHOD
/begin COMPU_METHOD autosar_swc_tos_CM_uint8 "Q = V" IDENTICAL "%3.0" "" /end COMPU_METHOD
/begin GROUP SwcOut_TOS_AEB[17] ""
 /begin REF_MEASUREMENT SwcOut_TOS_AEB[17].LeftLane_flag SwcOut_TOS_AEB[17].SameLane_flag SwcOut_TOS_AEB[17].RightLane_flag SwcOut_TOS_AEB[17].Object_Type SwcOut_TOS_AEB[17].Object_MovingState SwcOut_TOS_AEB[17].Object_Orientation SwcOut_TOS_AEB[17].Object_Turn_Signal SwcOut_TOS_AEB[17].Sceniaro_Flag SwcOut_TOS_AEB[17].CllsnMtgtnByBrkgPrimQly SwcOut_TOS_AEB[17].CllsnMtgtnByBrkgSecQly SwcOut_TOS_AEB[17].CllsnWarnFwdQly SwcOut_TOS_AEB[17].ramp SwcOut_TOS_AEB[17].Object_Fus_Type SwcOut_TOS_AEB[17].pro_flag SwcOut_TOS_AEB[17].Object_Length SwcOut_TOS_AEB[17].Object_Width SwcOut_TOS_AEB[17].Object_Hight SwcOut_TOS_AEB[17].Object_HeadingAngle SwcOut_TOS_AEB[17].Object_YawAngle SwcOut_TOS_AEB[17].Object_DX SwcOut_TOS_AEB[17].Object_DY SwcOut_TOS_AEB[17].Object_RangeX SwcOut_TOS_AEB[17].Object_RangeY SwcOut_TOS_AEB[17].Object_VX SwcOut_TOS_AEB[17].Object_VY SwcOut_TOS_AEB[17].Object_Abs_SPEED SwcOut_TOS_AEB[17].Object_Abs_VX SwcOut_TOS_AEB[17].Object_Abs_VY SwcOut_TOS_AEB[17].Object_AX SwcOut_TOS_AEB[17].Object_AY SwcOut_TOS_AEB[17].Object_Abs_AX SwcOut_TOS_AEB[17].Object_Abs_AY SwcOut_TOS_AEB[17].corner_left_front_x SwcOut_TOS_AEB[17].corner_left_front_y SwcOut_TOS_AEB[17].corner_right_front_x SwcOut_TOS_AEB[17].corner_right_front_y SwcOut_TOS_AEB[17].corner_left_rear_x SwcOut_TOS_AEB[17].corner_left_rear_y SwcOut_TOS_AEB[17].corner_right_rear_x SwcOut_TOS_AEB[17].corner_right_rear_y SwcOut_TOS_AEB[17].Object_ID SwcOut_TOS_AEB[17].camID SwcOut_TOS_AEB[17].Object_Age SwcOut_TOS_AEB[17].TimeStamp /end REF_MEASUREMENT
/end GROUP
/begin GROUP SwcOut_TOS_AEB[18] ""
 /begin REF_MEASUREMENT SwcOut_TOS_AEB[18].LeftLane_flag SwcOut_TOS_AEB[18].SameLane_flag SwcOut_TOS_AEB[18].RightLane_flag SwcOut_TOS_AEB[18].Object_Type SwcOut_TOS_AEB[18].Object_MovingState SwcOut_TOS_AEB[18].Object_Orientation SwcOut_TOS_AEB[18].Object_Turn_Signal SwcOut_TOS_AEB[18].Sceniaro_Flag SwcOut_TOS_AEB[18].CllsnMtgtnByBrkgPrimQly SwcOut_TOS_AEB[18].CllsnMtgtnByBrkgSecQly SwcOut_TOS_AEB[18].CllsnWarnFwdQly SwcOut_TOS_AEB[18].ramp SwcOut_TOS_AEB[18].Object_Fus_Type SwcOut_TOS_AEB[18].pro_flag SwcOut_TOS_AEB[18].Object_Length SwcOut_TOS_AEB[18].Object_Width SwcOut_TOS_AEB[18].Object_Hight SwcOut_TOS_AEB[18].Object_HeadingAngle SwcOut_TOS_AEB[18].Object_YawAngle SwcOut_TOS_AEB[18].Object_DX SwcOut_TOS_AEB[18].Object_DY SwcOut_TOS_AEB[18].Object_RangeX SwcOut_TOS_AEB[18].Object_RangeY SwcOut_TOS_AEB[18].Object_VX SwcOut_TOS_AEB[18].Object_VY SwcOut_TOS_AEB[18].Object_Abs_SPEED SwcOut_TOS_AEB[18].Object_Abs_VX SwcOut_TOS_AEB[18].Object_Abs_VY SwcOut_TOS_AEB[18].Object_AX SwcOut_TOS_AEB[18].Object_AY SwcOut_TOS_AEB[18].Object_Abs_AX SwcOut_TOS_AEB[18].Object_Abs_AY SwcOut_TOS_AEB[18].corner_left_front_x SwcOut_TOS_AEB[18].corner_left_front_y SwcOut_TOS_AEB[18].corner_right_front_x SwcOut_TOS_AEB[18].corner_right_front_y SwcOut_TOS_AEB[18].corner_left_rear_x SwcOut_TOS_AEB[18].corner_left_rear_y SwcOut_TOS_AEB[18].corner_right_rear_x SwcOut_TOS_AEB[18].corner_right_rear_y SwcOut_TOS_AEB[18].Object_ID SwcOut_TOS_AEB[18].camID SwcOut_TOS_AEB[18].Object_Age SwcOut_TOS_AEB[18].TimeStamp /end REF_MEASUREMENT
/end GROUP
/begin GROUP SwcOut_TOS_AEB[19] ""
 /begin REF_MEASUREMENT SwcOut_TOS_AEB[19].LeftLane_flag SwcOut_TOS_AEB[19].SameLane_flag SwcOut_TOS_AEB[19].RightLane_flag SwcOut_TOS_AEB[19].Object_Type SwcOut_TOS_AEB[19].Object_MovingState SwcOut_TOS_AEB[19].Object_Orientation SwcOut_TOS_AEB[19].Object_Turn_Signal SwcOut_TOS_AEB[19].Sceniaro_Flag SwcOut_TOS_AEB[19].CllsnMtgtnByBrkgPrimQly SwcOut_TOS_AEB[19].CllsnMtgtnByBrkgSecQly SwcOut_TOS_AEB[19].CllsnWarnFwdQly SwcOut_TOS_AEB[19].ramp SwcOut_TOS_AEB[19].Object_Fus_Type SwcOut_TOS_AEB[19].pro_flag SwcOut_TOS_AEB[19].Object_Length SwcOut_TOS_AEB[19].Object_Width SwcOut_TOS_AEB[19].Object_Hight SwcOut_TOS_AEB[19].Object_HeadingAngle SwcOut_TOS_AEB[19].Object_YawAngle SwcOut_TOS_AEB[19].Object_DX SwcOut_TOS_AEB[19].Object_DY SwcOut_TOS_AEB[19].Object_RangeX SwcOut_TOS_AEB[19].Object_RangeY SwcOut_TOS_AEB[19].Object_VX SwcOut_TOS_AEB[19].Object_VY SwcOut_TOS_AEB[19].Object_Abs_SPEED SwcOut_TOS_AEB[19].Object_Abs_VX SwcOut_TOS_AEB[19].Object_Abs_VY SwcOut_TOS_AEB[19].Object_AX SwcOut_TOS_AEB[19].Object_AY SwcOut_TOS_AEB[19].Object_Abs_AX SwcOut_TOS_AEB[19].Object_Abs_AY SwcOut_TOS_AEB[19].corner_left_front_x SwcOut_TOS_AEB[19].corner_left_front_y SwcOut_TOS_AEB[19].corner_right_front_x SwcOut_TOS_AEB[19].corner_right_front_y SwcOut_TOS_AEB[19].corner_left_rear_x SwcOut_TOS_AEB[19].corner_left_rear_y SwcOut_TOS_AEB[19].corner_right_rear_x SwcOut_TOS_AEB[19].corner_right_rear_y SwcOut_TOS_AEB[19].Object_ID SwcOut_TOS_AEB[19].camID SwcOut_TOS_AEB[19].Object_Age SwcOut_TOS_AEB[19].TimeStamp /end REF_MEASUREMENT
/end GROUP
/begin GROUP SwcOut_TOS_AEB[1] ""
 /begin REF_MEASUREMENT SwcOut_TOS_AEB[1].LeftLane_flag SwcOut_TOS_AEB[1].SameLane_flag SwcOut_TOS_AEB[1].RightLane_flag SwcOut_TOS_AEB[1].Object_Type SwcOut_TOS_AEB[1].Object_MovingState SwcOut_TOS_AEB[1].Object_Orientation SwcOut_TOS_AEB[1].Object_Turn_Signal SwcOut_TOS_AEB[1].Sceniaro_Flag SwcOut_TOS_AEB[1].CllsnMtgtnByBrkgPrimQly SwcOut_TOS_AEB[1].CllsnMtgtnByBrkgSecQly SwcOut_TOS_AEB[1].CllsnWarnFwdQly SwcOut_TOS_AEB[1].ramp SwcOut_TOS_AEB[1].Object_Fus_Type SwcOut_TOS_AEB[1].pro_flag SwcOut_TOS_AEB[1].Object_Length SwcOut_TOS_AEB[1].Object_Width SwcOut_TOS_AEB[1].Object_Hight SwcOut_TOS_AEB[1].Object_HeadingAngle SwcOut_TOS_AEB[1].Object_YawAngle SwcOut_TOS_AEB[1].Object_DX SwcOut_TOS_AEB[1].Object_DY SwcOut_TOS_AEB[1].Object_RangeX SwcOut_TOS_AEB[1].Object_RangeY SwcOut_TOS_AEB[1].Object_VX SwcOut_TOS_AEB[1].Object_VY SwcOut_TOS_AEB[1].Object_Abs_SPEED SwcOut_TOS_AEB[1].Object_Abs_VX SwcOut_TOS_AEB[1].Object_Abs_VY SwcOut_TOS_AEB[1].Object_AX SwcOut_TOS_AEB[1].Object_AY SwcOut_TOS_AEB[1].Object_Abs_AX SwcOut_TOS_AEB[1].Object_Abs_AY SwcOut_TOS_AEB[1].corner_left_front_x SwcOut_TOS_AEB[1].corner_left_front_y SwcOut_TOS_AEB[1].corner_right_front_x SwcOut_TOS_AEB[1].corner_right_front_y SwcOut_TOS_AEB[1].corner_left_rear_x SwcOut_TOS_AEB[1].corner_left_rear_y SwcOut_TOS_AEB[1].corner_right_rear_x SwcOut_TOS_AEB[1].corner_right_rear_y SwcOut_TOS_AEB[1].Object_ID SwcOut_TOS_AEB[1].camID SwcOut_TOS_AEB[1].Object_Age SwcOut_TOS_AEB[1].TimeStamp /end REF_MEASUREMENT
/end GROUP
/begin GROUP SwcOut_TOS_AEB[2] ""
 /begin REF_MEASUREMENT SwcOut_TOS_AEB[2].LeftLane_flag SwcOut_TOS_AEB[2].SameLane_flag SwcOut_TOS_AEB[2].RightLane_flag SwcOut_TOS_AEB[2].Object_Type SwcOut_TOS_AEB[2].Object_MovingState SwcOut_TOS_AEB[2].Object_Orientation SwcOut_TOS_AEB[2].Object_Turn_Signal SwcOut_TOS_AEB[2].Sceniaro_Flag SwcOut_TOS_AEB[2].CllsnMtgtnByBrkgPrimQly SwcOut_TOS_AEB[2].CllsnMtgtnByBrkgSecQly SwcOut_TOS_AEB[2].CllsnWarnFwdQly SwcOut_TOS_AEB[2].ramp SwcOut_TOS_AEB[2].Object_Fus_Type SwcOut_TOS_AEB[2].pro_flag SwcOut_TOS_AEB[2].Object_Length SwcOut_TOS_AEB[2].Object_Width SwcOut_TOS_AEB[2].Object_Hight SwcOut_TOS_AEB[2].Object_HeadingAngle SwcOut_TOS_AEB[2].Object_YawAngle SwcOut_TOS_AEB[2].Object_DX SwcOut_TOS_AEB[2].Object_DY SwcOut_TOS_AEB[2].Object_RangeX SwcOut_TOS_AEB[2].Object_RangeY SwcOut_TOS_AEB[2].Object_VX SwcOut_TOS_AEB[2].Object_VY SwcOut_TOS_AEB[2].Object_Abs_SPEED SwcOut_TOS_AEB[2].Object_Abs_VX SwcOut_TOS_AEB[2].Object_Abs_VY SwcOut_TOS_AEB[2].Object_AX SwcOut_TOS_AEB[2].Object_AY SwcOut_TOS_AEB[2].Object_Abs_AX SwcOut_TOS_AEB[2].Object_Abs_AY SwcOut_TOS_AEB[2].corner_left_front_x SwcOut_TOS_AEB[2].corner_left_front_y SwcOut_TOS_AEB[2].corner_right_front_x SwcOut_TOS_AEB[2].corner_right_front_y SwcOut_TOS_AEB[2].corner_left_rear_x SwcOut_TOS_AEB[2].corner_left_rear_y SwcOut_TOS_AEB[2].corner_right_rear_x SwcOut_TOS_AEB[2].corner_right_rear_y SwcOut_TOS_AEB[2].Object_ID SwcOut_TOS_AEB[2].camID SwcOut_TOS_AEB[2].Object_Age SwcOut_TOS_AEB[2].TimeStamp /end REF_MEASUREMENT
/end GROUP
/begin GROUP SwcOut_TOS_AEB[3] ""
 /begin REF_MEASUREMENT SwcOut_TOS_AEB[3].LeftLane_flag SwcOut_TOS_AEB[3].SameLane_flag SwcOut_TOS_AEB[3].RightLane_flag SwcOut_TOS_AEB[3].Object_Type SwcOut_TOS_AEB[3].Object_MovingState SwcOut_TOS_AEB[3].Object_Orientation SwcOut_TOS_AEB[3].Object_Turn_Signal SwcOut_TOS_AEB[3].Sceniaro_Flag SwcOut_TOS_AEB[3].CllsnMtgtnByBrkgPrimQly SwcOut_TOS_AEB[3].CllsnMtgtnByBrkgSecQly SwcOut_TOS_AEB[3].CllsnWarnFwdQly SwcOut_TOS_AEB[3].ramp SwcOut_TOS_AEB[3].Object_Fus_Type SwcOut_TOS_AEB[3].pro_flag SwcOut_TOS_AEB[3].Object_Length SwcOut_TOS_AEB[3].Object_Width SwcOut_TOS_AEB[3].Object_Hight SwcOut_TOS_AEB[3].Object_HeadingAngle SwcOut_TOS_AEB[3].Object_YawAngle SwcOut_TOS_AEB[3].Object_DX SwcOut_TOS_AEB[3].Object_DY SwcOut_TOS_AEB[3].Object_RangeX SwcOut_TOS_AEB[3].Object_RangeY SwcOut_TOS_AEB[3].Object_VX SwcOut_TOS_AEB[3].Object_VY SwcOut_TOS_AEB[3].Object_Abs_SPEED SwcOut_TOS_AEB[3].Object_Abs_VX SwcOut_TOS_AEB[3].Object_Abs_VY SwcOut_TOS_AEB[3].Object_AX SwcOut_TOS_AEB[3].Object_AY SwcOut_TOS_AEB[3].Object_Abs_AX SwcOut_TOS_AEB[3].Object_Abs_AY SwcOut_TOS_AEB[3].corner_left_front_x SwcOut_TOS_AEB[3].corner_left_front_y SwcOut_TOS_AEB[3].corner_right_front_x SwcOut_TOS_AEB[3].corner_right_front_y SwcOut_TOS_AEB[3].corner_left_rear_x SwcOut_TOS_AEB[3].corner_left_rear_y SwcOut_TOS_AEB[3].corner_right_rear_x SwcOut_TOS_AEB[3].corner_right_rear_y SwcOut_TOS_AEB[3].Object_ID SwcOut_TOS_AEB[3].camID SwcOut_TOS_AEB[3].Object_Age SwcOut_TOS_AEB[3].TimeStamp /end REF_MEASUREMENT
/end GROUP
/begin GROUP SwcOut_TOS_AEB[4] ""
 /begin REF_MEASUREMENT SwcOut_TOS_AEB[4].LeftLane_flag SwcOut_TOS_AEB[4].SameLane_flag SwcOut_TOS_AEB[4].RightLane_flag SwcOut_TOS_AEB[4].Object_Type SwcOut_TOS_AEB[4].Object_MovingState SwcOut_TOS_AEB[4].Object_Orientation SwcOut_TOS_AEB[4].Object_Turn_Signal SwcOut_TOS_AEB[4].Sceniaro_Flag SwcOut_TOS_AEB[4].CllsnMtgtnByBrkgPrimQly SwcOut_TOS_AEB[4].CllsnMtgtnByBrkgSecQly SwcOut_TOS_AEB[4].CllsnWarnFwdQly SwcOut_TOS_AEB[4].ramp SwcOut_TOS_AEB[4].Object_Fus_Type SwcOut_TOS_AEB[4].pro_flag SwcOut_TOS_AEB[4].Object_Length SwcOut_TOS_AEB[4].Object_Width SwcOut_TOS_AEB[4].Object_Hight SwcOut_TOS_AEB[4].Object_HeadingAngle SwcOut_TOS_AEB[4].Object_YawAngle SwcOut_TOS_AEB[4].Object_DX SwcOut_TOS_AEB[4].Object_DY SwcOut_TOS_AEB[4].Object_RangeX SwcOut_TOS_AEB[4].Object_RangeY SwcOut_TOS_AEB[4].Object_VX SwcOut_TOS_AEB[4].Object_VY SwcOut_TOS_AEB[4].Object_Abs_SPEED SwcOut_TOS_AEB[4].Object_Abs_VX SwcOut_TOS_AEB[4].Object_Abs_VY SwcOut_TOS_AEB[4].Object_AX SwcOut_TOS_AEB[4].Object_AY SwcOut_TOS_AEB[4].Object_Abs_AX SwcOut_TOS_AEB[4].Object_Abs_AY SwcOut_TOS_AEB[4].corner_left_front_x SwcOut_TOS_AEB[4].corner_left_front_y SwcOut_TOS_AEB[4].corner_right_front_x SwcOut_TOS_AEB[4].corner_right_front_y SwcOut_TOS_AEB[4].corner_left_rear_x SwcOut_TOS_AEB[4].corner_left_rear_y SwcOut_TOS_AEB[4].corner_right_rear_x SwcOut_TOS_AEB[4].corner_right_rear_y SwcOut_TOS_AEB[4].Object_ID SwcOut_TOS_AEB[4].camID SwcOut_TOS_AEB[4].Object_Age SwcOut_TOS_AEB[4].TimeStamp /end REF_MEASUREMENT
/end GROUP
/begin GROUP SwcOut_TOS_AEB[5] ""
 /begin REF_MEASUREMENT SwcOut_TOS_AEB[5].LeftLane_flag SwcOut_TOS_AEB[5].SameLane_flag SwcOut_TOS_AEB[5].RightLane_flag SwcOut_TOS_AEB[5].Object_Type SwcOut_TOS_AEB[5].Object_MovingState SwcOut_TOS_AEB[5].Object_Orientation SwcOut_TOS_AEB[5].Object_Turn_Signal SwcOut_TOS_AEB[5].Sceniaro_Flag SwcOut_TOS_AEB[5].CllsnMtgtnByBrkgPrimQly SwcOut_TOS_AEB[5].CllsnMtgtnByBrkgSecQly SwcOut_TOS_AEB[5].CllsnWarnFwdQly SwcOut_TOS_AEB[5].ramp SwcOut_TOS_AEB[5].Object_Fus_Type SwcOut_TOS_AEB[5].pro_flag SwcOut_TOS_AEB[5].Object_Length SwcOut_TOS_AEB[5].Object_Width SwcOut_TOS_AEB[5].Object_Hight SwcOut_TOS_AEB[5].Object_HeadingAngle SwcOut_TOS_AEB[5].Object_YawAngle SwcOut_TOS_AEB[5].Object_DX SwcOut_TOS_AEB[5].Object_DY SwcOut_TOS_AEB[5].Object_RangeX SwcOut_TOS_AEB[5].Object_RangeY SwcOut_TOS_AEB[5].Object_VX SwcOut_TOS_AEB[5].Object_VY SwcOut_TOS_AEB[5].Object_Abs_SPEED SwcOut_TOS_AEB[5].Object_Abs_VX SwcOut_TOS_AEB[5].Object_Abs_VY SwcOut_TOS_AEB[5].Object_AX SwcOut_TOS_AEB[5].Object_AY SwcOut_TOS_AEB[5].Object_Abs_AX SwcOut_TOS_AEB[5].Object_Abs_AY SwcOut_TOS_AEB[5].corner_left_front_x SwcOut_TOS_AEB[5].corner_left_front_y SwcOut_TOS_AEB[5].corner_right_front_x SwcOut_TOS_AEB[5].corner_right_front_y SwcOut_TOS_AEB[5].corner_left_rear_x SwcOut_TOS_AEB[5].corner_left_rear_y SwcOut_TOS_AEB[5].corner_right_rear_x SwcOut_TOS_AEB[5].corner_right_rear_y SwcOut_TOS_AEB[5].Object_ID SwcOut_TOS_AEB[5].camID SwcOut_TOS_AEB[5].Object_Age SwcOut_TOS_AEB[5].TimeStamp /end REF_MEASUREMENT
/end GROUP
/begin GROUP SwcOut_TOS_AEB[6] ""
 /begin REF_MEASUREMENT SwcOut_TOS_AEB[6].LeftLane_flag SwcOut_TOS_AEB[6].SameLane_flag SwcOut_TOS_AEB[6].RightLane_flag SwcOut_TOS_AEB[6].Object_Type SwcOut_TOS_AEB[6].Object_MovingState SwcOut_TOS_AEB[6].Object_Orientation SwcOut_TOS_AEB[6].Object_Turn_Signal SwcOut_TOS_AEB[6].Sceniaro_Flag SwcOut_TOS_AEB[6].CllsnMtgtnByBrkgPrimQly SwcOut_TOS_AEB[6].CllsnMtgtnByBrkgSecQly SwcOut_TOS_AEB[6].CllsnWarnFwdQly SwcOut_TOS_AEB[6].ramp SwcOut_TOS_AEB[6].Object_Fus_Type SwcOut_TOS_AEB[6].pro_flag SwcOut_TOS_AEB[6].Object_Length SwcOut_TOS_AEB[6].Object_Width SwcOut_TOS_AEB[6].Object_Hight SwcOut_TOS_AEB[6].Object_HeadingAngle SwcOut_TOS_AEB[6].Object_YawAngle SwcOut_TOS_AEB[6].Object_DX SwcOut_TOS_AEB[6].Object_DY SwcOut_TOS_AEB[6].Object_RangeX SwcOut_TOS_AEB[6].Object_RangeY SwcOut_TOS_AEB[6].Object_VX SwcOut_TOS_AEB[6].Object_VY SwcOut_TOS_AEB[6].Object_Abs_SPEED SwcOut_TOS_AEB[6].Object_Abs_VX SwcOut_TOS_AEB[6].Object_Abs_VY SwcOut_TOS_AEB[6].Object_AX SwcOut_TOS_AEB[6].Object_AY SwcOut_TOS_AEB[6].Object_Abs_AX SwcOut_TOS_AEB[6].Object_Abs_AY SwcOut_TOS_AEB[6].corner_left_front_x SwcOut_TOS_AEB[6].corner_left_front_y SwcOut_TOS_AEB[6].corner_right_front_x SwcOut_TOS_AEB[6].corner_right_front_y SwcOut_TOS_AEB[6].corner_left_rear_x SwcOut_TOS_AEB[6].corner_left_rear_y SwcOut_TOS_AEB[6].corner_right_rear_x SwcOut_TOS_AEB[6].corner_right_rear_y SwcOut_TOS_AEB[6].Object_ID SwcOut_TOS_AEB[6].camID SwcOut_TOS_AEB[6].Object_Age SwcOut_TOS_AEB[6].TimeStamp /end REF_MEASUREMENT
/end GROUP
/begin GROUP SwcOut_TOS_AEB[7] ""
 /begin REF_MEASUREMENT SwcOut_TOS_AEB[7].LeftLane_flag SwcOut_TOS_AEB[7].SameLane_flag SwcOut_TOS_AEB[7].RightLane_flag SwcOut_TOS_AEB[7].Object_Type SwcOut_TOS_AEB[7].Object_MovingState SwcOut_TOS_AEB[7].Object_Orientation SwcOut_TOS_AEB[7].Object_Turn_Signal SwcOut_TOS_AEB[7].Sceniaro_Flag SwcOut_TOS_AEB[7].CllsnMtgtnByBrkgPrimQly SwcOut_TOS_AEB[7].CllsnMtgtnByBrkgSecQly SwcOut_TOS_AEB[7].CllsnWarnFwdQly SwcOut_TOS_AEB[7].ramp SwcOut_TOS_AEB[7].Object_Fus_Type SwcOut_TOS_AEB[7].pro_flag SwcOut_TOS_AEB[7].Object_Length SwcOut_TOS_AEB[7].Object_Width SwcOut_TOS_AEB[7].Object_Hight SwcOut_TOS_AEB[7].Object_HeadingAngle SwcOut_TOS_AEB[7].Object_YawAngle SwcOut_TOS_AEB[7].Object_DX SwcOut_TOS_AEB[7].Object_DY SwcOut_TOS_AEB[7].Object_RangeX SwcOut_TOS_AEB[7].Object_RangeY SwcOut_TOS_AEB[7].Object_VX SwcOut_TOS_AEB[7].Object_VY SwcOut_TOS_AEB[7].Object_Abs_SPEED SwcOut_TOS_AEB[7].Object_Abs_VX SwcOut_TOS_AEB[7].Object_Abs_VY SwcOut_TOS_AEB[7].Object_AX SwcOut_TOS_AEB[7].Object_AY SwcOut_TOS_AEB[7].Object_Abs_AX SwcOut_TOS_AEB[7].Object_Abs_AY SwcOut_TOS_AEB[7].corner_left_front_x SwcOut_TOS_AEB[7].corner_left_front_y SwcOut_TOS_AEB[7].corner_right_front_x SwcOut_TOS_AEB[7].corner_right_front_y SwcOut_TOS_AEB[7].corner_left_rear_x SwcOut_TOS_AEB[7].corner_left_rear_y SwcOut_TOS_AEB[7].corner_right_rear_x SwcOut_TOS_AEB[7].corner_right_rear_y SwcOut_TOS_AEB[7].Object_ID SwcOut_TOS_AEB[7].camID SwcOut_TOS_AEB[7].Object_Age SwcOut_TOS_AEB[7].TimeStamp /end REF_MEASUREMENT
/end GROUP
/begin GROUP SwcOut_TOS_AEB[8] ""
 /begin REF_MEASUREMENT SwcOut_TOS_AEB[8].LeftLane_flag SwcOut_TOS_AEB[8].SameLane_flag SwcOut_TOS_AEB[8].RightLane_flag SwcOut_TOS_AEB[8].Object_Type SwcOut_TOS_AEB[8].Object_MovingState SwcOut_TOS_AEB[8].Object_Orientation SwcOut_TOS_AEB[8].Object_Turn_Signal SwcOut_TOS_AEB[8].Sceniaro_Flag SwcOut_TOS_AEB[8].CllsnMtgtnByBrkgPrimQly SwcOut_TOS_AEB[8].CllsnMtgtnByBrkgSecQly SwcOut_TOS_AEB[8].CllsnWarnFwdQly SwcOut_TOS_AEB[8].ramp SwcOut_TOS_AEB[8].Object_Fus_Type SwcOut_TOS_AEB[8].pro_flag SwcOut_TOS_AEB[8].Object_Length SwcOut_TOS_AEB[8].Object_Width SwcOut_TOS_AEB[8].Object_Hight SwcOut_TOS_AEB[8].Object_HeadingAngle SwcOut_TOS_AEB[8].Object_YawAngle SwcOut_TOS_AEB[8].Object_DX SwcOut_TOS_AEB[8].Object_DY SwcOut_TOS_AEB[8].Object_RangeX SwcOut_TOS_AEB[8].Object_RangeY SwcOut_TOS_AEB[8].Object_VX SwcOut_TOS_AEB[8].Object_VY SwcOut_TOS_AEB[8].Object_Abs_SPEED SwcOut_TOS_AEB[8].Object_Abs_VX SwcOut_TOS_AEB[8].Object_Abs_VY SwcOut_TOS_AEB[8].Object_AX SwcOut_TOS_AEB[8].Object_AY SwcOut_TOS_AEB[8].Object_Abs_AX SwcOut_TOS_AEB[8].Object_Abs_AY SwcOut_TOS_AEB[8].corner_left_front_x SwcOut_TOS_AEB[8].corner_left_front_y SwcOut_TOS_AEB[8].corner_right_front_x SwcOut_TOS_AEB[8].corner_right_front_y SwcOut_TOS_AEB[8].corner_left_rear_x SwcOut_TOS_AEB[8].corner_left_rear_y SwcOut_TOS_AEB[8].corner_right_rear_x SwcOut_TOS_AEB[8].corner_right_rear_y SwcOut_TOS_AEB[8].Object_ID SwcOut_TOS_AEB[8].camID SwcOut_TOS_AEB[8].Object_Age SwcOut_TOS_AEB[8].TimeStamp /end REF_MEASUREMENT
/end GROUP
/begin GROUP SwcOut_TOS_AEB[9] ""
 /begin REF_MEASUREMENT SwcOut_TOS_AEB[9].LeftLane_flag SwcOut_TOS_AEB[9].SameLane_flag SwcOut_TOS_AEB[9].RightLane_flag SwcOut_TOS_AEB[9].Object_Type SwcOut_TOS_AEB[9].Object_MovingState SwcOut_TOS_AEB[9].Object_Orientation SwcOut_TOS_AEB[9].Object_Turn_Signal SwcOut_TOS_AEB[9].Sceniaro_Flag SwcOut_TOS_AEB[9].CllsnMtgtnByBrkgPrimQly SwcOut_TOS_AEB[9].CllsnMtgtnByBrkgSecQly SwcOut_TOS_AEB[9].CllsnWarnFwdQly SwcOut_TOS_AEB[9].ramp SwcOut_TOS_AEB[9].Object_Fus_Type SwcOut_TOS_AEB[9].pro_flag SwcOut_TOS_AEB[9].Object_Length SwcOut_TOS_AEB[9].Object_Width SwcOut_TOS_AEB[9].Object_Hight SwcOut_TOS_AEB[9].Object_HeadingAngle SwcOut_TOS_AEB[9].Object_YawAngle SwcOut_TOS_AEB[9].Object_DX SwcOut_TOS_AEB[9].Object_DY SwcOut_TOS_AEB[9].Object_RangeX SwcOut_TOS_AEB[9].Object_RangeY SwcOut_TOS_AEB[9].Object_VX SwcOut_TOS_AEB[9].Object_VY SwcOut_TOS_AEB[9].Object_Abs_SPEED SwcOut_TOS_AEB[9].Object_Abs_VX SwcOut_TOS_AEB[9].Object_Abs_VY SwcOut_TOS_AEB[9].Object_AX SwcOut_TOS_AEB[9].Object_AY SwcOut_TOS_AEB[9].Object_Abs_AX SwcOut_TOS_AEB[9].Object_Abs_AY SwcOut_TOS_AEB[9].corner_left_front_x SwcOut_TOS_AEB[9].corner_left_front_y SwcOut_TOS_AEB[9].corner_right_front_x SwcOut_TOS_AEB[9].corner_right_front_y SwcOut_TOS_AEB[9].corner_left_rear_x SwcOut_TOS_AEB[9].corner_left_rear_y SwcOut_TOS_AEB[9].corner_right_rear_x SwcOut_TOS_AEB[9].corner_right_rear_y SwcOut_TOS_AEB[9].Object_ID SwcOut_TOS_AEB[9].camID SwcOut_TOS_AEB[9].Object_Age SwcOut_TOS_AEB[9].TimeStamp /end REF_MEASUREMENT
/end GROUP
/begin GROUP SwcOut_TOS_HWA ""
 /begin REF_MEASUREMENT SwcOut_TOS_HWA.LeftLane_flag SwcOut_TOS_HWA.SameLane_flag SwcOut_TOS_HWA.RightLane_flag SwcOut_TOS_HWA.Object_Type SwcOut_TOS_HWA.Object_MovingState SwcOut_TOS_HWA.Object_Orientation SwcOut_TOS_HWA.Object_Turn_Signal SwcOut_TOS_HWA.Object_Fus_Type SwcOut_TOS_HWA.Object_Length SwcOut_TOS_HWA.Object_Width SwcOut_TOS_HWA.Object_Hight SwcOut_TOS_HWA.Object_HeadingAngle SwcOut_TOS_HWA.Object_YawAngle SwcOut_TOS_HWA.Object_DX SwcOut_TOS_HWA.Object_DY SwcOut_TOS_HWA.Object_VX SwcOut_TOS_HWA.Object_VY SwcOut_TOS_HWA.Object_Abs_VX SwcOut_TOS_HWA.Object_Abs_VY SwcOut_TOS_HWA.Object_Abs_AX SwcOut_TOS_HWA.Object_Abs_AY SwcOut_TOS_HWA.corner_left_front_x SwcOut_TOS_HWA.corner_left_front_y SwcOut_TOS_HWA.corner_right_front_x SwcOut_TOS_HWA.corner_right_front_y SwcOut_TOS_HWA.corner_left_rear_x SwcOut_TOS_HWA.corner_left_rear_y SwcOut_TOS_HWA.corner_right_rear_x SwcOut_TOS_HWA.corner_right_rear_y SwcOut_TOS_HWA.Object_ID SwcOut_TOS_HWA.Object_Age /end REF_MEASUREMENT
/end GROUP
/begin GROUP SwcOut_TOS_Herbeat_Info ""
 /begin REF_MEASUREMENT SwcOut_TOS_Herbeat_Info.swc_id SwcOut_TOS_Herbeat_Info.sequence_num SwcOut_TOS_Herbeat_Info.inner_error SwcOut_TOS_Herbeat_Info.module_status /end REF_MEASUREMENT
/end GROUP
/begin GROUP SwcOut_TOS_LM_LL ""
 /begin REF_MEASUREMENT SwcOut_TOS_LM_LL.pC0 SwcOut_TOS_LM_LL.pC1 SwcOut_TOS_LM_LL.pC2 SwcOut_TOS_LM_LL.pC3 SwcOut_TOS_LM_LL.pC4 SwcOut_TOS_LM_LL.pC5 SwcOut_TOS_LM_LL.dDisStart SwcOut_TOS_LM_LL.dDisEnd SwcOut_TOS_LM_LL.dQuality SwcOut_TOS_LM_LL.fCamValid /end REF_MEASUREMENT
/end GROUP
/begin GROUP SwcOut_TOS_LM_LR ""
 /begin REF_MEASUREMENT SwcOut_TOS_LM_LR.pC0 SwcOut_TOS_LM_LR.pC1 SwcOut_TOS_LM_LR.pC2 SwcOut_TOS_LM_LR.pC3 SwcOut_TOS_LM_LR.pC4 SwcOut_TOS_LM_LR.pC5 SwcOut_TOS_LM_LR.dDisStart SwcOut_TOS_LM_LR.dDisEnd SwcOut_TOS_LM_LR.dQuality SwcOut_TOS_LM_LR.fCamValid /end REF_MEASUREMENT
/end GROUP
/begin GROUP SwcOut_TOS_LM_RL ""
 /begin REF_MEASUREMENT SwcOut_TOS_LM_RL.pC0 SwcOut_TOS_LM_RL.pC1 SwcOut_TOS_LM_RL.pC2 SwcOut_TOS_LM_RL.pC3 SwcOut_TOS_LM_RL.pC4 SwcOut_TOS_LM_RL.pC5 SwcOut_TOS_LM_RL.dDisStart SwcOut_TOS_LM_RL.dDisEnd SwcOut_TOS_LM_RL.dQuality SwcOut_TOS_LM_RL.fCamValid /end REF_MEASUREMENT
/end GROUP
/begin GROUP SwcOut_TOS_LM_RR ""
 /begin REF_MEASUREMENT SwcOut_TOS_LM_RR.pC0 SwcOut_TOS_LM_RR.pC1 SwcOut_TOS_LM_RR.pC2 SwcOut_TOS_LM_RR.pC3 SwcOut_TOS_LM_RR.pC4 SwcOut_TOS_LM_RR.pC5 SwcOut_TOS_LM_RR.dDisStart SwcOut_TOS_LM_RR.dDisEnd SwcOut_TOS_LM_RR.dQuality SwcOut_TOS_LM_RR.fCamValid /end REF_MEASUREMENT
/end GROUP
/begin GROUP SwcOut_TOS_LcSts ""
 /begin REF_MEASUREMENT SwcOut_TOS_LcSts.Lc SwcOut_TOS_LcSts.LC_Left SwcOut_TOS_LcSts.LC_Right /end REF_MEASUREMENT
/end GROUP
/begin GROUP SwcOut_TOS_SecondSele_Object ""
 /begin REF_MEASUREMENT SwcOut_TOS_SecondSele_Object.movingState SwcOut_TOS_SecondSele_Object.orientation SwcOut_TOS_SecondSele_Object.type SwcOut_TOS_SecondSele_Object.fu_type SwcOut_TOS_SecondSele_Object.id SwcOut_TOS_SecondSele_Object.dx SwcOut_TOS_SecondSele_Object.dy SwcOut_TOS_SecondSele_Object.vxRel SwcOut_TOS_SecondSele_Object.vyRel SwcOut_TOS_SecondSele_Object.headingAngle SwcOut_TOS_SecondSele_Object.length SwcOut_TOS_SecondSele_Object.width SwcOut_TOS_SecondSele_Object.ax SwcOut_TOS_SecondSele_Object.ay /end REF_MEASUREMENT
/end GROUP
/begin GROUP TOS_ExecTimestamp ""
 /begin REF_MEASUREMENT TOS_ExecTimestamp.timeBaseStatus TOS_ExecTimestamp.nanoseconds TOS_ExecTimestamp.seconds /end REF_MEASUREMENT
/end GROUP
/begin GROUP TOS_HLane ""
 /begin REF_MEASUREMENT TOS_HLane.Source TOS_HLane.bIsLineExist TOS_HLane.dC0V TOS_HLane.dC1V TOS_HLane.dC2V TOS_HLane.dC3V TOS_HLane.dC4V TOS_HLane.dC5V TOS_HLane.eLineType TOS_HLane.dDisStart TOS_HLane.dDisFront TOS_HLane.dQuality TOS_HLane.dLaneWidth TOS_HLane.eLinefusType /end REF_MEASUREMENT
/end GROUP
/begin GROUP TOS_LL ""
 /begin REF_MEASUREMENT TOS_LL.Source TOS_LL.bIsLineExist TOS_LL.dC0V TOS_LL.dC1V TOS_LL.dC2V TOS_LL.dC3V TOS_LL.dC4V TOS_LL.dC5V TOS_LL.eLineType TOS_LL.dDisStart TOS_LL.dDisFront TOS_LL.dQuality TOS_LL.dLaneWidth TOS_LL.eLinefusType /end REF_MEASUREMENT
/end GROUP
/begin GROUP TOS_LLane ""
 /begin REF_MEASUREMENT TOS_LLane.Source TOS_LLane.bIsLineExist TOS_LLane.dC0V TOS_LLane.dC1V TOS_LLane.dC2V TOS_LLane.dC3V TOS_LLane.dC4V TOS_LLane.dC5V TOS_LLane.eLineType TOS_LLane.dDisStart TOS_LLane.dDisFront TOS_LLane.dQuality TOS_LLane.dLaneWidth TOS_LLane.eLinefusType /end REF_MEASUREMENT
/end GROUP
/begin GROUP TOS_LR ""
 /begin REF_MEASUREMENT TOS_LR.Source TOS_LR.bIsLineExist TOS_LR.dC0V TOS_LR.dC1V TOS_LR.dC2V TOS_LR.dC3V TOS_LR.dC4V TOS_LR.dC5V TOS_LR.eLineType TOS_LR.dDisStart TOS_LR.dDisFront TOS_LR.dQuality TOS_LR.dLaneWidth TOS_LR.eLinefusType /end REF_MEASUREMENT
/end GROUP
/begin GROUP TOS_OFM_OBJs ""
 /begin REF_MEASUREMENT TOS_OFM_OBJs.fu_type TOS_OFM_OBJs.exist_prob TOS_OFM_OBJs.type_prob TOS_OFM_OBJs.headingAngle TOS_OFM_OBJs.ID TOS_OFM_OBJs.Cipv_flag TOS_OFM_OBJs.age TOS_OFM_OBJs.movingSts TOS_OFM_OBJs.type TOS_OFM_OBJs.vxAbs TOS_OFM_OBJs.vyAbs TOS_OFM_OBJs.axAbs TOS_OFM_OBJs.ayAbs TOS_OFM_OBJs.Length TOS_OFM_OBJs.Width TOS_OFM_OBJs.Hight TOS_OFM_OBJs.dx TOS_OFM_OBJs.dy TOS_OFM_OBJs.yawAngle TOS_OFM_OBJs.orientation TOS_OFM_OBJs.MovDir TOS_OFM_OBJs.FL_dx TOS_OFM_OBJs.FL_dy TOS_OFM_OBJs.FR_dx TOS_OFM_OBJs.FR_dy TOS_OFM_OBJs.RL_dx TOS_OFM_OBJs.RL_dy TOS_OFM_OBJs.RR_dx TOS_OFM_OBJs.RR_dy TOS_OFM_OBJs.breakLmpSts TOS_OFM_OBJs.camCutInFlag TOS_OFM_OBJs.turnLmpSts TOS_OFM_OBJs.camObjLaneAssignment TOS_OFM_OBJs.camDx TOS_OFM_OBJs.camDy TOS_OFM_OBJs.camCutInSpd TOS_OFM_OBJs.camID TOS_OFM_OBJs.camCutInDist TOS_OFM_OBJs.vxRel TOS_OFM_OBJs.vyRel TOS_OFM_OBJs.axRel TOS_OFM_OBJs.ayRel TOS_OFM_OBJs.offset_flag TOS_OFM_OBJs.offset_value TOS_OFM_OBJs.OverlapRatio_LM TOS_OFM_OBJs.OverlapRatio_OTL TOS_OFM_OBJs.DistIn_Lane TOS_OFM_OBJs.DistOut_Lane TOS_OFM_OBJs.CutIn_Flag TOS_OFM_OBJs.Obj_CutIn TOS_OFM_OBJs.Obj_CutOut TOS_OFM_OBJs.PressedLaneSts TOS_OFM_OBJs.Dis_Lateral TOS_OFM_OBJs.LcDis_Lateral TOS_OFM_OBJs.SameLaneConfirms /end REF_MEASUREMENT
/end GROUP
/begin GROUP TOS_RL ""
 /begin REF_MEASUREMENT TOS_RL.Source TOS_RL.bIsLineExist TOS_RL.dC0V TOS_RL.dC1V TOS_RL.dC2V TOS_RL.dC3V TOS_RL.dC4V TOS_RL.dC5V TOS_RL.eLineType TOS_RL.dDisStart TOS_RL.dDisFront TOS_RL.dQuality TOS_RL.dLaneWidth TOS_RL.eLinefusType /end REF_MEASUREMENT
/end GROUP
/begin GROUP TOS_RLane ""
 /begin REF_MEASUREMENT TOS_RLane.Source TOS_RLane.bIsLineExist TOS_RLane.dC0V TOS_RLane.dC1V TOS_RLane.dC2V TOS_RLane.dC3V TOS_RLane.dC4V TOS_RLane.dC5V TOS_RLane.eLineType TOS_RLane.dDisStart TOS_RLane.dDisFront TOS_RLane.dQuality TOS_RLane.dLaneWidth TOS_RLane.eLinefusType /end REF_MEASUREMENT
/end GROUP
/begin GROUP TOS_RR ""
 /begin REF_MEASUREMENT TOS_RR.Source TOS_RR.bIsLineExist TOS_RR.dC0V TOS_RR.dC1V TOS_RR.dC2V TOS_RR.dC3V TOS_RR.dC4V TOS_RR.dC5V TOS_RR.eLineType TOS_RR.dDisStart TOS_RR.dDisFront TOS_RR.dQuality TOS_RR.dLaneWidth TOS_RR.eLinefusType /end REF_MEASUREMENT
/end GROUP
/begin GROUP ZDrive_BSW_Cal_Cal "" /begin SUB_GROUP ZDrive_BSW_Cal_Cal.ZDrive_BSW_Cal_VehicleInfomationTable /end SUB_GROUP /end GROUP
/begin GROUP autosar_swc_tos "autosar_swc_tos" ROOT /begin SUB_GROUP TOS_ExecTimestamp autosar_swc_tos_autosar_swc_tos_Step_sys /end SUB_GROUP /end GROUP
/begin GROUP autosar_swc_tos_autosar_swc_tos_Step_sys "autosar_swc_tos/autosar_swc_tos_Step_sys"
 /begin SUB_GROUP autosar_swc_tos_autosar_swc_tos_Step_sys_Counter_Limited autosar_swc_tos_autosar_swc_tos_Step_sys_TOS_main autosar_swc_tos_autosar_swc_tos_Step_sys_Tos_inport /end SUB_GROUP
 /begin REF_MEASUREMENT TOS_UpdateCnt TOS_Version /end REF_MEASUREMENT
/end GROUP
/begin GROUP autosar_swc_tos_autosar_swc_tos_Step_sys_Counter_Limited "autosar_swc_tos/autosar_swc_tos_Step_sys/Counter\nLimited" /begin REF_MEASUREMENT autosar_swc_tos_rtARID_DEF.Output_DSTATE_k /end REF_MEASUREMENT /end GROUP
/begin GROUP autosar_swc_tos_autosar_swc_tos_Step_sys_TOS_main "autosar_swc_tos/autosar_swc_tos_Step_sys/TOS_main"
 /begin SUB_GROUP autosar_swc_tos_autosar_swc_tos_Step_sys_TOS_main_Ego_Veh_LC_Sts1 autosar_swc_tos_autosar_swc_tos_Step_sys_TOS_main_LM_Model autosar_swc_tos_autosar_swc_tos_Step_sys_TOS_main_Output_Model autosar_swc_tos_autosar_swc_tos_Step_sys_TOS_main_TOS_ACC autosar_swc_tos_autosar_swc_tos_Step_sys_TOS_main_TOS_P0_TARGET_LINE /end SUB_GROUP
/end GROUP
/begin GROUP autosar_swc_tos_autosar_swc_tos_Step_sys_TOS_main_Ego_Veh_LC_Sts1 "autosar_swc_tos/autosar_swc_tos_Step_sys/TOS_main/Ego_Veh_LC_Sts1"
 /begin SUB_GROUP autosar_swc_tos_autosar_swc_tos_Step_sys_TOS_main_Ego_Veh_LC_Sts1_LaneChanging autosar_swc_tos_autosar_swc_tos_Step_sys_TOS_main_Ego_Veh_LC_Sts1_Subsystem autosar_swc_tos_autosar_swc_tos_Step_sys_TOS_main_Ego_Veh_LC_Sts1_Subsystem1 /end SUB_GROUP
 /begin REF_MEASUREMENT TOS_reserve05 autosar_swc_tos_rtARID_DEF.LCSTS autosar_swc_tos_rtARID_DEF.is_active_c392_autosar_swc_tos autosar_swc_tos_rtARID_DEF.is_c392_autosar_swc_tos autosar_swc_tos_rtARID_DEF.time_cnt_l autosar_swc_tos_rtARID_DEF.time_cnt_r /end REF_MEASUREMENT
/end GROUP
/end MODULE
/end PROJECT
