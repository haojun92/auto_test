ASAP2_VERSION 1 71
/begin PROJECT ProjectName ""
/begin MODULE ModuleName ""
/begin MOD_COMMON "" BYTE_ORDER MSB_LAST ALIGNMENT_BYTE 1 ALIGNMENT_WORD 1 ALIGNMENT_LONG 1 ALIGNMENT_INT64 1 ALIGNMENT_FLOAT16_IEEE 1 ALIGNMENT_FLOAT32_IEEE 1 ALIGNMENT_FLOAT64_IEEE 1 /end MOD_COMMON
/begin RECORD_LAYOUT SSV__FLOAT32_IEEE_S AXIS_PTS_X 1 FLOAT32_IEEE INDEX_INCR DIRECT /end RECORD_LAYOUT
/begin RECORD_LAYOUT Record_BOOLEAN FNC_VALUES 1 UBYTE COLUMN_DIR DIRECT /end RECORD_LAYOUT
/begin RECORD_LAYOUT Record_FLOAT32_IEEE FNC_VALUES 1 FLOAT32_IEEE COLUMN_DIR DIRECT /end RECORD_LAYOUT
/begin RECORD_LAYOUT Record_FLOAT64_IEEE FNC_VALUES 1 FLOAT64_IEEE COLUMN_DIR DIRECT /end RECORD_LAYOUT
/begin RECORD_LAYOUT Record_SLONG FNC_VALUES 1 SLONG COLUMN_DIR DIRECT /end RECORD_LAYOUT
/begin RECORD_LAYOUT Record_UBYTE FNC_VALUES 1 UBYTE COLUMN_DIR DIRECT /end RECORD_LAYOUT
/begin RECORD_LAYOUT Record_UWORD FNC_VALUES 1 UWORD COLUMN_DIR DIRECT /end RECORD_LAYOUT
/begin RECORD_LAYOUT Axis_FLOAT32_IEEE AXIS_PTS_X 1 FLOAT32_IEEE INDEX_INCR DIRECT /end RECORD_LAYOUT
/begin RECORD_LAYOUT Record_BOOLEAN FNC_VALUES 1 UBYTE COLUMN_DIR DIRECT /end RECORD_LAYOUT
/begin RECORD_LAYOUT Record_FLOAT32_IEEE FNC_VALUES 1 FLOAT32_IEEE COLUMN_DIR DIRECT /end RECORD_LAYOUT
/begin RECORD_LAYOUT Record_UBYTE FNC_VALUES 1 UBYTE COLUMN_DIR DIRECT /end RECORD_LAYOUT
/begin RECORD_LAYOUT Record_UWORD FNC_VALUES 1 UWORD COLUMN_DIR DIRECT /end RECORD_LAYOUT
/begin RECORD_LAYOUT Axis_FLOAT32_IEEE AXIS_PTS_X 1 FLOAT32_IEEE INDEX_INCR DIRECT /end RECORD_LAYOUT
/begin RECORD_LAYOUT Record_BOOLEAN FNC_VALUES 1 UBYTE COLUMN_DIR DIRECT /end RECORD_LAYOUT
/begin RECORD_LAYOUT Record_FLOAT32_IEEE FNC_VALUES 1 FLOAT32_IEEE COLUMN_DIR DIRECT /end RECORD_LAYOUT
/begin RECORD_LAYOUT Record_FLOAT64_IEEE FNC_VALUES 1 FLOAT64_IEEE COLUMN_DIR DIRECT /end RECORD_LAYOUT
/begin RECORD_LAYOUT Record_UBYTE FNC_VALUES 1 UBYTE COLUMN_DIR DIRECT /end RECORD_LAYOUT
/begin RECORD_LAYOUT Record_BOOLEAN FNC_VALUES 1 UBYTE COLUMN_DIR DIRECT /end RECORD_LAYOUT
/begin RECORD_LAYOUT Record_FLOAT32_IEEE FNC_VALUES 1 FLOAT32_IEEE COLUMN_DIR DIRECT /end RECORD_LAYOUT
/begin RECORD_LAYOUT Record_UBYTE FNC_VALUES 1 UBYTE COLUMN_DIR DIRECT /end RECORD_LAYOUT
/begin RECORD_LAYOUT Record_UWORD FNC_VALUES 1 UWORD COLUMN_DIR DIRECT /end RECORD_LAYOUT
/begin RECORD_LAYOUT Axis_FLOAT32_IEEE AXIS_PTS_X 1 FLOAT32_IEEE INDEX_INCR DIRECT /end RECORD_LAYOUT
/begin RECORD_LAYOUT Record_BOOLEAN FNC_VALUES 1 UBYTE COLUMN_DIR DIRECT /end RECORD_LAYOUT
/begin RECORD_LAYOUT Record_FLOAT32_IEEE FNC_VALUES 1 FLOAT32_IEEE COLUMN_DIR DIRECT /end RECORD_LAYOUT
/begin RECORD_LAYOUT Record_FLOAT64_IEEE FNC_VALUES 1 FLOAT64_IEEE COLUMN_DIR DIRECT /end RECORD_LAYOUT
/begin RECORD_LAYOUT Record_SLONG FNC_VALUES 1 SLONG COLUMN_DIR DIRECT /end RECORD_LAYOUT
/begin RECORD_LAYOUT Record_UBYTE FNC_VALUES 1 UBYTE COLUMN_DIR DIRECT /end RECORD_LAYOUT
/begin RECORD_LAYOUT Record_UWORD FNC_VALUES 1 UWORD COLUMN_DIR DIRECT /end RECORD_LAYOUT
/begin RECORD_LAYOUT Axis_FLOAT32_IEEE AXIS_PTS_X 1 FLOAT32_IEEE INDEX_INCR DIRECT /end RECORD_LAYOUT
/begin CHARACTERISTIC P_ALC_CityExpresswayActiveEnable "" VALUE 0xfe821d4a /* @ECU_Address@P_ALC_CityExpresswayActiveEnable@ */ Record_BOOLEAN 0 autosar_swc_rlgs_CM_boolean 0 1 /end CHARACTERISTIC
/begin CHARACTERISTIC P_ALC_LCDrvDelayCnt "" VALUE 0xfe821d34 /* @ECU_Address@P_ALC_LCDrvDelayCnt@ */ Record_UWORD 0 autosar_swc_rlgs_CM_uint16 0 65535 /end CHARACTERISTIC
/begin CHARACTERISTIC P_ALC_LcAvoidConeObsSwitch "" VALUE 0xfe821d4b /* @ECU_Address@P_ALC_LcAvoidConeObsSwitch@ */ Record_BOOLEAN 0 autosar_swc_rlgs_CM_boolean 0 1 /end CHARACTERISTIC
/begin CHARACTERISTIC P_ALC_LcOverTkCancelSwitch "" VALUE 0xfe821d4c /* @ECU_Address@P_ALC_LcOverTkCancelSwitch@ */ Record_BOOLEAN 0 autosar_swc_rlgs_CM_boolean 0 1 /end CHARACTERISTIC
/begin CHARACTERISTIC P_ALC_LcOverTk_InhibitFlagEnable "" VALUE 0xfe821d4d /* @ECU_Address@P_ALC_LcOverTk_InhibitFlagEnable@ */ Record_BOOLEAN 0 autosar_swc_rlgs_CM_boolean 0 1 /end CHARACTERISTIC
/begin CHARACTERISTIC P_ALC_LcOverTk_LcSnvtySetEnable "" VALUE 0xfe821d4e /* @ECU_Address@P_ALC_LcOverTk_LcSnvtySetEnable@ */ Record_BOOLEAN 0 autosar_swc_rlgs_CM_boolean 0 1 /end CHARACTERISTIC
/begin CHARACTERISTIC P_ALC_LcOverTk_NoOverrideEnable "" VALUE 0xfe821d4f /* @ECU_Address@P_ALC_LcOverTk_NoOverrideEnable@ */ Record_BOOLEAN 0 autosar_swc_rlgs_CM_boolean 0 1 /end CHARACTERISTIC
/begin CHARACTERISTIC P_ALC_LcTkOverMapLimEnable "" VALUE 0xfe821d50 /* @ECU_Address@P_ALC_LcTkOverMapLimEnable@ */ Record_BOOLEAN 0 autosar_swc_rlgs_CM_boolean 0 1 /end CHARACTERISTIC
/begin CHARACTERISTIC P_ALC_MapValidSw "" VALUE 0xfe821d51 /* @ECU_Address@P_ALC_MapValidSw@ */ Record_BOOLEAN 0 autosar_swc_rlgs_CM_boolean 0 1 /end CHARACTERISTIC
/begin CHARACTERISTIC P_ALC_NOAActiveDistance "" VALUE 0xfe821b18 /* @ECU_Address@P_ALC_NOAActiveDistance@ */ Record_SLONG 0 autosar_swc_rlgs_CM_int32 -2147483648 2147483647 /end CHARACTERISTIC
/begin CHARACTERISTIC P_ALC_NOHNotActiveHoldCnt "" VALUE 0xfe821d36 /* @ECU_Address@P_ALC_NOHNotActiveHoldCnt@ */ Record_UWORD 0 autosar_swc_rlgs_CM_uint16 0 65535 /end CHARACTERISTIC
/begin CHARACTERISTIC P_ALC_OveTkrSupDistSet "" VALUE 0xfe821b1c /* @ECU_Address@P_ALC_OveTkrSupDistSet@ */ Record_FLOAT32_IEEE 0 autosar_swc_rlgs_CM_single -3.4E+38 3.4E+38 /end CHARACTERISTIC
/begin CHARACTERISTIC P_ALC_PathValidConfirmCnt "" VALUE 0xfe821d53 /* @ECU_Address@P_ALC_PathValidConfirmCnt@ */ Record_UBYTE 0 autosar_swc_rlgs_CM_uint8 0 255 /end CHARACTERISTIC
/begin CHARACTERISTIC P_ALC_VirtualSwtDia "" VALUE 0xfe821d55 /* @ECU_Address@P_ALC_VirtualSwtDia@ */ Record_BOOLEAN 0 autosar_swc_rlgs_CM_boolean 0 1 /end CHARACTERISTIC
/begin CHARACTERISTIC P_ALC_Virtual_ALC_Error "" VALUE 0xfe821d56 /* @ECU_Address@P_ALC_Virtual_ALC_Error@ */ Record_UBYTE 0 autosar_swc_rlgs_CM_uint8 0 255 /end CHARACTERISTIC
/begin CHARACTERISTIC P_ALC_Virtual_ALC_SwtReq "" VALUE 0xfe821d57 /* @ECU_Address@P_ALC_Virtual_ALC_SwtReq@ */ Record_UBYTE 0 autosar_swc_rlgs_CM_uint8 0 255 /end CHARACTERISTIC
/begin CHARACTERISTIC P_ALC_Virtual_DCLCSet "" VALUE 0xfe821d58 /* @ECU_Address@P_ALC_Virtual_DCLCSet@ */ Record_UBYTE 0 autosar_swc_rlgs_CM_uint8 0 255 /end CHARACTERISTIC
/begin CHARACTERISTIC P_ALC_Virtual_HWA_Error "" VALUE 0xfe821d59 /* @ECU_Address@P_ALC_Virtual_HWA_Error@ */ Record_UBYTE 0 autosar_swc_rlgs_CM_uint8 0 255 /end CHARACTERISTIC
/begin CHARACTERISTIC P_ALC_Virtual_HWA_SnvtySet "" VALUE 0xfe821d5a /* @ECU_Address@P_ALC_Virtual_HWA_SnvtySet@ */ Record_UBYTE 0 autosar_swc_rlgs_CM_uint8 0 255 /end CHARACTERISTIC
/begin CHARACTERISTIC P_ALC_Virtual_VehConfigHWA "" VALUE 0xfe821d5b /* @ECU_Address@P_ALC_Virtual_VehConfigHWA@ */ Record_UBYTE 0 autosar_swc_rlgs_CM_uint8 0 255 /end CHARACTERISTIC
/begin CHARACTERISTIC P_ALC_VoiceLcEnable "" VALUE 0xfe821d5c /* @ECU_Address@P_ALC_VoiceLcEnable@ */ Record_BOOLEAN 0 autosar_swc_rlgs_CM_boolean 0 1 /end CHARACTERISTIC
/begin CHARACTERISTIC P_ALC_pathPolyMatchTol "" VALUE 0xfe821b24 /* @ECU_Address@P_ALC_pathPolyMatchTol@ */ Record_FLOAT32_IEEE 0 autosar_swc_rlgs_CM_single -3.4E+38 3.4E+38 /end CHARACTERISTIC
/begin CHARACTERISTIC P_PG_SignalDelayTimeComSw "" VALUE 0xfe821d64 /* @ECU_Address@P_PG_SignalDelayTimeComSw@ */ Record_BOOLEAN 0 autosar_swc_rlgs_CM_boolean 0 1 /end CHARACTERISTIC
/begin CHARACTERISTIC P_PG_SignalDelayTimeMaxLimit "" VALUE 0xfe821bdc /* @ECU_Address@P_PG_SignalDelayTimeMaxLimit@ */ Record_FLOAT32_IEEE 0 autosar_swc_rlgs_CM_single -3.4E+38 3.4E+38 /end CHARACTERISTIC
/begin CHARACTERISTIC P_PG_abandonVirtualLineSW "" VALUE 0xfe821ae0 /* @ECU_Address@P_PG_abandonVirtualLineSW@ */ Record_FLOAT64_IEEE 0 autosar_swc_rlgs_CM_double -1.7E+308 1.7E+308 /end CHARACTERISTIC
/begin CHARACTERISTIC P_PSM_A2S_FliterTime "" VALUE 0xfe821c30 /* @ECU_Address@P_PSM_A2S_FliterTime@ */ Record_FLOAT32_IEEE 0 autosar_swc_rlgs_CM_single -3.4E+38 3.4E+38 /end CHARACTERISTIC
/begin CHARACTERISTIC P_PSM_A2_Pretime "" VALUE 0xfe821c34 /* @ECU_Address@P_PSM_A2_Pretime@ */ Record_FLOAT32_IEEE 0 autosar_swc_rlgs_CM_single -3.4E+38 3.4E+38 /end CHARACTERISTIC
/begin CHARACTERISTIC P_PSM_AfterLeftMergeLeftChgSw "" VALUE 0xfe821d68 /* @ECU_Address@P_PSM_AfterLeftMergeLeftChgSw@ */ Record_BOOLEAN 0 autosar_swc_rlgs_CM_boolean 0 1 /end CHARACTERISTIC
/begin CHARACTERISTIC P_PSM_AllowMoveDirStsSW "" VALUE 0xfe821d69 /* @ECU_Address@P_PSM_AllowMoveDirStsSW@ */ Record_BOOLEAN 0 autosar_swc_rlgs_CM_boolean 0 1 /end CHARACTERISTIC
/begin CHARACTERISTIC P_PSM_AllowRightChangeStsSw "" VALUE 0xfe821d6a /* @ECU_Address@P_PSM_AllowRightChangeStsSw@ */ Record_BOOLEAN 0 autosar_swc_rlgs_CM_boolean 0 1 /end CHARACTERISTIC
/begin CHARACTERISTIC P_PSM_ChangeAfC0Value "" VALUE 0xfe821c38 /* @ECU_Address@P_PSM_ChangeAfC0Value@ */ Record_FLOAT32_IEEE 0 autosar_swc_rlgs_CM_single -3.4E+38 3.4E+38 /end CHARACTERISTIC
/begin CHARACTERISTIC P_PSM_ChangeBfC0Value "" VALUE 0xfe821c3c /* @ECU_Address@P_PSM_ChangeBfC0Value@ */ Record_FLOAT32_IEEE 0 autosar_swc_rlgs_CM_single -3.4E+38 3.4E+38 /end CHARACTERISTIC
/begin CHARACTERISTIC P_PSM_ConeInHostLaneFlagConfirmTime "" VALUE 0xfe821d6b /* @ECU_Address@P_PSM_ConeInHostLaneFlagConfirmTime@ */ Record_UBYTE 0 autosar_swc_rlgs_CM_uint8 0 255 /end CHARACTERISTIC
/begin CHARACTERISTIC P_PSM_ConeRoadEdge2LineLatDisThresvalue "" VALUE 0xfe821c40 /* @ECU_Address@P_PSM_ConeRoadEdge2LineLatDisThresvalue@ */ Record_FLOAT32_IEEE 0 autosar_swc_rlgs_CM_single -3.4E+38 3.4E+38 /end CHARACTERISTIC
/begin CHARACTERISTIC P_PSM_ConeStartThresValue "" VALUE 0xfe821c44 /* @ECU_Address@P_PSM_ConeStartThresValue@ */ Record_FLOAT32_IEEE 0 autosar_swc_rlgs_CM_single -3.4E+38 3.4E+38 /end CHARACTERISTIC
/begin CHARACTERISTIC P_PSM_Dis2StubThreshold "" VALUE 0xfe821c48 /* @ECU_Address@P_PSM_Dis2StubThreshold@ */ Record_SLONG 0 autosar_swc_rlgs_CM_int32 -2147483648 2147483647 /end CHARACTERISTIC
/begin CHARACTERISTIC P_PSM_DisNotChangeTime "" VALUE 0xfe821c4c /* @ECU_Address@P_PSM_DisNotChangeTime@ */ Record_FLOAT32_IEEE 0 autosar_swc_rlgs_CM_single -3.4E+38 3.4E+38 /end CHARACTERISTIC
/begin CHARACTERISTIC P_PSM_Distance2MergeStubMinValue "" VALUE 0xfe821d40 /* @ECU_Address@P_PSM_Distance2MergeStubMinValue@ */ Record_UWORD 0 autosar_swc_rlgs_CM_uint16 0 65535 /end CHARACTERISTIC
/begin CHARACTERISTIC P_PSM_DistanceLimitValue "" VALUE 0xfe821c50 /* @ECU_Address@P_PSM_DistanceLimitValue@ */ Record_FLOAT32_IEEE 0 autosar_swc_rlgs_CM_single -3.4E+38 3.4E+38 /end CHARACTERISTIC
/begin CHARACTERISTIC P_PSM_DistanceThreshold "" VALUE 0xfe821c54 /* @ECU_Address@P_PSM_DistanceThreshold@ */ Record_FLOAT32_IEEE 0 autosar_swc_rlgs_CM_single -3.4E+38 3.4E+38 /end CHARACTERISTIC
/begin CHARACTERISTIC P_PSM_DyAllowSplitDy "" VALUE 0xfe821c58 /* @ECU_Address@P_PSM_DyAllowSplitDy@ */ Record_FLOAT32_IEEE 0 autosar_swc_rlgs_CM_single -3.4E+38 3.4E+38 /end CHARACTERISTIC
/begin CHARACTERISTIC P_PSM_DyThresthold "" VALUE 0xfe821c5c /* @ECU_Address@P_PSM_DyThresthold@ */ Record_FLOAT32_IEEE 0 autosar_swc_rlgs_CM_single -3.4E+38 3.4E+38 /end CHARACTERISTIC
/begin CHARACTERISTIC P_PSM_ExitLineCalEnd "" VALUE 0xfe821d42 /* @ECU_Address@P_PSM_ExitLineCalEnd@ */ Record_UWORD 0 autosar_swc_rlgs_CM_uint16 0 65535 /end CHARACTERISTIC
/begin CHARACTERISTIC P_PSM_ExitLineCalStart "" VALUE 0xfe821d44 /* @ECU_Address@P_PSM_ExitLineCalStart@ */ Record_UWORD 0 autosar_swc_rlgs_CM_uint16 0 65535 /end CHARACTERISTIC
/begin CHARACTERISTIC P_PSM_ExitLineHoldTime "" VALUE 0xfe821c60 /* @ECU_Address@P_PSM_ExitLineHoldTime@ */ Record_FLOAT32_IEEE 0 autosar_swc_rlgs_CM_single -3.4E+38 3.4E+38 /end CHARACTERISTIC
/begin CHARACTERISTIC P_PSM_FirstActNOACntTimeValue "" VALUE 0xfe821c64 /* @ECU_Address@P_PSM_FirstActNOACntTimeValue@ */ Record_FLOAT32_IEEE 0 autosar_swc_rlgs_CM_single -3.4E+38 3.4E+38 /end CHARACTERISTIC
/begin CHARACTERISTIC P_PSM_FrontRoadWidthErr "" VALUE 0xfe821c68 /* @ECU_Address@P_PSM_FrontRoadWidthErr@ */ Record_FLOAT32_IEEE 0 autosar_swc_rlgs_CM_single -3.4E+38 3.4E+38 /end CHARACTERISTIC
/begin CHARACTERISTIC P_PSM_HighWayNOAExitByTollDis "" VALUE 0xfe821c6c /* @ECU_Address@P_PSM_HighWayNOAExitByTollDis@ */ Record_SLONG 0 autosar_swc_rlgs_CM_int32 -2147483648 2147483647 /end CHARACTERISTIC
/begin CHARACTERISTIC P_PSM_IPVehSpdMaxPreLC_Drv "" VALUE 0xfe821d6d /* @ECU_Address@P_PSM_IPVehSpdMaxPreLC_Drv@ */ Record_UBYTE 0 autosar_swc_rlgs_CM_uint8 0 255 /end CHARACTERISTIC
/begin CHARACTERISTIC P_PSM_IPVehSpdMinPreLC_Drv "" VALUE 0xfe821d6e /* @ECU_Address@P_PSM_IPVehSpdMinPreLC_Drv@ */ Record_UBYTE 0 autosar_swc_rlgs_CM_uint8 0 255 /end CHARACTERISTIC
/begin CHARACTERISTIC P_PSM_IPVehSpdMinPreLC_Noh "" VALUE 0xfe821d6f /* @ECU_Address@P_PSM_IPVehSpdMinPreLC_Noh@ */ Record_UBYTE 0 autosar_swc_rlgs_CM_uint8 0 255 /end CHARACTERISTIC
/begin CHARACTERISTIC P_PSM_KeepNotChangeTime "" VALUE 0xfe821c70 /* @ECU_Address@P_PSM_KeepNotChangeTime@ */ Record_FLOAT32_IEEE 0 autosar_swc_rlgs_CM_single -3.4E+38 3.4E+38 /end CHARACTERISTIC
/begin CHARACTERISTIC P_PSM_L1AndLeftConeSimilarErrValue "" VALUE 0xfe821af8 /* @ECU_Address@P_PSM_L1AndLeftConeSimilarErrValue@ */ Record_FLOAT64_IEEE 0 autosar_swc_rlgs_CM_double -1.7E+308 1.7E+308 /end CHARACTERISTIC
/begin CHARACTERISTIC P_PSM_LcOverInhibitTime "" VALUE 0xfe821c74 /* @ECU_Address@P_PSM_LcOverInhibitTime@ */ Record_FLOAT32_IEEE 0 autosar_swc_rlgs_CM_single -3.4E+38 3.4E+38 /end CHARACTERISTIC
/begin CHARACTERISTIC P_PSM_LcOverTkCurveLimitValue "" VALUE 0xfe821c78 /* @ECU_Address@P_PSM_LcOverTkCurveLimitValue@ */ Record_FLOAT32_IEEE 0 autosar_swc_rlgs_CM_single -3.4E+38 3.4E+38 /end CHARACTERISTIC
/begin CHARACTERISTIC P_PSM_LcOverTkSpdThreshold "" VALUE 0xfe821c7c /* @ECU_Address@P_PSM_LcOverTkSpdThreshold@ */ Record_FLOAT32_IEEE 0 autosar_swc_rlgs_CM_single -3.4E+38 3.4E+38 /end CHARACTERISTIC
/begin CHARACTERISTIC P_PSM_LcTkObjLeftTime "" VALUE 0xfe821c80 /* @ECU_Address@P_PSM_LcTkObjLeftTime@ */ Record_FLOAT32_IEEE 0 autosar_swc_rlgs_CM_single -3.4E+38 3.4E+38 /end CHARACTERISTIC
/begin CHARACTERISTIC P_PSM_LcTkObjRainTime "" VALUE 0xfe821c84 /* @ECU_Address@P_PSM_LcTkObjRainTime@ */ Record_FLOAT32_IEEE 0 autosar_swc_rlgs_CM_single -3.4E+38 3.4E+38 /end CHARACTERISTIC
/begin CHARACTERISTIC P_PSM_LcTkObjRightTime "" VALUE 0xfe821c88 /* @ECU_Address@P_PSM_LcTkObjRightTime@ */ Record_FLOAT32_IEEE 0 autosar_swc_rlgs_CM_single -3.4E+38 3.4E+38 /end CHARACTERISTIC
/begin CHARACTERISTIC P_PSM_LcTkOverCancelThreshold "" VALUE 0xfe821c8c /* @ECU_Address@P_PSM_LcTkOverCancelThreshold@ */ Record_FLOAT32_IEEE 0 autosar_swc_rlgs_CM_single -3.4E+38 3.4E+38 /end CHARACTERISTIC
/begin CHARACTERISTIC P_PSM_LeftLcAfterMergeWaitTime "" VALUE 0xfe821c90 /* @ECU_Address@P_PSM_LeftLcAfterMergeWaitTime@ */ Record_FLOAT32_IEEE 0 autosar_swc_rlgs_CM_single -3.4E+38 3.4E+38 /end CHARACTERISTIC
/begin CHARACTERISTIC P_PSM_LeftLcOverInhibitTimeAfterMerge "" VALUE 0xfe821c94 /* @ECU_Address@P_PSM_LeftLcOverInhibitTimeAfterMerge@ */ Record_FLOAT32_IEEE 0 autosar_swc_rlgs_CM_single -3.4E+38 3.4E+38 /end CHARACTERISTIC
/begin CHARACTERISTIC P_PSM_LeftMergeExitInRiSplitDis "" VALUE 0xfe821c98 /* @ECU_Address@P_PSM_LeftMergeExitInRiSplitDis@ */ Record_SLONG 0 autosar_swc_rlgs_CM_int32 -2147483648 2147483647 /end CHARACTERISTIC
/begin CHARACTERISTIC P_PSM_LineAvaiLcAffirmTime "" VALUE 0xfe821c9c /* @ECU_Address@P_PSM_LineAvaiLcAffirmTime@ */ Record_FLOAT32_IEEE 0 autosar_swc_rlgs_CM_single -3.4E+38 3.4E+38 /end CHARACTERISTIC
/begin CHARACTERISTIC P_PSM_MapNavValidCounter "" VALUE 0xfe821d71 /* @ECU_Address@P_PSM_MapNavValidCounter@ */ Record_UBYTE 0 autosar_swc_rlgs_CM_uint8 0 255 /end CHARACTERISTIC
/begin CHARACTERISTIC P_PSM_MergeInhibitLcOverSW "" VALUE 0xfe821d72 /* @ECU_Address@P_PSM_MergeInhibitLcOverSW@ */ Record_BOOLEAN 0 autosar_swc_rlgs_CM_boolean 0 1 /end CHARACTERISTIC
/begin CHARACTERISTIC P_PSM_MergeLeftChangeTestSW "" VALUE 0xfe821d73 /* @ECU_Address@P_PSM_MergeLeftChangeTestSW@ */ Record_BOOLEAN 0 autosar_swc_rlgs_CM_boolean 0 1 /end CHARACTERISTIC
/begin CHARACTERISTIC P_PSM_MostRightTimeThreshold "" VALUE 0xfe821ca0 /* @ECU_Address@P_PSM_MostRightTimeThreshold@ */ Record_FLOAT32_IEEE 0 autosar_swc_rlgs_CM_single -3.4E+38 3.4E+38 /end CHARACTERISTIC
/begin CHARACTERISTIC P_PSM_NOAActv2TollBoothDis "" VALUE 0xfe821ca4 /* @ECU_Address@P_PSM_NOAActv2TollBoothDis@ */ Record_SLONG 0 autosar_swc_rlgs_CM_int32 -2147483648 2147483647 /end CHARACTERISTIC
/begin CHARACTERISTIC P_PSM_NOAExitRemindTime "" VALUE 0xfe821ca8 /* @ECU_Address@P_PSM_NOAExitRemindTime@ */ Record_FLOAT32_IEEE 0 autosar_swc_rlgs_CM_single -3.4E+38 3.4E+38 /end CHARACTERISTIC
/begin CHARACTERISTIC P_PSM_NOA_ForceLaneChangeTime "" VALUE 0xfe821cac /* @ECU_Address@P_PSM_NOA_ForceLaneChangeTime@ */ Record_FLOAT32_IEEE 0 autosar_swc_rlgs_CM_single -3.4E+38 3.4E+38 /end CHARACTERISTIC
/begin CHARACTERISTIC P_PSM_NOA_LB2LeftLineNotMergeLatDis "" VALUE 0xfe821cb0 /* @ECU_Address@P_PSM_NOA_LB2LeftLineNotMergeLatDis@ */ Record_FLOAT32_IEEE 0 autosar_swc_rlgs_CM_single -3.4E+38 3.4E+38 /end CHARACTERISTIC
/begin CHARACTERISTIC P_PSM_NOA_LBChgDisValue "" VALUE 0xfe821b00 /* @ECU_Address@P_PSM_NOA_LBChgDisValue@ */ Record_FLOAT64_IEEE 0 autosar_swc_rlgs_CM_double -1.7E+308 1.7E+308 /end CHARACTERISTIC
/begin CHARACTERISTIC P_PSM_NOA_LeftMergeDisThresValue "" VALUE 0xfe821cb4 /* @ECU_Address@P_PSM_NOA_LeftMergeDisThresValue@ */ Record_SLONG 0 autosar_swc_rlgs_CM_int32 -2147483648 2147483647 /end CHARACTERISTIC
/begin CHARACTERISTIC P_PSM_NOA_LeftMergeWaitTime "" VALUE 0xfe821cb8 /* @ECU_Address@P_PSM_NOA_LeftMergeWaitTime@ */ Record_FLOAT32_IEEE 0 autosar_swc_rlgs_CM_single -3.4E+38 3.4E+38 /end CHARACTERISTIC
/begin CHARACTERISTIC P_PSM_NOA_Veh2LBDisThresValue "" VALUE 0xfe821cbc /* @ECU_Address@P_PSM_NOA_Veh2LBDisThresValue@ */ Record_FLOAT32_IEEE 0 autosar_swc_rlgs_CM_single -3.4E+38 3.4E+38 /end CHARACTERISTIC
/begin CHARACTERISTIC P_PSM_NOA_tollDisThresValue "" VALUE 0xfe821cc0 /* @ECU_Address@P_PSM_NOA_tollDisThresValue@ */ Record_SLONG 0 autosar_swc_rlgs_CM_int32 -2147483648 2147483647 /end CHARACTERISTIC
/begin CHARACTERISTIC P_PSM_NextStubRiSplitDisThresvalue "" VALUE 0xfe821cc4 /* @ECU_Address@P_PSM_NextStubRiSplitDisThresvalue@ */ Record_SLONG 0 autosar_swc_rlgs_CM_int32 -2147483648 2147483647 /end CHARACTERISTIC
/begin CHARACTERISTIC P_PSM_NotMatchDyThresthold "" VALUE 0xfe821cc8 /* @ECU_Address@P_PSM_NotMatchDyThresthold@ */ Record_FLOAT32_IEEE 0 autosar_swc_rlgs_CM_single -3.4E+38 3.4E+38 /end CHARACTERISTIC
/begin CHARACTERISTIC P_PSM_R1AndRiConeSimilarErrValue "" VALUE 0xfe821ccc /* @ECU_Address@P_PSM_R1AndRiConeSimilarErrValue@ */ Record_FLOAT32_IEEE 0 autosar_swc_rlgs_CM_single -3.4E+38 3.4E+38 /end CHARACTERISTIC
/begin CHARACTERISTIC P_PSM_R1LineTypeNotRampTime "" VALUE 0xfe821cd0 /* @ECU_Address@P_PSM_R1LineTypeNotRampTime@ */ Record_FLOAT32_IEEE 0 autosar_swc_rlgs_CM_single -3.4E+38 3.4E+38 /end CHARACTERISTIC
/begin CHARACTERISTIC P_PSM_R2RBYBranchThreshold "" VALUE 0xfe821cd4 /* @ECU_Address@P_PSM_R2RBYBranchThreshold@ */ Record_FLOAT32_IEEE 0 autosar_swc_rlgs_CM_single -3.4E+38 3.4E+38 /end CHARACTERISTIC
/begin CHARACTERISTIC P_PSM_R2RRCurrentError "" VALUE 0xfe821cd8 /* @ECU_Address@P_PSM_R2RRCurrentError@ */ Record_FLOAT32_IEEE 0 autosar_swc_rlgs_CM_single -3.4E+38 3.4E+38 /end CHARACTERISTIC
/begin CHARACTERISTIC P_PSM_R2RRYBranchThreshold1 "" VALUE 0xfe821cdc /* @ECU_Address@P_PSM_R2RRYBranchThreshold1@ */ Record_FLOAT32_IEEE 0 autosar_swc_rlgs_CM_single -3.4E+38 3.4E+38 /end CHARACTERISTIC
/begin CHARACTERISTIC P_PSM_R2RRYBranchThreshold2 "" VALUE 0xfe821ce0 /* @ECU_Address@P_PSM_R2RRYBranchThreshold2@ */ Record_FLOAT32_IEEE 0 autosar_swc_rlgs_CM_single -3.4E+38 3.4E+38 /end CHARACTERISTIC
/begin CHARACTERISTIC P_PSM_RampNOAExitByTollDis "" VALUE 0xfe821ce4 /* @ECU_Address@P_PSM_RampNOAExitByTollDis@ */ Record_SLONG 0 autosar_swc_rlgs_CM_int32 -2147483648 2147483647 /end CHARACTERISTIC
/begin CHARACTERISTIC P_PSM_RemindStageOfFirst "" VALUE 0xfe821ce8 /* @ECU_Address@P_PSM_RemindStageOfFirst@ */ Record_SLONG 0 autosar_swc_rlgs_CM_int32 -2147483648 2147483647 /end CHARACTERISTIC
/begin CHARACTERISTIC P_PSM_RemindStageOfSecond "" VALUE 0xfe821cec /* @ECU_Address@P_PSM_RemindStageOfSecond@ */ Record_SLONG 0 autosar_swc_rlgs_CM_int32 -2147483648 2147483647 /end CHARACTERISTIC
/begin CHARACTERISTIC P_PSM_RiLcOverTkSpdThreshold "" VALUE 0xfe821cf0 /* @ECU_Address@P_PSM_RiLcOverTkSpdThreshold@ */ Record_FLOAT32_IEEE 0 autosar_swc_rlgs_CM_single -3.4E+38 3.4E+38 /end CHARACTERISTIC
/begin CHARACTERISTIC P_PSM_RiRoadClassSW "" VALUE 0xfe821d74 /* @ECU_Address@P_PSM_RiRoadClassSW@ */ Record_BOOLEAN 0 autosar_swc_rlgs_CM_boolean 0 1 /end CHARACTERISTIC
/begin CHARACTERISTIC P_PSM_RightSplitKeepSW "" VALUE 0xfe821d75 /* @ECU_Address@P_PSM_RightSplitKeepSW@ */ Record_BOOLEAN 0 autosar_swc_rlgs_CM_boolean 0 1 /end CHARACTERISTIC
/begin CHARACTERISTIC P_PSM_RightSplitStubDis "" VALUE 0xfe821d46 /* @ECU_Address@P_PSM_RightSplitStubDis@ */ Record_UWORD 0 autosar_swc_rlgs_CM_uint16 0 65535 /end CHARACTERISTIC
/begin CHARACTERISTIC P_PSM_RoadClass1HighWaySW "" VALUE 0xfe821d76 /* @ECU_Address@P_PSM_RoadClass1HighWaySW@ */ Record_BOOLEAN 0 autosar_swc_rlgs_CM_boolean 0 1 /end CHARACTERISTIC
/begin CHARACTERISTIC P_PSM_RoadEgeStartDis "" VALUE 0xfe821b08 /* @ECU_Address@P_PSM_RoadEgeStartDis@ */ Record_FLOAT64_IEEE 0 autosar_swc_rlgs_CM_double -1.7E+308 1.7E+308 /end CHARACTERISTIC
/begin CHARACTERISTIC P_PSM_ShadeMergeStubDisByNextStub "" VALUE 0xfe821cf4 /* @ECU_Address@P_PSM_ShadeMergeStubDisByNextStub@ */ Record_SLONG 0 autosar_swc_rlgs_CM_int32 -2147483648 2147483647 /end CHARACTERISTIC
/begin CHARACTERISTIC P_PSM_SlopeKapThresValue "" VALUE 0xfe821b10 /* @ECU_Address@P_PSM_SlopeKapThresValue@ */ Record_FLOAT64_IEEE 0 autosar_swc_rlgs_CM_double -1.7E+308 1.7E+308 /end CHARACTERISTIC
/begin CHARACTERISTIC P_PSM_SpeedSuppressedConfirmTime "" CURVE 0xfe821db0 /* @ECU_Address@P_PSM_SpeedSuppressedConfirmTime@ */ Record_FLOAT32_IEEE 0 autosar_swc_rlgs_CM_single -3.4E+38 3.4E+38
 /begin AXIS_DESCR COM_AXIS NO_INPUT_QUANTITY autosar_swc_rlgs_CM_single 3 -3.4E+38 3.4E+38 AXIS_PTS_REF P_PSM_SpeedSuppressedErrorTable /end AXIS_DESCR
/end CHARACTERISTIC
/begin CHARACTERISTIC P_PSM_SpeedSuppressedMinValue "" VALUE 0xfe821cf8 /* @ECU_Address@P_PSM_SpeedSuppressedMinValue@ */ Record_FLOAT32_IEEE 0 autosar_swc_rlgs_CM_single -3.4E+38 3.4E+38 /end CHARACTERISTIC
/begin CHARACTERISTIC P_PSM_SplitLcCtrlLevel "" VALUE 0xfe821d77 /* @ECU_Address@P_PSM_SplitLcCtrlLevel@ */ Record_UBYTE 0 autosar_swc_rlgs_CM_uint8 0 255 /end CHARACTERISTIC
/begin CHARACTERISTIC P_PSM_SplitStage_C0dist_m "" VALUE 0xfe821cfc /* @ECU_Address@P_PSM_SplitStage_C0dist_m@ */ Record_FLOAT32_IEEE 0 autosar_swc_rlgs_CM_single -3.4E+38 3.4E+38 /end CHARACTERISTIC
/begin CHARACTERISTIC P_PSM_SplitStubIsTollDisValue "" VALUE 0xfe821d00 /* @ECU_Address@P_PSM_SplitStubIsTollDisValue@ */ Record_SLONG 0 autosar_swc_rlgs_CM_int32 -2147483648 2147483647 /end CHARACTERISTIC
/begin CHARACTERISTIC P_PSM_StepTime "" VALUE 0xfe821d04 /* @ECU_Address@P_PSM_StepTime@ */ Record_FLOAT32_IEEE 0 autosar_swc_rlgs_CM_single -3.4E+38 3.4E+38 /end CHARACTERISTIC
/begin CHARACTERISTIC P_PSM_StubDisThreshold "" VALUE 0xfe821d08 /* @ECU_Address@P_PSM_StubDisThreshold@ */ Record_SLONG 0 autosar_swc_rlgs_CM_int32 -2147483648 2147483647 /end CHARACTERISTIC
/begin CHARACTERISTIC P_PSM_SuppreLcOverTkStubDis "" VALUE 0xfe821d0c /* @ECU_Address@P_PSM_SuppreLcOverTkStubDis@ */ Record_SLONG 0 autosar_swc_rlgs_CM_int32 -2147483648 2147483647 /end CHARACTERISTIC
/begin CHARACTERISTIC P_PSM_TFCDisComMaxThresValue "" VALUE 0xfe821d10 /* @ECU_Address@P_PSM_TFCDisComMaxThresValue@ */ Record_FLOAT32_IEEE 0 autosar_swc_rlgs_CM_single -3.4E+38 3.4E+38 /end CHARACTERISTIC
/begin CHARACTERISTIC P_PSM_TFCDisComMinThresValue "" VALUE 0xfe821d14 /* @ECU_Address@P_PSM_TFCDisComMinThresValue@ */ Record_FLOAT32_IEEE 0 autosar_swc_rlgs_CM_single -3.4E+38 3.4E+38 /end CHARACTERISTIC
/begin CHARACTERISTIC P_PSM_TFCDisMaxThresValue "" VALUE 0xfe821d18 /* @ECU_Address@P_PSM_TFCDisMaxThresValue@ */ Record_FLOAT32_IEEE 0 autosar_swc_rlgs_CM_single -3.4E+38 3.4E+38 /end CHARACTERISTIC
/begin CHARACTERISTIC P_PSM_TFCDisMinThresValue "" VALUE 0xfe821d1c /* @ECU_Address@P_PSM_TFCDisMinThresValue@ */ Record_FLOAT32_IEEE 0 autosar_swc_rlgs_CM_single -3.4E+38 3.4E+38 /end CHARACTERISTIC
/begin CHARACTERISTIC P_PSM_TFCMaxThresValue "" VALUE 0xfe821d20 /* @ECU_Address@P_PSM_TFCMaxThresValue@ */ Record_FLOAT32_IEEE 0 autosar_swc_rlgs_CM_single -3.4E+38 3.4E+38 /end CHARACTERISTIC
/begin CHARACTERISTIC P_PSM_TFCMinThresValue "" VALUE 0xfe821d24 /* @ECU_Address@P_PSM_TFCMinThresValue@ */ Record_FLOAT32_IEEE 0 autosar_swc_rlgs_CM_single -3.4E+38 3.4E+38 /end CHARACTERISTIC
/begin CHARACTERISTIC P_PSM_TFCRoadWidthMax "" VALUE 0xfe821d28 /* @ECU_Address@P_PSM_TFCRoadWidthMax@ */ Record_FLOAT32_IEEE 0 autosar_swc_rlgs_CM_single -3.4E+38 3.4E+38 /end CHARACTERISTIC
/begin CHARACTERISTIC P_PSM_TFCRoadWidthMin "" VALUE 0xfe821d2c /* @ECU_Address@P_PSM_TFCRoadWidthMin@ */ Record_FLOAT32_IEEE 0 autosar_swc_rlgs_CM_single -3.4E+38 3.4E+38 /end CHARACTERISTIC
/begin CHARACTERISTIC P_PSM_UrbanStudEndDisThresValue "" VALUE 0xfe821d30 /* @ECU_Address@P_PSM_UrbanStudEndDisThresValue@ */ Record_SLONG 0 autosar_swc_rlgs_CM_int32 -2147483648 2147483647 /end CHARACTERISTIC
/begin CHARACTERISTIC P_PSM_VehLocationWithStubSW "" VALUE 0xfe821d78 /* @ECU_Address@P_PSM_VehLocationWithStubSW@ */ Record_BOOLEAN 0 autosar_swc_rlgs_CM_boolean 0 1 /end CHARACTERISTIC
/begin CHARACTERISTIC P_PSM_splitAtStubDis "" VALUE 0xfe821d48 /* @ECU_Address@P_PSM_splitAtStubDis@ */ Record_UWORD 0 autosar_swc_rlgs_CM_uint16 0 65535 /end CHARACTERISTIC
/begin MEASUREMENT PSM_AfterLeftMergeLeftChgFlag "" UBYTE autosar_swc_rlgs_CM_boolean 0 0 0 1 ECU_ADDRESS 0xfe4b0043 /* @ECU_Address@PSM_AfterLeftMergeLeftChgFlag@ */ /end MEASUREMENT
/begin MEASUREMENT PSM_AfterLeftMergeLeftChgSts "" UBYTE autosar_swc_rlgs_CM_uint8 0 0 0 255 ECU_ADDRESS 0xfe4b0044 /* @ECU_Address@PSM_AfterLeftMergeLeftChgSts@ */ /end MEASUREMENT
/begin MEASUREMENT PSM_AllowSplitLineFlag "" UBYTE autosar_swc_rlgs_CM_boolean 0 0 0 1 ECU_ADDRESS 0xfe4b0045 /* @ECU_Address@PSM_AllowSplitLineFlag@ */ /end MEASUREMENT
/begin MEASUREMENT PSM_ExitLineFlag "" UBYTE autosar_swc_rlgs_CM_boolean 0 0 0 1 ECU_ADDRESS 0xfe4b0046 /* @ECU_Address@PSM_ExitLineFlag@ */ /end MEASUREMENT
/begin MEASUREMENT PSM_ExitLineMatchCurLineFlag "" UBYTE autosar_swc_rlgs_CM_boolean 0 0 0 1 ECU_ADDRESS 0xfe4b0047 /* @ECU_Address@PSM_ExitLineMatchCurLineFlag@ */ /end MEASUREMENT
/begin MEASUREMENT PSM_ExitLineNotMatchCurLineFlag "" UBYTE autosar_swc_rlgs_CM_boolean 0 0 0 1 ECU_ADDRESS 0xfe4b0048 /* @ECU_Address@PSM_ExitLineNotMatchCurLineFlag@ */ /end MEASUREMENT
/begin MEASUREMENT PSM_FilterMapValid "" FLOAT32_IEEE autosar_swc_rlgs_CM_single 0 0 -3.4E+38 3.4E+38 ECU_ADDRESS 0xfe4afe80 /* @ECU_Address@PSM_FilterMapValid@ */ /end MEASUREMENT
/begin MEASUREMENT PSM_FilterNavValid "" FLOAT32_IEEE autosar_swc_rlgs_CM_single 0 0 -3.4E+38 3.4E+38 MATRIX_DIM 1 1 ECU_ADDRESS 0xfe4afe84 /* @ECU_Address@PSM_FilterNavValid@ */ /end MEASUREMENT
/begin MEASUREMENT PSM_ForceLeftChgTimeOut "" FLOAT32_IEEE autosar_swc_rlgs_CM_single 0 0 -3.4E+38 3.4E+38 ECU_ADDRESS 0xfe4afe88 /* @ECU_Address@PSM_ForceLeftChgTimeOut@ */ /end MEASUREMENT
/begin MEASUREMENT PSM_HighWay_Cruise "" UBYTE autosar_swc_rlgs_CM_boolean 0 0 0 1 MATRIX_DIM 1 1 ECU_ADDRESS 0xfe4b0049 /* @ECU_Address@PSM_HighWay_Cruise@ */ /end MEASUREMENT
/begin MEASUREMENT PSM_HighWay_LeftMerge "" UBYTE autosar_swc_rlgs_CM_boolean 0 0 0 1 ECU_ADDRESS 0xfe4b004a /* @ECU_Address@PSM_HighWay_LeftMerge@ */ /end MEASUREMENT
/begin MEASUREMENT PSM_HighWay_LeftMergeFinish "" UBYTE autosar_swc_rlgs_CM_boolean 0 0 0 1 ECU_ADDRESS 0xfe4b004b /* @ECU_Address@PSM_HighWay_LeftMergeFinish@ */ /end MEASUREMENT
/begin MEASUREMENT PSM_HighWay_LeftMerge_InStub "" UBYTE autosar_swc_rlgs_CM_boolean 0 0 0 1 ECU_ADDRESS 0xfe4b004c /* @ECU_Address@PSM_HighWay_LeftMerge_InStub@ */ /end MEASUREMENT
/begin MEASUREMENT PSM_HighWay_LeftStraight "" UBYTE autosar_swc_rlgs_CM_boolean 0 0 0 1 ECU_ADDRESS 0xfe4b004d /* @ECU_Address@PSM_HighWay_LeftStraight@ */ /end MEASUREMENT
/begin MEASUREMENT PSM_HighWay_RightSplit "" UBYTE autosar_swc_rlgs_CM_boolean 0 0 0 1 ECU_ADDRESS 0xfe4b004e /* @ECU_Address@PSM_HighWay_RightSplit@ */ /end MEASUREMENT
/begin MEASUREMENT PSM_HighWay_RightSplit_BfStub "" UBYTE autosar_swc_rlgs_CM_boolean 0 0 0 1 ECU_ADDRESS 0xfe4b004f /* @ECU_Address@PSM_HighWay_RightSplit_BfStub@ */ /end MEASUREMENT
/begin MEASUREMENT PSM_HighWay_RightSplit_InStub "" UBYTE autosar_swc_rlgs_CM_boolean 0 0 0 1 ECU_ADDRESS 0xfe4b0050 /* @ECU_Address@PSM_HighWay_RightSplit_InStub@ */ /end MEASUREMENT
/begin MEASUREMENT PSM_HostLaneConePosition_X "" FLOAT32_IEEE autosar_swc_rlgs_CM_single 0 0 -3.4E+38 3.4E+38 MATRIX_DIM 1 1 ECU_ADDRESS 0xfe4afe8c /* @ECU_Address@PSM_HostLaneConePosition_X@ */ /end MEASUREMENT
/begin MEASUREMENT PSM_HostLaneConePosition_Y "" FLOAT32_IEEE autosar_swc_rlgs_CM_single 0 0 -3.4E+38 3.4E+38 MATRIX_DIM 1 1 ECU_ADDRESS 0xfe4afe90 /* @ECU_Address@PSM_HostLaneConePosition_Y@ */ /end MEASUREMENT
/begin MEASUREMENT PSM_HostLaneExitConeFlag "" UBYTE autosar_swc_rlgs_CM_boolean 0 0 0 1 ECU_ADDRESS 0xfe4b0051 /* @ECU_Address@PSM_HostLaneExitConeFlag@ */ /end MEASUREMENT
/begin MEASUREMENT PSM_IsLeftMergeStubExistFlag "" UBYTE autosar_swc_rlgs_CM_boolean 0 0 0 1 ECU_ADDRESS 0xfe4b0052 /* @ECU_Address@PSM_IsLeftMergeStubExistFlag@ */ /end MEASUREMENT
/begin MEASUREMENT PSM_IsLeftSplitSubExistFlag "" UBYTE autosar_swc_rlgs_CM_boolean 0 0 0 1 ECU_ADDRESS 0xfe4b0053 /* @ECU_Address@PSM_IsLeftSplitSubExistFlag@ */ /end MEASUREMENT
/begin MEASUREMENT PSM_IsRiMergeStubExistFlag "" UBYTE autosar_swc_rlgs_CM_boolean 0 0 0 1 ECU_ADDRESS 0xfe4b0054 /* @ECU_Address@PSM_IsRiMergeStubExistFlag@ */ /end MEASUREMENT
/begin MEASUREMENT PSM_IsRiSplitStubExistFlag "" UBYTE autosar_swc_rlgs_CM_boolean 0 0 0 1 ECU_ADDRESS 0xfe4b0055 /* @ECU_Address@PSM_IsRiSplitStubExistFlag@ */ /end MEASUREMENT
/begin MEASUREMENT PSM_IsVehInLeNavLaneFlag "" UBYTE autosar_swc_rlgs_CM_boolean 0 0 0 1 ECU_ADDRESS 0xfe4b0056 /* @ECU_Address@PSM_IsVehInLeNavLaneFlag@ */ /end MEASUREMENT
/begin MEASUREMENT PSM_IsVehInRiLaneFlag "" UBYTE autosar_swc_rlgs_CM_boolean 0 0 0 1 ECU_ADDRESS 0xfe4b0057 /* @ECU_Address@PSM_IsVehInRiLaneFlag@ */ /end MEASUREMENT
/begin MEASUREMENT PSM_IsVehInRiNavLaneFlag "" UBYTE autosar_swc_rlgs_CM_boolean 0 0 0 1 ECU_ADDRESS 0xfe4b0058 /* @ECU_Address@PSM_IsVehInRiNavLaneFlag@ */ /end MEASUREMENT
/begin MEASUREMENT PSM_KapL1 "" FLOAT32_IEEE autosar_swc_rlgs_CM_single 0 0 -3.4E+38 3.4E+38 ECU_ADDRESS 0xfe4afe94 /* @ECU_Address@PSM_KapL1@ */ /end MEASUREMENT
/begin MEASUREMENT PSM_KapR1 "" FLOAT32_IEEE autosar_swc_rlgs_CM_single 0 0 -3.4E+38 3.4E+38 ECU_ADDRESS 0xfe4afe98 /* @ECU_Address@PSM_KapR1@ */ /end MEASUREMENT
/begin MEASUREMENT PSM_KapRB "" FLOAT32_IEEE autosar_swc_rlgs_CM_single 0 0 -3.4E+38 3.4E+38 ECU_ADDRESS 0xfe4afe9c /* @ECU_Address@PSM_KapRB@ */ /end MEASUREMENT
/begin MEASUREMENT PSM_KeepNotChangeTimeOut "" FLOAT32_IEEE autosar_swc_rlgs_CM_single 0 0 -3.4E+38 3.4E+38 ECU_ADDRESS 0xfe4afea0 /* @ECU_Address@PSM_KeepNotChangeTimeOut@ */ /end MEASUREMENT
/begin MEASUREMENT PSM_L1ShadeInhiChgTimeOut "" FLOAT32_IEEE autosar_swc_rlgs_CM_single 0 0 -3.4E+38 3.4E+38 ECU_ADDRESS 0xfe4afea4 /* @ECU_Address@PSM_L1ShadeInhiChgTimeOut@ */ /end MEASUREMENT
/begin MEASUREMENT PSM_L2ShadeInhiChgTimeOut "" FLOAT32_IEEE autosar_swc_rlgs_CM_single 0 0 -3.4E+38 3.4E+38 ECU_ADDRESS 0xfe4afea8 /* @ECU_Address@PSM_L2ShadeInhiChgTimeOut@ */ /end MEASUREMENT
/begin MEASUREMENT PSM_LBShadeInhiChgTimeOut "" FLOAT32_IEEE autosar_swc_rlgs_CM_single 0 0 -3.4E+38 3.4E+38 ECU_ADDRESS 0xfe4afeac /* @ECU_Address@PSM_LBShadeInhiChgTimeOut@ */ /end MEASUREMENT
/begin MEASUREMENT PSM_LaneChangeTrg "" UBYTE autosar_swc_rlgs_CM_boolean 0 0 0 1 ECU_ADDRESS 0xfe4b0059 /* @ECU_Address@PSM_LaneChangeTrg@ */ /end MEASUREMENT
/begin MEASUREMENT PSM_LaneLeftSlopeFlag "" UBYTE autosar_swc_rlgs_CM_boolean 0 0 0 1 ECU_ADDRESS 0xfe4b005a /* @ECU_Address@PSM_LaneLeftSlopeFlag@ */ /end MEASUREMENT
/begin MEASUREMENT PSM_LcAvoidConeLeft "" UBYTE autosar_swc_rlgs_CM_boolean 0 0 0 1 ECU_ADDRESS 0xfe4b005b /* @ECU_Address@PSM_LcAvoidConeLeft@ */ /end MEASUREMENT
/begin MEASUREMENT PSM_LcAvoidConeRight "" UBYTE autosar_swc_rlgs_CM_boolean 0 0 0 1 ECU_ADDRESS 0xfe4b005c /* @ECU_Address@PSM_LcAvoidConeRight@ */ /end MEASUREMENT
/begin MEASUREMENT PSM_LcConeLeDirValid "" UBYTE autosar_swc_rlgs_CM_boolean 0 0 0 1 MATRIX_DIM 1 1 ECU_ADDRESS 0xfe4b005d /* @ECU_Address@PSM_LcConeLeDirValid@ */ /end MEASUREMENT
/begin MEASUREMENT PSM_LcConeTkRiDirValid "" UBYTE autosar_swc_rlgs_CM_boolean 0 0 0 1 MATRIX_DIM 1 1 ECU_ADDRESS 0xfe4b005e /* @ECU_Address@PSM_LcConeTkRiDirValid@ */ /end MEASUREMENT
/begin MEASUREMENT PSM_LcOverInhibitFlag "" UBYTE autosar_swc_rlgs_CM_boolean 0 0 0 1 ECU_ADDRESS 0xfe4b005f /* @ECU_Address@PSM_LcOverInhibitFlag@ */ /end MEASUREMENT
/begin MEASUREMENT PSM_LcOverTkCondSpdGainRi "" UBYTE autosar_swc_rlgs_CM_boolean 0 0 0 1 ECU_ADDRESS 0xfe4b0060 /* @ECU_Address@PSM_LcOverTkCondSpdGainRi@ */ /end MEASUREMENT
/begin MEASUREMENT PSM_LcOverTkCondsSpdGainLe "" UBYTE autosar_swc_rlgs_CM_boolean 0 0 0 1 ECU_ADDRESS 0xfe4b0061 /* @ECU_Address@PSM_LcOverTkCondsSpdGainLe@ */ /end MEASUREMENT
/begin MEASUREMENT PSM_LcOverTkCurveLimit "" UBYTE autosar_swc_rlgs_CM_boolean 0 0 0 1 ECU_ADDRESS 0xfe4b0062 /* @ECU_Address@PSM_LcOverTkCurveLimit@ */ /end MEASUREMENT
/begin MEASUREMENT PSM_LcOverTkLeDirValid "" UBYTE autosar_swc_rlgs_CM_boolean 0 0 0 1 ECU_ADDRESS 0xfe4b0063 /* @ECU_Address@PSM_LcOverTkLeDirValid@ */ /end MEASUREMENT
/begin MEASUREMENT PSM_LcOverTkRiDirValid "" UBYTE autosar_swc_rlgs_CM_boolean 0 0 0 1 ECU_ADDRESS 0xfe4b0064 /* @ECU_Address@PSM_LcOverTkRiDirValid@ */ /end MEASUREMENT
/begin MEASUREMENT PSM_LcOverTk_ALCSwtOn "" UBYTE autosar_swc_rlgs_CM_boolean 0 0 0 1 MATRIX_DIM 1 1 ECU_ADDRESS 0xfe4b0065 /* @ECU_Address@PSM_LcOverTk_ALCSwtOn@ */ /end MEASUREMENT
/begin MEASUREMENT PSM_LcOverTk_NoOverride "" UBYTE autosar_swc_rlgs_CM_boolean 0 0 0 1 ECU_ADDRESS 0xfe4b0066 /* @ECU_Address@PSM_LcOverTk_NoOverride@ */ /end MEASUREMENT
/begin MEASUREMENT PSM_LcOverTk_NoTurnLampReq "" UBYTE autosar_swc_rlgs_CM_boolean 0 0 0 1 ECU_ADDRESS 0xfe4b0067 /* @ECU_Address@PSM_LcOverTk_NoTurnLampReq@ */ /end MEASUREMENT
/begin MEASUREMENT PSM_LcOverTk_NohstsInhibit "" UBYTE autosar_swc_rlgs_CM_boolean 0 0 0 1 ECU_ADDRESS 0xfe4b0068 /* @ECU_Address@PSM_LcOverTk_NohstsInhibit@ */ /end MEASUREMENT
/begin MEASUREMENT PSM_LcOverTk_SpeedSuppressed "" UBYTE autosar_swc_rlgs_CM_boolean 0 0 0 1 MATRIX_DIM 1 1 ECU_ADDRESS 0xfe4b0069 /* @ECU_Address@PSM_LcOverTk_SpeedSuppressed@ */ /end MEASUREMENT
/begin MEASUREMENT PSM_LeftLaneChgFlag "" UBYTE autosar_swc_rlgs_CM_boolean 0 0 0 1 ECU_ADDRESS 0xfe4b006a /* @ECU_Address@PSM_LeftLaneChgFlag@ */ /end MEASUREMENT
/begin MEASUREMENT PSM_LeftMergeFinishFlag "" UBYTE autosar_swc_rlgs_CM_boolean 0 0 0 1 ECU_ADDRESS 0xfe4b006b /* @ECU_Address@PSM_LeftMergeFinishFlag@ */ /end MEASUREMENT
/begin MEASUREMENT PSM_LeftMergeFlag "" UBYTE autosar_swc_rlgs_CM_boolean 0 0 0 1 ECU_ADDRESS 0xfe4b006c /* @ECU_Address@PSM_LeftMergeFlag@ */ /end MEASUREMENT
/begin MEASUREMENT PSM_LeftTurnReq "" UBYTE autosar_swc_rlgs_CM_boolean 0 0 0 1 ECU_ADDRESS 0xfe4b006d /* @ECU_Address@PSM_LeftTurnReq@ */ /end MEASUREMENT
/begin MEASUREMENT PSM_MatchCalControlLineDy "" FLOAT32_IEEE autosar_swc_rlgs_CM_single 0 0 -3.4E+38 3.4E+38 ECU_ADDRESS 0xfe4afeb0 /* @ECU_Address@PSM_MatchCalControlLineDy@ */ /end MEASUREMENT
/begin MEASUREMENT PSM_MergeInhibitLeftLcOverFlag "" UBYTE autosar_swc_rlgs_CM_boolean 0 0 0 1 ECU_ADDRESS 0xfe4b006e /* @ECU_Address@PSM_MergeInhibitLeftLcOverFlag@ */ /end MEASUREMENT
/begin MEASUREMENT PSM_NOAExitFlagByToll "" UBYTE autosar_swc_rlgs_CM_boolean 0 0 0 1 ECU_ADDRESS 0xfe4b006f /* @ECU_Address@PSM_NOAExitFlagByToll@ */ /end MEASUREMENT
/begin MEASUREMENT PSM_NOAExitFlagByToll2 "" UBYTE autosar_swc_rlgs_CM_boolean 0 0 0 1 ECU_ADDRESS 0xfe4b0070 /* @ECU_Address@PSM_NOAExitFlagByToll2@ */ /end MEASUREMENT
/begin MEASUREMENT PSM_NOAExitRemindByToll "" UBYTE autosar_swc_rlgs_CM_uint8 0 0 0 255 ECU_ADDRESS 0xfe4b0071 /* @ECU_Address@PSM_NOAExitRemindByToll@ */ /end MEASUREMENT
/begin MEASUREMENT PSM_NOAFirstTrigerLeftChgFlag "" UBYTE autosar_swc_rlgs_CM_boolean 0 0 0 1 ECU_ADDRESS 0xfe4b0072 /* @ECU_Address@PSM_NOAFirstTrigerLeftChgFlag@ */ /end MEASUREMENT
/begin MEASUREMENT PSM_NOAFirstTrigerLeftChgSts "" UBYTE autosar_swc_rlgs_CM_uint8 0 0 0 255 ECU_ADDRESS 0xfe4b0073 /* @ECU_Address@PSM_NOAFirstTrigerLeftChgSts@ */ /end MEASUREMENT
/begin MEASUREMENT PSM_NOANAVLeftChgSts "" UBYTE autosar_swc_rlgs_CM_uint8 0 0 0 255 ECU_ADDRESS 0xfe4b0074 /* @ECU_Address@PSM_NOANAVLeftChgSts@ */ /end MEASUREMENT
/begin MEASUREMENT PSM_NOANAVRiChgSts "" UBYTE autosar_swc_rlgs_CM_uint8 0 0 0 255 ECU_ADDRESS 0xfe4b0075 /* @ECU_Address@PSM_NOANAVRiChgSts@ */ /end MEASUREMENT
/begin MEASUREMENT PSM_NOA_LaneNumber "" UBYTE autosar_swc_rlgs_CM_uint8 0 0 0 255 MATRIX_DIM 1 1 ECU_ADDRESS 0xfe4b0076 /* @ECU_Address@PSM_NOA_LaneNumber@ */ /end MEASUREMENT
/begin MEASUREMENT PSM_NextStubIsRiSplitInhibitLeftMergeFlag "" UBYTE autosar_swc_rlgs_CM_boolean 0 0 0 1 ECU_ADDRESS 0xfe4b0077 /* @ECU_Address@PSM_NextStubIsRiSplitInhibitLeftMergeFlag@ */ /end MEASUREMENT
/begin MEASUREMENT PSM_RampSts "" UBYTE autosar_swc_rlgs_CM_uint8 0 0 0 255 ECU_ADDRESS 0xfe4b0078 /* @ECU_Address@PSM_RampSts@ */ /end MEASUREMENT
/begin MEASUREMENT PSM_Ramp_Cruise "" UBYTE autosar_swc_rlgs_CM_boolean 0 0 0 1 MATRIX_DIM 1 1 ECU_ADDRESS 0xfe4b0079 /* @ECU_Address@PSM_Ramp_Cruise@ */ /end MEASUREMENT
/begin MEASUREMENT PSM_Ramp_LeftMerge "" UBYTE autosar_swc_rlgs_CM_boolean 0 0 0 1 ECU_ADDRESS 0xfe4b007a /* @ECU_Address@PSM_Ramp_LeftMerge@ */ /end MEASUREMENT
/begin MEASUREMENT PSM_Ramp_LeftMerge_Finish "" UBYTE autosar_swc_rlgs_CM_boolean 0 0 0 1 MATRIX_DIM 1 1 ECU_ADDRESS 0xfe4b007b /* @ECU_Address@PSM_Ramp_LeftMerge_Finish@ */ /end MEASUREMENT
/begin MEASUREMENT PSM_Ramp_LeftMerge_InStub "" UBYTE autosar_swc_rlgs_CM_boolean 0 0 0 1 ECU_ADDRESS 0xfe4b007c /* @ECU_Address@PSM_Ramp_LeftMerge_InStub@ */ /end MEASUREMENT
/begin MEASUREMENT PSM_Ramp_LeftStraight "" UBYTE autosar_swc_rlgs_CM_boolean 0 0 0 1 ECU_ADDRESS 0xfe4b007d /* @ECU_Address@PSM_Ramp_LeftStraight@ */ /end MEASUREMENT
/begin MEASUREMENT PSM_Ramp_RightSplit "" UBYTE autosar_swc_rlgs_CM_boolean 0 0 0 1 ECU_ADDRESS 0xfe4b007e /* @ECU_Address@PSM_Ramp_RightSplit@ */ /end MEASUREMENT
/begin MEASUREMENT PSM_Ramp_RightSplit_BfStub "" UBYTE autosar_swc_rlgs_CM_boolean 0 0 0 1 ECU_ADDRESS 0xfe4b007f /* @ECU_Address@PSM_Ramp_RightSplit_BfStub@ */ /end MEASUREMENT
/begin MEASUREMENT PSM_Ramp_RightSplit_InStub "" UBYTE autosar_swc_rlgs_CM_boolean 0 0 0 1 ECU_ADDRESS 0xfe4b0080 /* @ECU_Address@PSM_Ramp_RightSplit_InStub@ */ /end MEASUREMENT
/begin MEASUREMENT PSM_RiClassYBranchSts "" UBYTE autosar_swc_rlgs_CM_uint8 0 0 0 255 ECU_ADDRESS 0xfe4b0081 /* @ECU_Address@PSM_RiClassYBranchSts@ */ /end MEASUREMENT
/begin MEASUREMENT PSM_RiRoadClass_Narrow "" UBYTE autosar_swc_rlgs_CM_uint8 0 0 0 255 ECU_ADDRESS 0xfe4b0082 /* @ECU_Address@PSM_RiRoadClass_Narrow@ */ /end MEASUREMENT
/begin MEASUREMENT PSM_RiRoadClass_New "" UBYTE autosar_swc_rlgs_CM_uint8 0 0 0 255 ECU_ADDRESS 0xfe4b0083 /* @ECU_Address@PSM_RiRoadClass_New@ */ /end MEASUREMENT
/begin MEASUREMENT PSM_RiRoadClass_Out "" UBYTE autosar_swc_rlgs_CM_uint8 0 0 0 255 ECU_ADDRESS 0xfe4b0084 /* @ECU_Address@PSM_RiRoadClass_Out@ */ /end MEASUREMENT
/begin MEASUREMENT PSM_RiTurnReq "" UBYTE autosar_swc_rlgs_CM_boolean 0 0 0 1 ECU_ADDRESS 0xfe4b0085 /* @ECU_Address@PSM_RiTurnReq@ */ /end MEASUREMENT
/begin MEASUREMENT PSM_RightLaneChgFlag "" UBYTE autosar_swc_rlgs_CM_boolean 0 0 0 1 ECU_ADDRESS 0xfe4b0086 /* @ECU_Address@PSM_RightLaneChgFlag@ */ /end MEASUREMENT
/begin MEASUREMENT PSM_RightSplit "" UBYTE autosar_swc_rlgs_CM_boolean 0 0 0 1 ECU_ADDRESS 0xfe4b0087 /* @ECU_Address@PSM_RightSplit@ */ /end MEASUREMENT
/begin MEASUREMENT PSM_RightSplit_BfStub "" UBYTE autosar_swc_rlgs_CM_boolean 0 0 0 1 ECU_ADDRESS 0xfe4b0088 /* @ECU_Address@PSM_RightSplit_BfStub@ */ /end MEASUREMENT
/begin MEASUREMENT PSM_RightSplit_InStub "" UBYTE autosar_swc_rlgs_CM_boolean 0 0 0 1 ECU_ADDRESS 0xfe4b0089 /* @ECU_Address@PSM_RightSplit_InStub@ */ /end MEASUREMENT
/begin MEASUREMENT PSM_ScenarioClass "" UBYTE autosar_swc_rlgs_CM_uint8 0 0 0 255 MATRIX_DIM 1 1 ECU_ADDRESS 0xfe4b008a /* @ECU_Address@PSM_ScenarioClass@ */ /end MEASUREMENT
/begin MEASUREMENT PSM_ScenarioSubType "" UBYTE autosar_swc_rlgs_CM_uint8 0 0 0 255 MATRIX_DIM 1 1 ECU_ADDRESS 0xfe4b008b /* @ECU_Address@PSM_ScenarioSubType@ */ /end MEASUREMENT
/begin MEASUREMENT PSM_ScenarioType "" UBYTE autosar_swc_rlgs_CM_uint8 0 0 0 255 MATRIX_DIM 1 1 ECU_ADDRESS 0xfe4b008c /* @ECU_Address@PSM_ScenarioType@ */ /end MEASUREMENT
/begin MEASUREMENT PSM_SuggDrvDirection "" UBYTE autosar_swc_rlgs_CM_uint8 0 0 0 255 MATRIX_DIM 1 1 ECU_ADDRESS 0xfe4b008d /* @ECU_Address@PSM_SuggDrvDirection@ */ /end MEASUREMENT
/begin MEASUREMENT PSM_VehInAdjacentLeftmostLane_Flag "" UBYTE autosar_swc_rlgs_CM_boolean 0 0 0 1 ECU_ADDRESS 0xfe4b008e /* @ECU_Address@PSM_VehInAdjacentLeftmostLane_Flag@ */ /end MEASUREMENT
/begin MEASUREMENT PSM_VehInAdjacentRightmostLane_Flag "" UBYTE autosar_swc_rlgs_CM_boolean 0 0 0 1 ECU_ADDRESS 0xfe4b008f /* @ECU_Address@PSM_VehInAdjacentRightmostLane_Flag@ */ /end MEASUREMENT
/begin MEASUREMENT PSM_VehInLeftmostLane_Flag "" UBYTE autosar_swc_rlgs_CM_boolean 0 0 0 1 ECU_ADDRESS 0xfe4b0090 /* @ECU_Address@PSM_VehInLeftmostLane_Flag@ */ /end MEASUREMENT
/begin MEASUREMENT PSM_VehInPathFlag "" UBYTE autosar_swc_rlgs_CM_boolean 0 0 0 1 ECU_ADDRESS 0xfe4b0091 /* @ECU_Address@PSM_VehInPathFlag@ */ /end MEASUREMENT
/begin MEASUREMENT PSM_VehInRightmostLane_Flag "" UBYTE autosar_swc_rlgs_CM_boolean 0 0 0 1 ECU_ADDRESS 0xfe4b0092 /* @ECU_Address@PSM_VehInRightmostLane_Flag@ */ /end MEASUREMENT
/begin MEASUREMENT PSM_YBranchPointDisOut "" SLONG autosar_swc_rlgs_CM_int32 0 0 -2147483648 2147483647 ECU_ADDRESS 0xfe4afeb4 /* @ECU_Address@PSM_YBranchPointDisOut@ */ /end MEASUREMENT
/begin MEASUREMENT PSM_YBranchSts "" UBYTE autosar_swc_rlgs_CM_uint8 0 0 0 255 ECU_ADDRESS 0xfe4b0093 /* @ECU_Address@PSM_YBranchSts@ */ /end MEASUREMENT
/begin MEASUREMENT PSM_mostLeftLane_FlagConfig "" UBYTE autosar_swc_rlgs_CM_boolean 0 0 0 1 ECU_ADDRESS 0xfe4b0094 /* @ECU_Address@PSM_mostLeftLane_FlagConfig@ */ /end MEASUREMENT
/begin MEASUREMENT PSM_reserve01 "" UBYTE autosar_swc_rlgs_CM_uint8 0 0 0 255 ECU_ADDRESS 0xfe4b0095 /* @ECU_Address@PSM_reserve01@ */ /end MEASUREMENT
/begin MEASUREMENT PSM_reserve07 "" FLOAT32_IEEE autosar_swc_rlgs_CM_single 0 0 -3.4E+38 3.4E+38 MATRIX_DIM 1 1 ECU_ADDRESS 0xfe4afecc /* @ECU_Address@PSM_reserve07@ */ /end MEASUREMENT
/begin MEASUREMENT PSM_reserve08 "" FLOAT32_IEEE autosar_swc_rlgs_CM_single 0 0 -3.4E+38 3.4E+38 MATRIX_DIM 1 1 ECU_ADDRESS 0xfe4afed0 /* @ECU_Address@PSM_reserve08@ */ /end MEASUREMENT
/begin MEASUREMENT RLGS_PSM_LciDrvCondsLe "" ULONG autosar_swc_rlgs_CM_uint32 0 0 0 4294967295 ECU_ADDRESS 0xfe4afedc /* @ECU_Address@RLGS_PSM_LciDrvCondsLe@ */ /end MEASUREMENT
/begin MEASUREMENT RLGS_PSM_LciDrvCondsRi "" ULONG autosar_swc_rlgs_CM_uint32 0 0 0 4294967295 ECU_ADDRESS 0xfe4afee0 /* @ECU_Address@RLGS_PSM_LciDrvCondsRi@ */ /end MEASUREMENT
/begin MEASUREMENT autosar_swc_rlgs_rtARID_DEF.A0K1 "" FLOAT32_IEEE autosar_swc_rlgs_CM_single 0 0 -3.4E+38 3.4E+38 ECU_ADDRESS 0xfe4afa2c /* @ECU_Address@autosar_swc_rlgs_rtARID_DEF.A0K1@ */ /end MEASUREMENT
/begin MEASUREMENT autosar_swc_rlgs_rtARID_DEF.A0K1_e "" FLOAT32_IEEE autosar_swc_rlgs_CM_single 0 0 -3.4E+38 3.4E+38 ECU_ADDRESS 0xfe4afafc /* @ECU_Address@autosar_swc_rlgs_rtARID_DEF.A0K1_e@ */ /end MEASUREMENT
/begin MEASUREMENT autosar_swc_rlgs_rtARID_DEF.A0K1_f "" FLOAT32_IEEE autosar_swc_rlgs_CM_single 0 0 -3.4E+38 3.4E+38 ECU_ADDRESS 0xfe4afa6c /* @ECU_Address@autosar_swc_rlgs_rtARID_DEF.A0K1_f@ */ /end MEASUREMENT
/begin MEASUREMENT autosar_swc_rlgs_rtARID_DEF.A0K1_g "" FLOAT32_IEEE autosar_swc_rlgs_CM_single 0 0 -3.4E+38 3.4E+38 ECU_ADDRESS 0xfe4afa4c /* @ECU_Address@autosar_swc_rlgs_rtARID_DEF.A0K1_g@ */ /end MEASUREMENT
/begin MEASUREMENT autosar_swc_rlgs_rtARID_DEF.A0K1_k "" FLOAT32_IEEE autosar_swc_rlgs_CM_single 0 0 -3.4E+38 3.4E+38 ECU_ADDRESS 0xfe4afa9c /* @ECU_Address@autosar_swc_rlgs_rtARID_DEF.A0K1_k@ */ /end MEASUREMENT
/begin MEASUREMENT autosar_swc_rlgs_rtARID_DEF.A0K1_n "" FLOAT32_IEEE autosar_swc_rlgs_CM_single 0 0 -3.4E+38 3.4E+38 ECU_ADDRESS 0xfe4afacc /* @ECU_Address@autosar_swc_rlgs_rtARID_DEF.A0K1_n@ */ /end MEASUREMENT
/begin MEASUREMENT autosar_swc_rlgs_rtARID_DEF.A1K1 "" FLOAT32_IEEE autosar_swc_rlgs_CM_single 0 0 -3.4E+38 3.4E+38 ECU_ADDRESS 0xfe4afa28 /* @ECU_Address@autosar_swc_rlgs_rtARID_DEF.A1K1@ */ /end MEASUREMENT
/begin MEASUREMENT autosar_swc_rlgs_rtARID_DEF.A1K1_a "" FLOAT32_IEEE autosar_swc_rlgs_CM_single 0 0 -3.4E+38 3.4E+38 ECU_ADDRESS 0xfe4afa48 /* @ECU_Address@autosar_swc_rlgs_rtARID_DEF.A1K1_a@ */ /end MEASUREMENT
/begin MEASUREMENT autosar_swc_rlgs_rtARID_DEF.A1K1_k "" FLOAT32_IEEE autosar_swc_rlgs_CM_single 0 0 -3.4E+38 3.4E+38 ECU_ADDRESS 0xfe4afaf8 /* @ECU_Address@autosar_swc_rlgs_rtARID_DEF.A1K1_k@ */ /end MEASUREMENT
/begin MEASUREMENT autosar_swc_rlgs_rtARID_DEF.A1K1_l "" FLOAT32_IEEE autosar_swc_rlgs_CM_single 0 0 -3.4E+38 3.4E+38 ECU_ADDRESS 0xfe4afac8 /* @ECU_Address@autosar_swc_rlgs_rtARID_DEF.A1K1_l@ */ /end MEASUREMENT
/begin MEASUREMENT autosar_swc_rlgs_rtARID_DEF.A1K1_n "" FLOAT32_IEEE autosar_swc_rlgs_CM_single 0 0 -3.4E+38 3.4E+38 ECU_ADDRESS 0xfe4afa68 /* @ECU_Address@autosar_swc_rlgs_rtARID_DEF.A1K1_n@ */ /end MEASUREMENT
/begin MEASUREMENT autosar_swc_rlgs_rtARID_DEF.A1K1_o "" FLOAT32_IEEE autosar_swc_rlgs_CM_single 0 0 -3.4E+38 3.4E+38 ECU_ADDRESS 0xfe4afa98 /* @ECU_Address@autosar_swc_rlgs_rtARID_DEF.A1K1_o@ */ /end MEASUREMENT
/begin MEASUREMENT autosar_swc_rlgs_rtARID_DEF.A2K1 "" FLOAT32_IEEE autosar_swc_rlgs_CM_single 0 0 -3.4E+38 3.4E+38 ECU_ADDRESS 0xfe4afa24 /* @ECU_Address@autosar_swc_rlgs_rtARID_DEF.A2K1@ */ /end MEASUREMENT
/begin MEASUREMENT autosar_swc_rlgs_rtARID_DEF.A2K1_f "" FLOAT32_IEEE autosar_swc_rlgs_CM_single 0 0 -3.4E+38 3.4E+38 ECU_ADDRESS 0xfe4afa44 /* @ECU_Address@autosar_swc_rlgs_rtARID_DEF.A2K1_f@ */ /end MEASUREMENT
/begin MEASUREMENT autosar_swc_rlgs_rtARID_DEF.A2K1_ff "" FLOAT32_IEEE autosar_swc_rlgs_CM_single 0 0 -3.4E+38 3.4E+38 ECU_ADDRESS 0xfe4afac4 /* @ECU_Address@autosar_swc_rlgs_rtARID_DEF.A2K1_ff@ */ /end MEASUREMENT
/begin MEASUREMENT autosar_swc_rlgs_rtARID_DEF.A2K1_fh "" FLOAT32_IEEE autosar_swc_rlgs_CM_single 0 0 -3.4E+38 3.4E+38 ECU_ADDRESS 0xfe4afa64 /* @ECU_Address@autosar_swc_rlgs_rtARID_DEF.A2K1_fh@ */ /end MEASUREMENT
/begin MEASUREMENT autosar_swc_rlgs_rtARID_DEF.A2K1_m "" FLOAT32_IEEE autosar_swc_rlgs_CM_single 0 0 -3.4E+38 3.4E+38 ECU_ADDRESS 0xfe4afaf4 /* @ECU_Address@autosar_swc_rlgs_rtARID_DEF.A2K1_m@ */ /end MEASUREMENT
/begin MEASUREMENT autosar_swc_rlgs_rtARID_DEF.A2K1_p "" FLOAT32_IEEE autosar_swc_rlgs_CM_single 0 0 -3.4E+38 3.4E+38 ECU_ADDRESS 0xfe4afa94 /* @ECU_Address@autosar_swc_rlgs_rtARID_DEF.A2K1_p@ */ /end MEASUREMENT
/begin MEASUREMENT autosar_swc_rlgs_rtARID_DEF.A3K1 "" FLOAT32_IEEE autosar_swc_rlgs_CM_single 0 0 -3.4E+38 3.4E+38 ECU_ADDRESS 0xfe4afa20 /* @ECU_Address@autosar_swc_rlgs_rtARID_DEF.A3K1@ */ /end MEASUREMENT
/begin MEASUREMENT autosar_swc_rlgs_rtARID_DEF.A3K1_g "" FLOAT32_IEEE autosar_swc_rlgs_CM_single 0 0 -3.4E+38 3.4E+38 ECU_ADDRESS 0xfe4afac0 /* @ECU_Address@autosar_swc_rlgs_rtARID_DEF.A3K1_g@ */ /end MEASUREMENT
/begin MEASUREMENT autosar_swc_rlgs_rtARID_DEF.A3K1_j "" FLOAT32_IEEE autosar_swc_rlgs_CM_single 0 0 -3.4E+38 3.4E+38 ECU_ADDRESS 0xfe4afa60 /* @ECU_Address@autosar_swc_rlgs_rtARID_DEF.A3K1_j@ */ /end MEASUREMENT
/begin MEASUREMENT autosar_swc_rlgs_rtARID_DEF.A3K1_o "" FLOAT32_IEEE autosar_swc_rlgs_CM_single 0 0 -3.4E+38 3.4E+38 ECU_ADDRESS 0xfe4afa40 /* @ECU_Address@autosar_swc_rlgs_rtARID_DEF.A3K1_o@ */ /end MEASUREMENT
/begin MEASUREMENT autosar_swc_rlgs_rtARID_DEF.A3K1_o3 "" FLOAT32_IEEE autosar_swc_rlgs_CM_single 0 0 -3.4E+38 3.4E+38 ECU_ADDRESS 0xfe4afa90 /* @ECU_Address@autosar_swc_rlgs_rtARID_DEF.A3K1_o3@ */ /end MEASUREMENT
/begin MEASUREMENT autosar_swc_rlgs_rtARID_DEF.A3K1_p "" FLOAT32_IEEE autosar_swc_rlgs_CM_single 0 0 -3.4E+38 3.4E+38 ECU_ADDRESS 0xfe4afaf0 /* @ECU_Address@autosar_swc_rlgs_rtARID_DEF.A3K1_p@ */ /end MEASUREMENT
/begin MEASUREMENT autosar_swc_rlgs_rtARID_DEF.ALC_LcCtrlLevel "" UBYTE autosar_swc_rlgs_CM_uint8 0 0 0 255 MATRIX_DIM 1 1 ECU_ADDRESS 0xfe4afcd9 /* @ECU_Address@autosar_swc_rlgs_rtARID_DEF.ALC_LcCtrlLevel@ */ /end MEASUREMENT
/begin MEASUREMENT autosar_swc_rlgs_rtARID_DEF.AutoLmpStsFlag "" UBYTE autosar_swc_rlgs_CM_logical 0 0 0 1 ECU_ADDRESS 0xfe4afd94 /* @ECU_Address@autosar_swc_rlgs_rtARID_DEF.AutoLmpStsFlag@ */ /end MEASUREMENT
/begin MEASUREMENT autosar_swc_rlgs_rtARID_DEF.AutoLmpStsFlag_f "" UBYTE autosar_swc_rlgs_CM_logical 0 0 0 1 ECU_ADDRESS 0xfe4afd9b /* @ECU_Address@autosar_swc_rlgs_rtARID_DEF.AutoLmpStsFlag_f@ */ /end MEASUREMENT
/begin MEASUREMENT autosar_swc_rlgs_rtARID_DEF.CntTime "" FLOAT32_IEEE autosar_swc_rlgs_CM_single 0 0 -3.4E+38 3.4E+38 ECU_ADDRESS 0xfe4af9f8 /* @ECU_Address@autosar_swc_rlgs_rtARID_DEF.CntTime@ */ /end MEASUREMENT
/begin MEASUREMENT autosar_swc_rlgs_rtARID_DEF.CntTime4Confirm "" FLOAT32_IEEE autosar_swc_rlgs_CM_single 0 0 -3.4E+38 3.4E+38 ECU_ADDRESS 0xfe4afa00 /* @ECU_Address@autosar_swc_rlgs_rtARID_DEF.CntTime4Confirm@ */ /end MEASUREMENT
/begin MEASUREMENT autosar_swc_rlgs_rtARID_DEF.CntTime_f "" FLOAT32_IEEE autosar_swc_rlgs_CM_single 0 0 -3.4E+38 3.4E+38 ECU_ADDRESS 0xfe4af9fc /* @ECU_Address@autosar_swc_rlgs_rtARID_DEF.CntTime_f@ */ /end MEASUREMENT
/begin MEASUREMENT autosar_swc_rlgs_rtARID_DEF.DistK1 "" FLOAT32_IEEE autosar_swc_rlgs_CM_single 0 0 -3.4E+38 3.4E+38 ECU_ADDRESS 0xfe4af980 /* @ECU_Address@autosar_swc_rlgs_rtARID_DEF.DistK1@ */ /end MEASUREMENT
/begin MEASUREMENT autosar_swc_rlgs_rtARID_DEF.Distance "" FLOAT32_IEEE autosar_swc_rlgs_CM_single 0 0 -3.4E+38 3.4E+38 ECU_ADDRESS 0xfe4af9d0 /* @ECU_Address@autosar_swc_rlgs_rtARID_DEF.Distance@ */ /end MEASUREMENT
/begin MEASUREMENT autosar_swc_rlgs_rtARID_DEF.DistanceLimit "" FLOAT32_IEEE autosar_swc_rlgs_CM_single 0 0 -3.4E+38 3.4E+38 ECU_ADDRESS 0xfe4af9bc /* @ECU_Address@autosar_swc_rlgs_rtARID_DEF.DistanceLimit@ */ /end MEASUREMENT
/begin MEASUREMENT autosar_swc_rlgs_rtARID_DEF.ExitHoldTime "" FLOAT32_IEEE autosar_swc_rlgs_CM_single 0 0 -3.4E+38 3.4E+38 ECU_ADDRESS 0xfe4afa10 /* @ECU_Address@autosar_swc_rlgs_rtARID_DEF.ExitHoldTime@ */ /end MEASUREMENT
/begin MEASUREMENT autosar_swc_rlgs_rtARID_DEF.ForceLaneChgTime "" FLOAT32_IEEE autosar_swc_rlgs_CM_single 0 0 -3.4E+38 3.4E+38 ECU_ADDRESS 0xfe4af9f4 /* @ECU_Address@autosar_swc_rlgs_rtARID_DEF.ForceLaneChgTime@ */ /end MEASUREMENT
/begin MEASUREMENT autosar_swc_rlgs_rtARID_DEF.ForceLeftChgTime "" FLOAT32_IEEE autosar_swc_rlgs_CM_single 0 0 -3.4E+38 3.4E+38 ECU_ADDRESS 0xfe4af9b8 /* @ECU_Address@autosar_swc_rlgs_rtARID_DEF.ForceLeftChgTime@ */ /end MEASUREMENT
/begin MEASUREMENT autosar_swc_rlgs_rtARID_DEF.ForceLeftChgTime_e "" FLOAT32_IEEE autosar_swc_rlgs_CM_single 0 0 -3.4E+38 3.4E+38 ECU_ADDRESS 0xfe4af9ec /* @ECU_Address@autosar_swc_rlgs_rtARID_DEF.ForceLeftChgTime_e@ */ /end MEASUREMENT
/begin MEASUREMENT autosar_swc_rlgs_rtARID_DEF.ForceRiChgTime "" FLOAT32_IEEE autosar_swc_rlgs_CM_single 0 0 -3.4E+38 3.4E+38 ECU_ADDRESS 0xfe4af9f0 /* @ECU_Address@autosar_swc_rlgs_rtARID_DEF.ForceRiChgTime@ */ /end MEASUREMENT
/begin MEASUREMENT autosar_swc_rlgs_rtARID_DEF.HoldCond1 "" UBYTE autosar_swc_rlgs_CM_logical 0 0 0 1 ECU_ADDRESS 0xfe4afd96 /* @ECU_Address@autosar_swc_rlgs_rtARID_DEF.HoldCond1@ */ /end MEASUREMENT
/begin MEASUREMENT autosar_swc_rlgs_rtARID_DEF.HoldCond1_d "" UBYTE autosar_swc_rlgs_CM_logical 0 0 0 1 ECU_ADDRESS 0xfe4afd9d /* @ECU_Address@autosar_swc_rlgs_rtARID_DEF.HoldCond1_d@ */ /end MEASUREMENT
/begin MEASUREMENT autosar_swc_rlgs_rtARID_DEF.HoldCond1_f "" UBYTE autosar_swc_rlgs_CM_logical 0 0 0 1 ECU_ADDRESS 0xfe4afda8 /* @ECU_Address@autosar_swc_rlgs_rtARID_DEF.HoldCond1_f@ */ /end MEASUREMENT
/begin MEASUREMENT autosar_swc_rlgs_rtARID_DEF.HoldCond1_m "" UBYTE autosar_swc_rlgs_CM_logical 0 0 0 1 ECU_ADDRESS 0xfe4afda4 /* @ECU_Address@autosar_swc_rlgs_rtARID_DEF.HoldCond1_m@ */ /end MEASUREMENT
/begin MEASUREMENT autosar_swc_rlgs_rtARID_DEF.HoldCond2 "" UBYTE autosar_swc_rlgs_CM_logical 0 0 0 1 ECU_ADDRESS 0xfe4afd97 /* @ECU_Address@autosar_swc_rlgs_rtARID_DEF.HoldCond2@ */ /end MEASUREMENT
/begin MEASUREMENT autosar_swc_rlgs_rtARID_DEF.HoldCond2_c "" UBYTE autosar_swc_rlgs_CM_logical 0 0 0 1 ECU_ADDRESS 0xfe4afd9e /* @ECU_Address@autosar_swc_rlgs_rtARID_DEF.HoldCond2_c@ */ /end MEASUREMENT
/begin MEASUREMENT autosar_swc_rlgs_rtARID_DEF.HoldCond2_f "" UBYTE autosar_swc_rlgs_CM_logical 0 0 0 1 ECU_ADDRESS 0xfe4afda5 /* @ECU_Address@autosar_swc_rlgs_rtARID_DEF.HoldCond2_f@ */ /end MEASUREMENT
/begin MEASUREMENT autosar_swc_rlgs_rtARID_DEF.HoldCond2_n "" UBYTE autosar_swc_rlgs_CM_logical 0 0 0 1 ECU_ADDRESS 0xfe4afda9 /* @ECU_Address@autosar_swc_rlgs_rtARID_DEF.HoldCond2_n@ */ /end MEASUREMENT
/begin MEASUREMENT autosar_swc_rlgs_rtARID_DEF.HoldCond3 "" UBYTE autosar_swc_rlgs_CM_logical 0 0 0 1 ECU_ADDRESS 0xfe4afd98 /* @ECU_Address@autosar_swc_rlgs_rtARID_DEF.HoldCond3@ */ /end MEASUREMENT
/begin MEASUREMENT autosar_swc_rlgs_rtARID_DEF.HoldCond3_l "" UBYTE autosar_swc_rlgs_CM_logical 0 0 0 1 ECU_ADDRESS 0xfe4afd9f /* @ECU_Address@autosar_swc_rlgs_rtARID_DEF.HoldCond3_l@ */ /end MEASUREMENT
/begin MEASUREMENT autosar_swc_rlgs_rtARID_DEF.HoldCond3_n "" UBYTE autosar_swc_rlgs_CM_logical 0 0 0 1 ECU_ADDRESS 0xfe4afdaa /* @ECU_Address@autosar_swc_rlgs_rtARID_DEF.HoldCond3_n@ */ /end MEASUREMENT
/begin MEASUREMENT autosar_swc_rlgs_rtARID_DEF.HoldCond3_p "" UBYTE autosar_swc_rlgs_CM_logical 0 0 0 1 ECU_ADDRESS 0xfe4afda6 /* @ECU_Address@autosar_swc_rlgs_rtARID_DEF.HoldCond3_p@ */ /end MEASUREMENT
/begin MEASUREMENT autosar_swc_rlgs_rtARID_DEF.HoldCond4 "" UBYTE autosar_swc_rlgs_CM_logical 0 0 0 1 ECU_ADDRESS 0xfe4afd99 /* @ECU_Address@autosar_swc_rlgs_rtARID_DEF.HoldCond4@ */ /end MEASUREMENT
/begin MEASUREMENT autosar_swc_rlgs_rtARID_DEF.HoldCond4_e "" UBYTE autosar_swc_rlgs_CM_logical 0 0 0 1 ECU_ADDRESS 0xfe4afda7 /* @ECU_Address@autosar_swc_rlgs_rtARID_DEF.HoldCond4_e@ */ /end MEASUREMENT
/begin MEASUREMENT autosar_swc_rlgs_rtARID_DEF.HoldCond4_h "" UBYTE autosar_swc_rlgs_CM_logical 0 0 0 1 ECU_ADDRESS 0xfe4afdab /* @ECU_Address@autosar_swc_rlgs_rtARID_DEF.HoldCond4_h@ */ /end MEASUREMENT
/begin MEASUREMENT autosar_swc_rlgs_rtARID_DEF.HoldCond4_o "" UBYTE autosar_swc_rlgs_CM_logical 0 0 0 1 ECU_ADDRESS 0xfe4afda0 /* @ECU_Address@autosar_swc_rlgs_rtARID_DEF.HoldCond4_o@ */ /end MEASUREMENT
/begin MEASUREMENT autosar_swc_rlgs_rtARID_DEF.InhibitHighWayLeftMergeBySplit "" UBYTE autosar_swc_rlgs_CM_logical 0 0 0 1 ECU_ADDRESS 0xfe4afda3 /* @ECU_Address@autosar_swc_rlgs_rtARID_DEF.InhibitHighWayLeftMergeBySplit@ */ /end MEASUREMENT
/begin MEASUREMENT autosar_swc_rlgs_rtARID_DEF.InhibitTime "" FLOAT32_IEEE autosar_swc_rlgs_CM_single 0 0 -3.4E+38 3.4E+38 ECU_ADDRESS 0xfe4af970 /* @ECU_Address@autosar_swc_rlgs_rtARID_DEF.InhibitTime@ */ /end MEASUREMENT
/begin MEASUREMENT autosar_swc_rlgs_rtARID_DEF.IniBranchDis "" SLONG autosar_swc_rlgs_CM_int32 0 0 -2147483648 2147483647 ECU_ADDRESS 0xfe4afc74 /* @ECU_Address@autosar_swc_rlgs_rtARID_DEF.IniBranchDis@ */ /end MEASUREMENT
/begin MEASUREMENT autosar_swc_rlgs_rtARID_DEF.IsLeftMergeStubExistFlagK1 "" UBYTE autosar_swc_rlgs_CM_logical 0 0 0 1 ECU_ADDRESS 0xfe4afdbb /* @ECU_Address@autosar_swc_rlgs_rtARID_DEF.IsLeftMergeStubExistFlagK1@ */ /end MEASUREMENT
/begin MEASUREMENT autosar_swc_rlgs_rtARID_DEF.IsLeftMergeStubExistFlagK1_o "" UBYTE autosar_swc_rlgs_CM_logical 0 0 0 1 ECU_ADDRESS 0xfe4afdbd /* @ECU_Address@autosar_swc_rlgs_rtARID_DEF.IsLeftMergeStubExistFlagK1_o@ */ /end MEASUREMENT
/begin MEASUREMENT autosar_swc_rlgs_rtARID_DEF.IsLeftMergeStubExistFlagMemoryFlag "" UBYTE autosar_swc_rlgs_CM_logical 0 0 0 1 ECU_ADDRESS 0xfe4afdba /* @ECU_Address@autosar_swc_rlgs_rtARID_DEF.IsLeftMergeStubExistFlagMemoryFlag@ */ /end MEASUREMENT
/begin MEASUREMENT autosar_swc_rlgs_rtARID_DEF.IsLeftMergeStubExistFlagMemoryFlag_n "" UBYTE autosar_swc_rlgs_CM_logical 0 0 0 1 ECU_ADDRESS 0xfe4afdbc /* @ECU_Address@autosar_swc_rlgs_rtARID_DEF.IsLeftMergeStubExistFlagMemoryFlag_n@ */ /end MEASUREMENT
/begin MEASUREMENT autosar_swc_rlgs_rtARID_DEF.IsLeftMergeStubExistFlag_temp "" UBYTE autosar_swc_rlgs_CM_logical 0 0 0 1 ECU_ADDRESS 0xfe4afdbf /* @ECU_Address@autosar_swc_rlgs_rtARID_DEF.IsLeftMergeStubExistFlag_temp@ */ /end MEASUREMENT
/begin MEASUREMENT autosar_swc_rlgs_rtARID_DEF.IsRiSplitStubExistFlagK1 "" UBYTE autosar_swc_rlgs_CM_logical 0 0 0 1 ECU_ADDRESS 0xfe4afdc1 /* @ECU_Address@autosar_swc_rlgs_rtARID_DEF.IsRiSplitStubExistFlagK1@ */ /end MEASUREMENT
/begin MEASUREMENT autosar_swc_rlgs_rtARID_DEF.L1LineTypeK1 "" UBYTE autosar_swc_rlgs_CM_uint8 0 0 0 255 ECU_ADDRESS 0xfe4afd1a /* @ECU_Address@autosar_swc_rlgs_rtARID_DEF.L1LineTypeK1@ */ /end MEASUREMENT
/begin MEASUREMENT autosar_swc_rlgs_rtARID_DEF.L1MergeLineTypeConfirmTime "" FLOAT32_IEEE autosar_swc_rlgs_CM_single 0 0 -3.4E+38 3.4E+38 ECU_ADDRESS 0xfe4af9a0 /* @ECU_Address@autosar_swc_rlgs_rtARID_DEF.L1MergeLineTypeConfirmTime@ */ /end MEASUREMENT
/begin MEASUREMENT autosar_swc_rlgs_rtARID_DEF.L1ShadeChgTime "" FLOAT32_IEEE autosar_swc_rlgs_CM_single 0 0 -3.4E+38 3.4E+38 ECU_ADDRESS 0xfe4af98c /* @ECU_Address@autosar_swc_rlgs_rtARID_DEF.L1ShadeChgTime@ */ /end MEASUREMENT
/begin MEASUREMENT autosar_swc_rlgs_rtARID_DEF.L2LineTypeK1 "" UBYTE autosar_swc_rlgs_CM_uint8 0 0 0 255 ECU_ADDRESS 0xfe4afd1b /* @ECU_Address@autosar_swc_rlgs_rtARID_DEF.L2LineTypeK1@ */ /end MEASUREMENT
/begin MEASUREMENT autosar_swc_rlgs_rtARID_DEF.L2MergeLineTypeConfirmTime "" FLOAT32_IEEE autosar_swc_rlgs_CM_single 0 0 -3.4E+38 3.4E+38 ECU_ADDRESS 0xfe4af9a4 /* @ECU_Address@autosar_swc_rlgs_rtARID_DEF.L2MergeLineTypeConfirmTime@ */ /end MEASUREMENT
/begin MEASUREMENT autosar_swc_rlgs_rtARID_DEF.L2ShadeChgTime "" FLOAT32_IEEE autosar_swc_rlgs_CM_single 0 0 -3.4E+38 3.4E+38 ECU_ADDRESS 0xfe4af990 /* @ECU_Address@autosar_swc_rlgs_rtARID_DEF.L2ShadeChgTime@ */ /end MEASUREMENT
/begin MEASUREMENT autosar_swc_rlgs_rtARID_DEF.LBLostTime "" FLOAT32_IEEE autosar_swc_rlgs_CM_single 0 0 -3.4E+38 3.4E+38 ECU_ADDRESS 0xfe4af9b0 /* @ECU_Address@autosar_swc_rlgs_rtARID_DEF.LBLostTime@ */ /end MEASUREMENT
/begin MEASUREMENT autosar_swc_rlgs_rtARID_DEF.LB_LoseKeepTime "" FLOAT32_IEEE autosar_swc_rlgs_CM_single 0 0 -3.4E+38 3.4E+38 ECU_ADDRESS 0xfe4af9ac /* @ECU_Address@autosar_swc_rlgs_rtARID_DEF.LB_LoseKeepTime@ */ /end MEASUREMENT
/begin MEASUREMENT autosar_swc_rlgs_rtARID_DEF.LB_bIsLineExist_K1 "" UBYTE autosar_swc_rlgs_CM_uint8 0 0 0 255 ECU_ADDRESS 0xfe4afd1f /* @ECU_Address@autosar_swc_rlgs_rtARID_DEF.LB_bIsLineExist_K1@ */ /end MEASUREMENT
/begin MEASUREMENT autosar_swc_rlgs_rtARID_DEF.LB_dC0V_K1 "" FLOAT32_IEEE autosar_swc_rlgs_CM_single 0 0 -3.4E+38 3.4E+38 ECU_ADDRESS 0xfe4af9a8 /* @ECU_Address@autosar_swc_rlgs_rtARID_DEF.LB_dC0V_K1@ */ /end MEASUREMENT
/begin MEASUREMENT autosar_swc_rlgs_rtARID_DEF.LaneChangeTime "" FLOAT32_IEEE autosar_swc_rlgs_CM_single 0 0 -3.4E+38 3.4E+38 ECU_ADDRESS 0xfe4afa14 /* @ECU_Address@autosar_swc_rlgs_rtARID_DEF.LaneChangeTime@ */ /end MEASUREMENT
/begin MEASUREMENT autosar_swc_rlgs_rtARID_DEF.LaneExtraFarPointPosX_k1 "" FLOAT32_IEEE autosar_swc_rlgs_CM_single 0 0 -3.4E+38 3.4E+38 ECU_ADDRESS 0xfe4afa84 /* @ECU_Address@autosar_swc_rlgs_rtARID_DEF.LaneExtraFarPointPosX_k1@ */ /end MEASUREMENT
/begin MEASUREMENT autosar_swc_rlgs_rtARID_DEF.LaneExtraFarPointPosX_k1_b "" FLOAT32_IEEE autosar_swc_rlgs_CM_single 0 0 -3.4E+38 3.4E+38 ECU_ADDRESS 0xfe4afae4 /* @ECU_Address@autosar_swc_rlgs_rtARID_DEF.LaneExtraFarPointPosX_k1_b@ */ /end MEASUREMENT
/begin MEASUREMENT autosar_swc_rlgs_rtARID_DEF.LaneExtraFarPointPosX_k1_d "" FLOAT32_IEEE autosar_swc_rlgs_CM_single 0 0 -3.4E+38 3.4E+38 ECU_ADDRESS 0xfe4afb14 /* @ECU_Address@autosar_swc_rlgs_rtARID_DEF.LaneExtraFarPointPosX_k1_d@ */ /end MEASUREMENT
/begin MEASUREMENT autosar_swc_rlgs_rtARID_DEF.LaneExtraFarPointPosX_k1_p "" FLOAT32_IEEE autosar_swc_rlgs_CM_single 0 0 -3.4E+38 3.4E+38 ECU_ADDRESS 0xfe4afab4 /* @ECU_Address@autosar_swc_rlgs_rtARID_DEF.LaneExtraFarPointPosX_k1_p@ */ /end MEASUREMENT
/begin MEASUREMENT autosar_swc_rlgs_rtARID_DEF.LaneExtraFarPointPosY_k1 "" FLOAT32_IEEE autosar_swc_rlgs_CM_single 0 0 -3.4E+38 3.4E+38 ECU_ADDRESS 0xfe4afa88 /* @ECU_Address@autosar_swc_rlgs_rtARID_DEF.LaneExtraFarPointPosY_k1@ */ /end MEASUREMENT
/begin MEASUREMENT autosar_swc_rlgs_rtARID_DEF.LaneExtraFarPointPosY_k1_d "" FLOAT32_IEEE autosar_swc_rlgs_CM_single 0 0 -3.4E+38 3.4E+38 ECU_ADDRESS 0xfe4afb18 /* @ECU_Address@autosar_swc_rlgs_rtARID_DEF.LaneExtraFarPointPosY_k1_d@ */ /end MEASUREMENT
/begin MEASUREMENT autosar_swc_rlgs_rtARID_DEF.LaneExtraFarPointPosY_k1_e "" FLOAT32_IEEE autosar_swc_rlgs_CM_single 0 0 -3.4E+38 3.4E+38 ECU_ADDRESS 0xfe4afab8 /* @ECU_Address@autosar_swc_rlgs_rtARID_DEF.LaneExtraFarPointPosY_k1_e@ */ /end MEASUREMENT
/begin MEASUREMENT autosar_swc_rlgs_rtARID_DEF.LaneExtraFarPointPosY_k1_k "" FLOAT32_IEEE autosar_swc_rlgs_CM_single 0 0 -3.4E+38 3.4E+38 ECU_ADDRESS 0xfe4afae8 /* @ECU_Address@autosar_swc_rlgs_rtARID_DEF.LaneExtraFarPointPosY_k1_k@ */ /end MEASUREMENT
/begin MEASUREMENT autosar_swc_rlgs_rtARID_DEF.LaneExtraFarPointType_k1 "" UBYTE autosar_swc_rlgs_CM_uint8 0 0 0 255 ECU_ADDRESS 0xfe4afd47 /* @ECU_Address@autosar_swc_rlgs_rtARID_DEF.LaneExtraFarPointType_k1@ */ /end MEASUREMENT
/begin MEASUREMENT autosar_swc_rlgs_rtARID_DEF.LaneExtraFarPointType_k1_h "" UBYTE autosar_swc_rlgs_CM_uint8 0 0 0 255 ECU_ADDRESS 0xfe4afd56 /* @ECU_Address@autosar_swc_rlgs_rtARID_DEF.LaneExtraFarPointType_k1_h@ */ /end MEASUREMENT
/begin MEASUREMENT autosar_swc_rlgs_rtARID_DEF.LaneExtraFarPointType_k1_i "" UBYTE autosar_swc_rlgs_CM_uint8 0 0 0 255 ECU_ADDRESS 0xfe4afd4c /* @ECU_Address@autosar_swc_rlgs_rtARID_DEF.LaneExtraFarPointType_k1_i@ */ /end MEASUREMENT
/begin MEASUREMENT autosar_swc_rlgs_rtARID_DEF.LaneExtraFarPointType_k1_l "" UBYTE autosar_swc_rlgs_CM_uint8 0 0 0 255 ECU_ADDRESS 0xfe4afd51 /* @ECU_Address@autosar_swc_rlgs_rtARID_DEF.LaneExtraFarPointType_k1_l@ */ /end MEASUREMENT
/begin MEASUREMENT autosar_swc_rlgs_rtARID_DEF.LaneExtraNearPointPosX_k1 "" FLOAT32_IEEE autosar_swc_rlgs_CM_single 0 0 -3.4E+38 3.4E+38 ECU_ADDRESS 0xfe4afa7c /* @ECU_Address@autosar_swc_rlgs_rtARID_DEF.LaneExtraNearPointPosX_k1@ */ /end MEASUREMENT
/begin MEASUREMENT autosar_swc_rlgs_rtARID_DEF.LaneExtraNearPointPosX_k1_e "" FLOAT32_IEEE autosar_swc_rlgs_CM_single 0 0 -3.4E+38 3.4E+38 ECU_ADDRESS 0xfe4afb0c /* @ECU_Address@autosar_swc_rlgs_rtARID_DEF.LaneExtraNearPointPosX_k1_e@ */ /end MEASUREMENT
/begin MEASUREMENT autosar_swc_rlgs_rtARID_DEF.LaneExtraNearPointPosX_k1_j "" FLOAT32_IEEE autosar_swc_rlgs_CM_single 0 0 -3.4E+38 3.4E+38 ECU_ADDRESS 0xfe4afaac /* @ECU_Address@autosar_swc_rlgs_rtARID_DEF.LaneExtraNearPointPosX_k1_j@ */ /end MEASUREMENT
/begin MEASUREMENT autosar_swc_rlgs_rtARID_DEF.LaneExtraNearPointPosX_k1_n "" FLOAT32_IEEE autosar_swc_rlgs_CM_single 0 0 -3.4E+38 3.4E+38 ECU_ADDRESS 0xfe4afadc /* @ECU_Address@autosar_swc_rlgs_rtARID_DEF.LaneExtraNearPointPosX_k1_n@ */ /end MEASUREMENT
/begin MEASUREMENT autosar_swc_rlgs_rtARID_DEF.LaneExtraNearPointPosY_k1 "" FLOAT32_IEEE autosar_swc_rlgs_CM_single 0 0 -3.4E+38 3.4E+38 ECU_ADDRESS 0xfe4afa80 /* @ECU_Address@autosar_swc_rlgs_rtARID_DEF.LaneExtraNearPointPosY_k1@ */ /end MEASUREMENT
/begin MEASUREMENT autosar_swc_rlgs_rtARID_DEF.LaneExtraNearPointPosY_k1_a "" FLOAT32_IEEE autosar_swc_rlgs_CM_single 0 0 -3.4E+38 3.4E+38 ECU_ADDRESS 0xfe4afab0 /* @ECU_Address@autosar_swc_rlgs_rtARID_DEF.LaneExtraNearPointPosY_k1_a@ */ /end MEASUREMENT
/begin MEASUREMENT autosar_swc_rlgs_rtARID_DEF.LaneExtraNearPointPosY_k1_m "" FLOAT32_IEEE autosar_swc_rlgs_CM_single 0 0 -3.4E+38 3.4E+38 ECU_ADDRESS 0xfe4afb10 /* @ECU_Address@autosar_swc_rlgs_rtARID_DEF.LaneExtraNearPointPosY_k1_m@ */ /end MEASUREMENT
/begin MEASUREMENT autosar_swc_rlgs_rtARID_DEF.LaneExtraNearPointPosY_k1_o "" FLOAT32_IEEE autosar_swc_rlgs_CM_single 0 0 -3.4E+38 3.4E+38 ECU_ADDRESS 0xfe4afae0 /* @ECU_Address@autosar_swc_rlgs_rtARID_DEF.LaneExtraNearPointPosY_k1_o@ */ /end MEASUREMENT
/begin MEASUREMENT autosar_swc_rlgs_rtARID_DEF.LaneExtraNearPointType_k1 "" UBYTE autosar_swc_rlgs_CM_uint8 0 0 0 255 ECU_ADDRESS 0xfe4afd46 /* @ECU_Address@autosar_swc_rlgs_rtARID_DEF.LaneExtraNearPointType_k1@ */ /end MEASUREMENT
/begin MEASUREMENT autosar_swc_rlgs_rtARID_DEF.LaneExtraNearPointType_k1_e "" UBYTE autosar_swc_rlgs_CM_uint8 0 0 0 255 ECU_ADDRESS 0xfe4afd50 /* @ECU_Address@autosar_swc_rlgs_rtARID_DEF.LaneExtraNearPointType_k1_e@ */ /end MEASUREMENT
/begin MEASUREMENT autosar_swc_rlgs_rtARID_DEF.LaneExtraNearPointType_k1_j "" UBYTE autosar_swc_rlgs_CM_uint8 0 0 0 255 ECU_ADDRESS 0xfe4afd4b /* @ECU_Address@autosar_swc_rlgs_rtARID_DEF.LaneExtraNearPointType_k1_j@ */ /end MEASUREMENT
/begin MEASUREMENT autosar_swc_rlgs_rtARID_DEF.LaneExtraNearPointType_k1_p "" UBYTE autosar_swc_rlgs_CM_uint8 0 0 0 255 ECU_ADDRESS 0xfe4afd55 /* @ECU_Address@autosar_swc_rlgs_rtARID_DEF.LaneExtraNearPointType_k1_p@ */ /end MEASUREMENT
/begin MEASUREMENT autosar_swc_rlgs_rtARID_DEF.LcInhibitTime "" FLOAT32_IEEE autosar_swc_rlgs_CM_single 0 0 -3.4E+38 3.4E+38 ECU_ADDRESS 0xfe4af974 /* @ECU_Address@autosar_swc_rlgs_rtARID_DEF.LcInhibitTime@ */ /end MEASUREMENT
/begin MEASUREMENT autosar_swc_rlgs_rtARID_DEF.LcIntentionSubState "" UBYTE autosar_swc_rlgs_CM_uint8 0 0 0 255 ECU_ADDRESS 0xfe4afcdc /* @ECU_Address@autosar_swc_rlgs_rtARID_DEF.LcIntentionSubState@ */ /end MEASUREMENT
/begin MEASUREMENT autosar_swc_rlgs_rtARID_DEF.LcReason "" UBYTE autosar_swc_rlgs_CM_uint8 0 0 0 255 ECU_ADDRESS 0xfe4afcd7 /* @ECU_Address@autosar_swc_rlgs_rtARID_DEF.LcReason@ */ /end MEASUREMENT
/begin MEASUREMENT autosar_swc_rlgs_rtARID_DEF.Lci "" UBYTE autosar_swc_rlgs_CM_logical 0 0 0 1 ECU_ADDRESS 0xfe4afd95 /* @ECU_Address@autosar_swc_rlgs_rtARID_DEF.Lci@ */ /end MEASUREMENT
/begin MEASUREMENT autosar_swc_rlgs_rtARID_DEF.Lci_c "" UBYTE autosar_swc_rlgs_CM_logical 0 0 0 1 ECU_ADDRESS 0xfe4afd9c /* @ECU_Address@autosar_swc_rlgs_rtARID_DEF.Lci_c@ */ /end MEASUREMENT
/begin MEASUREMENT autosar_swc_rlgs_rtARID_DEF.LeftLaneChgTrgCnt "" UBYTE autosar_swc_rlgs_CM_uint8 0 0 0 255 ECU_ADDRESS 0xfe4afd1e /* @ECU_Address@autosar_swc_rlgs_rtARID_DEF.LeftLaneChgTrgCnt@ */ /end MEASUREMENT
/begin MEASUREMENT autosar_swc_rlgs_rtARID_DEF.LeftLaneChgTrg_k1 "" UBYTE autosar_swc_rlgs_CM_logical 0 0 0 1 ECU_ADDRESS 0xfe4afdbe /* @ECU_Address@autosar_swc_rlgs_rtARID_DEF.LeftLaneChgTrg_k1@ */ /end MEASUREMENT
/begin MEASUREMENT autosar_swc_rlgs_rtARID_DEF.LeftMergeInhiTime "" FLOAT32_IEEE autosar_swc_rlgs_CM_single 0 0 -3.4E+38 3.4E+38 ECU_ADDRESS 0xfe4af994 /* @ECU_Address@autosar_swc_rlgs_rtARID_DEF.LeftMergeInhiTime@ */ /end MEASUREMENT
/begin MEASUREMENT autosar_swc_rlgs_rtARID_DEF.LeftMergeKeepTimeByFormWay "" FLOAT32_IEEE autosar_swc_rlgs_CM_single 0 0 -3.4E+38 3.4E+38 ECU_ADDRESS 0xfe4af9b4 /* @ECU_Address@autosar_swc_rlgs_rtARID_DEF.LeftMergeKeepTimeByFormWay@ */ /end MEASUREMENT
/begin MEASUREMENT autosar_swc_rlgs_rtARID_DEF.LeftMergeMemoryTime "" FLOAT32_IEEE autosar_swc_rlgs_CM_single 0 0 -3.4E+38 3.4E+38 ECU_ADDRESS 0xfe4af988 /* @ECU_Address@autosar_swc_rlgs_rtARID_DEF.LeftMergeMemoryTime@ */ /end MEASUREMENT
/begin MEASUREMENT autosar_swc_rlgs_rtARID_DEF.LeftMergeMemoryTime_p "" FLOAT32_IEEE autosar_swc_rlgs_CM_single 0 0 -3.4E+38 3.4E+38 ECU_ADDRESS 0xfe4af998 /* @ECU_Address@autosar_swc_rlgs_rtARID_DEF.LeftMergeMemoryTime_p@ */ /end MEASUREMENT
/begin MEASUREMENT autosar_swc_rlgs_rtARID_DEF.LeftMergeTimeClearConfirmTime "" FLOAT32_IEEE autosar_swc_rlgs_CM_single 0 0 -3.4E+38 3.4E+38 ECU_ADDRESS 0xfe4af99c /* @ECU_Address@autosar_swc_rlgs_rtARID_DEF.LeftMergeTimeClearConfirmTime@ */ /end MEASUREMENT
/begin MEASUREMENT autosar_swc_rlgs_rtARID_DEF.LineConfK1 "" UBYTE autosar_swc_rlgs_CM_uint8 0 0 0 255 ECU_ADDRESS 0xfe4afd40 /* @ECU_Address@autosar_swc_rlgs_rtARID_DEF.LineConfK1@ */ /end MEASUREMENT
/begin MEASUREMENT autosar_swc_rlgs_rtARID_DEF.LineConfK1_f "" UBYTE autosar_swc_rlgs_CM_uint8 0 0 0 255 ECU_ADDRESS 0xfe4afd49 /* @ECU_Address@autosar_swc_rlgs_rtARID_DEF.LineConfK1_f@ */ /end MEASUREMENT
/begin MEASUREMENT autosar_swc_rlgs_rtARID_DEF.LineConfK1_i "" UBYTE autosar_swc_rlgs_CM_uint8 0 0 0 255 ECU_ADDRESS 0xfe4afd42 /* @ECU_Address@autosar_swc_rlgs_rtARID_DEF.LineConfK1_i@ */ /end MEASUREMENT
/begin MEASUREMENT autosar_swc_rlgs_rtARID_DEF.LineConfK1_k "" UBYTE autosar_swc_rlgs_CM_uint8 0 0 0 255 ECU_ADDRESS 0xfe4afd53 /* @ECU_Address@autosar_swc_rlgs_rtARID_DEF.LineConfK1_k@ */ /end MEASUREMENT
/begin MEASUREMENT autosar_swc_rlgs_rtARID_DEF.LineConfK1_l "" UBYTE autosar_swc_rlgs_CM_uint8 0 0 0 255 ECU_ADDRESS 0xfe4afd44 /* @ECU_Address@autosar_swc_rlgs_rtARID_DEF.LineConfK1_l@ */ /end MEASUREMENT
/begin MEASUREMENT autosar_swc_rlgs_rtARID_DEF.LineConfK1_n "" UBYTE autosar_swc_rlgs_CM_uint8 0 0 0 255 ECU_ADDRESS 0xfe4afd4e /* @ECU_Address@autosar_swc_rlgs_rtARID_DEF.LineConfK1_n@ */ /end MEASUREMENT
/begin MEASUREMENT autosar_swc_rlgs_rtARID_DEF.LineReliableK1 "" FLOAT32_IEEE autosar_swc_rlgs_CM_single 0 0 -3.4E+38 3.4E+38 ECU_ADDRESS 0xfe4afa1c /* @ECU_Address@autosar_swc_rlgs_rtARID_DEF.LineReliableK1@ */ /end MEASUREMENT
/begin MEASUREMENT autosar_swc_rlgs_rtARID_DEF.LineReliableK1_a "" FLOAT32_IEEE autosar_swc_rlgs_CM_single 0 0 -3.4E+38 3.4E+38 ECU_ADDRESS 0xfe4afa3c /* @ECU_Address@autosar_swc_rlgs_rtARID_DEF.LineReliableK1_a@ */ /end MEASUREMENT
/begin MEASUREMENT autosar_swc_rlgs_rtARID_DEF.LineReliableK1_e "" FLOAT32_IEEE autosar_swc_rlgs_CM_single 0 0 -3.4E+38 3.4E+38 ECU_ADDRESS 0xfe4afaec /* @ECU_Address@autosar_swc_rlgs_rtARID_DEF.LineReliableK1_e@ */ /end MEASUREMENT
/begin MEASUREMENT autosar_swc_rlgs_rtARID_DEF.LineReliableK1_k "" FLOAT32_IEEE autosar_swc_rlgs_CM_single 0 0 -3.4E+38 3.4E+38 ECU_ADDRESS 0xfe4afa5c /* @ECU_Address@autosar_swc_rlgs_rtARID_DEF.LineReliableK1_k@ */ /end MEASUREMENT
/begin MEASUREMENT autosar_swc_rlgs_rtARID_DEF.LineReliableK1_o "" FLOAT32_IEEE autosar_swc_rlgs_CM_single 0 0 -3.4E+38 3.4E+38 ECU_ADDRESS 0xfe4afabc /* @ECU_Address@autosar_swc_rlgs_rtARID_DEF.LineReliableK1_o@ */ /end MEASUREMENT
/begin MEASUREMENT autosar_swc_rlgs_rtARID_DEF.LineReliableK1_p "" FLOAT32_IEEE autosar_swc_rlgs_CM_single 0 0 -3.4E+38 3.4E+38 ECU_ADDRESS 0xfe4afa8c /* @ECU_Address@autosar_swc_rlgs_rtARID_DEF.LineReliableK1_p@ */ /end MEASUREMENT
/begin MEASUREMENT autosar_swc_rlgs_rtARID_DEF.LogicalOperator10 "" UBYTE autosar_swc_rlgs_CM_logical 0 0 0 1 ECU_ADDRESS 0xfe4afd89 /* @ECU_Address@autosar_swc_rlgs_rtARID_DEF.LogicalOperator10@ */ /end MEASUREMENT
/begin MEASUREMENT autosar_swc_rlgs_rtARID_DEF.LogicalOperator10_b "" UBYTE autosar_swc_rlgs_CM_logical 0 0 0 1 ECU_ADDRESS 0xfe4afd8d /* @ECU_Address@autosar_swc_rlgs_rtARID_DEF.LogicalOperator10_b@ */ /end MEASUREMENT
/begin MEASUREMENT autosar_swc_rlgs_rtARID_DEF.LogicalOperator15 "" UBYTE autosar_swc_rlgs_CM_logical 0 0 0 1 MATRIX_DIM 1 1 ECU_ADDRESS 0xfe4afd90 /* @ECU_Address@autosar_swc_rlgs_rtARID_DEF.LogicalOperator15@ */ /end MEASUREMENT
/begin MEASUREMENT autosar_swc_rlgs_rtARID_DEF.LogicalOperator19 "" UBYTE autosar_swc_rlgs_CM_logical 0 0 0 1 ECU_ADDRESS 0xfe4afd8f /* @ECU_Address@autosar_swc_rlgs_rtARID_DEF.LogicalOperator19@ */ /end MEASUREMENT
/begin MEASUREMENT autosar_swc_rlgs_rtARID_DEF.LogicalOperator2 "" UBYTE autosar_swc_rlgs_CM_logical 0 0 0 1 ECU_ADDRESS 0xfe4afd8c /* @ECU_Address@autosar_swc_rlgs_rtARID_DEF.LogicalOperator2@ */ /end MEASUREMENT
/begin MEASUREMENT autosar_swc_rlgs_rtARID_DEF.LogicalOperator6 "" UBYTE autosar_swc_rlgs_CM_logical 0 0 0 1 MATRIX_DIM 1 1 ECU_ADDRESS 0xfe4afd8e /* @ECU_Address@autosar_swc_rlgs_rtARID_DEF.LogicalOperator6@ */ /end MEASUREMENT
/begin MEASUREMENT autosar_swc_rlgs_rtARID_DEF.LogicalOperator7_e "" UBYTE autosar_swc_rlgs_CM_logical 0 0 0 1 MATRIX_DIM 1 1 ECU_ADDRESS 0xfe4afd91 /* @ECU_Address@autosar_swc_rlgs_rtARID_DEF.LogicalOperator7_e@ */ /end MEASUREMENT
/begin MEASUREMENT autosar_swc_rlgs_rtARID_DEF.LogicalOperator7_h "" UBYTE autosar_swc_rlgs_CM_logical 0 0 0 1 ECU_ADDRESS 0xfe4afd8a /* @ECU_Address@autosar_swc_rlgs_rtARID_DEF.LogicalOperator7_h@ */ /end MEASUREMENT
/begin MEASUREMENT autosar_swc_rlgs_rtARID_DEF.NOAExitRemindByToll "" UBYTE autosar_swc_rlgs_CM_uint8 0 0 0 255 ECU_ADDRESS 0xfe4afd38 /* @ECU_Address@autosar_swc_rlgs_rtARID_DEF.NOAExitRemindByToll@ */ /end MEASUREMENT
/begin MEASUREMENT autosar_swc_rlgs_rtARID_DEF.NOAExitRemindByTollCntTime "" FLOAT32_IEEE autosar_swc_rlgs_CM_single 0 0 -3.4E+38 3.4E+38 ECU_ADDRESS 0xfe4af9e4 /* @ECU_Address@autosar_swc_rlgs_rtARID_DEF.NOAExitRemindByTollCntTime@ */ /end MEASUREMENT
/begin MEASUREMENT autosar_swc_rlgs_rtARID_DEF.NOA_Methods "" UBYTE autosar_swc_rlgs_CM_uint8 0 0 0 255 ECU_ADDRESS 0xfe4afce2 /* @ECU_Address@autosar_swc_rlgs_rtARID_DEF.NOA_Methods@ */ /end MEASUREMENT
/begin MEASUREMENT autosar_swc_rlgs_rtARID_DEF.NaroFlag_k1 "" UBYTE autosar_swc_rlgs_CM_logical 0 0 0 1 ECU_ADDRESS 0xfe4afdc0 /* @ECU_Address@autosar_swc_rlgs_rtARID_DEF.NaroFlag_k1@ */ /end MEASUREMENT
/begin MEASUREMENT autosar_swc_rlgs_rtARID_DEF.NextStubIsRiSplitInhibitLeftMergeDistance "" FLOAT32_IEEE autosar_swc_rlgs_CM_single 0 0 -3.4E+38 3.4E+38 ECU_ADDRESS 0xfe4af97c /* @ECU_Address@autosar_swc_rlgs_rtARID_DEF.NextStubIsRiSplitInhibitLeftMergeDistance@ */ /end MEASUREMENT
/begin MEASUREMENT autosar_swc_rlgs_rtARID_DEF.NextStubIsRiSplitInhibitLeftMergeFlag "" UBYTE autosar_swc_rlgs_CM_logical 0 0 0 1 ECU_ADDRESS 0xfe4afda1 /* @ECU_Address@autosar_swc_rlgs_rtARID_DEF.NextStubIsRiSplitInhibitLeftMergeFlag@ */ /end MEASUREMENT
/begin MEASUREMENT autosar_swc_rlgs_rtARID_DEF.OverTime "" UBYTE autosar_swc_rlgs_CM_logical 0 0 0 1 ECU_ADDRESS 0xfe4afd93 /* @ECU_Address@autosar_swc_rlgs_rtARID_DEF.OverTime@ */ /end MEASUREMENT
/begin MEASUREMENT autosar_swc_rlgs_rtARID_DEF.OverTime_m "" UBYTE autosar_swc_rlgs_CM_logical 0 0 0 1 ECU_ADDRESS 0xfe4afd9a /* @ECU_Address@autosar_swc_rlgs_rtARID_DEF.OverTime_m@ */ /end MEASUREMENT
/begin MEASUREMENT autosar_swc_rlgs_rtARID_DEF.ParallelTime "" FLOAT32_IEEE autosar_swc_rlgs_CM_single 0 0 -3.4E+38 3.4E+38 ECU_ADDRESS 0xfe4af9c0 /* @ECU_Address@autosar_swc_rlgs_rtARID_DEF.ParallelTime@ */ /end MEASUREMENT
/begin MEASUREMENT autosar_swc_rlgs_rtARID_DEF.R1LineTypeK1 "" UBYTE autosar_swc_rlgs_CM_uint8 0 0 0 255 ECU_ADDRESS 0xfe4afd36 /* @ECU_Address@autosar_swc_rlgs_rtARID_DEF.R1LineTypeK1@ */ /end MEASUREMENT
/begin MEASUREMENT autosar_swc_rlgs_rtARID_DEF.R1ShadeTime "" FLOAT32_IEEE autosar_swc_rlgs_CM_single 0 0 -3.4E+38 3.4E+38 ECU_ADDRESS 0xfe4af9e0 /* @ECU_Address@autosar_swc_rlgs_rtARID_DEF.R1ShadeTime@ */ /end MEASUREMENT
/begin MEASUREMENT autosar_swc_rlgs_rtARID_DEF.R1SolidLineConfirmTime "" FLOAT32_IEEE autosar_swc_rlgs_CM_single 0 0 -3.4E+38 3.4E+38 ECU_ADDRESS 0xfe4af9cc /* @ECU_Address@autosar_swc_rlgs_rtARID_DEF.R1SolidLineConfirmTime@ */ /end MEASUREMENT
/begin MEASUREMENT autosar_swc_rlgs_rtARID_DEF.R1_TrackID_k1 "" UWORD autosar_swc_rlgs_CM_uint16 0 0 0 65535 ECU_ADDRESS 0xfe4afca2 /* @ECU_Address@autosar_swc_rlgs_rtARID_DEF.R1_TrackID_k1@ */ /end MEASUREMENT
/begin MEASUREMENT autosar_swc_rlgs_rtARID_DEF.RampSts "" UBYTE autosar_swc_rlgs_CM_uint8 0 0 0 255 ECU_ADDRESS 0xfe4afcde /* @ECU_Address@autosar_swc_rlgs_rtARID_DEF.RampSts@ */ /end MEASUREMENT
/begin MEASUREMENT autosar_swc_rlgs_rtARID_DEF.RampStsK1 "" UBYTE autosar_swc_rlgs_CM_logical 0 0 0 1 ECU_ADDRESS 0xfe4afdc2 /* @ECU_Address@autosar_swc_rlgs_rtARID_DEF.RampStsK1@ */ /end MEASUREMENT
/begin MEASUREMENT autosar_swc_rlgs_rtARID_DEF.RampStsK1_i "" UBYTE autosar_swc_rlgs_CM_logical 0 0 0 1 ECU_ADDRESS 0xfe4afdc3 /* @ECU_Address@autosar_swc_rlgs_rtARID_DEF.RampStsK1_i@ */ /end MEASUREMENT
/begin MEASUREMENT autosar_swc_rlgs_rtARID_DEF.RampSts_temp "" UBYTE autosar_swc_rlgs_CM_logical 0 0 0 1 ECU_ADDRESS 0xfe4afdb9 /* @ECU_Address@autosar_swc_rlgs_rtARID_DEF.RampSts_temp@ */ /end MEASUREMENT
/begin MEASUREMENT autosar_swc_rlgs_rtARID_DEF.RangeK1 "" FLOAT32_IEEE autosar_swc_rlgs_CM_single 0 0 -3.4E+38 3.4E+38 ECU_ADDRESS 0xfe4afa34 /* @ECU_Address@autosar_swc_rlgs_rtARID_DEF.RangeK1@ */ /end MEASUREMENT
/begin MEASUREMENT autosar_swc_rlgs_rtARID_DEF.RangeK1_f "" FLOAT32_IEEE autosar_swc_rlgs_CM_single 0 0 -3.4E+38 3.4E+38 ECU_ADDRESS 0xfe4afad4 /* @ECU_Address@autosar_swc_rlgs_rtARID_DEF.RangeK1_f@ */ /end MEASUREMENT
/begin MEASUREMENT autosar_swc_rlgs_rtARID_DEF.RangeK1_fc "" FLOAT32_IEEE autosar_swc_rlgs_CM_single 0 0 -3.4E+38 3.4E+38 ECU_ADDRESS 0xfe4afb04 /* @ECU_Address@autosar_swc_rlgs_rtARID_DEF.RangeK1_fc@ */ /end MEASUREMENT
/begin MEASUREMENT autosar_swc_rlgs_rtARID_DEF.RangeK1_h "" FLOAT32_IEEE autosar_swc_rlgs_CM_single 0 0 -3.4E+38 3.4E+38 ECU_ADDRESS 0xfe4afa54 /* @ECU_Address@autosar_swc_rlgs_rtARID_DEF.RangeK1_h@ */ /end MEASUREMENT
/begin MEASUREMENT autosar_swc_rlgs_rtARID_DEF.RangeK1_hx "" FLOAT32_IEEE autosar_swc_rlgs_CM_single 0 0 -3.4E+38 3.4E+38 ECU_ADDRESS 0xfe4afa74 /* @ECU_Address@autosar_swc_rlgs_rtARID_DEF.RangeK1_hx@ */ /end MEASUREMENT
/begin MEASUREMENT autosar_swc_rlgs_rtARID_DEF.RangeK1_i "" FLOAT32_IEEE autosar_swc_rlgs_CM_single 0 0 -3.4E+38 3.4E+38 ECU_ADDRESS 0xfe4afaa4 /* @ECU_Address@autosar_swc_rlgs_rtARID_DEF.RangeK1_i@ */ /end MEASUREMENT
/begin MEASUREMENT autosar_swc_rlgs_rtARID_DEF.RiLineTypeChgConfirmTime "" FLOAT32_IEEE autosar_swc_rlgs_CM_single 0 0 -3.4E+38 3.4E+38 ECU_ADDRESS 0xfe4af9c8 /* @ECU_Address@autosar_swc_rlgs_rtARID_DEF.RiLineTypeChgConfirmTime@ */ /end MEASUREMENT
/begin MEASUREMENT autosar_swc_rlgs_rtARID_DEF.RiRoadClass "" UBYTE autosar_swc_rlgs_CM_uint8 0 0 0 255 ECU_ADDRESS 0xfe4afd37 /* @ECU_Address@autosar_swc_rlgs_rtARID_DEF.RiRoadClass@ */ /end MEASUREMENT
/begin MEASUREMENT autosar_swc_rlgs_rtARID_DEF.RoadClassTemp "" UBYTE autosar_swc_rlgs_CM_uint8 0 0 0 255 ECU_ADDRESS 0xfe4afd3f /* @ECU_Address@autosar_swc_rlgs_rtARID_DEF.RoadClassTemp@ */ /end MEASUREMENT
/begin MEASUREMENT autosar_swc_rlgs_rtARID_DEF.Rout_bIsLineExist_k1 "" UBYTE autosar_swc_rlgs_CM_uint8 0 0 0 255 ECU_ADDRESS 0xfe4afd3e /* @ECU_Address@autosar_swc_rlgs_rtARID_DEF.Rout_bIsLineExist_k1@ */ /end MEASUREMENT
/begin MEASUREMENT autosar_swc_rlgs_rtARID_DEF.Rsts_K1 "" UBYTE autosar_swc_rlgs_CM_uint8 0 0 0 255 ECU_ADDRESS 0xfe4afd39 /* @ECU_Address@autosar_swc_rlgs_rtARID_DEF.Rsts_K1@ */ /end MEASUREMENT
/begin MEASUREMENT autosar_swc_rlgs_rtARID_DEF.ScenarioClass "" UBYTE autosar_swc_rlgs_CM_uint8 0 0 0 255 MATRIX_DIM 1 1 ECU_ADDRESS 0xfe4afcdd /* @ECU_Address@autosar_swc_rlgs_rtARID_DEF.ScenarioClass@ */ /end MEASUREMENT
/begin MEASUREMENT autosar_swc_rlgs_rtARID_DEF.ScenarioSubType "" UBYTE autosar_swc_rlgs_CM_uint8 0 0 0 255 MATRIX_DIM 1 1 ECU_ADDRESS 0xfe4afce0 /* @ECU_Address@autosar_swc_rlgs_rtARID_DEF.ScenarioSubType@ */ /end MEASUREMENT
/begin MEASUREMENT autosar_swc_rlgs_rtARID_DEF.ScenarioSubType_K1 "" UBYTE autosar_swc_rlgs_CM_uint8 0 0 0 255 ECU_ADDRESS 0xfe4afd1d /* @ECU_Address@autosar_swc_rlgs_rtARID_DEF.ScenarioSubType_K1@ */ /end MEASUREMENT
/begin MEASUREMENT autosar_swc_rlgs_rtARID_DEF.ScenarioType "" UBYTE autosar_swc_rlgs_CM_uint8 0 0 0 255 MATRIX_DIM 1 1 ECU_ADDRESS 0xfe4afcdf /* @ECU_Address@autosar_swc_rlgs_rtARID_DEF.ScenarioType@ */ /end MEASUREMENT
/begin MEASUREMENT autosar_swc_rlgs_rtARID_DEF.ScenarioType_K1 "" UBYTE autosar_swc_rlgs_CM_uint8 0 0 0 255 ECU_ADDRESS 0xfe4afd1c /* @ECU_Address@autosar_swc_rlgs_rtARID_DEF.ScenarioType_K1@ */ /end MEASUREMENT
/begin MEASUREMENT autosar_swc_rlgs_rtARID_DEF.SignalCopy2 "" UBYTE autosar_swc_rlgs_CM_logical 0 0 0 1 ECU_ADDRESS 0xfe4afd8b /* @ECU_Address@autosar_swc_rlgs_rtARID_DEF.SignalCopy2@ */ /end MEASUREMENT
/begin MEASUREMENT autosar_swc_rlgs_rtARID_DEF.SplitDircCorrectFlag "" UBYTE autosar_swc_rlgs_CM_logical 0 0 0 1 ECU_ADDRESS 0xfe4afda2 /* @ECU_Address@autosar_swc_rlgs_rtARID_DEF.SplitDircCorrectFlag@ */ /end MEASUREMENT
/begin MEASUREMENT autosar_swc_rlgs_rtARID_DEF.StartK1 "" FLOAT32_IEEE autosar_swc_rlgs_CM_single 0 0 -3.4E+38 3.4E+38 ECU_ADDRESS 0xfe4afa30 /* @ECU_Address@autosar_swc_rlgs_rtARID_DEF.StartK1@ */ /end MEASUREMENT
/begin MEASUREMENT autosar_swc_rlgs_rtARID_DEF.StartK1_g "" FLOAT32_IEEE autosar_swc_rlgs_CM_single 0 0 -3.4E+38 3.4E+38 ECU_ADDRESS 0xfe4afa70 /* @ECU_Address@autosar_swc_rlgs_rtARID_DEF.StartK1_g@ */ /end MEASUREMENT
/begin MEASUREMENT autosar_swc_rlgs_rtARID_DEF.StartK1_h "" FLOAT32_IEEE autosar_swc_rlgs_CM_single 0 0 -3.4E+38 3.4E+38 ECU_ADDRESS 0xfe4afad0 /* @ECU_Address@autosar_swc_rlgs_rtARID_DEF.StartK1_h@ */ /end MEASUREMENT
/begin MEASUREMENT autosar_swc_rlgs_rtARID_DEF.StartK1_i "" FLOAT32_IEEE autosar_swc_rlgs_CM_single 0 0 -3.4E+38 3.4E+38 ECU_ADDRESS 0xfe4afa50 /* @ECU_Address@autosar_swc_rlgs_rtARID_DEF.StartK1_i@ */ /end MEASUREMENT
/begin MEASUREMENT autosar_swc_rlgs_rtARID_DEF.StartK1_k "" FLOAT32_IEEE autosar_swc_rlgs_CM_single 0 0 -3.4E+38 3.4E+38 ECU_ADDRESS 0xfe4afb00 /* @ECU_Address@autosar_swc_rlgs_rtARID_DEF.StartK1_k@ */ /end MEASUREMENT
/begin MEASUREMENT autosar_swc_rlgs_rtARID_DEF.StartK1_m "" FLOAT32_IEEE autosar_swc_rlgs_CM_single 0 0 -3.4E+38 3.4E+38 ECU_ADDRESS 0xfe4afaa0 /* @ECU_Address@autosar_swc_rlgs_rtARID_DEF.StartK1_m@ */ /end MEASUREMENT
/begin MEASUREMENT autosar_swc_rlgs_rtARID_DEF.Stopline_Relevancy_k1 "" UBYTE autosar_swc_rlgs_CM_uint8 0 0 0 255 ECU_ADDRESS 0xfe4afd48 /* @ECU_Address@autosar_swc_rlgs_rtARID_DEF.Stopline_Relevancy_k1@ */ /end MEASUREMENT
/begin MEASUREMENT autosar_swc_rlgs_rtARID_DEF.Stopline_Relevancy_k1_f "" UBYTE autosar_swc_rlgs_CM_uint8 0 0 0 255 ECU_ADDRESS 0xfe4afd57 /* @ECU_Address@autosar_swc_rlgs_rtARID_DEF.Stopline_Relevancy_k1_f@ */ /end MEASUREMENT
/begin MEASUREMENT autosar_swc_rlgs_rtARID_DEF.Stopline_Relevancy_k1_h "" UBYTE autosar_swc_rlgs_CM_uint8 0 0 0 255 ECU_ADDRESS 0xfe4afd4d /* @ECU_Address@autosar_swc_rlgs_rtARID_DEF.Stopline_Relevancy_k1_h@ */ /end MEASUREMENT
/begin MEASUREMENT autosar_swc_rlgs_rtARID_DEF.Stopline_Relevancy_k1_j "" UBYTE autosar_swc_rlgs_CM_uint8 0 0 0 255 ECU_ADDRESS 0xfe4afd52 /* @ECU_Address@autosar_swc_rlgs_rtARID_DEF.Stopline_Relevancy_k1_j@ */ /end MEASUREMENT
/begin MEASUREMENT autosar_swc_rlgs_rtARID_DEF.SuggDrvDirection "" UBYTE autosar_swc_rlgs_CM_uint8 0 0 0 255 MATRIX_DIM 1 1 ECU_ADDRESS 0xfe4afce1 /* @ECU_Address@autosar_swc_rlgs_rtARID_DEF.SuggDrvDirection@ */ /end MEASUREMENT
/begin MEASUREMENT autosar_swc_rlgs_rtARID_DEF.TarPathIndex "" UBYTE autosar_swc_rlgs_CM_uint8 0 0 0 255 MATRIX_DIM 1 1 ECU_ADDRESS 0xfe4afcd8 /* @ECU_Address@autosar_swc_rlgs_rtARID_DEF.TarPathIndex@ */ /end MEASUREMENT
/begin MEASUREMENT autosar_swc_rlgs_rtARID_DEF.TrackIdk1 "" UWORD autosar_swc_rlgs_CM_uint16 0 0 0 65535 ECU_ADDRESS 0xfe4afca4 /* @ECU_Address@autosar_swc_rlgs_rtARID_DEF.TrackIdk1@ */ /end MEASUREMENT
/begin MEASUREMENT autosar_swc_rlgs_rtARID_DEF.TrackIdk1_b "" UWORD autosar_swc_rlgs_CM_uint16 0 0 0 65535 ECU_ADDRESS 0xfe4afca6 /* @ECU_Address@autosar_swc_rlgs_rtARID_DEF.TrackIdk1_b@ */ /end MEASUREMENT
/begin MEASUREMENT autosar_swc_rlgs_rtARID_DEF.TrackIdk1_i "" UWORD autosar_swc_rlgs_CM_uint16 0 0 0 65535 ECU_ADDRESS 0xfe4afcac /* @ECU_Address@autosar_swc_rlgs_rtARID_DEF.TrackIdk1_i@ */ /end MEASUREMENT
/begin MEASUREMENT autosar_swc_rlgs_rtARID_DEF.TrackIdk1_k "" UWORD autosar_swc_rlgs_CM_uint16 0 0 0 65535 ECU_ADDRESS 0xfe4afca8 /* @ECU_Address@autosar_swc_rlgs_rtARID_DEF.TrackIdk1_k@ */ /end MEASUREMENT
/begin MEASUREMENT autosar_swc_rlgs_rtARID_DEF.TrackIdk1_l "" UWORD autosar_swc_rlgs_CM_uint16 0 0 0 65535 ECU_ADDRESS 0xfe4afcaa /* @ECU_Address@autosar_swc_rlgs_rtARID_DEF.TrackIdk1_l@ */ /end MEASUREMENT
/begin MEASUREMENT autosar_swc_rlgs_rtARID_DEF.TrackR1Time "" FLOAT32_IEEE autosar_swc_rlgs_CM_single 0 0 -3.4E+38 3.4E+38 ECU_ADDRESS 0xfe4afa0c /* @ECU_Address@autosar_swc_rlgs_rtARID_DEF.TrackR1Time@ */ /end MEASUREMENT
/begin MEASUREMENT autosar_swc_rlgs_rtARID_DEF.UnitDelay1_DSTATE_ad "" SLONG autosar_swc_rlgs_CM_int32 0 0 -2147483648 2147483647 ECU_ADDRESS 0xfe4afc70 /* @ECU_Address@autosar_swc_rlgs_rtARID_DEF.UnitDelay1_DSTATE_ad@ */ /end MEASUREMENT
/begin MEASUREMENT autosar_swc_rlgs_rtARID_DEF.UnitDelay1_DSTATE_b "" FLOAT32_IEEE autosar_swc_rlgs_CM_single 0 0 -3.4E+38 3.4E+38 ECU_ADDRESS 0xfe4af8a4 /* @ECU_Address@autosar_swc_rlgs_rtARID_DEF.UnitDelay1_DSTATE_b@ */ /end MEASUREMENT
/begin MEASUREMENT autosar_swc_rlgs_rtARID_DEF.UnitDelay1_DSTATE_bq "" SLONG autosar_swc_rlgs_CM_int32 0 0 -2147483648 2147483647 ECU_ADDRESS 0xfe4afc64 /* @ECU_Address@autosar_swc_rlgs_rtARID_DEF.UnitDelay1_DSTATE_bq@ */ /end MEASUREMENT
/begin MEASUREMENT autosar_swc_rlgs_rtARID_DEF.UnitDelay1_DSTATE_c "" UBYTE autosar_swc_rlgs_CM_uint8 0 0 0 255 ECU_ADDRESS 0xfe4afcfb /* @ECU_Address@autosar_swc_rlgs_rtARID_DEF.UnitDelay1_DSTATE_c@ */ /end MEASUREMENT
/begin MEASUREMENT autosar_swc_rlgs_rtARID_DEF.UnitDelay1_DSTATE_d "" SLONG autosar_swc_rlgs_CM_int32 0 0 -2147483648 2147483647 ECU_ADDRESS 0xfe4afc58 /* @ECU_Address@autosar_swc_rlgs_rtARID_DEF.UnitDelay1_DSTATE_d@ */ /end MEASUREMENT
/begin MEASUREMENT autosar_swc_rlgs_rtARID_DEF.UnitDelay1_DSTATE_f "" UBYTE autosar_swc_rlgs_CM_logical 0 0 0 1 ECU_ADDRESS 0xfe4afdb0 /* @ECU_Address@autosar_swc_rlgs_rtARID_DEF.UnitDelay1_DSTATE_f@ */ /end MEASUREMENT
/begin MEASUREMENT autosar_swc_rlgs_rtARID_DEF.UnitDelay1_DSTATE_k "" FLOAT32_IEEE autosar_swc_rlgs_CM_single 0 0 -3.4E+38 3.4E+38 ECU_ADDRESS 0xfe4af908 /* @ECU_Address@autosar_swc_rlgs_rtARID_DEF.UnitDelay1_DSTATE_k@ */ /end MEASUREMENT
/begin MEASUREMENT autosar_swc_rlgs_rtARID_DEF.UnitDelay1_DSTATE_m "" UBYTE autosar_swc_rlgs_CM_uint8 0 0 0 255 ECU_ADDRESS 0xfe4afcf7 /* @ECU_Address@autosar_swc_rlgs_rtARID_DEF.UnitDelay1_DSTATE_m@ */ /end MEASUREMENT
/begin MEASUREMENT autosar_swc_rlgs_rtARID_DEF.UnitDelay2_DSTATE_dd "" UBYTE autosar_swc_rlgs_CM_logical 0 0 0 1 ECU_ADDRESS 0xfe4afdb3 /* @ECU_Address@autosar_swc_rlgs_rtARID_DEF.UnitDelay2_DSTATE_dd@ */ /end MEASUREMENT
/begin MEASUREMENT autosar_swc_rlgs_rtARID_DEF.UnitDelay2_DSTATE_e "" UBYTE autosar_swc_rlgs_CM_logical 0 0 0 1 ECU_ADDRESS 0xfe4afdb5 /* @ECU_Address@autosar_swc_rlgs_rtARID_DEF.UnitDelay2_DSTATE_e@ */ /end MEASUREMENT
/begin MEASUREMENT autosar_swc_rlgs_rtARID_DEF.UnitDelay2_DSTATE_g "" SLONG autosar_swc_rlgs_CM_int32 0 0 -2147483648 2147483647 ECU_ADDRESS 0xfe4afc6c /* @ECU_Address@autosar_swc_rlgs_rtARID_DEF.UnitDelay2_DSTATE_g@ */ /end MEASUREMENT
/begin MEASUREMENT autosar_swc_rlgs_rtARID_DEF.UnitDelay2_DSTATE_o "" UBYTE autosar_swc_rlgs_CM_uint8 0 0 0 255 ECU_ADDRESS 0xfe4afcf5 /* @ECU_Address@autosar_swc_rlgs_rtARID_DEF.UnitDelay2_DSTATE_o@ */ /end MEASUREMENT
/begin MEASUREMENT autosar_swc_rlgs_rtARID_DEF.UnitDelay2_DSTATE_od "" UBYTE autosar_swc_rlgs_CM_uint8 0 0 0 255 ECU_ADDRESS 0xfe4afcff /* @ECU_Address@autosar_swc_rlgs_rtARID_DEF.UnitDelay2_DSTATE_od@ */ /end MEASUREMENT
/begin MEASUREMENT autosar_swc_rlgs_rtARID_DEF.UnitDelay3_DSTATE_d "" ULONG autosar_swc_rlgs_CM_uint32 0 0 0 4294967295 ECU_ADDRESS 0xfe4afc88 /* @ECU_Address@autosar_swc_rlgs_rtARID_DEF.UnitDelay3_DSTATE_d@ */ /end MEASUREMENT
/begin MEASUREMENT autosar_swc_rlgs_rtARID_DEF.UnitDelay3_DSTATE_mq "" UBYTE autosar_swc_rlgs_CM_uint8 0 0 0 255 ECU_ADDRESS 0xfe4afd00 /* @ECU_Address@autosar_swc_rlgs_rtARID_DEF.UnitDelay3_DSTATE_mq@ */ /end MEASUREMENT
/begin MEASUREMENT autosar_swc_rlgs_rtARID_DEF.UnitDelay3_DSTATE_pv "" UBYTE autosar_swc_rlgs_CM_logical 0 0 0 1 ECU_ADDRESS 0xfe4afdb6 /* @ECU_Address@autosar_swc_rlgs_rtARID_DEF.UnitDelay3_DSTATE_pv@ */ /end MEASUREMENT
/begin MEASUREMENT autosar_swc_rlgs_rtARID_DEF.UnitDelay4_DSTATE_bd "" UBYTE autosar_swc_rlgs_CM_uint8 0 0 0 255 ECU_ADDRESS 0xfe4afcf8 /* @ECU_Address@autosar_swc_rlgs_rtARID_DEF.UnitDelay4_DSTATE_bd@ */ /end MEASUREMENT
/begin MEASUREMENT autosar_swc_rlgs_rtARID_DEF.UnitDelay4_DSTATE_c "" FLOAT32_IEEE autosar_swc_rlgs_CM_single 0 0 -3.4E+38 3.4E+38 ECU_ADDRESS 0xfe4af90c /* @ECU_Address@autosar_swc_rlgs_rtARID_DEF.UnitDelay4_DSTATE_c@ */ /end MEASUREMENT
/begin MEASUREMENT autosar_swc_rlgs_rtARID_DEF.UnitDelay4_DSTATE_p "" ULONG autosar_swc_rlgs_CM_uint32 0 0 0 4294967295 ECU_ADDRESS 0xfe4afc84 /* @ECU_Address@autosar_swc_rlgs_rtARID_DEF.UnitDelay4_DSTATE_p@ */ /end MEASUREMENT
/begin MEASUREMENT autosar_swc_rlgs_rtARID_DEF.UnitDelay5_DSTATE_gi "" UBYTE autosar_swc_rlgs_CM_uint8 0 0 0 255 ECU_ADDRESS 0xfe4afcf9 /* @ECU_Address@autosar_swc_rlgs_rtARID_DEF.UnitDelay5_DSTATE_gi@ */ /end MEASUREMENT
/begin MEASUREMENT autosar_swc_rlgs_rtARID_DEF.UnitDelay5_DSTATE_nx "" ULONG autosar_swc_rlgs_CM_uint32 0 0 0 4294967295 ECU_ADDRESS 0xfe4afc80 /* @ECU_Address@autosar_swc_rlgs_rtARID_DEF.UnitDelay5_DSTATE_nx@ */ /end MEASUREMENT
/begin MEASUREMENT autosar_swc_rlgs_rtARID_DEF.UnitDelay68_DSTATE "" UBYTE autosar_swc_rlgs_CM_uint8 0 0 0 255 ECU_ADDRESS 0xfe4afce9 /* @ECU_Address@autosar_swc_rlgs_rtARID_DEF.UnitDelay68_DSTATE@ */ /end MEASUREMENT
/begin MEASUREMENT autosar_swc_rlgs_rtARID_DEF.UnitDelay7_DSTATE_b "" FLOAT32_IEEE autosar_swc_rlgs_CM_single 0 0 -3.4E+38 3.4E+38 ECU_ADDRESS 0xfe4af918 /* @ECU_Address@autosar_swc_rlgs_rtARID_DEF.UnitDelay7_DSTATE_b@ */ /end MEASUREMENT
/begin MEASUREMENT autosar_swc_rlgs_rtARID_DEF.UnitDelay8_DSTATE_c "" FLOAT32_IEEE autosar_swc_rlgs_CM_single 0 0 -3.4E+38 3.4E+38 ECU_ADDRESS 0xfe4af91c /* @ECU_Address@autosar_swc_rlgs_rtARID_DEF.UnitDelay8_DSTATE_c@ */ /end MEASUREMENT
/begin MEASUREMENT autosar_swc_rlgs_rtARID_DEF.UnitDelay_DSTATE_a "" FLOAT32_IEEE autosar_swc_rlgs_CM_single 0 0 -3.4E+38 3.4E+38 ECU_ADDRESS 0xfe4af93c /* @ECU_Address@autosar_swc_rlgs_rtARID_DEF.UnitDelay_DSTATE_a@ */ /end MEASUREMENT
/begin MEASUREMENT autosar_swc_rlgs_rtARID_DEF.UnitDelay_DSTATE_b "" FLOAT32_IEEE autosar_swc_rlgs_CM_single 0 0 -3.4E+38 3.4E+38 ECU_ADDRESS 0xfe4af950 /* @ECU_Address@autosar_swc_rlgs_rtARID_DEF.UnitDelay_DSTATE_b@ */ /end MEASUREMENT
/begin MEASUREMENT autosar_swc_rlgs_rtARID_DEF.UnitDelay_DSTATE_cb "" SLONG autosar_swc_rlgs_CM_int32 0 0 -2147483648 2147483647 ECU_ADDRESS 0xfe4afc5c /* @ECU_Address@autosar_swc_rlgs_rtARID_DEF.UnitDelay_DSTATE_cb@ */ /end MEASUREMENT
/begin MEASUREMENT autosar_swc_rlgs_rtARID_DEF.UnitDelay_DSTATE_cc "" UBYTE autosar_swc_rlgs_CM_uint8 0 0 0 255 ECU_ADDRESS 0xfe4afcfd /* @ECU_Address@autosar_swc_rlgs_rtARID_DEF.UnitDelay_DSTATE_cc@ */ /end MEASUREMENT
/begin MEASUREMENT autosar_swc_rlgs_rtARID_DEF.UnitDelay_DSTATE_d3 "" UWORD autosar_swc_rlgs_CM_uint16 0 0 0 65535 ECU_ADDRESS 0xfe4afc9a /* @ECU_Address@autosar_swc_rlgs_rtARID_DEF.UnitDelay_DSTATE_d3@ */ /end MEASUREMENT
/begin MEASUREMENT autosar_swc_rlgs_rtARID_DEF.UnitDelay_DSTATE_df "" UBYTE autosar_swc_rlgs_CM_uint8 0 0 0 255 ECU_ADDRESS 0xfe4afcf6 /* @ECU_Address@autosar_swc_rlgs_rtARID_DEF.UnitDelay_DSTATE_df@ */ /end MEASUREMENT
/begin MEASUREMENT autosar_swc_rlgs_rtARID_DEF.UnitDelay_DSTATE_e2 "" UBYTE autosar_swc_rlgs_CM_uint8 0 0 0 255 ECU_ADDRESS 0xfe4afcfc /* @ECU_Address@autosar_swc_rlgs_rtARID_DEF.UnitDelay_DSTATE_e2@ */ /end MEASUREMENT
/begin MEASUREMENT autosar_swc_rlgs_rtARID_DEF.UnitDelay_DSTATE_ew "" SLONG autosar_swc_rlgs_CM_int32 0 0 -2147483648 2147483647 ECU_ADDRESS 0xfe4afc60 /* @ECU_Address@autosar_swc_rlgs_rtARID_DEF.UnitDelay_DSTATE_ew@ */ /end MEASUREMENT
/begin MEASUREMENT autosar_swc_rlgs_rtARID_DEF.UnitDelay_DSTATE_f "" FLOAT32_IEEE autosar_swc_rlgs_CM_single 0 0 -3.4E+38 3.4E+38 ECU_ADDRESS 0xfe4af924 /* @ECU_Address@autosar_swc_rlgs_rtARID_DEF.UnitDelay_DSTATE_f@ */ /end MEASUREMENT
/begin MEASUREMENT autosar_swc_rlgs_rtARID_DEF.UnitDelay_DSTATE_fe "" FLOAT32_IEEE autosar_swc_rlgs_CM_single 0 0 -3.4E+38 3.4E+38 ECU_ADDRESS 0xfe4af958 /* @ECU_Address@autosar_swc_rlgs_rtARID_DEF.UnitDelay_DSTATE_fe@ */ /end MEASUREMENT
/begin MEASUREMENT autosar_swc_rlgs_rtARID_DEF.UnitDelay_DSTATE_fem "" FLOAT32_IEEE autosar_swc_rlgs_CM_single 0 0 -3.4E+38 3.4E+38 ECU_ADDRESS 0xfe4af960 /* @ECU_Address@autosar_swc_rlgs_rtARID_DEF.UnitDelay_DSTATE_fem@ */ /end MEASUREMENT
/begin MEASUREMENT autosar_swc_rlgs_rtARID_DEF.UnitDelay_DSTATE_g "" FLOAT32_IEEE autosar_swc_rlgs_CM_single 0 0 -3.4E+38 3.4E+38 ECU_ADDRESS 0xfe4af954 /* @ECU_Address@autosar_swc_rlgs_rtARID_DEF.UnitDelay_DSTATE_g@ */ /end MEASUREMENT
/begin MEASUREMENT autosar_swc_rlgs_rtARID_DEF.UnitDelay_DSTATE_gc "" FLOAT32_IEEE autosar_swc_rlgs_CM_single 0 0 -3.4E+38 3.4E+38 ECU_ADDRESS 0xfe4af964 /* @ECU_Address@autosar_swc_rlgs_rtARID_DEF.UnitDelay_DSTATE_gc@ */ /end MEASUREMENT
/begin MEASUREMENT autosar_swc_rlgs_rtARID_DEF.UnitDelay_DSTATE_gk "" UBYTE autosar_swc_rlgs_CM_logical 0 0 0 1 ECU_ADDRESS 0xfe4afdaf /* @ECU_Address@autosar_swc_rlgs_rtARID_DEF.UnitDelay_DSTATE_gk@ */ /end MEASUREMENT
/begin MEASUREMENT autosar_swc_rlgs_rtARID_DEF.UnitDelay_DSTATE_h "" FLOAT32_IEEE autosar_swc_rlgs_CM_single 0 0 -3.4E+38 3.4E+38 ECU_ADDRESS 0xfe4af944 /* @ECU_Address@autosar_swc_rlgs_rtARID_DEF.UnitDelay_DSTATE_h@ */ /end MEASUREMENT
/begin MEASUREMENT autosar_swc_rlgs_rtARID_DEF.UnitDelay_DSTATE_hr "" UBYTE autosar_swc_rlgs_CM_uint8 0 0 0 255 ECU_ADDRESS 0xfe4afcfa /* @ECU_Address@autosar_swc_rlgs_rtARID_DEF.UnitDelay_DSTATE_hr@ */ /end MEASUREMENT
/begin MEASUREMENT autosar_swc_rlgs_rtARID_DEF.UnitDelay_DSTATE_ht "" FLOAT32_IEEE autosar_swc_rlgs_CM_single 0 0 -3.4E+38 3.4E+38 ECU_ADDRESS 0xfe4af968 /* @ECU_Address@autosar_swc_rlgs_rtARID_DEF.UnitDelay_DSTATE_ht@ */ /end MEASUREMENT
/begin MEASUREMENT autosar_swc_rlgs_rtARID_DEF.UnitDelay_DSTATE_htr "" UWORD autosar_swc_rlgs_CM_uint16 0 0 0 65535 ECU_ADDRESS 0xfe4afc98 /* @ECU_Address@autosar_swc_rlgs_rtARID_DEF.UnitDelay_DSTATE_htr@ */ /end MEASUREMENT
/begin MEASUREMENT autosar_swc_rlgs_rtARID_DEF.UnitDelay_DSTATE_ie "" FLOAT32_IEEE autosar_swc_rlgs_CM_single 0 0 -3.4E+38 3.4E+38 ECU_ADDRESS 0xfe4af920 /* @ECU_Address@autosar_swc_rlgs_rtARID_DEF.UnitDelay_DSTATE_ie@ */ /end MEASUREMENT
/begin MEASUREMENT autosar_swc_rlgs_rtARID_DEF.UnitDelay_DSTATE_il "" UWORD autosar_swc_rlgs_CM_uint16 0 0 0 65535 ECU_ADDRESS 0xfe4afc92 /* @ECU_Address@autosar_swc_rlgs_rtARID_DEF.UnitDelay_DSTATE_il@ */ /end MEASUREMENT
/begin MEASUREMENT autosar_swc_rlgs_rtARID_DEF.UnitDelay_DSTATE_iw "" FLOAT32_IEEE autosar_swc_rlgs_CM_single 0 0 -3.4E+38 3.4E+38 ECU_ADDRESS 0xfe4af914 /* @ECU_Address@autosar_swc_rlgs_rtARID_DEF.UnitDelay_DSTATE_iw@ */ /end MEASUREMENT
/begin MEASUREMENT autosar_swc_rlgs_rtARID_DEF.UnitDelay_DSTATE_jg "" FLOAT32_IEEE autosar_swc_rlgs_CM_single 0 0 -3.4E+38 3.4E+38 ECU_ADDRESS 0xfe4af940 /* @ECU_Address@autosar_swc_rlgs_rtARID_DEF.UnitDelay_DSTATE_jg@ */ /end MEASUREMENT
/begin MEASUREMENT autosar_swc_rlgs_rtARID_DEF.UnitDelay_DSTATE_jt "" FLOAT32_IEEE autosar_swc_rlgs_CM_single 0 0 -3.4E+38 3.4E+38 ECU_ADDRESS 0xfe4af92c /* @ECU_Address@autosar_swc_rlgs_rtARID_DEF.UnitDelay_DSTATE_jt@ */ /end MEASUREMENT
/begin MEASUREMENT autosar_swc_rlgs_rtARID_DEF.UnitDelay_DSTATE_jv "" UWORD autosar_swc_rlgs_CM_uint16 0 0 0 65535 ECU_ADDRESS 0xfe4afc9e /* @ECU_Address@autosar_swc_rlgs_rtARID_DEF.UnitDelay_DSTATE_jv@ */ /end MEASUREMENT
/begin MEASUREMENT autosar_swc_rlgs_rtARID_DEF.UnitDelay_DSTATE_jy "" FLOAT32_IEEE autosar_swc_rlgs_CM_single 0 0 -3.4E+38 3.4E+38 ECU_ADDRESS 0xfe4af930 /* @ECU_Address@autosar_swc_rlgs_rtARID_DEF.UnitDelay_DSTATE_jy@ */ /end MEASUREMENT
/begin MEASUREMENT autosar_swc_rlgs_rtARID_DEF.UnitDelay_DSTATE_k "" FLOAT32_IEEE autosar_swc_rlgs_CM_single 0 0 -3.4E+38 3.4E+38 ECU_ADDRESS 0xfe4af910 /* @ECU_Address@autosar_swc_rlgs_rtARID_DEF.UnitDelay_DSTATE_k@ */ /end MEASUREMENT
/begin MEASUREMENT autosar_swc_rlgs_rtARID_DEF.UnitDelay_DSTATE_kf "" FLOAT32_IEEE autosar_swc_rlgs_CM_single 0 0 -3.4E+38 3.4E+38 ECU_ADDRESS 0xfe4af948 /* @ECU_Address@autosar_swc_rlgs_rtARID_DEF.UnitDelay_DSTATE_kf@ */ /end MEASUREMENT
/begin MEASUREMENT autosar_swc_rlgs_rtARID_DEF.UnitDelay_DSTATE_kv "" FLOAT32_IEEE autosar_swc_rlgs_CM_single 0 0 -3.4E+38 3.4E+38 ECU_ADDRESS 0xfe4af96c /* @ECU_Address@autosar_swc_rlgs_rtARID_DEF.UnitDelay_DSTATE_kv@ */ /end MEASUREMENT
/begin MEASUREMENT autosar_swc_rlgs_rtARID_DEF.UnitDelay_DSTATE_l "" FLOAT32_IEEE autosar_swc_rlgs_CM_single 0 0 -3.4E+38 3.4E+38 ECU_ADDRESS 0xfe4af864 /* @ECU_Address@autosar_swc_rlgs_rtARID_DEF.UnitDelay_DSTATE_l@ */ /end MEASUREMENT
/begin MEASUREMENT autosar_swc_rlgs_rtARID_DEF.UnitDelay_DSTATE_lg "" FLOAT32_IEEE autosar_swc_rlgs_CM_single 0 0 -3.4E+38 3.4E+38 ECU_ADDRESS 0xfe4af934 /* @ECU_Address@autosar_swc_rlgs_rtARID_DEF.UnitDelay_DSTATE_lg@ */ /end MEASUREMENT
/begin MEASUREMENT autosar_swc_rlgs_rtARID_DEF.UnitDelay_DSTATE_ly "" FLOAT32_IEEE autosar_swc_rlgs_CM_single 0 0 -3.4E+38 3.4E+38 ECU_ADDRESS 0xfe4af938 /* @ECU_Address@autosar_swc_rlgs_rtARID_DEF.UnitDelay_DSTATE_ly@ */ /end MEASUREMENT
/begin MEASUREMENT autosar_swc_rlgs_rtARID_DEF.UnitDelay_DSTATE_n1 "" SLONG autosar_swc_rlgs_CM_int32 0 0 -2147483648 2147483647 ECU_ADDRESS 0xfe4afc68 /* @ECU_Address@autosar_swc_rlgs_rtARID_DEF.UnitDelay_DSTATE_n1@ */ /end MEASUREMENT
/begin MEASUREMENT autosar_swc_rlgs_rtARID_DEF.UnitDelay_DSTATE_nu "" FLOAT32_IEEE autosar_swc_rlgs_CM_single 0 0 -3.4E+38 3.4E+38 ECU_ADDRESS 0xfe4af860 /* @ECU_Address@autosar_swc_rlgs_rtARID_DEF.UnitDelay_DSTATE_nu@ */ /end MEASUREMENT
/begin MEASUREMENT autosar_swc_rlgs_rtARID_DEF.UnitDelay_DSTATE_nw "" UWORD autosar_swc_rlgs_CM_uint16 0 0 0 65535 ECU_ADDRESS 0xfe4afc90 /* @ECU_Address@autosar_swc_rlgs_rtARID_DEF.UnitDelay_DSTATE_nw@ */ /end MEASUREMENT
/begin MEASUREMENT autosar_swc_rlgs_rtARID_DEF.UnitDelay_DSTATE_o "" FLOAT32_IEEE autosar_swc_rlgs_CM_single 0 0 -3.4E+38 3.4E+38 ECU_ADDRESS 0xfe4af95c /* @ECU_Address@autosar_swc_rlgs_rtARID_DEF.UnitDelay_DSTATE_o@ */ /end MEASUREMENT
/begin MEASUREMENT autosar_swc_rlgs_rtARID_DEF.UnitDelay_DSTATE_ob "" UWORD autosar_swc_rlgs_CM_uint16 0 0 0 65535 ECU_ADDRESS 0xfe4afc9c /* @ECU_Address@autosar_swc_rlgs_rtARID_DEF.UnitDelay_DSTATE_ob@ */ /end MEASUREMENT
/begin MEASUREMENT autosar_swc_rlgs_rtARID_DEF.UnitDelay_DSTATE_oj "" UBYTE autosar_swc_rlgs_CM_logical 0 0 0 1 ECU_ADDRESS 0xfe4afdb7 /* @ECU_Address@autosar_swc_rlgs_rtARID_DEF.UnitDelay_DSTATE_oj@ */ /end MEASUREMENT
/begin MEASUREMENT autosar_swc_rlgs_rtARID_DEF.UnitDelay_DSTATE_om "" UBYTE autosar_swc_rlgs_CM_uint8 0 0 0 255 ECU_ADDRESS 0xfe4afcf0 /* @ECU_Address@autosar_swc_rlgs_rtARID_DEF.UnitDelay_DSTATE_om@ */ /end MEASUREMENT
/begin MEASUREMENT autosar_swc_rlgs_rtARID_DEF.UnitDelay_DSTATE_p "" FLOAT32_IEEE autosar_swc_rlgs_CM_single 0 0 -3.4E+38 3.4E+38 ECU_ADDRESS 0xfe4af928 /* @ECU_Address@autosar_swc_rlgs_rtARID_DEF.UnitDelay_DSTATE_p@ */ /end MEASUREMENT
/begin MEASUREMENT autosar_swc_rlgs_rtARID_DEF.UnitDelay_DSTATE_pa "" FLOAT32_IEEE autosar_swc_rlgs_CM_single 0 0 -3.4E+38 3.4E+38 ECU_ADDRESS 0xfe4af94c /* @ECU_Address@autosar_swc_rlgs_rtARID_DEF.UnitDelay_DSTATE_pa@ */ /end MEASUREMENT
/begin MEASUREMENT autosar_swc_rlgs_rtARID_DEF.Urban_RightStraight "" UBYTE autosar_swc_rlgs_CM_logical 0 0 0 1 MATRIX_DIM 1 1 ECU_ADDRESS 0xfe4afd92 /* @ECU_Address@autosar_swc_rlgs_rtARID_DEF.Urban_RightStraight@ */ /end MEASUREMENT
/begin MEASUREMENT autosar_swc_rlgs_rtARID_DEF.VehMoveFordDis "" FLOAT32_IEEE autosar_swc_rlgs_CM_single 0 0 -3.4E+38 3.4E+38 ECU_ADDRESS 0xfe4af9e8 /* @ECU_Address@autosar_swc_rlgs_rtARID_DEF.VehMoveFordDis@ */ /end MEASUREMENT
/begin MEASUREMENT autosar_swc_rlgs_rtARID_DEF.YBranchTime "" FLOAT32_IEEE autosar_swc_rlgs_CM_single 0 0 -3.4E+38 3.4E+38 ECU_ADDRESS 0xfe4af9d4 /* @ECU_Address@autosar_swc_rlgs_rtARID_DEF.YBranchTime@ */ /end MEASUREMENT
/begin MEASUREMENT autosar_swc_rlgs_rtARID_DEF.cnt "" UBYTE autosar_swc_rlgs_CM_uint8 0 0 0 255 ECU_ADDRESS 0xfe4afd0c /* @ECU_Address@autosar_swc_rlgs_rtARID_DEF.cnt@ */ /end MEASUREMENT
/begin MEASUREMENT autosar_swc_rlgs_rtARID_DEF.counter "" FLOAT32_IEEE autosar_swc_rlgs_CM_single 0 0 -3.4E+38 3.4E+38 ECU_ADDRESS 0xfe4afa18 /* @ECU_Address@autosar_swc_rlgs_rtARID_DEF.counter@ */ /end MEASUREMENT
/begin MEASUREMENT autosar_swc_rlgs_rtARID_DEF.dist "" FLOAT32_IEEE autosar_swc_rlgs_CM_single 0 0 -3.4E+38 3.4E+38 ECU_ADDRESS 0xfe4af978 /* @ECU_Address@autosar_swc_rlgs_rtARID_DEF.dist@ */ /end MEASUREMENT
/begin MEASUREMENT autosar_swc_rlgs_rtARID_DEF.hold_cnt "" UWORD autosar_swc_rlgs_CM_uint16 0 0 0 65535 ECU_ADDRESS 0xfe4afca0 /* @ECU_Address@autosar_swc_rlgs_rtARID_DEF.hold_cnt@ */ /end MEASUREMENT
/begin MEASUREMENT autosar_swc_rlgs_rtARID_DEF.host_lane_idx "" UBYTE autosar_swc_rlgs_CM_uint8 0 0 0 255 ECU_ADDRESS 0xfe4afcda /* @ECU_Address@autosar_swc_rlgs_rtARID_DEF.host_lane_idx@ */ /end MEASUREMENT
/begin MEASUREMENT autosar_swc_rlgs_rtARID_DEF.i_form_of_way_k1 "" UBYTE autosar_swc_rlgs_CM_uint8 0 0 0 255 ECU_ADDRESS 0xfe4afd20 /* @ECU_Address@autosar_swc_rlgs_rtARID_DEF.i_form_of_way_k1@ */ /end MEASUREMENT
/begin MEASUREMENT autosar_swc_rlgs_rtARID_DEF.is_ElecFenceJudge "" UBYTE autosar_swc_rlgs_CM_uint8 0 0 0 255 ECU_ADDRESS 0xfe4afd29 /* @ECU_Address@autosar_swc_rlgs_rtARID_DEF.is_ElecFenceJudge@ */ /end MEASUREMENT
/begin MEASUREMENT autosar_swc_rlgs_rtARID_DEF.is_HighWayMode "" UBYTE autosar_swc_rlgs_CM_uint8 0 0 0 255 ECU_ADDRESS 0xfe4afd2a /* @ECU_Address@autosar_swc_rlgs_rtARID_DEF.is_HighWayMode@ */ /end MEASUREMENT
/begin MEASUREMENT autosar_swc_rlgs_rtARID_DEF.is_HighWay_LeftEntry "" UBYTE autosar_swc_rlgs_CM_uint8 0 0 0 255 ECU_ADDRESS 0xfe4afd2b /* @ECU_Address@autosar_swc_rlgs_rtARID_DEF.is_HighWay_LeftEntry@ */ /end MEASUREMENT
/begin MEASUREMENT autosar_swc_rlgs_rtARID_DEF.is_HighWay_RightSplit "" UBYTE autosar_swc_rlgs_CM_uint8 0 0 0 255 ECU_ADDRESS 0xfe4afd2c /* @ECU_Address@autosar_swc_rlgs_rtARID_DEF.is_HighWay_RightSplit@ */ /end MEASUREMENT
/begin MEASUREMENT autosar_swc_rlgs_rtARID_DEF.is_LeLCP "" UBYTE autosar_swc_rlgs_CM_uint8 0 0 0 255 ECU_ADDRESS 0xfe4afd10 /* @ECU_Address@autosar_swc_rlgs_rtARID_DEF.is_LeLCP@ */ /end MEASUREMENT
/begin MEASUREMENT autosar_swc_rlgs_rtARID_DEF.is_Merge "" UBYTE autosar_swc_rlgs_CM_uint8 0 0 0 255 ECU_ADDRESS 0xfe4afd34 /* @ECU_Address@autosar_swc_rlgs_rtARID_DEF.is_Merge@ */ /end MEASUREMENT
/begin MEASUREMENT autosar_swc_rlgs_rtARID_DEF.is_RampMode "" UBYTE autosar_swc_rlgs_CM_uint8 0 0 0 255 ECU_ADDRESS 0xfe4afd2d /* @ECU_Address@autosar_swc_rlgs_rtARID_DEF.is_RampMode@ */ /end MEASUREMENT
/begin MEASUREMENT autosar_swc_rlgs_rtARID_DEF.is_Ramp_LeftEntry "" UBYTE autosar_swc_rlgs_CM_uint8 0 0 0 255 ECU_ADDRESS 0xfe4afd2e /* @ECU_Address@autosar_swc_rlgs_rtARID_DEF.is_Ramp_LeftEntry@ */ /end MEASUREMENT
/begin MEASUREMENT autosar_swc_rlgs_rtARID_DEF.is_Ramp_LeftStraightAndReChoose "" UBYTE autosar_swc_rlgs_CM_uint8 0 0 0 255 ECU_ADDRESS 0xfe4afd2f /* @ECU_Address@autosar_swc_rlgs_rtARID_DEF.is_Ramp_LeftStraightAndReChoose@ */ /end MEASUREMENT
/begin MEASUREMENT autosar_swc_rlgs_rtARID_DEF.is_Ramp_RightSplit "" UBYTE autosar_swc_rlgs_CM_uint8 0 0 0 255 ECU_ADDRESS 0xfe4afd30 /* @ECU_Address@autosar_swc_rlgs_rtARID_DEF.is_Ramp_RightSplit@ */ /end MEASUREMENT
/begin MEASUREMENT autosar_swc_rlgs_rtARID_DEF.is_RiLCP "" UBYTE autosar_swc_rlgs_CM_uint8 0 0 0 255 ECU_ADDRESS 0xfe4afd11 /* @ECU_Address@autosar_swc_rlgs_rtARID_DEF.is_RiLCP@ */ /end MEASUREMENT
/begin MEASUREMENT autosar_swc_rlgs_rtARID_DEF.is_Split "" UBYTE autosar_swc_rlgs_CM_uint8 0 0 0 255 ECU_ADDRESS 0xfe4afd35 /* @ECU_Address@autosar_swc_rlgs_rtARID_DEF.is_Split@ */ /end MEASUREMENT
/begin MEASUREMENT autosar_swc_rlgs_rtARID_DEF.is_Urban "" UBYTE autosar_swc_rlgs_CM_uint8 0 0 0 255 ECU_ADDRESS 0xfe4afd31 /* @ECU_Address@autosar_swc_rlgs_rtARID_DEF.is_Urban@ */ /end MEASUREMENT
/begin MEASUREMENT autosar_swc_rlgs_rtARID_DEF.is_active_c1074_autosar_swc_rlgs "" UBYTE autosar_swc_rlgs_CM_uint8 0 0 0 255 ECU_ADDRESS 0xfe4afd0d /* @ECU_Address@autosar_swc_rlgs_rtARID_DEF.is_active_c1074_autosar_swc_rlgs@ */ /end MEASUREMENT
/begin MEASUREMENT autosar_swc_rlgs_rtARID_DEF.is_active_c1270_autosar_swc_rlgs "" UBYTE autosar_swc_rlgs_CM_uint8 0 0 0 255 ECU_ADDRESS 0xfe4afd3c /* @ECU_Address@autosar_swc_rlgs_rtARID_DEF.is_active_c1270_autosar_swc_rlgs@ */ /end MEASUREMENT
/begin MEASUREMENT autosar_swc_rlgs_rtARID_DEF.is_active_c1271_autosar_swc_rlgs "" UBYTE autosar_swc_rlgs_CM_uint8 0 0 0 255 ECU_ADDRESS 0xfe4afd3a /* @ECU_Address@autosar_swc_rlgs_rtARID_DEF.is_active_c1271_autosar_swc_rlgs@ */ /end MEASUREMENT
/begin MEASUREMENT autosar_swc_rlgs_rtARID_DEF.is_active_c1280_autosar_swc_rlgs "" UBYTE autosar_swc_rlgs_CM_uint8 0 0 0 255 ECU_ADDRESS 0xfe4afd32 /* @ECU_Address@autosar_swc_rlgs_rtARID_DEF.is_active_c1280_autosar_swc_rlgs@ */ /end MEASUREMENT
/begin MEASUREMENT autosar_swc_rlgs_rtARID_DEF.is_active_c1287_autosar_swc_rlgs "" UBYTE autosar_swc_rlgs_CM_uint8 0 0 0 255 ECU_ADDRESS 0xfe4afd27 /* @ECU_Address@autosar_swc_rlgs_rtARID_DEF.is_active_c1287_autosar_swc_rlgs@ */ /end MEASUREMENT
/begin MEASUREMENT autosar_swc_rlgs_rtARID_DEF.is_active_c1288_autosar_swc_rlgs "" UBYTE autosar_swc_rlgs_CM_uint8 0 0 0 255 ECU_ADDRESS 0xfe4afd25 /* @ECU_Address@autosar_swc_rlgs_rtARID_DEF.is_active_c1288_autosar_swc_rlgs@ */ /end MEASUREMENT
/begin MEASUREMENT autosar_swc_rlgs_rtARID_DEF.is_active_c1289_autosar_swc_rlgs "" UBYTE autosar_swc_rlgs_CM_uint8 0 0 0 255 ECU_ADDRESS 0xfe4afd23 /* @ECU_Address@autosar_swc_rlgs_rtARID_DEF.is_active_c1289_autosar_swc_rlgs@ */ /end MEASUREMENT
/begin MEASUREMENT autosar_swc_rlgs_rtARID_DEF.is_active_c1291_autosar_swc_rlgs "" UBYTE autosar_swc_rlgs_CM_uint8 0 0 0 255 ECU_ADDRESS 0xfe4afd21 /* @ECU_Address@autosar_swc_rlgs_rtARID_DEF.is_active_c1291_autosar_swc_rlgs@ */ /end MEASUREMENT
/begin MEASUREMENT autosar_swc_rlgs_rtARID_DEF.is_active_c1359_autosar_swc_rlgs "" UBYTE autosar_swc_rlgs_CM_uint8 0 0 0 255 ECU_ADDRESS 0xfe4afd18 /* @ECU_Address@autosar_swc_rlgs_rtARID_DEF.is_active_c1359_autosar_swc_rlgs@ */ /end MEASUREMENT
/begin MEASUREMENT autosar_swc_rlgs_rtARID_DEF.is_active_c1360_autosar_swc_rlgs "" UBYTE autosar_swc_rlgs_CM_uint8 0 0 0 255 ECU_ADDRESS 0xfe4afd16 /* @ECU_Address@autosar_swc_rlgs_rtARID_DEF.is_active_c1360_autosar_swc_rlgs@ */ /end MEASUREMENT
/begin MEASUREMENT autosar_swc_rlgs_rtARID_DEF.is_active_c1361_autosar_swc_rlgs "" UBYTE autosar_swc_rlgs_CM_uint8 0 0 0 255 ECU_ADDRESS 0xfe4afd14 /* @ECU_Address@autosar_swc_rlgs_rtARID_DEF.is_active_c1361_autosar_swc_rlgs@ */ /end MEASUREMENT
/begin MEASUREMENT autosar_swc_rlgs_rtARID_DEF.is_active_c1362_autosar_swc_rlgs "" UBYTE autosar_swc_rlgs_CM_uint8 0 0 0 255 ECU_ADDRESS 0xfe4afd12 /* @ECU_Address@autosar_swc_rlgs_rtARID_DEF.is_active_c1362_autosar_swc_rlgs@ */ /end MEASUREMENT
/begin MEASUREMENT autosar_swc_rlgs_rtARID_DEF.is_c1074_autosar_swc_rlgs "" UBYTE autosar_swc_rlgs_CM_uint8 0 0 0 255 ECU_ADDRESS 0xfe4afd0e /* @ECU_Address@autosar_swc_rlgs_rtARID_DEF.is_c1074_autosar_swc_rlgs@ */ /end MEASUREMENT
/begin MEASUREMENT autosar_swc_rlgs_rtARID_DEF.is_c1270_autosar_swc_rlgs "" UBYTE autosar_swc_rlgs_CM_uint8 0 0 0 255 ECU_ADDRESS 0xfe4afd3d /* @ECU_Address@autosar_swc_rlgs_rtARID_DEF.is_c1270_autosar_swc_rlgs@ */ /end MEASUREMENT
/begin MEASUREMENT autosar_swc_rlgs_rtARID_DEF.is_c1271_autosar_swc_rlgs "" UBYTE autosar_swc_rlgs_CM_uint8 0 0 0 255 ECU_ADDRESS 0xfe4afd3b /* @ECU_Address@autosar_swc_rlgs_rtARID_DEF.is_c1271_autosar_swc_rlgs@ */ /end MEASUREMENT
/begin MEASUREMENT autosar_swc_rlgs_rtARID_DEF.is_c1280_autosar_swc_rlgs "" UBYTE autosar_swc_rlgs_CM_uint8 0 0 0 255 ECU_ADDRESS 0xfe4afd33 /* @ECU_Address@autosar_swc_rlgs_rtARID_DEF.is_c1280_autosar_swc_rlgs@ */ /end MEASUREMENT
/begin MEASUREMENT autosar_swc_rlgs_rtARID_DEF.is_c1287_autosar_swc_rlgs "" UBYTE autosar_swc_rlgs_CM_uint8 0 0 0 255 ECU_ADDRESS 0xfe4afd28 /* @ECU_Address@autosar_swc_rlgs_rtARID_DEF.is_c1287_autosar_swc_rlgs@ */ /end MEASUREMENT
/begin MEASUREMENT autosar_swc_rlgs_rtARID_DEF.is_c1288_autosar_swc_rlgs "" UBYTE autosar_swc_rlgs_CM_uint8 0 0 0 255 ECU_ADDRESS 0xfe4afd26 /* @ECU_Address@autosar_swc_rlgs_rtARID_DEF.is_c1288_autosar_swc_rlgs@ */ /end MEASUREMENT
/begin MEASUREMENT autosar_swc_rlgs_rtARID_DEF.is_c1289_autosar_swc_rlgs "" UBYTE autosar_swc_rlgs_CM_uint8 0 0 0 255 ECU_ADDRESS 0xfe4afd24 /* @ECU_Address@autosar_swc_rlgs_rtARID_DEF.is_c1289_autosar_swc_rlgs@ */ /end MEASUREMENT
/begin MEASUREMENT autosar_swc_rlgs_rtARID_DEF.is_c1291_autosar_swc_rlgs "" UBYTE autosar_swc_rlgs_CM_uint8 0 0 0 255 ECU_ADDRESS 0xfe4afd22 /* @ECU_Address@autosar_swc_rlgs_rtARID_DEF.is_c1291_autosar_swc_rlgs@ */ /end MEASUREMENT
/begin MEASUREMENT autosar_swc_rlgs_rtARID_DEF.is_c1359_autosar_swc_rlgs "" UBYTE autosar_swc_rlgs_CM_uint8 0 0 0 255 ECU_ADDRESS 0xfe4afd19 /* @ECU_Address@autosar_swc_rlgs_rtARID_DEF.is_c1359_autosar_swc_rlgs@ */ /end MEASUREMENT
/begin MEASUREMENT autosar_swc_rlgs_rtARID_DEF.is_c1360_autosar_swc_rlgs "" UBYTE autosar_swc_rlgs_CM_uint8 0 0 0 255 ECU_ADDRESS 0xfe4afd17 /* @ECU_Address@autosar_swc_rlgs_rtARID_DEF.is_c1360_autosar_swc_rlgs@ */ /end MEASUREMENT
/begin MEASUREMENT autosar_swc_rlgs_rtARID_DEF.is_c1361_autosar_swc_rlgs "" UBYTE autosar_swc_rlgs_CM_uint8 0 0 0 255 ECU_ADDRESS 0xfe4afd15 /* @ECU_Address@autosar_swc_rlgs_rtARID_DEF.is_c1361_autosar_swc_rlgs@ */ /end MEASUREMENT
/begin MEASUREMENT autosar_swc_rlgs_rtARID_DEF.is_c1362_autosar_swc_rlgs "" UBYTE autosar_swc_rlgs_CM_uint8 0 0 0 255 ECU_ADDRESS 0xfe4afd13 /* @ECU_Address@autosar_swc_rlgs_rtARID_DEF.is_c1362_autosar_swc_rlgs@ */ /end MEASUREMENT
/begin MEASUREMENT autosar_swc_rlgs_rtARID_DEF.is_lane_change_req "" UBYTE autosar_swc_rlgs_CM_uint8 0 0 0 255 ECU_ADDRESS 0xfe4afd0f /* @ECU_Address@autosar_swc_rlgs_rtARID_DEF.is_lane_change_req@ */ /end MEASUREMENT
/begin MEASUREMENT autosar_swc_rlgs_rtARID_DEF.lc_req "" UBYTE autosar_swc_rlgs_CM_uint8 0 0 0 255 ECU_ADDRESS 0xfe4afcd6 /* @ECU_Address@autosar_swc_rlgs_rtARID_DEF.lc_req@ */ /end MEASUREMENT
/begin MEASUREMENT autosar_swc_rlgs_rtARID_DEF.lc_req_sync_id "" UBYTE autosar_swc_rlgs_CM_uint8 0 0 0 255 MATRIX_DIM 1 1 ECU_ADDRESS 0xfe4afcdb /* @ECU_Address@autosar_swc_rlgs_rtARID_DEF.lc_req_sync_id@ */ /end MEASUREMENT
/begin MEASUREMENT autosar_swc_rlgs_rtARID_DEF.lineTypeK1 "" UBYTE autosar_swc_rlgs_CM_uint8 0 0 0 255 ECU_ADDRESS 0xfe4afd41 /* @ECU_Address@autosar_swc_rlgs_rtARID_DEF.lineTypeK1@ */ /end MEASUREMENT
/begin MEASUREMENT autosar_swc_rlgs_rtARID_DEF.lineTypeK1_k "" UBYTE autosar_swc_rlgs_CM_uint8 0 0 0 255 ECU_ADDRESS 0xfe4afd4f /* @ECU_Address@autosar_swc_rlgs_rtARID_DEF.lineTypeK1_k@ */ /end MEASUREMENT
/begin MEASUREMENT autosar_swc_rlgs_rtARID_DEF.lineTypeK1_l "" UBYTE autosar_swc_rlgs_CM_uint8 0 0 0 255 ECU_ADDRESS 0xfe4afd43 /* @ECU_Address@autosar_swc_rlgs_rtARID_DEF.lineTypeK1_l@ */ /end MEASUREMENT
/begin MEASUREMENT autosar_swc_rlgs_rtARID_DEF.lineTypeK1_n "" UBYTE autosar_swc_rlgs_CM_uint8 0 0 0 255 ECU_ADDRESS 0xfe4afd54 /* @ECU_Address@autosar_swc_rlgs_rtARID_DEF.lineTypeK1_n@ */ /end MEASUREMENT
/begin MEASUREMENT autosar_swc_rlgs_rtARID_DEF.lineTypeK1_o "" UBYTE autosar_swc_rlgs_CM_uint8 0 0 0 255 ECU_ADDRESS 0xfe4afd4a /* @ECU_Address@autosar_swc_rlgs_rtARID_DEF.lineTypeK1_o@ */ /end MEASUREMENT
/begin MEASUREMENT autosar_swc_rlgs_rtARID_DEF.lineTypeK1_p "" UBYTE autosar_swc_rlgs_CM_uint8 0 0 0 255 ECU_ADDRESS 0xfe4afd45 /* @ECU_Address@autosar_swc_rlgs_rtARID_DEF.lineTypeK1_p@ */ /end MEASUREMENT
/begin MEASUREMENT autosar_swc_rlgs_rtARID_DEF.mostLeftLane_FlagK1 "" UBYTE autosar_swc_rlgs_CM_logical 0 0 0 1 ECU_ADDRESS 0xfe4afdc4 /* @ECU_Address@autosar_swc_rlgs_rtARID_DEF.mostLeftLane_FlagK1@ */ /end MEASUREMENT
/begin MEASUREMENT autosar_swc_rlgs_rtARID_DEF.mostLeftLane_adjacent_FlagK1 "" UBYTE autosar_swc_rlgs_CM_logical 0 0 0 1 ECU_ADDRESS 0xfe4afdc5 /* @ECU_Address@autosar_swc_rlgs_rtARID_DEF.mostLeftLane_adjacent_FlagK1@ */ /end MEASUREMENT
/begin MEASUREMENT autosar_swc_rlgs_rtARID_DEF.mostRightLaneFlagk1 "" UBYTE autosar_swc_rlgs_CM_logical 0 0 0 1 ECU_ADDRESS 0xfe4afdc6 /* @ECU_Address@autosar_swc_rlgs_rtARID_DEF.mostRightLaneFlagk1@ */ /end MEASUREMENT
/begin MEASUREMENT autosar_swc_rlgs_rtARID_DEF.mostRightLane_adjacent_FlagK1 "" UBYTE autosar_swc_rlgs_CM_logical 0 0 0 1 ECU_ADDRESS 0xfe4afdc7 /* @ECU_Address@autosar_swc_rlgs_rtARID_DEF.mostRightLane_adjacent_FlagK1@ */ /end MEASUREMENT
/begin MEASUREMENT autosar_swc_rlgs_rtARID_DEF.mostrightTime "" FLOAT32_IEEE autosar_swc_rlgs_CM_single 0 0 -3.4E+38 3.4E+38 ECU_ADDRESS 0xfe4af984 /* @ECU_Address@autosar_swc_rlgs_rtARID_DEF.mostrightTime@ */ /end MEASUREMENT
/begin MEASUREMENT autosar_swc_rlgs_rtARID_DEF.t "" FLOAT32_IEEE autosar_swc_rlgs_CM_single 0 0 -3.4E+38 3.4E+38 ECU_ADDRESS 0xfe4af9c4 /* @ECU_Address@autosar_swc_rlgs_rtARID_DEF.t@ */ /end MEASUREMENT
/begin MEASUREMENT autosar_swc_rlgs_rtARID_DEF.tLostK1 "" FLOAT32_IEEE autosar_swc_rlgs_CM_single 0 0 -3.4E+38 3.4E+38 ECU_ADDRESS 0xfe4afa38 /* @ECU_Address@autosar_swc_rlgs_rtARID_DEF.tLostK1@ */ /end MEASUREMENT
/begin MEASUREMENT autosar_swc_rlgs_rtARID_DEF.tLostK1_a "" FLOAT32_IEEE autosar_swc_rlgs_CM_single 0 0 -3.4E+38 3.4E+38 ECU_ADDRESS 0xfe4afad8 /* @ECU_Address@autosar_swc_rlgs_rtARID_DEF.tLostK1_a@ */ /end MEASUREMENT
/begin MEASUREMENT autosar_swc_rlgs_rtARID_DEF.tLostK1_i "" FLOAT32_IEEE autosar_swc_rlgs_CM_single 0 0 -3.4E+38 3.4E+38 ECU_ADDRESS 0xfe4afa78 /* @ECU_Address@autosar_swc_rlgs_rtARID_DEF.tLostK1_i@ */ /end MEASUREMENT
/begin MEASUREMENT autosar_swc_rlgs_rtARID_DEF.tLostK1_ir "" FLOAT32_IEEE autosar_swc_rlgs_CM_single 0 0 -3.4E+38 3.4E+38 ECU_ADDRESS 0xfe4afaa8 /* @ECU_Address@autosar_swc_rlgs_rtARID_DEF.tLostK1_ir@ */ /end MEASUREMENT
/begin MEASUREMENT autosar_swc_rlgs_rtARID_DEF.tLostK1_j "" FLOAT32_IEEE autosar_swc_rlgs_CM_single 0 0 -3.4E+38 3.4E+38 ECU_ADDRESS 0xfe4afb08 /* @ECU_Address@autosar_swc_rlgs_rtARID_DEF.tLostK1_j@ */ /end MEASUREMENT
/begin MEASUREMENT autosar_swc_rlgs_rtARID_DEF.tLostK1_n "" FLOAT32_IEEE autosar_swc_rlgs_CM_single 0 0 -3.4E+38 3.4E+38 ECU_ADDRESS 0xfe4afa58 /* @ECU_Address@autosar_swc_rlgs_rtARID_DEF.tLostK1_n@ */ /end MEASUREMENT
/begin MEASUREMENT autosar_swc_rlgs_rtARID_DEF.t_R1 "" FLOAT32_IEEE autosar_swc_rlgs_CM_single 0 0 -3.4E+38 3.4E+38 ECU_ADDRESS 0xfe4af9d8 /* @ECU_Address@autosar_swc_rlgs_rtARID_DEF.t_R1@ */ /end MEASUREMENT
/begin MEASUREMENT autosar_swc_rlgs_rtARID_DEF.t_R1_i "" FLOAT32_IEEE autosar_swc_rlgs_CM_single 0 0 -3.4E+38 3.4E+38 ECU_ADDRESS 0xfe4afa04 /* @ECU_Address@autosar_swc_rlgs_rtARID_DEF.t_R1_i@ */ /end MEASUREMENT
/begin MEASUREMENT autosar_swc_rlgs_rtARID_DEF.t_RB "" FLOAT32_IEEE autosar_swc_rlgs_CM_single 0 0 -3.4E+38 3.4E+38 ECU_ADDRESS 0xfe4af9dc /* @ECU_Address@autosar_swc_rlgs_rtARID_DEF.t_RB@ */ /end MEASUREMENT
/begin MEASUREMENT autosar_swc_rlgs_rtARID_DEF.t_RB_e "" FLOAT32_IEEE autosar_swc_rlgs_CM_single 0 0 -3.4E+38 3.4E+38 ECU_ADDRESS 0xfe4afa08 /* @ECU_Address@autosar_swc_rlgs_rtARID_DEF.t_RB_e@ */ /end MEASUREMENT
/begin AXIS_PTS P_PSM_SpeedSuppressedErrorTable "" 0xfe821dbc /* @ECU_Address@P_PSM_SpeedSuppressedErrorTable@ */ NO_INPUT_QUANTITY Axis_FLOAT32_IEEE 0 autosar_swc_rlgs_CM_single 3 -3.4E+38 3.4E+38 /end AXIS_PTS
/begin COMPU_METHOD autosar_swc_rlgs_CM_boolean "Q = V" IDENTICAL "%1.0" "" /end COMPU_METHOD
/begin COMPU_METHOD autosar_swc_rlgs_CM_double "Q = V" IDENTICAL "%15.10" "" /end COMPU_METHOD
/begin COMPU_METHOD autosar_swc_rlgs_CM_int32 "Q = V" IDENTICAL "%10.0" "" /end COMPU_METHOD
/begin COMPU_METHOD autosar_swc_rlgs_CM_logical "Q = V" IDENTICAL "%1.0" "" /end COMPU_METHOD
/begin COMPU_METHOD autosar_swc_rlgs_CM_single "Q = V" IDENTICAL "%8.6" "" /end COMPU_METHOD
/begin COMPU_METHOD autosar_swc_rlgs_CM_uint16 "Q = V" IDENTICAL "%5.0" "" /end COMPU_METHOD
/begin COMPU_METHOD autosar_swc_rlgs_CM_uint32 "Q = V" IDENTICAL "%10.0" "" /end COMPU_METHOD
/begin COMPU_METHOD autosar_swc_rlgs_CM_uint8 "Q = V" IDENTICAL "%3.0" "" /end COMPU_METHOD
/begin RECORD_LAYOUT Record_BOOLEAN FNC_VALUES 1 UBYTE COLUMN_DIR DIRECT /end RECORD_LAYOUT
/begin RECORD_LAYOUT Record_FLOAT32_IEEE FNC_VALUES 1 FLOAT32_IEEE COLUMN_DIR DIRECT /end RECORD_LAYOUT
/begin RECORD_LAYOUT Record_FLOAT64_IEEE FNC_VALUES 1 FLOAT64_IEEE COLUMN_DIR DIRECT /end RECORD_LAYOUT
/begin RECORD_LAYOUT Record_SLONG FNC_VALUES 1 SLONG COLUMN_DIR DIRECT /end RECORD_LAYOUT
/begin RECORD_LAYOUT Record_UBYTE FNC_VALUES 1 UBYTE COLUMN_DIR DIRECT /end RECORD_LAYOUT
/begin RECORD_LAYOUT Record_UWORD FNC_VALUES 1 UWORD COLUMN_DIR DIRECT /end RECORD_LAYOUT
/begin RECORD_LAYOUT Axis_FLOAT32_IEEE AXIS_PTS_X 1 FLOAT32_IEEE INDEX_INCR DIRECT /end RECORD_LAYOUT
/begin GROUP autosar_swc_rlgs_autosar_swc_rlgs_Step_sys_rlgs1_Subsystem6 "autosar_swc_rlgs/autosar_swc_rlgs_Step_sys/rlgs1/Subsystem6"
 /begin SUB_GROUP autosar_swc_rlgs_autosar_swc_rlgs_Step_sys_rlgs1_Subsystem6_LineUpdate autosar_swc_rlgs_autosar_swc_rlgs_Step_sys_rlgs1_Subsystem6_Subsystem autosar_swc_rlgs_autosar_swc_rlgs_Step_sys_rlgs1_Subsystem6_Subsystem1 autosar_swc_rlgs_autosar_swc_rlgs_Step_sys_rlgs1_Subsystem6_Subsystem2 autosar_swc_rlgs_autosar_swc_rlgs_Step_sys_rlgs1_Subsystem6_Subsystem3 autosar_swc_rlgs_autosar_swc_rlgs_Step_sys_rlgs1_Subsystem6_Subsystem4 autosar_swc_rlgs_autosar_swc_rlgs_Step_sys_rlgs1_Subsystem6_Subsystem5 autosar_swc_rlgs_autosar_swc_rlgs_Step_sys_rlgs1_Subsystem6_Subsystem6 autosar_swc_rlgs_autosar_swc_rlgs_Step_sys_rlgs1_Subsystem6_Subsystem7 /end SUB_GROUP
 /begin REF_CHARACTERISTIC P_PG_SignalDelayTimeComSw /end REF_CHARACTERISTIC
/end GROUP
/begin GROUP autosar_swc_rlgs_autosar_swc_rlgs_Step_sys_rlgs1_Subsystem6_LineUpdate "autosar_swc_rlgs/autosar_swc_rlgs_Step_sys/rlgs1/Subsystem6/LineUpdate"
 /begin SUB_GROUP autosar_swc_rlgs_autosar_swc_rlgs_Step_sys_rlgs1_Subsystem6_LineUpdate_Compare_To_Constant /end SUB_GROUP
 /begin REF_MEASUREMENT autosar_swc_rlgs_rtARID_DEF.UnitDelay68_DSTATE /end REF_MEASUREMENT
/end GROUP
/begin GROUP autosar_swc_rlgs_autosar_swc_rlgs_Step_sys_rlgs1_Subsystem6_Subsystem "autosar_swc_rlgs/autosar_swc_rlgs_Step_sys/rlgs1/Subsystem6/Subsystem"
 /begin SUB_GROUP autosar_swc_rlgs_autosar_swc_rlgs_Step_sys_rlgs1_Subsystem6_Subsystem_Subsystem2 /end SUB_GROUP
 /begin REF_CHARACTERISTIC P_PG_SignalDelayTimeMaxLimit P_PG_abandonVirtualLineSW /end REF_CHARACTERISTIC
 /begin REF_MEASUREMENT PSM_reserve07 PSM_reserve08 autosar_swc_rlgs_rtARID_DEF.A0K1_e autosar_swc_rlgs_rtARID_DEF.A1K1_k autosar_swc_rlgs_rtARID_DEF.A2K1_m autosar_swc_rlgs_rtARID_DEF.A3K1_p autosar_swc_rlgs_rtARID_DEF.LaneExtraFarPointPosX_k1_d autosar_swc_rlgs_rtARID_DEF.LaneExtraFarPointPosY_k1_d autosar_swc_rlgs_rtARID_DEF.LaneExtraFarPointType_k1_h autosar_swc_rlgs_rtARID_DEF.LaneExtraNearPointPosX_k1_e autosar_swc_rlgs_rtARID_DEF.LaneExtraNearPointPosY_k1_m autosar_swc_rlgs_rtARID_DEF.LaneExtraNearPointType_k1_p autosar_swc_rlgs_rtARID_DEF.LineConfK1_k autosar_swc_rlgs_rtARID_DEF.LineReliableK1_e autosar_swc_rlgs_rtARID_DEF.RangeK1_fc autosar_swc_rlgs_rtARID_DEF.StartK1_k autosar_swc_rlgs_rtARID_DEF.Stopline_Relevancy_k1_f autosar_swc_rlgs_rtARID_DEF.TrackIdk1_i autosar_swc_rlgs_rtARID_DEF.lineTypeK1_n autosar_swc_rlgs_rtARID_DEF.tLostK1_j /end REF_MEASUREMENT
/end GROUP
/begin GROUP autosar_swc_rlgs_autosar_swc_rlgs_Step_sys_rlgs1_Subsystem6_Subsystem1 "autosar_swc_rlgs/autosar_swc_rlgs_Step_sys/rlgs1/Subsystem6/Subsystem1"
 /begin SUB_GROUP autosar_swc_rlgs_autosar_swc_rlgs_Step_sys_rlgs1_Subsystem6_Subsystem1_Subsystem2 /end SUB_GROUP
 /begin REF_CHARACTERISTIC P_PG_SignalDelayTimeMaxLimit P_PG_abandonVirtualLineSW /end REF_CHARACTERISTIC
 /begin REF_MEASUREMENT PSM_HostLaneConePosition_X PSM_HostLaneConePosition_Y autosar_swc_rlgs_rtARID_DEF.A0K1_n autosar_swc_rlgs_rtARID_DEF.A1K1_l autosar_swc_rlgs_rtARID_DEF.A2K1_ff autosar_swc_rlgs_rtARID_DEF.A3K1_g autosar_swc_rlgs_rtARID_DEF.LaneExtraFarPointPosX_k1_b autosar_swc_rlgs_rtARID_DEF.LaneExtraFarPointPosY_k1_k autosar_swc_rlgs_rtARID_DEF.LaneExtraFarPointType_k1_l autosar_swc_rlgs_rtARID_DEF.LaneExtraNearPointPosX_k1_n autosar_swc_rlgs_rtARID_DEF.LaneExtraNearPointPosY_k1_o autosar_swc_rlgs_rtARID_DEF.LaneExtraNearPointType_k1_e autosar_swc_rlgs_rtARID_DEF.LineConfK1_n autosar_swc_rlgs_rtARID_DEF.LineReliableK1_o autosar_swc_rlgs_rtARID_DEF.RangeK1_f autosar_swc_rlgs_rtARID_DEF.StartK1_h autosar_swc_rlgs_rtARID_DEF.Stopline_Relevancy_k1_j autosar_swc_rlgs_rtARID_DEF.TrackIdk1_l autosar_swc_rlgs_rtARID_DEF.lineTypeK1_k autosar_swc_rlgs_rtARID_DEF.tLostK1_a /end REF_MEASUREMENT
/end GROUP
/begin GROUP autosar_swc_rlgs_autosar_swc_rlgs_Step_sys_rlgs1_Subsystem6_Subsystem1_Subsystem2 "autosar_swc_rlgs/autosar_swc_rlgs_Step_sys/rlgs1/Subsystem6/Subsystem1/Subsystem2" /begin REF_CHARACTERISTIC P_PSM_StepTime /end REF_CHARACTERISTIC /begin REF_MEASUREMENT autosar_swc_rlgs_rtARID_DEF.UnitDelay_DSTATE_l /end REF_MEASUREMENT /end GROUP
/begin GROUP autosar_swc_rlgs_autosar_swc_rlgs_Step_sys_rlgs1_Subsystem6_Subsystem2 "autosar_swc_rlgs/autosar_swc_rlgs_Step_sys/rlgs1/Subsystem6/Subsystem2" /begin REF_CHARACTERISTIC P_PG_SignalDelayTimeMaxLimit P_PG_abandonVirtualLineSW /end REF_CHARACTERISTIC
 /begin REF_MEASUREMENT autosar_swc_rlgs_rtARID_DEF.A0K1_k autosar_swc_rlgs_rtARID_DEF.A1K1_o autosar_swc_rlgs_rtARID_DEF.A2K1_p autosar_swc_rlgs_rtARID_DEF.A3K1_o3 autosar_swc_rlgs_rtARID_DEF.LaneExtraFarPointPosX_k1_p autosar_swc_rlgs_rtARID_DEF.LaneExtraFarPointPosY_k1_e autosar_swc_rlgs_rtARID_DEF.LaneExtraFarPointType_k1_i autosar_swc_rlgs_rtARID_DEF.LaneExtraNearPointPosX_k1_j autosar_swc_rlgs_rtARID_DEF.LaneExtraNearPointPosY_k1_a autosar_swc_rlgs_rtARID_DEF.LaneExtraNearPointType_k1_j autosar_swc_rlgs_rtARID_DEF.LineConfK1_f autosar_swc_rlgs_rtARID_DEF.LineReliableK1_p autosar_swc_rlgs_rtARID_DEF.RangeK1_i autosar_swc_rlgs_rtARID_DEF.StartK1_m autosar_swc_rlgs_rtARID_DEF.Stopline_Relevancy_k1_h autosar_swc_rlgs_rtARID_DEF.TrackIdk1_k autosar_swc_rlgs_rtARID_DEF.lineTypeK1_o autosar_swc_rlgs_rtARID_DEF.tLostK1_ir /end REF_MEASUREMENT
/end GROUP
/begin GROUP autosar_swc_rlgs_autosar_swc_rlgs_Step_sys_rlgs1_Subsystem6_Subsystem3 "autosar_swc_rlgs/autosar_swc_rlgs_Step_sys/rlgs1/Subsystem6/Subsystem3" /begin REF_CHARACTERISTIC P_PG_SignalDelayTimeMaxLimit P_PG_abandonVirtualLineSW /end REF_CHARACTERISTIC /end GROUP
/begin GROUP autosar_swc_rlgs_autosar_swc_rlgs_Step_sys_rlgs1_Subsystem6_Subsystem4 "autosar_swc_rlgs/autosar_swc_rlgs_Step_sys/rlgs1/Subsystem6/Subsystem4" /begin REF_CHARACTERISTIC P_PG_SignalDelayTimeMaxLimit P_PG_abandonVirtualLineSW /end REF_CHARACTERISTIC
 /begin REF_MEASUREMENT autosar_swc_rlgs_rtARID_DEF.A0K1_f autosar_swc_rlgs_rtARID_DEF.A1K1_n autosar_swc_rlgs_rtARID_DEF.A2K1_fh autosar_swc_rlgs_rtARID_DEF.A3K1_j autosar_swc_rlgs_rtARID_DEF.LaneExtraFarPointPosX_k1 autosar_swc_rlgs_rtARID_DEF.LaneExtraFarPointPosY_k1 autosar_swc_rlgs_rtARID_DEF.LaneExtraFarPointType_k1 autosar_swc_rlgs_rtARID_DEF.LaneExtraNearPointPosX_k1 autosar_swc_rlgs_rtARID_DEF.LaneExtraNearPointPosY_k1 autosar_swc_rlgs_rtARID_DEF.LaneExtraNearPointType_k1 autosar_swc_rlgs_rtARID_DEF.LineConfK1_l autosar_swc_rlgs_rtARID_DEF.LineReliableK1_k autosar_swc_rlgs_rtARID_DEF.RangeK1_hx autosar_swc_rlgs_rtARID_DEF.StartK1_g autosar_swc_rlgs_rtARID_DEF.Stopline_Relevancy_k1 autosar_swc_rlgs_rtARID_DEF.TrackIdk1_b autosar_swc_rlgs_rtARID_DEF.lineTypeK1_p autosar_swc_rlgs_rtARID_DEF.tLostK1_i /end REF_MEASUREMENT
/end GROUP
/begin GROUP autosar_swc_rlgs_autosar_swc_rlgs_Step_sys_rlgs1_Subsystem6_Subsystem5 "autosar_swc_rlgs/autosar_swc_rlgs_Step_sys/rlgs1/Subsystem6/Subsystem5" /begin REF_CHARACTERISTIC P_PG_SignalDelayTimeMaxLimit P_PG_abandonVirtualLineSW /end REF_CHARACTERISTIC /end GROUP
/begin GROUP autosar_swc_rlgs_autosar_swc_rlgs_Step_sys_rlgs1_Subsystem6_Subsystem6 "autosar_swc_rlgs/autosar_swc_rlgs_Step_sys/rlgs1/Subsystem6/Subsystem6" /begin REF_CHARACTERISTIC P_PG_SignalDelayTimeMaxLimit /end REF_CHARACTERISTIC
 /begin REF_MEASUREMENT autosar_swc_rlgs_rtARID_DEF.A0K1_g autosar_swc_rlgs_rtARID_DEF.A1K1_a autosar_swc_rlgs_rtARID_DEF.A2K1_f autosar_swc_rlgs_rtARID_DEF.A3K1_o autosar_swc_rlgs_rtARID_DEF.LineConfK1_i autosar_swc_rlgs_rtARID_DEF.LineReliableK1_a autosar_swc_rlgs_rtARID_DEF.RangeK1_h autosar_swc_rlgs_rtARID_DEF.StartK1_i autosar_swc_rlgs_rtARID_DEF.lineTypeK1_l autosar_swc_rlgs_rtARID_DEF.tLostK1_n /end REF_MEASUREMENT
/end GROUP
/begin GROUP autosar_swc_rlgs_autosar_swc_rlgs_Step_sys_rlgs1_Subsystem6_Subsystem7 "autosar_swc_rlgs/autosar_swc_rlgs_Step_sys/rlgs1/Subsystem6/Subsystem7" /begin REF_CHARACTERISTIC P_PG_SignalDelayTimeMaxLimit /end REF_CHARACTERISTIC
 /begin REF_MEASUREMENT autosar_swc_rlgs_rtARID_DEF.A0K1 autosar_swc_rlgs_rtARID_DEF.A1K1 autosar_swc_rlgs_rtARID_DEF.A2K1 autosar_swc_rlgs_rtARID_DEF.A3K1 autosar_swc_rlgs_rtARID_DEF.LineConfK1 autosar_swc_rlgs_rtARID_DEF.LineReliableK1 autosar_swc_rlgs_rtARID_DEF.RangeK1 autosar_swc_rlgs_rtARID_DEF.StartK1 autosar_swc_rlgs_rtARID_DEF.TrackIdk1 autosar_swc_rlgs_rtARID_DEF.lineTypeK1 autosar_swc_rlgs_rtARID_DEF.tLostK1 /end REF_MEASUREMENT
/end GROUP
/begin GROUP autosar_swc_rlgs_autosar_swc_rlgs_Step_sys_rlgs1_Subsystem6_Subsystem_Subsystem2 "autosar_swc_rlgs/autosar_swc_rlgs_Step_sys/rlgs1/Subsystem6/Subsystem/Subsystem2" /begin REF_CHARACTERISTIC P_PSM_StepTime /end REF_CHARACTERISTIC /begin REF_MEASUREMENT autosar_swc_rlgs_rtARID_DEF.UnitDelay_DSTATE_nu /end REF_MEASUREMENT /end GROUP
/begin GROUP autosar_swc_rlgs_autosar_swc_rlgs_Step_sys_rlgs1_alc1 "autosar_swc_rlgs/autosar_swc_rlgs_Step_sys/rlgs1/alc1"
 /begin SUB_GROUP autosar_swc_rlgs_autosar_swc_rlgs_Step_sys_rlgs1_alc1_ALC_LcDrvVoice autosar_swc_rlgs_autosar_swc_rlgs_Step_sys_rlgs1_alc1_NOADecision3 autosar_swc_rlgs_autosar_swc_rlgs_Step_sys_rlgs1_alc1_Subsystem autosar_swc_rlgs_autosar_swc_rlgs_Step_sys_rlgs1_alc1_alc_dfimAndSwtMapping autosar_swc_rlgs_autosar_swc_rlgs_Step_sys_rlgs1_alc1_alc_lcAvoidObstacle autosar_swc_rlgs_autosar_swc_rlgs_Step_sys_rlgs1_alc1_alc_lcDrv1 autosar_swc_rlgs_autosar_swc_rlgs_Step_sys_rlgs1_alc1_alc_lcOverTk autosar_swc_rlgs_autosar_swc_rlgs_Step_sys_rlgs1_alc1_alc_pathCalc autosar_swc_rlgs_autosar_swc_rlgs_Step_sys_rlgs1_alc1_alc_sm autosar_swc_rlgs_autosar_swc_rlgs_Step_sys_rlgs1_alc1_alc_unpack autosar_swc_rlgs_autosar_swc_rlgs_Step_sys_rlgs1_alc1_tsr /end SUB_GROUP
/end GROUP
/begin GROUP autosar_swc_rlgs_autosar_swc_rlgs_Step_sys_rlgs1_alc1_ALC_LcDrvVoice "autosar_swc_rlgs/autosar_swc_rlgs_Step_sys/rlgs1/alc1/ALC_LcDrvVoice"
 /begin SUB_GROUP autosar_swc_rlgs_autosar_swc_rlgs_Step_sys_rlgs1_alc1_ALC_LcDrvVoice_Compare_To_Constant1 autosar_swc_rlgs_autosar_swc_rlgs_Step_sys_rlgs1_alc1_ALC_LcDrvVoice_Compare_To_Constant5 /end SUB_GROUP
 /begin REF_MEASUREMENT autosar_swc_rlgs_rtARID_DEF.HoldCond1_f autosar_swc_rlgs_rtARID_DEF.HoldCond1_m autosar_swc_rlgs_rtARID_DEF.HoldCond2_f autosar_swc_rlgs_rtARID_DEF.HoldCond2_n autosar_swc_rlgs_rtARID_DEF.HoldCond3_n autosar_swc_rlgs_rtARID_DEF.HoldCond3_p autosar_swc_rlgs_rtARID_DEF.HoldCond4_e autosar_swc_rlgs_rtARID_DEF.HoldCond4_h /end REF_MEASUREMENT
/end GROUP
/begin GROUP autosar_swc_rlgs_autosar_swc_rlgs_Step_sys_rlgs1_alc1_ALC_LcDrvVoice_Compare_To_Constant1 "autosar_swc_rlgs/autosar_swc_rlgs_Step_sys/rlgs1/alc1/ALC_LcDrvVoice/Compare\nTo Constant1" /begin REF_CHARACTERISTIC P_PSM_IPVehSpdMinPreLC_Drv /end REF_CHARACTERISTIC /end GROUP
/begin GROUP autosar_swc_rlgs_autosar_swc_rlgs_Step_sys_rlgs1_alc1_ALC_LcDrvVoice_Compare_To_Constant5 "autosar_swc_rlgs/autosar_swc_rlgs_Step_sys/rlgs1/alc1/ALC_LcDrvVoice/Compare\nTo Constant5" /begin REF_CHARACTERISTIC P_PSM_IPVehSpdMaxPreLC_Drv /end REF_CHARACTERISTIC /end GROUP
/begin GROUP autosar_swc_rlgs_autosar_swc_rlgs_Step_sys_rlgs1_alc1_NOADecision3 "autosar_swc_rlgs/autosar_swc_rlgs_Step_sys/rlgs1/alc1/NOADecision3"
 /begin SUB_GROUP autosar_swc_rlgs_autosar_swc_rlgs_Step_sys_rlgs1_alc1_NOADecision3_CRUISE_NOH autosar_swc_rlgs_autosar_swc_rlgs_Step_sys_rlgs1_alc1_NOADecision3_CarLaneStatePreDeal1 autosar_swc_rlgs_autosar_swc_rlgs_Step_sys_rlgs1_alc1_NOADecision3_ExternalSignalReq autosar_swc_rlgs_autosar_swc_rlgs_Step_sys_rlgs1_alc1_NOADecision3_JudgeStub0StartPoint autosar_swc_rlgs_autosar_swc_rlgs_Step_sys_rlgs1_alc1_NOADecision3_LaneChangeReqFlagCal autosar_swc_rlgs_autosar_swc_rlgs_Step_sys_rlgs1_alc1_NOADecision3_LaneNumberInference autosar_swc_rlgs_autosar_swc_rlgs_Step_sys_rlgs1_alc1_NOADecision3_NOAExitByODDRemind autosar_swc_rlgs_autosar_swc_rlgs_Step_sys_rlgs1_alc1_NOADecision3_RoadClassCal autosar_swc_rlgs_autosar_swc_rlgs_Step_sys_rlgs1_alc1_NOADecision3_Subsystem1 autosar_swc_rlgs_autosar_swc_rlgs_Step_sys_rlgs1_alc1_NOADecision3_Subsystem2 autosar_swc_rlgs_autosar_swc_rlgs_Step_sys_rlgs1_alc1_NOADecision3_Subsystem4 autosar_swc_rlgs_autosar_swc_rlgs_Step_sys_rlgs1_alc1_NOADecision3_np_roadElecFence /end SUB_GROUP
/end GROUP
/begin GROUP autosar_swc_rlgs_autosar_swc_rlgs_Step_sys_rlgs1_alc1_NOADecision3_CRUISE_NOH "autosar_swc_rlgs/autosar_swc_rlgs_Step_sys/rlgs1/alc1/NOADecision3/CRUISE_NOH"
 /begin REF_CHARACTERISTIC P_ALC_CityExpresswayActiveEnable P_ALC_NOAActiveDistance P_PSM_HighWayNOAExitByTollDis P_PSM_NOAActv2TollBoothDis P_PSM_RampNOAExitByTollDis P_PSM_SplitStubIsTollDisValue /end REF_CHARACTERISTIC
 /begin REF_MEASUREMENT PSM_NOAExitFlagByToll2 autosar_swc_rlgs_rtARID_DEF.RoadClassTemp autosar_swc_rlgs_rtARID_DEF.UnitDelay1_DSTATE_f autosar_swc_rlgs_rtARID_DEF.UnitDelay_DSTATE_gk autosar_swc_rlgs_rtARID_DEF.counter /end REF_MEASUREMENT
/end GROUP
/begin GROUP autosar_swc_rlgs_autosar_swc_rlgs_Step_sys_rlgs1_alc1_NOADecision3_CarLaneStatePreDeal1 "autosar_swc_rlgs/autosar_swc_rlgs_Step_sys/rlgs1/alc1/NOADecision3/CarLaneStatePreDeal1"
 /begin SUB_GROUP autosar_swc_rlgs_autosar_swc_rlgs_Step_sys_rlgs1_alc1_NOADecision3_CarLaneStatePreDeal1_LaneChangeDetect1 /end SUB_GROUP
/end GROUP
/begin GROUP autosar_swc_rlgs_autosar_swc_rlgs_Step_sys_rlgs1_alc1_NOADecision3_CarLaneStatePreDeal1_LaneChangeDetect1 "autosar_swc_rlgs/autosar_swc_rlgs_Step_sys/rlgs1/alc1/NOADecision3/CarLaneStatePreDeal1/LaneChangeDetect1"
 /begin REF_CHARACTERISTIC P_PSM_ChangeAfC0Value P_PSM_ChangeBfC0Value P_PSM_RoadEgeStartDis /end REF_CHARACTERISTIC
 /begin REF_MEASUREMENT PSM_LaneChangeTrg PSM_LeftLaneChgFlag PSM_RightLaneChgFlag PSM_VehInAdjacentLeftmostLane_Flag PSM_VehInAdjacentRightmostLane_Flag PSM_VehInLeftmostLane_Flag PSM_VehInPathFlag PSM_VehInRightmostLane_Flag autosar_swc_rlgs_rtARID_DEF.LaneChangeTime autosar_swc_rlgs_rtARID_DEF.UnitDelay1_DSTATE_k autosar_swc_rlgs_rtARID_DEF.UnitDelay2_DSTATE_e autosar_swc_rlgs_rtARID_DEF.UnitDelay3_DSTATE_pv autosar_swc_rlgs_rtARID_DEF.UnitDelay4_DSTATE_c autosar_swc_rlgs_rtARID_DEF.UnitDelay5_DSTATE_nx autosar_swc_rlgs_rtARID_DEF.UnitDelay7_DSTATE_b autosar_swc_rlgs_rtARID_DEF.UnitDelay8_DSTATE_c autosar_swc_rlgs_rtARID_DEF.UnitDelay_DSTATE_k autosar_swc_rlgs_rtARID_DEF.mostLeftLane_FlagK1 autosar_swc_rlgs_rtARID_DEF.mostLeftLane_adjacent_FlagK1 autosar_swc_rlgs_rtARID_DEF.mostRightLaneFlagk1 autosar_swc_rlgs_rtARID_DEF.mostRightLane_adjacent_FlagK1 /end REF_MEASUREMENT
/end GROUP
/begin GROUP autosar_swc_rlgs_autosar_swc_rlgs_Step_sys_rlgs1_alc1_NOADecision3_ExternalSignalReq "autosar_swc_rlgs/autosar_swc_rlgs_Step_sys/rlgs1/alc1/NOADecision3/ExternalSignalReq"
 /begin REF_CHARACTERISTIC P_PSM_DyAllowSplitDy P_PSM_DyThresthold P_PSM_ExitLineHoldTime P_PSM_NotMatchDyThresthold /end REF_CHARACTERISTIC
 /begin REF_MEASUREMENT PSM_AllowSplitLineFlag PSM_ExitLineFlag PSM_ExitLineMatchCurLineFlag PSM_ExitLineNotMatchCurLineFlag PSM_MatchCalControlLineDy autosar_swc_rlgs_rtARID_DEF.ExitHoldTime autosar_swc_rlgs_rtARID_DEF.RampStsK1_i /end REF_MEASUREMENT
/end GROUP
/begin GROUP autosar_swc_rlgs_autosar_swc_rlgs_Step_sys_rlgs1_alc1_NOADecision3_JudgeStub0StartPoint "autosar_swc_rlgs/autosar_swc_rlgs_Step_sys/rlgs1/alc1/NOADecision3/JudgeStub0StartPoint"
 /begin SUB_GROUP autosar_swc_rlgs_autosar_swc_rlgs_Step_sys_rlgs1_alc1_NOADecision3_JudgeStub0StartPoint_RampStsJudge /end SUB_GROUP
 /begin REF_MEASUREMENT PSM_YBranchPointDisOut autosar_swc_rlgs_rtARID_DEF.UnitDelay2_DSTATE_od autosar_swc_rlgs_rtARID_DEF.UnitDelay3_DSTATE_mq /end REF_MEASUREMENT
/end GROUP
/begin GROUP autosar_swc_rlgs_autosar_swc_rlgs_Step_sys_rlgs1_alc1_NOADecision3_JudgeStub0StartPoint_RampStsJudge "autosar_swc_rlgs/autosar_swc_rlgs_Step_sys/rlgs1/alc1/NOADecision3/JudgeStub0StartPoint/RampStsJudge"
 /begin REF_CHARACTERISTIC P_PSM_ExitLineCalEnd P_PSM_ExitLineCalStart P_PSM_R2RBYBranchThreshold P_PSM_R2RRCurrentError P_PSM_R2RRYBranchThreshold1 P_PSM_R2RRYBranchThreshold2 P_PSM_SlopeKapThresValue P_PSM_StepTime /end REF_CHARACTERISTIC
 /begin REF_MEASUREMENT PSM_KapL1 PSM_KapR1 PSM_KapRB PSM_LaneLeftSlopeFlag PSM_YBranchSts autosar_swc_rlgs_rtARID_DEF.IniBranchDis autosar_swc_rlgs_rtARID_DEF.R1_TrackID_k1 autosar_swc_rlgs_rtARID_DEF.RampStsK1 autosar_swc_rlgs_rtARID_DEF.Rout_bIsLineExist_k1 autosar_swc_rlgs_rtARID_DEF.TrackR1Time autosar_swc_rlgs_rtARID_DEF.UnitDelay2_DSTATE_dd autosar_swc_rlgs_rtARID_DEF.t_R1_i autosar_swc_rlgs_rtARID_DEF.t_RB_e /end REF_MEASUREMENT
/end GROUP
/begin GROUP autosar_swc_rlgs_autosar_swc_rlgs_Step_sys_rlgs1_alc1_NOADecision3_LaneChangeReqFlagCal "autosar_swc_rlgs/autosar_swc_rlgs_Step_sys/rlgs1/alc1/NOADecision3/LaneChangeReqFlagCal"
 /begin SUB_GROUP autosar_swc_rlgs_autosar_swc_rlgs_Step_sys_rlgs1_alc1_NOADecision3_LaneChangeReqFlagCal_AfterLeftMergeOrNOAActFirLeftLaneChg autosar_swc_rlgs_autosar_swc_rlgs_Step_sys_rlgs1_alc1_NOADecision3_LaneChangeReqFlagCal_Compare_To_Constant2 autosar_swc_rlgs_autosar_swc_rlgs_Step_sys_rlgs1_alc1_NOADecision3_LaneChangeReqFlagCal_Compare_To_Constant6 autosar_swc_rlgs_autosar_swc_rlgs_Step_sys_rlgs1_alc1_NOADecision3_LaneChangeReqFlagCal_Subsystem2 autosar_swc_rlgs_autosar_swc_rlgs_Step_sys_rlgs1_alc1_NOADecision3_LaneChangeReqFlagCal_Subsystem3 autosar_swc_rlgs_autosar_swc_rlgs_Step_sys_rlgs1_alc1_NOADecision3_LaneChangeReqFlagCal_Subsystem4 autosar_swc_rlgs_autosar_swc_rlgs_Step_sys_rlgs1_alc1_NOADecision3_LaneChangeReqFlagCal_Subsystem5 autosar_swc_rlgs_autosar_swc_rlgs_Step_sys_rlgs1_alc1_NOADecision3_LaneChangeReqFlagCal_Subsystem6 autosar_swc_rlgs_autosar_swc_rlgs_Step_sys_rlgs1_alc1_NOADecision3_LaneChangeReqFlagCal_Subsystem7 autosar_swc_rlgs_autosar_swc_rlgs_Step_sys_rlgs1_alc1_NOADecision3_LaneChangeReqFlagCal_Subsystem8 /end SUB_GROUP
 /begin REF_CHARACTERISTIC P_PSM_AllowMoveDirStsSW P_PSM_KeepNotChangeTime P_PSM_MergeLeftChangeTestSW P_PSM_NOA_ForceLaneChangeTime P_PSM_RightSplitStubDis P_PSM_StepTime P_PSM_splitAtStubDis /end REF_CHARACTERISTIC
 /begin REF_MEASUREMENT PSM_IsVehInLeNavLaneFlag PSM_IsVehInRiLaneFlag PSM_IsVehInRiNavLaneFlag PSM_KeepNotChangeTimeOut PSM_LeftTurnReq PSM_NOANAVLeftChgSts PSM_NOANAVRiChgSts PSM_RiTurnReq PSM_mostLeftLane_FlagConfig autosar_swc_rlgs_rtARID_DEF.ForceLaneChgTime autosar_swc_rlgs_rtARID_DEF.ForceLeftChgTime_e autosar_swc_rlgs_rtARID_DEF.ForceRiChgTime autosar_swc_rlgs_rtARID_DEF.IsRiSplitStubExistFlagK1 autosar_swc_rlgs_rtARID_DEF.NOA_Methods autosar_swc_rlgs_rtARID_DEF.Rsts_K1 autosar_swc_rlgs_rtARID_DEF.VehMoveFordDis /end REF_MEASUREMENT
/end GROUP
/begin GROUP autosar_swc_rlgs_autosar_swc_rlgs_Step_sys_rlgs1_alc1_NOADecision3_LaneChangeReqFlagCal_AfterLeftMergeOrNOAActFirLeftLaneChg "autosar_swc_rlgs/autosar_swc_rlgs_Step_sys/rlgs1/alc1/NOADecision3/LaneChangeReqFlagCal/AfterLeftMergeOrNOAActFirLeftLaneChg"
 /begin REF_CHARACTERISTIC P_PSM_AfterLeftMergeLeftChgSw P_PSM_FirstActNOACntTimeValue P_PSM_LeftLcAfterMergeWaitTime P_PSM_StepTime /end REF_CHARACTERISTIC
 /begin REF_MEASUREMENT PSM_AfterLeftMergeLeftChgFlag PSM_AfterLeftMergeLeftChgSts PSM_NOAFirstTrigerLeftChgFlag PSM_NOAFirstTrigerLeftChgSts autosar_swc_rlgs_rtARID_DEF.CntTime autosar_swc_rlgs_rtARID_DEF.CntTime4Confirm autosar_swc_rlgs_rtARID_DEF.CntTime_f autosar_swc_rlgs_rtARID_DEF.UnitDelay1_DSTATE_c autosar_swc_rlgs_rtARID_DEF.is_active_c1270_autosar_swc_rlgs autosar_swc_rlgs_rtARID_DEF.is_active_c1271_autosar_swc_rlgs autosar_swc_rlgs_rtARID_DEF.is_c1270_autosar_swc_rlgs autosar_swc_rlgs_rtARID_DEF.is_c1271_autosar_swc_rlgs /end REF_MEASUREMENT
/end GROUP
/begin GROUP autosar_swc_rlgs_autosar_swc_rlgs_Step_sys_rlgs1_alc1_NOADecision3_LaneChangeReqFlagCal_Compare_To_Constant2 "autosar_swc_rlgs/autosar_swc_rlgs_Step_sys/rlgs1/alc1/NOADecision3/LaneChangeReqFlagCal/Compare\nTo Constant2" /begin REF_MEASUREMENT PSM_mostLeftLane_FlagConfig /end REF_MEASUREMENT /end GROUP
/begin GROUP autosar_swc_rlgs_autosar_swc_rlgs_Step_sys_rlgs1_alc1_NOADecision3_LaneChangeReqFlagCal_Compare_To_Constant6 "autosar_swc_rlgs/autosar_swc_rlgs_Step_sys/rlgs1/alc1/NOADecision3/LaneChangeReqFlagCal/Compare\nTo Constant6" /begin REF_CHARACTERISTIC P_PSM_R1LineTypeNotRampTime /end REF_CHARACTERISTIC /end GROUP
/begin GROUP autosar_swc_rlgs_autosar_swc_rlgs_Step_sys_rlgs1_alc1_NOADecision3_LaneChangeReqFlagCal_Subsystem2 "autosar_swc_rlgs/autosar_swc_rlgs_Step_sys/rlgs1/alc1/NOADecision3/LaneChangeReqFlagCal/Subsystem2" /begin REF_CHARACTERISTIC P_PSM_StepTime /end REF_CHARACTERISTIC /begin REF_MEASUREMENT autosar_swc_rlgs_rtARID_DEF.UnitDelay_DSTATE_jg /end REF_MEASUREMENT /end GROUP
/begin GROUP autosar_swc_rlgs_autosar_swc_rlgs_Step_sys_rlgs1_alc1_NOADecision3_LaneChangeReqFlagCal_Subsystem3 "autosar_swc_rlgs/autosar_swc_rlgs_Step_sys/rlgs1/alc1/NOADecision3/LaneChangeReqFlagCal/Subsystem3" /begin REF_CHARACTERISTIC P_PSM_StepTime /end REF_CHARACTERISTIC /begin REF_MEASUREMENT autosar_swc_rlgs_rtARID_DEF.UnitDelay_DSTATE_gc /end REF_MEASUREMENT /end GROUP
/begin GROUP autosar_swc_rlgs_autosar_swc_rlgs_Step_sys_rlgs1_alc1_NOADecision3_LaneChangeReqFlagCal_Subsystem4 "autosar_swc_rlgs/autosar_swc_rlgs_Step_sys/rlgs1/alc1/NOADecision3/LaneChangeReqFlagCal/Subsystem4" /begin REF_CHARACTERISTIC P_PSM_StepTime /end REF_CHARACTERISTIC /begin REF_MEASUREMENT autosar_swc_rlgs_rtARID_DEF.UnitDelay_DSTATE_h /end REF_MEASUREMENT /end GROUP
/begin GROUP autosar_swc_rlgs_autosar_swc_rlgs_Step_sys_rlgs1_alc1_NOADecision3_LaneChangeReqFlagCal_Subsystem5 "autosar_swc_rlgs/autosar_swc_rlgs_Step_sys/rlgs1/alc1/NOADecision3/LaneChangeReqFlagCal/Subsystem5" /begin REF_CHARACTERISTIC P_PSM_StepTime /end REF_CHARACTERISTIC /begin REF_MEASUREMENT autosar_swc_rlgs_rtARID_DEF.UnitDelay_DSTATE_ht /end REF_MEASUREMENT /end GROUP
/begin GROUP autosar_swc_rlgs_autosar_swc_rlgs_Step_sys_rlgs1_alc1_NOADecision3_LaneChangeReqFlagCal_Subsystem6 "autosar_swc_rlgs/autosar_swc_rlgs_Step_sys/rlgs1/alc1/NOADecision3/LaneChangeReqFlagCal/Subsystem6" /begin REF_CHARACTERISTIC P_PSM_StepTime /end REF_CHARACTERISTIC /begin REF_MEASUREMENT autosar_swc_rlgs_rtARID_DEF.UnitDelay_DSTATE_kf /end REF_MEASUREMENT /end GROUP
/begin GROUP autosar_swc_rlgs_autosar_swc_rlgs_Step_sys_rlgs1_alc1_NOADecision3_LaneChangeReqFlagCal_Subsystem7 "autosar_swc_rlgs/autosar_swc_rlgs_Step_sys/rlgs1/alc1/NOADecision3/LaneChangeReqFlagCal/Subsystem7" /begin REF_CHARACTERISTIC P_PSM_StepTime /end REF_CHARACTERISTIC /begin REF_MEASUREMENT autosar_swc_rlgs_rtARID_DEF.UnitDelay_DSTATE_ly /end REF_MEASUREMENT /end GROUP
/begin GROUP autosar_swc_rlgs_autosar_swc_rlgs_Step_sys_rlgs1_alc1_NOADecision3_LaneChangeReqFlagCal_Subsystem8 "autosar_swc_rlgs/autosar_swc_rlgs_Step_sys/rlgs1/alc1/NOADecision3/LaneChangeReqFlagCal/Subsystem8" /begin REF_CHARACTERISTIC P_PSM_StepTime /end REF_CHARACTERISTIC /begin REF_MEASUREMENT autosar_swc_rlgs_rtARID_DEF.UnitDelay_DSTATE_a /end REF_MEASUREMENT /end GROUP
/begin GROUP autosar_swc_rlgs_autosar_swc_rlgs_Step_sys_rlgs1_alc1_NOADecision3_LaneNumberInference "autosar_swc_rlgs/autosar_swc_rlgs_Step_sys/rlgs1/alc1/NOADecision3/LaneNumberInference" /begin REF_MEASUREMENT PSM_NOA_LaneNumber /end REF_MEASUREMENT /end GROUP
/begin GROUP autosar_swc_rlgs_autosar_swc_rlgs_Step_sys_rlgs1_alc1_NOADecision3_NOAExitByODDRemind "autosar_swc_rlgs/autosar_swc_rlgs_Step_sys/rlgs1/alc1/NOADecision3/NOAExitByODDRemind"
 /begin REF_CHARACTERISTIC P_PSM_NOAExitRemindTime P_PSM_RemindStageOfFirst P_PSM_RemindStageOfSecond P_PSM_SplitStubIsTollDisValue P_PSM_StepTime /end REF_CHARACTERISTIC
 /begin REF_MEASUREMENT PSM_NOAExitRemindByToll autosar_swc_rlgs_rtARID_DEF.NOAExitRemindByToll autosar_swc_rlgs_rtARID_DEF.NOAExitRemindByTollCntTime autosar_swc_rlgs_rtARID_DEF.UnitDelay1_DSTATE_bq autosar_swc_rlgs_rtARID_DEF.UnitDelay_DSTATE_ew /end REF_MEASUREMENT
/end GROUP
/begin GROUP autosar_swc_rlgs_autosar_swc_rlgs_Step_sys_rlgs1_alc1_NOADecision3_RoadClassCal "autosar_swc_rlgs/autosar_swc_rlgs_Step_sys/rlgs1/alc1/NOADecision3/RoadClassCal"
 /begin SUB_GROUP autosar_swc_rlgs_autosar_swc_rlgs_Step_sys_rlgs1_alc1_NOADecision3_RoadClassCal_RiClassCal /end SUB_GROUP
/end GROUP
/begin GROUP autosar_swc_rlgs_autosar_swc_rlgs_Step_sys_rlgs1_alc1_NOADecision3_RoadClassCal_RiClassCal "autosar_swc_rlgs/autosar_swc_rlgs_Step_sys/rlgs1/alc1/NOADecision3/RoadClassCal/RiClassCal"
 /begin SUB_GROUP autosar_swc_rlgs_autosar_swc_rlgs_Step_sys_rlgs1_alc1_NOADecision3_RoadClassCal_RiClassCal_Subsystem1 /end SUB_GROUP
 /begin REF_CHARACTERISTIC P_PSM_AllowRightChangeStsSw P_PSM_DistanceThreshold P_PSM_R2RBYBranchThreshold P_PSM_R2RRCurrentError P_PSM_R2RRYBranchThreshold1 P_PSM_R2RRYBranchThreshold2 P_PSM_RiRoadClassSW /end REF_CHARACTERISTIC
 /begin REF_MEASUREMENT PSM_RiClassYBranchSts PSM_RiRoadClass_Narrow PSM_RiRoadClass_New PSM_RiRoadClass_Out autosar_swc_rlgs_rtARID_DEF.Distance autosar_swc_rlgs_rtARID_DEF.R1LineTypeK1 autosar_swc_rlgs_rtARID_DEF.R1ShadeTime autosar_swc_rlgs_rtARID_DEF.R1SolidLineConfirmTime autosar_swc_rlgs_rtARID_DEF.RiLineTypeChgConfirmTime autosar_swc_rlgs_rtARID_DEF.RiRoadClass autosar_swc_rlgs_rtARID_DEF.YBranchTime autosar_swc_rlgs_rtARID_DEF.t_R1 autosar_swc_rlgs_rtARID_DEF.t_RB /end REF_MEASUREMENT
/end GROUP
/begin GROUP autosar_swc_rlgs_autosar_swc_rlgs_Step_sys_rlgs1_alc1_NOADecision3_RoadClassCal_RiClassCal_Subsystem1 "autosar_swc_rlgs/autosar_swc_rlgs_Step_sys/rlgs1/alc1/NOADecision3/RoadClassCal/RiClassCal/Subsystem1" /begin REF_MEASUREMENT autosar_swc_rlgs_rtARID_DEF.UnitDelay_DSTATE_kv /end REF_MEASUREMENT /end GROUP
/begin GROUP autosar_swc_rlgs_autosar_swc_rlgs_Step_sys_rlgs1_alc1_NOADecision3_Subsystem1 "autosar_swc_rlgs/autosar_swc_rlgs_Step_sys/rlgs1/alc1/NOADecision3/Subsystem1"
 /begin REF_MEASUREMENT autosar_swc_rlgs_rtARID_DEF.NaroFlag_k1 autosar_swc_rlgs_rtARID_DEF.ParallelTime autosar_swc_rlgs_rtARID_DEF.is_Merge autosar_swc_rlgs_rtARID_DEF.is_Split autosar_swc_rlgs_rtARID_DEF.is_active_c1280_autosar_swc_rlgs autosar_swc_rlgs_rtARID_DEF.is_c1280_autosar_swc_rlgs autosar_swc_rlgs_rtARID_DEF.t /end REF_MEASUREMENT
/end GROUP
/begin GROUP autosar_swc_rlgs_autosar_swc_rlgs_Step_sys_rlgs1_alc1_NOADecision3_Subsystem2 "autosar_swc_rlgs/autosar_swc_rlgs_Step_sys/rlgs1/alc1/NOADecision3/Subsystem2" /begin REF_CHARACTERISTIC P_PSM_Dis2StubThreshold /end REF_CHARACTERISTIC /begin REF_MEASUREMENT autosar_swc_rlgs_rtARID_DEF.NOA_Methods /end REF_MEASUREMENT /end GROUP
/begin GROUP autosar_swc_rlgs_autosar_swc_rlgs_Step_sys_rlgs1_alc1_NOADecision3_Subsystem4 "autosar_swc_rlgs/autosar_swc_rlgs_Step_sys/rlgs1/alc1/NOADecision3/Subsystem4"
 /begin REF_MEASUREMENT autosar_swc_rlgs_rtARID_DEF.UnitDelay1_DSTATE_ad autosar_swc_rlgs_rtARID_DEF.UnitDelay2_DSTATE_g autosar_swc_rlgs_rtARID_DEF.UnitDelay3_DSTATE_d autosar_swc_rlgs_rtARID_DEF.UnitDelay4_DSTATE_p autosar_swc_rlgs_rtARID_DEF.UnitDelay_DSTATE_n1 /end REF_MEASUREMENT
/end GROUP
/begin GROUP autosar_swc_rlgs_autosar_swc_rlgs_Step_sys_rlgs1_alc1_NOADecision3_np_roadElecFence "autosar_swc_rlgs/autosar_swc_rlgs_Step_sys/rlgs1/alc1/NOADecision3/np_roadElecFence"
 /begin SUB_GROUP autosar_swc_rlgs_autosar_swc_rlgs_Step_sys_rlgs1_alc1_NOADecision3_np_roadElecFence_ElecFenceSignalCal autosar_swc_rlgs_autosar_swc_rlgs_Step_sys_rlgs1_alc1_NOADecision3_np_roadElecFence_ScenarioClassCal autosar_swc_rlgs_autosar_swc_rlgs_Step_sys_rlgs1_alc1_NOADecision3_np_roadElecFence_Subsystem /end SUB_GROUP
 /begin REF_CHARACTERISTIC P_PSM_Distance2MergeStubMinValue P_PSM_DistanceLimitValue P_PSM_RightSplitKeepSW /end REF_CHARACTERISTIC
 /begin REF_MEASUREMENT PSM_HighWay_LeftMerge PSM_Ramp_LeftMerge PSM_ScenarioClass PSM_ScenarioSubType PSM_ScenarioType PSM_SuggDrvDirection autosar_swc_rlgs_rtARID_DEF.DistanceLimit autosar_swc_rlgs_rtARID_DEF.InhibitHighWayLeftMergeBySplit autosar_swc_rlgs_rtARID_DEF.LogicalOperator10 autosar_swc_rlgs_rtARID_DEF.LogicalOperator10_b autosar_swc_rlgs_rtARID_DEF.LogicalOperator15 autosar_swc_rlgs_rtARID_DEF.LogicalOperator19 autosar_swc_rlgs_rtARID_DEF.LogicalOperator2 autosar_swc_rlgs_rtARID_DEF.LogicalOperator6 autosar_swc_rlgs_rtARID_DEF.LogicalOperator7_e autosar_swc_rlgs_rtARID_DEF.LogicalOperator7_h autosar_swc_rlgs_rtARID_DEF.NOA_Methods autosar_swc_rlgs_rtARID_DEF.NextStubIsRiSplitInhibitLeftMergeFlag autosar_swc_rlgs_rtARID_DEF.ScenarioClass autosar_swc_rlgs_rtARID_DEF.ScenarioSubType autosar_swc_rlgs_rtARID_DEF.ScenarioType autosar_swc_rlgs_rtARID_DEF.SignalCopy2 autosar_swc_rlgs_rtARID_DEF.SplitDircCorrectFlag autosar_swc_rlgs_rtARID_DEF.SuggDrvDirection autosar_swc_rlgs_rtARID_DEF.UnitDelay1_DSTATE_m autosar_swc_rlgs_rtARID_DEF.UnitDelay4_DSTATE_bd autosar_swc_rlgs_rtARID_DEF.UnitDelay5_DSTATE_gi autosar_swc_rlgs_rtARID_DEF.UnitDelay_DSTATE_df autosar_swc_rlgs_rtARID_DEF.Urban_RightStraight autosar_swc_rlgs_rtARID_DEF.is_ElecFenceJudge autosar_swc_rlgs_rtARID_DEF.is_HighWayMode autosar_swc_rlgs_rtARID_DEF.is_HighWay_LeftEntry autosar_swc_rlgs_rtARID_DEF.is_HighWay_RightSplit autosar_swc_rlgs_rtARID_DEF.is_RampMode autosar_swc_rlgs_rtARID_DEF.is_Ramp_LeftEntry autosar_swc_rlgs_rtARID_DEF.is_Ramp_LeftStraightAndReChoose autosar_swc_rlgs_rtARID_DEF.is_Ramp_RightSplit autosar_swc_rlgs_rtARID_DEF.is_Urban autosar_swc_rlgs_rtARID_DEF.is_active_c1287_autosar_swc_rlgs autosar_swc_rlgs_rtARID_DEF.is_c1287_autosar_swc_rlgs /end REF_MEASUREMENT
/end GROUP
/begin GROUP autosar_swc_rlgs_autosar_swc_rlgs_Step_sys_rlgs1_alc1_NOADecision3_np_roadElecFence_ElecFenceSignalCal "autosar_swc_rlgs/autosar_swc_rlgs_Step_sys/rlgs1/alc1/NOADecision3/np_roadElecFence/ElecFenceSignalCal"
 /begin SUB_GROUP autosar_swc_rlgs_autosar_swc_rlgs_Step_sys_rlgs1_alc1_NOADecision3_np_roadElecFence_ElecFenceSignalCal_HighWayCruise autosar_swc_rlgs_autosar_swc_rlgs_Step_sys_rlgs1_alc1_NOADecision3_np_roadElecFence_ElecFenceSignalCal_HighWayRiSplitOrLeftMerge autosar_swc_rlgs_autosar_swc_rlgs_Step_sys_rlgs1_alc1_NOADecision3_np_roadElecFence_ElecFenceSignalCal_HighWayRightSplit autosar_swc_rlgs_autosar_swc_rlgs_Step_sys_rlgs1_alc1_NOADecision3_np_roadElecFence_ElecFenceSignalCal_InhibitLeftMergerBySplitJudge autosar_swc_rlgs_autosar_swc_rlgs_Step_sys_rlgs1_alc1_NOADecision3_np_roadElecFence_ElecFenceSignalCal_LeftMerge autosar_swc_rlgs_autosar_swc_rlgs_Step_sys_rlgs1_alc1_NOADecision3_np_roadElecFence_ElecFenceSignalCal_LeftMergeStubExistMemoryFlag autosar_swc_rlgs_autosar_swc_rlgs_Step_sys_rlgs1_alc1_NOADecision3_np_roadElecFence_ElecFenceSignalCal_LineDirCorrect autosar_swc_rlgs_autosar_swc_rlgs_Step_sys_rlgs1_alc1_NOADecision3_np_roadElecFence_ElecFenceSignalCal_NextStubJudge autosar_swc_rlgs_autosar_swc_rlgs_Step_sys_rlgs1_alc1_NOADecision3_np_roadElecFence_ElecFenceSignalCal_RampMode autosar_swc_rlgs_autosar_swc_rlgs_Step_sys_rlgs1_alc1_NOADecision3_np_roadElecFence_ElecFenceSignalCal_UrbanMode /end SUB_GROUP
 /begin REF_CHARACTERISTIC P_PSM_Dis2StubThreshold P_PSM_SplitStubIsTollDisValue /end REF_CHARACTERISTIC
 /begin REF_MEASUREMENT PSM_IsLeftMergeStubExistFlag PSM_IsLeftSplitSubExistFlag PSM_IsRiMergeStubExistFlag PSM_IsRiSplitStubExistFlag PSM_NOAExitFlagByToll autosar_swc_rlgs_rtARID_DEF.NOA_Methods autosar_swc_rlgs_rtARID_DEF.is_active_c1288_autosar_swc_rlgs autosar_swc_rlgs_rtARID_DEF.is_c1288_autosar_swc_rlgs /end REF_MEASUREMENT
/end GROUP
/begin GROUP autosar_swc_rlgs_autosar_swc_rlgs_Step_sys_rlgs1_alc1_NOADecision3_np_roadElecFence_ElecFenceSignalCal_HighWayCruise "autosar_swc_rlgs/autosar_swc_rlgs_Step_sys/rlgs1/alc1/NOADecision3/np_roadElecFence/ElecFenceSignalCal/HighWayCruise"
 /begin SUB_GROUP autosar_swc_rlgs_autosar_swc_rlgs_Step_sys_rlgs1_alc1_NOADecision3_np_roadElecFence_ElecFenceSignalCal_HighWayCruise_Compare_To_Constant3 autosar_swc_rlgs_autosar_swc_rlgs_Step_sys_rlgs1_alc1_NOADecision3_np_roadElecFence_ElecFenceSignalCal_HighWayCruise_Compare_To_Constant4 /end SUB_GROUP
 /begin REF_MEASUREMENT PSM_HighWay_Cruise PSM_HighWay_LeftStraight /end REF_MEASUREMENT
/end GROUP
/begin GROUP autosar_swc_rlgs_autosar_swc_rlgs_Step_sys_rlgs1_alc1_NOADecision3_np_roadElecFence_ElecFenceSignalCal_HighWayCruise_Compare_To_Constant3 "autosar_swc_rlgs/autosar_swc_rlgs_Step_sys/rlgs1/alc1/NOADecision3/np_roadElecFence/ElecFenceSignalCal/HighWayCruise/Compare\nTo Constant3" /begin REF_CHARACTERISTIC P_PSM_Dis2StubThreshold /end REF_CHARACTERISTIC /end GROUP
/begin GROUP autosar_swc_rlgs_autosar_swc_rlgs_Step_sys_rlgs1_alc1_NOADecision3_np_roadElecFence_ElecFenceSignalCal_HighWayCruise_Compare_To_Constant4 "autosar_swc_rlgs/autosar_swc_rlgs_Step_sys/rlgs1/alc1/NOADecision3/np_roadElecFence/ElecFenceSignalCal/HighWayCruise/Compare\nTo Constant4" /begin REF_CHARACTERISTIC P_PSM_NOA_LeftMergeDisThresValue /end REF_CHARACTERISTIC /end GROUP
/begin GROUP autosar_swc_rlgs_autosar_swc_rlgs_Step_sys_rlgs1_alc1_NOADecision3_np_roadElecFence_ElecFenceSignalCal_HighWayRiSplitOrLeftMerge "autosar_swc_rlgs/autosar_swc_rlgs_Step_sys/rlgs1/alc1/NOADecision3/np_roadElecFence/ElecFenceSignalCal/HighWayRiSplitOrLeftMerge"
 /begin SUB_GROUP autosar_swc_rlgs_autosar_swc_rlgs_Step_sys_rlgs1_alc1_NOADecision3_np_roadElecFence_ElecFenceSignalCal_HighWayRiSplitOrLeftMerge_Compare_To_Constant2 autosar_swc_rlgs_autosar_swc_rlgs_Step_sys_rlgs1_alc1_NOADecision3_np_roadElecFence_ElecFenceSignalCal_HighWayRiSplitOrLeftMerge_Subsystem1 autosar_swc_rlgs_autosar_swc_rlgs_Step_sys_rlgs1_alc1_NOADecision3_np_roadElecFence_ElecFenceSignalCal_HighWayRiSplitOrLeftMerge_Subsystem2 autosar_swc_rlgs_autosar_swc_rlgs_Step_sys_rlgs1_alc1_NOADecision3_np_roadElecFence_ElecFenceSignalCal_HighWayRiSplitOrLeftMerge_Subsystem3 /end SUB_GROUP
 /begin REF_CHARACTERISTIC P_PSM_RoadClass1HighWaySW /end REF_CHARACTERISTIC
 /begin REF_MEASUREMENT PSM_HighWay_LeftMerge PSM_HighWay_LeftMergeFinish PSM_HighWay_LeftMerge_InStub PSM_HighWay_RightSplit PSM_HighWay_RightSplit_BfStub PSM_HighWay_RightSplit_InStub autosar_swc_rlgs_rtARID_DEF.LogicalOperator10 autosar_swc_rlgs_rtARID_DEF.LogicalOperator19 autosar_swc_rlgs_rtARID_DEF.ScenarioClass autosar_swc_rlgs_rtARID_DEF.UnitDelay_DSTATE_cb autosar_swc_rlgs_rtARID_DEF.is_active_c1289_autosar_swc_rlgs autosar_swc_rlgs_rtARID_DEF.is_c1289_autosar_swc_rlgs /end REF_MEASUREMENT
/end GROUP
/begin GROUP autosar_swc_rlgs_autosar_swc_rlgs_Step_sys_rlgs1_alc1_NOADecision3_np_roadElecFence_ElecFenceSignalCal_HighWayRiSplitOrLeftMerge_Compare_To_Constant2 "autosar_swc_rlgs/autosar_swc_rlgs_Step_sys/rlgs1/alc1/NOADecision3/np_roadElecFence/ElecFenceSignalCal/HighWayRiSplitOrLeftMerge/Compare\nTo Constant2" /begin REF_MEASUREMENT autosar_swc_rlgs_rtARID_DEF.ScenarioClass /end REF_MEASUREMENT /end GROUP
/begin GROUP autosar_swc_rlgs_autosar_swc_rlgs_Step_sys_rlgs1_alc1_NOADecision3_np_roadElecFence_ElecFenceSignalCal_HighWayRiSplitOrLeftMerge_Subsystem1 "autosar_swc_rlgs/autosar_swc_rlgs_Step_sys/rlgs1/alc1/NOADecision3/np_roadElecFence/ElecFenceSignalCal/HighWayRiSplitOrLeftMerge/Subsystem1" /begin REF_CHARACTERISTIC P_PSM_StepTime /end REF_CHARACTERISTIC /begin REF_MEASUREMENT autosar_swc_rlgs_rtARID_DEF.UnitDelay_DSTATE_p /end REF_MEASUREMENT /end GROUP
/begin GROUP autosar_swc_rlgs_autosar_swc_rlgs_Step_sys_rlgs1_alc1_NOADecision3_np_roadElecFence_ElecFenceSignalCal_HighWayRiSplitOrLeftMerge_Subsystem2 "autosar_swc_rlgs/autosar_swc_rlgs_Step_sys/rlgs1/alc1/NOADecision3/np_roadElecFence/ElecFenceSignalCal/HighWayRiSplitOrLeftMerge/Subsystem2" /begin REF_CHARACTERISTIC P_PSM_StepTime /end REF_CHARACTERISTIC /begin REF_MEASUREMENT autosar_swc_rlgs_rtARID_DEF.UnitDelay_DSTATE_jt /end REF_MEASUREMENT /end GROUP
/begin GROUP autosar_swc_rlgs_autosar_swc_rlgs_Step_sys_rlgs1_alc1_NOADecision3_np_roadElecFence_ElecFenceSignalCal_HighWayRiSplitOrLeftMerge_Subsystem3 "autosar_swc_rlgs/autosar_swc_rlgs_Step_sys/rlgs1/alc1/NOADecision3/np_roadElecFence/ElecFenceSignalCal/HighWayRiSplitOrLeftMerge/Subsystem3" /begin REF_CHARACTERISTIC P_PSM_StepTime /end REF_CHARACTERISTIC /begin REF_MEASUREMENT autosar_swc_rlgs_rtARID_DEF.UnitDelay_DSTATE_jy /end REF_MEASUREMENT /end GROUP
/begin GROUP autosar_swc_rlgs_autosar_swc_rlgs_Step_sys_rlgs1_alc1_NOADecision3_np_roadElecFence_ElecFenceSignalCal_HighWayRightSplit "autosar_swc_rlgs/autosar_swc_rlgs_Step_sys/rlgs1/alc1/NOADecision3/np_roadElecFence/ElecFenceSignalCal/HighWayRightSplit"
 /begin SUB_GROUP autosar_swc_rlgs_autosar_swc_rlgs_Step_sys_rlgs1_alc1_NOADecision3_np_roadElecFence_ElecFenceSignalCal_HighWayRightSplit_RampStsJudge /end SUB_GROUP
/end GROUP
/begin GROUP autosar_swc_rlgs_autosar_swc_rlgs_Step_sys_rlgs1_alc1_NOADecision3_np_roadElecFence_ElecFenceSignalCal_HighWayRightSplit_RampStsJudge "autosar_swc_rlgs/autosar_swc_rlgs_Step_sys/rlgs1/alc1/NOADecision3/np_roadElecFence/ElecFenceSignalCal/HighWayRightSplit/RampStsJudge"
 /begin SUB_GROUP autosar_swc_rlgs_autosar_swc_rlgs_Step_sys_rlgs1_alc1_NOADecision3_np_roadElecFence_ElecFenceSignalCal_HighWayRightSplit_RampStsJudge_Compare_To_Constant1 autosar_swc_rlgs_autosar_swc_rlgs_Step_sys_rlgs1_alc1_NOADecision3_np_roadElecFence_ElecFenceSignalCal_HighWayRightSplit_RampStsJudge_Compare_To_Constant4 autosar_swc_rlgs_autosar_swc_rlgs_Step_sys_rlgs1_alc1_NOADecision3_np_roadElecFence_ElecFenceSignalCal_HighWayRightSplit_RampStsJudge_Compare_To_Constant5 autosar_swc_rlgs_autosar_swc_rlgs_Step_sys_rlgs1_alc1_NOADecision3_np_roadElecFence_ElecFenceSignalCal_HighWayRightSplit_RampStsJudge_SplitMergeStubFlag /end SUB_GROUP
 /begin REF_MEASUREMENT PSM_RampSts PSM_RightSplit PSM_RightSplit_BfStub PSM_RightSplit_InStub autosar_swc_rlgs_rtARID_DEF.RampSts /end REF_MEASUREMENT
/end GROUP
/begin GROUP autosar_swc_rlgs_autosar_swc_rlgs_Step_sys_rlgs1_alc1_NOADecision3_np_roadElecFence_ElecFenceSignalCal_HighWayRightSplit_RampStsJudge_Compare_To_Constant1 "autosar_swc_rlgs/autosar_swc_rlgs_Step_sys/rlgs1/alc1/NOADecision3/np_roadElecFence/ElecFenceSignalCal/HighWayRightSplit/RampStsJudge/Compare\nTo Constant1" /begin REF_MEASUREMENT autosar_swc_rlgs_rtARID_DEF.RampSts /end REF_MEASUREMENT /end GROUP
/begin GROUP autosar_swc_rlgs_autosar_swc_rlgs_Step_sys_rlgs1_alc1_NOADecision3_np_roadElecFence_ElecFenceSignalCal_HighWayRightSplit_RampStsJudge_Compare_To_Constant4 "autosar_swc_rlgs/autosar_swc_rlgs_Step_sys/rlgs1/alc1/NOADecision3/np_roadElecFence/ElecFenceSignalCal/HighWayRightSplit/RampStsJudge/Compare\nTo Constant4" /begin REF_CHARACTERISTIC P_PSM_LeftMergeExitInRiSplitDis /end REF_CHARACTERISTIC /end GROUP
/begin GROUP autosar_swc_rlgs_autosar_swc_rlgs_Step_sys_rlgs1_alc1_NOADecision3_np_roadElecFence_ElecFenceSignalCal_HighWayRightSplit_RampStsJudge_Compare_To_Constant5 "autosar_swc_rlgs/autosar_swc_rlgs_Step_sys/rlgs1/alc1/NOADecision3/np_roadElecFence/ElecFenceSignalCal/HighWayRightSplit/RampStsJudge/Compare\nTo Constant5" /begin REF_MEASUREMENT autosar_swc_rlgs_rtARID_DEF.RampSts /end REF_MEASUREMENT /end GROUP
/begin GROUP autosar_swc_rlgs_autosar_swc_rlgs_Step_sys_rlgs1_alc1_NOADecision3_np_roadElecFence_ElecFenceSignalCal_HighWayRightSplit_RampStsJudge_SplitMergeStubFlag "autosar_swc_rlgs/autosar_swc_rlgs_Step_sys/rlgs1/alc1/NOADecision3/np_roadElecFence/ElecFenceSignalCal/HighWayRightSplit/RampStsJudge/SplitMergeStubFlag"
 /begin SUB_GROUP autosar_swc_rlgs_autosar_swc_rlgs_Step_sys_rlgs1_alc1_NOADecision3_np_roadElecFence_ElecFenceSignalCal_HighWayRightSplit_RampStsJudge_SplitMergeStubFlag_Compare_To_Constant autosar_swc_rlgs_autosar_swc_rlgs_Step_sys_rlgs1_alc1_NOADecision3_np_roadElecFence_ElecFenceSignalCal_HighWayRightSplit_RampStsJudge_SplitMergeStubFlag_Compare_To_Constant11 autosar_swc_rlgs_autosar_swc_rlgs_Step_sys_rlgs1_alc1_NOADecision3_np_roadElecFence_ElecFenceSignalCal_HighWayRightSplit_RampStsJudge_SplitMergeStubFlag_RampExit autosar_swc_rlgs_autosar_swc_rlgs_Step_sys_rlgs1_alc1_NOADecision3_np_roadElecFence_ElecFenceSignalCal_HighWayRightSplit_RampStsJudge_SplitMergeStubFlag_Subsystem3 /end SUB_GROUP
 /begin REF_CHARACTERISTIC P_PSM_VehLocationWithStubSW /end REF_CHARACTERISTIC
 /begin REF_MEASUREMENT autosar_swc_rlgs_rtARID_DEF.RampSts autosar_swc_rlgs_rtARID_DEF.is_active_c1291_autosar_swc_rlgs autosar_swc_rlgs_rtARID_DEF.is_c1291_autosar_swc_rlgs /end REF_MEASUREMENT
/end GROUP
/begin GROUP autosar_swc_rlgs_autosar_swc_rlgs_Step_sys_rlgs1_alc1_NOADecision3_np_roadElecFence_ElecFenceSignalCal_HighWayRightSplit_RampStsJudge_SplitMergeStubFlag_Compare_To_Constant11 "autosar_swc_rlgs/autosar_swc_rlgs_Step_sys/rlgs1/alc1/NOADecision3/np_roadElecFence/ElecFenceSignalCal/HighWayRightSplit/RampStsJudge/SplitMergeStubFlag/Compare\nTo Constant11" /begin REF_CHARACTERISTIC P_PSM_SplitStage_C0dist_m /end REF_CHARACTERISTIC /end GROUP
/begin GROUP autosar_swc_rlgs_autosar_swc_rlgs_Step_sys_rlgs1_alc1_NOADecision3_np_roadElecFence_ElecFenceSignalCal_HighWayRightSplit_RampStsJudge_SplitMergeStubFlag_RampExit "autosar_swc_rlgs/autosar_swc_rlgs_Step_sys/rlgs1/alc1/NOADecision3/np_roadElecFence/ElecFenceSignalCal/HighWayRightSplit/RampStsJudge/SplitMergeStubFlag/RampExit"
 /begin SUB_GROUP autosar_swc_rlgs_autosar_swc_rlgs_Step_sys_rlgs1_alc1_NOADecision3_np_roadElecFence_ElecFenceSignalCal_HighWayRightSplit_RampStsJudge_SplitMergeStubFlag_RampExit_Compare_To_Constant3 autosar_swc_rlgs_autosar_swc_rlgs_Step_sys_rlgs1_alc1_NOADecision3_np_roadElecFence_ElecFenceSignalCal_HighWayRightSplit_RampStsJudge_SplitMergeStubFlag_RampExit_Subsystem1 /end SUB_GROUP
 /begin REF_MEASUREMENT autosar_swc_rlgs_rtARID_DEF.UnitDelay1_DSTATE_d /end REF_MEASUREMENT
/end GROUP
/begin GROUP autosar_swc_rlgs_autosar_swc_rlgs_Step_sys_rlgs1_alc1_NOADecision3_np_roadElecFence_ElecFenceSignalCal_HighWayRightSplit_RampStsJudge_SplitMergeStubFlag_RampExit_Compare_To_Constant3 "autosar_swc_rlgs/autosar_swc_rlgs_Step_sys/rlgs1/alc1/NOADecision3/np_roadElecFence/ElecFenceSignalCal/HighWayRightSplit/RampStsJudge/SplitMergeStubFlag/RampExit/Compare\nTo Constant3" /begin REF_CHARACTERISTIC P_PSM_DisNotChangeTime /end REF_CHARACTERISTIC /end GROUP
/begin GROUP autosar_swc_rlgs_autosar_swc_rlgs_Step_sys_rlgs1_alc1_NOADecision3_np_roadElecFence_ElecFenceSignalCal_HighWayRightSplit_RampStsJudge_SplitMergeStubFlag_RampExit_Subsystem1 "autosar_swc_rlgs/autosar_swc_rlgs_Step_sys/rlgs1/alc1/NOADecision3/np_roadElecFence/ElecFenceSignalCal/HighWayRightSplit/RampStsJudge/SplitMergeStubFlag/RampExit/Subsystem1" /begin REF_CHARACTERISTIC P_PSM_StepTime /end REF_CHARACTERISTIC /begin REF_MEASUREMENT autosar_swc_rlgs_rtARID_DEF.UnitDelay_DSTATE_f /end REF_MEASUREMENT /end GROUP
/begin GROUP autosar_swc_rlgs_autosar_swc_rlgs_Step_sys_rlgs1_alc1_NOADecision3_np_roadElecFence_ElecFenceSignalCal_HighWayRightSplit_RampStsJudge_SplitMergeStubFlag_Subsystem3 "autosar_swc_rlgs/autosar_swc_rlgs_Step_sys/rlgs1/alc1/NOADecision3/np_roadElecFence/ElecFenceSignalCal/HighWayRightSplit/RampStsJudge/SplitMergeStubFlag/Subsystem3" /begin REF_CHARACTERISTIC P_PSM_StepTime /end REF_CHARACTERISTIC /begin REF_MEASUREMENT autosar_swc_rlgs_rtARID_DEF.UnitDelay_DSTATE_ie /end REF_MEASUREMENT /end GROUP
/begin GROUP autosar_swc_rlgs_autosar_swc_rlgs_Step_sys_rlgs1_alc1_NOADecision3_np_roadElecFence_ElecFenceSignalCal_InhibitLeftMergerBySplitJudge "autosar_swc_rlgs/autosar_swc_rlgs_Step_sys/rlgs1/alc1/NOADecision3/np_roadElecFence/ElecFenceSignalCal/InhibitLeftMergerBySplitJudge" /begin REF_CHARACTERISTIC P_PSM_ShadeMergeStubDisByNextStub /end REF_CHARACTERISTIC
 /begin REF_MEASUREMENT autosar_swc_rlgs_rtARID_DEF.InhibitHighWayLeftMergeBySplit autosar_swc_rlgs_rtARID_DEF.IsLeftMergeStubExistFlag_temp /end REF_MEASUREMENT
/end GROUP
/begin GROUP autosar_swc_rlgs_autosar_swc_rlgs_Step_sys_rlgs1_alc1_NOADecision3_np_roadElecFence_ElecFenceSignalCal_LeftMerge "autosar_swc_rlgs/autosar_swc_rlgs_Step_sys/rlgs1/alc1/NOADecision3/np_roadElecFence/ElecFenceSignalCal/LeftMerge"
 /begin SUB_GROUP autosar_swc_rlgs_autosar_swc_rlgs_Step_sys_rlgs1_alc1_NOADecision3_np_roadElecFence_ElecFenceSignalCal_LeftMerge_Subsystem4 /end SUB_GROUP
 /begin REF_CHARACTERISTIC P_PSM_NOA_LB2LeftLineNotMergeLatDis P_PSM_NOA_LBChgDisValue P_PSM_NOA_LeftMergeDisThresValue P_PSM_NOA_LeftMergeWaitTime P_PSM_NOA_Veh2LBDisThresValue P_PSM_NOA_tollDisThresValue P_PSM_StepTime /end REF_CHARACTERISTIC
 /begin REF_MEASUREMENT PSM_ForceLeftChgTimeOut PSM_L1ShadeInhiChgTimeOut PSM_L2ShadeInhiChgTimeOut PSM_LBShadeInhiChgTimeOut PSM_LeftMergeFinishFlag PSM_LeftMergeFlag PSM_NOAExitFlagByToll autosar_swc_rlgs_rtARID_DEF.ForceLeftChgTime autosar_swc_rlgs_rtARID_DEF.IsLeftMergeStubExistFlagK1_o autosar_swc_rlgs_rtARID_DEF.IsLeftMergeStubExistFlagMemoryFlag_n autosar_swc_rlgs_rtARID_DEF.L1LineTypeK1 autosar_swc_rlgs_rtARID_DEF.L1MergeLineTypeConfirmTime autosar_swc_rlgs_rtARID_DEF.L1ShadeChgTime autosar_swc_rlgs_rtARID_DEF.L2LineTypeK1 autosar_swc_rlgs_rtARID_DEF.L2MergeLineTypeConfirmTime autosar_swc_rlgs_rtARID_DEF.L2ShadeChgTime autosar_swc_rlgs_rtARID_DEF.LBLostTime autosar_swc_rlgs_rtARID_DEF.LB_LoseKeepTime autosar_swc_rlgs_rtARID_DEF.LB_bIsLineExist_K1 autosar_swc_rlgs_rtARID_DEF.LB_dC0V_K1 autosar_swc_rlgs_rtARID_DEF.LeftLaneChgTrgCnt autosar_swc_rlgs_rtARID_DEF.LeftLaneChgTrg_k1 autosar_swc_rlgs_rtARID_DEF.LeftMergeInhiTime autosar_swc_rlgs_rtARID_DEF.LeftMergeKeepTimeByFormWay autosar_swc_rlgs_rtARID_DEF.LeftMergeMemoryTime_p autosar_swc_rlgs_rtARID_DEF.LeftMergeTimeClearConfirmTime autosar_swc_rlgs_rtARID_DEF.ScenarioClass autosar_swc_rlgs_rtARID_DEF.ScenarioSubType_K1 autosar_swc_rlgs_rtARID_DEF.ScenarioType_K1 autosar_swc_rlgs_rtARID_DEF.UnitDelay2_DSTATE_o autosar_swc_rlgs_rtARID_DEF.UnitDelay_DSTATE_oj autosar_swc_rlgs_rtARID_DEF.i_form_of_way_k1 /end REF_MEASUREMENT
/end GROUP
/begin GROUP autosar_swc_rlgs_autosar_swc_rlgs_Step_sys_rlgs1_alc1_NOADecision3_np_roadElecFence_ElecFenceSignalCal_LeftMergeStubExistMemoryFlag "autosar_swc_rlgs/autosar_swc_rlgs_Step_sys/rlgs1/alc1/NOADecision3/np_roadElecFence/ElecFenceSignalCal/LeftMergeStubExistMemoryFlag" /begin REF_CHARACTERISTIC P_PSM_NOA_LeftMergeDisThresValue P_PSM_StepTime /end REF_CHARACTERISTIC
 /begin REF_MEASUREMENT autosar_swc_rlgs_rtARID_DEF.IsLeftMergeStubExistFlagK1 autosar_swc_rlgs_rtARID_DEF.IsLeftMergeStubExistFlagMemoryFlag autosar_swc_rlgs_rtARID_DEF.LeftMergeMemoryTime /end REF_MEASUREMENT
/end GROUP
/begin GROUP autosar_swc_rlgs_autosar_swc_rlgs_Step_sys_rlgs1_alc1_NOADecision3_np_roadElecFence_ElecFenceSignalCal_LeftMerge_Subsystem4 "autosar_swc_rlgs/autosar_swc_rlgs_Step_sys/rlgs1/alc1/NOADecision3/np_roadElecFence/ElecFenceSignalCal/LeftMerge/Subsystem4" /begin REF_CHARACTERISTIC P_PSM_StepTime /end REF_CHARACTERISTIC /begin REF_MEASUREMENT autosar_swc_rlgs_rtARID_DEF.UnitDelay_DSTATE_iw /end REF_MEASUREMENT /end GROUP
/begin GROUP autosar_swc_rlgs_autosar_swc_rlgs_Step_sys_rlgs1_alc1_NOADecision3_np_roadElecFence_ElecFenceSignalCal_LineDirCorrect "autosar_swc_rlgs/autosar_swc_rlgs_Step_sys/rlgs1/alc1/NOADecision3/np_roadElecFence/ElecFenceSignalCal/LineDirCorrect"
 /begin REF_CHARACTERISTIC P_PSM_FrontRoadWidthErr P_PSM_MostRightTimeThreshold P_PSM_StubDisThreshold /end REF_CHARACTERISTIC
 /begin REF_MEASUREMENT autosar_swc_rlgs_rtARID_DEF.DistK1 autosar_swc_rlgs_rtARID_DEF.SplitDircCorrectFlag autosar_swc_rlgs_rtARID_DEF.mostrightTime /end REF_MEASUREMENT
/end GROUP
/begin GROUP autosar_swc_rlgs_autosar_swc_rlgs_Step_sys_rlgs1_alc1_NOADecision3_np_roadElecFence_ElecFenceSignalCal_NextStubJudge "autosar_swc_rlgs/autosar_swc_rlgs_Step_sys/rlgs1/alc1/NOADecision3/np_roadElecFence/ElecFenceSignalCal/NextStubJudge" /begin REF_CHARACTERISTIC P_PSM_NextStubRiSplitDisThresvalue /end REF_CHARACTERISTIC
 /begin REF_MEASUREMENT PSM_NextStubIsRiSplitInhibitLeftMergeFlag autosar_swc_rlgs_rtARID_DEF.NextStubIsRiSplitInhibitLeftMergeDistance autosar_swc_rlgs_rtARID_DEF.NextStubIsRiSplitInhibitLeftMergeFlag /end REF_MEASUREMENT
/end GROUP
/begin GROUP autosar_swc_rlgs_autosar_swc_rlgs_Step_sys_rlgs1_alc1_NOADecision3_np_roadElecFence_ElecFenceSignalCal_RampMode "autosar_swc_rlgs/autosar_swc_rlgs_Step_sys/rlgs1/alc1/NOADecision3/np_roadElecFence/ElecFenceSignalCal/RampMode"
 /begin SUB_GROUP autosar_swc_rlgs_autosar_swc_rlgs_Step_sys_rlgs1_alc1_NOADecision3_np_roadElecFence_ElecFenceSignalCal_RampMode_Compare_To_Constant12 autosar_swc_rlgs_autosar_swc_rlgs_Step_sys_rlgs1_alc1_NOADecision3_np_roadElecFence_ElecFenceSignalCal_RampMode_Compare_To_Constant5 autosar_swc_rlgs_autosar_swc_rlgs_Step_sys_rlgs1_alc1_NOADecision3_np_roadElecFence_ElecFenceSignalCal_RampMode_Compare_To_Constant9 /end SUB_GROUP
 /begin REF_MEASUREMENT PSM_Ramp_Cruise PSM_Ramp_LeftMerge PSM_Ramp_LeftMerge_Finish PSM_Ramp_LeftMerge_InStub PSM_Ramp_LeftStraight PSM_Ramp_RightSplit PSM_Ramp_RightSplit_BfStub PSM_Ramp_RightSplit_InStub autosar_swc_rlgs_rtARID_DEF.LogicalOperator10_b autosar_swc_rlgs_rtARID_DEF.LogicalOperator15 autosar_swc_rlgs_rtARID_DEF.LogicalOperator2 autosar_swc_rlgs_rtARID_DEF.LogicalOperator6 autosar_swc_rlgs_rtARID_DEF.LogicalOperator7_h autosar_swc_rlgs_rtARID_DEF.SignalCopy2 /end REF_MEASUREMENT
/end GROUP
/begin GROUP autosar_swc_rlgs_autosar_swc_rlgs_Step_sys_rlgs1_alc1_NOADecision3_np_roadElecFence_ElecFenceSignalCal_RampMode_Compare_To_Constant12 "autosar_swc_rlgs/autosar_swc_rlgs_Step_sys/rlgs1/alc1/NOADecision3/np_roadElecFence/ElecFenceSignalCal/RampMode/Compare\nTo Constant12" /begin REF_MEASUREMENT autosar_swc_rlgs_rtARID_DEF.ScenarioClass /end REF_MEASUREMENT /end GROUP
/begin GROUP autosar_swc_rlgs_autosar_swc_rlgs_Step_sys_rlgs1_alc1_NOADecision3_np_roadElecFence_ElecFenceSignalCal_RampMode_Compare_To_Constant5 "autosar_swc_rlgs/autosar_swc_rlgs_Step_sys/rlgs1/alc1/NOADecision3/np_roadElecFence/ElecFenceSignalCal/RampMode/Compare\nTo Constant5" /begin REF_MEASUREMENT autosar_swc_rlgs_rtARID_DEF.ScenarioClass /end REF_MEASUREMENT /end GROUP
/begin GROUP autosar_swc_rlgs_autosar_swc_rlgs_Step_sys_rlgs1_alc1_NOADecision3_np_roadElecFence_ElecFenceSignalCal_RampMode_Compare_To_Constant9 "autosar_swc_rlgs/autosar_swc_rlgs_Step_sys/rlgs1/alc1/NOADecision3/np_roadElecFence/ElecFenceSignalCal/RampMode/Compare\nTo Constant9" /begin REF_CHARACTERISTIC P_PSM_NOA_LeftMergeDisThresValue /end REF_CHARACTERISTIC /end GROUP
/begin GROUP autosar_swc_rlgs_autosar_swc_rlgs_Step_sys_rlgs1_alc1_NOADecision3_np_roadElecFence_ElecFenceSignalCal_UrbanMode "autosar_swc_rlgs/autosar_swc_rlgs_Step_sys/rlgs1/alc1/NOADecision3/np_roadElecFence/ElecFenceSignalCal/UrbanMode"
 /begin SUB_GROUP autosar_swc_rlgs_autosar_swc_rlgs_Step_sys_rlgs1_alc1_NOADecision3_np_roadElecFence_ElecFenceSignalCal_UrbanMode_Compare_To_Constant11 autosar_swc_rlgs_autosar_swc_rlgs_Step_sys_rlgs1_alc1_NOADecision3_np_roadElecFence_ElecFenceSignalCal_UrbanMode_Compare_To_Constant5 autosar_swc_rlgs_autosar_swc_rlgs_Step_sys_rlgs1_alc1_NOADecision3_np_roadElecFence_ElecFenceSignalCal_UrbanMode_Compare_To_Constant9 /end SUB_GROUP
 /begin REF_MEASUREMENT autosar_swc_rlgs_rtARID_DEF.LogicalOperator7_e autosar_swc_rlgs_rtARID_DEF.Urban_RightStraight /end REF_MEASUREMENT
/end GROUP
/begin GROUP autosar_swc_rlgs_autosar_swc_rlgs_Step_sys_rlgs1_alc1_NOADecision3_np_roadElecFence_ElecFenceSignalCal_UrbanMode_Compare_To_Constant11 "autosar_swc_rlgs/autosar_swc_rlgs_Step_sys/rlgs1/alc1/NOADecision3/np_roadElecFence/ElecFenceSignalCal/UrbanMode/Compare\nTo Constant11" /begin REF_CHARACTERISTIC P_PSM_UrbanStudEndDisThresValue /end REF_CHARACTERISTIC /end GROUP
/begin GROUP autosar_swc_rlgs_autosar_swc_rlgs_Step_sys_rlgs1_alc1_NOADecision3_np_roadElecFence_ElecFenceSignalCal_UrbanMode_Compare_To_Constant5 "autosar_swc_rlgs/autosar_swc_rlgs_Step_sys/rlgs1/alc1/NOADecision3/np_roadElecFence/ElecFenceSignalCal/UrbanMode/Compare\nTo Constant5" /begin REF_CHARACTERISTIC P_PSM_UrbanStudEndDisThresValue /end REF_CHARACTERISTIC /end GROUP
/begin GROUP autosar_swc_rlgs_autosar_swc_rlgs_Step_sys_rlgs1_alc1_NOADecision3_np_roadElecFence_ElecFenceSignalCal_UrbanMode_Compare_To_Constant9 "autosar_swc_rlgs/autosar_swc_rlgs_Step_sys/rlgs1/alc1/NOADecision3/np_roadElecFence/ElecFenceSignalCal/UrbanMode/Compare\nTo Constant9" /begin REF_CHARACTERISTIC P_PSM_UrbanStudEndDisThresValue /end REF_CHARACTERISTIC /end GROUP
/begin GROUP autosar_swc_rlgs_autosar_swc_rlgs_Step_sys_rlgs1_alc1_NOADecision3_np_roadElecFence_ScenarioClassCal "autosar_swc_rlgs/autosar_swc_rlgs_Step_sys/rlgs1/alc1/NOADecision3/np_roadElecFence/ScenarioClassCal" /begin REF_MEASUREMENT autosar_swc_rlgs_rtARID_DEF.ScenarioClass /end REF_MEASUREMENT /end GROUP
/begin GROUP autosar_swc_rlgs_autosar_swc_rlgs_Step_sys_rlgs1_alc1_NOADecision3_np_roadElecFence_Subsystem "autosar_swc_rlgs/autosar_swc_rlgs_Step_sys/rlgs1/alc1/NOADecision3/np_roadElecFence/Subsystem"
 /begin REF_MEASUREMENT autosar_swc_rlgs_rtARID_DEF.RampSts_temp autosar_swc_rlgs_rtARID_DEF.UnitDelay_DSTATE_e2 /end REF_MEASUREMENT
/end GROUP
/begin GROUP autosar_swc_rlgs_autosar_swc_rlgs_Step_sys_rlgs1_alc1_Subsystem "autosar_swc_rlgs/autosar_swc_rlgs_Step_sys/rlgs1/alc1/Subsystem"
 /begin SUB_GROUP autosar_swc_rlgs_autosar_swc_rlgs_Step_sys_rlgs1_alc1_Subsystem_ValidStsJudge /end SUB_GROUP
/end GROUP
/begin GROUP autosar_swc_rlgs_autosar_swc_rlgs_Step_sys_rlgs1_alc1_Subsystem_ValidStsJudge "autosar_swc_rlgs/autosar_swc_rlgs_Step_sys/rlgs1/alc1/Subsystem/ValidStsJudge"
 /begin SUB_GROUP autosar_swc_rlgs_autosar_swc_rlgs_Step_sys_rlgs1_alc1_Subsystem_ValidStsJudge_Compare_To_Constant1 autosar_swc_rlgs_autosar_swc_rlgs_Step_sys_rlgs1_alc1_Subsystem_ValidStsJudge_Compare_To_Constant3 autosar_swc_rlgs_autosar_swc_rlgs_Step_sys_rlgs1_alc1_Subsystem_ValidStsJudge_Counter autosar_swc_rlgs_autosar_swc_rlgs_Step_sys_rlgs1_alc1_Subsystem_ValidStsJudge_Counter1 /end SUB_GROUP
 /begin REF_CHARACTERISTIC P_ALC_MapValidSw /end REF_CHARACTERISTIC
 /begin REF_MEASUREMENT PSM_FilterMapValid PSM_FilterNavValid autosar_swc_rlgs_rtARID_DEF.UnitDelay1_DSTATE_b autosar_swc_rlgs_rtARID_DEF.UnitDelay_DSTATE_lg /end REF_MEASUREMENT
/end GROUP
/begin GROUP autosar_swc_rlgs_autosar_swc_rlgs_Step_sys_rlgs1_alc1_Subsystem_ValidStsJudge_Compare_To_Constant1 "autosar_swc_rlgs/autosar_swc_rlgs_Step_sys/rlgs1/alc1/Subsystem/ValidStsJudge/Compare\nTo Constant1" /begin REF_CHARACTERISTIC P_PSM_MapNavValidCounter /end REF_CHARACTERISTIC /end GROUP
/begin GROUP autosar_swc_rlgs_autosar_swc_rlgs_Step_sys_rlgs1_alc1_Subsystem_ValidStsJudge_Compare_To_Constant3 "autosar_swc_rlgs/autosar_swc_rlgs_Step_sys/rlgs1/alc1/Subsystem/ValidStsJudge/Compare\nTo Constant3" /begin REF_CHARACTERISTIC P_PSM_MapNavValidCounter /end REF_CHARACTERISTIC /end GROUP
/begin GROUP autosar_swc_rlgs_autosar_swc_rlgs_Step_sys_rlgs1_alc1_Subsystem_ValidStsJudge_Counter "autosar_swc_rlgs/autosar_swc_rlgs_Step_sys/rlgs1/alc1/Subsystem/ValidStsJudge/Counter" /begin REF_MEASUREMENT autosar_swc_rlgs_rtARID_DEF.UnitDelay_DSTATE_hr /end REF_MEASUREMENT /end GROUP
/begin GROUP autosar_swc_rlgs_autosar_swc_rlgs_Step_sys_rlgs1_alc1_Subsystem_ValidStsJudge_Counter1 "autosar_swc_rlgs/autosar_swc_rlgs_Step_sys/rlgs1/alc1/Subsystem/ValidStsJudge/Counter1" /begin REF_MEASUREMENT autosar_swc_rlgs_rtARID_DEF.UnitDelay_DSTATE_om /end REF_MEASUREMENT /end GROUP
/begin GROUP autosar_swc_rlgs_autosar_swc_rlgs_Step_sys_rlgs1_alc1_alc_dfimAndSwtMapping "autosar_swc_rlgs/autosar_swc_rlgs_Step_sys/rlgs1/alc1/alc_dfimAndSwtMapping"
 /begin REF_CHARACTERISTIC P_ALC_VirtualSwtDia P_ALC_Virtual_ALC_Error P_ALC_Virtual_ALC_SwtReq P_ALC_Virtual_DCLCSet P_ALC_Virtual_HWA_Error P_ALC_Virtual_HWA_SnvtySet P_ALC_Virtual_VehConfigHWA /end REF_CHARACTERISTIC
/end GROUP
/begin GROUP autosar_swc_rlgs_autosar_swc_rlgs_Step_sys_rlgs1_alc1_alc_lcAvoidObstacle "autosar_swc_rlgs/autosar_swc_rlgs_Step_sys/rlgs1/alc1/alc_lcAvoidObstacle"
 /begin SUB_GROUP autosar_swc_rlgs_autosar_swc_rlgs_Step_sys_rlgs1_alc1_alc_lcAvoidObstacle_ConelcAvoid1 /end SUB_GROUP
/end GROUP
/begin GROUP autosar_swc_rlgs_autosar_swc_rlgs_Step_sys_rlgs1_alc1_alc_lcAvoidObstacle_ConelcAvoid1 "autosar_swc_rlgs/autosar_swc_rlgs_Step_sys/rlgs1/alc1/alc_lcAvoidObstacle/ConelcAvoid1"
 /begin SUB_GROUP autosar_swc_rlgs_autosar_swc_rlgs_Step_sys_rlgs1_alc1_alc_lcAvoidObstacle_ConelcAvoid1_Compare_To_Constant1 autosar_swc_rlgs_autosar_swc_rlgs_Step_sys_rlgs1_alc1_alc_lcAvoidObstacle_ConelcAvoid1_Counter1 autosar_swc_rlgs_autosar_swc_rlgs_Step_sys_rlgs1_alc1_alc_lcAvoidObstacle_ConelcAvoid1_Subsystem1 autosar_swc_rlgs_autosar_swc_rlgs_Step_sys_rlgs1_alc1_alc_lcAvoidObstacle_ConelcAvoid1_getLcDir /end SUB_GROUP
 /begin REF_CHARACTERISTIC P_ALC_LcAvoidConeObsSwitch P_PSM_ConeRoadEdge2LineLatDisThresvalue P_PSM_ConeStartThresValue P_PSM_L1AndLeftConeSimilarErrValue P_PSM_R1AndRiConeSimilarErrValue P_PSM_TFCDisComMaxThresValue P_PSM_TFCDisComMinThresValue P_PSM_TFCDisMaxThresValue P_PSM_TFCDisMinThresValue P_PSM_TFCMaxThresValue P_PSM_TFCMinThresValue P_PSM_TFCRoadWidthMax P_PSM_TFCRoadWidthMin /end REF_CHARACTERISTIC
 /begin REF_MEASUREMENT PSM_HostLaneExitConeFlag PSM_LcAvoidConeLeft PSM_LcAvoidConeRight PSM_LcConeLeDirValid PSM_LcConeTkRiDirValid /end REF_MEASUREMENT
/end GROUP
/begin GROUP autosar_swc_rlgs_autosar_swc_rlgs_Step_sys_rlgs1_alc1_alc_lcAvoidObstacle_ConelcAvoid1_Compare_To_Constant1 "autosar_swc_rlgs/autosar_swc_rlgs_Step_sys/rlgs1/alc1/alc_lcAvoidObstacle/ConelcAvoid1/Compare\nTo Constant1" /begin REF_CHARACTERISTIC P_PSM_ConeInHostLaneFlagConfirmTime /end REF_CHARACTERISTIC /begin REF_MEASUREMENT PSM_HostLaneExitConeFlag /end REF_MEASUREMENT /end GROUP
/begin GROUP autosar_swc_rlgs_autosar_swc_rlgs_Step_sys_rlgs1_alc1_alc_lcAvoidObstacle_ConelcAvoid1_Counter1 "autosar_swc_rlgs/autosar_swc_rlgs_Step_sys/rlgs1/alc1/alc_lcAvoidObstacle/ConelcAvoid1/Counter1" /begin REF_MEASUREMENT autosar_swc_rlgs_rtARID_DEF.UnitDelay_DSTATE_d3 /end REF_MEASUREMENT /end GROUP
/begin GROUP autosar_swc_rlgs_autosar_swc_rlgs_Step_sys_rlgs1_alc1_alc_lcAvoidObstacle_ConelcAvoid1_Subsystem1 "autosar_swc_rlgs/autosar_swc_rlgs_Step_sys/rlgs1/alc1/alc_lcAvoidObstacle/ConelcAvoid1/Subsystem1" /begin REF_MEASUREMENT autosar_swc_rlgs_rtARID_DEF.UnitDelay_DSTATE_cc /end REF_MEASUREMENT /end GROUP
/begin GROUP autosar_swc_rlgs_autosar_swc_rlgs_Step_sys_rlgs1_alc1_alc_lcAvoidObstacle_ConelcAvoid1_getLcDir "autosar_swc_rlgs/autosar_swc_rlgs_Step_sys/rlgs1/alc1/alc_lcAvoidObstacle/ConelcAvoid1/getLcDir" /begin REF_CHARACTERISTIC P_ALC_LcTkOverMapLimEnable /end REF_CHARACTERISTIC /begin REF_MEASUREMENT PSM_LcConeLeDirValid PSM_LcConeTkRiDirValid /end REF_MEASUREMENT /end GROUP
/begin GROUP autosar_swc_rlgs_autosar_swc_rlgs_Step_sys_rlgs1_alc1_alc_lcDrv1 "autosar_swc_rlgs/autosar_swc_rlgs_Step_sys/rlgs1/alc1/alc_lcDrv1"
 /begin SUB_GROUP autosar_swc_rlgs_autosar_swc_rlgs_Step_sys_rlgs1_alc1_alc_lcDrv1_Compare_To_Constant1 autosar_swc_rlgs_autosar_swc_rlgs_Step_sys_rlgs1_alc1_alc_lcDrv1_Compare_To_Constant5 autosar_swc_rlgs_autosar_swc_rlgs_Step_sys_rlgs1_alc1_alc_lcDrv1_Counter1 autosar_swc_rlgs_autosar_swc_rlgs_Step_sys_rlgs1_alc1_alc_lcDrv1_Counter2 /end SUB_GROUP
 /begin REF_CHARACTERISTIC P_ALC_LCDrvDelayCnt P_ALC_LcOverTkCancelSwitch /end REF_CHARACTERISTIC
 /begin REF_MEASUREMENT RLGS_PSM_LciDrvCondsLe RLGS_PSM_LciDrvCondsRi autosar_swc_rlgs_rtARID_DEF.AutoLmpStsFlag autosar_swc_rlgs_rtARID_DEF.AutoLmpStsFlag_f autosar_swc_rlgs_rtARID_DEF.HoldCond1 autosar_swc_rlgs_rtARID_DEF.HoldCond1_d autosar_swc_rlgs_rtARID_DEF.HoldCond2 autosar_swc_rlgs_rtARID_DEF.HoldCond2_c autosar_swc_rlgs_rtARID_DEF.HoldCond3 autosar_swc_rlgs_rtARID_DEF.HoldCond3_l autosar_swc_rlgs_rtARID_DEF.HoldCond4 autosar_swc_rlgs_rtARID_DEF.HoldCond4_o autosar_swc_rlgs_rtARID_DEF.Lci autosar_swc_rlgs_rtARID_DEF.Lci_c autosar_swc_rlgs_rtARID_DEF.OverTime autosar_swc_rlgs_rtARID_DEF.OverTime_m /end REF_MEASUREMENT
/end GROUP
/begin GROUP autosar_swc_rlgs_autosar_swc_rlgs_Step_sys_rlgs1_alc1_alc_lcDrv1_Compare_To_Constant1 "autosar_swc_rlgs/autosar_swc_rlgs_Step_sys/rlgs1/alc1/alc_lcDrv1/Compare\nTo Constant1" /begin REF_CHARACTERISTIC P_PSM_IPVehSpdMinPreLC_Drv /end REF_CHARACTERISTIC /end GROUP
/begin GROUP autosar_swc_rlgs_autosar_swc_rlgs_Step_sys_rlgs1_alc1_alc_lcDrv1_Compare_To_Constant5 "autosar_swc_rlgs/autosar_swc_rlgs_Step_sys/rlgs1/alc1/alc_lcDrv1/Compare\nTo Constant5" /begin REF_CHARACTERISTIC P_PSM_IPVehSpdMaxPreLC_Drv /end REF_CHARACTERISTIC /end GROUP
/begin GROUP autosar_swc_rlgs_autosar_swc_rlgs_Step_sys_rlgs1_alc1_alc_lcDrv1_Counter1 "autosar_swc_rlgs/autosar_swc_rlgs_Step_sys/rlgs1/alc1/alc_lcDrv1/Counter1" /begin REF_MEASUREMENT autosar_swc_rlgs_rtARID_DEF.UnitDelay_DSTATE_jv /end REF_MEASUREMENT /end GROUP
/begin GROUP autosar_swc_rlgs_autosar_swc_rlgs_Step_sys_rlgs1_alc1_alc_lcDrv1_Counter2 "autosar_swc_rlgs/autosar_swc_rlgs_Step_sys/rlgs1/alc1/alc_lcDrv1/Counter2" /begin REF_MEASUREMENT autosar_swc_rlgs_rtARID_DEF.UnitDelay_DSTATE_ob /end REF_MEASUREMENT /end GROUP
/begin GROUP autosar_swc_rlgs_autosar_swc_rlgs_Step_sys_rlgs1_alc1_alc_lcOverTk "autosar_swc_rlgs/autosar_swc_rlgs_Step_sys/rlgs1/alc1/alc_lcOverTk"
 /begin SUB_GROUP autosar_swc_rlgs_autosar_swc_rlgs_Step_sys_rlgs1_alc1_alc_lcOverTk_getLcCancelCond autosar_swc_rlgs_autosar_swc_rlgs_Step_sys_rlgs1_alc1_alc_lcOverTk_getLcDir autosar_swc_rlgs_autosar_swc_rlgs_Step_sys_rlgs1_alc1_alc_lcOverTk_getSpdGainCond autosar_swc_rlgs_autosar_swc_rlgs_Step_sys_rlgs1_alc1_alc_lcOverTk_isSpeedSuppressed1 autosar_swc_rlgs_autosar_swc_rlgs_Step_sys_rlgs1_alc1_alc_lcOverTk_lcOverTkDecs /end SUB_GROUP
/end GROUP
/begin GROUP autosar_swc_rlgs_autosar_swc_rlgs_Step_sys_rlgs1_alc1_alc_lcOverTk_getLcCancelCond "autosar_swc_rlgs/autosar_swc_rlgs_Step_sys/rlgs1/alc1/alc_lcOverTk/getLcCancelCond" /begin REF_CHARACTERISTIC P_ALC_LcOverTkCancelSwitch P_PSM_LcTkOverCancelThreshold /end REF_CHARACTERISTIC /end GROUP
/begin GROUP autosar_swc_rlgs_autosar_swc_rlgs_Step_sys_rlgs1_alc1_alc_lcOverTk_getLcDir "autosar_swc_rlgs/autosar_swc_rlgs_Step_sys/rlgs1/alc1/alc_lcOverTk/getLcDir"
 /begin SUB_GROUP autosar_swc_rlgs_autosar_swc_rlgs_Step_sys_rlgs1_alc1_alc_lcOverTk_getLcDir_Compare_To_Constant4 autosar_swc_rlgs_autosar_swc_rlgs_Step_sys_rlgs1_alc1_alc_lcOverTk_getLcDir_Compare_To_Constant60 autosar_swc_rlgs_autosar_swc_rlgs_Step_sys_rlgs1_alc1_alc_lcOverTk_getLcDir_Counter1 autosar_swc_rlgs_autosar_swc_rlgs_Step_sys_rlgs1_alc1_alc_lcOverTk_getLcDir_Counter3 autosar_swc_rlgs_autosar_swc_rlgs_Step_sys_rlgs1_alc1_alc_lcOverTk_getLcDir_Subsystem1 autosar_swc_rlgs_autosar_swc_rlgs_Step_sys_rlgs1_alc1_alc_lcOverTk_getLcDir_Subsystem2 /end SUB_GROUP
 /begin REF_CHARACTERISTIC P_ALC_LcTkOverMapLimEnable P_ALC_PathValidConfirmCnt /end REF_CHARACTERISTIC
 /begin REF_MEASUREMENT PSM_LcOverTkLeDirValid PSM_LcOverTkRiDirValid /end REF_MEASUREMENT
/end GROUP
/begin GROUP autosar_swc_rlgs_autosar_swc_rlgs_Step_sys_rlgs1_alc1_alc_lcOverTk_getLcDir_Compare_To_Constant4 "autosar_swc_rlgs/autosar_swc_rlgs_Step_sys/rlgs1/alc1/alc_lcOverTk/getLcDir/Compare\nTo Constant4" /begin REF_CHARACTERISTIC P_PSM_LineAvaiLcAffirmTime /end REF_CHARACTERISTIC /end GROUP
/begin GROUP autosar_swc_rlgs_autosar_swc_rlgs_Step_sys_rlgs1_alc1_alc_lcOverTk_getLcDir_Compare_To_Constant60 "autosar_swc_rlgs/autosar_swc_rlgs_Step_sys/rlgs1/alc1/alc_lcOverTk/getLcDir/Compare\nTo Constant60" /begin REF_CHARACTERISTIC P_PSM_LineAvaiLcAffirmTime /end REF_CHARACTERISTIC /end GROUP
/begin GROUP autosar_swc_rlgs_autosar_swc_rlgs_Step_sys_rlgs1_alc1_alc_lcOverTk_getLcDir_Counter1 "autosar_swc_rlgs/autosar_swc_rlgs_Step_sys/rlgs1/alc1/alc_lcOverTk/getLcDir/Counter1" /begin REF_MEASUREMENT autosar_swc_rlgs_rtARID_DEF.UnitDelay_DSTATE_htr /end REF_MEASUREMENT /end GROUP
/begin GROUP autosar_swc_rlgs_autosar_swc_rlgs_Step_sys_rlgs1_alc1_alc_lcOverTk_getLcDir_Counter3 "autosar_swc_rlgs/autosar_swc_rlgs_Step_sys/rlgs1/alc1/alc_lcOverTk/getLcDir/Counter3" /begin REF_MEASUREMENT autosar_swc_rlgs_rtARID_DEF.UnitDelay_DSTATE_il /end REF_MEASUREMENT /end GROUP
/begin GROUP autosar_swc_rlgs_autosar_swc_rlgs_Step_sys_rlgs1_alc1_alc_lcOverTk_getLcDir_Subsystem1 "autosar_swc_rlgs/autosar_swc_rlgs_Step_sys/rlgs1/alc1/alc_lcOverTk/getLcDir/Subsystem1" /begin REF_CHARACTERISTIC P_PSM_StepTime /end REF_CHARACTERISTIC /begin REF_MEASUREMENT autosar_swc_rlgs_rtARID_DEF.UnitDelay_DSTATE_g /end REF_MEASUREMENT /end GROUP
/begin GROUP autosar_swc_rlgs_autosar_swc_rlgs_Step_sys_rlgs1_alc1_alc_lcOverTk_getLcDir_Subsystem2 "autosar_swc_rlgs/autosar_swc_rlgs_Step_sys/rlgs1/alc1/alc_lcOverTk/getLcDir/Subsystem2" /begin REF_CHARACTERISTIC P_PSM_StepTime /end REF_CHARACTERISTIC /begin REF_MEASUREMENT autosar_swc_rlgs_rtARID_DEF.UnitDelay_DSTATE_o /end REF_MEASUREMENT /end GROUP
/begin GROUP autosar_swc_rlgs_autosar_swc_rlgs_Step_sys_rlgs1_alc1_alc_lcOverTk_getSpdGainCond "autosar_swc_rlgs/autosar_swc_rlgs_Step_sys/rlgs1/alc1/alc_lcOverTk/getSpdGainCond"
 /begin SUB_GROUP autosar_swc_rlgs_autosar_swc_rlgs_Step_sys_rlgs1_alc1_alc_lcOverTk_getSpdGainCond_Subsystem1 autosar_swc_rlgs_autosar_swc_rlgs_Step_sys_rlgs1_alc1_alc_lcOverTk_getSpdGainCond_Subsystem2 /end SUB_GROUP
 /begin REF_CHARACTERISTIC P_PSM_LcOverTkSpdThreshold P_PSM_LcTkObjLeftTime P_PSM_LcTkObjRainTime P_PSM_LcTkObjRightTime P_PSM_RiLcOverTkSpdThreshold /end REF_CHARACTERISTIC
 /begin REF_MEASUREMENT PSM_LcOverTkCondSpdGainRi PSM_LcOverTkCondsSpdGainLe /end REF_MEASUREMENT
/end GROUP
/begin GROUP autosar_swc_rlgs_autosar_swc_rlgs_Step_sys_rlgs1_alc1_alc_lcOverTk_getSpdGainCond_Subsystem1 "autosar_swc_rlgs/autosar_swc_rlgs_Step_sys/rlgs1/alc1/alc_lcOverTk/getSpdGainCond/Subsystem1" /begin REF_CHARACTERISTIC P_PSM_StepTime /end REF_CHARACTERISTIC /begin REF_MEASUREMENT autosar_swc_rlgs_rtARID_DEF.UnitDelay_DSTATE_fe /end REF_MEASUREMENT /end GROUP
/begin GROUP autosar_swc_rlgs_autosar_swc_rlgs_Step_sys_rlgs1_alc1_alc_lcOverTk_getSpdGainCond_Subsystem2 "autosar_swc_rlgs/autosar_swc_rlgs_Step_sys/rlgs1/alc1/alc_lcOverTk/getSpdGainCond/Subsystem2" /begin REF_CHARACTERISTIC P_PSM_StepTime /end REF_CHARACTERISTIC /begin REF_MEASUREMENT autosar_swc_rlgs_rtARID_DEF.UnitDelay_DSTATE_fem /end REF_MEASUREMENT /end GROUP
/begin GROUP autosar_swc_rlgs_autosar_swc_rlgs_Step_sys_rlgs1_alc1_alc_lcOverTk_isSpeedSuppressed1 "autosar_swc_rlgs/autosar_swc_rlgs_Step_sys/rlgs1/alc1/alc_lcOverTk/isSpeedSuppressed1"
 /begin SUB_GROUP autosar_swc_rlgs_autosar_swc_rlgs_Step_sys_rlgs1_alc1_alc_lcOverTk_isSpeedSuppressed1_Compare_To_Constant1 autosar_swc_rlgs_autosar_swc_rlgs_Step_sys_rlgs1_alc1_alc_lcOverTk_isSpeedSuppressed1_Counter1 /end SUB_GROUP
 /begin REF_CHARACTERISTIC P_PSM_SpeedSuppressedConfirmTime P_PSM_SpeedSuppressedErrorTable /end REF_CHARACTERISTIC
/end GROUP
/begin GROUP autosar_swc_rlgs_autosar_swc_rlgs_Step_sys_rlgs1_alc1_alc_lcOverTk_isSpeedSuppressed1_Compare_To_Constant1 "autosar_swc_rlgs/autosar_swc_rlgs_Step_sys/rlgs1/alc1/alc_lcOverTk/isSpeedSuppressed1/Compare\nTo Constant1" /begin REF_CHARACTERISTIC P_PSM_SpeedSuppressedMinValue /end REF_CHARACTERISTIC /end GROUP
/begin GROUP autosar_swc_rlgs_autosar_swc_rlgs_Step_sys_rlgs1_alc1_alc_lcOverTk_isSpeedSuppressed1_Counter1 "autosar_swc_rlgs/autosar_swc_rlgs_Step_sys/rlgs1/alc1/alc_lcOverTk/isSpeedSuppressed1/Counter1" /begin REF_CHARACTERISTIC P_PSM_StepTime /end REF_CHARACTERISTIC /begin REF_MEASUREMENT autosar_swc_rlgs_rtARID_DEF.UnitDelay_DSTATE_b /end REF_MEASUREMENT /end GROUP
/begin GROUP autosar_swc_rlgs_autosar_swc_rlgs_Step_sys_rlgs1_alc1_alc_lcOverTk_lcOverTkDecs "autosar_swc_rlgs/autosar_swc_rlgs_Step_sys/rlgs1/alc1/alc_lcOverTk/lcOverTkDecs"
 /begin SUB_GROUP autosar_swc_rlgs_autosar_swc_rlgs_Step_sys_rlgs1_alc1_alc_lcOverTk_lcOverTkDecs_Compare_To_Constant13 autosar_swc_rlgs_autosar_swc_rlgs_Step_sys_rlgs1_alc1_alc_lcOverTk_lcOverTkDecs_Counter1 autosar_swc_rlgs_autosar_swc_rlgs_Step_sys_rlgs1_alc1_alc_lcOverTk_lcOverTkDecs_LP_filter autosar_swc_rlgs_autosar_swc_rlgs_Step_sys_rlgs1_alc1_alc_lcOverTk_lcOverTkDecs_Subsystem /end SUB_GROUP
 /begin REF_CHARACTERISTIC P_ALC_LcOverTk_InhibitFlagEnable P_ALC_LcOverTk_LcSnvtySetEnable P_ALC_LcOverTk_NoOverrideEnable P_ALC_NOHNotActiveHoldCnt P_ALC_OveTkrSupDistSet P_PSM_A2S_FliterTime P_PSM_A2_Pretime P_PSM_LcOverInhibitTime P_PSM_LcOverTkCurveLimitValue P_PSM_LeftLcOverInhibitTimeAfterMerge P_PSM_MergeInhibitLcOverSW P_PSM_StepTime /end REF_CHARACTERISTIC
 /begin REF_MEASUREMENT PSM_LcOverInhibitFlag PSM_LcOverTkCurveLimit PSM_LcOverTk_ALCSwtOn PSM_LcOverTk_NoOverride PSM_LcOverTk_NohstsInhibit PSM_LcOverTk_SpeedSuppressed PSM_MergeInhibitLeftLcOverFlag autosar_swc_rlgs_rtARID_DEF.InhibitTime autosar_swc_rlgs_rtARID_DEF.LcInhibitTime autosar_swc_rlgs_rtARID_DEF.dist autosar_swc_rlgs_rtARID_DEF.hold_cnt autosar_swc_rlgs_rtARID_DEF.is_active_c1359_autosar_swc_rlgs autosar_swc_rlgs_rtARID_DEF.is_active_c1360_autosar_swc_rlgs autosar_swc_rlgs_rtARID_DEF.is_active_c1361_autosar_swc_rlgs autosar_swc_rlgs_rtARID_DEF.is_active_c1362_autosar_swc_rlgs autosar_swc_rlgs_rtARID_DEF.is_c1359_autosar_swc_rlgs autosar_swc_rlgs_rtARID_DEF.is_c1360_autosar_swc_rlgs autosar_swc_rlgs_rtARID_DEF.is_c1361_autosar_swc_rlgs autosar_swc_rlgs_rtARID_DEF.is_c1362_autosar_swc_rlgs /end REF_MEASUREMENT
/end GROUP
/begin GROUP autosar_swc_rlgs_autosar_swc_rlgs_Step_sys_rlgs1_alc1_alc_lcOverTk_lcOverTkDecs_Compare_To_Constant13 "autosar_swc_rlgs/autosar_swc_rlgs_Step_sys/rlgs1/alc1/alc_lcOverTk/lcOverTkDecs/Compare\nTo Constant13" /begin REF_MEASUREMENT PSM_LcOverTk_NoTurnLampReq /end REF_MEASUREMENT /end GROUP
/begin GROUP autosar_swc_rlgs_autosar_swc_rlgs_Step_sys_rlgs1_alc1_alc_lcOverTk_lcOverTkDecs_Counter1 "autosar_swc_rlgs/autosar_swc_rlgs_Step_sys/rlgs1/alc1/alc_lcOverTk/lcOverTkDecs/Counter1" /begin REF_MEASUREMENT autosar_swc_rlgs_rtARID_DEF.UnitDelay_DSTATE_nw /end REF_MEASUREMENT /end GROUP
/begin GROUP autosar_swc_rlgs_autosar_swc_rlgs_Step_sys_rlgs1_alc1_alc_lcOverTk_lcOverTkDecs_LP_filter "autosar_swc_rlgs/autosar_swc_rlgs_Step_sys/rlgs1/alc1/alc_lcOverTk/lcOverTkDecs/LP filter" /begin REF_MEASUREMENT autosar_swc_rlgs_rtARID_DEF.UnitDelay_DSTATE_pa /end REF_MEASUREMENT /end GROUP
/begin GROUP autosar_swc_rlgs_autosar_swc_rlgs_Step_sys_rlgs1_alc1_alc_lcOverTk_lcOverTkDecs_Subsystem "autosar_swc_rlgs/autosar_swc_rlgs_Step_sys/rlgs1/alc1/alc_lcOverTk/lcOverTkDecs/Subsystem" /begin REF_CHARACTERISTIC P_PSM_SuppreLcOverTkStubDis /end REF_CHARACTERISTIC /end GROUP
/begin GROUP autosar_swc_rlgs_autosar_swc_rlgs_Step_sys_rlgs1_alc1_alc_pathCalc "autosar_swc_rlgs/autosar_swc_rlgs_Step_sys/rlgs1/alc1/alc_pathCalc" /begin REF_CHARACTERISTIC P_ALC_pathPolyMatchTol P_PSM_StepTime /end REF_CHARACTERISTIC /end GROUP
/begin GROUP autosar_swc_rlgs_autosar_swc_rlgs_Step_sys_rlgs1_alc1_alc_sm "autosar_swc_rlgs/autosar_swc_rlgs_Step_sys/rlgs1/alc1/alc_sm"
 /begin SUB_GROUP autosar_swc_rlgs_autosar_swc_rlgs_Step_sys_rlgs1_alc1_alc_sm_alc_lcNoh /end SUB_GROUP
 /begin REF_CHARACTERISTIC P_ALC_VoiceLcEnable P_PSM_SplitLcCtrlLevel /end REF_CHARACTERISTIC
 /begin REF_MEASUREMENT PSM_LcAvoidConeLeft PSM_LcAvoidConeRight PSM_reserve01 autosar_swc_rlgs_rtARID_DEF.ALC_LcCtrlLevel autosar_swc_rlgs_rtARID_DEF.LcIntentionSubState autosar_swc_rlgs_rtARID_DEF.LcReason autosar_swc_rlgs_rtARID_DEF.TarPathIndex autosar_swc_rlgs_rtARID_DEF.cnt autosar_swc_rlgs_rtARID_DEF.host_lane_idx autosar_swc_rlgs_rtARID_DEF.is_LeLCP autosar_swc_rlgs_rtARID_DEF.is_RiLCP autosar_swc_rlgs_rtARID_DEF.is_active_c1074_autosar_swc_rlgs autosar_swc_rlgs_rtARID_DEF.is_c1074_autosar_swc_rlgs autosar_swc_rlgs_rtARID_DEF.is_lane_change_req autosar_swc_rlgs_rtARID_DEF.lc_req autosar_swc_rlgs_rtARID_DEF.lc_req_sync_id /end REF_MEASUREMENT
/end GROUP
/begin GROUP autosar_swc_rlgs_autosar_swc_rlgs_Step_sys_rlgs1_alc1_alc_sm_alc_lcNoh "autosar_swc_rlgs/autosar_swc_rlgs_Step_sys/rlgs1/alc1/alc_sm/alc_lcNoh" /begin REF_CHARACTERISTIC P_PSM_IPVehSpdMinPreLC_Noh /end REF_CHARACTERISTIC /end GROUP
/begin RECORD_LAYOUT Record_BOOLEAN FNC_VALUES 1 UBYTE COLUMN_DIR DIRECT /end RECORD_LAYOUT
/begin RECORD_LAYOUT Record_FLOAT32_IEEE FNC_VALUES 1 FLOAT32_IEEE COLUMN_DIR DIRECT /end RECORD_LAYOUT
/begin RECORD_LAYOUT Record_FLOAT64_IEEE FNC_VALUES 1 FLOAT64_IEEE COLUMN_DIR DIRECT /end RECORD_LAYOUT
/begin RECORD_LAYOUT Record_SLONG FNC_VALUES 1 SLONG COLUMN_DIR DIRECT /end RECORD_LAYOUT
/begin RECORD_LAYOUT Record_UBYTE FNC_VALUES 1 UBYTE COLUMN_DIR DIRECT /end RECORD_LAYOUT
/begin RECORD_LAYOUT Record_UWORD FNC_VALUES 1 UWORD COLUMN_DIR DIRECT /end RECORD_LAYOUT
/begin RECORD_LAYOUT Record_BOOLEAN FNC_VALUES 1 UBYTE COLUMN_DIR DIRECT /end RECORD_LAYOUT
/begin RECORD_LAYOUT Record_FLOAT32_IEEE FNC_VALUES 1 FLOAT32_IEEE COLUMN_DIR DIRECT /end RECORD_LAYOUT
/begin RECORD_LAYOUT Record_FLOAT64_IEEE FNC_VALUES 1 FLOAT64_IEEE COLUMN_DIR DIRECT /end RECORD_LAYOUT
/begin RECORD_LAYOUT Record_UBYTE FNC_VALUES 1 UBYTE COLUMN_DIR DIRECT /end RECORD_LAYOUT
/begin RECORD_LAYOUT Record_UWORD FNC_VALUES 1 UWORD COLUMN_DIR DIRECT /end RECORD_LAYOUT
/begin RECORD_LAYOUT Axis_FLOAT32_IEEE AXIS_PTS_X 1 FLOAT32_IEEE INDEX_INCR DIRECT /end RECORD_LAYOUT
/begin RECORD_LAYOUT Record_BOOLEAN FNC_VALUES 1 UBYTE COLUMN_DIR DIRECT /end RECORD_LAYOUT
/begin RECORD_LAYOUT Record_FLOAT32_IEEE FNC_VALUES 1 FLOAT32_IEEE COLUMN_DIR DIRECT /end RECORD_LAYOUT
/begin RECORD_LAYOUT Record_FLOAT64_IEEE FNC_VALUES 1 FLOAT64_IEEE COLUMN_DIR DIRECT /end RECORD_LAYOUT
/begin RECORD_LAYOUT Record_UBYTE FNC_VALUES 1 UBYTE COLUMN_DIR DIRECT /end RECORD_LAYOUT
/begin RECORD_LAYOUT Record_UWORD FNC_VALUES 1 UWORD COLUMN_DIR DIRECT /end RECORD_LAYOUT
/begin RECORD_LAYOUT Axis_FLOAT32_IEEE AXIS_PTS_X 1 FLOAT32_IEEE INDEX_INCR DIRECT /end RECORD_LAYOUT
/begin RECORD_LAYOUT Record_BOOLEAN FNC_VALUES 1 UBYTE COLUMN_DIR DIRECT /end RECORD_LAYOUT
/begin RECORD_LAYOUT Record_FLOAT32_IEEE FNC_VALUES 1 FLOAT32_IEEE COLUMN_DIR DIRECT /end RECORD_LAYOUT
/begin RECORD_LAYOUT Record_FLOAT64_IEEE FNC_VALUES 1 FLOAT64_IEEE COLUMN_DIR DIRECT /end RECORD_LAYOUT
/begin RECORD_LAYOUT Record_UBYTE FNC_VALUES 1 UBYTE COLUMN_DIR DIRECT /end RECORD_LAYOUT
/begin RECORD_LAYOUT Record_UWORD FNC_VALUES 1 UWORD COLUMN_DIR DIRECT /end RECORD_LAYOUT
/begin RECORD_LAYOUT Axis_FLOAT32_IEEE AXIS_PTS_X 1 FLOAT32_IEEE INDEX_INCR DIRECT /end RECORD_LAYOUT
/begin RECORD_LAYOUT Record_BOOLEAN FNC_VALUES 1 UBYTE COLUMN_DIR DIRECT /end RECORD_LAYOUT
/begin RECORD_LAYOUT Record_FLOAT32_IEEE FNC_VALUES 1 FLOAT32_IEEE COLUMN_DIR DIRECT /end RECORD_LAYOUT
/begin RECORD_LAYOUT Record_FLOAT64_IEEE FNC_VALUES 1 FLOAT64_IEEE COLUMN_DIR DIRECT /end RECORD_LAYOUT
/begin RECORD_LAYOUT Record_SLONG FNC_VALUES 1 SLONG COLUMN_DIR DIRECT /end RECORD_LAYOUT
/begin RECORD_LAYOUT Record_UBYTE FNC_VALUES 1 UBYTE COLUMN_DIR DIRECT /end RECORD_LAYOUT
/begin RECORD_LAYOUT Record_UWORD FNC_VALUES 1 UWORD COLUMN_DIR DIRECT /end RECORD_LAYOUT
/begin RECORD_LAYOUT Axis_FLOAT32_IEEE AXIS_PTS_X 1 FLOAT32_IEEE INDEX_INCR DIRECT /end RECORD_LAYOUT
/end MODULE
/end PROJECT
